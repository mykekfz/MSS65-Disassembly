/begin PROJECT MSS65-inj-V912 "MSS65 INJ - V912.00-B204.00, data set 0569Q60Z520E"
/begin HEADER "" VERSION "V912.00-B204.00" /end HEADER
/begin MODULE _MSS65-inj "MSS65 INJ - V912.00-B204.00, data 7842800"
/begin MOD_COMMON "" BYTE_ORDER MSB_FIRST /* Default byteorder (Motorola) */ /end MOD_COMMON
/* ------------------ Abschnitt erzeugt aus adapt_common.dat ------------------ */
/begin COMPU_METHOD FORMULA_0000 "FORMULA_0000" RAT_FUNC "%7.0" "-" COEFFS 0 1 0 0 0 1 /end COMPU_METHOD
/begin COMPU_METHOD FORMULA_0001 "FORMULA_0001" RAT_FUNC "%6.1" "%" COEFFS 0 10 0 0 0 1 /end COMPU_METHOD
/begin COMPU_METHOD FORMULA_0003 "FORMULA_0003" RAT_FUNC "%3.0" "-" COEFFS 0 1 0 0 0 1 /end COMPU_METHOD
/begin COMPU_METHOD FORMULA_0006 "FORMULA_0006" RAT_FUNC "%5.0" "Upm" COEFFS 0 1 0 0 0 1 /end COMPU_METHOD
/begin COMPU_METHOD FORMULA_0007 "FORMULA_0007" RAT_FUNC "%8.3" "-" COEFFS 0 10000 0 0 0 1 /end COMPU_METHOD
/begin COMPU_METHOD FORMULA_0010 "FORMULA_0010" RAT_FUNC "%5.0" "-" COEFFS 0 1 0 0 0 1 /end COMPU_METHOD
/begin COMPU_METHOD FORMULA_0021 "FORMULA_0021" RAT_FUNC "%7.2" "s" COEFFS 0 100 0 0 0 1 /end COMPU_METHOD
/* ------------------ Abschnitt erzeugt aus adapt_glob.dat ------------------ */
/begin COMPU_METHOD FORMULA_0023 "FORMULA_0023" RAT_FUNC "%6.1" "�C" COEFFS 0 10 2732 0 0 1 /end COMPU_METHOD
/begin COMPU_METHOD FORMULA_0024 "FORMULA_0024" RAT_FUNC "%9.4" "-" COEFFS 0 32768 0 0 0 1 /end COMPU_METHOD
/begin COMPU_METHOD FORMULA_0025 "FORMULA_0025" RAT_FUNC "%8.3" "-" COEFFS 0 16384 0 0 0 1 /end COMPU_METHOD
/begin COMPU_METHOD FORMULA_0033 "FORMULA_0033" RAT_FUNC "%5.2" "-" COEFFS 0 1 0 0 0 1 /end COMPU_METHOD
/begin COMPU_METHOD FORMULA_0062 "FORMULA_0062" RAT_FUNC "%5.0" "s" COEFFS 0 1 0 0 0 1 /end COMPU_METHOD
/begin COMPU_METHOD FORMULA_0073 "FORMULA_0073" RAT_FUNC "%6.1" "s" COEFFS 0 10 0 0 0 1 /end COMPU_METHOD
/begin COMPU_METHOD FORMULA_0075 "FORMULA_0075" RAT_FUNC "%8.3" "-" COEFFS 0 1024 0 0 0 1 /end COMPU_METHOD
/begin COMPU_METHOD FORMULA_0077 "FORMULA_0077" RAT_FUNC "%6.1" "mbar" COEFFS 0 16 0 0 0 1 /end COMPU_METHOD
/begin COMPU_METHOD FORMULA_0078 "FORMULA_0078" RAT_FUNC "%6.1" "km/h" COEFFS 0 16 0 0 0 1 /end COMPU_METHOD
/* ------------------ Abschnitt erzeugt aus glob.dat ------------------ */
/begin COMPU_METHOD FORMULA_0083 "FORMULA_0083" RAT_FUNC "%7.2" "-" COEFFS 0 1 0 0 0 1 /end COMPU_METHOD
/begin COMPU_METHOD FORMULA_0093 "FORMULA_0093" RAT_FUNC "%7.2" "mg" COEFFS 0 10 0 0 0 1 /end COMPU_METHOD
/begin COMPU_METHOD FORMULA_0111 "FORMULA_0111" RAT_FUNC "%6.1" "�KW" COEFFS 0 10 0 0 0 1 /end COMPU_METHOD
/begin COMPU_METHOD FORMULA_0112 "FORMULA_0112" RAT_FUNC "%6.1" "kg/h" COEFFS 0 10 0 0 0 1 /end COMPU_METHOD
/begin COMPU_METHOD FORMULA_0115 "FORMULA_0115" RAT_FUNC "%7.2" "%" COEFFS 0 16384 0 0 0 100 /end COMPU_METHOD
/begin COMPU_METHOD FORMULA_0117 "FORMULA_0117" RAT_FUNC "%7.2" "s" COEFFS 0 200 0 0 0 1 /end COMPU_METHOD
/begin COMPU_METHOD FORMULA_0118 "FORMULA_0118" RAT_FUNC "%8.3" "bar" COEFFS 0 1000 0 0 0 1 /end COMPU_METHOD
/begin COMPU_METHOD FORMULA_0140 "FORMULA_0140" RAT_FUNC "%5.0" "bar/s" COEFFS 0 1 0 0 0 50 /end COMPU_METHOD
/begin COMPU_METHOD FORMULA_0147 "FORMULA_0147" RAT_FUNC "%6.1" "qmm" COEFFS 0 10 0 0 0 1 /end COMPU_METHOD
/begin COMPU_METHOD FORMULA_0232 "FORMULA_0232" RAT_FUNC "%3.0" "s" COEFFS 0 1 0 0 0 1 /end COMPU_METHOD
/begin COMPU_METHOD FORMULA_0233 "FORMULA_0233" TAB_VERB "%3.0" "-" COMPU_TAB_REF FORMULA_0233_VTAB /end COMPU_METHOD
/begin COMPU_VTAB FORMULA_0233_VTAB "FORMULA_0233_VTAB" TAB_VERB 4 0 "k. Aenderung" 1 "Aus" 2 "Ein" 4 "Sport" DEFAULT_VALUE "undef" /end COMPU_VTAB
/begin COMPU_METHOD FORMULA_0234 "FORMULA_0234" TAB_VERB "%3.0" "-" COMPU_TAB_REF FORMULA_0234_VTAB /end COMPU_METHOD
/begin COMPU_VTAB FORMULA_0234_VTAB "FORMULA_0234_VTAB" TAB_VERB 3 0 "k. Aenderung" 1 "Automat" 2 "Sequentiell" DEFAULT_VALUE "undef" /end COMPU_VTAB
/begin COMPU_METHOD FORMULA_0236 "FORMULA_0236" TAB_VERB "%3.0" "-" COMPU_TAB_REF FORMULA_0236_VTAB /end COMPU_METHOD
/begin COMPU_VTAB FORMULA_0236_VTAB "FORMULA_0236_VTAB" TAB_VERB 4 0 "k. Aenderung" 1 "Komfort" 2 "Normal" 3 "Sport" DEFAULT_VALUE "undef" /end COMPU_VTAB
/begin COMPU_METHOD FORMULA_0237 "FORMULA_0237" TAB_VERB "%3.0" "-" COMPU_TAB_REF FORMULA_0237_VTAB /end COMPU_METHOD
/begin COMPU_VTAB FORMULA_0237_VTAB "FORMULA_0237_VTAB" TAB_VERB 4 0 "k. Aenderung" 1 "KL1" 2 "KL2" 3 "KL3" DEFAULT_VALUE "undef" /end COMPU_VTAB
/begin COMPU_METHOD FORMULA_0238 "FORMULA_0238" TAB_VERB "%3.0" "-" COMPU_TAB_REF FORMULA_0238_VTAB /end COMPU_METHOD
/begin COMPU_VTAB FORMULA_0238_VTAB "FORMULA_0238_VTAB" TAB_VERB 2 0 "k. Aenderung" 1 "M-Cfg" DEFAULT_VALUE "undef" /end COMPU_VTAB
/begin COMPU_METHOD FORMULA_0317 "FORMULA_0317" RAT_FUNC "%5.2" "s" COEFFS 0 100 0 0 0 1 /end COMPU_METHOD
/begin COMPU_METHOD FORMULA_0344 "FORMULA_0344" TAB_VERB "%5.0" "-" COMPU_TAB_REF FORMULA_0344_VTAB /end COMPU_METHOD
/begin COMPU_VTAB FORMULA_0344_VTAB "FORMULA_0344_VTAB" TAB_VERB 1 0 "keine aus" DEFAULT_VALUE "Mind. eine abgesch." /end COMPU_VTAB
/begin COMPU_METHOD FORMULA_0345 "FORMULA_0345" TAB_VERB "%3.0" "-" COMPU_TAB_REF FORMULA_0345_VTAB /end COMPU_METHOD
/begin COMPU_VTAB FORMULA_0345_VTAB "FORMULA_0345_VTAB" TAB_VERB 3 0 "nichts" 1 "postiv" 2 "negativ" /end COMPU_VTAB
/* ------------------ Abschnitt erzeugt aus ipk.dat ------------------ */
/begin COMPU_METHOD FORMULA_0346 "FORMULA_0346" TAB_VERB "%5.2" "-" COMPU_TAB_REF FORMULA_0346_VTAB /end COMPU_METHOD
/begin COMPU_VTAB FORMULA_0346_VTAB "FORMULA_0346_VTAB" TAB_VERB 4 0 "ok" 1 "no send/busy" 2 "csum nok" 4 "Stackbereich" DEFAULT_VALUE "ungueltig" /end COMPU_VTAB
/begin COMPU_METHOD FORMULA_0347 "FORMULA_0347" RAT_FUNC "%8.1" "ms" COEFFS 0 1000 0 0 0 1 /end COMPU_METHOD
/* ------------------ Abschnitt erzeugt aus n.dat ------------------ */
/begin COMPU_METHOD FORMULA_0348 "FORMULA_0348" TAB_VERB "%3.0" "-" COMPU_TAB_REF FORMULA_0348_VTAB /end COMPU_METHOD
/begin COMPU_VTAB FORMULA_0348_VTAB "FORMULA_0348_VTAB" TAB_VERB 6 0 "Initialisierung" 1 "Zahndrehzahl" 3 "noch Zahndrehzahl" 7 "Segmentdrehzahl" 16 "Stoerung" 17 "Stoerung" DEFAULT_VALUE "Eingefroren" /end COMPU_VTAB
/begin COMPU_METHOD FORMULA_0349 "FORMULA_0349" RAT_FUNC "%7.2" "ms" COEFFS 0 625 0 0 0 1 /end COMPU_METHOD
/* ------------------ Abschnitt erzeugt aus os.dat ------------------ */
/begin COMPU_METHOD FORMULA_0350 "FORMULA_0350" TAB_VERB "%3.0" "-" COMPU_TAB_REF FORMULA_0350_VTAB /end COMPU_METHOD
/begin COMPU_VTAB FORMULA_0350_VTAB "FORMULA_0350_VTAB" TAB_VERB 11 0 "Ok" 1 "Sync1" 2 "Sync2" 3 "SyncMS" 4 "1ms-Task" 5 "5ms-Task" 6 "10ms-Task" 7 "100ms-Task" 8 "1s-Task" 9 "Bgnd-Task" 10 "undef" /end COMPU_VTAB
/begin COMPU_METHOD FORMULA_0351 "FORMULA_0351" TAB_VERB "%3.0" "-" COMPU_TAB_REF FORMULA_0351_VTAB /end COMPU_METHOD
/begin COMPU_VTAB FORMULA_0351_VTAB "FORMULA_0351_VTAB" TAB_VERB 13 0 "Ok" 1 "Access" 2 "Level" 3 "ID" 4 "Limit" 5 "NoFnc" 6 "Resource" 7 "State" 8 "Value" 9 "TT missing" 10 "TT active" 11 "Overrun" 14 "Stack" /end COMPU_VTAB
/* ------------------ Abschnitt erzeugt aus qadc.dat ------------------ */
/begin COMPU_METHOD FORMULA_0354 "FORMULA_0354" TAB_VERB "%5.2" "-" COMPU_TAB_REF FORMULA_0354_VTAB /end COMPU_METHOD
/begin COMPU_VTAB FORMULA_0354_VTAB "FORMULA_0354_VTAB" TAB_VERB 3 0 "OK" 1 "QADCA NIO" 2 "QADCB NIO" DEFAULT_VALUE "undef" /end COMPU_VTAB
/* ------------------ Abschnitt erzeugt aus ram_chk.dat ------------------ */
/begin COMPU_METHOD FORMULA_0355 "FORMULA_0355" RAT_FUNC "%7.2" "kHz" COEFFS 0 100 0 0 0 1 /end COMPU_METHOD
/* ------------------ Abschnitt erzeugt aus sc_glob.dat ------------------ */
/begin COMPU_METHOD FORMULA_0358 "FORMULA_0358" RAT_FUNC "%9.2" "ms" COEFFS 0 1000 0 0 0 1 /end COMPU_METHOD
/begin COMPU_METHOD FORMULA_0359 "FORMULA_0359" TAB_VERB "%5.2" "-" COMPU_TAB_REF FORMULA_0359_VTAB /end COMPU_METHOD
/begin COMPU_VTAB FORMULA_0359_VTAB "FORMULA_0359_VTAB" TAB_VERB 2 0 "WorkPage" 16 "RefPage" DEFAULT_VALUE "Err/RefP" /end COMPU_VTAB
/begin COMPU_METHOD FORMULA_0360 "FORMULA_0360" TAB_VERB "%5.2" "-" COMPU_TAB_REF FORMULA_0360_VTAB /end COMPU_METHOD
/begin COMPU_VTAB FORMULA_0360_VTAB "FORMULA_0360_VTAB" TAB_VERB 4 0 "idle" 1 "to WorkPage" 2 "to RefPage" 4 "ready" /end COMPU_VTAB
/begin COMPU_METHOD FORMULA_0361 "FORMULA_0361" TAB_VERB "%5.2" "-" COMPU_TAB_REF FORMULA_0361_VTAB /end COMPU_METHOD
/begin COMPU_VTAB FORMULA_0361_VTAB "FORMULA_0361_VTAB" TAB_VERB 3 0 "idle" 1 "loop" 2 "ready" /end COMPU_VTAB
/* ------------------ Abschnitt erzeugt aus sk.dat ------------------ */
/begin COMPU_METHOD FORMULA_0362 "FORMULA_0362" TAB_VERB "%3.0" "-" COMPU_TAB_REF FORMULA_0362_VTAB /end COMPU_METHOD
/begin COMPU_VTAB FORMULA_0362_VTAB "FORMULA_0362_VTAB" TAB_VERB 1 0 "Inaktiv" DEFAULT_VALUE "Aktiv" /end COMPU_VTAB
/* ------------------ Abschnitt erzeugt aus sk_e2_glob.dat ------------------ */
/begin COMPU_METHOD FORMULA_0369 "FORMULA_0369" TAB_VERB "%5.0" "-" COMPU_TAB_REF FORMULA_0369_VTAB /end COMPU_METHOD
/begin COMPU_VTAB FORMULA_0369_VTAB "FORMULA_0369_VTAB" TAB_VERB 23 0 "kein Fehler" 5 "Motortemperatur" 6 "Oeltemperatur" 10 "SMG-Schaltablauf" 11 "SMG-Eingriff" 12 "SMG-Sollmoment" 13 "SMG-nGetr" 14 "SMG-Gang" 20 "LLR-Plausi" 21 "Minimalmoment" 22 "Maximalmoment" 23 "Istmoment" 24 "Schleppmoment" 25 "Soll-Istvergleich" 26 "rel. Fahrerwunsch" 30 "Luftmasse" 40 "Drehzahl" 50 "Pedalwert" 60 "Bremslichtschalter" 80 "Komplementvergleich" 85 "Fehler Testrechnung" 86 "Timeout Testrechnung" 90 "Maxdrehzahl" /end COMPU_VTAB
/* ------------------ Abschnitt erzeugt aus spi.dat ------------------ */
/begin COMPU_METHOD FORMULA_0370 "FORMULA_0370" TAB_VERB "%3.0" "-" COMPU_TAB_REF FORMULA_0370_VTAB /end COMPU_METHOD
/begin COMPU_VTAB FORMULA_0370_VTAB "FORMULA_0370_VTAB" TAB_VERB 2 0 "frei" 128 "Belegt" DEFAULT_VALUE "undefiniert" /end COMPU_VTAB
/* ------------------ Abschnitt erzeugt aus sys_zust.dat ------------------ */
/begin COMPU_METHOD FORMULA_0383 "FORMULA_0383" TAB_VERB "%7.2" "-" COMPU_TAB_REF FORMULA_0383_VTAB /end COMPU_METHOD
/begin COMPU_VTAB FORMULA_0383_VTAB "FORMULA_0383_VTAB" TAB_VERB 3 0 "Treiberdiagnose" 1 "Dauerbestromung TPU" 2 "Dauerbestromung Treiber" DEFAULT_VALUE "undef" /end COMPU_VTAB
/begin COMPU_METHOD FORMULA_0384 "FORMULA_0384" TAB_VERB "%7.2" "-" COMPU_TAB_REF FORMULA_0384_VTAB /end COMPU_METHOD
/begin COMPU_VTAB FORMULA_0384_VTAB "FORMULA_0384_VTAB" TAB_VERB 5 1 "Boot" 2 "FpFlash/iD" 4 "FpRAM/iD" 10 "FpFlash/eD" 12 "FpRAM/eD" DEFAULT_VALUE "undefiniert" /end COMPU_VTAB
/begin COMPU_METHOD FORMULA_0385 "FORMULA_0385" TAB_VERB "%3.0" "-" COMPU_TAB_REF FORMULA_0385_VTAB /end COMPU_METHOD
/begin COMPU_VTAB FORMULA_0385_VTAB "FORMULA_0385_VTAB" TAB_VERB 3 0 "Prozessor" 1 "Selbst" 2 "Kollege" DEFAULT_VALUE "undef" /end COMPU_VTAB
/begin COMPU_METHOD FORMULA_0386 "FORMULA_0386" TAB_VERB "%7.2" "-" COMPU_TAB_REF FORMULA_0386_VTAB /end COMPU_METHOD
/begin COMPU_VTAB FORMULA_0386_VTAB "FORMULA_0386_VTAB" TAB_VERB 1 0 "no" DEFAULT_VALUE "ja" /end COMPU_VTAB
/begin COMPU_METHOD FORMULA_0387 "FORMULA_0387" TAB_VERB "%7.2" "-" COMPU_TAB_REF FORMULA_0387_VTAB /end COMPU_METHOD
/begin COMPU_VTAB FORMULA_0387_VTAB "FORMULA_0387_VTAB" TAB_VERB 1 0 "no" DEFAULT_VALUE "ja" /end COMPU_VTAB
/begin COMPU_METHOD FORMULA_0388 "FORMULA_0388" TAB_VERB "%7.2" "-" COMPU_TAB_REF FORMULA_0388_VTAB /end COMPU_METHOD
/begin COMPU_VTAB FORMULA_0388_VTAB "FORMULA_0388_VTAB" TAB_VERB 1 0 "no" DEFAULT_VALUE "ja" /end COMPU_VTAB
/begin COMPU_METHOD FORMULA_0389 "FORMULA_0389" TAB_VERB "%7.2" "-" COMPU_TAB_REF FORMULA_0389_VTAB /end COMPU_METHOD
/begin COMPU_VTAB FORMULA_0389_VTAB "FORMULA_0389_VTAB" TAB_VERB 1 0 "no" DEFAULT_VALUE "ja" /end COMPU_VTAB
/begin COMPU_METHOD FORMULA_0390 "FORMULA_0390" TAB_VERB "%7.2" "-" COMPU_TAB_REF FORMULA_0390_VTAB /end COMPU_METHOD
/begin COMPU_VTAB FORMULA_0390_VTAB "FORMULA_0390_VTAB" TAB_VERB 1 0 "no" DEFAULT_VALUE "ja" /end COMPU_VTAB
/begin COMPU_METHOD FORMULA_0391 "FORMULA_0391" TAB_VERB "%7.2" "-" COMPU_TAB_REF FORMULA_0391_VTAB /end COMPU_METHOD
/begin COMPU_VTAB FORMULA_0391_VTAB "FORMULA_0391_VTAB" TAB_VERB 1 0 "no" DEFAULT_VALUE "ja" /end COMPU_VTAB
/begin COMPU_METHOD FORMULA_0392 "FORMULA_0392" TAB_VERB "%7.2" "-" COMPU_TAB_REF FORMULA_0392_VTAB /end COMPU_METHOD
/begin COMPU_VTAB FORMULA_0392_VTAB "FORMULA_0392_VTAB" TAB_VERB 1 0 "no" DEFAULT_VALUE "ja" /end COMPU_VTAB
/begin COMPU_METHOD FORMULA_0393 "FORMULA_0393" TAB_VERB "%7.2" "-" COMPU_TAB_REF FORMULA_0393_VTAB /end COMPU_METHOD
/begin COMPU_VTAB FORMULA_0393_VTAB "FORMULA_0393_VTAB" TAB_VERB 1 0 "no" DEFAULT_VALUE "ja" /end COMPU_VTAB
/begin COMPU_METHOD FORMULA_0394 "FORMULA_0394" TAB_VERB "%7.2" "-" COMPU_TAB_REF FORMULA_0394_VTAB /end COMPU_METHOD
/begin COMPU_VTAB FORMULA_0394_VTAB "FORMULA_0394_VTAB" TAB_VERB 1 0 "no" DEFAULT_VALUE "ja" /end COMPU_VTAB
/begin COMPU_METHOD FORMULA_0395 "FORMULA_0395" TAB_VERB "%7.2" "-" COMPU_TAB_REF FORMULA_0395_VTAB /end COMPU_METHOD
/begin COMPU_VTAB FORMULA_0395_VTAB "FORMULA_0395_VTAB" TAB_VERB 1 0 "no" DEFAULT_VALUE "ja" /end COMPU_VTAB
/begin COMPU_METHOD FORMULA_0396 "FORMULA_0396" TAB_VERB "%7.2" "-" COMPU_TAB_REF FORMULA_0396_VTAB /end COMPU_METHOD
/begin COMPU_VTAB FORMULA_0396_VTAB "FORMULA_0396_VTAB" TAB_VERB 1 0 "no" DEFAULT_VALUE "ja" /end COMPU_VTAB
/begin COMPU_METHOD FORMULA_0397 "FORMULA_0397" TAB_VERB "%7.2" "-" COMPU_TAB_REF FORMULA_0397_VTAB /end COMPU_METHOD
/begin COMPU_VTAB FORMULA_0397_VTAB "FORMULA_0397_VTAB" TAB_VERB 1 0 "no" DEFAULT_VALUE "ja" /end COMPU_VTAB
/begin COMPU_METHOD FORMULA_0398 "FORMULA_0398" TAB_VERB "%7.2" "-" COMPU_TAB_REF FORMULA_0398_VTAB /end COMPU_METHOD
/begin COMPU_VTAB FORMULA_0398_VTAB "FORMULA_0398_VTAB" TAB_VERB 1 0 "no" DEFAULT_VALUE "ja" /end COMPU_VTAB
/begin COMPU_METHOD FORMULA_0399 "FORMULA_0399" RAT_FUNC "%8.3" "ms" COEFFS 0 1000 0 0 0 1 /end COMPU_METHOD
/begin COMPU_METHOD FORMULA_0400 "FORMULA_0400" TAB_VERB "%3.0" "-" COMPU_TAB_REF FORMULA_0400_VTAB /end COMPU_METHOD
/begin COMPU_VTAB FORMULA_0400_VTAB "FORMULA_0400_VTAB" TAB_VERB 59 0 "kein Fehler" 1 "Adaptionsdaten CRC32" 2 "Programm CRC32" 3 "Daten CRC32" 4 "undef" 5 "undef" 6 "Watchdog-Reset" 7 "Reset" 8 "CRC Boot" 9 "Reset-MCI" 10 "Reset-Data" 11 "Reset-Instr" 13 "Reset-Align" 14 "Reset-Prog" 15 "Reset-NoFp" 19 "Reset-System" 20 "Reset-Trace" 21 "Reset-FpAss" 22 "Reset-Perform" 23 "Reset-SwEmu" 26 "Reset-InstrProt" 27 "Reset-DataProt" 35 "Reset-DataBrk" 36 "Reset-InstrBrk" 37 "Reset-MaskBrk" 38 "Reset-NMIBrk" 39 "Reset-NMI" 40 "Reset-Reserve" 41 "HW_INDEX zu klein" 42 "ADAPT Loeschen" 43 "ADAPT Schreiben" 44 "ADAPT Hochlauf" 50 "SK-Resetausloesung" 51 "ADC" 52 "TZ-TPU Pin" 53 "TZ-TREIBER Pin" 54 "DSP-Bus" 55 "DSP-Stack" 56 "DSP-Watchdog" 57 "DSP-Programm" 58 "DSP-Daten" 59 "DSP-CRC" 60 "ZUST_NL IGN Timeout" 61 "DSP-Zylinder" 62 "FPGA Init Pin NHigh1" 63 "FPGA Init Pin NHigh2" 64 "FPGA Done Pin NHigh" 65 "FPGA Kennung-CRC32" 66 "RAM" 67 "Register" 68 "TPU RAM" 69 "QADC0 CCW" 70 "QADC1 CCW" 71 "SPI-ATIC39 Chain" 72 "SPI-ATIC35 Chain" 73 "SPI-ATIC29 Chain" 74 "Interne Spannung" 75 "OS-Tasksystem" 76 "OS-Stack" DEFAULT_VALUE "undef" /end COMPU_VTAB
/begin COMPU_METHOD FORMULA_0401 "FORMULA_0401" RAT_FUNC "%6.1" "ms" COEFFS 0 1 0 0 0 0.255 /end COMPU_METHOD
/* ------------------ Abschnitt erzeugt aus tpu_kw.dat ------------------ */
/begin COMPU_METHOD FORMULA_0402 "FORMULA_0402" TAB_VERB "%3.0" "-" COMPU_TAB_REF FORMULA_0402_VTAB /end COMPU_METHOD
/begin COMPU_VTAB FORMULA_0402_VTAB "FORMULA_0402_VTAB" TAB_VERB 5 0 "sync - 720� Mode" 1 "sync - 360� Mode" 129 "suche Luecke" 161 "Zahnentprellung laeuft" 225 "nicht sync." /end COMPU_VTAB
/begin COMPU_METHOD FORMULA_0403 "FORMULA_0403" RAT_FUNC "%3.0" "-" COEFFS 0 -1 1 0 0 -1 /end COMPU_METHOD
/begin COMPU_METHOD FORMULA_0404 "FORMULA_0404" TAB_VERB "%3.0" "-" COMPU_TAB_REF FORMULA_0404_VTAB /end COMPU_METHOD
/begin COMPU_VTAB FORMULA_0404_VTAB "FORMULA_0404_VTAB" TAB_VERB 1 0 "Kein Interrupt." DEFAULT_VALUE "Mind. Einfachinterrupt." /end COMPU_VTAB
/begin COMPU_METHOD FORMULA_0405 "FORMULA_0405" TAB_VERB "%3.0" "-" COMPU_TAB_REF FORMULA_0405_VTAB /end COMPU_METHOD
/begin COMPU_VTAB FORMULA_0405_VTAB "FORMULA_0405_VTAB" TAB_VERB 1 0 "nein." DEFAULT_VALUE "aktiv." /end COMPU_VTAB
/begin COMPU_METHOD FORMULA_0406 "FORMULA_0406" TAB_VERB "%3.0" "-" COMPU_TAB_REF FORMULA_0406_VTAB /end COMPU_METHOD
/begin COMPU_VTAB FORMULA_0406_VTAB "FORMULA_0406_VTAB" TAB_VERB 1 0 "nein." DEFAULT_VALUE "aktiv." /end COMPU_VTAB
/begin COMPU_METHOD FORMULA_0407 "FORMULA_0407" TAB_VERB "%3.0" "-" COMPU_TAB_REF FORMULA_0407_VTAB /end COMPU_METHOD
/begin COMPU_VTAB FORMULA_0407_VTAB "FORMULA_0407_VTAB" TAB_VERB 1 0 "nein." DEFAULT_VALUE "aktiv." /end COMPU_VTAB
/begin COMPU_METHOD FORMULA_0408 "FORMULA_0408" TAB_VERB "%3.0" "-" COMPU_TAB_REF FORMULA_0408_VTAB /end COMPU_METHOD
/begin COMPU_VTAB FORMULA_0408_VTAB "FORMULA_0408_VTAB" TAB_VERB 1 0 "nein." DEFAULT_VALUE "aktiv." /end COMPU_VTAB
/begin COMPU_METHOD FORMULA_0409 "FORMULA_0409" TAB_VERB "%3.0" "-" COMPU_TAB_REF FORMULA_0409_VTAB /end COMPU_METHOD
/begin COMPU_VTAB FORMULA_0409_VTAB "FORMULA_0409_VTAB" TAB_VERB 1 0 "nein." DEFAULT_VALUE "aktiv." /end COMPU_VTAB
/begin COMPU_METHOD FORMULA_0410 "FORMULA_0410" TAB_VERB "%3.0" "-" COMPU_TAB_REF FORMULA_0410_VTAB /end COMPU_METHOD
/begin COMPU_VTAB FORMULA_0410_VTAB "FORMULA_0410_VTAB" TAB_VERB 1 0 "nein." DEFAULT_VALUE "aktiv." /end COMPU_VTAB
/begin COMPU_METHOD FORMULA_0411 "FORMULA_0411" TAB_VERB "%3.0" "-" COMPU_TAB_REF FORMULA_0411_VTAB /end COMPU_METHOD
/begin COMPU_VTAB FORMULA_0411_VTAB "FORMULA_0411_VTAB" TAB_VERB 1 0 "nein." DEFAULT_VALUE "aktiv." /end COMPU_VTAB
/begin COMPU_METHOD FORMULA_0412 "FORMULA_0412" TAB_VERB "%3.0" "-" COMPU_TAB_REF FORMULA_0412_VTAB /end COMPU_METHOD
/begin COMPU_VTAB FORMULA_0412_VTAB "FORMULA_0412_VTAB" TAB_VERB 1 0 "nein." DEFAULT_VALUE "aktiv." /end COMPU_VTAB
/begin COMPU_METHOD FORMULA_0415 "FORMULA_0415" TAB_VERB "%5.2" "-" COMPU_TAB_REF FORMULA_0415_VTAB /end COMPU_METHOD
/begin COMPU_VTAB FORMULA_0415_VTAB "FORMULA_0415_VTAB" TAB_VERB 29 0 "Labordaten" 1 "ZS-E-45" 2 "Master" 3 "Prerauer" 4 "Erler" 5 "Heiss" 6 "Lutz" 7 "Maier" 8 "Andritzky" 9 "Neumann" 10 "Wilke" 11 "Scherer" 12 "Erdoedy" 13 "Fischer" 14 "May" 15 "ECE" 16 "US" 17 "Habermann" 18 "Moesbauer" 19 "Hartke" 20 "Renner" 21 "Stoll" 22 "Schaefer" 23 "Ast" 24 "Eickmeyer" 25 "Biebl" 26 "Betz" 27 "NN2" 28 "NN2" DEFAULT_VALUE "unbekannt" /end COMPU_VTAB
/begin COMPU_METHOD FORMULA_0416 "FORMULA_0416" TAB_VERB "%5.2" "-" COMPU_TAB_REF FORMULA_0416_VTAB /end COMPU_METHOD
/begin COMPU_VTAB FORMULA_0416_VTAB "FORMULA_0416_VTAB" TAB_VERB 6 177 "B1-Muster" 178 "B2-Muster" 179 "B3-Muster" 193 "C1-Muster" 194 "C2-Muster" 255 "ohne Kennung" /end COMPU_VTAB
/begin COMPU_METHOD FORMULA_0417 "FORMULA_0417" TAB_VERB "%5.2" "-" COMPU_TAB_REF FORMULA_0417_VTAB /end COMPU_METHOD
/begin COMPU_VTAB FORMULA_0417_VTAB "FORMULA_0417_VTAB" TAB_VERB 2 1 "INJ" 2 "IGN" DEFAULT_VALUE "undefiniert" /end COMPU_VTAB
/* ------------------ Abschnitt erzeugt aus dqlt.dat ------------------ */
/begin COMPU_METHOD FORMULA_0418 "FORMULA_0418" TAB_VERB "%5.2" "-" COMPU_TAB_REF FORMULA_0418_VTAB /end COMPU_METHOD
/begin COMPU_VTAB FORMULA_0418_VTAB "FORMULA_0418_VTAB" TAB_VERB 2 0 "FALSE" 1 "TRUE" DEFAULT_VALUE "TRUE" /end COMPU_VTAB
/begin COMPU_METHOD FORMULA_0419 "FORMULA_0419" TAB_VERB "%5.2" "-" COMPU_TAB_REF FORMULA_0419_VTAB /end COMPU_METHOD
/begin COMPU_VTAB FORMULA_0419_VTAB "FORMULA_0419_VTAB" TAB_VERB 2 0 "FALSE" 1 "TRUE" DEFAULT_VALUE "TRUE" /end COMPU_VTAB
/begin COMPU_METHOD FORMULA_0420 "FORMULA_0420" TAB_VERB "%5.2" "-" COMPU_TAB_REF FORMULA_0420_VTAB /end COMPU_METHOD
/begin COMPU_VTAB FORMULA_0420_VTAB "FORMULA_0420_VTAB" TAB_VERB 2 0 "FALSE" 1 "TRUE" DEFAULT_VALUE "TRUE" /end COMPU_VTAB
/begin COMPU_METHOD FORMULA_0421 "FORMULA_0421" TAB_VERB "%5.2" "-" COMPU_TAB_REF FORMULA_0421_VTAB /end COMPU_METHOD
/begin COMPU_VTAB FORMULA_0421_VTAB "FORMULA_0421_VTAB" TAB_VERB 2 0 "FALSE" 1 "TRUE" DEFAULT_VALUE "TRUE" /end COMPU_VTAB
/begin COMPU_METHOD FORMULA_0422 "FORMULA_0422" TAB_VERB "%5.2" "-" COMPU_TAB_REF FORMULA_0422_VTAB /end COMPU_METHOD
/begin COMPU_VTAB FORMULA_0422_VTAB "FORMULA_0422_VTAB" TAB_VERB 2 0 "FALSE" 1 "TRUE" DEFAULT_VALUE "TRUE" /end COMPU_VTAB
/begin COMPU_METHOD FORMULA_0423 "FORMULA_0423" TAB_VERB "%5.2" "-" COMPU_TAB_REF FORMULA_0423_VTAB /end COMPU_METHOD
/begin COMPU_VTAB FORMULA_0423_VTAB "FORMULA_0423_VTAB" TAB_VERB 2 0 "FALSE" 1 "TRUE" DEFAULT_VALUE "TRUE" /end COMPU_VTAB
/begin COMPU_METHOD FORMULA_0424 "FORMULA_0424" TAB_VERB "%5.2" "-" COMPU_TAB_REF FORMULA_0424_VTAB /end COMPU_METHOD
/begin COMPU_VTAB FORMULA_0424_VTAB "FORMULA_0424_VTAB" TAB_VERB 2 0 "FALSE" 1 "TRUE" DEFAULT_VALUE "TRUE" /end COMPU_VTAB
/begin COMPU_METHOD FORMULA_0425 "FORMULA_0425" TAB_VERB "%5.2" "-" COMPU_TAB_REF FORMULA_0425_VTAB /end COMPU_METHOD
/begin COMPU_VTAB FORMULA_0425_VTAB "FORMULA_0425_VTAB" TAB_VERB 2 0 "FALSE" 1 "TRUE" DEFAULT_VALUE "TRUE" /end COMPU_VTAB
/begin COMPU_METHOD FORMULA_0426 "FORMULA_0426" RAT_FUNC "%5.0" "�C" COEFFS 0 10 0 0 0 1 /end COMPU_METHOD
/begin COMPU_METHOD FORMULA_0427 "FORMULA_0427" RAT_FUNC "%6.1" "V" COEFFS 0 1 0 0 0 0.0942 /end COMPU_METHOD
/* ------------------ Abschnitt erzeugt aus ozbg.dat ------------------ */
/begin COMPU_METHOD FORMULA_0428 "FORMULA_0428" RAT_FUNC "%6.1" "km" COEFFS 0 1 0 0 0 10 /end COMPU_METHOD
/begin COMPU_METHOD FORMULA_0429 "FORMULA_0429" RAT_FUNC "%3.0" "km" COEFFS 0 1 0 0 0 1000 /end COMPU_METHOD
/* ------------------ Abschnitt erzeugt aus ozgg.dat ------------------ */
/begin COMPU_METHOD FORMULA_0430 "FORMULA_0430" RAT_FUNC "%6.1" "-" COEFFS 0 65536 0 0 0 6 /end COMPU_METHOD
/begin COMPU_METHOD FORMULA_0431 "FORMULA_0431" RAT_FUNC "%5.2" "mm" COEFFS 0 256 0 0 0 75 /end COMPU_METHOD
/begin COMPU_METHOD FORMULA_0432 "FORMULA_0432" RAT_FUNC "%5.0" "km" COEFFS 0 1 0 0 0 10 /end COMPU_METHOD
/begin COMPU_METHOD FORMULA_0433 "FORMULA_0433" RAT_FUNC "%7.2" "%" COEFFS 0 65536 0 0 0 100 /end COMPU_METHOD
/begin COMPU_METHOD FORMULA_0434 "FORMULA_0434" RAT_FUNC "%5.2" "-" COEFFS 0 256 0 0 0 1 /end COMPU_METHOD
/begin COMPU_METHOD FORMULA_0435 "FORMULA_0435" RAT_FUNC "%6.3" "s" COEFFS 0 1 0 0 0 1 /end COMPU_METHOD
/* ------------------ Abschnitt erzeugt aus oznivdl.dat ------------------ */
/begin COMPU_METHOD FORMULA_0436 "FORMULA_0436" RAT_FUNC "%5.2" "Liter" COEFFS 0 10 0 0 0 1 /end COMPU_METHOD
/begin COMPU_METHOD FORMULA_0437 "FORMULA_0437" RAT_FUNC "%5.2" "mm" COEFFS 0 256 0 0 0 8 /end COMPU_METHOD
/begin COMPU_METHOD FORMULA_0438 "FORMULA_0438" RAT_FUNC "%7.2" "min" COEFFS 0 1 0 0 0 1 /end COMPU_METHOD
/begin COMPU_METHOD FORMULA_0439 "FORMULA_0439" RAT_FUNC "%8.3" "" COEFFS 0 4096 0 0 0 1 /end COMPU_METHOD
/begin COMPU_METHOD FORMULA_0440 "FORMULA_0440" RAT_FUNC "%7.2" "-" COEFFS 0 65536 0 0 0 128 /end COMPU_METHOD
/begin COMPU_METHOD FORMULA_0441 "FORMULA_0441" RAT_FUNC "%7.2" "%" COEFFS 0 65536 0 0 0 10 /end COMPU_METHOD
/begin COMPU_METHOD FORMULA_0442 "FORMULA_0442" RAT_FUNC "%5.2" "-" COEFFS 0 128 0 0 0 2 /end COMPU_METHOD
/begin COMPU_METHOD FORMULA_0443 "FORMULA_0443" RAT_FUNC "%7.2" "�C" COEFFS 0 100 0 0 0 1 /end COMPU_METHOD
/begin COMPU_METHOD FORMULA_0444 "FORMULA_0444" RAT_FUNC "%9.4" "-" COEFFS 0 32768 0 0 0 32 /end COMPU_METHOD
/begin COMPU_METHOD FORMULA_0445 "FORMULA_0445" RAT_FUNC "%8.3" "hPa" COEFFS 0 256 0 0 0 10 /end COMPU_METHOD
/begin COMPU_METHOD FORMULA_0446 "FORMULA_0446" RAT_FUNC "%4.1" "-" COEFFS 0 4 0 0 0 1 /end COMPU_METHOD
/begin COMPU_METHOD FORMULA_0447 "FORMULA_0447" RAT_FUNC "%5.2" "-" COEFFS 0 256 0 0 0 8 /end COMPU_METHOD
/begin COMPU_METHOD FORMULA_0448 "FORMULA_0448" RAT_FUNC "%7.2" "-" COEFFS 0 65536 0 0 0 2 /end COMPU_METHOD
/begin COMPU_METHOD FORMULA_0449 "FORMULA_0449" RAT_FUNC "%7.2" "mm" COEFFS 0 256 0 0 0 75 /end COMPU_METHOD
/begin COMPU_METHOD FORMULA_0450 "FORMULA_0450" RAT_FUNC "%7.2" "mm" COEFFS 0 512 0 0 0 75 /end COMPU_METHOD
/* ------------------ Abschnitt erzeugt aus ozrestkm.dat ------------------ */
/begin COMPU_METHOD FORMULA_0451 "FORMULA_0451" RAT_FUNC "%4.1" "-" COEFFS 0 100 0 0 0 1 /end COMPU_METHOD
/begin COMPU_METHOD FORMULA_0452 "FORMULA_0452" RAT_FUNC "%10.3" "" COEFFS 0 8192 0 0 0 1 /end COMPU_METHOD
/begin COMPU_METHOD FORMULA_0454 "FORMULA_0454" RAT_FUNC "%6.3" "-" COEFFS 0 256 0 0 0 0.25 /end COMPU_METHOD
/begin COMPU_METHOD FORMULA_0455 "FORMULA_0455" RAT_FUNC "%5.2" "-" COEFFS 0 256 0 0 0 32 /end COMPU_METHOD
/begin COMPU_METHOD FORMULA_0456 "FORMULA_0456" RAT_FUNC "%6.3" "�KW" COEFFS 0 256 0 0 0 6 /end COMPU_METHOD
/begin COMPU_METHOD FORMULA_0457 "FORMULA_0457" RAT_FUNC "%9.4" "-" COEFFS 0 65536 0 0 0 1 /end COMPU_METHOD
/* ------------------ Abschnitt erzeugt aus imdgen_1pr.dat ------------------ */
/begin COMPU_METHOD FORMULA_0459 "FORMULA_0459" RAT_FUNC "%6.3" "" COEFFS 0 1 0 0 0 1 /end COMPU_METHOD
/begin COMPU_METHOD FORMULA_0460 "FORMULA_0460" RAT_FUNC "%6.3" "A" COEFFS 0 8 0 0 0 1 /end COMPU_METHOD
/begin COMPU_METHOD FORMULA_0462 "FORMULA_0462" RAT_FUNC "%8.3" "V" COEFFS 0 10 0 0 0 1 /end COMPU_METHOD
/begin COMPU_METHOD FORMULA_0463 "FORMULA_0463" RAT_FUNC "%9.2" "-" COEFFS 0 524288 0 0 0 1 /end COMPU_METHOD
/begin COMPU_METHOD FORMULA_0464 "FORMULA_0464" RAT_FUNC "%10.3" "" COEFFS 0 65536 0 0 0 2048 /end COMPU_METHOD
/begin COMPU_METHOD FORMULA_0465 "FORMULA_0465" RAT_FUNC "%8.3" "A" COEFFS 0 1 0 0 0 1 /end COMPU_METHOD
/begin COMPU_METHOD FORMULA_0466 "FORMULA_0466" RAT_FUNC "%7.2" "%" COEFFS 0 65536 0 0 0 2048 /end COMPU_METHOD
/begin COMPU_METHOD FORMULA_0467 "FORMULA_0467" RAT_FUNC "%7.2" "�C" COEFFS 0 1 0 0 0 0.75 /end COMPU_METHOD
/begin COMPU_METHOD FORMULA_0468 "FORMULA_0468" RAT_FUNC "%8.3" "-" COEFFS 0 2048 0 0 0 1 /end COMPU_METHOD
/begin COMPU_METHOD FORMULA_0469 "FORMULA_0469" RAT_FUNC "%8.3" "A" COEFFS 0 65536 0 0 0 2048 /end COMPU_METHOD
/begin COMPU_METHOD FORMULA_0470 "FORMULA_0470" RAT_FUNC "%5.0" "km/h" COEFFS 0 1 0 0 0 1 /end COMPU_METHOD
/begin COMPU_METHOD FORMULA_0472 "FORMULA_0472" RAT_FUNC "%5.2" "min" COEFFS 0 1 0 0 0 1 /end COMPU_METHOD
/begin COMPU_METHOD FORMULA_0474 "FORMULA_0474" RAT_FUNC "%4.1" "-" COEFFS 0 1 0 0 0 1 /end COMPU_METHOD
/begin COMPU_METHOD FORMULA_0476 "FORMULA_0476" RAT_FUNC "%9.4" "%" COEFFS 0 100 0 0 0 1 /end COMPU_METHOD
/begin COMPU_METHOD FORMULA_0477 "FORMULA_0477" RAT_FUNC "%5.2" "sec" COEFFS 0 1 0 0 0 1 /end COMPU_METHOD
/* ------------------ Abschnitt erzeugt aus pgentred.dat ------------------ */
/begin COMPU_METHOD FORMULA_0478 "FORMULA_0478" RAT_FUNC "%7.2" "%" COEFFS 0 65536 0 0 0 256 /end COMPU_METHOD
/begin COMPU_METHOD FORMULA_0479 "FORMULA_0479" RAT_FUNC "%8.3" "V" COEFFS 0 1024 0 0 0 5 /end COMPU_METHOD
/begin COMPU_METHOD FORMULA_0481 "FORMULA_0481" RAT_FUNC "%8.3" "A" COEFFS 0 65536 0 0 0 4096 /end COMPU_METHOD
/begin COMPU_METHOD FORMULA_0482 "FORMULA_0482" RAT_FUNC "%8.3" "A" COEFFS 0 1000 0 0 0 1 /end COMPU_METHOD
/* ------------------ Abschnitt erzeugt aus lbattcal.dat ------------------ */
/begin COMPU_METHOD FORMULA_0484 "FORMULA_0484" RAT_FUNC "%8.3" "V" COEFFS 0 256 0 0 0 1 /end COMPU_METHOD
/begin COMPU_METHOD FORMULA_0485 "FORMULA_0485" RAT_FUNC "%8.3" "kg" COEFFS 0 2250 0 0 0 1 /end COMPU_METHOD
/* ------------------ Abschnitt erzeugt aus pmbnstab.dat ------------------ */
/begin COMPU_METHOD FORMULA_0486 "FORMULA_0486" RAT_FUNC "%7.4" "V" COEFFS 0 1 0 0 0 0.0942 /end COMPU_METHOD
/* ------------------ Abschnitt erzeugt aus pmdiag.dat ------------------ */
/begin COMPU_METHOD FORMULA_0487 "FORMULA_0487" RAT_FUNC "%7.2" "" COEFFS 0 103 0 0 0 30 /end COMPU_METHOD
/begin COMPU_METHOD FORMULA_0489 "FORMULA_0489" RAT_FUNC "%7.2" "min" COEFFS 0 15 0 0 0 14 /end COMPU_METHOD
/begin COMPU_METHOD FORMULA_0491 "FORMULA_0491" RAT_FUNC "%5.2" "A" COEFFS 0 1 0 0 0 10 /end COMPU_METHOD
/begin COMPU_METHOD FORMULA_0492 "FORMULA_0492" RAT_FUNC "%6.3" "" COEFFS 0 800 0 0 0 1 /end COMPU_METHOD
/begin COMPU_METHOD FORMULA_0493 "FORMULA_0493" RAT_FUNC "%5.2" "min" COEFFS 0 15 0 0 0 224 /end COMPU_METHOD
/begin COMPU_METHOD FORMULA_0496 "FORMULA_0496" RAT_FUNC "%8.3" "" COEFFS 0 4000 0 0 0 1 /end COMPU_METHOD
/begin COMPU_METHOD FORMULA_0499 "FORMULA_0499" RAT_FUNC "%7.4" "min" COEFFS 0 15 0 0 0 14 /end COMPU_METHOD
/* ------------------ Abschnitt erzeugt aus pmprsvcalc.dat ------------------ */
/begin COMPU_METHOD FORMULA_0500 "FORMULA_0500" RAT_FUNC "%9.2" "" COEFFS 0 65536 0 0 0 512 /end COMPU_METHOD
/begin COMPU_METHOD FORMULA_0502 "FORMULA_0502" RAT_FUNC "%9.4" "-" COEFFS 0 64 0 0 0 0.0942 /end COMPU_METHOD
/begin COMPU_METHOD FORMULA_0505 "FORMULA_0505" RAT_FUNC "%8.3" "V" COEFFS 0 200 0 0 0 3 /end COMPU_METHOD
/begin COMPU_METHOD FORMULA_0508 "FORMULA_0508" RAT_FUNC "%11.4" "Ah" COEFFS 0 3600000 0 0 0 1 /end COMPU_METHOD
/* ------------------ Abschnitt erzeugt aus pmsockor.dat ------------------ */
/begin COMPU_METHOD FORMULA_0510 "FORMULA_0510" RAT_FUNC "%6.1" "s" COEFFS 0 1 0 0 0 1 /end COMPU_METHOD
/* ------------------ Abschnitt erzeugt aus pmsocstart.dat ------------------ */
/begin COMPU_METHOD FORMULA_0511 "FORMULA_0511" RAT_FUNC "%8.3" "A" COEFFS 0 1 0 0 0 0.02 /end COMPU_METHOD
/begin COMPU_METHOD FORMULA_0531 "FORMULA_0531" RAT_FUNC "%8.3" "mg/ASP" COEFFS 0 64 0 0 0 1 /end COMPU_METHOD
/begin COMPU_METHOD FORMULA_0532 "FORMULA_0532" RAT_FUNC "%5.0" "mV" COEFFS 0 1024 0 0 0 5000 /end COMPU_METHOD
/begin COMPU_METHOD FORMULA_0537 "FORMULA_0537" RAT_FUNC "%6.1" "Ohm" COEFFS 0 10 0 0 0 1 /end COMPU_METHOD
/begin COMPU_METHOD FORMULA_0538 "FORMULA_0538" RAT_FUNC "%5.0" "ms" COEFFS 0 1 0 0 0 10 /end COMPU_METHOD
/begin COMPU_METHOD FORMULA_0539 "FORMULA_0539" RAT_FUNC "%5.0" "ms" COEFFS 0 1 0 0 0 100 /end COMPU_METHOD
/begin COMPU_METHOD FORMULA_0556 "FORMULA_0556" RAT_FUNC "%9.4" "-" COEFFS 0 10000 0 0 0 1 /end COMPU_METHOD
/begin COMPU_METHOD FORMULA_0595 "FORMULA_0595" RAT_FUNC "%5.0" "-" COEFFS 0 1 0 0 0 10 /end COMPU_METHOD
/begin COMPU_METHOD FORMULA_0643 "FORMULA_0643" RAT_FUNC "%5.2" "" COEFFS 0 128 0 0 0 1 /end COMPU_METHOD
/begin COMPU_METHOD FORMULA_0651 "FORMULA_0651" RAT_FUNC "%6.3" "s" COEFFS 0 0 1.28 0 1 0 /end COMPU_METHOD
/begin COMPU_METHOD FORMULA_0664 "FORMULA_0664" RAT_FUNC "%5.2" "s" COEFFS 0 0 2.56 0 1 0 /end COMPU_METHOD
/begin COMPU_METHOD FORMULA_0750 "FORMULA_0750" RAT_FUNC "%9.4" "mA" COEFFS 0 32768 0 0 0 10 /end COMPU_METHOD
/begin COMPU_METHOD FORMULA_0753 "FORMULA_0753" RAT_FUNC "%8.3" "s" COEFFS 0 1000 0 0 0 1 /end COMPU_METHOD
/begin COMPU_METHOD FORMULA_0755 "FORMULA_0755" RAT_FUNC "%7.2" "-" COEFFS 0 256 0 0 0 1 /end COMPU_METHOD
/begin COMPU_METHOD FORMULA_0762 "FORMULA_0762" RAT_FUNC "%5.0" "ms" COEFFS 0 1000 0 0 0 32 /end COMPU_METHOD
/begin COMPU_METHOD FORMULA_0764 "FORMULA_0764" RAT_FUNC "%5.0" "ms" COEFFS 0 1 0 0 0 1 /end COMPU_METHOD
/begin COMPU_METHOD FORMULA_0782 "FORMULA_0782" TAB_VERB "%7.2" "-" COMPU_TAB_REF FORMULA_0782_VTAB /end COMPU_METHOD
/begin COMPU_VTAB FORMULA_0782_VTAB "FORMULA_0782_VTAB" TAB_VERB 2 0 "automatisch" 1 "manuell" /end COMPU_VTAB
/begin COMPU_METHOD FORMULA_0783 "FORMULA_0783" TAB_VERB "%7.2" "-" COMPU_TAB_REF FORMULA_0783_VTAB /end COMPU_METHOD
/begin COMPU_VTAB FORMULA_0783_VTAB "FORMULA_0783_VTAB" TAB_VERB 2 0 "Regler inaktiv" 1 "Regler aktiv" /end COMPU_VTAB
/begin COMPU_METHOD FORMULA_0784 "FORMULA_0784" TAB_VERB "%7.2" "-" COMPU_TAB_REF FORMULA_0784_VTAB /end COMPU_METHOD
/begin COMPU_VTAB FORMULA_0784_VTAB "FORMULA_0784_VTAB" TAB_VERB 2 0 "ADAPTION" 1 "RESET" /end COMPU_VTAB
/begin COMPU_METHOD FORMULA_0785 "FORMULA_0785" TAB_VERB "%7.2" "-" COMPU_TAB_REF FORMULA_0785_VTAB /end COMPU_METHOD
/begin COMPU_VTAB FORMULA_0785_VTAB "FORMULA_0785_VTAB" TAB_VERB 2 0 "keine RESET-Anforderung" 1 "LA-RESET-Anforderung" /end COMPU_VTAB
/begin COMPU_METHOD FORMULA_0786 "FORMULA_0786" RAT_FUNC "%7.2" "ms" COEFFS 0 1000 0 0 0 1 /end COMPU_METHOD
/begin COMPU_METHOD FORMULA_0787 "FORMULA_0787" TAB_VERB "%7.2" "-" COMPU_TAB_REF FORMULA_0787_VTAB /end COMPU_METHOD
/begin COMPU_VTAB FORMULA_0787_VTAB "FORMULA_0787_VTAB" TAB_VERB 2 0 "Adaption inaktiv" 1 "Adaption aktiv" /end COMPU_VTAB
/begin COMPU_METHOD FORMULA_0788 "FORMULA_0788" TAB_VERB "%7.2" "-" COMPU_TAB_REF FORMULA_0788_VTAB /end COMPU_METHOD
/begin COMPU_VTAB FORMULA_0788_VTAB "FORMULA_0788_VTAB" TAB_VERB 2 0 "RESET inaktiv" 1 "RESET aktiv" /end COMPU_VTAB
/begin COMPU_METHOD FORMULA_0789 "FORMULA_0789" TAB_VERB "%7.2" "-" COMPU_TAB_REF FORMULA_0789_VTAB /end COMPU_METHOD
/begin COMPU_VTAB FORMULA_0789_VTAB "FORMULA_0789_VTAB" TAB_VERB 2 0 "keine Filterung" 1 "Filterung" /end COMPU_VTAB
/begin COMPU_METHOD FORMULA_0790 "FORMULA_0790" TAB_VERB "%7.2" "-" COMPU_TAB_REF FORMULA_0790_VTAB /end COMPU_METHOD
/begin COMPU_VTAB FORMULA_0790_VTAB "FORMULA_0790_VTAB" TAB_VERB 2 0 "inaktiv" 1 "aktiv" /end COMPU_VTAB
/begin COMPU_METHOD FORMULA_0791 "FORMULA_0791" RAT_FUNC "%5.0" "�C" COEFFS 0 1 0 0 0 1 /end COMPU_METHOD
/begin COMPU_METHOD FORMULA_0792 "FORMULA_0792" RAT_FUNC "%6.1" "-" COEFFS 0 512 0 0 0 1 /end COMPU_METHOD
/begin COMPU_METHOD FORMULA_0797 "FORMULA_0797" TAB_VERB "%7.2" "-" COMPU_TAB_REF FORMULA_0797_VTAB /end COMPU_METHOD
/begin COMPU_VTAB FORMULA_0797_VTAB "FORMULA_0797_VTAB" TAB_VERB 2 1 "t_segm-144�KW" 2 "t_segm-72�KW" /end COMPU_VTAB
/begin COMPU_METHOD FORMULA_0798 "FORMULA_0798" TAB_VERB "%7.2" "-" COMPU_TAB_REF FORMULA_0798_VTAB /end COMPU_METHOD
/begin COMPU_VTAB FORMULA_0798_VTAB "FORMULA_0798_VTAB" TAB_VERB 2 0 "inaktiv" 1 "aktiv" /end COMPU_VTAB
/begin COMPU_METHOD FORMULA_0799 "FORMULA_0799" RAT_FUNC "%5.0" "sec" COEFFS 0 1 0 0 0 1 /end COMPU_METHOD
/begin COMPU_METHOD FORMULA_0800 "FORMULA_0800" RAT_FUNC "%6.1" "�C" COEFFS 0 10 0 0 0 1 /end COMPU_METHOD
/begin COMPU_METHOD FORMULA_0801 "FORMULA_0801" RAT_FUNC "%8.3" "1/s" COEFFS 0 16384 0 0 0 1 /end COMPU_METHOD
/begin COMPU_METHOD FORMULA_0802 "FORMULA_0802" RAT_FUNC "%8.3" "-/s" COEFFS 0 16384 0 0 0 1 /end COMPU_METHOD
/begin COMPU_METHOD FORMULA_0803 "FORMULA_0803" RAT_FUNC "%6.1" "mg" COEFFS 0 10 0 0 0 1 /end COMPU_METHOD
/begin COMPU_METHOD FORMULA_0804 "FORMULA_0804" RAT_FUNC "%5.0" "sec" COEFFS 0 100 0 0 0 1 /end COMPU_METHOD
/begin COMPU_METHOD FORMULA_0805 "FORMULA_0805" RAT_FUNC "%7.2" "-" COEFFS 0 128 0 0 0 1 /end COMPU_METHOD
/begin COMPU_METHOD FORMULA_0806 "FORMULA_0806" RAT_FUNC "%8.3" "1/�KW" COEFFS 0 1024 0 0 0 1 /end COMPU_METHOD
/begin COMPU_METHOD FORMULA_0807 "FORMULA_0807" TAB_VERB "%7.2" "-" COMPU_TAB_REF FORMULA_0807_VTAB /end COMPU_METHOD
/begin COMPU_VTAB FORMULA_0807_VTAB "FORMULA_0807_VTAB" TAB_VERB 2 0 "no" 1 "yes" /end COMPU_VTAB
/begin COMPU_METHOD FORMULA_0832 "FORMULA_0832" RAT_FUNC "%5.0" "mg" COEFFS 0 1 0 0 0 1 /end COMPU_METHOD
/begin COMPU_METHOD FORMULA_0838 "FORMULA_0838" RAT_FUNC "%7.2" "-" COEFFS 0 255 0 0 0 1 /end COMPU_METHOD
/begin COMPU_METHOD FORMULA_0839 "FORMULA_0839" TAB_VERB "%5.2" "-" COMPU_TAB_REF FORMULA_0839_VTAB /end COMPU_METHOD
/begin COMPU_VTAB FORMULA_0839_VTAB "FORMULA_0839_VTAB" TAB_VERB 2 0 "inaktiv" 1 "aktiv" /end COMPU_VTAB
/begin COMPU_METHOD FORMULA_0840 "FORMULA_0840" RAT_FUNC "%6.1" "%" COEFFS 0 1024 0 0 0 100 /end COMPU_METHOD
/begin COMPU_METHOD FORMULA_0889 "FORMULA_0889" TAB_VERB "%3.0" "-" COMPU_TAB_REF FORMULA_0889_VTAB /end COMPU_METHOD
/begin COMPU_VTAB FORMULA_0889_VTAB "FORMULA_0889_VTAB" TAB_VERB 2 0 "Off" 1 "On" DEFAULT_VALUE "nicht definiert" /end COMPU_VTAB
/begin COMPU_METHOD FORMULA_0890 "FORMULA_0890" TAB_VERB "%3.0" "-" COMPU_TAB_REF FORMULA_0890_VTAB /end COMPU_METHOD
/begin COMPU_VTAB FORMULA_0890_VTAB "FORMULA_0890_VTAB" TAB_VERB 2 0 "Disable" 1 "Enable" DEFAULT_VALUE "nicht definiert" /end COMPU_VTAB
/begin COMPU_METHOD FORMULA_0891 "FORMULA_0891" RAT_FUNC "%3.0" "uA" COEFFS 0 -1 5.15 0 0 -5.15 /end COMPU_METHOD
/begin COMPU_METHOD FORMULA_0892 "FORMULA_0892" RAT_FUNC "%4.1" "ms" COEFFS 0 -1 0.8 0 0 -0.1 /end COMPU_METHOD
/begin COMPU_METHOD FORMULA_0893 "FORMULA_0893" RAT_FUNC "%6.3" "kHz" COEFFS 0 -1 1.9531 0 0 -0.122 /end COMPU_METHOD
/begin COMPU_METHOD FORMULA_0894 "FORMULA_0894" TAB_VERB "%3.0" "-" COMPU_TAB_REF FORMULA_0894_VTAB /end COMPU_METHOD
/begin COMPU_VTAB FORMULA_0894_VTAB "FORMULA_0894_VTAB" TAB_VERB 2 0 "inaktiv" 1 "aktiv" DEFAULT_VALUE "nicht definiert" /end COMPU_VTAB
/begin COMPU_METHOD FORMULA_0932 "FORMULA_0932" RAT_FUNC "%5.0" "s" COEFFS 0 100 0 0 0 1 /end COMPU_METHOD
/begin COMPU_METHOD FORMULA_0966 "FORMULA_0966" TAB_VERB "%5.2" "-" COMPU_TAB_REF FORMULA_0966_VTAB /end COMPU_METHOD
/begin COMPU_VTAB FORMULA_0966_VTAB "FORMULA_0966_VTAB" TAB_VERB 5 0 "Schalter" 1 "Komfort" 2 "Normal" 3 "Sport" 4 "Konfigmode" DEFAULT_VALUE "undef" /end COMPU_VTAB
/begin COMPU_METHOD FORMULA_0967 "FORMULA_0967" TAB_VERB "%5.2" "-" COMPU_TAB_REF FORMULA_0967_VTAB /end COMPU_METHOD
/begin COMPU_VTAB FORMULA_0967_VTAB "FORMULA_0967_VTAB" TAB_VERB 2 0 "nur US" 1 "immer" /end COMPU_VTAB
/begin COMPU_METHOD FORMULA_0979 "FORMULA_0979" RAT_FUNC "%9.4" "kg/h" COEFFS 0 512 0 0 0 1 /end COMPU_METHOD
/begin COMPU_METHOD FORMULA_0980 "FORMULA_0980" RAT_FUNC "%7.2" "(kg/h)/mbar" COEFFS 0 1024 0 0 0 1 /end COMPU_METHOD
/begin COMPU_METHOD FORMULA_0984 "FORMULA_0984" RAT_FUNC "%5.0" "mbar" COEFFS 0 16 0 0 0 1 /end COMPU_METHOD
/begin COMPU_METHOD FORMULA_0985 "FORMULA_0985" RAT_FUNC "%7.2" "s" COEFFS 0 0 327.67 0 1 0 /end COMPU_METHOD
/begin COMPU_METHOD FORMULA_0986 "FORMULA_0986" RAT_FUNC "%8.3" "mbar" COEFFS 0 16 0 0 0 1 /end COMPU_METHOD
/begin COMPU_METHOD FORMULA_0987 "FORMULA_0987" RAT_FUNC "%8.3" "�C" COEFFS 0 10 2732 0 0 1 /end COMPU_METHOD
/begin COMPU_METHOD FORMULA_0988 "FORMULA_0988" RAT_FUNC "%8.3" "mbar/V" COEFFS 0 80 0 0 0 1 /end COMPU_METHOD
/begin COMPU_METHOD FORMULA_0989 "FORMULA_0989" RAT_FUNC "%8.3" "s" COEFFS 0 0 327.67 0 1 0 /end COMPU_METHOD
/begin COMPU_METHOD FORMULA_0990 "FORMULA_0990" TAB_VERB "%5.2" "-" COMPU_TAB_REF FORMULA_0990_VTAB /end COMPU_METHOD
/begin COMPU_VTAB FORMULA_0990_VTAB "FORMULA_0990_VTAB" TAB_VERB 2 0 "mvac_ml_sr_rsv_mess" 1 "mvac_ml_sr_rsv_psens" DEFAULT_VALUE "undef" /end COMPU_VTAB
/begin COMPU_METHOD FORMULA_0991 "FORMULA_0991" RAT_FUNC "%8.3" "(kg/h)/mbar" COEFFS 0 1024 0 0 0 1 /end COMPU_METHOD
/begin COMPU_METHOD FORMULA_0992 "FORMULA_0992" RAT_FUNC "%7.2" "kg/h" COEFFS 0 80 0 0 0 1 /end COMPU_METHOD
/begin COMPU_METHOD FORMULA_0993 "FORMULA_0993" RAT_FUNC "%7.2" "1/2^20" COEFFS 0 16 0 0 0 1 /end COMPU_METHOD
/begin COMPU_METHOD FORMULA_0994 "FORMULA_0994" RAT_FUNC "%6.1" "1/2^20" COEFFS 0 16 0 0 0 1 /end COMPU_METHOD
/begin COMPU_METHOD FORMULA_0995 "FORMULA_0995" RAT_FUNC "%8.1" "ccm" COEFFS 0 10 0 0 0 1 /end COMPU_METHOD
/begin COMPU_METHOD FORMULA_0997 "FORMULA_0997" RAT_FUNC "%8.3" "qcm" COEFFS 0 1000 0 0 0 1 /end COMPU_METHOD
/begin COMPU_METHOD FORMULA_0998 "FORMULA_0998" RAT_FUNC "%7.2" "ms" COEFFS 0 100 0 0 0 1 /end COMPU_METHOD
/begin COMPU_METHOD FORMULA_1000 "FORMULA_1000" TAB_VERB "%5.2" "-" COMPU_TAB_REF FORMULA_1000_VTAB /end COMPU_METHOD
/begin COMPU_VTAB FORMULA_1000_VTAB "FORMULA_1000_VTAB" TAB_VERB 4 1 "HFM" 2 "PSAU" 4 "AQ" 8 "HFM-AQ Komb" DEFAULT_VALUE "undefiniert" /end COMPU_VTAB
/begin COMPU_METHOD FORMULA_1001 "FORMULA_1001" TAB_VERB "%5.2" "-" COMPU_TAB_REF FORMULA_1001_VTAB /end COMPU_METHOD
/begin COMPU_VTAB FORMULA_1001_VTAB "FORMULA_1001_VTAB" TAB_VERB 3 1 "HFM" 2 "PSAU" 4 "AQ" DEFAULT_VALUE "undefiniert" /end COMPU_VTAB
/begin COMPU_METHOD FORMULA_1002 "FORMULA_1002" TAB_VERB "%5.2" "-" COMPU_TAB_REF FORMULA_1002_VTAB /end COMPU_METHOD
/begin COMPU_VTAB FORMULA_1002_VTAB "FORMULA_1002_VTAB" TAB_VERB 4 1 "TAN HFM" 2 "TAN Modell" 4 "TMOT" 8 "TAN+TMOT/2" /end COMPU_VTAB
/begin COMPU_METHOD FORMULA_1003 "FORMULA_1003" RAT_FUNC "%6.1" "J/K*mol" COEFFS 0 10 0 0 0 1 /end COMPU_METHOD
/begin COMPU_METHOD FORMULA_1004 "FORMULA_1004" RAT_FUNC "%9.4" "-/tseg" COEFFS 0 10000 0 0 0 1 /end COMPU_METHOD
/begin COMPU_METHOD FORMULA_1029 "FORMULA_1029" TAB_VERB "%7.2" "-" COMPU_TAB_REF FORMULA_1029_VTAB /end COMPU_METHOD
/begin COMPU_VTAB FORMULA_1029_VTAB "FORMULA_1029_VTAB" TAB_VERB 2 0 "inaktiv" 1 "TRIMMREGELUNG" /end COMPU_VTAB
/begin COMPU_METHOD FORMULA_1030 "FORMULA_1030" RAT_FUNC "%7.2" "s" COEFFS 0 1000 0 0 0 1 /end COMPU_METHOD
/begin COMPU_METHOD FORMULA_1031 "FORMULA_1031" RAT_FUNC "%7.2" "l" COEFFS 0 30 0 0 0 1 /end COMPU_METHOD
/* ------------------ Abschnitt erzeugt aus dqlt.dat ------------------ */
/begin CHARACTERISTIC K_TOGMAXUNPL "" VALUE 0x7058C TKW_VV_VV_UL 100.0 FORMULA_0000 0.0 4294967295.0000 /end CHARACTERISTIC
/begin CHARACTERISTIC K_TOG_CNTMAX " | EN: Max Versuche für Signal-Fehler Toens" VALUE 0x70590 TKW_VV_VV_UL 100.0 FORMULA_0000 0.0 4294967295.0000 /end CHARACTERISTIC
/begin CHARACTERISTIC K_OZDIAGNMOT "Mindestdrehzahl zur QLT-Diagnose | EN: Minimum engine speed for oil-quality diagnosis [Upm]" VALUE 0x70594 TKW_VV_VV_SW 100.0 FORMULA_0006 -32768.0000 32767.0000 /end CHARACTERISTIC
/begin CHARACTERISTIC K_OZDIAGNMOT2 "Max Drehzahl zur QLT-Diagnose | EN: Maximum engine speed for oil-quality diagnosis [Upm]" VALUE 0x70596 TKW_VV_VV_SW 100.0 FORMULA_0006 -32768.0000 32767.0000 /end CHARACTERISTIC
/begin CHARACTERISTIC K_OZTEMPQERR "Temperaturschwelle f�r den Permittivit�tsfehler | EN: Temperature threshold for permittivity fault [°C]" VALUE 0x70598 TKW_VV_VV_SW 100.0 FORMULA_0426 -3276.8000 3276.7000 /end CHARACTERISTIC
/begin CHARACTERISTIC K_DTOG_UBMIN "" VALUE 0x7059A TKW_VV_VV_UW 100.0 FORMULA_0427 0.0 6173.3970 FORMAT "%4.1" /end CHARACTERISTIC
/begin CHARACTERISTIC K_OZDELTOE "Verz�gerung f�r das Schreiben in Fehlerspeicher T�ns-Fehler | EN: Delay for writing oil-sensor fault to fault memory" VALUE 0x7059C TKW_VV_VV_UW 100.0 FORMULA_0010 0.0 65535.0000 /end CHARACTERISTIC
/begin CHARACTERISTIC K_OZDIAGSPG "Spannung, unterhalb der die Diagnose ausgeblendet wird | EN: Voltage below which the diagnosis is suppressed [V]" VALUE 0x7059E TKW_VV_VV_UW 100.0 FORMULA_0427 0.0 6173.3970 FORMAT "%4.1" /end CHARACTERISTIC
/begin CHARACTERISTIC K_OZERRD "Entprellzeit Sensor- und Kommunikationsfehler | EN: Debounce time, sensor and communication fault" VALUE 0x705A0 TKW_VV_VV_UW 100.0 FORMULA_0010 0.0 65535.0000 /end CHARACTERISTIC
/begin CHARACTERISTIC K_OZHEAL "Entprellzeit Fehler-Healing | EN: Debounce time, fault healing" VALUE 0x705A2 TKW_VV_VV_UW 100.0 FORMULA_0010 0.0 65535.0000 /end CHARACTERISTIC
/begin CHARACTERISTIC K_OZZTEMP "Max Zeit mit dem selben Temperaturwert (Plausibilisierung wegen ASIC-Pins Bruch) | EN: Maximum time with same temperature value (plausibility for ASIC pin break)" VALUE 0x705A4 TKW_VV_VV_UW 100.0 FORMULA_0010 0.0 65535.0000 /end CHARACTERISTIC
/begin CHARACTERISTIC K_OZPLTEMP "Max Temperatursprung QLT (Plausibilisierung wegen ASIC-Pins Bruch) | EN: Max Temperatursprung QLT (Plausibilisierung wegen ASIC- Pins Bruch)" VALUE 0x705A6 TKW_VV_VV_UB 100.0 FORMULA_0003 0.0 255.0000 /end CHARACTERISTIC
/begin CHARACTERISTIC K_OZPLZTEMP "Max unplausibel Spr�nge (Plausibilisierung wegen ASIC-Pins Bruch) | EN: Max unplausibel Sprünge (Plausibilisierung wegen ASIC- Pins Bruch)" VALUE 0x705A7 TKW_VV_VV_UB 100.0 FORMULA_0003 0.0 255.0000 /end CHARACTERISTIC
/* ------------------ Abschnitt erzeugt aus ozbg.dat ------------------ */
/begin CHARACTERISTIC K_CW_OZ_2 " | EN: Codeword OZ - 2" VALUE 0x75A70 TKW_VV_VV_UW 100.0 FORMULA_0010 0.0 65535.0000 /end CHARACTERISTIC
/begin CHARACTERISTIC K_OZZYKCBS "Zeitabstand f�rs zyklisch Senden der CBS-Nachricht" VALUE 0x75A72 TKW_VV_VV_UB 100.0 FORMULA_0003 0.0 255.0000 /end CHARACTERISTIC
/* ------------------ Abschnitt erzeugt aus ozgg.dat ------------------ */
/begin CHARACTERISTIC K_OZKMUPL "F�r die Kontrolle der Km_st-Plausibilit�t | EN: Für die Kontrolle der Km_st-Plausibilität" VALUE 0x75A74 TKW_VV_VV_UW 100.0 FORMULA_0432 0.0 655350.0000 /end CHARACTERISTIC
/begin CHARACTERISTIC K_CW_OZ_PERM "Codeword Permittivit�t | EN: Codeword Permittivität" VALUE 0x75A76 TKW_VV_VV_UB 100.0 FORMULA_0003 0.0 255.0000 /end CHARACTERISTIC
/begin CHARACTERISTIC K_OZBZKMSTK1 "Bezugsintervall [V912: differs from V452 160E]" VALUE 0x75A77 TKW_VV_VV_UB 100.0 FORMULA_0429 0.0 255000.0000 /end CHARACTERISTIC
/begin CHARACTERISTIC K_OZPERGRADMAX "Obere Grenze Permittivit�tsgradient (bitte K_OZPERGRADKD ber�cksichtigen) | EN: Obere Grenze Permittivitï¿½tsgradient (bitte K_OZPERGRADKD berï¿½cksichtigen)" VALUE 0x75A78 TKW_VV_VV_SW 100.0 FORMULA_0010 -32768.0000 32767.0000 /end CHARACTERISTIC
/begin CHARACTERISTIC K_OZPERGRADMIN "Untere Grenze Permittivit�tsgradient (bitte K_OZPERGRADKD ber�cksichtigen) | EN: Untere Grenze Permittivitï¿½tsgradient (bitte K_OZPERGRADKD berï¿½cksichtigen)" VALUE 0x75A7A TKW_VV_VV_SW 100.0 FORMULA_0010 -32768.0000 32767.0000 /end CHARACTERISTIC
/begin CHARACTERISTIC K_OZPERMWDMAX "Max positives Delta zwischen Mittelwerten Permittivit�t | EN: Max positives Delta zwischen Mittelwerten Permittivität" VALUE 0x75A7C TKW_VV_VV_SW 100.0 FORMULA_0010 -1024.0000 1024.0000 /end CHARACTERISTIC
/begin CHARACTERISTIC K_OZPERMWDMIN "Max negatives Delta zwischen Mittelwerten Permittivit�t | EN: Max negatives Delta zwischen Mittelwerten Permittivität" VALUE 0x75A7E TKW_VV_VV_SW 100.0 FORMULA_0010 -1024.0000 1024.0000 /end CHARACTERISTIC
/begin CHARACTERISTIC K_OZPERINI "Startwert f�r Oz_perref | EN: Startwert für Oz_perref" VALUE 0x75A80 TKW_VV_VV_UW 100.0 FORMULA_0010 0.0 1024.0000 /end CHARACTERISTIC
/begin CHARACTERISTIC K_OZPERKFIL "Zeitkonstante Permittivit�ts-LOW-Pass-Filter | EN: Zeitkonstante Permittivitäts-LOW-Pass-Filter" VALUE 0x75A82 TKW_VV_VV_UW 100.0 FORMULA_0433 0.0 99.9984 FORMAT "%5.2" /end CHARACTERISTIC
/begin CHARACTERISTIC K_OZPERMRMIN "Grenze f�r Niveauberechnung aus Permittivit�t | EN: Grenze für Niveauberechnung aus Permittivität" VALUE 0x75A84 TKW_VV_VV_UW 100.0 FORMULA_0010 0.0 65535.0000 /end CHARACTERISTIC
/begin CHARACTERISTIC K_OZPRREFMAX "Maximum f�r Referenzpermittivit�t | EN: Maximum für Referenzpermittivität" VALUE 0x75A86 TKW_VV_VV_UW 100.0 FORMULA_0010 0.0 1024.0000 /end CHARACTERISTIC
/begin CHARACTERISTIC K_OZPRREFMIN "Minimum f�r Referenzpermittivit�t | EN: Minimum für Referenzpermittivität" VALUE 0x75A88 TKW_VV_VV_UW 100.0 FORMULA_0010 0.0 1024.0000 /end CHARACTERISTIC
/begin CHARACTERISTIC K_TRTYP "Faktor f�r die Berechnung �l-Temperatur T�ns | EN: Faktor für die Berechnung Öl-Temperatur Töns" VALUE 0x75A8A TKW_VV_VV_UW 100.0 FORMULA_0021 0.0 655.3500 FORMAT "%5.2" /end CHARACTERISTIC
/begin CHARACTERISTIC K_OZNIVKL "Konvertierungsfaktor f�r den Niveau-Wert QLT | EN: Konvertierungsfaktor für den Niveau-Wert QLT" VALUE 0x75A8C TKW_VV_VV_UB 100.0 FORMULA_0431 0.0 74.7070 /end CHARACTERISTIC
/begin CHARACTERISTIC K_OZPERCMW "Anzahl Messungen f�r den Mittelwert Permittivit�t | EN: Anzahl Messungen für den Mit-telwert Permittivität" VALUE 0x75A8D TKW_VV_VV_UB 100.0 FORMULA_0003 1.0000 255.0000 /end CHARACTERISTIC
/begin CHARACTERISTIC K_OZPERGRADKD "Delta-Verst�rkungsfaktor f�r die Berechnung Permittivit�tsgradient | EN: berücksichti- gen)" VALUE 0x75A8E TKW_VV_VV_UB 100.0 FORMULA_0003 0.0 255.0000 /end CHARACTERISTIC
/begin CHARACTERISTIC K_OZPERGRADTN "Zeitkonstante f�r den Permittivit�tsgradientenverlauf | EN: Zeitkonstante für den Permittivitätsgradientenverlauf" VALUE 0x75A8F TKW_VV_VV_UB 100.0 FORMULA_0434 0.0 0.9960 /end CHARACTERISTIC
/begin CHARACTERISTIC K_OZSTZYK "Max Permittivit�tsfahler f�r die Niveau-Freigabe  | EN: Max Permittivitätsfahler für die Niveau-Freigabe" VALUE 0x75A90 TKW_VV_VV_UB 100.0 FORMULA_0003 0.0 255.0000 /end CHARACTERISTIC
/begin CHARACTERISTIC K_OZVERZNIVERS "Verz�gerung Umschaltung auf Niveau-Ersatzwert | EN: Verzögerung Umschaltung auf Niveau-Ersatzwert" VALUE 0x75A91 TKW_VV_VV_UB 100.0 FORMULA_0435 0.0 255.0000 /end CHARACTERISTIC
/begin CHARACTERISTIC K_TOGVERZOEG "F�r das �berspringen der ersten Messungen T�ns" VALUE 0x75A92 TKW_VV_VV_UB 100.0 FORMULA_0003 0.0 255.0000 /end CHARACTERISTIC
/begin CHARACTERISTIC KL_OZPERMKL "Skalierungskennlinie Permittivit�t | EN: Scaling curve, permittivity (oil quality)" CURVE 0x75A94 TKL_UW_VV_UW 100.0 FORMULA_0430 0.0 5.9999 /begin AXIS_DESCR STD_AXIS FORMULA_0010 2 0.0 65535.0000 /end AXIS_DESCR FORMAT "%4.1" /end CHARACTERISTIC
/begin CHARACTERISTIC KL_TVTOEL "F�r die �ltemperatur-Berechnung T�ns" CURVE 0x75A9E TKL_UW_VV_SW 100.0 FORMULA_0426 -3276.8000 3276.7000
 /begin AXIS_DESCR STD_AXIS NO_INPUT_QUANTITY FORMULA_0073 8 0.0 6553.5000 FORMAT "%4.1" /end AXIS_DESCR
/end CHARACTERISTIC
/begin CHARACTERISTIC KL_PERREFTKOR "Temperaturkompensation der Referenzpermittivit�t f�r den Niveauersatzwert" CURVE 0x75AC0 TKL_SW_VV_SW 100.0 FORMULA_0010 -1024.0000 1024.0000
 /begin AXIS_DESCR STD_AXIS NO_INPUT_QUANTITY FORMULA_0426 6 -3276.8000 3276.7000 /end AXIS_DESCR
/end CHARACTERISTIC
/begin CHARACTERISTIC KL_OZTEMPKL "F�r die �ltemperatur-Berechnung QLT | EN: Für die Öltemperatur-Berechnung QLT" CURVE 0x75ADA TKL_UW_VV_SW 100.0 FORMULA_0426 -3276.8000 3276.7000 /begin AXIS_DESCR STD_AXIS FORMULA_0010 6 0.0 65535.0000 /end AXIS_DESCR /end CHARACTERISTIC
/begin CHARACTERISTIC KL_TKTOENIV "Umsetzung Tk -> Oelnivau | EN: Conversion to oil level" CURVE 0x75AF4 TKL_UW_VV_UW 100.0 FORMULA_0073 0.0 75.0000
 /begin AXIS_DESCR STD_AXIS Td_og_tk FORMULA_0073 8 0.0 6553.5000 FORMAT "%4.1" /end AXIS_DESCR
 FORMAT "%4.1" /end CHARACTERISTIC
/* ------------------ Abschnitt erzeugt aus oznivdl.dat ------------------ */
/begin CHARACTERISTIC K_CW_OZ "" VALUE 0x75B16 TKW_VV_VV_UW 100.0 FORMULA_0010 0.0 65535.0000 /end CHARACTERISTIC
/begin CHARACTERISTIC K_OZVERLORI "Schwelle f�r Orientierungswert �lniveau (Verlustwarnung) | EN: Schwelle für Orientierungswert Ölniveau (Verlustwarnung)" VALUE 0x75B18 TKW_VV_VV_UB 100.0 FORMULA_0431 0.0 74.7070 /end CHARACTERISTIC
/begin CHARACTERISTIC KL_OZBEFKL "Bef�llkennlinie | EN: Fill curve (oil)" CURVE 0x75B19 TKL_UB_VV_UB 100.0 FORMULA_0436 0.0 25.5000 /begin AXIS_DESCR STD_AXIS FORMULA_0431 6 0.0 74.7070 FORMAT "%5.2" /end AXIS_DESCR /end CHARACTERISTIC
/begin CHARACTERISTIC K_OZMAXSLOPE "Maximale erlaubte Steigung | EN: Maximale erlaubte Steigung" VALUE 0x75B28 TKW_VV_VV_SW 100.0 FORMULA_0440 -64.0000 63.9980 FORMAT "%5.2" /end CHARACTERISTIC
/begin CHARACTERISTIC K_OZMINSLOPE "Kleinste erlaubte Steigung (<0) | EN: Kleinste erlaubte Steigung (<0)" VALUE 0x75B2A TKW_VV_VV_SW 100.0 FORMULA_0440 -64.0000 63.9980 FORMAT "%5.2" /end CHARACTERISTIC
/begin CHARACTERISTIC K_OZNMOTMAX "obere Drehzahlgrenze f�r drehzahlkorrigierten Niveaumittelwert | EN: obere Drehzahlgrenze für dreh-zahlkorrigierten Niveaumittelwert" VALUE 0x75B2C TKW_VV_VV_SW 100.0 FORMULA_0006 -32768.0000 32767.0000 /end CHARACTERISTIC
/begin CHARACTERISTIC K_OZNMOTMIN "untere Drehzahlgrenze f�r drehzahlkorrigierten Niveaumittelwert | EN: untere Drehzahlgrenze für dreh- zahlkorrigierten Niveaumittelwert" VALUE 0x75B2E TKW_VV_VV_SW 100.0 FORMULA_0006 -32768.0000 32767.0000 /end CHARACTERISTIC
/begin CHARACTERISTIC K_OZTEMPBW "Temperaturschwelle �ltemperatur Motor betriebswarm | EN: Temperaturschwelle Öltempera-tur Motor betriebswarm" VALUE 0x75B30 TKW_VV_VV_SW 100.0 FORMULA_0426 -3276.8000 3276.7000 /end CHARACTERISTIC
/begin CHARACTERISTIC K_OZTORMAX "Temperaturschwelle f�r Orientierungsmessung" VALUE 0x75B32 TKW_VV_VV_SW 100.0 FORMULA_0426 -3276.8000 3276.7000 /end CHARACTERISTIC
/begin CHARACTERISTIC K_OZTORMIN "Mindest Temperatur f�r OrientierungMw QLT | EN: Mindest Temperatur für OrientierungMw QLT" VALUE 0x75B34 TKW_VV_VV_SW 100.0 FORMULA_0443 -327.6800 327.6700 FORMAT "%5.2" /end CHARACTERISTIC
/begin CHARACTERISTIC K_OZUEFNST "Maximale negative Steigung f�r die �berf�llungserkenung" VALUE 0x75B36 TKW_VV_VV_SW 100.0 FORMULA_0440 -64.0000 63.9980 FORMAT "%5.2" /end CHARACTERISTIC
/begin CHARACTERISTIC K_OZUEFODZ "Obere Drehzahlgrenze f�r die �berf�llungserkennung" VALUE 0x75B38 TKW_VV_VV_SW 100.0 FORMULA_0006 -32768.0000 32767.0000 /end CHARACTERISTIC
/begin CHARACTERISTIC K_OZUEFPST "Maximale positive Steigung f�r die �berf�llungserkenung" VALUE 0x75B3A TKW_VV_VV_SW 100.0 FORMULA_0440 -64.0000 63.9980 FORMAT "%5.2" /end CHARACTERISTIC
/begin CHARACTERISTIC K_OZUEFTEM "Mindest�ltemperatur f�r die �berf�llungserkennung" VALUE 0x75B3C TKW_VV_VV_SW 100.0 FORMULA_0426 -3276.8000 3276.7000 /end CHARACTERISTIC
/begin CHARACTERISTIC K_OZUEFUDZ "Untere Drehzahlgrenze f�r die �berf�llungserkennung" VALUE 0x75B3E TKW_VV_VV_SW 100.0 FORMULA_0006 -32768.0000 32767.0000 /end CHARACTERISTIC
/begin CHARACTERISTIC K_OZVORMV "Korrektur von Vormw f�r Peilstab | EN: Korrektur von Vormw für Peilstab" VALUE 0x75B40 TKW_VV_VV_SW 100.0 FORMULA_0444 -32.0000 31.9990 FORMAT "%7.4" /end CHARACTERISTIC
/begin CHARACTERISTIC K_OZABSTELL "Mindestwert f�r die �bernahme der Abstellzeit | EN: Mindestwert für die Übernahme der Abstellzeit" VALUE 0x75B42 TKW_VV_VV_UW 100.0 FORMULA_0438 0.0 65535.0000 FORMAT "%5.2" /end CHARACTERISTIC
/begin CHARACTERISTIC K_OZALTANZABZ "Abstellzeit f�r die Ausgabe der letzten Anzeige nach dem �lcheck | EN: Abstellzeit für die Ausgabe der letzten Anzeige nach dem Ölcheck" VALUE 0x75B44 TKW_VV_VV_UW 100.0 FORMULA_0438 0.0 65535.0000 FORMAT "%5.2" /end CHARACTERISTIC
/begin CHARACTERISTIC K_OZLUFTMAX "Plausibel max luftsprung | EN: hPa 0.0p 3 10*x/256 Plausibel max luftsprung" VALUE 0x75B46 TKW_VV_VV_UW 100.0 FORMULA_0445 0.0 2559.9609 FORMAT "%6.3" /end CHARACTERISTIC
/begin CHARACTERISTIC K_OZMWL "Anzahl der Messwerte f�r Langzeit-Mittelwert Niveau | EN: Anzahl der Messwerte für Lang-zeit-Mittelwert Niveau" VALUE 0x75B48 TKW_VV_VV_UW 100.0 FORMULA_0010 0.0 65535.0000 /end CHARACTERISTIC
/begin CHARACTERISTIC K_OZMWOR "Anzahl der Messwerte f�r Orientierungsmessung | EN: Anzahl der Messwerte für Orien-tierungsmessung" VALUE 0x75B4A TKW_VV_VV_UW 100.0 FORMULA_0010 0.0 65535.0000 /end CHARACTERISTIC
/begin CHARACTERISTIC K_OZMWV "Anzahl der Messwerte f�r vorgezogenen Mittelwert Niveau | EN: Anzahl der Messwerte für vorge-zogenen Mittelwert Niveau" VALUE 0x75B4C TKW_VV_VV_UW 100.0 FORMULA_0010 0.0 65535.0000 /end CHARACTERISTIC
/begin CHARACTERISTIC K_OZOELCABZ "Minimale Abstellzeit f�r den �lCheck | EN: Minimale Abstellzeit für den ÖlCheck" VALUE 0x75B4E TKW_VV_VV_UW 100.0 FORMULA_0438 0.0 65535.0000 FORMAT "%5.2" /end CHARACTERISTIC
/begin CHARACTERISTIC K_OZOELVERB "�lverbrauch | EN: Ölverbrauch" VALUE 0x75B50 TKW_VV_VV_UW 100.0 FORMULA_0010 0.0 65535.0000 /end CHARACTERISTIC
/begin CHARACTERISTIC K_OZSTARTABZ "Mindestlaufzeit f�r die �bernahme der Abstellzeit | EN: Mindestlaufzeit für die Übernah-me der Abstellzeit" VALUE 0x75B52 TKW_VV_VV_UW 100.0 FORMULA_0021 0.0 655.3500 FORMAT "%5.2" /end CHARACTERISTIC
/begin CHARACTERISTIC K_OZSTMINW "Minimale Strecke f�r die Steigungserkennung | EN: Minimale Strecke für die Stei-gungserkennung" VALUE 0x75B54 TKW_VV_VV_UW 100.0 FORMULA_0441 0.0 9.9998 FORMAT "%5.2" /end CHARACTERISTIC
/begin CHARACTERISTIC K_OZVERBDKM "Delta km f�r die �lverbrauch-Berechnung" VALUE 0x75B56 TKW_VV_VV_UW 100.0 FORMULA_0432 0.0 655350.0000 /end CHARACTERISTIC
/begin CHARACTERISTIC K_OZLBESCHN "Negative L�ngsbeschleunigung Ausblendung-Schwelle  | EN: Negative Längsbeschleunigung Ausblendung-Schwelle" VALUE 0x75B58 TKW_VV_VV_SB 100.0 FORMULA_0446 -32.0000 31.7500 /end CHARACTERISTIC
/begin CHARACTERISTIC K_OZLBESCHORI "L�ngsbeschleunigung Ausblendung-Schwelle beim OriMw | EN: Längsbeschleunigung Ausblen-dung-Schwelle beim OriMw" VALUE 0x75B59 TKW_VV_VV_SB 100.0 FORMULA_0446 -32.0000 31.7500 /end CHARACTERISTIC
/begin CHARACTERISTIC K_OZLBESCHP "Positive L�ngsbeschleunigung Ausblendung-Schwelle  | EN: Positive Längsbeschleunigung Ausblendung-Schwelle" VALUE 0x75B5A TKW_VV_VV_SB 100.0 FORMULA_0446 -32.0000 31.7500 /end CHARACTERISTIC
/begin CHARACTERISTIC K_OZLBESCHST "L�ngsbeschleunigung Ausblendung-Schwelle im Stand | EN: Längsbeschleunigung Ausblen-dung-Schwelle im Stand" VALUE 0x75B5B TKW_VV_VV_SB 100.0 FORMULA_0446 -32.0000 31.7500 /end CHARACTERISTIC
/begin CHARACTERISTIC K_OZQBESCHN "Negative Querbeschleunigung Ausblendung-Schwelle  | EN: Negative Querbeschleunigung Ausblendung-Schwelle" VALUE 0x75B5C TKW_VV_VV_SB 100.0 FORMULA_0446 -32.0000 31.7500 /end CHARACTERISTIC
/begin CHARACTERISTIC K_OZQBESCHORI "Querbeschleunigung Ausblendung-Schwelle Beim OriMw | EN: Querbeschleunigung Ausblen-dung-Schwelle Beim OriMw" VALUE 0x75B5D TKW_VV_VV_SB 100.0 FORMULA_0446 -32.0000 31.7500 /end CHARACTERISTIC
/begin CHARACTERISTIC K_OZQBESCHP "Positive Querbeschleunigung Ausblendung-Schwelle  | EN: Positive Querbeschleunigung Ausblendung-Schwelle" VALUE 0x75B5E TKW_VV_VV_SB 100.0 FORMULA_0446 -32.0000 31.7500 /end CHARACTERISTIC
/begin CHARACTERISTIC K_OZQBESCHST "Querbeschleunigung Ausblendung-Schwelle im Stand | EN: Querbeschleunigung Ausblen-dung-Schwelle im Stand" VALUE 0x75B5F TKW_VV_VV_SB 100.0 FORMULA_0446 -32.0000 31.7500 /end CHARACTERISTIC
/begin CHARACTERISTIC K_OZUEFNLB "Negative L�ngsbeschleunigungsgrenze f�r die �berf�llung" VALUE 0x75B60 TKW_VV_VV_SB 100.0 FORMULA_0446 -32.0000 31.7500 /end CHARACTERISTIC
/begin CHARACTERISTIC K_OZUEFNQB "Negative Querbeschleunigungsgrenze f�r die �berf�llung" VALUE 0x75B61 TKW_VV_VV_SB 100.0 FORMULA_0446 -32.0000 31.7500 /end CHARACTERISTIC
/begin CHARACTERISTIC K_OZUEFPLB "Positive L�ngsbeschleunigungsgrenze f�r die �berf�llung" VALUE 0x75B62 TKW_VV_VV_SB 100.0 FORMULA_0446 -32.0000 31.7500 /end CHARACTERISTIC
/begin CHARACTERISTIC K_OZUEFPQB "Positive Querbeschleunigungsgrenze f�r die �berf�llung" VALUE 0x75B63 TKW_VV_VV_SB 100.0 FORMULA_0446 -32.0000 31.7500 /end CHARACTERISTIC
/begin CHARACTERISTIC K_NACHFUELL12 "Nachf�ll Erste Balken von Peistab | EN: Nachfüll Erste Balken von Peistab" VALUE 0x75B64 TKW_VV_VV_UB 100.0 FORMULA_0003 0.0 255.0000 /end CHARACTERISTIC
/begin CHARACTERISTIC K_NACHFUELL25 "Nachf�ll Zweite Balken von Peistab | EN: Nachfüll Zweite Balken von Peistab" VALUE 0x75B65 TKW_VV_VV_UB 100.0 FORMULA_0003 0.0 255.0000 /end CHARACTERISTIC
/begin CHARACTERISTIC K_NACHFUELL38 "Nachf�ll Dritte Balken von Peistab | EN: Nachfüll Dritte Balken von Peistab" VALUE 0x75B66 TKW_VV_VV_UB 100.0 FORMULA_0003 0.0 255.0000 /end CHARACTERISTIC
/begin CHARACTERISTIC K_NACHFUELL53 "Nachf�ll Vierte Balken von Peistab | EN: Nachfüll Vierte Balken von Peistab" VALUE 0x75B67 TKW_VV_VV_UB 100.0 FORMULA_0003 0.0 255.0000 /end CHARACTERISTIC
/begin CHARACTERISTIC K_NACHFUELL69 "Nachf�ll F�nfte Balken von Peistab | EN: Nachfüll Fünfte Balken von Peistab" VALUE 0x75B68 TKW_VV_VV_UB 100.0 FORMULA_0003 0.0 255.0000 /end CHARACTERISTIC
/begin CHARACTERISTIC K_NACHFUELL85 "Nachf�ll Sechte Balken von Peistab | EN: Nachfüll Sechte Balken von Peistab" VALUE 0x75B69 TKW_VV_VV_UB 100.0 FORMULA_0003 0.0 255.0000 /end CHARACTERISTIC
/begin CHARACTERISTIC K_NACHFUELL95 "Nachf�ll Siebte Balken von Peistab | EN: Nachfüll Siebte Balken von Peistab" VALUE 0x75B6A TKW_VV_VV_UB 100.0 FORMULA_0003 0.0 255.0000 /end CHARACTERISTIC
/begin CHARACTERISTIC K_OZBESCHAUS "Zahl Ausgeblendet bei Lengsbescheunigung | EN: Zahl Ausgeblendet bei Lengsbescheunigung" VALUE 0x75B6B TKW_VV_VV_UB 100.0 FORMULA_0003 0.0 255.0000 /end CHARACTERISTIC
/begin CHARACTERISTIC K_OZDKNIVN "Ersatzwert f�r die Drehzahlkorrektur bei Oz_peilaltanz = 0 | EN: Ersatzwert für die Drehzahlkor-rektur bei Oz_peilaltanz = 0" VALUE 0x75B6C TKW_VV_VV_UB 100.0 FORMULA_0431 0.0 74.7070 /end CHARACTERISTIC
/begin CHARACTERISTIC K_OZMWK "Anzahl der Messwerte f�r Kurzzeit-Mittelwert Niveau | EN: Number of measurements for short-term level average" VALUE 0x75B6D TKW_VV_VV_UB 100.0 FORMULA_0003 0.0 255.0000 /end CHARACTERISTIC
/begin CHARACTERISTIC K_OZNFERR "Nachf�llmengenanzeige bei PreCheck OK | EN: Top-up quantity display when pre-check OK" VALUE 0x75B6E TKW_VV_VV_UB 100.0 FORMULA_0003 0.0 255.0000 /end CHARACTERISTIC
/begin CHARACTERISTIC K_OZNFML "Nachf�llmengenanzeige bei  | EN: Top-up quantity display while measuring" VALUE 0x75B6F TKW_VV_VV_UB 100.0 FORMULA_0003 0.0 255.0000 /end CHARACTERISTIC
/begin CHARACTERISTIC K_OZNFOELCKO "Nachf�llmengenanzeige bei PreCheck KO | EN: Top-up quantity display when pre-check not OK" VALUE 0x75B70 TKW_VV_VV_UB 100.0 FORMULA_0003 0.0 255.0000 /end CHARACTERISTIC
/begin CHARACTERISTIC K_OZNFOELCOK "Nachf�llmengenanzeige bei PreCheck OK | EN: Top-up quantity display when pre-check OK" VALUE 0x75B71 TKW_VV_VV_UB 100.0 FORMULA_0003 0.0 255.0000 /end CHARACTERISTIC
/begin CHARACTERISTIC K_OZOELCOK "PreDriveCheck-Schwelle | EN: Pre-drive check threshold [mm]" VALUE 0x75B72 TKW_VV_VV_UB 100.0 FORMULA_0431 0.0 74.7070 /end CHARACTERISTIC
/begin CHARACTERISTIC K_OZOELCVERZ "Verz�gerung f�r den �lcheck | EN: Delay for the oil check [s]" VALUE 0x75B73 TKW_VV_VV_UB 100.0 FORMULA_0003 0.0 255.0000 /end CHARACTERISTIC
/begin CHARACTERISTIC K_OZORIPEILTZO "Ausgabeniveau f�r die tote Zone Orientierung-Check Peilstab mit alter Anzeige >= Mitte | EN: Output level for dead zone, orientation check, electronic dipstick with old display >= middle [mm]" VALUE 0x75B74 TKW_VV_VV_UB 100.0 FORMULA_0431 0.0 74.7070 /end CHARACTERISTIC
/begin CHARACTERISTIC K_OZORIPEILTZU "Ausgabeniveau f�r die tote Zone Orientierung-Check Peilstab mit alter Anzeige < Mitte | EN: Output level for dead zone, orientation check, electronic dipstick with old display < middle [mm]" VALUE 0x75B75 TKW_VV_VV_UB 100.0 FORMULA_0431 0.0 74.7070 /end CHARACTERISTIC
/begin CHARACTERISTIC K_OZPEIL12 "Erste Balken von Peistab | EN: First bar of electronic dipstick [mm]" VALUE 0x75B76 TKW_VV_VV_UB 100.0 FORMULA_0431 0.0 74.7070 /end CHARACTERISTIC
/begin CHARACTERISTIC K_OZPEIL25 "Zweite Balken von Peistab | EN: Second bar of electronic dipstick [mm]" VALUE 0x75B77 TKW_VV_VV_UB 100.0 FORMULA_0431 0.0 74.7070 /end CHARACTERISTIC
/begin CHARACTERISTIC K_OZPEIL38 "Dritte Balken von Peistab | EN: Third bar of electronic dipstick [mm]" VALUE 0x75B78 TKW_VV_VV_UB 100.0 FORMULA_0431 0.0 74.7070 /end CHARACTERISTIC
/begin CHARACTERISTIC K_OZPEIL53 "Vierte Balken von Peistab | EN: Fourth bar of electronic dipstick [mm]" VALUE 0x75B79 TKW_VV_VV_UB 100.0 FORMULA_0431 0.0 74.7070 /end CHARACTERISTIC
/begin CHARACTERISTIC K_OZPEIL69 "F�nfte Balken von Peistab | EN: Fifth bar of electronic dipstick [mm]" VALUE 0x75B7A TKW_VV_VV_UB 100.0 FORMULA_0431 0.0 74.7070 /end CHARACTERISTIC
/begin CHARACTERISTIC K_OZPEIL85 "Sechte Balken von Peistab | EN: Sixth bar of electronic dipstick [mm]" VALUE 0x75B7B TKW_VV_VV_UB 100.0 FORMULA_0431 0.0 74.7070 /end CHARACTERISTIC
/begin CHARACTERISTIC K_OZPEILDO "Delta + Hysterese Peilstab | EN: Delta + hysteresis, dipstick [mm]" VALUE 0x75B7C TKW_VV_VV_UB 100.0 FORMULA_0431 0.0 74.7070 /end CHARACTERISTIC
/begin CHARACTERISTIC K_OZPEILDOMIN "Delta + Hysterese Peilstab bei Min | EN: Delta + hysteresis, dipstick at minimum [mm]" VALUE 0x75B7D TKW_VV_VV_UB 100.0 FORMULA_0431 0.0 74.7070 /end CHARACTERISTIC
/begin CHARACTERISTIC K_OZPEILDU "Delta - Hysterese Peilstab | EN: Delta - hysteresis, dipstick [mm]" VALUE 0x75B7E TKW_VV_VV_UB 100.0 FORMULA_0431 0.0 74.7070 /end CHARACTERISTIC
/begin CHARACTERISTIC K_OZPEILDU38 "Delta - Hysterese Peilstab bei 1/4 | EN: Delta - hysteresis, dipstick at 1/4 [mm]" VALUE 0x75B7F TKW_VV_VV_UB 100.0 FORMULA_0431 0.0 74.7070 /end CHARACTERISTIC
/begin CHARACTERISTIC K_OZPEILERR "Balkenanzeige im Fehlerfall | EN: Bar display in fault case" VALUE 0x75B80 TKW_VV_VV_UB 100.0 FORMULA_0003 0.0 255.0000 /end CHARACTERISTIC
/begin CHARACTERISTIC K_OZPEILKSPR "Max zul�ssiger Niveau-Unterschied zwischen alten Anzeige und VorMw | EN: Maximum permitted level difference between old display and previous mean [mm]" VALUE 0x75B81 TKW_VV_VV_UB 100.0 FORMULA_0431 0.0 74.7070 /end CHARACTERISTIC
/begin CHARACTERISTIC K_OZPEILLP85 "Bankenanzeige f�r Niveau bei 85% | EN: Bar display for level at 85%" VALUE 0x75B82 TKW_VV_VV_UB 100.0 FORMULA_0003 0.0 255.0000 /end CHARACTERISTIC
/begin CHARACTERISTIC K_OZPEILML "Balkenanzeige bei Messung l�uft | EN: Bar display while measuring" VALUE 0x75B83 TKW_VV_VV_UB 100.0 FORMULA_0003 0.0 255.0000 /end CHARACTERISTIC
/begin CHARACTERISTIC K_OZPEILOELCKO "Balkenanzeige bei �lCheck KO | EN: Bar display when oil check not OK" VALUE 0x75B84 TKW_VV_VV_UB 100.0 FORMULA_0003 0.0 255.0000 /end CHARACTERISTIC
/begin CHARACTERISTIC K_OZPEILOELCOK "Balkenanzeige bei �lCheck OK | EN: Bar display when oil check OK" VALUE 0x75B85 TKW_VV_VV_UB 100.0 FORMULA_0003 0.0 255.0000 /end CHARACTERISTIC
/begin CHARACTERISTIC K_OZPEILSPRUNG "Max zul�ssiger Niveau-Unterschied zwischen LangMw | EN: Maximum permitted level difference between long-term means [mm]" VALUE 0x75B86 TKW_VV_VV_UB 100.0 FORMULA_0431 0.0 74.7070 /end CHARACTERISTIC
/begin CHARACTERISTIC K_OZSTANDVERZ "Verz�gerung f�r Fahrzeug steht | EN: Delay for vehicle stationary [s]" VALUE 0x75B87 TKW_VV_VV_UB 100.0 FORMULA_0003 0.0 255.0000 /end CHARACTERISTIC
/begin CHARACTERISTIC K_OZSTARTVERZ "QLT Start Verz�gerung nach Drehzal | EN: Oil-quality sensor start delay after engine speed [s]" VALUE 0x75B88 TKW_VV_VV_UB 100.0 FORMULA_0003 0.0 255.0000 /end CHARACTERISTIC
/begin CHARACTERISTIC K_OZUEBERF "Schwelle f�r die �berf�llung | EN: Schwelle fï¿½r die ï¿½berfï¿½llung" VALUE 0x75B89 TKW_VV_VV_UB 100.0 FORMULA_0431 0.0 74.7070 /end CHARACTERISTIC
/begin CHARACTERISTIC K_OZUEFCNT "Anzahl Werte f�r �berf�llung" VALUE 0x75B8A TKW_VV_VV_UB 100.0 FORMULA_0003 0.0 255.0000 /end CHARACTERISTIC
/begin CHARACTERISTIC K_OZUEFVERZ "Verz�gerung f�r erkennung �berf�llung" VALUE 0x75B8B TKW_VV_VV_UB 100.0 FORMULA_0003 0.0 255.0000 /end CHARACTERISTIC
/begin CHARACTERISTIC K_OZVERBFAK "Faktor f�r die Anpassung des �lverbrauches" VALUE 0x75B8C TKW_VV_VV_UB 100.0 FORMULA_0447 0.0 7.9687 /end CHARACTERISTIC
/begin CHARACTERISTIC K_OZVORPEILMIN "Niveau Ausgabe (f�r die Peilstabanzeige) bei VorMw auf min und LangMw �ber 1/4" VALUE 0x75B8E TKW_VV_VV_UB 100.0 FORMULA_0431 0.0 74.7070 /end CHARACTERISTIC
/begin CHARACTERISTIC KL_OZLN "y = ln x" CURVE 0x75B90 TKL_UW_VV_SW 100.0 FORMULA_0448 -1.0000 9.99969482421875e-1 /begin AXIS_DESCR STD_AXIS FORMULA_0024 6 0.0 1.9999 FORMAT "%7.4" /end AXIS_DESCR FORMAT "%5.2" /end CHARACTERISTIC
/begin CHARACTERISTIC KL_OZKRZMW2 "Anzahl 10er Pakete f�r Steigungsberechnung in Abh�ngigkeit von der gefahrenen Strecke" CURVE 0x75BAA TKL_UW_VV_UB 100.0 FORMULA_0003 0.0 255.0000 /begin AXIS_DESCR STD_AXIS FORMULA_0441 4 0.0 9.9998 FORMAT "%5.2" /end AXIS_DESCR /end CHARACTERISTIC
/begin CHARACTERISTIC KL_OZORBERO "Toleranz f�r Orientierungsmessung nach oben in mm" CURVE 0x75BB8 TKL_UB_VV_UB 100.0 FORMULA_0431 0.0 74.7070 /begin AXIS_DESCR STD_AXIS FORMULA_0431 6 0.0 74.7070 FORMAT "%5.2" /end AXIS_DESCR /end CHARACTERISTIC
/begin CHARACTERISTIC KL_OZLBNIV "Korrektur der L�ngbeschleunigungseffekte beim 10er Paket QLT" CURVE 0x75BC6 TKL_SB_VV_SB 100.0 FORMULA_0431 -37.5000 37.2070 /begin AXIS_DESCR STD_AXIS FORMULA_0442 8 -2.0000 1.9843 FORMAT "%5.2" /end AXIS_DESCR /end CHARACTERISTIC
/begin CHARACTERISTIC KL_OZNFDELTA "Delta f�r die Nachf�llerkennung | EN: Delta für die Nachfüllerken-nung" CURVE 0x75BD8 TKL_UB_VV_UB 100.0 FORMULA_0431 0.0 74.7070 /begin AXIS_DESCR STD_AXIS FORMULA_0431 6 0.0 74.7070 FORMAT "%5.2" /end AXIS_DESCR /end CHARACTERISTIC
/begin CHARACTERISTIC KL_OZQBNIV "Korrektur der Querbeschleunigungseffekte beim 10er Paket QLT" CURVE 0x75BE6 TKL_SB_VV_SB 100.0 FORMULA_0431 -37.5000 37.2070 /begin AXIS_DESCR STD_AXIS FORMULA_0442 8 -2.0000 1.9843 FORMAT "%5.2" /end AXIS_DESCR /end CHARACTERISTIC
/begin CHARACTERISTIC KL_OZSTNIV "Korrektur der Steigungseffekte beim 20er Paket QLT | EN: Correction of incline effects for oil-quality sensor package" CURVE 0x75BF8 TKL_SW_VV_SW 100.0 FORMULA_0449 -37.5000 37.5000 /begin AXIS_DESCR STD_AXIS FORMULA_0440 8 -64.0000 63.9980 FORMAT "%5.2" /end AXIS_DESCR FORMAT "%5.2" /end CHARACTERISTIC
/begin CHARACTERISTIC KF_OZKORRORI "Kennfeld f�r die Korrektur des OriMw mit Abstellzeit und �ltemperatur" MAP 0x75C1A TKF_UW_SW_SW 100.0 FORMULA_0449 -37.5000 37.2070 /begin AXIS_DESCR STD_AXIS FORMULA_0426 4 -3276.8000 3276.7000 /end AXIS_DESCR
 /begin AXIS_DESCR STD_AXIS Tn_abstellm FORMULA_0438 3 0.0 65535.0000 FORMAT "%5.2" /end AXIS_DESCR
 FORMAT "%5.2" /end CHARACTERISTIC
/begin CHARACTERISTIC KF_OZDREHKOR_EINFAHR "Drehzahlkorrektur Niveau Einfahrintervall | EN: Engine-speed level correction (oil level)" MAP 0x75C42 TKF_UW_SW_SW 100.0 FORMULA_0450 -37.5000 37.5000 /begin AXIS_DESCR STD_AXIS FORMULA_0006 16 -32768.0000 32767.0000 /end AXIS_DESCR
 /begin AXIS_DESCR STD_AXIS Oz_Peilaltanz FORMULA_0449 3 0.0 19199.7070 FORMAT "%5.2" /end AXIS_DESCR
 FORMAT "%5.2" /end CHARACTERISTIC
/begin CHARACTERISTIC KF_OZDREHKOR "Drehzahlkorrektur Niveau | EN: Engine-speed level correction (oil level)" MAP 0x75CCA TKF_UW_SW_SW 100.0 FORMULA_0450 -37.5000 37.5000 /begin AXIS_DESCR STD_AXIS FORMULA_0006 16 -32768.0000 32767.0000 /end AXIS_DESCR
 /begin AXIS_DESCR STD_AXIS Oz_Peilaltanz FORMULA_0449 3 0.0 19199.7070 FORMAT "%5.2" /end AXIS_DESCR
 FORMAT "%5.2" /end CHARACTERISTIC
/begin CHARACTERISTIC KF_OZKORRNIV "Niveaukorrektur nach Startzeit und Temperatur | EN: Oil-level correction vs start time and temperature" MAP 0x75D52 TKF_UW_SW_SW 100.0 FORMULA_0449 -37.5000 37.5000 /begin AXIS_DESCR STD_AXIS FORMULA_0426 6 -3276.8000 3276.7000 /end AXIS_DESCR /begin AXIS_DESCR STD_AXIS FORMULA_0021 4 0.0 655.3500 FORMAT "%5.2" /end AXIS_DESCR FORMAT "%5.2" /end CHARACTERISTIC
/begin CHARACTERISTIC KF_OZZEIT "Zusammenf�hr�ng Abstellzeit und Startzeit | EN: Combination of engine-off time and start time" MAP 0x75D98 TKF_UW_UW_UW 100.0 FORMULA_0021 0.0 655.3500
 /begin AXIS_DESCR STD_AXIS Tn_start_10 FORMULA_0021 6 0.0 655.3500 FORMAT "%5.2" /end AXIS_DESCR
 /begin AXIS_DESCR STD_AXIS FORMULA_0438 4 0.0 65535.0000 FORMAT "%5.2" /end AXIS_DESCR
 FORMAT "%5.2" /end CHARACTERISTIC
/* ------------------ Abschnitt erzeugt aus ozrestkm.dat ------------------ */
/begin CHARACTERISTIC K_OZZEITFAKT "Bereich der gesamten Laufstrecke wo die Berechnung des Zeit-RW Beainfluss hat" VALUE 0x75DDE TKW_VV_VV_UB 100.0 FORMULA_0434 0.0 0.9960 /end CHARACTERISTIC
/begin CHARACTERISTIC K_OZUEBERTEMP "Schwelle f�r die �ls�bertemperatur-Kontrolle" VALUE 0x75DE0 TKW_VV_VV_SW 100.0 FORMULA_0426 -3276.8000 3276.7000 /end CHARACTERISTIC
/begin CHARACTERISTIC K_OZANFANZ "BOS-Startanzeigewert Restlaufstrecke [V912: differs from V452 160E]" VALUE 0x75DE2 TKW_VV_VV_UW 100.0 FORMULA_0432 0.0 655350.0000 /end CHARACTERISTIC
/begin CHARACTERISTIC K_OZKMMAXK11 "Maximalintervall [V912: differs from V452 160E]" VALUE 0x75DE4 TKW_VV_VV_UW 100.0 FORMULA_0432 0.0 655350.0000 /end CHARACTERISTIC
/begin CHARACTERISTIC K_OZKVBMXK18 "maximal zul�ssige Gesamtkraftstoffbonusmenge" VALUE 0x75DE6 TKW_VV_VV_UW 100.0 FORMULA_0010 0.0 65535.0000 /end CHARACTERISTIC
/begin CHARACTERISTIC K_OZKVBOK16 "Kraftstoffbonusmenge in [l] je 0,5l �lnachf�llung" VALUE 0x75DE8 TKW_VV_VV_UW 100.0 FORMULA_0010 0.0 65535.0000 /end CHARACTERISTIC
/begin CHARACTERISTIC K_OZMNKMBO "Wegstrecke ab der eine Bonuszuteilung erfolgt" VALUE 0x75DEA TKW_VV_VV_UW 100.0 FORMULA_0432 0.0 655350.0000 /end CHARACTERISTIC
/begin CHARACTERISTIC K_OZMXOHK15 "Max Tage f�r den �lservice" VALUE 0x75DEC TKW_VV_VV_UW 100.0 FORMULA_0010 0.0 65535.0000 /end CHARACTERISTIC
/begin CHARACTERISTIC K_OZPERBOK17 "Er-Bonusbetrag je 0,5l �lnachf�llung" VALUE 0x75DEE TKW_VV_VV_UW 100.0 FORMULA_0430 0.0 5.9999 FORMAT "%4.1" /end CHARACTERISTIC
/begin CHARACTERISTIC K_OZPERXK10 "zul�ssige Permittivit�ts�nderung im �lwechselintervall" VALUE 0x75DF0 TKW_VV_VV_UW 100.0 FORMULA_0430 0.0 5.9999 FORMAT "%4.1" /end CHARACTERISTIC
/begin CHARACTERISTIC K_OZTAGCTERR "Wert f�r unplausibel Tagez�hler" VALUE 0x75DF2 TKW_VV_VV_UW 100.0 FORMULA_0010 0.0 65535.0000 /end CHARACTERISTIC
/begin CHARACTERISTIC K_OZDAEMPF "" VALUE 0x75DF4 TKW_VV_VV_UB 100.0 FORMULA_0454 0.0 0.2490 /end CHARACTERISTIC
/begin CHARACTERISTIC K_OZKVB96 "Typpr�fkraftstoffverbrauch" VALUE 0x75DF5 TKW_VV_VV_UB 100.0 FORMULA_0455 0.0 31.8750 /end CHARACTERISTIC
/begin CHARACTERISTIC K_OZKVB96A "Typpr�fkraftstoffverbrauch Automatikgetriebe" VALUE 0x75DF6 TKW_VV_VV_UB 100.0 FORMULA_0455 0.0 31.8750 /end CHARACTERISTIC
/begin CHARACTERISTIC K_OZLF1 "L�nderfaktor 1 Festwert" VALUE 0x75DF7 TKW_VV_VV_UB 100.0 FORMULA_0451 0.0 2.5500 /end CHARACTERISTIC
/begin CHARACTERISTIC K_OZLF2 "L�nderfaktor 2 Festwert" VALUE 0x75DF8 TKW_VV_VV_UB 100.0 FORMULA_0451 0.0 2.5500 /end CHARACTERISTIC
/begin CHARACTERISTIC K_OZOELMEN "�lmenge f�r den Dieseleintrag" VALUE 0x75DF9 TKW_VV_VV_UB 100.0 FORMULA_0436 0.0 25.5000 /end CHARACTERISTIC
/begin CHARACTERISTIC K_OZPERBRK14 "Begrenzungsfaktor f�r Restweg aus der Permittivit�t" VALUE 0x75DFA TKW_VV_VV_UB 100.0 FORMULA_0456 0.0 5.9765 /end CHARACTERISTIC
/begin CHARACTERISTIC K_OZUTFAK "Faktor f�r den Kraftstoffverbrauch bei �bertemperatur" VALUE 0x75DFB TKW_VV_VV_UB 100.0 FORMULA_0003 0.0 255.0000 /end CHARACTERISTIC
/begin CHARACTERISTIC K_OZZEITINT "Zeitintervall f�r �lwechsel in Monate (CBS4)" VALUE 0x75DFC TKW_VV_VV_UB 100.0 FORMULA_0003 0.0 255.0000 /end CHARACTERISTIC
/begin CHARACTERISTIC KL_OZVERDFAK "Verd�nnungsfaktor von Dieseleintrag" CURVE 0x75DFE TKL_UW_VV_UW 100.0 FORMULA_0457 0.0 9.99984741210938e-1
 /begin AXIS_DESCR STD_AXIS NO_INPUT_QUANTITY FORMULA_0457 5 0.0 0.9999 FORMAT "%7.4" /end AXIS_DESCR
 FORMAT "%7.4" /end CHARACTERISTIC
/* ------------------ Abschnitt erzeugt aus llranh.dat ------------------ */ /* ------------------ Abschnitt erzeugt aus loadresp.dat ------------------ */ /* ------------------ Abschnitt erzeugt aus pgentred.dat ------------------ */
/begin CHARACTERISTIC K_TCHIPFIL "Filterkonstante schneller Tchip Filter | EN: Filterkonstante schneller Tchip Filter [V912: differs from V452 160E]" VALUE 0x75E48 TKW_VV_VV_UW 100.0 FORMULA_0457 0.0 9.99984741210938e-1 FORMAT "%7.4" /end CHARACTERISTIC
/begin CHARACTERISTIC K_TDUBFZMN "Verz�gerung Bordnetzschwelle | EN: Verzï¿½gerung Bordnetzschwelle [V912: differs from V452 160E]" VALUE 0x75E93 TKW_VV_VV_UB 100.0 FORMULA_0472 0.0 255.0000 /end CHARACTERISTIC
/begin CHARACTERISTIC K_TLCHTEP "Entprellung Hochtemperatur Generator | EN: Schalter zur Aktivierung Überwachung Diodentemparatur [V912: differs from V452 160E]" VALUE 0x75E95 TKW_VV_VV_UB 100.0 FORMULA_0472 0.0 255.0000 /end CHARACTERISTIC
/begin CHARACTERISTIC S_HTDETEC "Schalter zur Aktivierung �berwachung Diodentemparatur | EN: Schalter zur Aktivierung ï¿½berwachung Diodentemparatur [V912: differs from V452 160E]" VALUE 0x75E96 TKW_VV_VV_UB 100.0 FORMULA_0474 0.0 1.0000 /end CHARACTERISTIC
/begin CHARACTERISTIC KL_TMAXDIODE "Zul�ssige Diodenmaximaltemperatur | EN: Zulässige Diodenmaximaltemperatur [V912: differs from V452 160E]" CURVE 0x75EA6 TKL_UB_VV_SW 100.0 FORMULA_0426 -3276.8000 3276.7000 /begin AXIS_DESCR STD_AXIS FORMULA_0003 6 0.0 255.0000 /end AXIS_DESCR /end CHARACTERISTIC
/begin CHARACTERISTIC KL_RTHJADIOD "Temperaturkoeffizient der Diode | EN: Temperaturkoeffizient der Diode [V912: differs from V452 160E]" CURVE 0x75EBA TKL_UB_VV_UW 100.0 FORMULA_0433 0.0 99.9984 /begin AXIS_DESCR STD_AXIS FORMULA_0003 6 0.0 255.0000 /end AXIS_DESCR FORMAT "%5.2" /end CHARACTERISTIC
/begin CHARACTERISTIC KL_TCHIPOFFS "Offset zur gemessenen Chiptemperatur Herstellerspezifisch" CURVE 0x75ECE TKL_UB_VV_SW 100.0 FORMULA_0426 -3276.8000 3276.7000 /begin AXIS_DESCR STD_AXIS FORMULA_0003 8 0.0 255.0000 /end AXIS_DESCR /end CHARACTERISTIC
/begin CHARACTERISTIC KF_UFDIODE "Kennfeld f�r Diodenvorw�rtsspannung | EN: Kennfeld für Diodenvorwärtsspannung [V912: differs from V452 160E]" MAP 0x75EE8 TKF_UB_SW_UW 100.0 FORMULA_0479 0.0 319.9951 /begin AXIS_DESCR STD_AXIS FORMULA_0426 2 -3276.8000 3276.7000 /end AXIS_DESCR /begin AXIS_DESCR STD_AXIS FORMULA_0003 6 0.0 255.0000 /end AXIS_DESCR FORMAT "%6.3" /end CHARACTERISTIC
/begin CHARACTERISTIC KF_IERRGREHT "Generatorstrombegrenzung bei Generatorhochtemparatur | EN: Generator current limit at high generator temperature [V912: differs from V452 160E]" MAP 0x75F0C TKF_SW_SW_UB 100.0 FORMULA_0460 0.0 31.8750 /begin AXIS_DESCR STD_AXIS FORMULA_0006 3 -32768.0000 32767.0000 /end AXIS_DESCR /begin AXIS_DESCR STD_AXIS FORMULA_0010 6 -32768.0000 32767.0000 /end AXIS_DESCR /end CHARACTERISTIC
/begin CHARACTERISTIC KF_TANSGENKO "Kennfeld zur Bestimmung Ansauglufttemparatur Generator [V912: differs from V452 160E]" MAP 0x75F32 TKF_SW_SW_SW 100.0 FORMULA_0426 -3276.8000 3276.7000 /begin AXIS_DESCR STD_AXIS FORMULA_0426 4 -3276.8000 3276.7000 /end AXIS_DESCR /begin AXIS_DESCR STD_AXIS FORMULA_0006 4 -32768.0000 32767.0000 /end AXIS_DESCR /end CHARACTERISTIC
/* ------------------ Abschnitt erzeugt aus ugenkor.dat ------------------ */ /* ------------------ Abschnitt erzeugt aus bgcreng.dat ------------------ */ /* ------------------ Abschnitt erzeugt aus bgllgen_1pr.dat ------------------ */ /* ------------------ Abschnitt erzeugt aus dibs.dat ------------------ */ /* ------------------ Abschnitt erzeugt aus lbattcal.dat ------------------ */ /* ------------------ Abschnitt erzeugt aus llpmctrl.dat ------------------ */ /* ------------------ Abschnitt erzeugt aus pmbnstab.dat ------------------ */
/begin CHARACTERISTIC K_BNS_VFZG "Schwelle Geschwindigkeit fuer BNS [V912: differs from V452 160E]" VALUE 0x76214 TKW_VV_VV_UW 100.0 FORMULA_0470 0.0 65535.0000 /end CHARACTERISTIC
/* ------------------ Abschnitt erzeugt aus la.dat ------------------ */
/begin CHARACTERISTIC K_LAVK_AD_TEST " d. Sondenadaption | EN: Sensor adaptation" VALUE 0x73F34 TKW_VV_VV_UW 100.0 FORMULA_0782 0.0 1.0 FORMAT "%5.2" /end CHARACTERISTIC
/begin CHARACTERISTIC K_LAVK_AD_MIN "MIN-AD-Wert d. Sondensignals | EN: Minimum A/D value of sensor signal [mV]" VALUE 0x73F36 TKW_VV_VV_UW 100.0 FORMULA_0532 0.0 5000.0000 /end CHARACTERISTIC
/begin CHARACTERISTIC K_LAVK_AD_MAX "MAX-AD-Wert d. Sondensignals | EN: Maximum A/D value of sensor signal [mV]" VALUE 0x73F38 TKW_VV_VV_UW 100.0 FORMULA_0532 0.0 5000.0000 /end CHARACTERISTIC
/begin CHARACTERISTIC K_LAVK_US_REF "Referenzspannung lambda=1,0 | EN: Reference voltage lambda = 1.0 [mV]" VALUE 0x73F3A TKW_VV_VV_UW 100.0 FORMULA_0532 0.0 5000.0000 /end CHARACTERISTIC
/begin CHARACTERISTIC K_LAVK_R7 "Widerstand R7 | EN: Resistor R7 [Ohm]" VALUE 0x73F3C TKW_VV_VV_UW 100.0 FORMULA_0537 0.0 6553.5000 FORMAT "%4.1" /end CHARACTERISTIC
/begin CHARACTERISTIC K_LAVK_GAIN_LAM_SCHW "Umschaltschw. f. Signalverstaerkung | EN: Switching threshold for signal gain" VALUE 0x73F3E TKW_VV_VV_UW 100.0 FORMULA_0025 0.0 3.9990 FORMAT "%6.3" /end CHARACTERISTIC
/begin CHARACTERISTIC K_LAVK_AD_OFFS_CNT_MIN "MIN-Zaehler fuer OFFSET-Sondenadaption | EN: Minimum counter for sensor offset adaptation" VALUE 0x73F40 TKW_VV_VV_UW 100.0 FORMULA_0010 0.0 65535.0000 /end CHARACTERISTIC
/begin CHARACTERISTIC K_LAVK_AD_OFFS_CNT_MIN_MS "MIN-Zaehler fuer MS-OFFSET-Sondenadapt. | EN: Minimum counter for MS sensor offset adaptation" VALUE 0x73F42 TKW_VV_VV_UW 100.0 FORMULA_0010 0.0 65535.0000 /end CHARACTERISTIC
/begin CHARACTERISTIC K_LAVK_AD_OFFS_CNT "Zaehler fuer OFFSET-Sondenadaption | EN: Counter for sensor offset adaptation" VALUE 0x73F44 TKW_VV_VV_UW 100.0 FORMULA_0010 0.0 65535.0000 /end CHARACTERISTIC
/begin CHARACTERISTIC K_LAVK_AD_OFFS_CNT_MS "Zaehler fuer MS-OFFSET-Sondenadapt. | EN: Counter for MS sensor offset adaptation" VALUE 0x73F46 TKW_VV_VV_UW 100.0 FORMULA_0010 0.0 65535.0000 /end CHARACTERISTIC
/begin CHARACTERISTIC K_LAVK_AD_GAIN_CNT_MIN "MIN-Zaehler fuer GAIN-Sondenadaption | EN: Minimum counter for sensor gain adaptation" VALUE 0x73F48 TKW_VV_VV_UW 100.0 FORMULA_0010 0.0 65535.0000 /end CHARACTERISTIC
/begin CHARACTERISTIC K_LAVK_AD_GAIN_CNT "Zaehler fuer GAIN-Sondenadapt. | EN: Zaehler fuer GAIN-Sondenadapt." VALUE 0x73F4A TKW_VV_VV_UW 100.0 FORMULA_0010 0.0 65535.0000 /end CHARACTERISTIC
/begin CHARACTERISTIC K_LAVK_AD_OFFS_T "MIN-Zeit zwischen zwei OFFSET-Adapt. | EN: MIN-Zeit zwischen zwei OFF-SET-Adapt." VALUE 0x73F4C TKW_VV_VV_UW 100.0 FORMULA_0021 0.0 655.0000 FORMAT "%5.2" /end CHARACTERISTIC
/begin CHARACTERISTIC K_LAVK_AD_GAIN_T "MIN-Zeit zwischen zwei GAIN-Adapt. | EN: MIN-Zeit zwischen zwei GAIN-Adapt." VALUE 0x73F4E TKW_VV_VV_UW 100.0 FORMULA_0021 0.0 655.0000 FORMAT "%5.2" /end CHARACTERISTIC
/begin CHARACTERISTIC K_LAVK_AD_OFFS_T1 "Filterkoeffizient - OFFSET-Sondenadapt. | EN: Filterkoeffizient - OFFSET-Sondenadapt." VALUE 0x73F50 TKW_VV_VV_UW 100.0 FORMULA_0595 0.0 655350.0000 /end CHARACTERISTIC
/begin CHARACTERISTIC K_LAVK_AD_GAIN_T1 "Filterkoeffizient - GAIN-Sondenadapt. | EN: Filterkoeffizient - GAIN-Sondenadapt." VALUE 0x73F52 TKW_VV_VV_UW 100.0 FORMULA_0595 0.0 655350.0000 /end CHARACTERISTIC
/begin CHARACTERISTIC K_LAVK_AD_OFFS_MAX "MAX-Schwelle f. Offset-Sondenadaption | EN: MAX-Schwelle f. Offset-Sondenadaption" VALUE 0x73F54 TKW_VV_VV_UW 100.0 FORMULA_0532 0.0 5000.0000 /end CHARACTERISTIC
/begin CHARACTERISTIC K_LAVK_AD_OFFS_MIN "MIN-Schwelle f. Offset-Sondenadaption | EN: MIN-Schwelle f. Offset-Sondenadaption" VALUE 0x73F56 TKW_VV_VV_UW 100.0 FORMULA_0532 0.0 5000.0000 /end CHARACTERISTIC
/begin CHARACTERISTIC K_LAVK_AD_GAIN_MIN "MIN-Schwelle f. GAIN-Sondenadaption | EN: MIN-Schwelle f. GAIN-Sondenadaption" VALUE 0x73F58 TKW_VV_VV_UW 100.0 FORMULA_0532 0.0 5000.0000 /end CHARACTERISTIC
/begin CHARACTERISTIC K_LAVK_AD_OFFS_GRAD "max. OFFEST-Gradient | EN: max. OFFEST-Gradient" VALUE 0x73F5A TKW_VV_VV_UW 100.0 FORMULA_0532 0.0 5000.0000 /end CHARACTERISTIC
/begin CHARACTERISTIC K_LAVK_AD_GAIN_GRAD "max. GAIN-Gradient | EN: max. GAIN-Gradient" VALUE 0x73F5C TKW_VV_VV_UW 100.0 FORMULA_0075 0.0 4.0000 FORMAT "%6.3" /end CHARACTERISTIC
/begin CHARACTERISTIC K_LAVK_AD_GAIN_ML_MIN "MIN-Luftmasse pro Bank | EN: MIN-Luftmasse pro Bank" VALUE 0x73F5E TKW_VV_VV_SW 100.0 FORMULA_0112 -100.0000 1400.0000 FORMAT "%4.1" /end CHARACTERISTIC
/begin CHARACTERISTIC K_LAVK_AD_OFFS_NV_MAX "max. Grenze fuer OFFEST-Sonden-Adapt. | EN: max. Grenze fuer OFFEST-Sonden-Adapt." VALUE 0x73F60 TKW_VV_VV_SW 100.0 FORMULA_0532 -5000.0000 5000.0000 /end CHARACTERISTIC
/begin CHARACTERISTIC K_LAVK_AD_OFFS_NV_MIN "min. Grenze fuer OFFEST-Sonden-Adapt. | EN: min. Grenze fuer OFFEST-Sonden-Adapt." VALUE 0x73F62 TKW_VV_VV_SW 100.0 FORMULA_0532 -5000.0000 5000.0000 /end CHARACTERISTIC
/begin CHARACTERISTIC K_LAVK_AD_GAIN_NV_MAX "max. Grenze fuer GAIN-Sonden-Adapt. | EN: max. Grenze fuer GAIN-Sonden-Adapt." VALUE 0x73F64 TKW_VV_VV_UW 100.0 FORMULA_0075 0.0 4.0000 FORMAT "%6.3" /end CHARACTERISTIC
/begin CHARACTERISTIC K_LAVK_AD_GAIN_NV_MIN "min. Grenze fuer GAIN-Sonden-Adapt. | EN: min. Grenze fuer GAIN-Sonden-Adapt." VALUE 0x73F66 TKW_VV_VV_UW 100.0 FORMULA_0075 0.0 4.0000 FORMAT "%6.3" /end CHARACTERISTIC
/begin CHARACTERISTIC K_LAM_REG_CFG "Freigabe Lambdaregler | EN: 0 keine RESET- Anforderung 1 LA-RESET- Anforderung Freigabe Lambdaregler" VALUE 0x73F68 TKW_VV_VV_UW 100.0 FORMULA_0783 0.0 1.0 FORMAT "%5.2" /end CHARACTERISTIC
/begin CHARACTERISTIC K_LAVK_US_LUFT_REF "Referenzspannung LUFT | EN: Referenzspannung LUFT" VALUE 0x73F6A TKW_VV_VV_UW 100.0 FORMULA_0532 0.0 5000.0000 /end CHARACTERISTIC
/begin CHARACTERISTIC K_LAVK_AD_RESET "RESET d. Sondenadaption | EN: 0 ADAPTION 1 RESET RESET d. Sondenadaption" VALUE 0x73F6C TKW_VV_VV_UW 100.0 FORMULA_0784 0.0 1.0 FORMAT "%5.2" /end CHARACTERISTIC
/begin CHARACTERISTIC K_LAM_REG_RESET_CFG "RESET Lambdaregler | EN: 0 keine RESET- Anforderung 1 LA-RESET- Anforderung RESET Lambdaregler" VALUE 0x73F6E TKW_VV_VV_UW 100.0 FORMULA_0785 0.0 1.0 FORMAT "%5.2" /end CHARACTERISTIC
/begin CHARACTERISTIC K_LAM_REG_START_TIME "Verzaegerungszeit nach Startende | EN: Verzoegerungszeit nach Startende" VALUE 0x73F70 TKW_VV_VV_UW 100.0 FORMULA_0021 0.0 655.3500 FORMAT "%5.2" /end CHARACTERISTIC
/begin CHARACTERISTIC K_LAM_REG_TI_IST_MIN "min. SOLL-TI" VALUE 0x73F72 TKW_VV_VV_UW 100.0 FORMULA_0786 0.0 65.5350 FORMAT "%5.2" /end CHARACTERISTIC
/begin CHARACTERISTIC K_LAM_REG_IST_MW_MIN "min. IST-Lambdawert | EN: Minimum actual lambda value" VALUE 0x73F74 TKW_VV_VV_UW 100.0 FORMULA_0025 0.0 3.9990 FORMAT "%6.3" /end CHARACTERISTIC
/begin CHARACTERISTIC K_LAM_REG_IST_MW_MAX "max. IST_Lambdawert | EN: Maximum actual lambda value" VALUE 0x73F76 TKW_VV_VV_UW 100.0 FORMULA_0025 0.0 3.9990 FORMAT "%6.3" /end CHARACTERISTIC
/begin CHARACTERISTIC K_LAM_REG_SOLL_MIN "min. SOLL-Lambdawert | EN: Minimum target lambda value" VALUE 0x73F78 TKW_VV_VV_UW 100.0 FORMULA_0025 0.0 3.9990 FORMAT "%6.3" /end CHARACTERISTIC
/begin CHARACTERISTIC K_LAM_REG_SOLL_MAX "max. SOLL_Lambdawert | EN: Maximum target lambda value" VALUE 0x73F7A TKW_VV_VV_UW 100.0 FORMULA_0025 0.0 3.9990 FORMAT "%6.3" /end CHARACTERISTIC
/begin CHARACTERISTIC K_LAM_REG_DELTA_MIN "min. Reglerabweichung | EN: Minimum control error" VALUE 0x73F7C TKW_VV_VV_SW 100.0 FORMULA_0025 -2.0000 1.9999 FORMAT "%6.3" /end CHARACTERISTIC
/begin CHARACTERISTIC K_LAM_REG_DELTA_MAX "max. Reglerabweichung | EN: Maximum control error" VALUE 0x73F7E TKW_VV_VV_SW 100.0 FORMULA_0025 -2.0000 1.9999 FORMAT "%6.3" /end CHARACTERISTIC
/begin CHARACTERISTIC K_LAM_REG_DELTA_STAT_MAX "Regelabweichung f. stationaeren Zustand | EN: Control error for steady state" VALUE 0x73F80 TKW_VV_VV_UW 100.0 FORMULA_0025 0.0 3.9990 FORMAT "%6.3" /end CHARACTERISTIC
/begin CHARACTERISTIC K_LAM_REG_DELTA_STAT_MAX_TE "Regelabweichung f. stat. Zustand bei TE | EN: Control error for steady state during purge" VALUE 0x73F82 TKW_VV_VV_UW 100.0 FORMULA_0025 0.0 3.9990 FORMAT "%6.3" /end CHARACTERISTIC
/begin CHARACTERISTIC K_LAM_REG_DELTA_STAT_TRIM "Regelabweichung f. stat. Zustand - Trimmregelung | EN: Control error for steady state - trim control" VALUE 0x73F84 TKW_VV_VV_UW 100.0 FORMULA_0025 0.0 3.9990 FORMAT "%6.3" /end CHARACTERISTIC
/begin CHARACTERISTIC K_LAM_REG_F_MIN "Regelabweichung f. stationaeren Zustand | EN: Control error for steady state" VALUE 0x73F86 TKW_VV_VV_UW 100.0 FORMULA_0024 0.0 1.9990 FORMAT "%7.4" /end CHARACTERISTIC
/begin CHARACTERISTIC K_LAM_REG_F_MAX "Regelabweichung f. stationaeren Zustand | EN: Control error for steady state" VALUE 0x73F88 TKW_VV_VV_UW 100.0 FORMULA_0024 0.0 1.9990 FORMAT "%7.4" /end CHARACTERISTIC
/begin CHARACTERISTIC K_LAM_REG_TV_TU_F "Tuningfaktor Vorhaltezeit | EN: Tuning factor, derivative time" VALUE 0x73F8A TKW_VV_VV_UB 100.0 FORMULA_0643 0.0 1.9921 /end CHARACTERISTIC
/begin CHARACTERISTIC K_LAM_REG_TN_TU_F "Tuningfaktor Nachstellzeit | EN: Tuning factor, integral time" VALUE 0x73F8B TKW_VV_VV_UB 100.0 FORMULA_0643 0.0 1.9921 /end CHARACTERISTIC
/begin CHARACTERISTIC K_LAM_REG_RESET_SA_TMOT_MIN "min. TMOT-Schwelle f. LAA | EN: Minimum engine-temperature threshold for lambda adaptation [°C]" VALUE 0x73F8C TKW_VV_VV_SW 100.0 FORMULA_0023 -50.0000 170.0000 FORMAT "%4.1" /end CHARACTERISTIC
/begin CHARACTERISTIC K_LAA_CFG "Freigabe Lambdaadaption" VALUE 0x73F8E TKW_VV_VV_UW 100.0 FORMULA_0787 0.0 1.0 FORMAT "%5.2" /end CHARACTERISTIC
/begin CHARACTERISTIC K_LAA_RESET_CFG "Ruecksetzen d.  Lambdaadaption" VALUE 0x73F90 TKW_VV_VV_UW 100.0 FORMULA_0788 0.0 1.0 FORMAT "%5.2" /end CHARACTERISTIC
/begin CHARACTERISTIC K_LAA_TAN_MAX "max. TAN-Schwelle fuer LAA | EN: Maximum intake-air-temperature threshold for lambda adaptation [°C]" VALUE 0x73F92 TKW_VV_VV_SW 100.0 FORMULA_0023 -50.0000 170.0000 FORMAT "%4.1" /end CHARACTERISTIC
/begin CHARACTERISTIC K_LAA_TMOT_MIN "min. TMOT-Schwelle f. LAA | EN: Minimum engine-temperature threshold for lambda adaptation [°C]" VALUE 0x73F94 TKW_VV_VV_SW 100.0 FORMULA_0023 -50.0000 170.0000 FORMAT "%4.1" /end CHARACTERISTIC
/begin CHARACTERISTIC K_LAA_PKS_MAX "max. PKS-Schwelle f. LAA | EN: Maximum fuel-pressure threshold for lambda adaptation [bar]" VALUE 0x73F96 TKW_VV_VV_SW 100.0 FORMULA_0118 0.0 10.0000 FORMAT "%6.3" /end CHARACTERISTIC
/begin CHARACTERISTIC K_LAA_F_TE_N_MAX "max. Drehzahl f. TE-LAA | EN: Maximum engine speed for purge lambda adaptation [Upm]" VALUE 0x73F98 TKW_VV_VV_SW 100.0 FORMULA_0006 0.0 10000.0000 /end CHARACTERISTIC
/begin CHARACTERISTIC K_LAA_F_N_MIN "min. Drehzahl f. Faktor-LAA | EN: Minimum engine speed for factor lambda adaptation [Upm]" VALUE 0x73F9A TKW_VV_VV_SW 100.0 FORMULA_0006 0.0 10000.0000 /end CHARACTERISTIC
/begin CHARACTERISTIC K_LAA_F_N_MAX "max. Drehzahl f. Faktor-LAA | EN: Maximum engine speed for factor lambda adaptation [Upm]" VALUE 0x73F9C TKW_VV_VV_SW 100.0 FORMULA_0006 0.0 10000.0000 /end CHARACTERISTIC
/begin CHARACTERISTIC K_LAA_OFFS_N_MAX "max. Drehzahl f. Offset-LAA | EN: Maximum engine speed for offset lambda adaptation [Upm]" VALUE 0x73F9E TKW_VV_VV_SW 100.0 FORMULA_0006 0.0 10000.0000 /end CHARACTERISTIC
/begin CHARACTERISTIC K_LAA_F_TE_RF_MAX "max. relative F�llung f. TE-LAA | EN: Maximum relative charge for purge lambda adaptation" VALUE 0x73FA0 TKW_VV_VV_SW 100.0 FORMULA_0007 0.0 2.0000 FORMAT "%6.3" /end CHARACTERISTIC
/begin CHARACTERISTIC K_LAA_F_RF_MIN "min. relative F�llung f. Faktor-LAA | EN: Minimum relative charge for factor lambda adaptation" VALUE 0x73FA2 TKW_VV_VV_SW 100.0 FORMULA_0007 0.0 2.0000 FORMAT "%6.3" /end CHARACTERISTIC
/begin CHARACTERISTIC K_LAA_F_RF_MAX "max. relative F�llung f. Faktor-LAA | EN: Maximum relative charge for factor lambda adaptation" VALUE 0x73FA4 TKW_VV_VV_SW 100.0 FORMULA_0007 0.0 2.0000 FORMAT "%6.3" /end CHARACTERISTIC
/begin CHARACTERISTIC K_LAA_OFFS_RF_MAX "max. relative F�llung f. Offset-LAA | EN: Maximum relative charge for offset lambda adaptation" VALUE 0x73FA6 TKW_VV_VV_SW 100.0 FORMULA_0007 0.0 2.0000 FORMAT "%6.3" /end CHARACTERISTIC
/begin CHARACTERISTIC K_LAA_F_T_ADAPT "Adaptionszeitraum f. F-Adaption | EN: Adaptation period for factor adaptation [ms]" VALUE 0x73FA8 TKW_VV_VV_UW 100.0 FORMULA_0764 0.0 65535.0000 /end CHARACTERISTIC
/begin CHARACTERISTIC K_LAA_F_TE_T_ADAPT "Adaptionszeitraum f. F-TE-Adaption | EN: Adaptionszeitraum f. F-TE-Adaption" VALUE 0x73FAA TKW_VV_VV_UW 100.0 FORMULA_0764 0.0 65535.0000 /end CHARACTERISTIC
/begin CHARACTERISTIC K_LAA_OFFS_T_ADAPT "Adaptionszeitraum f. OFFS-Adaption | EN: Adaptionszeitraum f. OFFS-Adaption" VALUE 0x73FAC TKW_VV_VV_UW 100.0 FORMULA_0764 0.0 65535.0000 /end CHARACTERISTIC
/begin CHARACTERISTIC K_LAA_F_MCS_B1 "MCS-INIT Adaptionsfaktor | EN: MCS-INIT Adaptionsfaktor" VALUE 0x73FAE TKW_VV_VV_UW 100.0 FORMULA_0024 0.0 1.9990 FORMAT "%7.4" /end CHARACTERISTIC
/begin CHARACTERISTIC K_LAA_F_MCS_B2 "MCS-INIT Adaptionsfaktor | EN: MCS-INIT Adaptionsfaktor" VALUE 0x73FB0 TKW_VV_VV_UW 100.0 FORMULA_0024 0.0 1.9990 FORMAT "%7.4" /end CHARACTERISTIC
/begin CHARACTERISTIC K_LAA_F_MAX "max. Adaptionsfaktor | EN: max. Adaptionsfaktor" VALUE 0x73FB2 TKW_VV_VV_UW 100.0 FORMULA_0024 0.0 1.9990 FORMAT "%7.4" /end CHARACTERISTIC
/begin CHARACTERISTIC K_LAA_F_MIN "min. Adaptionsfaktor | EN: min. Adaptionsfaktor" VALUE 0x73FB4 TKW_VV_VV_UW 100.0 FORMULA_0024 0.0 1.9990 FORMAT "%7.4" /end CHARACTERISTIC
/begin CHARACTERISTIC K_LAA_F_TE_MAX "max. Offset auf LAA-Faktor ueber TE | EN: max. Offset auf LAA-Faktor ueber TE" VALUE 0x73FB6 TKW_VV_VV_SW 100.0 FORMULA_0024 -1.0000 0.9999 FORMAT "%7.4" /end CHARACTERISTIC
/begin CHARACTERISTIC K_LAA_F_TE_MIN "min. Offset auf LAA-Faktor ueber TE | EN: min. Offset auf LAA-Faktor ueber TE" VALUE 0x73FB8 TKW_VV_VV_SW 100.0 FORMULA_0024 -1.0000 0.9999 FORMAT "%7.4" /end CHARACTERISTIC
/begin CHARACTERISTIC K_LAA_OFFS_MCS_B1 "MCS-INIT Offset-Adaption | EN: MCS-INIT Offset-Adaption" VALUE 0x73FBA TKW_VV_VV_SW 100.0 FORMULA_0531 -512.0000 511.0000 FORMAT "%6.3" /end CHARACTERISTIC
/begin CHARACTERISTIC K_LAA_OFFS_MCS_B2 "MCS-INIT Offset-Adaption | EN: MCS-INIT Offset-Adaption" VALUE 0x73FBC TKW_VV_VV_SW 100.0 FORMULA_0531 -512.0000 511.0000 FORMAT "%6.3" /end CHARACTERISTIC
/begin CHARACTERISTIC K_LAA_OFFS_MAX "max. Offset-Adaption | EN: max. Offset-Adaption" VALUE 0x73FBE TKW_VV_VV_SW 100.0 FORMULA_0531 -512.0000 511.0000 FORMAT "%6.3" /end CHARACTERISTIC
/begin CHARACTERISTIC K_LAA_OFFS_MIN "min. Offset-Adaption | EN: min. Offset-Adaption Stetiger Lambdaregler und Lambdaadaption Seite 125 von 198" VALUE 0x73FC0 TKW_VV_VV_SW 100.0 FORMULA_0531 -512.0000 511.0000 FORMAT "%6.3" /end CHARACTERISTIC
/begin CHARACTERISTIC K_LAA_TI_IST_MIN "min. SOLL-TI | EN: min. SOLL-TI" VALUE 0x73FC2 TKW_VV_VV_UW 100.0 FORMULA_0786 0.0 65.5350 FORMAT "%5.2" /end CHARACTERISTIC
/begin CHARACTERISTIC K_LAA_OFFS_GRAD "LAA-OFFEST-Gradient | EN: LAA-OFFEST-Gradient" VALUE 0x73FC4 TKW_VV_VV_SW 100.0 FORMULA_0531 0.0 511.0000 FORMAT "%6.3" /end CHARACTERISTIC
/begin CHARACTERISTIC K_LAA_F_GRAD "LAA-F-Gradient | EN: LAA-F-Gradient" VALUE 0x73FC6 TKW_VV_VV_UW 100.0 FORMULA_0024 0.0 1.9990 FORMAT "%7.4" /end CHARACTERISTIC
/begin CHARACTERISTIC K_LAA_F_TE_GRAD "LAA-F-Gradient | EN: LAA-F-Gradient" VALUE 0x73FC8 TKW_VV_VV_UW 100.0 FORMULA_0024 0.0 1.9990 FORMAT "%7.4" /end CHARACTERISTIC
/begin CHARACTERISTIC K_LAA_LAM_REG_F_DELTA "Regelabweichung f. stationaere LAA | EN: Regelabweichung f. stationaere LAA" VALUE 0x73FCA TKW_VV_VV_UW 100.0 FORMULA_0024 0.0 1.9990 FORMAT "%7.4" /end CHARACTERISTIC
/begin CHARACTERISTIC K_LAA_F_TE_RAMPE "Abregelwert fuer laa_f_te | EN: Abregelwert fuer laa_f_te" VALUE 0x73FCC TKW_VV_VV_UW 100.0 FORMULA_0024 0.0 1.9990 FORMAT "%7.4" /end CHARACTERISTIC
/begin CHARACTERISTIC K_LAVK_FILT_CFG "Filterung IST-LA-Wert" VALUE 0x73FCE TKW_VV_VV_UW 100.0 FORMULA_0789 0.0 1.0 FORMAT "%5.2" /end CHARACTERISTIC
/begin CHARACTERISTIC K_LAM_DIAG_CFG "Diagnose LAM_REG/LAA-Anschlag | EN: 0 inaktiv 1 aktiv Diagnose LAM_REG/LAA- Anschlag" VALUE 0x73FD0 TKW_VV_VV_UW 100.0 FORMULA_0790 0.0 1.0 FORMAT "%5.2" /end CHARACTERISTIC
/begin CHARACTERISTIC K_LAM_DIAG_REG_T "Diagnosezeit - LA-Regleranschlag | EN: Diagnosezeit - LA-Regleranschlag" VALUE 0x73FD2 TKW_VV_VV_UW 100.0 FORMULA_0073 0.0 6553.5000 FORMAT "%4.1" /end CHARACTERISTIC
/begin CHARACTERISTIC K_LAM_DIAG_LAA_T "Diagnosezeit - LA-Adaptionanschlag | EN: Diagnosezeit - LA-Adaptionanschlag" VALUE 0x73FD4 TKW_VV_VV_UW 100.0 FORMULA_0073 0.0 6553.5000 FORMAT "%4.1" /end CHARACTERISTIC
/begin CHARACTERISTIC K_LAM_DIAG_LAA_IO_T "Heilungszeit - LA-Adaptionanschlag" VALUE 0x73FD6 TKW_VV_VV_UW 100.0 FORMULA_0073 0.0 6553.5000 FORMAT "%4.1" /end CHARACTERISTIC
/begin CHARACTERISTIC K_LAM_REG_T_SA_VERZ "Wartezeit LA-Regler nach SA | EN: Wartezeit LA-Regler nach SA [V912: differs from V452 160E]" VALUE 0x73FD8 TKW_VV_VV_UW 100.0 FORMULA_0753 0.0 65.5350 FORMAT "%6.3" /end CHARACTERISTIC
/begin CHARACTERISTIC K_LAM_REG_T_SLP_VERZ "Wartezeit LA-Regler nach aktiver SLP | EN: Wait time for lambda controller after active secondary-air pump [s]" VALUE 0x73FDA TKW_VV_VV_UW 100.0 FORMULA_0753 0.0 65.5350 FORMAT "%6.3" /end CHARACTERISTIC
/begin CHARACTERISTIC K_LAM_DIAG_LAA_F_HYS "Faktor-Hysterese fuer LAA-Diag. | EN: Factor hysteresis for lambda adaptation diagnosis [V912: differs from V452 160E]" VALUE 0x73FDC TKW_VV_VV_UW 100.0 FORMULA_0024 0.0 1.9990 FORMAT "%7.4" /end CHARACTERISTIC
/begin CHARACTERISTIC K_LAM_DIAG_LAA_OFFS_HYS "Offset-Hysterese fuer LAA-Diag. | EN: Offset hysteresis for lambda adaptation diagnosis [mg/ASP]" VALUE 0x73FDE TKW_VV_VV_SW 100.0 FORMULA_0531 -512.0000 511.0000 FORMAT "%6.3" /end CHARACTERISTIC
/begin CHARACTERISTIC KL_LAVK_IST_OFFS "Adaptionsoffset der Lambdasonde | EN: Lambda sensor adaptation offset" CURVE 0x73FE0 TKL_UW_VV_SW 100.0 FORMULA_0532 -5000.0000 5000.0000 /begin AXIS_DESCR STD_AXIS Abgasbank FORMULA_0010 2 1.0000 2.0000 /end AXIS_DESCR /end CHARACTERISTIC
/begin CHARACTERISTIC KL_LAVK_IST_F "Adaptionsfaktor der Lambdasonde | EN: Lambda sensor adaptation factor" CURVE 0x73FEA TKL_UW_VV_UW 100.0 FORMULA_0075 0.0 4.0000 /begin AXIS_DESCR STD_AXIS Abgasbank FORMULA_0010 2 1.0000 2.0000 /end AXIS_DESCR FORMAT "%6.3" /end CHARACTERISTIC
/begin CHARACTERISTIC KL_LAVK_T_KORR_F "Korrekturfaktor - Temperaturgang Sonde | EN: Correction factor - sensor temperature dependence" CURVE 0x73FF4 TKL_SW_VV_UW 100.0 FORMULA_0075 0.0 4.0000
 /begin AXIS_DESCR STD_AXIS lshvk_temp_dif FORMULA_0791 6 -1300.0000 1300.0000 /end AXIS_DESCR
 FORMAT "%6.3" /end CHARACTERISTIC
/begin CHARACTERISTIC KL_LAM_IST "IST-Lambda | EN: Actual lambda" CURVE 0x7400E TKL_SW_VV_UW 100.0 FORMULA_0025 0.0 3.9990
 /begin AXIS_DESCR STD_AXIS lavk_ip_korr FORMULA_0750 24 -10.0000 9.9996 FORMAT "%7.4" /end AXIS_DESCR
 FORMAT "%6.3" /end CHARACTERISTIC
/begin CHARACTERISTIC KL_LAVK_P_KORR_F_FETT "Korrekturfaktor FETT - Druckgang Sonde | EN: Correction factor RICH - sensor pressure dependence" CURVE 0x74070 TKL_SW_VV_UW 100.0 FORMULA_0075 0.0 4.0000 /begin AXIS_DESCR STD_AXIS pabg FORMULA_0077 12 0.0 2000.0000 FORMAT "%4.1" /end AXIS_DESCR FORMAT "%6.3" /end CHARACTERISTIC
/begin CHARACTERISTIC KL_LAVK_P_KORR_F_MAGER "Korrekturfaktor MAGER - Druckgang Sonde | EN: Correction factor LEAN - sensor pressure dependence" CURVE 0x740A2 TKL_SW_VV_UW 100.0 FORMULA_0075 0.0 4.0000 /begin AXIS_DESCR STD_AXIS pabg FORMULA_0077 12 0.0 2000.0000 FORMAT "%4.1" /end AXIS_DESCR FORMAT "%6.3" /end CHARACTERISTIC
/begin CHARACTERISTIC KF_LAM_REG_K "Reglerverstaerkung | EN: Controller gain" MAP 0x740D4 TKF_SW_SW_SW 100.0 FORMULA_0755 -2.0000 2.0000
 /begin AXIS_DESCR STD_AXIS lam_delta_lim FORMULA_0025 7 -2.0000 1.9999 FORMAT "%6.3" /end AXIS_DESCR
 /begin AXIS_DESCR STD_AXIS wf_mks_rel FORMULA_0075 3 0.0 31.9990 FORMAT "%6.3" /end AXIS_DESCR
 FORMAT "%5.2" /end CHARACTERISTIC
/begin CHARACTERISTIC KF_LAM_REG_KORR_F "Korrekturfaktor fuer Reglerverstaerkung | EN: Correction factor for controller gain" MAP 0x74114 TKF_SW_SW_UW 100.0 FORMULA_0075 0.0 4.0000 /begin AXIS_DESCR STD_AXIS lam_soll FORMULA_0025 4 0.0 1.9999 FORMAT "%6.3" /end AXIS_DESCR /begin AXIS_DESCR STD_AXIS FORMULA_0023 4 -50.0000 170.0000 FORMAT "%4.1" /end AXIS_DESCR FORMAT "%6.3" /end CHARACTERISTIC
/begin CHARACTERISTIC KF_LAVK_FILT_T1 "Fiterkonstante IST-LA-Wert | EN: Filter constant, actual lambda value" MAP 0x74146 TKF_SW_SW_UW 100.0 FORMULA_0762 0.0 2097.0000
 /begin AXIS_DESCR STD_AXIS lam_delta_lim FORMULA_0025 4 -2.0000 1.9999 FORMAT "%6.3" /end AXIS_DESCR
 /begin AXIS_DESCR STD_AXIS FORMULA_0006 4 0.0 10000.0000 /end AXIS_DESCR
/end CHARACTERISTIC
/begin CHARACTERISTIC KF_LAM_REG_WF_MKS_REL_MAX "max. rel. Eingriff - WF-Modell | EN: Maximum relative intervention - wall-film model" MAP 0x74178 TKF_SW_SW_UW 100.0 FORMULA_0075 0.0 4.0000 /begin AXIS_DESCR STD_AXIS FORMULA_0006 6 0.0 10000.0000 /end AXIS_DESCR /begin AXIS_DESCR STD_AXIS rf FORMULA_0007 6 0.0 2.0000 FORMAT "%6.3" /end AXIS_DESCR FORMAT "%6.3" /end CHARACTERISTIC
/begin CHARACTERISTIC KF_LAM_REG_WF_VERZ_F "Verzoegerungsfaktor - Wandfilmeingriff | EN: Delay factor - wall-film intervention" MAP 0x741DA TKF_SW_SW_UW 100.0 FORMULA_0792 0.0 127.9980 /begin AXIS_DESCR STD_AXIS FORMULA_0006 6 0.0 10000.0000 /end AXIS_DESCR /begin AXIS_DESCR STD_AXIS rf FORMULA_0007 6 0.0 2.0000 FORMAT "%6.3" /end AXIS_DESCR FORMAT "%4.1" /end CHARACTERISTIC
/* ------------------ Abschnitt erzeugt aus lam_soll.dat ------------------ */
/begin CHARACTERISTIC K_LAM_SEGM_V214_FAK2 "Anpassungsfaktor fuer Segmentzeit" VALUE 0x7423C TKW_VV_VV_UW 100.0 FORMULA_0797 1.0 2.0 FORMAT "%5.2" /end CHARACTERISTIC
/begin CHARACTERISTIC K_LAM_SOLL_MS_KAT_F_OBD "Wichtungsfak. auf Lambdapulshub bei KAT_ZUST_PASSIV | EN: Weighting factor on lambda pulse amplitude when catalyst passive" VALUE 0x7423E TKW_VV_VV_UW 100.0 FORMULA_0075 0.0 1.0000 FORMAT "%6.3" /end CHARACTERISTIC
/begin CHARACTERISTIC K_LAM_SOLL_KONV_CFG "KONV-Pulsgenerator" VALUE 0x74240 TKW_VV_VV_UW 100.0 FORMULA_0798 0.0 1.0 FORMAT "%5.2" /end CHARACTERISTIC
/begin CHARACTERISTIC K_LAM_SOLL_OFFS_MCS "LAM-SOLL-Offset - Fummeloffset | EN: Target lambda offset (MCS) | [Code V452 INJ 0x4596C] Global lambda target offset added to every state after the cat-protection min() (0 here)." VALUE 0x74242 TKW_VV_VV_SW 100.0 FORMULA_0025 -2.0000 1.9999 FORMAT "%6.3" /end CHARACTERISTIC
/begin CHARACTERISTIC K_LAM_SOLL_KATH_T_ML_MAX "max. Zeit fuer den Zustand SL (frueher KATH-Heizen) | EN: Max. time in state SL (former cat heating) [s]" VALUE 0x74244 TKW_VV_VV_UW 100.0 FORMULA_0799 0.0 65535.0000 /end CHARACTERISTIC
/begin CHARACTERISTIC K_LAM_SOLL_WL_TMOT_MAX "TMOT-Schwelle f. WL-Zustand-Erkennung | [Code V452 INJ 0x453C4/0x455EC] Coolant temperature above which the warm-up lambda state is left (with K_LAM_SOLL_WL_TMOT_HYS). [V912: differs from V452 160E]" VALUE 0x74246 TKW_VV_VV_SW 100.0 FORMULA_0023 -50.0000 170.0000 FORMAT "%4.1" /end CHARACTERISTIC
/begin CHARACTERISTIC K_LAM_SOLL_WL_TMOT_HYS "TMOT-Schwelle f. WL-Zustand-Erkennung | EN: TMOT hysteresis for warm-up state detection [degC x/10] | [Code V452 INJ 0x453C4] Hysteresis of the warm-up state threshold." VALUE 0x74248 TKW_VV_VV_SW 100.0 FORMULA_0800 -1000.0000 1000.0000 FORMAT "%4.1" /end CHARACTERISTIC
/begin CHARACTERISTIC K_LAM_SOLL_KATH_DELTA_POS "pos. Aenderungsbegr. in SL (frueher KATH) | EN: Pos. lambda rate limit in SL [1/s]" VALUE 0x7424A TKW_VV_VV_UW 100.0 FORMULA_0801 0.0 1.9990 FORMAT "%6.3" /end CHARACTERISTIC
/begin CHARACTERISTIC K_LAM_SOLL_KATH_DELTA_NEG "neg. Aenderungsbegr. in SL (frueher KATH) | EN: Neg. lambda rate limit in SL [1/s]" VALUE 0x7424C TKW_VV_VV_SW 100.0 FORMULA_0802 0.0 -2.0000 FORMAT "%6.3" /end CHARACTERISTIC
/begin CHARACTERISTIC K_LAM_SOLL_WL_DELTA_POS "pos. Aenderungsbegr. im WL | EN: Pos. lambda rate limit in warm-up [1/s]" VALUE 0x7424E TKW_VV_VV_UW 100.0 FORMULA_0801 0.0 1.9990 FORMAT "%6.3" /end CHARACTERISTIC
/begin CHARACTERISTIC K_LAM_SOLL_WL_DELTA_NEG "neg. Aenderungsbegr. im WL | EN: Neg. lambda rate limit in warm-up [1/s]" VALUE 0x74250 TKW_VV_VV_SW 100.0 FORMULA_0802 0.0 -2.0000 FORMAT "%6.3" /end CHARACTERISTIC
/begin CHARACTERISTIC K_LAM_SOLL_FETT_ERK "FETT-Erkennung f. MS_KAT-Adaption | EN: Rich detection for MS_KAT adaptation" VALUE 0x74252 TKW_VV_VV_UW 100.0 FORMULA_0025 0.0 3.9990 FORMAT "%6.3" /end CHARACTERISTIC
/begin CHARACTERISTIC K_LAM_SOLL_MS_KAT_MIN "KAT befuellt mit min. Sauerstoffmasse | EN: Cat filled with min. O2 mass" VALUE 0x74254 TKW_VV_VV_SW 100.0 FORMULA_0803 -3276.8000 3276.7000 FORMAT "%4.1" /end CHARACTERISTIC
/begin CHARACTERISTIC K_LAM_SOLL_MS_KAT_SOLL_MAX_OBD "max. gespeicherte Sauerstoffmasse im KAT - O2-Ermittlung | EN: Max. stored O2 mass in cat - O2 determination" VALUE 0x74256 TKW_VV_VV_SW 100.0 FORMULA_0803 -3276.8000 3276.7000 FORMAT "%4.1" /end CHARACTERISTIC
/begin CHARACTERISTIC K_LAM_SOLL_T_SA_SLP_MIN "min. Zeit in SA/SLP-ON f. Adaption | EN: Min. time in SA/SLP-ON for adaptation" VALUE 0x74258 TKW_VV_VV_UW 100.0 FORMULA_0804 0.0 655.3500 /end CHARACTERISTIC
/begin CHARACTERISTIC K_LAM_SOLL_T_FETT_MIN "min. Zeit in FETT f. Adaption | EN: Min. time rich for adaptation" VALUE 0x7425A TKW_VV_VV_UW 100.0 FORMULA_0804 0.0 655.3500 /end CHARACTERISTIC
/begin CHARACTERISTIC K_LAM_SOLL_FILT_F "Filterfaktor f. lam_soll_filt | EN: Filter factor for lam_soll_filt (x/128)" VALUE 0x7425C TKW_VV_VV_UW 100.0 FORMULA_0805 0.0 511.9921 FORMAT "%5.2" /end CHARACTERISTIC
/begin CHARACTERISTIC K_LAM_SOLL_O2_ANT "Sauerstoffanteil d. Luft | EN: Oxygen fraction of air (x/128)" VALUE 0x7425E TKW_VV_VV_UW 100.0 FORMULA_0805 0.0 511.9921 FORMAT "%5.2" /end CHARACTERISTIC
/begin CHARACTERISTIC K_LAM_SOLL_PULS_O2_HYST "min. Schwelle f. Berechnung Sauerstoffmassengradient | EN: Min. |lambda-1| for O2 mass gradient calculation" VALUE 0x74260 TKW_VV_VV_UW 100.0 FORMULA_0025 0.0 3.9990 FORMAT "%6.3" /end CHARACTERISTIC
/begin CHARACTERISTIC K_LAM_SOLL_KR_KATS "KR-LA-Faktor | EN: Knock-retard to lambda factor [1/degKW] | [Code V452 INJ 0x4596C] Knock-to-lambda factor: target offset = (kr_dtz_sum + ka_dtz_sum - KF_LAM_SOLL_KR_KATS_OFFS) x factor (only when the retard exceeds the map offset). 0 here = off." VALUE 0x74262 TKW_VV_VV_UW 100.0 FORMULA_0806 0.0 1.0000 FORMAT "%6.3" /end CHARACTERISTIC
/begin CHARACTERISTIC K_LAM_SOLL_ADD_KONV_GRAD "Pulshub - Aenderungsbegrenzung | EN: Pulse amplitude rate limit" VALUE 0x74264 TKW_VV_VV_UW 100.0 FORMULA_0025 0.0 3.9990 FORMAT "%6.3" /end CHARACTERISTIC
/begin CHARACTERISTIC K_LAM_SOLL_MAX "MAX-Begrenzung LAM_SOLL | EN: Max. limit of target lambda | [Code V452 INJ 0x46CB8] Leanest allowed final lambda target." VALUE 0x74266 TKW_VV_VV_UW 100.0 FORMULA_0025 0.0 3.9990 FORMAT "%6.3" /end CHARACTERISTIC
/begin CHARACTERISTIC K_LAM_SOLL_MIN "MIN-Begrenzung LAM_SOLL | EN: Min. limit of target lambda | [Code V452 INJ 0x46CB8] Richest allowed final lambda target (after trim offset)." VALUE 0x74268 TKW_VV_VV_UW 100.0 FORMULA_0025 0.0 3.9990 FORMAT "%6.3" /end CHARACTERISTIC
/begin CHARACTERISTIC K_LAM_SOLL_PULS_AUSR_CFG "O2-Ausraeumfunktion | EN: O2 clearing function enable (0 inactive, 1 active)" VALUE 0x7426A TKW_VV_VV_UW 100.0 FORMULA_0798 0.0 1.0 FORMAT "%5.2" /end CHARACTERISTIC
/begin CHARACTERISTIC K_LAM_SOLL_PULS_AUSR_SL_CFG "O2-Ausraeumfunktion - nach SLP-Betrieb | EN: O2 clearing after secondary-air operation enable" VALUE 0x7426C TKW_VV_VV_UW 100.0 FORMULA_0798 0.0 1.0 FORMAT "%5.2" /end CHARACTERISTIC
/begin CHARACTERISTIC K_LAM_SOLL_PULS_LANK_CFG "O2-Ausraeumfunktion - Fuehrung duch NKAT-Signal | EN: O2 clearing guided by post-cat probe signal" VALUE 0x7426E TKW_VV_VV_UW 100.0 FORMULA_0807 0.0 1.0 FORMAT "%5.2" /end CHARACTERISTIC
/begin CHARACTERISTIC K_LAM_SOLL_PULS_LANK_MAX "O2-Ausraeumfunktion - max. Schwelle fuer NKAT-Fuehrung | EN: O2 clearing - max. threshold for post-cat guidance" VALUE 0x74270 TKW_VV_VV_SW 100.0 FORMULA_0532 -1200.0000 1200.0000 /end CHARACTERISTIC
/begin CHARACTERISTIC K_LAM_SOLL_PULS_LANK_MIN "O2-Ausraeumfunktion - min. Schwelle fuer NKAT-Fuehrung | EN: O2 clearing - min. threshold for post-cat guidance" VALUE 0x74272 TKW_VV_VV_SW 100.0 FORMULA_0532 -1200.0000 1200.0000 /end CHARACTERISTIC
/begin CHARACTERISTIC K_LAM_SOLL_PULS_AUSR_SL_T "Verzaegerungszeit nach Startende | EN: Delay after start end (O2 clearing)" VALUE 0x74274 TKW_VV_VV_UW 100.0 FORMULA_0021 0.0 655.3500 FORMAT "%5.2" /end CHARACTERISTIC
/begin CHARACTERISTIC K_LAM_SOLL_MS_KAT_OFFSET_OBD "OFFSET auf min. Sauerstoffmasse im Zustand PASSIV | EN: OFFSET für max. Sauerstoff- masse im Zustand PASSIV /WARTEN" VALUE 0x74276 TKW_VV_VV_SW 100.0 FORMULA_0803 -3276.8000 3276.7000 FORMAT "%4.1" /end CHARACTERISTIC
/begin CHARACTERISTIC KL_LAM_SOLL_START "SOLL-Lambda von START -> ML | EN: Target lambda at start | [Code V452 INJ 0xF7008] Start lambda over tmot (state 'start')." CURVE 0x74278 TKL_SW_VV_UW 100.0 FORMULA_0025 0.0 3.9990 /begin AXIS_DESCR STD_AXIS FORMULA_0023 6 -50.0000 170.0000 FORMAT "%4.1" /end AXIS_DESCR FORMAT "%6.3" /end CHARACTERISTIC
/begin CHARACTERISTIC KL_LAM_SOLL_VL "SOLL-Lambda - Vollast | EN: Target lambda - full load | [Code V452 INJ 0x4596C] Full-load lambda over n. On entering full load the current target is frozen as lam_w.soll_vl_bezug; then target = bezug + f x (KL_LAM_SOLL_VL - bezug) + knock offset, f = (md_wunsch_rel - zust_md_rel_tl_vl)/(100 % - threshold): 0 at 90 % torque demand, 1.0 at 100 %. Full value only at 100 % demand. Cat protection can make it richer, never leaner." CURVE 0x74292 TKL_SW_VV_UW 100.0 FORMULA_0025 0.0 3.9990 /begin AXIS_DESCR STD_AXIS FORMULA_0006 8 0.0 10000.0000 /end AXIS_DESCR FORMAT "%6.3" /end CHARACTERISTIC
/begin CHARACTERISTIC KL_LAM_SOLL_PULS_PW_OBD "Pulsdauer f. Pulsgenerator OBD" CURVE 0x742B4 TKL_UW_VV_UW 100.0 FORMULA_0021 0.0 655.3500 /begin AXIS_DESCR STD_AXIS Abgasbank FORMULA_0010 2 1.0000 2.0000 /end AXIS_DESCR FORMAT "%5.2" /end CHARACTERISTIC
/begin CHARACTERISTIC KL_LAM_SOLL_PULS_ADD_OBD "Pulshub f. Pulsgenerator OBD" CURVE 0x742BE TKL_UW_VV_SW 100.0 FORMULA_0025 -2.0000 1.9999 /begin AXIS_DESCR STD_AXIS Abgasbank FORMULA_0010 2 1.0000 2.0000 /end AXIS_DESCR FORMAT "%6.3" /end CHARACTERISTIC
/begin CHARACTERISTIC KL_LAM_SOLL_ADD_KAT_ALT_F "Wichtungsfaktor ueber KAT-Alterung | EN: Weighting factor over catalyst ageing" CURVE 0x742C8 TKL_UW_VV_UW 100.0 FORMULA_0075 0.0 4.0000
 /begin AXIS_DESCR STD_AXIS kat_obd_wert_nv FORMULA_0025 6 0.0 3.9990 FORMAT "%6.3" /end AXIS_DESCR
 FORMAT "%6.3" /end CHARACTERISTIC
/begin CHARACTERISTIC KL_LAM_SOLL_AUSS_F "Korrekturfak. f. Zustand Sicherheitskonzept | EN: Correction factor for safety-concept state" CURVE 0x742E2 TKL_SW_VV_UW 100.0 FORMULA_0075 0.0 4.0000 /begin AXIS_DESCR STD_AXIS FORMULA_0023 8 -50.0000 170.0000 FORMAT "%4.1" /end AXIS_DESCR FORMAT "%6.3" /end CHARACTERISTIC
/begin CHARACTERISTIC KL_LAM_SOLL_MS_KAT_MAX "KAT befuellt mit max. Sauerstoffmasse | EN: Catalyst filled with max. oxygen mass [V912: differs from V452 160E]" CURVE 0x74304 TKL_UW_VV_SW 100.0 FORMULA_0803 -3276.8000 3276.7000 /begin AXIS_DESCR STD_AXIS FORMULA_0025 6 0.0 3.9990 FORMAT "%6.3" /end AXIS_DESCR FORMAT "%4.1" /end CHARACTERISTIC
/begin CHARACTERISTIC KL_LAM_SOLL_MS_KAT_SOLL_HYS "relative Vorgabe d. Hysterese auf max. Sauerstoffmasse | EN: Relative hysteresis on max. oxygen mass" CURVE 0x7431E TKL_UW_VV_SW 100.0 FORMULA_0001 0.0 100.0000 /begin AXIS_DESCR STD_AXIS FORMULA_0025 6 0.0 3.9990 FORMAT "%6.3" /end AXIS_DESCR FORMAT "%4.1" /end CHARACTERISTIC
/begin CHARACTERISTIC KF_LAM_SOLL_WL "SOLL-Lambda - Warmlaufbetrieb | EN: Target lambda - warm-up operation | [Code V452 INJ 0x4596C] Warm-up lambda (n x rf_m) x KF_LAM_SOLL_WL_F/1024; used while tmot < K_LAM_SOLL_WL_TMOT_MAX (+hyst). Full load still blends from this value to KL_LAM_SOLL_VL." MAP 0x74338 TKF_SW_SW_UW 100.0 FORMULA_0025 0.0 3.9990 /begin AXIS_DESCR STD_AXIS FORMULA_0006 8 0.0 10000.0000 /end AXIS_DESCR /begin AXIS_DESCR STD_AXIS rf FORMULA_0007 8 0.0 2.0000 FORMAT "%6.3" /end AXIS_DESCR FORMAT "%6.3" /end CHARACTERISTIC
/begin CHARACTERISTIC KF_LAM_SOLL_TAU1_ABG "Zeitkonstante Abgassystem u. Sonde | EN: Time constant of exhaust system and sensor | [Code V452 INJ 0x46CB8] Exhaust/probe delay time constant for the filtered target lam_soll_filt (used by lambda control comparison)." MAP 0x743DA TKF_SW_SW_UW 100.0 FORMULA_0762 0.0 2097.0000 /begin AXIS_DESCR STD_AXIS FORMULA_0006 6 0.0 10000.0000 /end AXIS_DESCR /begin AXIS_DESCR STD_AXIS rf FORMULA_0007 4 0.0 2.0000 FORMAT "%6.3" /end AXIS_DESCR /end CHARACTERISTIC
/begin CHARACTERISTIC KF_LAM_SOLL_GRUND "SOLL-Lambda - Normalbetrieb | EN: Target lambda - normal operation | [Code V452 INJ 0x4596C] Part-load lambda target (n x rf_m), per bank via state machine lam_w.soll_zust_st: start KL_LAM_SOLL_START | normal KF_LAM_SOLL_GRUND + wall-film offset + knock offset (K_LAM_SOLL_KR_KATS) | warm-up KF_LAM_SOLL_WL x KF_LAM_SOLL_WL_F | full load: blend to KL_LAM_SOLL_VL | safety/misfire KF_LAM_SOLL_AUSS_KATS. Then min(target, cat-protection lambda) -> + K_LAM_SOLL_OFFS_MCS -> change limit -> K_LAM_SOLL_MIN..MAX -> lam_soll_b." MAP 0x74420 TKF_SW_SW_UW 100.0 FORMULA_0025 0.9501 1.0200 /begin AXIS_DESCR STD_AXIS FORMULA_0006 8 0.0 10000.0000 /end AXIS_DESCR /begin AXIS_DESCR STD_AXIS rf FORMULA_0007 8 0.0 2.0000 FORMAT "%6.3" /end AXIS_DESCR FORMAT "%6.3" /end CHARACTERISTIC
/begin CHARACTERISTIC KF_LAM_SOLL_GRUND_PST "SOLL-Lambda - Normalbetrieb PST | EN: Target lambda - normal operation, test bench | [Code V452 INJ 0x4596C] Replaces KF_LAM_SOLL_GRUND in PST (test-bench / production) mode (soll_st bit, or cfg.betriebsmode / tester operating mode)." MAP 0x744C2 TKF_SW_SW_UW 100.0 FORMULA_0025 0.0 3.9990 /begin AXIS_DESCR STD_AXIS FORMULA_0006 8 0.0 10000.0000 /end AXIS_DESCR /begin AXIS_DESCR STD_AXIS rf FORMULA_0007 8 0.0 2.0000 FORMAT "%6.3" /end AXIS_DESCR FORMAT "%6.3" /end CHARACTERISTIC
/begin CHARACTERISTIC KF_LAM_SOLL_KR_KATS_OFFS "TZ-OFFSET aus KR | EN: Ignition-angle offset from knock control | [Code V452 INJ 0x4596C] Knock retard threshold (n x rf_m) above which K_LAM_SOLL_KR_KATS enriches. -100 here = never." MAP 0x74564 TKF_SW_SW_SW 100.0 FORMULA_0111 -100.0000 60.0000 /begin AXIS_DESCR STD_AXIS FORMULA_0006 6 0.0 10000.0000 /end AXIS_DESCR /begin AXIS_DESCR STD_AXIS rf FORMULA_0007 6 0.0 2.0000 FORMAT "%6.3" /end AXIS_DESCR FORMAT "%4.1" /end CHARACTERISTIC
/begin CHARACTERISTIC KF_LAM_SOLL_AUSS_KATS "KATS-Lambda beim SK-Manager | EN: Catalyst-protection lambda from safety-concept manager | [Code V452 INJ 0x4596C] Lambda in the safety-concept/misfire state: KF_LAM_SOLL_AUSS_KATS - KF_LAM_SOLL_AUSS_OFFS x KL_LAM_SOLL_AUSS_F." MAP 0x745C6 TKF_SW_SW_UW 100.0 FORMULA_0025 0.0 3.9990 /begin AXIS_DESCR STD_AXIS FORMULA_0006 6 0.0 10000.0000 /end AXIS_DESCR /begin AXIS_DESCR STD_AXIS rf FORMULA_0007 6 0.0 2.0000 FORMAT "%6.3" /end AXIS_DESCR FORMAT "%6.3" /end CHARACTERISTIC
/begin CHARACTERISTIC KF_LAM_SOLL_AUSS_OFFS "OFFSET auf KATS-Lambda beim SK-Manager | [Code V452 INJ 0x4596C] Offset subtracted in the safety-concept/misfire lambda state, weighted by KL_LAM_SOLL_AUSS_F(tmot_modell)." MAP 0x74628 TKF_SW_SW_UW 100.0 FORMULA_0025 0.0 3.9990 /begin AXIS_DESCR STD_AXIS FORMULA_0006 6 0.0 10000.0000 /end AXIS_DESCR /begin AXIS_DESCR STD_AXIS rf FORMULA_0007 6 0.0 2.0000 FORMAT "%6.3" /end AXIS_DESCR FORMAT "%6.3" /end CHARACTERISTIC
/begin CHARACTERISTIC KF_LAM_SOLL_MS_KAT_SOLL_MAX "relative Vorgabe fuer max. gespeicherte Sauerstoffmasse im KAT" MAP 0x7468A TKF_SW_SW_SW 100.0 FORMULA_0001 0.0 100.0000 /begin AXIS_DESCR STD_AXIS FORMULA_0006 8 0.0 10000.0000 /end AXIS_DESCR /begin AXIS_DESCR STD_AXIS rf FORMULA_0007 8 0.0 2.0000 FORMAT "%6.3" /end AXIS_DESCR FORMAT "%4.1" /end CHARACTERISTIC
/begin CHARACTERISTIC KF_LAM_SOLL_MS_KAT_SOLL_MIN "relative Vorgabe fuer min. gespeicherte Sauerstoffmasse im KAT" MAP 0x7472C TKF_SW_SW_SW 100.0 FORMULA_0001 0.0 100.0000 /begin AXIS_DESCR STD_AXIS FORMULA_0006 8 0.0 10000.0000 /end AXIS_DESCR /begin AXIS_DESCR STD_AXIS rf FORMULA_0007 8 0.0 2.0000 FORMAT "%6.3" /end AXIS_DESCR FORMAT "%4.1" /end CHARACTERISTIC
/begin CHARACTERISTIC KF_LAM_SOLL_MS_KAT_SOLL_MIN_OBD "min. gespeicherte Sauerstoffmasse im KAT - O2-Ermittlung | EN: Minimum stored oxygen mass in catalyst - O2 determination [V912: differs from V452 160E]" MAP 0x747CE TKF_SW_SW_SW 100.0 FORMULA_0093 -3276.8000 3276.7000 /begin AXIS_DESCR STD_AXIS FORMULA_0006 6 0.0 10000.0000 /end AXIS_DESCR /begin AXIS_DESCR STD_AXIS rf FORMULA_0007 6 0.0 2.0000 FORMAT "%6.3" /end AXIS_DESCR FORMAT "%5.2" /end CHARACTERISTIC
/begin CHARACTERISTIC KF_LAM_SOLL_ADD_POS_OBD "Lambdapulshub in Richtung MAGER | EN: Lambda pulse amplitude towards LEAN" MAP 0x74830 TKF_SW_SW_UW 100.0 FORMULA_0025 0.0 3.9990 /begin AXIS_DESCR STD_AXIS FORMULA_0006 6 0.0 10000.0000 /end AXIS_DESCR /begin AXIS_DESCR STD_AXIS rf FORMULA_0007 6 0.0 2.0000 FORMAT "%6.3" /end AXIS_DESCR FORMAT "%6.3" /end CHARACTERISTIC
/begin CHARACTERISTIC KF_LAM_SOLL_ADD_NEG_OBD "Lambdapulshub in Richtung FETT | EN: Lambda pulse amplitude towards RICH" MAP 0x74892 TKF_SW_SW_UW 100.0 FORMULA_0025 0.0 3.9990 /begin AXIS_DESCR STD_AXIS FORMULA_0006 6 0.0 10000.0000 /end AXIS_DESCR /begin AXIS_DESCR STD_AXIS rf FORMULA_0007 6 0.0 2.0000 FORMAT "%6.3" /end AXIS_DESCR FORMAT "%6.3" /end CHARACTERISTIC
/begin CHARACTERISTIC KF_LAM_SOLL_ADD_KONV "Lambdapulshub in Richtung MAGER/FETT | EN: Lambda pulse amplitude (normal operation)" MAP 0x748F4 TKF_SW_SW_UW 100.0 FORMULA_0025 0.0 3.9990 /begin AXIS_DESCR STD_AXIS FORMULA_0006 8 0.0 10000.0000 /end AXIS_DESCR /begin AXIS_DESCR STD_AXIS rf FORMULA_0007 8 0.0 2.0000 FORMAT "%6.3" /end AXIS_DESCR FORMAT "%6.3" /end CHARACTERISTIC
/begin CHARACTERISTIC KF_LAM_SOLL_PULS_OFFS_AUSR "Pulshub - O2-Ausraeumfunktion | EN: Pulse amplitude - O2 clearing (applied rich)" MAP 0x74996 TKF_SW_SW_UW 100.0 FORMULA_0025 0.0 3.9990 /begin AXIS_DESCR STD_AXIS FORMULA_0006 8 0.0 10000.0000 /end AXIS_DESCR /begin AXIS_DESCR STD_AXIS rf FORMULA_0007 8 0.0 2.0000 FORMAT "%6.3" /end AXIS_DESCR FORMAT "%6.3" /end CHARACTERISTIC
/begin CHARACTERISTIC KF_LAM_SOLL_WL_F "Korrekturfak. f. Zustand Warmlaufbetrieb | EN: Correction factor for warm-up state (target lambda) | [Code V452 INJ 0xF7008] Warm-up factor over tmot x pumg applied to KF_LAM_SOLL_WL (richer at low temperature / altitude). [V912: differs from V452 160E]" MAP 0x74A38 TKF_SW_SW_UW 100.0 FORMULA_0075 0.0 4.0000 /begin AXIS_DESCR STD_AXIS FORMULA_0023 8 -50.0000 170.0000 FORMAT "%4.1" /end AXIS_DESCR /begin AXIS_DESCR STD_AXIS FORMULA_0077 4 400.0000 1200.0000 FORMAT "%4.1" /end AXIS_DESCR FORMAT "%6.3" /end CHARACTERISTIC
/* ------------------ Abschnitt erzeugt aus lank.dat ------------------ */
/begin CHARACTERISTIC K_LANK_US_TAU_S "schnelle Filterkonstante NKAT-Signal | EN: Fast filter constant, post-cat signal" VALUE 0x74A92 TKW_VV_VV_UW 100.0 FORMULA_0838 0.0 257.0000 FORMAT "%5.2" /end CHARACTERISTIC
/begin CHARACTERISTIC K_LANK_US_FILT_UNT "Filterband - untere Schwelle | EN: Filter band - lower threshold [mV]" VALUE 0x74A94 TKW_VV_VV_UW 100.0 FORMULA_0532 0.0 1200.0000 /end CHARACTERISTIC
/begin CHARACTERISTIC K_LANK_US_FILT_OB "Filterband - obere Schwelle | EN: Filter band - upper threshold [mV]" VALUE 0x74A96 TKW_VV_VV_UW 100.0 FORMULA_0532 0.0 1200.0000 /end CHARACTERISTIC
/begin CHARACTERISTIC K_LANK_US_FILT_T "Einschwingzeit - NKAT-Signal | EN: Settling time - post-cat signal [ms]" VALUE 0x74A98 TKW_VV_VV_UW 100.0 FORMULA_0538 0.0 655350.0000 /end CHARACTERISTIC
/begin CHARACTERISTIC K_LANK_US_TAU "Zeitkonstante NKAT-Signal | EN: Time constant, post-cat signal [s]" VALUE 0x74A9A TKW_VV_VV_UB 100.0 FORMULA_0664 0.0101 2.5600 /end CHARACTERISTIC
/begin CHARACTERISTIC K_LANK_USF "Fettschwelle fuer verbotenes Band | EN: Rich threshold for forbidden band [mV]" VALUE 0x74A9C TKW_VV_VV_UW 100.0 FORMULA_0532 0.0 1200.0000 /end CHARACTERISTIC
/begin CHARACTERISTIC K_LANK_USM "Magerschwelle fuer verbotenes Band | EN: Lean threshold for forbidden band [mV]" VALUE 0x74A9E TKW_VV_VV_UW 100.0 FORMULA_0532 0.0 1200.0000 /end CHARACTERISTIC
/begin CHARACTERISTIC K_LANK_FETT "Fettschwelle fuer NKAT-Signal | EN: Rich threshold for post-cat signal [mV]" VALUE 0x74AA0 TKW_VV_VV_UW 100.0 FORMULA_0532 0.0 1200.0000 /end CHARACTERISTIC
/begin CHARACTERISTIC K_LANK_MAGER "Magerschwelle fuer NKAT-Signal | EN: Lean threshold for post-cat signal [mV]" VALUE 0x74AA2 TKW_VV_VV_UW 100.0 FORMULA_0532 0.0 1200.0000 /end CHARACTERISTIC
/begin CHARACTERISTIC K_LANK_T_EIN "Einschaltueberwachungszeit NKAT-Signal | EN: Switch-on monitoring time, post-cat signal [s]" VALUE 0x74AA4 TKW_VV_VV_UW 100.0 FORMULA_0021 0.0 655.0000 FORMAT "%5.2" /end CHARACTERISTIC
/begin CHARACTERISTIC K_LANK_T_AUS "Ausschaltueberwachungszeit NKAT-Signal | EN: Switch-off monitoring time, post-cat signal [s]" VALUE 0x74AA6 TKW_VV_VV_UW 100.0 FORMULA_0021 0.0 655.0000 FORMAT "%5.2" /end CHARACTERISTIC
/begin CHARACTERISTIC K_LANK_N_MAX "obere n-Schwelle als Ausschaltbedingung | EN: obere n-Schwelle als Ausschaltbedingung" VALUE 0x74AA8 TKW_VV_VV_SW 100.0 FORMULA_0006 0.0 10000.0000 /end CHARACTERISTIC
/begin CHARACTERISTIC K_LANK_N_MIN "untere n-Schwelle als Ausschaltbedingung | EN: untere n -Schwelle als Ausschaltbedi n-gung" VALUE 0x74AAA TKW_VV_VV_SW 100.0 FORMULA_0006 0.0 10000.0000 /end CHARACTERISTIC
/begin CHARACTERISTIC K_LANK_RF_MAX "obere rf-Schwelle als Ausschaltbedingung | EN: obere rf -Schwelle als Ausschaltbedin-gung" VALUE 0x74AAC TKW_VV_VV_SW 100.0 FORMULA_0007 0.0 2.0000 FORMAT "%6.3" /end CHARACTERISTIC
/begin CHARACTERISTIC K_LANK_RF_MIN "untere rf-Schwelle als Ausschaltbedingung | EN: untere rf -Schwelle als Ausschaltbedi n-gung" VALUE 0x74AAE TKW_VV_VV_SW 100.0 FORMULA_0007 0.0 2.0000 FORMAT "%6.3" /end CHARACTERISTIC
/begin CHARACTERISTIC K_LANK_TKAT_SCHW "Kattemperaturschwelle als Einschaltbedingung | EN: Kattemperaturschwelle als Einschaltb e-dingung" VALUE 0x74AB0 TKW_VV_VV_SW 100.0 FORMULA_0023 -50.0000 1200.0000 FORMAT "%4.1" /end CHARACTERISTIC
/begin CHARACTERISTIC K_LANK_DIAG_CFG "Freigabe d. elektrischen Diag. NKAT | EN: Freigabe d. elektrischen Diag. NKAT" VALUE 0x74AB2 TKW_VV_VV_UB 100.0 FORMULA_0839 0.0 1.0 /end CHARACTERISTIC
/begin CHARACTERISTIC K_LANK_DIAG_VK_REG_T "Aktivzeit VKAT-Regler | EN: Aktivzeit VKAT-Regler [V912: differs from V452 160E]" VALUE 0x74AB4 TKW_VV_VV_UW 100.0 FORMULA_0021 0.0 655.0000 FORMAT "%5.2" /end CHARACTERISTIC
/begin CHARACTERISTIC K_LANK_DIAG_TKAT "KAT-Temperaturschwelle | EN: KAT-Temperaturschwelle" VALUE 0x74AB6 TKW_VV_VV_SW 100.0 FORMULA_0023 -50.0000 1250.0000 FORMAT "%4.1" /end CHARACTERISTIC
/begin CHARACTERISTIC K_LANK_DIAG_SONDTEMP "min. Sondentemperatur | EN: min. Sondentemperatur" VALUE 0x74AB8 TKW_VV_VV_SW 100.0 FORMULA_0023 -50.0000 1250.0000 FORMAT "%4.1" /end CHARACTERISTIC
/begin CHARACTERISTIC K_LANK_DIAG_STAB_T "Zeitschwelle f. stab. Zustand | EN: Zeitschwelle f. stab. Zustand" VALUE 0x74ABA TKW_VV_VV_UW 100.0 FORMULA_0021 0.0 655.0000 FORMAT "%5.2" /end CHARACTERISTIC
/begin CHARACTERISTIC K_LANK_DIAG_MAX_T "Zeitschwelle-NKAT fuer UBATT | EN: Zeitschwelle-NKAT fuer UBATT" VALUE 0x74ABC TKW_VV_VV_UW 100.0 FORMULA_0021 0.0 655.0000 FORMAT "%5.2" /end CHARACTERISTIC
/begin CHARACTERISTIC K_LANK_DIAG_GND_T "Zeitschwelle-NKAT fuer GND | EN: Zeitschwelle-NKAT fuer GND" VALUE 0x74ABE TKW_VV_VV_UW 100.0 FORMULA_0021 0.0 655.0000 FORMAT "%5.2" /end CHARACTERISTIC
/begin CHARACTERISTIC K_LANK_DIAG_OL_T "Zeitschwelle-NKAT fuer OL | EN: Zeitschwelle-NKAT fuer OL" VALUE 0x74AC0 TKW_VV_VV_UW 100.0 FORMULA_0062 0.0 65535.0000 /end CHARACTERISTIC
/begin CHARACTERISTIC K_LANK_DIAG_OL_N_MIN "min. n-Schwelle f. OL-Diagnose" VALUE 0x74AC2 TKW_VV_VV_SW 100.0 FORMULA_0006 0.0 10000.0000 /end CHARACTERISTIC
/begin CHARACTERISTIC K_LANK_DIAG_OL_N_MAX "max. n-Schwelle f. OL-Diagnose | EN: max. n-Schwelle f. OL-Diagnose" VALUE 0x74AC4 TKW_VV_VV_SW 100.0 FORMULA_0006 0.0 10000.0000 /end CHARACTERISTIC
/begin CHARACTERISTIC K_LANK_DIAG_UMAX "MAX. NKAT-Sondenspannung | EN: MAX. NKAT-Sondenspannung" VALUE 0x74AC6 TKW_VV_VV_UW 100.0 FORMULA_0532 0.0 1200.0000 /end CHARACTERISTIC
/begin CHARACTERISTIC K_LANK_DIAG_UMIN "MIN. NKAT-Sondenspannung | EN: MIN. NKAT-Sondenspannung" VALUE 0x74AC8 TKW_VV_VV_UW 100.0 FORMULA_0532 0.0 1200.0000 /end CHARACTERISTIC
/begin CHARACTERISTIC K_LANK_DIAG_OL_LAM_SOLL_M "SOLL-Lambda-Magersprung - OL-Diagnose" VALUE 0x74ACA TKW_VV_VV_UW 100.0 FORMULA_0025 0.0 3.9990 FORMAT "%6.3" /end CHARACTERISTIC
/begin CHARACTERISTIC K_LANK_DIAG_OL_ML_MIN "min. Luftmassendurchsatz f. best. Zeit  | EN: min. Luftmassendurchsatz f. best. Zeit" VALUE 0x74ACC TKW_VV_VV_SW 100.0 FORMULA_0112 -100.0000 1400.0000 FORMAT "%4.1" /end CHARACTERISTIC
/begin CHARACTERISTIC K_LANK_DIAG_OL_ML_STABIL_T "min. Zeitschwelle f. Luftmassendurchsatz | EN: min. Zeitschwelle f. Luftmassendurchsatz" VALUE 0x74ACE TKW_VV_VV_UW 100.0 FORMULA_0062 0.0 65535.0000 /end CHARACTERISTIC
/begin CHARACTERISTIC K_LANK_DIAG_OL_MAGER_T "Zeit fuer MAGERSPRUNG - OL-Diag. | EN: Zeit fuer MAGERSPRUNG - OL-Diag." VALUE 0x74AD0 TKW_VV_VV_UW 100.0 FORMULA_0062 0.0 65535.0000 /end CHARACTERISTIC
/begin CHARACTERISTIC K_LANK_DIAG_OL_MAGER_CNT "max. Anzahl der MAGERSPRUENGE - OL-Diag. | EN: max. Anzahl der MAGERSPRUENGE - OL-Diag." VALUE 0x74AD2 TKW_VV_VV_UW 100.0 FORMULA_0010 0.0 65535.0000 /end CHARACTERISTIC
/begin CHARACTERISTIC K_LANK_OBD_S_CFG "Freigabe d. NKAT-Schwingungspr. | EN: 0 inaktiv 1 aktiv Freigabe d. NKAT - Schwingungspr." VALUE 0x74AD4 TKW_VV_VV_UW 100.0 FORMULA_0798 0.0 1.0 FORMAT "%5.2" /end CHARACTERISTIC
/begin CHARACTERISTIC K_LANK_OBD_S_USF_SA "Fettschwelle f. Aktivierung SA-Diag. | EN: Fettschwelle fuer Aktivierung SA-Diag." VALUE 0x74AD6 TKW_VV_VV_UW 100.0 FORMULA_0532 0.0 1200.0000 /end CHARACTERISTIC
/begin CHARACTERISTIC K_LANK_OBD_S_USF_WE "Magerschwelle f. Aktivierung WE-Diag." VALUE 0x74AD8 TKW_VV_VV_UW 100.0 FORMULA_0532 0.0 1200.0000 /end CHARACTERISTIC
/begin CHARACTERISTIC K_LANK_OBD_S_NMAX "obere n-Schwelle als Ausschaltbedingung [V912: differs from V452 160E]" VALUE 0x74ADA TKW_VV_VV_SW 100.0 FORMULA_0006 0.0 10000.0000 /end CHARACTERISTIC
/begin CHARACTERISTIC K_LANK_OBD_S_NMIN "untere n-Schwelle als Ausschaltbedingung" VALUE 0x74ADC TKW_VV_VV_SW 100.0 FORMULA_0006 0.0 10000.0000 /end CHARACTERISTIC
/begin CHARACTERISTIC K_LANK_OBD_S_VL_US "Fehlerschwelle fuer OBD-S-Diag." VALUE 0x74ADE TKW_VV_VV_UW 100.0 FORMULA_0532 0.0 1200.0000 /end CHARACTERISTIC
/begin CHARACTERISTIC K_LANK_OBD_S_VL_T "Wartezeit VL - OBD-S-Diag. | EN: Wartezeit VL - OBD-S-Diag." VALUE 0x74AE0 TKW_VV_VV_UW 100.0 FORMULA_0021 0.0 655.0000 FORMAT "%5.2" /end CHARACTERISTIC
/begin CHARACTERISTIC K_LANK_OBD_S_LAM_VKAT "VKAT-FETT-Schwelle f. VL-S-Diag." VALUE 0x74AE2 TKW_VV_VV_UW 100.0 FORMULA_0025 0.0 3.9990 FORMAT "%6.3" /end CHARACTERISTIC
/begin CHARACTERISTIC K_LANK_OBD_S_WE_US "Fehlerschwelle fuer OBD-WE-Diag." VALUE 0x74AE4 TKW_VV_VV_UW 100.0 FORMULA_0532 0.0 1200.0000 /end CHARACTERISTIC
/begin CHARACTERISTIC K_LANK_OBD_S_SA_US "Fehlerschwelle fuer OBD-SA-Diag." VALUE 0x74AE6 TKW_VV_VV_UW 100.0 FORMULA_0532 0.0 1200.0000 /end CHARACTERISTIC
/begin CHARACTERISTIC K_LANK_OBD_S_SA_T "Wartezeit SCHUBDAUER - OBD-S-Diag." VALUE 0x74AE8 TKW_VV_VV_UW 100.0 FORMULA_0073 0.0 6553.5000 FORMAT "%4.1" /end CHARACTERISTIC
/begin CHARACTERISTIC K_LANK_OBD_S_TML "min. ML-Zeit" VALUE 0x74AEA TKW_VV_VV_UW 100.0 FORMULA_0021 0.0 655.0000 FORMAT "%5.2" /end CHARACTERISTIC
/begin CHARACTERISTIC K_LANK_OBD_S_WE_T "Wartezeit WE - OBD-S-Diag." VALUE 0x74AEC TKW_VV_VV_UW 100.0 FORMULA_0073 0.0 6553.5000 FORMAT "%4.1" /end CHARACTERISTIC
/begin CHARACTERISTIC K_LANK_OBD_S_SA_WE_T "max. SCHUBDAUER fuer Schaltvorgang | EN: max. SCHUBDAUER fuer Schaltvorgang" VALUE 0x74AEE TKW_VV_VV_UW 100.0 FORMULA_0073 0.0 6553.5000 FORMAT "%4.1" /end CHARACTERISTIC
/begin CHARACTERISTIC K_LANK_OBD_S_WE_LAM_T "max. Zeit in d. zus. Anfettung wirkt - OBD-S-Diag." VALUE 0x74AF0 TKW_VV_VV_UW 100.0 FORMULA_0073 0.0 6553.5000 FORMAT "%4.1" /end CHARACTERISTIC
/begin CHARACTERISTIC K_LANK_OBD_S_SA_ML_SUM "min. aufsummierte Luftmassenstr. fuer SA-Diag. | EN: min. aufsummierte Luftmassen-str. fuer SA-Diag." VALUE 0x74AF2 TKW_VV_VV_UW 100.0 FORMULA_0832 0.0 65535.0000 /end CHARACTERISTIC
/begin CHARACTERISTIC K_LANK_OBD_S_SA_AUTOM "Anzahl der Automatikprogramme" VALUE 0x74AF4 TKW_VV_VV_UB 100.0 FORMULA_0003 0.0 255.0000 /end CHARACTERISTIC
/begin CHARACTERISTIC K_LANK_OBD_S_AUTOM_CNT "Anzahl d.fehlerhafte Diagnosen - Automatikprog." VALUE 0x74AF5 TKW_VV_VV_UB 100.0 FORMULA_0003 0.0 255.0000 /end CHARACTERISTIC
/begin CHARACTERISTIC K_LANK_OBD_S_CNT "Anzahl d.fehlerhafte Diagnosen" VALUE 0x74AF6 TKW_VV_VV_UB 100.0 FORMULA_0003 0.0 255.0000 /end CHARACTERISTIC
/begin CHARACTERISTIC K_LANK_OBD_S_WE_CNT "Anzahl durchzufuehrende WE-Diagnosen" VALUE 0x74AF7 TKW_VV_VV_UB 100.0 FORMULA_0003 0.0 255.0000 /end CHARACTERISTIC
/begin CHARACTERISTIC K_LANK_OBD_SLOPE_F_MAX "Wichtung d. Bezugswertes f. MAX-Schwelle - SLOPE-SA-Diag. | EN: Wichtung d. Bezugswertes f. MAX-Schwelle - SLOPE-SA-Diag." VALUE 0x74AF8 TKW_VV_VV_UW 100.0 FORMULA_0840 0.0 100.0000 FORMAT "%4.1" /end CHARACTERISTIC
/begin CHARACTERISTIC K_LANK_OBD_SLOPE_F_MIN "Wichtung d. Bezugswertes f. MIN-Schwelle - SLOPE-SA-Diag. | EN: Wichtung d. Bezugswertes f. MIN-Schwelle - SLOPE-SA-Diag." VALUE 0x74AFA TKW_VV_VV_UW 100.0 FORMULA_0840 0.0 100.0000 FORMAT "%4.1" /end CHARACTERISTIC
/begin CHARACTERISTIC K_LANK_OBD_SLOPE_HYS "Hysterese fuer  | EN: Hysterese fuer" VALUE 0x74AFC TKW_VV_VV_SW 100.0 FORMULA_0532 0.0 100.0000 /end CHARACTERISTIC
/begin CHARACTERISTIC K_LANK_OBD_SLOPE_CNT_IO "Anzahl i.O. Slope-Diagnosen im DCY | EN: Anzahl i.O. Slope-Diagnosen im DCY" VALUE 0x74AFE TKW_VV_VV_UB 100.0 FORMULA_0003 0.0 255.0000 /end CHARACTERISTIC
/begin CHARACTERISTIC K_LANK_OBD_SLOPE_CNT "Anzahl d. gueltigen Messungen" VALUE 0x74AFF TKW_VV_VV_UB 100.0 FORMULA_0003 0.0 255.0000 /end CHARACTERISTIC
/begin CHARACTERISTIC K_LANK_OBD_SLOPE_NASE_CNT "NASE-Ermittlung ueber X-Messungen" VALUE 0x74B00 TKW_VV_VV_UB 100.0 FORMULA_0003 0.0 255.0000 /end CHARACTERISTIC
/begin CHARACTERISTIC K_LANK_OBD_S_USF_SLOPE_MAX "max. Fettschwelle f. Freigabe d. SLOPE-Diag. | EN: Max. Fettschwelle fuer Freigabe d. SLOPE-Diag." VALUE 0x74B02 TKW_VV_VV_UW 100.0 FORMULA_0532 0.0 1200.0000 /end CHARACTERISTIC
/begin CHARACTERISTIC K_LANK_OBD_SLOPE_T_MAX_MODE5 "max. Schwelle SLOPE-Zeit f. MODE 5/6 [V912: differs from V452 160E]" VALUE 0x74B04 TKW_VV_VV_UW 100.0 FORMULA_0538 0.0 655350.0000 /end CHARACTERISTIC
/begin CHARACTERISTIC K_LANK_OBD_SLOPE_T_MIN_MODE5 "min. Schwelle SLOPE-Zeit f. MODE 5/6" VALUE 0x74B06 TKW_VV_VV_UW 100.0 FORMULA_0538 0.0 655350.0000 /end CHARACTERISTIC
/begin CHARACTERISTIC K_LANK_OBD_S_SA_T_MAX_MODE6 "max. Abfallszeit des NKAT-Signals in SA f. MODE 6" VALUE 0x74B08 TKW_VV_VV_UW 100.0 FORMULA_0539 0.0 6553500.0000 /end CHARACTERISTIC
/begin CHARACTERISTIC K_LANK_OBD_S_SA_T_MIN_MODE6 "min. Abfallszeit des NKAT-Signals in SA f. MODE 6 | EN: Min. Abfallszeit des NKAT -Signals in SA f. MODE 6" VALUE 0x74B0A TKW_VV_VV_UW 100.0 FORMULA_0539 0.0 6553500.0000 /end CHARACTERISTIC
/begin CHARACTERISTIC K_LANK_OBD_S_SA_T_MODE6_FALSE "fehlerhafte Abfallszeit des NKAT-Signals in SA f. MODE 6 | EN: fehlerhafte Abfallszeit des NKAT-Signals in SA f. MODE 6" VALUE 0x74B0C TKW_VV_VV_UW 100.0 FORMULA_0539 0.0 6553500.0000 /end CHARACTERISTIC
/begin CHARACTERISTIC KL_KAT_OBD_LANK_LAM "Lambda der NKAT-Sonde | EN: Lambda from post-cat sensor" CURVE 0x74B0E TKL_UW_VV_UW 100.0 FORMULA_0025 0.0 3.9990 /begin AXIS_DESCR STD_AXIS lank_us FORMULA_0532 16 0.0 1200.0000 /end AXIS_DESCR FORMAT "%6.3" /end CHARACTERISTIC
/begin CHARACTERISTIC KL_LANK_OBD_S_WE_ML_SUM "min. aufsummierte Luftmassenstr. fuer. WE-Diag." CURVE 0x74B50 TKL_SW_VV_UW 100.0 FORMULA_0832 0.0 65535.0000 /begin AXIS_DESCR STD_AXIS FORMULA_0006 4 0.0 10000.0000 /end AXIS_DESCR /end CHARACTERISTIC
/begin CHARACTERISTIC KL_LANK_OBD_SLOPE_ML_T "SLOPE-Zeit fuer SA-Diagnose [V912: differs from V452 160E]" CURVE 0x74B62 TKL_UW_VV_UW 100.0 FORMULA_0538 0.0 655350.0000 /begin AXIS_DESCR STD_AXIS mzyl_ml_sum_sa FORMULA_0832 5 0.0 65535.0000 /end AXIS_DESCR /end CHARACTERISTIC
/begin CHARACTERISTIC KF_LANK_US_TAU_L "langsame Filterkonstante NKAT-Signal | EN: Slow filter constant, post-cat sensor signal" MAP 0x74B78 TKF_SW_SW_UW 100.0 FORMULA_0838 0.0 257.0000 /begin AXIS_DESCR STD_AXIS FORMULA_0006 4 0.0 10000.0000 /end AXIS_DESCR /begin AXIS_DESCR STD_AXIS rf FORMULA_0007 4 0.0 2.0000 FORMAT "%6.3" /end AXIS_DESCR FORMAT "%5.2" /end CHARACTERISTIC
/begin CHARACTERISTIC KF_LANK_OBD_S_LAM_SOLL "OFFSET SOLL-Lambda - zusaetzliche WE-Anfettung" MAP 0x74BAA TKF_SW_SW_SW 100.0 FORMULA_0025 -2.0000 0.0 /begin AXIS_DESCR STD_AXIS FORMULA_0006 6 0.0 10000.0000 /end AXIS_DESCR /begin AXIS_DESCR STD_AXIS rf FORMULA_0007 6 0.0 2.0000 FORMAT "%6.3" /end AXIS_DESCR FORMAT "%6.3" /end CHARACTERISTIC
/* ------------------ Abschnitt erzeugt aus lavk_spi.dat ------------------ */
/begin CHARACTERISTIC K_LAVK_ATIC42_ICP_ENABLE_B1 "ATIC42 ICP Einspeisung | EN: ATIC42 ICP feed" VALUE 0x74CD4 TKW_VV_VV_UB 100.0 FORMULA_0889 0.0 1.0 /end CHARACTERISTIC
/begin CHARACTERISTIC K_LAVK_ATIC42_ICP_ENABLE_B2 "ATIC42 ICP Einspeisung | EN: ATIC42 ICP feed" VALUE 0x74CD5 TKW_VV_VV_UB 100.0 FORMULA_0889 0.0 1.0 /end CHARACTERISTIC
/begin CHARACTERISTIC K_LAVK_ATIC42_RI_OSCI_B1 "ATIC42 Innenwiderstands Oszillator | EN: ATIC42 internal-resistance oscillator" VALUE 0x74CD8 TKW_VV_VV_UB 100.0 FORMULA_0889 0.0 1.0 /end CHARACTERISTIC
/begin CHARACTERISTIC K_LAVK_ATIC42_RI_OSCI_B2 "ATIC42 Innenwiderstands Oszillator | EN: ATIC42 internal-resistance oscillator" VALUE 0x74CD9 TKW_VV_VV_UB 100.0 FORMULA_0889 0.0 1.0 /end CHARACTERISTIC
/begin CHARACTERISTIC K_LAVK_ATIC42_SENSOR_B1 "ATIC42 Lambda Sonde | EN: ATIC42 lambda sensor" VALUE 0x74CDA TKW_VV_VV_UB 100.0 FORMULA_0890 0.0 1.0 /end CHARACTERISTIC
/begin CHARACTERISTIC K_LAVK_ATIC42_SENSOR_B2 "ATIC42 Lambda Sonde | EN: ATIC42 lambda sensor" VALUE 0x74CDB TKW_VV_VV_UB 100.0 FORMULA_0890 0.0 1.0 /end CHARACTERISTIC
/begin CHARACTERISTIC K_LAVK_ATIC42_ICP_VALUE_B1 "ATIC42 ICP Wert | EN: ATIC42 ICP value" VALUE 0x74CDC TKW_VV_VV_UB 100.0 FORMULA_0891 5.0000 160.0000 /end CHARACTERISTIC
/begin CHARACTERISTIC K_LAVK_ATIC42_ICP_VALUE_B2 "ATIC42 ICP Wert | EN: ATIC42 ICP value" VALUE 0x74CDD TKW_VV_VV_UB 100.0 FORMULA_0891 5.0000 160.0000 /end CHARACTERISTIC
/begin CHARACTERISTIC K_LAVK_ATIC42_PROTEC_TIME_B1 "ATIC42 Zeit in der der Sensor nach einem Fehler getrennt wird | EN: ATIC42 time the sensor is disconnected after a fault" VALUE 0x74CDE TKW_VV_VV_UB 100.0 FORMULA_0892 0.8000 1.5000 /end CHARACTERISTIC
/begin CHARACTERISTIC K_LAVK_ATIC42_PROTEC_TIME_B2 "ATIC42 Zeit in der der Sensor nach einem Fehler getrennt wird | EN: ATIC42 time the sensor is disconnected after a fault" VALUE 0x74CDF TKW_VV_VV_UB 100.0 FORMULA_0892 0.8000 1.5000 /end CHARACTERISTIC
/begin CHARACTERISTIC K_LAVK_ATIC42_RI_MEAS_FREQ_B1 "ATIC42 Frequenz der Oszillators zur Innenwiderstandsmessung | EN: ATIC42 oscillator frequency for internal-resistance measurement" VALUE 0x74CE0 TKW_VV_VV_UB 100.0 FORMULA_0893 2.0000 9.8750 /end CHARACTERISTIC
/begin CHARACTERISTIC K_LAVK_ATIC42_RI_MEAS_FREQ_B2 "ATIC42 Frequenz der Oszillators zur Innenwiderstandsmessung | EN: ATIC42 oscillator frequency for internal-resistance measurement" VALUE 0x74CE1 TKW_VV_VV_UB 100.0 FORMULA_0893 2.0000 9.8750 /end CHARACTERISTIC
/begin CHARACTERISTIC K_LAVK_ATIC42_PIN_CFG_B1 "ATIC42 PIN-Freigabe | EN: ATIC42 pin enable" VALUE 0x74CE2 TKW_VV_VV_UB 100.0 FORMULA_0894 0.0 1.0 /end CHARACTERISTIC
/begin CHARACTERISTIC K_LAVK_ATIC42_PIN_CFG_B2 "ATIC42 PIN-Freigabe | EN: ATIC42 pin enable" VALUE 0x74CE3 TKW_VV_VV_UB 100.0 FORMULA_0894 0.0 1.0 /end CHARACTERISTIC
/begin CHARACTERISTIC K_LAVK_ATIC42_SPI_DIAG_CNT "Fehlerschwelle f. ATIC42-SPI-Diag. | EN: Fehlerschwelle f. ATIC42-SPI-Diag." VALUE 0x74CE4 TKW_VV_VV_UW 100.0 FORMULA_0010 0.0 65535.0000 /end CHARACTERISTIC
/* ------------------ Abschnitt erzeugt aus mdrv.dat ------------------ */
/begin CHARACTERISTIC K_MDRV_CFG "Konfiguration | EN: 0 Schalter 1 Komfort 2 Normal 3 Sport 4 Konfigmode ELSE undef Konfiguration" VALUE 0x75288 TKW_VV_VV_UB 100.0 FORMULA_0966 0.0 255.0 /end CHARACTERISTIC
/begin CHARACTERISTIC K_MDRV_CFG_P400 "Konfiguration P400-Only | EN: 0 nur US 1 immer Konfiguration P400-Only" VALUE 0x75289 TKW_VV_VV_UB 100.0 FORMULA_0967 0.0 255.0 /end CHARACTERISTIC
/begin CHARACTERISTIC K_MDRV_PTH_CNT_MAX "max. Entprellcounter | EN: max. Entprellcounter" VALUE 0x7528A TKW_VV_VV_UB 100.0 FORMULA_0003 0.0 255.0000 /end CHARACTERISTIC
/begin CHARACTERISTIC K_MDRV_DSC "Default-Konfiguration DSC | EN: 0 k. Aenderung 1 Aus 2 Ein 4 MDM ELSE undef Default-Konfiguration DSC" VALUE 0x7528B TKW_VV_VV_UB 100.0 FORMULA_0233 0.0 255.0 /end CHARACTERISTIC
/begin CHARACTERISTIC K_MDRV_MOD_SMG "Default-Konfiguration SMG-Mode | EN: 0 k. Aenderung 1 Automat 2 Sequentiell ELSE undef Default-Konfiguration SMG - Mode" VALUE 0x7528C TKW_VV_VV_UB 100.0 FORMULA_0234 0.0 255.0 /end CHARACTERISTIC
/begin CHARACTERISTIC K_MDRV_STG_SMG "Default-Konfiguration SMG-Sufe | EN: Default-Konfiguration SMG-Sufe" VALUE 0x7528D TKW_VV_VV_UB 100.0 FORMULA_0003 0.0 255.0000 /end CHARACTERISTIC
/begin CHARACTERISTIC K_MDRV_ENG "Default-Konfiguration Motor | EN: 0 k. Aenderung 1 Komfort 2 Normal 3 Sport ELSE undef Default-Konfiguration Motor" VALUE 0x7528E TKW_VV_VV_UB 100.0 FORMULA_0236 0.0 255.0 /end CHARACTERISTIC
/begin CHARACTERISTIC K_MDRV_EDCK "Default-Konfiguration EDCK | EN: 0 k. Aenderung 1 Komfort 2 Normal 10 Sport ELSE undef Default-Konfiguration EDCK" VALUE 0x7528F TKW_VV_VV_UB 100.0 FORMULA_0237 0.0 255.0 /end CHARACTERISTIC
/begin CHARACTERISTIC K_MDRV_ALBV "Default-Konfiguration ALBV | EN: 0 k. Aenderung 1 KL1 2 KL2 3 KL3 ELSE undef Default-Konfiguration ALBV" VALUE 0x75290 TKW_VV_VV_UB 100.0 FORMULA_0237 0.0 255.0 /end CHARACTERISTIC
/begin CHARACTERISTIC K_MDRV_HUD "Default-Konfiguration HUD | EN: 0 k. Aenderung 1 M-Cfg ELSE undef Default-Konfiguration HUD" VALUE 0x75291 TKW_VV_VV_UB 100.0 FORMULA_0238 0.0 255.0 /end CHARACTERISTIC
/begin CHARACTERISTIC K_MDRV_P400_ONLY "P400-Sperre | EN: P400-Sperre" VALUE 0x75292 TKW_VV_VV_UW 100.0 FORMULA_0010 0.0 65535.0000 /end CHARACTERISTIC
/begin CHARACTERISTIC K_MDRV_P500_START "P500-Hochlauf | EN: P500-Hochlauf" VALUE 0x75294 TKW_VV_VV_UW 100.0 FORMULA_0010 0.0 65535.0000 /end CHARACTERISTIC
/begin CHARACTERISTIC K_MDRV_TBLINK "Blinkzeit | EN: Blinkzeit" VALUE 0x75296 TKW_VV_VV_UW 100.0 FORMULA_0021 0.0 655.0000 FORMAT "%5.2" /end CHARACTERISTIC
/* ------------------ Abschnitt erzeugt aus msa.dat ------------------ */
/begin CHARACTERISTIC K_MSA_Kl15OFF_T_LOW "max. Lowzeit MSA-Pin bei Kl15 aus | EN: max. Lowzeit MSA-Pin bei Kl15 aus" VALUE 0x75298 TKW_VV_VV_UB 100.0 FORMULA_0317 0.0 2.5500 /end CHARACTERISTIC
/* ------------------ Abschnitt erzeugt aus msg.dat ------------------ */ /* ------------------ Abschnitt erzeugt aus mvac.dat ------------------ */
/begin CHARACTERISTIC K_MVAC_P_OBD_TIME_ML "Diagnosefreigabe via time_ml" VALUE 0x7529C TKW_VV_VV_UW 100.0 FORMULA_0021 0.0 655.0000 FORMAT "%5.2" /end CHARACTERISTIC
/begin CHARACTERISTIC K_MVAC_P_DIAG_MIN "Unter Grenze Unterdruck-MVAC | EN: Lower limit, brake-booster vacuum [mbar]" VALUE 0x7529E TKW_VV_VV_SW 100.0 FORMULA_0984 -1100.0000 200.0000 /end CHARACTERISTIC
/begin CHARACTERISTIC K_MVAC_P_DIAG_MAX "Obere Grenze Unterdruck-MVAC | EN: Upper limit, brake-booster vacuum [mbar]" VALUE 0x752A0 TKW_VV_VV_SW 100.0 FORMULA_0984 -1100.0000 200.0000 /end CHARACTERISTIC
/begin CHARACTERISTIC K_MVAC_P_OBD_PDIFF_ROH_TAU "Zeitkonstante fuer mvac_p_obd_pdiff_roh-Filterwert | EN: Time constant for mvac_p_diag_pdiff_roh filter value" VALUE 0x752A2 TKW_VV_VV_UW 100.0 FORMULA_0985 0.0050 327.6700 FORMAT "%5.2" /end CHARACTERISTIC
/begin CHARACTERISTIC K_MVAC_P_OBD_PDIFF_TAU "Zeitkonstante fuer mvac_p_diag_pdiff-Filterwert | EN: Time constant for mvac_p_diag_pdiff filter value" VALUE 0x752A4 TKW_VV_VV_UW 100.0 FORMULA_0985 0.0050 327.6700 FORMAT "%5.2" /end CHARACTERISTIC
/begin CHARACTERISTIC K_MVAC_P_OBD_PDIFF_DELAY "Zeitverzoegerung fuer Berechnung von mvac_p_obd_pdiff_roh | EN: Time delay for calculating mvac_p_diag_pdiff_roh" VALUE 0x752A6 TKW_VV_VV_UW 100.0 FORMULA_0117 0.0 325.0000 FORMAT "%5.2" /end CHARACTERISTIC
/begin CHARACTERISTIC K_MVAC_P_OBD_PDIFF_POS "Maximale Differenz zum Modell | EN: Maximale Differenz zum Modell" VALUE 0x752A8 TKW_VV_VV_SW 100.0 FORMULA_0986 -1100.0000 2000.0000 FORMAT "%6.3" /end CHARACTERISTIC
/begin CHARACTERISTIC K_MVAC_P_OBD_PDIFF_NEG "minimale Differenz zum Modell | EN: minimale Differenz zum M o-dell" VALUE 0x752AA TKW_VV_VV_SW 100.0 FORMULA_0986 -1100.0000 2000.0000 FORMAT "%6.3" /end CHARACTERISTIC
/begin CHARACTERISTIC K_MVAC_P_OBD_PDIFF_TMOT "minimale Differenz zum Modell | EN: minimale Differenz zum M o-dell" VALUE 0x752AC TKW_VV_VV_SW 100.0 FORMULA_0987 -50.0000 2000.0000 FORMAT "%6.3" /end CHARACTERISTIC
/begin CHARACTERISTIC K_MVAC_P_SENSOR_STEIGUNG "Steigung des Drucksensors | EN: Pressure-sensor slope [mbar/V]" VALUE 0x752AE TKW_VV_VV_SW 100.0 FORMULA_0988 -409.6000 275.0000 FORMAT "%6.3" /end CHARACTERISTIC
/begin CHARACTERISTIC K_MVAC_P_SENSOR_OFFSET "Offset des Drucksensors | EN: Pressure-sensor offset [mbar]" VALUE 0x752B0 TKW_VV_VV_SW 100.0 FORMULA_0986 0.0 625.0000 FORMAT "%6.3" /end CHARACTERISTIC
/begin CHARACTERISTIC K_MVAC_ML_TAU "Tau fuer mvac_ml_psens PT1-Glied | EN: Tau fuer mvac_ml_psens PT1-Glied" VALUE 0x752B2 TKW_VV_VV_UW 100.0 FORMULA_0989 0.0050 327.6700 FORMAT "%6.3" /end CHARACTERISTIC
/begin CHARACTERISTIC K_MVAC_ML_MIN "Schwelle Luftmassenstrom | EN: Schwelle Luftmassenstrom" VALUE 0x752B4 TKW_VV_VV_SW 100.0 FORMULA_0112 -100.0000 1400.0000 FORMAT "%4.1" /end CHARACTERISTIC
/begin CHARACTERISTIC K_MVAC_ELUP_ST_DEL "Zeitverzoegerung fuer Berechnung von mvac_ml_sr_rsv_psens | EN: Zeitverzoegerung fuer B e- rechnung von mvac_ml_sr_rsv_psens" VALUE 0x752B6 TKW_VV_VV_UW 100.0 FORMULA_0117 0.0 325.0000 FORMAT "%5.2" /end CHARACTERISTIC
/begin CHARACTERISTIC K_MVAC_P_TAU "Filterkonstante fuer den Unterdruck-MVAC | EN: Filterkonstante fuer den Unterdruck-MVAC" VALUE 0x752B8 TKW_VV_VV_UB 100.0 FORMULA_0651 0.0051 1.2800 /end CHARACTERISTIC
/begin CHARACTERISTIC K_MVAC_ML_CFG "Software-Schalter mvac_ml_sr | EN: 0x00 mvac_ml_sr_rsv_mess 0x01 mvac_ml_sr_rsv_psens ELSE undef Software-Schalter mvac_ml_sr" VALUE 0x752B9 TKW_VV_VV_UB 100.0 FORMULA_0990 0.0 255.0 /end CHARACTERISTIC
/begin CHARACTERISTIC K_MVAC_HYS_MIN "Filterschwelle Differenzdruck | EN: Filterschwelle Differenzdruck" VALUE 0x752BA TKW_VV_VV_SW 100.0 FORMULA_0077 -2000.0000 2000.0000 FORMAT "%4.1" /end CHARACTERISTIC
/begin CHARACTERISTIC K_MVAC_HYS_MAX "Filterschwelle Differenzdruck | EN: Filterschwelle Differenzdruck" VALUE 0x752BC TKW_VV_VV_SW 100.0 FORMULA_0077 -2000.0000 2000.0000 FORMAT "%4.1" /end CHARACTERISTIC
/begin CHARACTERISTIC K_MVAC_DEL_RSV "Verzug Schliesszeit RSV | EN: Verzug Schliesszeit RSV" VALUE 0x752BE TKW_VV_VV_UW 100.0 FORMULA_0117 0.0 325.0000 FORMAT "%5.2" /end CHARACTERISTIC
/begin CHARACTERISTIC K_MVAC_AL_SRMV "Durchflusswert SR/Mvac | EN: Durchflusswert SR/Mvac" VALUE 0x752C0 TKW_VV_VV_SW 100.0 FORMULA_0991 0.0 6.4000 FORMAT "%6.3" /end CHARACTERISTIC
/begin CHARACTERISTIC K_MVAC_ML_SR_MIN "Schwelle Luftmassenstrom | EN: Air mass flow threshold [kg/h]" VALUE 0x752C2 TKW_VV_VV_SW 100.0 FORMULA_0112 -100.0000 1400.0000 FORMAT "%4.1" /end CHARACTERISTIC
/begin CHARACTERISTIC K_MVAC_ML_SR_MAX "Schwelle Luftmassenstrom | EN: Air mass flow threshold [kg/h]" VALUE 0x752C4 TKW_VV_VV_SW 100.0 FORMULA_0112 -100.0000 1400.0000 FORMAT "%4.1" /end CHARACTERISTIC
/begin CHARACTERISTIC K_MVAC_MLRF_SR_SPERRE "Ausgabesperre fuer mvac_rf_sr ueber time_ml | EN: Output lock for mvac_rf_sr via time_ml [s]" VALUE 0x752C6 TKW_VV_VV_UW 100.0 FORMULA_0021 0.0 655.0000 FORMAT "%5.2" /end CHARACTERISTIC
/begin CHARACTERISTIC K_MVAC_ML_AEB_POS "Aenderungsbegrenzung positiv fuer mvac_ml_sr | EN: Positive rate limit for mvac_ml_sr [kg/h]" VALUE 0x752C8 TKW_VV_VV_UW 100.0 FORMULA_0992 0.0 200.0000 FORMAT "%5.2" /end CHARACTERISTIC
/begin CHARACTERISTIC K_MVAC_ML_AEB_NEG "Aenderungsbegrenzung negativ fuer mvac_ml_sr | EN: Negative rate limit for mvac_ml_sr [kg/h]" VALUE 0x752CA TKW_VV_VV_UW 100.0 FORMULA_0992 0.0 200.0000 FORMAT "%5.2" /end CHARACTERISTIC
/begin CHARACTERISTIC K_MVAC_PDIFF_UM_BEGR_MIN "Min-Begrenzung Differenzdruck Mastervac/Umgebung | EN: Minimum limit, differential pressure brake booster/ambient [mbar]" VALUE 0x752CC TKW_VV_VV_SW 100.0 FORMULA_0077 -1100.0000 200.0000 FORMAT "%4.1" /end CHARACTERISTIC
/begin CHARACTERISTIC K_MVAC_PDIFF_UM_BEGR_MAX "Max-Begrenzung Differenzdruck Mastervac/Umgebung | EN: Maximum limit, differential pressure brake booster/ambient [mbar]" VALUE 0x752CE TKW_VV_VV_SW 100.0 FORMULA_0077 -1100.0000 200.0000 FORMAT "%4.1" /end CHARACTERISTIC
/begin CHARACTERISTIC K_MVAC_AL_UMMV_STAT "Durchflusswert BKV stationaer | EN: Brake-booster steady-state flow value [1/2^20]" VALUE 0x752D0 TKW_VV_VV_SW 100.0 FORMULA_0993 0.0 31.2500 FORMAT "%5.2" /end CHARACTERISTIC
/begin CHARACTERISTIC K_MVAC_AL_LECK "Durchflusswert BKV Leckluft | EN: Brake-booster leakage flow value [1/2^20]" VALUE 0x752D2 TKW_VV_VV_SW 100.0 FORMULA_0994 0.0 312.5000 FORMAT "%4.1" /end CHARACTERISTIC
/begin CHARACTERISTIC K_MVAC_DEL_BLS "Verzug S_BLS bis can_brp_grad | EN: Delay from brake-light signal to brake-pressure gradient [s]" VALUE 0x752D4 TKW_VV_VV_UW 100.0 FORMULA_0117 0.0 325.0000 FORMAT "%5.2" /end CHARACTERISTIC
/begin CHARACTERISTIC K_MVAC_AL_BLS "dynamischer Durchflusswert MVAC zu Beginn S_BLS | EN: Dynamic brake-booster flow value at start of brake-light signal [(kg/h)/mbar]" VALUE 0x752D6 TKW_VV_VV_SW 100.0 FORMULA_0980 0.0 2.0000 FORMAT "%5.2" /end CHARACTERISTIC
/begin CHARACTERISTIC K_MVAC_ML_INTEGRATOR_TAU "Tau fuer mvac_ml-Integrator | EN: Time constant for mvac_ml integrator [s]" VALUE 0x752D8 TKW_VV_VV_UW 100.0 FORMULA_0985 0.0050 40.0000 FORMAT "%5.2" /end CHARACTERISTIC
/begin CHARACTERISTIC K_MVAC_BRPGRAD_SW "Aufloeseschwelle brp_grad fuer AQ-Eingriff | EN: Brake-pressure gradient release threshold for air cross-section intervention [bar/s]" VALUE 0x752DA TKW_VV_VV_SW 100.0 FORMULA_0140 -5000.0000 5000.0000 /end CHARACTERISTIC
/begin CHARACTERISTIC K_MVAC_V "Volumen Mastervac | EN: Brake-booster volume [ccm]" VALUE 0x752DC TKW_VV_VV_SL 100.0 FORMULA_0995 0.0 1000000.0000 FORMAT "%4.1" /end CHARACTERISTIC
/begin CHARACTERISTIC K_MVAC_N_MIN_B "Mindest-n fuer MVAC-LLS-AQ-B2-Eingriff bei Bremsung | EN: Minimum engine speed for brake-booster idle-valve bank 2 intervention during braking [Upm]" VALUE 0x752E0 TKW_VV_VV_SW 100.0 FORMULA_0006 0.0 10000.0000 /end CHARACTERISTIC
/begin CHARACTERISTIC K_MVAC_BRP_GRAD_RAMPE "Zeitfaktor Abregelrampe | EN: Time factor for ramp-down [s]" VALUE 0x752E2 TKW_VV_VV_SW 100.0 FORMULA_0117 0.0 150.0000 FORMAT "%5.2" /end CHARACTERISTIC
/begin CHARACTERISTIC K_MVAC_PDIFF_FILTER_TAU "Tau fuer mvac_pdiff_filter PT1-Glied | EN: Time constant for mvac_pdiff_filter PT1 element [s]" VALUE 0x752E4 TKW_VV_VV_UW 100.0 FORMULA_0989 0.0050 327.6700 FORMAT "%6.3" /end CHARACTERISTIC
/begin CHARACTERISTIC K_MVAC_N_MIN_SA "Mindest-n fuer MVAC-LLS-AQ-B2-Eingriff bei SA | EN: Minimum engine speed for brake-booster idle-valve bank 2 intervention at start [Upm]" VALUE 0x752E6 TKW_VV_VV_SW 100.0 FORMULA_0006 0.0 10000.0000 /end CHARACTERISTIC
/begin CHARACTERISTIC K_MVAC_RMP_FKT_SA_BEGR "Rampenhoechstwert fuer Zeitfaktor bei SA | EN: Ramp maximum for time factor at start [s]" VALUE 0x752E8 TKW_VV_VV_SW 100.0 FORMULA_0117 0.0 150.0000 FORMAT "%5.2" /end CHARACTERISTIC
/begin CHARACTERISTIC K_MVAC_PL_TIME_LIMIT "Timer-Limit fuer MVAC-Prueflauf | EN: Timer limit for brake-booster test run [s]" VALUE 0x752EA TKW_VV_VV_UB 100.0 FORMULA_0232 0.0 255.0000 /end CHARACTERISTIC
/begin CHARACTERISTIC K_MVAC_PL_TIME_MS "Motorstandzeit bei MVAC-Prueflauf | EN: Engine-off time for brake-booster test run [s]" VALUE 0x752EB TKW_VV_VV_UB 100.0 FORMULA_0232 0.0 255.0000 /end CHARACTERISTIC
/begin CHARACTERISTIC K_MVAC_PL_PDIFF "Unterdruck-Delta zw. Sensor- und Modellwert bei PL-Start | EN: Vacuum delta between sensor and model at test-run start [mbar]" VALUE 0x752EC TKW_VV_VV_SW 100.0 FORMULA_0077 -1100.0000 200.0000 FORMAT "%4.1" /end CHARACTERISTIC
/begin CHARACTERISTIC K_MVAC_PL_P_IO_SW "IO-Schwell Unterdrucksensorwert nach 60 sec. | EN: OK threshold of vacuum sensor value after 60 s [mbar]" VALUE 0x752EE TKW_VV_VV_SW 100.0 FORMULA_0077 -1100.0000 200.0000 FORMAT "%4.1" /end CHARACTERISTIC
/begin CHARACTERISTIC K_MVAC_P_OBD_SA_TIME_MIN "Mindestzeit fuer Uebernahme von mvac_p_obd_pdiff_roh bei B_SA | EN: Mindestzeit fuer Uebernahme von mvac_p_obd_pdiff_roh bei B_SA" VALUE 0x752F0 TKW_VV_VV_UW 100.0 FORMULA_0117 0.0 325.0000 FORMAT "%5.2" /end CHARACTERISTIC
/begin CHARACTERISTIC K_MVAC_P_OBD_LL_TIME_MIN "Mindestzeit fuer Uebernahme von mvac_p_obd_pdiff_roh bei B_ZUST_LL | EN: Mindestzeit fuer Uebernahme von mvac_p_obd_pdiff_roh bei B_ZUST_LL" VALUE 0x752F2 TKW_VV_VV_UW 100.0 FORMULA_0021 0.0 655.0000 FORMAT "%5.2" /end CHARACTERISTIC
/begin CHARACTERISTIC KL_MVAC_ML_WICHT "Kennlinie Wichtungsfaktor von mvac_ml_sr_rsv | EN: Curve: weighting factor from mvac_ml_sr_rsv" CURVE 0x752F4 TKL_SW_VV_SW 100.0 FORMULA_0755 -128.0000 127.0000 /begin AXIS_DESCR STD_AXIS FORMULA_0112 8 -100.0000 1400.0000 FORMAT "%4.1" /end AXIS_DESCR FORMAT "%5.2" /end CHARACTERISTIC
/begin CHARACTERISTIC KL_MVAC_ELUP "Kennlinie Wichtungsfaktor von mvac_ml_sr_rsv | EN: Curve: weighting factor from mvac_ml_sr_rsv" CURVE 0x75316 TKL_SW_VV_SW 100.0 FORMULA_0979 -32.0000 32.0000 /begin AXIS_DESCR STD_AXIS FORMULA_0077 6 -1100.0000 200.0000 FORMAT "%4.1" /end AXIS_DESCR FORMAT "%7.4" /end CHARACTERISTIC
/begin CHARACTERISTIC KL_MVAC_BRP_GRAD "Kennlinie Durchflusswert MVAC von can_brp_grad | EN: Curve: brake-booster flow value from brake-pressure gradient" CURVE 0x75330 TKL_SW_VV_SW 100.0 FORMULA_0980 0.0 2.0000 /begin AXIS_DESCR STD_AXIS FORMULA_0140 14 -5000.0000 5000.0000 /end AXIS_DESCR FORMAT "%5.2" /end CHARACTERISTIC
/begin CHARACTERISTIC KL_MVAC_PDIFF_B "Kennlinie Betrag AQ-Eingriff bei Bremsung | EN: Curve: air cross-section intervention amount during braking" CURVE 0x7536A TKL_SW_VV_UW 100.0 FORMULA_0147 0.0 6500.0000 /begin AXIS_DESCR STD_AXIS FORMULA_0077 5 -2000.0000 2000.0000 FORMAT "%4.1" /end AXIS_DESCR FORMAT "%4.1" /end CHARACTERISTIC
/begin CHARACTERISTIC KL_MVAC_PDIFF_SA "Kennlinie Betrag AQ-Eingriff Bank 2 bei SA | EN: Curve: air cross-section intervention amount bank 2 at start" CURVE 0x75380 TKL_SW_VV_UW 100.0 FORMULA_0147 0.0 6500.0000 /begin AXIS_DESCR STD_AXIS FORMULA_0077 5 -2000.0000 2000.0000 FORMAT "%4.1" /end AXIS_DESCR FORMAT "%4.1" /end CHARACTERISTIC
/begin CHARACTERISTIC KF_MVAC_ELUP_ETA "ELUP-Wirkungsgrad auf MVAC-Modellberechnung | EN: Vacuum-pump efficiency in brake-booster model calculation" MAP 0x75396 TKF_SW_SW_UB 100.0 FORMULA_0643 0.0 1.9921 /begin AXIS_DESCR STD_AXIS FORMULA_0077 6 400.0000 1200.0000 FORMAT "%4.1" /end AXIS_DESCR /begin AXIS_DESCR STD_AXIS FORMULA_0023 5 -50.0000 170.0000 FORMAT "%4.1" /end AXIS_DESCR /end CHARACTERISTIC
/* ------------------ Abschnitt erzeugt aus mzyl.dat ------------------ */
/begin CHARACTERISTIC K_MZYL_CFG "Schalter Fuellungsberechnung | EN: 0x2 PSAU 0x4 AQ ELSE undefiniert Schalter Fuellungsberechnung" VALUE 0x753CC TKW_VV_VV_UB 100.0 FORMULA_1000 0.0 255.0 /end CHARACTERISTIC
/begin CHARACTERISTIC K_MZYL_START_CFG "Schalter Fuellungsber. im Start | EN: 0x2 PSAU 0x4 AQ ELSE undefiniert Schalter Fuellungsber. im Start" VALUE 0x753CD TKW_VV_VV_UB 100.0 FORMULA_1001 0.0 255.0 /end CHARACTERISTIC
/begin CHARACTERISTIC K_MZYL_T_CFG "TAN fuer Fuellungsber. aus PSAU" VALUE 0x753CE TKW_VV_VV_UB 100.0 FORMULA_1002 0.0 255.0 /end CHARACTERISTIC
/begin CHARACTERISTIC K_MZYL_R "Allgemeine Gaskonstante R | EN: Allgemeine Gaskonstante R" VALUE 0x753D0 TKW_VV_VV_UW 100.0 FORMULA_1003 0.0 6553.5000 FORMAT "%4.1" /end CHARACTERISTIC
/begin CHARACTERISTIC K_MZYL_EV_RUECK "Vanos-Spreizung Delta" VALUE 0x753D2 TKW_VV_VV_SW 100.0 FORMULA_0111 -80.0000 350.0000 FORMAT "%4.1" /end CHARACTERISTIC
/begin CHARACTERISTIC K_MZYL_EV_RUECK_TMAX "Max. Zeit fuer EV Rueck" VALUE 0x753D4 TKW_VV_VV_UW 100.0 FORMULA_0998 0.0 40.0000 FORMAT "%5.2" /end CHARACTERISTIC
/begin CHARACTERISTIC K_MZYL_HFM_AQ_MIN_FAK "Min. Wert fuer hfm_aq_fak" VALUE 0x753D6 TKW_VV_VV_SW 100.0 FORMULA_0556 -3.0000 3.0000 FORMAT "%7.4" /end CHARACTERISTIC
/begin CHARACTERISTIC K_MZYL_HFM_AQ_MAX_FAK "Max. Wert fuer hfm_aq_fak" VALUE 0x753D8 TKW_VV_VV_SW 100.0 FORMULA_0556 -3.0000 3.0000 FORMAT "%7.4" /end CHARACTERISTIC
/begin CHARACTERISTIC KL_MZYL_EV_A_MEAN "Wirksamer EV-Quersch. Rueckstr." CURVE 0x753DA TKL_SW_VV_UW 100.0 FORMULA_0997 0.0 15.0000 /begin AXIS_DESCR STD_AXIS van_xd FORMULA_0111 12 0.0 160.0000 FORMAT "%4.1" /end AXIS_DESCR FORMAT "%6.3" /end CHARACTERISTIC
/begin CHARACTERISTIC KL_MZYL_PZYL_DP "Offset pzyl fuer EV-schliesst" CURVE 0x7540C TKL_SW_VV_SW 100.0 FORMULA_0077 0.0 2000.0000 /begin AXIS_DESCR STD_AXIS FORMULA_0006 8 0.0 10000.0000 /end AXIS_DESCR FORMAT "%4.1" /end CHARACTERISTIC
/begin CHARACTERISTIC KL_MZYL_PZYL_DP_F "Faktor pzyl fuer EV-schliesst" CURVE 0x7542E TKL_SW_VV_SW 100.0 FORMULA_0075 -4.0000 4.0000
 /begin AXIS_DESCR STD_AXIS psau_rel FORMULA_0115 4 0.0 120.0000 FORMAT "%5.2" /end AXIS_DESCR
 FORMAT "%6.3" /end CHARACTERISTIC
/begin CHARACTERISTIC KF_MZYL_ADAPT_RAMPE_UP "Rampe fuer Verhaeltniss hfm/aq" MAP 0x75440 TKF_SW_SW_SW 100.0 FORMULA_1004 0.0 3.0000 /begin AXIS_DESCR STD_AXIS FORMULA_0006 6 0.0 10000.0000 /end AXIS_DESCR
 /begin AXIS_DESCR STD_AXIS dr_rel_1of2_ FORMULA_0115 6 0.0 199.9938 FORMAT "%5.2" /end AXIS_DESCR
 FORMAT "%7.4" /end CHARACTERISTIC
/begin CHARACTERISTIC KF_MZYL_ADAPT_RAMPE_DOWN "Rampe fuer Verhaeltniss hfm/aq" MAP 0x754A2 TKF_SW_SW_SW 100.0 FORMULA_1004 0.0 3.0000 /begin AXIS_DESCR STD_AXIS FORMULA_0006 6 0.0 10000.0000 /end AXIS_DESCR
 /begin AXIS_DESCR STD_AXIS dr_rel_1of2_ FORMULA_0115 6 0.0 199.9938 FORMAT "%5.2" /end AXIS_DESCR
 FORMAT "%7.4" /end CHARACTERISTIC
/begin CHARACTERISTIC KF_MZYL_ADAPT_GEW "Rampe fuer Verhaeltniss hfm/aq" MAP 0x75504 TKF_SW_SW_UW 100.0 FORMULA_0075 0.5000 2.0000 /begin AXIS_DESCR STD_AXIS FORMULA_0006 6 0.0 10000.0000 /end AXIS_DESCR
 /begin AXIS_DESCR STD_AXIS dr_rel_1of2_ FORMULA_0115 6 0.0 199.9938 FORMAT "%5.2" /end AXIS_DESCR
 FORMAT "%6.3" /end CHARACTERISTIC
/* ------------------ Abschnitt erzeugt aus o2_obd.dat ------------------ */
/begin CHARACTERISTIC K_O2_OBD_CFG "Freigabe O2-Beladung | EN: Freigabe O2-Beladung" VALUE 0x75650 TKW_VV_VV_UW 100.0 FORMULA_0798 0.0 1.0 FORMAT "%5.2" /end CHARACTERISTIC
/begin CHARACTERISTIC K_O2_LA_TRIM_CFG "Verknuepfung mit Trimmregelung | EN: Verknuepfung mit Trimmregelung" VALUE 0x75652 TKW_VV_VV_UW 100.0 FORMULA_1029 0.0 1.0 FORMAT "%5.2" /end CHARACTERISTIC
/begin CHARACTERISTIC K_O2_OBD_TMOT "min. TMOT-Schwelle f. O2-Beladung | EN: min. TMOT-Schwelle f. O2-Beladung" VALUE 0x75654 TKW_VV_VV_SW 100.0 FORMULA_0023 -50.0000 170.0000 FORMAT "%4.1" /end CHARACTERISTIC
/begin CHARACTERISTIC K_O2_OBD_RF_MAX "max. relative F�llung f. O2-Beladung | EN: max. relative Fï¿½llung f. O2-Beladung [V912: differs from V452 160E]" VALUE 0x75656 TKW_VV_VV_SW 100.0 FORMULA_0007 0.0 2.0000 FORMAT "%6.3" /end CHARACTERISTIC
/begin CHARACTERISTIC K_O2_OBD_RF_MIN_HYS "Hysterese f.die min. RF-Schwelle | EN: Hysterese f.die min. RF-Schwelle" VALUE 0x75658 TKW_VV_VV_SW 100.0 FORMULA_0007 0.0 2.0000 FORMAT "%6.3" /end CHARACTERISTIC
/begin CHARACTERISTIC K_O2_OBD_TKAT_MIN "min. KAT-Temperatur f. O2-Beladung | EN: min. KAT-Temperatur f. O2-Beladung" VALUE 0x7565A TKW_VV_VV_SW 100.0 FORMULA_0023 -50.0000 1200.0000 FORMAT "%4.1" /end CHARACTERISTIC
/begin CHARACTERISTIC K_O2_OBD_TKAT_HYS "min. KAT-Temperatur f. O2-Beladung | EN: min. KAT-Temperatur f. O2-Beladung [V912: differs from V452 160E]" VALUE 0x7565C TKW_VV_VV_SW 100.0 FORMULA_0800 -1000.0000 1000.0000 FORMAT "%4.1" /end CHARACTERISTIC
/begin CHARACTERISTIC K_O2_OBD_TKAT_MAX "max. KAT-Temperatur f. O2-Beladung | EN: max. KAT-Temperatur f. O2-Beladung [V912: differs from V452 160E]" VALUE 0x7565E TKW_VV_VV_SW 100.0 FORMULA_0023 -50.0000 1200.0000 FORMAT "%4.1" /end CHARACTERISTIC
/begin CHARACTERISTIC K_O2_OBD_N_MAX "max. Drehzahl f. O2-Beladung | EN: max. Drehzahl f. O2-Beladung [V912: differs from V452 160E]" VALUE 0x75660 TKW_VV_VV_SW 100.0 FORMULA_0006 0.0 10000.0000 /end CHARACTERISTIC
/begin CHARACTERISTIC K_O2_OBD_N_MIN "min. Drehzahl f. O2-Beladung | EN: Minimum engine speed for O2 loading [Upm]" VALUE 0x75662 TKW_VV_VV_SW 100.0 FORMULA_0006 0.0 10000.0000 /end CHARACTERISTIC
/begin CHARACTERISTIC K_O2_OBD_RF_T_MIN "Verzoegerungszeit bei RF-MIN-Unterschreitung | EN: Delay time when relative charge drops below minimum [s]" VALUE 0x75664 TKW_VV_VV_UW 100.0 FORMULA_1030 0.0 65.5350 FORMAT "%5.2" /end CHARACTERISTIC
/begin CHARACTERISTIC K_O2_OBD_DYN_T_VERZ "Verzoegerungszeit bei Dynamik | EN: Delay time during dynamics [s]" VALUE 0x75666 TKW_VV_VV_UW 100.0 FORMULA_1030 0.0 65.5350 FORMAT "%5.2" /end CHARACTERISTIC
/begin CHARACTERISTIC K_O2_OBD_PUMG_MIN "min. Umgebungsdruck | EN: Minimum ambient pressure [mbar]" VALUE 0x75668 TKW_VV_VV_SW 100.0 FORMULA_0077 400.0000 1200.0000 FORMAT "%4.1" /end CHARACTERISTIC
/begin CHARACTERISTIC K_O2_OBD_LAVK_AD_OFFS_MAX "max. OFFEST-Sonden-Adapt fuer Pulsfreigabe | EN: Maximum sensor offset adaptation for pulse enable [mV]" VALUE 0x7566A TKW_VV_VV_SW 100.0 FORMULA_0532 -5000.0000 5000.0000 /end CHARACTERISTIC
/begin CHARACTERISTIC K_O2_OBD_LAVK_AD_OFFS_MIN "min. OFFEST-Sonden-Adapt. fuer Pulsfreigabe | EN: Minimum sensor offset adaptation for pulse enable [mV]" VALUE 0x7566C TKW_VV_VV_SW 100.0 FORMULA_0532 -5000.0000 5000.0000 /end CHARACTERISTIC
/begin CHARACTERISTIC K_O2_OBD_LAM_SOLL_OFFS "LAM-SOLL-OFFSET - zusaetzliche Anfettung/Abmagerung | EN: Target-lambda offset - additional enrichment/enleanment [V912: differs from V452 160E]" VALUE 0x7566E TKW_VV_VV_SW 100.0 FORMULA_0025 -0.0100 0.0100 FORMAT "%6.3" /end CHARACTERISTIC
/begin CHARACTERISTIC K_KAT_OBD_CFG "Freigabe KAT-Diagnose" VALUE 0x75670 TKW_VV_VV_UW 100.0 FORMULA_0798 0.0 1.0 FORMAT "%5.2" /end CHARACTERISTIC
/begin CHARACTERISTIC K_KAT_OBD_M_HUB_CNT "min. Anzahl - Zwangsanregung | EN: Minimum number - forced excitation" VALUE 0x75672 TKW_VV_VV_UW 100.0 FORMULA_0010 0.0 65535.0000 /end CHARACTERISTIC
/begin CHARACTERISTIC K_KAT_OBD_LANK_MW_MAX "max. Mittelwert LAM-NKAT | EN: max. Mittelwert LAM-NKAT" VALUE 0x75674 TKW_VV_VV_UW 100.0 FORMULA_0025 0.0 3.9990 FORMAT "%6.3" /end CHARACTERISTIC
/begin CHARACTERISTIC K_KAT_OBD_LANK_MW_MIN "min. Mittelwert LAM-NKAT | EN: min. Mittelwert LAM-NKAT" VALUE 0x75676 TKW_VV_VV_UW 100.0 FORMULA_0025 0.0 3.9990 FORMAT "%6.3" /end CHARACTERISTIC
/begin CHARACTERISTIC K_KAT_OBD_LANK_MW_DELTA_MAX "max. Diff d. akt. Wertes zum MW | EN: max. Diff d. akt. Wertes zum MW" VALUE 0x75678 TKW_VV_VV_UW 100.0 FORMULA_0025 0.0 3.9990 FORMAT "%6.3" /end CHARACTERISTIC
/begin CHARACTERISTIC K_KAT_OBD_LANK_MW_DIFF_MAX "max. Diff d. MW zum vorherigen Zyklus | EN: max. Diff d. MW zum vorher i-gen Zyklus" VALUE 0x7567A TKW_VV_VV_UW 100.0 FORMULA_0025 0.0 3.9990 FORMAT "%6.3" /end CHARACTERISTIC
/begin CHARACTERISTIC K_KAT_OBD_ZYKL_CNT_MAX "max. Anzahl fuer Diag.Zyklus | EN: max. Anzahl fuer Diag.Zyklus [V912: differs from V452 160E]" VALUE 0x7567C TKW_VV_VV_UW 100.0 FORMULA_0010 0.0 65535.0000 /end CHARACTERISTIC
/begin CHARACTERISTIC K_KAT_OBD_VERH "Schwelle f. Wichtungsverhaeltnis - Diag.Wert | EN: Schwelle f. Wichtungsverhaeltnis - Diag.Wert [V912: differs from V452 160E]" VALUE 0x7567E TKW_VV_VV_UW 100.0 FORMULA_0075 0.0 20.0000 FORMAT "%6.3" /end CHARACTERISTIC
/begin CHARACTERISTIC K_KAT_OBD_VERH_SCHWELLE "max. Schelle f. Anzahl d. verworfenen Messungen | EN: max. Schelle f. Anzahl d. verworfenen Messungen [V912: differs from V452 160E]" VALUE 0x75680 TKW_VV_VV_UW 100.0 FORMULA_0010 0.0 65535.0000 /end CHARACTERISTIC
/begin CHARACTERISTIC K_KAT_OBD_WERT_MODE6 "max. KAT-Diag.-Schwelle fuer MODE6 | EN: max. KAT-Diag.-Schwelle fuer MODE6 [V912: differs from V452 160E]" VALUE 0x75682 TKW_VV_VV_UW 100.0 FORMULA_0025 0.0 3.9990 FORMAT "%6.3" /end CHARACTERISTIC
/begin CHARACTERISTIC K_KAT_OBD_TABG_T_VERZ "Verzoegerungszeit bei Abgas-Temperaturgradient | EN: Verzoegerungszeit bei A b-gas-Temperaturgradient [V912: differs from V452 160E]" VALUE 0x75684 TKW_VV_VV_UW 100.0 FORMULA_0021 0.0 655.0000 FORMAT "%5.2" /end CHARACTERISTIC
/begin CHARACTERISTIC K_O2_OBD_ML_MIN "min. aufsummierte Luftmassenstr. nach SA_WE | EN: min. aufsummierte Luftmassenstr. nach SA_WE" VALUE 0x75686 TKW_VV_VV_UW 100.0 FORMULA_0832 0.0 65535.0000 /end CHARACTERISTIC
/begin CHARACTERISTIC K_O2_OBD_SA_ML_MAX "max. aufsummierte Luftmassenstr. in SA | EN: max. aufsummierte Luftmassenstr. in SA" VALUE 0x75688 TKW_VV_VV_UW 100.0 FORMULA_0832 0.0 65535.0000 /end CHARACTERISTIC
/begin CHARACTERISTIC K_O2_OBD_WE_ML_MIN "min. aufsum. Luftmassenstr. nach SA_WE f. lange SA | EN: min. aufsum. Luftmassenstr. nach SA_WE f. lange SA" VALUE 0x7568A TKW_VV_VV_UW 100.0 FORMULA_0832 0.0 65535.0000 /end CHARACTERISTIC
/begin CHARACTERISTIC K_O2_OBD_V_MIN "min. Fahrzeuggeschwindigkeit | EN: min. Fahrzeuggeschwindigkeit [V912: differs from V452 160E]" VALUE 0x7568C TKW_VV_VV_SW 100.0 FORMULA_0078 -80.0000 360.0000 FORMAT "%4.1" /end CHARACTERISTIC
/begin CHARACTERISTIC K_O2_OBD_V_MAX "max. Fahrzeuggeschwindigkeit | EN: max. Fahrzeuggeschwindigkeit" VALUE 0x7568E TKW_VV_VV_SW 100.0 FORMULA_0078 -80.0000 360.0000 FORMAT "%4.1" /end CHARACTERISTIC
/begin CHARACTERISTIC K_LAVK_OBD_DYN_CFG "Freigabe dynamische Sonden-VKAT-Diagnose | EN: 0 inaktiv 1 aktiv Freigabe dynamische Sonden -VKAT- Diagnose" VALUE 0x75690 TKW_VV_VV_UW 100.0 FORMULA_0798 0.0 1.0 FORMAT "%5.2" /end CHARACTERISTIC
/begin CHARACTERISTIC K_LAVK_OBD_DYN_MW_HYS "Delta f. min/max LA-Regeleingriff-Ermittlung" VALUE 0x75692 TKW_VV_VV_UW 100.0 FORMULA_0025 0.0 1.9900 FORMAT "%6.3" /end CHARACTERISTIC
/begin CHARACTERISTIC K_LAVK_OBD_DYN_MW_MAX "max. LAM-IST-Toleranzschwelle" VALUE 0x75694 TKW_VV_VV_UW 100.0 FORMULA_0025 0.0 3.9990 FORMAT "%6.3" /end CHARACTERISTIC
/begin CHARACTERISTIC K_LAVK_OBD_DYN_MW_MIN "min. LAM-IST-Toleranzschwelle" VALUE 0x75696 TKW_VV_VV_UW 100.0 FORMULA_0025 0.0 3.9990 FORMAT "%6.3" /end CHARACTERISTIC
/begin CHARACTERISTIC K_LAVK_OBD_DYN_AMPL_MAX "Offset fuer max. Amplitude" VALUE 0x75698 TKW_VV_VV_UW 100.0 FORMULA_0025 0.0 1.0000 FORMAT "%6.3" /end CHARACTERISTIC
/begin CHARACTERISTIC K_LAVK_OBD_DYN_AMPL_MIN "Offset fuer min. Amplitude" VALUE 0x7569A TKW_VV_VV_UW 100.0 FORMULA_0025 0.0 1.0000 FORMAT "%6.3" /end CHARACTERISTIC
/begin CHARACTERISTIC K_LAVK_OBD_DYN_AMPL_CNT "Anzahl gueltiger Perioden f. MW" VALUE 0x7569C TKW_VV_VV_UW 100.0 FORMULA_0010 1.0000 65535.0000 /end CHARACTERISTIC
/begin CHARACTERISTIC K_LAVK_OBD_DYN_NORM_CNT "Anzahl gueltiger MW f. Diagnosewert | EN: Anzahl gueltiger MW f. Diagnosewert Dynamische Diagnose der stetigen Lambdasonde Seite 217 von 629" VALUE 0x7569E TKW_VV_VV_UW 100.0 FORMULA_0010 1.0000 65535.0000 /end CHARACTERISTIC
/begin CHARACTERISTIC K_LAVK_OBD_DYN_LAM_REG_MIN "min. Regelabweichung bei dyn. LA-Diagnose | EN: min. Regelabweichung bei dyn. LA -Diagnose" VALUE 0x756A0 TKW_VV_VV_UW 100.0 FORMULA_0024 0.0 1.9990 FORMAT "%7.4" /end CHARACTERISTIC
/begin CHARACTERISTIC K_LAVK_OBD_DYN_LAM_REG_MAX "max. Regelabweichung bei dyn. LA-Diagnose | EN: max. Regelabweichung bei dyn. LA -Diagnose" VALUE 0x756A2 TKW_VV_VV_UW 100.0 FORMULA_0024 0.0 1.9990 FORMAT "%7.4" /end CHARACTERISTIC
/begin CHARACTERISTIC K_O2_OBD_T_ML "Verzoegerungszeit - O2-Beladung | EN: Verzoegerungszeit - O2-Beladung [V912: differs from V452 160E]" VALUE 0x756A4 TKW_VV_VV_UW 100.0 FORMULA_0799 0.0 65535.0000 /end CHARACTERISTIC
/begin CHARACTERISTIC K_LAVK_OBD_DYN_KAT_EXD_N_SOLL "Prueflauf - angeforderte Drehzahl | EN: Prueflauf - angeforderte Drehzahl" VALUE 0x756A6 TKW_VV_VV_SW 100.0 FORMULA_0006 0.0 10000.0000 /end CHARACTERISTIC
/begin CHARACTERISTIC K_LAVK_OBD_DYN_KAT_EXD_T "Prueflauf Freigabezeit | EN: Prueflauf Freigabezeit" VALUE 0x756A8 TKW_VV_VV_UW 100.0 FORMULA_0932 0.0 655.3500 /end CHARACTERISTIC
/begin CHARACTERISTIC K_LAVK_OBD_DYN_KAT_EXD_RF_MAX "max. relative F�llung fuer Ansteuerung dyn. Diag. u. KAT-Diag. | EN: max. relative Füllung fuer Ansteuer ung dyn. Diag. u. KAT-Diag." VALUE 0x756AA TKW_VV_VV_SW 100.0 FORMULA_0007 0.0 2.0000 FORMAT "%6.3" /end CHARACTERISTIC
/begin CHARACTERISTIC K_LAVK_OBD_DYN_KAT_EXD_RF_MIN "min. relative F�llung fuer Ansteuerung dyn. Diag. u. KAT-Diag. | EN: min. relative Füllung fuer Ansteuerung dyn. Diag. u. KAT-Diag." VALUE 0x756AC TKW_VV_VV_SW 100.0 FORMULA_0007 0.0 2.0000 FORMAT "%6.3" /end CHARACTERISTIC
/begin CHARACTERISTIC K_LAVK_OBD_DYN_KAT_EXD_LAM_SOLL "LAM-SOLL-OFFSET - zusaetzliche Anfettung/Abmagerung | EN: LAM-SOLL-OFFSET-zusätzliche Anfettung/Abmagerung" VALUE 0x756AE TKW_VV_VV_SW 100.0 FORMULA_0025 -0.1000 0.1000 FORMAT "%6.3" /end CHARACTERISTIC
/begin CHARACTERISTIC K_LAVK_OBD_DYN_KAT_EXD_FETT_LAM_SOLL "LAM-SOLL-OFFSET - um NKAT-Signal nach FETT vor Diagnose zu bringen | EN: LAM-SOLL-OFFSET-um NKAT -Signal nach FETT vor Diagnose zu bringen" VALUE 0x756B0 TKW_VV_VV_SW 100.0 FORMULA_0025 -0.2000 0.2000 FORMAT "%6.3" /end CHARACTERISTIC
/begin CHARACTERISTIC K_LAVK_OBD_DYN_KAT_EXD_LANK_FETT "FETT-Schwelle fuer Freigabe KAT/dyn.Sondendiag. bei ext. Ansteuerung | EN: FETT-Schelle für Freigabe KAT/ dyn.Sondendiag. bei ext. Ansteuerung" VALUE 0x756B2 TKW_VV_VV_UW 100.0 FORMULA_0532 0.0 1200.0000 /end CHARACTERISTIC
/begin CHARACTERISTIC K_O2_OBD_DYN_DELTA_RF "rf Differenz fuer Dynamikerkennung | EN: rf Differnez fuer Dynamikerkennung" VALUE 0x756B4 TKW_VV_VV_SW 100.0 FORMULA_0007 0.0 2.0000 FORMAT "%6.3" /end CHARACTERISTIC
/begin CHARACTERISTIC K_O2_OBD_DYN_DELTA_PUMP_RF "rf Differenz fuer Dynamikerkennung gegen Pumpen | EN: rf Differnez fuer Dynamikerkennung gegen Pumpen" VALUE 0x756B6 TKW_VV_VV_SW 100.0 FORMULA_0007 0.0 2.0000 FORMAT "%6.3" /end CHARACTERISTIC
/begin CHARACTERISTIC K_O2_OBD_DYN_DELTA_CNT "Anzahl der dyn Triggers bis status gesetzt wird | EN: Anzahl der dyn Triggers bis status gesetzt wird" VALUE 0x756B8 TKW_VV_VV_UW 100.0 FORMULA_0083 0.0 65535.0000 FORMAT "%5.2" /end CHARACTERISTIC
/begin CHARACTERISTIC K_O2_OBD_DYN_CNT_INC "Counter increments fuer rf_dyn_o2_cnt | EN: Counter increments fuer rf_dyn_o2_cnt" VALUE 0x756BA TKW_VV_VV_UB 100.0 FORMULA_0033 0.0 255.0000 /end CHARACTERISTIC
/begin CHARACTERISTIC K_O2_OBD_DYN_RF_T "Sperrzeit fuer Ruecknahme rf-Dynamik | EN: Sperrzeit fuer Ruecknahme rf-Dynamik" VALUE 0x756BC TKW_VV_VV_UW 100.0 FORMULA_0021 0.0 655.3500 FORMAT "%5.2" /end CHARACTERISTIC
/begin CHARACTERISTIC K_O2_OBD_TEV_MAX "max. Konzentration aus AKF | EN: max. Konzentration aus AKF [V912: differs from V452 160E]" VALUE 0x756BE TKW_VV_VV_UW 100.0 FORMULA_0556 0.0 2.0000 FORMAT "%7.4" /end CHARACTERISTIC
/begin CHARACTERISTIC K_LAVK_OBD_DYN_WERT_MODE6 "Diagnoseschwelle fuer MODE6 | EN: Diagnoseschwelle fuer MODE6" VALUE 0x756C0 TKW_VV_VV_UW 100.0 FORMULA_0025 0.0 3.9990 FORMAT "%6.3" /end CHARACTERISTIC
/begin CHARACTERISTIC K_LAVK_OBD_DYN_TE_VOL_SUM "min. TE-Volumenstrom in Motorlauf | EN: Min. TE-Volumenstrom in Motorlauf [V912: differs from V452 160E]" VALUE 0x756C2 TKW_VV_VV_UW 100.0 FORMULA_1031 0.0 2184.5000 FORMAT "%5.2" /end CHARACTERISTIC
/begin CHARACTERISTIC K_KAT_OBD_LANK_MW_HYS_CHK1 "Hys. um kat_obd_lank_mw f. Verifikation CHK1 | EN: Hys. um kat_obd_lank_mw f. Verifikation CHK1" VALUE 0x756C4 TKW_VV_VV_UW 100.0 FORMULA_0025 0.0 0.0100 FORMAT "%6.3" /end CHARACTERISTIC
/begin CHARACTERISTIC KL_O2_OBD_RF_MIN "min. relative F�llung f. O2-Beladung | EN: min. relative Füllung f. O2 -Beladung" CURVE 0x756C6 TKL_SW_VV_SW 100.0 FORMULA_0007 0.0 2.0000 /begin AXIS_DESCR STD_AXIS FORMULA_0006 5 0.0 10000.0000 /end AXIS_DESCR FORMAT "%6.3" /end CHARACTERISTIC
/begin CHARACTERISTIC KL_KAT_OBD_IO_VERZ "Verzoegerung d. Heilung abh. vom Diag.Wert | EN: Delay of healing depending on diagnosis value" CURVE 0x756DC TKL_UW_VV_UW 100.0 FORMULA_0021 0.0 655.0000
 /begin AXIS_DESCR STD_AXIS kat_obd_wert_nv FORMULA_0025 5 0.0 3.9990 FORMAT "%6.3" /end AXIS_DESCR
 FORMAT "%5.2" /end CHARACTERISTIC
/begin CHARACTERISTIC KL_LAVK_OBD_DYN_IO_VERZ "Verzoegerung d. Heilung abh. vom Diag.Wert | EN: Delay of healing depending on diagnosis value" CURVE 0x756F2 TKL_UW_VV_UW 100.0 FORMULA_0021 0.0 655.0000
 /begin AXIS_DESCR STD_AXIS lavk_obd_dyn_wert_nv FORMULA_0025 5 0.0 3.9990 FORMAT "%6.3" /end AXIS_DESCR
 FORMAT "%5.2" /end CHARACTERISTIC
/begin CHARACTERISTIC KL_LAVK_OBD_DYN_WERT_MAX "Diagnoseschwelle - dyn. Sondendiagnose | EN: Diagnosis threshold - dynamic sensor diagnosis" CURVE 0x75708 TKL_UW_VV_UW 100.0 FORMULA_0025 0.0 3.9990 /begin AXIS_DESCR STD_AXIS FORMULA_0556 4 0.0 2.0000 FORMAT "%7.4" /end AXIS_DESCR FORMAT "%6.3" /end CHARACTERISTIC
/begin CHARACTERISTIC KL_LAVK_OBD_DYN_RF_MIN "min. relative F�llung f. dyn. Sondendiag. | EN: Minimum relative charge for dynamic sensor diagnosis" CURVE 0x7571A TKL_SW_VV_SW 100.0 FORMULA_0007 0.0 2.0000 /begin AXIS_DESCR STD_AXIS FORMULA_0006 5 0.0 10000.0000 /end AXIS_DESCR FORMAT "%6.3" /end CHARACTERISTIC
/begin CHARACTERISTIC KL_KAT_OBD_WERT_MAX "Diagnoseschwelle - max. KAT-Diag. | EN: Diagnoseschwelle - max. KAT-Diag. [V912: differs from V452 160E]" CURVE 0x75730 TKL_UW_VV_UW 100.0 FORMULA_0025 0.0 3.9990 /begin AXIS_DESCR STD_AXIS FORMULA_0556 4 0.0 2.0000 FORMAT "%7.4" /end AXIS_DESCR FORMAT "%6.3" /end CHARACTERISTIC
/begin CHARACTERISTIC KL_KAT_OBD_GESAMT_MAX "Diagnoseschwelle - Gesamtsystem-KAT-Diag. | EN: Diagnoseschwelle - Gesamt-system-KAT-Diag. [V912: differs from V452 160E]" CURVE 0x75742 TKL_UW_VV_UW 100.0 FORMULA_0025 0.0 3.9990 /begin AXIS_DESCR STD_AXIS FORMULA_0556 4 0.0 2.0000 FORMAT "%7.4" /end AXIS_DESCR FORMAT "%6.3" /end CHARACTERISTIC
/begin CHARACTERISTIC KL_LAVK_OBD_DYN_GESAMT_MAX "Diagnoseschwelle - Gesamtsystem-dyn. Sonden-Diag." CURVE 0x75754 TKL_UW_VV_UW 100.0 FORMULA_0025 0.0 3.9990 /begin AXIS_DESCR STD_AXIS FORMULA_0556 4 0.0 2.0000 FORMAT "%7.4" /end AXIS_DESCR FORMAT "%6.3" /end CHARACTERISTIC
/begin CHARACTERISTIC KF_KAT_OBD_INT_WICHT "Wichtungskennfeld | EN: Wichtungskennfeld" MAP 0x75766 TKF_SW_SW_UW 100.0 FORMULA_0075 0.0 2.0000 /begin AXIS_DESCR STD_AXIS FORMULA_0006 6 0.0 10000.0000 /end AXIS_DESCR /begin AXIS_DESCR STD_AXIS rf FORMULA_0007 6 0.0 2.0000 FORMAT "%6.3" /end AXIS_DESCR FORMAT "%6.3" /end CHARACTERISTIC
/begin CHARACTERISTIC KF_KAT_OBD_WICHT_GESAMT "Ermittlung - Gesamtsystemdiagnosewert | EN: Determination - overall system diagnosis value" MAP 0x757C8 TKF_UW_UW_UW 100.0 FORMULA_0025 0.0 3.9990
 /begin AXIS_DESCR STD_AXIS kat_obd_wert_b1 FORMULA_0025 10 0.0 3.9990 FORMAT "%6.3" /end AXIS_DESCR
 /begin AXIS_DESCR STD_AXIS kat_obd_wert_b2 FORMULA_0025 10 0.0 3.9990 FORMAT "%6.3" /end AXIS_DESCR
 FORMAT "%6.3" /end CHARACTERISTIC
/begin CHARACTERISTIC KF_LAVK_OBD_DYN_AMPL_MAX "max. zulaessige Amplitude" MAP 0x758BA TKF_SW_SW_UW 100.0 FORMULA_0025 0.0 1.0000 /begin AXIS_DESCR STD_AXIS FORMULA_0006 6 0.0 10000.0000 /end AXIS_DESCR /begin AXIS_DESCR STD_AXIS rf FORMULA_0007 6 0.0 2.0000 FORMAT "%6.3" /end AXIS_DESCR FORMAT "%6.3" /end CHARACTERISTIC
/begin CHARACTERISTIC KF_LAVK_OBD_DYN_AMPL_MIN "min. zulaessige Amplitude" MAP 0x7591C TKF_SW_SW_UW 100.0 FORMULA_0025 0.0 1.0000 /begin AXIS_DESCR STD_AXIS FORMULA_0006 6 0.0 10000.0000 /end AXIS_DESCR /begin AXIS_DESCR STD_AXIS rf FORMULA_0007 6 0.0 2.0000 FORMAT "%6.3" /end AXIS_DESCR FORMAT "%6.3" /end CHARACTERISTIC
/begin CHARACTERISTIC KF_LAVK_OBD_DYN_WICHT_GESAMT "Ermittlung - Gesamtsystemdiagnosewert | EN: Determination - overall system diagnosis value" MAP 0x7597E TKF_UW_UW_UW 100.0 FORMULA_0025 0.0 3.9990
 /begin AXIS_DESCR STD_AXIS lavk_obd_dyn_wert_b1 FORMULA_0025 10 0.0 3.9990 FORMAT "%6.3" /end AXIS_DESCR
 /begin AXIS_DESCR STD_AXIS lavk_obd_dyn_wert_b2 FORMULA_0025 10 0.0 3.9990 FORMAT "%6.3" /end AXIS_DESCR
 FORMAT "%6.3" /end CHARACTERISTIC
/begin FUNCTION Lambda ""
 /begin DEF_CHARACTERISTIC KF_LAM_REG_K KF_LAM_REG_KORR_F KF_LAM_REG_WF_MKS_REL_MAX KF_LAM_REG_WF_VERZ_F KF_LAM_SOLL_ADD_KONV KF_LAM_SOLL_ADD_NEG_OBD KF_LAM_SOLL_ADD_POS_OBD KF_LAM_SOLL_AUSS_KATS KF_LAM_SOLL_AUSS_OFFS KF_LAM_SOLL_GRUND KF_LAM_SOLL_GRUND_PST KF_LAM_SOLL_KR_KATS_OFFS KF_LAM_SOLL_MS_KAT_SOLL_MAX KF_LAM_SOLL_MS_KAT_SOLL_MIN KF_LAM_SOLL_MS_KAT_SOLL_MIN_OBD KF_LAM_SOLL_PULS_OFFS_AUSR KF_LAM_SOLL_TAU1_ABG KF_LAM_SOLL_WL KF_LAM_SOLL_WL_F KF_LAVK_FILT_T1 KL_LAM_IST KL_LAM_SOLL_ADD_KAT_ALT_F KL_LAM_SOLL_AUSS_F KL_LAM_SOLL_MS_KAT_MAX KL_LAM_SOLL_MS_KAT_SOLL_HYS KL_LAM_SOLL_PULS_ADD_OBD KL_LAM_SOLL_PULS_PW_OBD KL_LAM_SOLL_START KL_LAM_SOLL_VL KL_LAVK_IST_F KL_LAVK_IST_OFFS KL_LAVK_P_KORR_F_FETT KL_LAVK_P_KORR_F_MAGER KL_LAVK_T_KORR_F K_LAA_CFG K_LAA_F_GRAD K_LAA_F_MAX K_LAA_F_MCS_B1 K_LAA_F_MCS_B2 K_LAA_F_MIN K_LAA_F_N_MAX K_LAA_F_N_MIN K_LAA_F_RF_MAX K_LAA_F_RF_MIN K_LAA_F_TE_GRAD K_LAA_F_TE_MAX K_LAA_F_TE_MIN K_LAA_F_TE_N_MAX K_LAA_F_TE_RAMPE K_LAA_F_TE_RF_MAX K_LAA_F_TE_T_ADAPT K_LAA_F_T_ADAPT K_LAA_LAM_REG_F_DELTA K_LAA_OFFS_GRAD K_LAA_OFFS_MAX K_LAA_OFFS_MCS_B1 K_LAA_OFFS_MCS_B2 K_LAA_OFFS_MIN K_LAA_OFFS_N_MAX K_LAA_OFFS_RF_MAX K_LAA_OFFS_T_ADAPT K_LAA_PKS_MAX K_LAA_RESET_CFG K_LAA_TAN_MAX K_LAA_TI_IST_MIN K_LAA_TMOT_MIN K_LAM_DIAG_CFG K_LAM_DIAG_LAA_F_HYS K_LAM_DIAG_LAA_IO_T K_LAM_DIAG_LAA_OFFS_HYS K_LAM_DIAG_LAA_T K_LAM_DIAG_REG_T K_LAM_REG_CFG K_LAM_REG_DELTA_MAX K_LAM_REG_DELTA_MIN K_LAM_REG_DELTA_STAT_MAX K_LAM_REG_DELTA_STAT_MAX_TE K_LAM_REG_DELTA_STAT_TRIM K_LAM_REG_F_MAX K_LAM_REG_F_MIN K_LAM_REG_IST_MW_MAX K_LAM_REG_IST_MW_MIN K_LAM_REG_RESET_CFG K_LAM_REG_RESET_SA_TMOT_MIN K_LAM_REG_SOLL_MAX K_LAM_REG_SOLL_MIN K_LAM_REG_START_TIME K_LAM_REG_TI_IST_MIN K_LAM_REG_TN_TU_F K_LAM_REG_TV_TU_F K_LAM_REG_T_SA_VERZ K_LAM_REG_T_SLP_VERZ K_LAM_SEGM_V214_FAK2 K_LAM_SOLL_ADD_KONV_GRAD K_LAM_SOLL_FETT_ERK K_LAM_SOLL_FILT_F K_LAM_SOLL_KATH_DELTA_NEG K_LAM_SOLL_KATH_DELTA_POS K_LAM_SOLL_KATH_T_ML_MAX K_LAM_SOLL_KONV_CFG K_LAM_SOLL_KR_KATS K_LAM_SOLL_MAX K_LAM_SOLL_MIN K_LAM_SOLL_MS_KAT_F_OBD K_LAM_SOLL_MS_KAT_MIN K_LAM_SOLL_MS_KAT_OFFSET_OBD K_LAM_SOLL_MS_KAT_SOLL_MAX_OBD K_LAM_SOLL_O2_ANT K_LAM_SOLL_OFFS_MCS K_LAM_SOLL_PULS_AUSR_CFG K_LAM_SOLL_PULS_AUSR_SL_CFG K_LAM_SOLL_PULS_AUSR_SL_T K_LAM_SOLL_PULS_LANK_CFG K_LAM_SOLL_PULS_LANK_MAX K_LAM_SOLL_PULS_LANK_MIN K_LAM_SOLL_PULS_O2_HYST K_LAM_SOLL_T_FETT_MIN K_LAM_SOLL_T_SA_SLP_MIN K_LAM_SOLL_WL_DELTA_NEG K_LAM_SOLL_WL_DELTA_POS K_LAM_SOLL_WL_TMOT_HYS K_LAM_SOLL_WL_TMOT_MAX K_LAVK_AD_GAIN_CNT K_LAVK_AD_GAIN_CNT_MIN K_LAVK_AD_GAIN_GRAD K_LAVK_AD_GAIN_MIN K_LAVK_AD_GAIN_ML_MIN K_LAVK_AD_GAIN_NV_MAX K_LAVK_AD_GAIN_NV_MIN K_LAVK_AD_GAIN_T K_LAVK_AD_GAIN_T1 K_LAVK_AD_MAX K_LAVK_AD_MIN K_LAVK_AD_OFFS_CNT K_LAVK_AD_OFFS_CNT_MIN K_LAVK_AD_OFFS_CNT_MIN_MS K_LAVK_AD_OFFS_CNT_MS K_LAVK_AD_OFFS_GRAD K_LAVK_AD_OFFS_MAX K_LAVK_AD_OFFS_MIN K_LAVK_AD_OFFS_NV_MAX K_LAVK_AD_OFFS_NV_MIN K_LAVK_AD_OFFS_T K_LAVK_AD_OFFS_T1 K_LAVK_AD_RESET K_LAVK_AD_TEST K_LAVK_ATIC42_ICP_ENABLE_B1 K_LAVK_ATIC42_ICP_ENABLE_B2 K_LAVK_ATIC42_ICP_VALUE_B1 K_LAVK_ATIC42_ICP_VALUE_B2 K_LAVK_ATIC42_PIN_CFG_B1 K_LAVK_ATIC42_PIN_CFG_B2 K_LAVK_ATIC42_PROTEC_TIME_B1 K_LAVK_ATIC42_PROTEC_TIME_B2 K_LAVK_ATIC42_RI_MEAS_FREQ_B1 K_LAVK_ATIC42_RI_MEAS_FREQ_B2 K_LAVK_ATIC42_RI_OSCI_B1 K_LAVK_ATIC42_RI_OSCI_B2 K_LAVK_ATIC42_SENSOR_B1 K_LAVK_ATIC42_SENSOR_B2 K_LAVK_ATIC42_SPI_DIAG_CNT K_LAVK_FILT_CFG K_LAVK_GAIN_LAM_SCHW K_LAVK_R7 K_LAVK_US_LUFT_REF K_LAVK_US_REF /end DEF_CHARACTERISTIC
 /begin REF_CHARACTERISTIC /end REF_CHARACTERISTIC
 /begin IN_MEASUREMENT /end IN_MEASUREMENT
 /begin OUT_MEASUREMENT /end OUT_MEASUREMENT
/end FUNCTION
/begin FUNCTION Lambda-NK ""
 /begin DEF_CHARACTERISTIC KF_LANK_OBD_S_LAM_SOLL KF_LANK_US_TAU_L KL_KAT_OBD_LANK_LAM KL_LANK_OBD_SLOPE_ML_T KL_LANK_OBD_S_WE_ML_SUM K_LANK_DIAG_CFG K_LANK_DIAG_GND_T K_LANK_DIAG_MAX_T K_LANK_DIAG_OL_LAM_SOLL_M K_LANK_DIAG_OL_MAGER_CNT K_LANK_DIAG_OL_MAGER_T K_LANK_DIAG_OL_ML_MIN K_LANK_DIAG_OL_ML_STABIL_T K_LANK_DIAG_OL_N_MAX K_LANK_DIAG_OL_N_MIN K_LANK_DIAG_OL_T K_LANK_DIAG_SONDTEMP K_LANK_DIAG_STAB_T K_LANK_DIAG_TKAT K_LANK_DIAG_UMAX K_LANK_DIAG_UMIN K_LANK_DIAG_VK_REG_T K_LANK_FETT K_LANK_MAGER K_LANK_N_MAX K_LANK_N_MIN K_LANK_OBD_SLOPE_CNT K_LANK_OBD_SLOPE_CNT_IO K_LANK_OBD_SLOPE_F_MAX K_LANK_OBD_SLOPE_F_MIN K_LANK_OBD_SLOPE_HYS K_LANK_OBD_SLOPE_NASE_CNT K_LANK_OBD_SLOPE_T_MAX_MODE5 K_LANK_OBD_SLOPE_T_MIN_MODE5 K_LANK_OBD_S_AUTOM_CNT K_LANK_OBD_S_CFG K_LANK_OBD_S_CNT K_LANK_OBD_S_LAM_VKAT K_LANK_OBD_S_NMAX K_LANK_OBD_S_NMIN K_LANK_OBD_S_SA_AUTOM K_LANK_OBD_S_SA_ML_SUM K_LANK_OBD_S_SA_T K_LANK_OBD_S_SA_T_MAX_MODE6 K_LANK_OBD_S_SA_T_MIN_MODE6 K_LANK_OBD_S_SA_T_MODE6_FALSE K_LANK_OBD_S_SA_US K_LANK_OBD_S_SA_WE_T K_LANK_OBD_S_TML K_LANK_OBD_S_USF_SA K_LANK_OBD_S_USF_SLOPE_MAX K_LANK_OBD_S_USF_WE K_LANK_OBD_S_VL_T K_LANK_OBD_S_VL_US K_LANK_OBD_S_WE_CNT K_LANK_OBD_S_WE_LAM_T K_LANK_OBD_S_WE_T K_LANK_OBD_S_WE_US K_LANK_RF_MAX K_LANK_RF_MIN K_LANK_TKAT_SCHW K_LANK_T_AUS K_LANK_T_EIN K_LANK_USF K_LANK_USM K_LANK_US_FILT_OB K_LANK_US_FILT_T K_LANK_US_FILT_UNT K_LANK_US_TAU K_LANK_US_TAU_S /end DEF_CHARACTERISTIC
 /begin REF_CHARACTERISTIC /end REF_CHARACTERISTIC
 /begin IN_MEASUREMENT /end IN_MEASUREMENT
 /begin OUT_MEASUREMENT /end OUT_MEASUREMENT
/end FUNCTION
/begin FUNCTION M-Drive ""
 /begin DEF_CHARACTERISTIC K_MDRV_ALBV K_MDRV_CFG K_MDRV_CFG_P400 K_MDRV_DSC K_MDRV_EDCK K_MDRV_ENG K_MDRV_HUD K_MDRV_MOD_SMG K_MDRV_P400_ONLY K_MDRV_P500_START K_MDRV_PTH_CNT_MAX K_MDRV_STG_SMG K_MDRV_TBLINK /end DEF_CHARACTERISTIC
 /begin REF_CHARACTERISTIC /end REF_CHARACTERISTIC
 /begin IN_MEASUREMENT /end IN_MEASUREMENT
 /begin OUT_MEASUREMENT /end OUT_MEASUREMENT
/end FUNCTION
/begin FUNCTION MSA "" /begin DEF_CHARACTERISTIC K_MSA_Kl15OFF_T_LOW /end DEF_CHARACTERISTIC /begin REF_CHARACTERISTIC /end REF_CHARACTERISTIC /begin IN_MEASUREMENT /end IN_MEASUREMENT /begin OUT_MEASUREMENT /end OUT_MEASUREMENT /end FUNCTION
/begin FUNCTION MZYL ""
 /begin DEF_CHARACTERISTIC KF_MZYL_ADAPT_GEW KF_MZYL_ADAPT_RAMPE_DOWN KF_MZYL_ADAPT_RAMPE_UP KL_MZYL_EV_A_MEAN KL_MZYL_PZYL_DP KL_MZYL_PZYL_DP_F K_MZYL_CFG K_MZYL_EV_RUECK K_MZYL_EV_RUECK_TMAX K_MZYL_HFM_AQ_MAX_FAK K_MZYL_HFM_AQ_MIN_FAK K_MZYL_R K_MZYL_START_CFG K_MZYL_T_CFG /end DEF_CHARACTERISTIC
 /begin REF_CHARACTERISTIC /end REF_CHARACTERISTIC
 /begin IN_MEASUREMENT /end IN_MEASUREMENT
 /begin OUT_MEASUREMENT /end OUT_MEASUREMENT
/end FUNCTION
/begin FUNCTION Mastervac ""
 /begin DEF_CHARACTERISTIC KF_MVAC_ELUP_ETA KL_MVAC_BRP_GRAD KL_MVAC_ELUP KL_MVAC_ML_WICHT KL_MVAC_PDIFF_B KL_MVAC_PDIFF_SA K_MVAC_AL_BLS K_MVAC_AL_LECK K_MVAC_AL_SRMV K_MVAC_AL_UMMV_STAT K_MVAC_BRPGRAD_SW K_MVAC_BRP_GRAD_RAMPE K_MVAC_DEL_BLS K_MVAC_DEL_RSV K_MVAC_ELUP_ST_DEL K_MVAC_HYS_MAX K_MVAC_HYS_MIN K_MVAC_MLRF_SR_SPERRE K_MVAC_ML_AEB_NEG K_MVAC_ML_AEB_POS K_MVAC_ML_CFG K_MVAC_ML_INTEGRATOR_TAU K_MVAC_ML_MIN K_MVAC_ML_SR_MAX K_MVAC_ML_SR_MIN K_MVAC_ML_TAU K_MVAC_N_MIN_B K_MVAC_N_MIN_SA K_MVAC_PDIFF_FILTER_TAU K_MVAC_PDIFF_UM_BEGR_MAX K_MVAC_PDIFF_UM_BEGR_MIN K_MVAC_PL_PDIFF K_MVAC_PL_P_IO_SW K_MVAC_PL_TIME_LIMIT K_MVAC_PL_TIME_MS K_MVAC_P_DIAG_MAX K_MVAC_P_DIAG_MIN K_MVAC_P_OBD_LL_TIME_MIN K_MVAC_P_OBD_PDIFF_DELAY K_MVAC_P_OBD_PDIFF_NEG K_MVAC_P_OBD_PDIFF_POS K_MVAC_P_OBD_PDIFF_ROH_TAU K_MVAC_P_OBD_PDIFF_TAU K_MVAC_P_OBD_PDIFF_TMOT K_MVAC_P_OBD_SA_TIME_MIN K_MVAC_P_OBD_TIME_ML K_MVAC_P_SENSOR_OFFSET K_MVAC_P_SENSOR_STEIGUNG K_MVAC_P_TAU K_MVAC_RMP_FKT_SA_BEGR K_MVAC_V /end DEF_CHARACTERISTIC
 /begin REF_CHARACTERISTIC /end REF_CHARACTERISTIC
 /begin IN_MEASUREMENT /end IN_MEASUREMENT
 /begin OUT_MEASUREMENT /end OUT_MEASUREMENT
/end FUNCTION
/begin FUNCTION Message-Kanal "" /begin DEF_CHARACTERISTIC /end DEF_CHARACTERISTIC /begin REF_CHARACTERISTIC /end REF_CHARACTERISTIC /begin IN_MEASUREMENT /end IN_MEASUREMENT /begin OUT_MEASUREMENT /end OUT_MEASUREMENT /end FUNCTION
/begin FUNCTION NO_FUNCTION ""
 /begin DEF_CHARACTERISTIC KF_IERRGREHT KF_TANSGENKO KF_UFDIODE KL_RTHJADIOD KL_TCHIPOFFS KL_TMAXDIODE K_BNS_VFZG K_TCHIPFIL K_TDUBFZMN K_TLCHTEP S_HTDETEC /end DEF_CHARACTERISTIC
 /begin REF_CHARACTERISTIC /end REF_CHARACTERISTIC
 /begin IN_MEASUREMENT /end IN_MEASUREMENT
 /begin OUT_MEASUREMENT /end OUT_MEASUREMENT
/end FUNCTION
/begin FUNCTION NWM "" /begin DEF_CHARACTERISTIC /end DEF_CHARACTERISTIC /begin REF_CHARACTERISTIC /end REF_CHARACTERISTIC /begin IN_MEASUREMENT /end IN_MEASUREMENT /begin OUT_MEASUREMENT /end OUT_MEASUREMENT /end FUNCTION
/begin FUNCTION OBD ""
 /begin DEF_CHARACTERISTIC KF_KAT_OBD_INT_WICHT KF_KAT_OBD_WICHT_GESAMT KF_LAVK_OBD_DYN_AMPL_MAX KF_LAVK_OBD_DYN_AMPL_MIN KF_LAVK_OBD_DYN_WICHT_GESAMT KL_KAT_OBD_GESAMT_MAX KL_KAT_OBD_IO_VERZ KL_KAT_OBD_WERT_MAX KL_LAVK_OBD_DYN_GESAMT_MAX KL_LAVK_OBD_DYN_IO_VERZ KL_LAVK_OBD_DYN_RF_MIN KL_LAVK_OBD_DYN_WERT_MAX KL_O2_OBD_RF_MIN K_KAT_OBD_CFG K_KAT_OBD_LANK_MW_DELTA_MAX K_KAT_OBD_LANK_MW_DIFF_MAX K_KAT_OBD_LANK_MW_HYS_CHK1 K_KAT_OBD_LANK_MW_MAX K_KAT_OBD_LANK_MW_MIN K_KAT_OBD_M_HUB_CNT K_KAT_OBD_TABG_T_VERZ K_KAT_OBD_VERH K_KAT_OBD_VERH_SCHWELLE K_KAT_OBD_WERT_MODE6 K_KAT_OBD_ZYKL_CNT_MAX K_LAVK_OBD_DYN_AMPL_CNT K_LAVK_OBD_DYN_AMPL_MAX K_LAVK_OBD_DYN_AMPL_MIN K_LAVK_OBD_DYN_CFG K_LAVK_OBD_DYN_KAT_EXD_FETT_LAM_SOLL K_LAVK_OBD_DYN_KAT_EXD_LAM_SOLL K_LAVK_OBD_DYN_KAT_EXD_LANK_FETT K_LAVK_OBD_DYN_KAT_EXD_N_SOLL K_LAVK_OBD_DYN_KAT_EXD_RF_MAX K_LAVK_OBD_DYN_KAT_EXD_RF_MIN K_LAVK_OBD_DYN_KAT_EXD_T K_LAVK_OBD_DYN_LAM_REG_MAX K_LAVK_OBD_DYN_LAM_REG_MIN K_LAVK_OBD_DYN_MW_HYS K_LAVK_OBD_DYN_MW_MAX K_LAVK_OBD_DYN_MW_MIN K_LAVK_OBD_DYN_NORM_CNT K_LAVK_OBD_DYN_TE_VOL_SUM K_LAVK_OBD_DYN_WERT_MODE6 K_O2_LA_TRIM_CFG K_O2_OBD_CFG K_O2_OBD_DYN_CNT_INC K_O2_OBD_DYN_DELTA_CNT K_O2_OBD_DYN_DELTA_PUMP_RF K_O2_OBD_DYN_DELTA_RF K_O2_OBD_DYN_RF_T K_O2_OBD_DYN_T_VERZ K_O2_OBD_LAM_SOLL_OFFS K_O2_OBD_LAVK_AD_OFFS_MAX K_O2_OBD_LAVK_AD_OFFS_MIN K_O2_OBD_ML_MIN K_O2_OBD_N_MAX K_O2_OBD_N_MIN K_O2_OBD_PUMG_MIN K_O2_OBD_RF_MAX K_O2_OBD_RF_MIN_HYS K_O2_OBD_RF_T_MIN K_O2_OBD_SA_ML_MAX K_O2_OBD_TEV_MAX K_O2_OBD_TKAT_HYS K_O2_OBD_TKAT_MAX K_O2_OBD_TKAT_MIN K_O2_OBD_TMOT K_O2_OBD_T_ML K_O2_OBD_V_MAX K_O2_OBD_V_MIN K_O2_OBD_WE_ML_MIN /end DEF_CHARACTERISTIC
 /begin REF_CHARACTERISTIC /end REF_CHARACTERISTIC
 /begin IN_MEASUREMENT /end IN_MEASUREMENT
 /begin OUT_MEASUREMENT /end OUT_MEASUREMENT
/end FUNCTION
/begin FUNCTION Oelsensor-Module ""
 /begin DEF_CHARACTERISTIC KF_OZDREHKOR KF_OZDREHKOR_EINFAHR KF_OZKORRNIV KF_OZKORRORI KF_OZZEIT KL_OZBEFKL KL_OZKRZMW2 KL_OZLBNIV KL_OZLN KL_OZNFDELTA KL_OZORBERO KL_OZPERMKL KL_OZQBNIV KL_OZSTNIV KL_OZTEMPKL KL_OZVERDFAK KL_PERREFTKOR KL_TKTOENIV KL_TVTOEL K_CW_OZ K_CW_OZ_2 K_CW_OZ_PERM K_DTOG_UBMIN K_NACHFUELL12 K_NACHFUELL25 K_NACHFUELL38 K_NACHFUELL53 K_NACHFUELL69 K_NACHFUELL85 K_NACHFUELL95 K_OZABSTELL K_OZALTANZABZ K_OZANFANZ K_OZBESCHAUS K_OZBZKMSTK1 K_OZDAEMPF K_OZDELTOE K_OZDIAGNMOT K_OZDIAGNMOT2 K_OZDIAGSPG K_OZDKNIVN K_OZERRD K_OZHEAL K_OZKMMAXK11 K_OZKMUPL K_OZKVB96 K_OZKVB96A K_OZKVBMXK18 K_OZKVBOK16 K_OZLBESCHN K_OZLBESCHORI K_OZLBESCHP K_OZLBESCHST K_OZLF1 K_OZLF2 K_OZLUFTMAX K_OZMAXSLOPE K_OZMINSLOPE K_OZMNKMBO K_OZMWK K_OZMWL K_OZMWOR K_OZMWV K_OZMXOHK15 K_OZNFERR K_OZNFML K_OZNFOELCKO K_OZNFOELCOK K_OZNIVKL K_OZNMOTMAX K_OZNMOTMIN K_OZOELCABZ K_OZOELCOK K_OZOELCVERZ K_OZOELMEN K_OZOELVERB K_OZORIPEILTZO K_OZORIPEILTZU K_OZPEIL12 K_OZPEIL25 K_OZPEIL38 K_OZPEIL53 K_OZPEIL69 K_OZPEIL85 K_OZPEILDO K_OZPEILDOMIN K_OZPEILDU K_OZPEILDU38 K_OZPEILERR K_OZPEILKSPR K_OZPEILLP85 K_OZPEILML K_OZPEILOELCKO K_OZPEILOELCOK K_OZPEILSPRUNG K_OZPERBOK17 K_OZPERBRK14 K_OZPERCMW K_OZPERGRADKD K_OZPERGRADMAX K_OZPERGRADMIN K_OZPERGRADTN K_OZPERINI K_OZPERKFIL K_OZPERMRMIN K_OZPERMWDMAX K_OZPERMWDMIN K_OZPERXK10 K_OZPLTEMP K_OZPLZTEMP K_OZPRREFMAX K_OZPRREFMIN K_OZQBESCHN K_OZQBESCHORI K_OZQBESCHP K_OZQBESCHST K_OZSTANDVERZ K_OZSTARTABZ K_OZSTARTVERZ K_OZSTMINW K_OZSTZYK K_OZTAGCTERR K_OZTEMPBW K_OZTEMPQERR K_OZTORMAX K_OZTORMIN K_OZUEBERF K_OZUEBERTEMP K_OZUEFCNT K_OZUEFNLB K_OZUEFNQB K_OZUEFNST K_OZUEFODZ K_OZUEFPLB K_OZUEFPQB K_OZUEFPST K_OZUEFTEM K_OZUEFUDZ K_OZUEFVERZ K_OZUTFAK K_OZVERBDKM K_OZVERBFAK K_OZVERLORI K_OZVERZNIVERS K_OZVORMV K_OZVORPEILMIN K_OZZEITFAKT K_OZZEITINT K_OZZTEMP K_OZZYKCBS K_TOGMAXUNPL K_TOGVERZOEG K_TOG_CNTMAX K_TRTYP /end DEF_CHARACTERISTIC
 /begin REF_CHARACTERISTIC /end REF_CHARACTERISTIC
 /begin IN_MEASUREMENT /end IN_MEASUREMENT
 /begin OUT_MEASUREMENT /end OUT_MEASUREMENT
/end FUNCTION
/begin RECORD_LAYOUT TKW_VV_VV_UB FNC_VALUES 1 UBYTE COLUMN_DIR DIRECT /end RECORD_LAYOUT
/begin RECORD_LAYOUT TKW_VV_VV_SB FNC_VALUES 1 SBYTE COLUMN_DIR DIRECT /end RECORD_LAYOUT
/begin RECORD_LAYOUT TKW_VV_VV_UW FNC_VALUES 1 UWORD COLUMN_DIR DIRECT /end RECORD_LAYOUT
/begin RECORD_LAYOUT TKW_VV_VV_SW FNC_VALUES 1 SWORD COLUMN_DIR DIRECT /end RECORD_LAYOUT
/begin RECORD_LAYOUT TKW_VV_VV_UL FNC_VALUES 1 ULONG COLUMN_DIR DIRECT /end RECORD_LAYOUT
/begin RECORD_LAYOUT TKW_VV_VV_SL FNC_VALUES 1 SLONG COLUMN_DIR DIRECT /end RECORD_LAYOUT
/begin RECORD_LAYOUT TKL_UB_VV_UB NO_AXIS_PTS_X 1 UBYTE RESERVED 2 BYTE AXIS_PTS_X 3 UBYTE INDEX_INCR DIRECT FNC_VALUES 4 UBYTE COLUMN_DIR DIRECT /end RECORD_LAYOUT
/begin RECORD_LAYOUT TKL_UB_VV_UW NO_AXIS_PTS_X 1 UBYTE RESERVED 2 BYTE AXIS_PTS_X 3 UBYTE INDEX_INCR DIRECT FNC_VALUES 4 UWORD COLUMN_DIR DIRECT /end RECORD_LAYOUT
/begin RECORD_LAYOUT TKL_UB_VV_SW NO_AXIS_PTS_X 1 UBYTE RESERVED 2 BYTE AXIS_PTS_X 3 UBYTE INDEX_INCR DIRECT FNC_VALUES 4 SWORD COLUMN_DIR DIRECT /end RECORD_LAYOUT
/begin RECORD_LAYOUT TKL_SB_VV_SB NO_AXIS_PTS_X 1 UBYTE RESERVED 2 BYTE AXIS_PTS_X 3 SBYTE INDEX_INCR DIRECT FNC_VALUES 4 SBYTE COLUMN_DIR DIRECT /end RECORD_LAYOUT
/begin RECORD_LAYOUT TKL_UW_VV_UB NO_AXIS_PTS_X 1 UBYTE RESERVED 2 BYTE AXIS_PTS_X 3 UWORD INDEX_INCR DIRECT FNC_VALUES 4 UBYTE COLUMN_DIR DIRECT /end RECORD_LAYOUT
/begin RECORD_LAYOUT TKL_UW_VV_UW NO_AXIS_PTS_X 1 UBYTE RESERVED 2 BYTE AXIS_PTS_X 3 UWORD INDEX_INCR DIRECT FNC_VALUES 4 UWORD COLUMN_DIR DIRECT /end RECORD_LAYOUT
/begin RECORD_LAYOUT TKL_UW_VV_SW NO_AXIS_PTS_X 1 UBYTE RESERVED 2 BYTE AXIS_PTS_X 3 UWORD INDEX_INCR DIRECT FNC_VALUES 4 SWORD COLUMN_DIR DIRECT /end RECORD_LAYOUT
/begin RECORD_LAYOUT TKL_SW_VV_UW NO_AXIS_PTS_X 1 UBYTE RESERVED 2 BYTE AXIS_PTS_X 3 SWORD INDEX_INCR DIRECT FNC_VALUES 4 UWORD COLUMN_DIR DIRECT /end RECORD_LAYOUT
/begin RECORD_LAYOUT TKL_SW_VV_SW NO_AXIS_PTS_X 1 UBYTE RESERVED 2 BYTE AXIS_PTS_X 3 SWORD INDEX_INCR DIRECT FNC_VALUES 4 SWORD COLUMN_DIR DIRECT /end RECORD_LAYOUT
/begin RECORD_LAYOUT TKF_UB_SW_UW NO_AXIS_PTS_X 1 UBYTE NO_AXIS_PTS_Y 2 UBYTE AXIS_PTS_X 3 SWORD INDEX_INCR DIRECT AXIS_PTS_Y 4 UBYTE INDEX_INCR DIRECT FNC_VALUES 5 UWORD COLUMN_DIR DIRECT /end RECORD_LAYOUT
/begin RECORD_LAYOUT TKF_UW_UW_UW NO_AXIS_PTS_X 1 UBYTE NO_AXIS_PTS_Y 2 UBYTE AXIS_PTS_X 3 UWORD INDEX_INCR DIRECT AXIS_PTS_Y 4 UWORD INDEX_INCR DIRECT FNC_VALUES 5 UWORD COLUMN_DIR DIRECT /end RECORD_LAYOUT
/begin RECORD_LAYOUT TKF_UW_SW_SW NO_AXIS_PTS_X 1 UBYTE NO_AXIS_PTS_Y 2 UBYTE AXIS_PTS_X 3 SWORD INDEX_INCR DIRECT AXIS_PTS_Y 4 UWORD INDEX_INCR DIRECT FNC_VALUES 5 SWORD COLUMN_DIR DIRECT /end RECORD_LAYOUT
/begin RECORD_LAYOUT TKF_SW_SW_UB NO_AXIS_PTS_X 1 UBYTE NO_AXIS_PTS_Y 2 UBYTE AXIS_PTS_X 3 SWORD INDEX_INCR DIRECT AXIS_PTS_Y 4 SWORD INDEX_INCR DIRECT FNC_VALUES 5 UBYTE COLUMN_DIR DIRECT /end RECORD_LAYOUT
/begin RECORD_LAYOUT TKF_SW_SW_UW NO_AXIS_PTS_X 1 UBYTE NO_AXIS_PTS_Y 2 UBYTE AXIS_PTS_X 3 SWORD INDEX_INCR DIRECT AXIS_PTS_Y 4 SWORD INDEX_INCR DIRECT FNC_VALUES 5 UWORD COLUMN_DIR DIRECT /end RECORD_LAYOUT
/begin RECORD_LAYOUT TKF_SW_SW_SW NO_AXIS_PTS_X 1 UBYTE NO_AXIS_PTS_Y 2 UBYTE AXIS_PTS_X 3 SWORD INDEX_INCR DIRECT AXIS_PTS_Y 4 SWORD INDEX_INCR DIRECT FNC_VALUES 5 SWORD COLUMN_DIR DIRECT /end RECORD_LAYOUT
/end MODULE
/end PROJECT
