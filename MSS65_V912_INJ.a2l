/begin PROJECT MSS65-inj-V912 "MSS65 INJ - V912.00-B204.00, data set 0569Q60Z520E"
/begin HEADER "" VERSION "V912.00-B204.00" /end HEADER
/begin MODULE _MSS65-inj "MSS65 INJ - V912.00-B204.00, data 7842800"
/begin MOD_COMMON "" BYTE_ORDER MSB_FIRST /* Default byteorder (Motorola) */ /end MOD_COMMON
/begin COMPU_METHOD FORMULA_0001 "FORMULA_0001" RAT_FUNC "%6.1" "%" COEFFS 0 10 0 0 0 1 /end COMPU_METHOD
/begin COMPU_METHOD FORMULA_0003 "FORMULA_0003" RAT_FUNC "%3.0" "-" COEFFS 0 1 0 0 0 1 /end COMPU_METHOD
/begin COMPU_METHOD FORMULA_0006 "FORMULA_0006" RAT_FUNC "%5.0" "Upm" COEFFS 0 1 0 0 0 1 /end COMPU_METHOD
/begin COMPU_METHOD FORMULA_0007 "FORMULA_0007" RAT_FUNC "%8.3" "-" COEFFS 0 10000 0 0 0 1 /end COMPU_METHOD
/begin COMPU_METHOD FORMULA_0008 "FORMULA_0008" RAT_FUNC "%6.1" "V" COEFFS 0 10 0 0 0 1 /end COMPU_METHOD
/begin COMPU_METHOD FORMULA_0009 "FORMULA_0009" RAT_FUNC "%6.1" "Nm" COEFFS 0 10 0 0 0 1 /end COMPU_METHOD
/begin COMPU_METHOD FORMULA_0010 "FORMULA_0010" RAT_FUNC "%5.0" "-" COEFFS 0 1 0 0 0 1 /end COMPU_METHOD
/begin COMPU_METHOD FORMULA_0021 "FORMULA_0021" RAT_FUNC "%7.2" "s" COEFFS 0 100 0 0 0 1 /end COMPU_METHOD
/begin COMPU_METHOD FORMULA_0022 "FORMULA_0022" RAT_FUNC "%7.2" "%" COEFFS 0 100 0 0 0 1 /end COMPU_METHOD
/* ------------------ Abschnitt erzeugt aus adapt_glob.dat ------------------ */
/begin COMPU_METHOD FORMULA_0023 "FORMULA_0023" RAT_FUNC "%6.1" "�C" COEFFS 0 10 2732 0 0 1 /end COMPU_METHOD
/begin COMPU_METHOD FORMULA_0024 "FORMULA_0024" RAT_FUNC "%9.4" "-" COEFFS 0 32768 0 0 0 1 /end COMPU_METHOD
/begin COMPU_METHOD FORMULA_0025 "FORMULA_0025" RAT_FUNC "%8.3" "-" COEFFS 0 16384 0 0 0 1 /end COMPU_METHOD
/begin COMPU_METHOD FORMULA_0062 "FORMULA_0062" RAT_FUNC "%5.0" "s" COEFFS 0 1 0 0 0 1 /end COMPU_METHOD
/begin COMPU_METHOD FORMULA_0073 "FORMULA_0073" RAT_FUNC "%6.1" "s" COEFFS 0 10 0 0 0 1 /end COMPU_METHOD
/begin COMPU_METHOD FORMULA_0075 "FORMULA_0075" RAT_FUNC "%8.3" "-" COEFFS 0 1024 0 0 0 1 /end COMPU_METHOD
/begin COMPU_METHOD FORMULA_0077 "FORMULA_0077" RAT_FUNC "%6.1" "mbar" COEFFS 0 16 0 0 0 1 /end COMPU_METHOD
/begin COMPU_METHOD FORMULA_0078 "FORMULA_0078" RAT_FUNC "%6.1" "km/h" COEFFS 0 16 0 0 0 1 /end COMPU_METHOD
/* ------------------ Abschnitt erzeugt aus glob.dat ------------------ */
/begin COMPU_METHOD FORMULA_0083 "FORMULA_0083" RAT_FUNC "%7.2" "-" COEFFS 0 1 0 0 0 1 /end COMPU_METHOD
/begin COMPU_METHOD FORMULA_0111 "FORMULA_0111" RAT_FUNC "%6.1" "�KW" COEFFS 0 10 0 0 0 1 /end COMPU_METHOD
/begin COMPU_METHOD FORMULA_0112 "FORMULA_0112" RAT_FUNC "%6.1" "kg/h" COEFFS 0 10 0 0 0 1 /end COMPU_METHOD
/begin COMPU_METHOD FORMULA_0115 "FORMULA_0115" RAT_FUNC "%7.2" "%" COEFFS 0 16384 0 0 0 100 /end COMPU_METHOD
/begin COMPU_METHOD FORMULA_0118 "FORMULA_0118" RAT_FUNC "%8.3" "bar" COEFFS 0 1000 0 0 0 1 /end COMPU_METHOD
/begin COMPU_METHOD FORMULA_0121 "FORMULA_0121" RAT_FUNC "%7.2" "Nm" COEFFS 0 10 0 0 0 1 /end COMPU_METHOD
/begin COMPU_METHOD FORMULA_0123 "FORMULA_0123" RAT_FUNC "%5.0" "digit" COEFFS 0 1 0 0 0 1 /end COMPU_METHOD
/begin COMPU_METHOD FORMULA_0129 "FORMULA_0129" RAT_FUNC "%6.1" "Nm" COEFFS 0 2 0 0 0 1 /end COMPU_METHOD
/begin COMPU_METHOD FORMULA_0132 "FORMULA_0132" RAT_FUNC "%7.2" "m/(s*s)" COEFFS 0 40 0 0 0 1 /end COMPU_METHOD
/begin COMPU_METHOD FORMULA_0141 "FORMULA_0141" RAT_FUNC "%7.2" "Grad" COEFFS 0 1 0 0 0 0.04395 /end COMPU_METHOD
/begin COMPU_METHOD FORMULA_0146 "FORMULA_0146" RAT_FUNC "%6.1" "%" COEFFS 0 1667 0 0 0 100 /end COMPU_METHOD
/begin COMPU_METHOD FORMULA_0152 "FORMULA_0152" RAT_FUNC "%9.2" "s" COEFFS 0 100 0 0 0 1 /end COMPU_METHOD
/begin COMPU_METHOD FORMULA_0232 "FORMULA_0232" RAT_FUNC "%3.0" "s" COEFFS 0 1 0 0 0 1 /end COMPU_METHOD
/begin COMPU_METHOD FORMULA_0295 "FORMULA_0295" RAT_FUNC "%9.4" "-" COEFFS 0 16384 0 0 0 1 /end COMPU_METHOD
/begin COMPU_METHOD FORMULA_0317 "FORMULA_0317" RAT_FUNC "%5.2" "s" COEFFS 0 100 0 0 0 1 /end COMPU_METHOD
/begin COMPU_METHOD FORMULA_0318 "FORMULA_0318" RAT_FUNC "%3.0" ".Gang" COEFFS 0 1 0 0 0 1 /end COMPU_METHOD
/begin COMPU_METHOD FORMULA_0413 "FORMULA_0413" RAT_FUNC "%5.0" "Upm" COEFFS 0 0 27344 0 1 0 /end COMPU_METHOD
/* ------------------ Abschnitt erzeugt aus version.dat ------------------ */
/begin COMPU_METHOD FORMULA_0414 "FORMULA_0414" TAB_VERB "%3.0" "-" COMPU_TAB_REF FORMULA_0414_VTAB /end COMPU_METHOD
/begin COMPU_VTAB FORMULA_0414_VTAB "FORMULA_0414_VTAB" TAB_VERB 63 45 "-" 48 "0" 49 "1" 50 "2" 51 "3" 52 "4" 53 "5" 54 "6" 55 "7" 56 "8" 57 "9" 65 "A" 66 "B" 67 "C" 68 "D" 69 "E" 70 "F" 71 "G" 72 "H" 73 "I" 74 "J" 75 "K" 76 "L" 77 "M" 78 "N" 79 "O" 80 "P" 81 "Q" 82 "R" 83 "S" 84 "T" 85 "U" 86 "V" 87 "W" 88 "X" 89 "Y" 90 "Z" 97 "a" 98 "b" 99 "c" 100 "d" 101 "e" 102 "f" 103 "g" 104 "h" 105 "i" 106 "j" 107 "k" 108 "l" 109 "m" 110 "n" 111 "o" 112 "p" 113 "q" 114 "r" 115 "s" 116 "t" 117 "u" 118 "v" 119 "w" 120 "x" 121 "y" 122 "z" DEFAULT_VALUE "DEZ" /end COMPU_VTAB
/* ------------------ Abschnitt erzeugt aus dgen.dat ------------------ */
/begin COMPU_METHOD FORMULA_0458 "FORMULA_0458" RAT_FUNC "%4.1" "s" COEFFS 0 10 0 0 0 1 /end COMPU_METHOD
/begin COMPU_METHOD FORMULA_0530 "FORMULA_0530" RAT_FUNC "%7.2" "mg" COEFFS 0 32 0 0 0 1 /end COMPU_METHOD
/begin COMPU_METHOD FORMULA_0539 "FORMULA_0539" RAT_FUNC "%5.0" "ms" COEFFS 0 1 0 0 0 100 /end COMPU_METHOD
/begin COMPU_METHOD FORMULA_0543 "FORMULA_0543" RAT_FUNC "%3.0" "Diags" COEFFS 0 1 0 0 0 1 /end COMPU_METHOD
/begin COMPU_METHOD FORMULA_0551 "FORMULA_0551" RAT_FUNC "%7.2" "mA" COEFFS 0 1 0 0 0 0.00225 /end COMPU_METHOD
/begin COMPU_METHOD FORMULA_0553 "FORMULA_0553" RAT_FUNC "%5.0" "min" COEFFS 0 1 0 0 0 1 /end COMPU_METHOD
/begin COMPU_METHOD FORMULA_0556 "FORMULA_0556" RAT_FUNC "%9.4" "-" COEFFS 0 10000 0 0 0 1 /end COMPU_METHOD
/begin COMPU_METHOD FORMULA_0557 "FORMULA_0557" RAT_FUNC "%4.1" "l" COEFFS 0 2 0 0 0 1 /end COMPU_METHOD
/begin COMPU_METHOD FORMULA_0561 "FORMULA_0561" RAT_FUNC "%8.3" "kg/h" COEFFS 0 1000 0 0 0 1 /end COMPU_METHOD
/begin COMPU_METHOD FORMULA_0600 "FORMULA_0600" RAT_FUNC "%7.2" "min" COEFFS 0 60 0 0 0 1 /end COMPU_METHOD
/begin COMPU_METHOD FORMULA_0643 "FORMULA_0643" RAT_FUNC "%5.2" "" COEFFS 0 128 0 0 0 1 /end COMPU_METHOD
/begin COMPU_METHOD FORMULA_0645 "FORMULA_0645" RAT_FUNC "%3.0" "ms" COEFFS 0 2 0 0 0 1 /end COMPU_METHOD
/begin COMPU_METHOD FORMULA_0646 "FORMULA_0646" TAB_VERB "%5.2" "-" COMPU_TAB_REF FORMULA_0646_VTAB /end COMPU_METHOD
/begin COMPU_VTAB FORMULA_0646_VTAB "FORMULA_0646_VTAB" TAB_VERB 3 0 "Ohne DMTL" 1 "Mit DMTL" 2 "Keine Fehlerheilung" DEFAULT_VALUE "undef." /end COMPU_VTAB
/begin COMPU_METHOD FORMULA_0647 "FORMULA_0647" RAT_FUNC "%4.1" "V" COEFFS 0 10 0 0 0 1 /end COMPU_METHOD
/begin COMPU_METHOD FORMULA_0648 "FORMULA_0648" RAT_FUNC "%5.2" "" COEFFS 0 255 0 0 0 1 /end COMPU_METHOD
/begin COMPU_METHOD FORMULA_0649 "FORMULA_0649" TAB_VERB "%5.2" "-" COMPU_TAB_REF FORMULA_0649_VTAB /end COMPU_METHOD
/begin COMPU_VTAB FORMULA_0649_VTAB "FORMULA_0649_VTAB" TAB_VERB 4 0 "Aus" 1 "Deckeldia" 2 "Grobleck" 4 "Feinleck" DEFAULT_VALUE "undef." /end COMPU_VTAB
/begin COMPU_METHOD FORMULA_0650 "FORMULA_0650" RAT_FUNC "%6.1" "s" COEFFS 0 100 0 0 0 1 /end COMPU_METHOD
/begin COMPU_METHOD FORMULA_0651 "FORMULA_0651" RAT_FUNC "%6.3" "s" COEFFS 0 0 1.28 0 1 0 /end COMPU_METHOD
/begin COMPU_METHOD FORMULA_0652 "FORMULA_0652" RAT_FUNC "%3.0" "ms" COEFFS 0 1 0 0 0 1 /end COMPU_METHOD
/begin COMPU_METHOD FORMULA_0653 "FORMULA_0653" RAT_FUNC "%3.0" "ms" COEFFS 0 1 0 0 0 5 /end COMPU_METHOD
/begin COMPU_METHOD FORMULA_0654 "FORMULA_0654" RAT_FUNC "%6.1" "min" COEFFS 0 1 0 0 0 0.1706666 /end COMPU_METHOD
/begin COMPU_METHOD FORMULA_0655 "FORMULA_0655" RAT_FUNC "%5.2" "-" COEFFS 0 32 0 0 0 1 /end COMPU_METHOD
/begin COMPU_METHOD FORMULA_0656 "FORMULA_0656" TAB_VERB "%5.2" "-" COMPU_TAB_REF FORMULA_0656_VTAB /end COMPU_METHOD
/begin COMPU_VTAB FORMULA_0656_VTAB "FORMULA_0656_VTAB" TAB_VERB 2 0 "1x Stabilzeit" 1 "2x Stabilzeit" DEFAULT_VALUE "undef." /end COMPU_VTAB
/begin COMPU_METHOD FORMULA_0657 "FORMULA_0657" RAT_FUNC "%7.2" "V" COEFFS 0 640 0 0 0 1 /end COMPU_METHOD
/begin COMPU_METHOD FORMULA_0658 "FORMULA_0658" RAT_FUNC "%3.0" "s" COEFFS 0 1 0 0 0 2 /end COMPU_METHOD
/begin COMPU_METHOD FORMULA_0664 "FORMULA_0664" RAT_FUNC "%5.2" "s" COEFFS 0 0 2.56 0 1 0 /end COMPU_METHOD
/begin COMPU_METHOD FORMULA_0683 "FORMULA_0683" RAT_FUNC "%5.2" "s" COEFFS 0 0 25.6 0 1 0 /end COMPU_METHOD
/begin COMPU_METHOD FORMULA_0708 "FORMULA_0708" TAB_VERB "%9.2" "-" COMPU_TAB_REF FORMULA_0708_VTAB /end COMPU_METHOD
/begin COMPU_VTAB FORMULA_0708_VTAB "FORMULA_0708_VTAB" TAB_VERB 1 0 "ok" DEFAULT_VALUE "nok" /end COMPU_VTAB
/begin COMPU_METHOD FORMULA_0709 "FORMULA_0709" RAT_FUNC "%6.1" "%" COEFFS 0 100 0 0 0 1 /end COMPU_METHOD
/begin COMPU_METHOD FORMULA_0710 "FORMULA_0710" TAB_VERB "%5.2" "-" COMPU_TAB_REF FORMULA_0710_VTAB /end COMPU_METHOD
/begin COMPU_VTAB FORMULA_0710_VTAB "FORMULA_0710_VTAB" TAB_VERB 5 0 "Inaktiv" 1 "Aktiv OK" 2 "Fehler" 4 "Fehler CNT" 8 "ED Eintrag" DEFAULT_VALUE "ugnueltig" /end COMPU_VTAB
/begin COMPU_METHOD FORMULA_0711 "FORMULA_0711" TAB_VERB "%5.2" "-" COMPU_TAB_REF FORMULA_0711_VTAB /end COMPU_METHOD
/begin COMPU_VTAB FORMULA_0711_VTAB "FORMULA_0711_VTAB" TAB_VERB 6 0 "Inaktiv" 1 "Aktiv OK" 2 "Fehler" 4 "Fehler CNT" 8 "ED Eintrag" 16 "TE sperrt" DEFAULT_VALUE "ugnueltig" /end COMPU_VTAB
/* ------------------ Abschnitt erzeugt aus fst.dat ------------------ */
/begin COMPU_METHOD FORMULA_0713 "FORMULA_0713" RAT_FUNC "%4.1" "ml" COEFFS 0 1 0 0 0 0.256 /end COMPU_METHOD
/begin COMPU_METHOD FORMULA_0714 "FORMULA_0714" TAB_VERB "%5.2" "-" COMPU_TAB_REF FORMULA_0714_VTAB /end COMPU_METHOD
/begin COMPU_VTAB FORMULA_0714_VTAB "FORMULA_0714_VTAB" TAB_VERB 2 0 "nein" 1 "ja" /end COMPU_VTAB
/begin COMPU_METHOD FORMULA_0715 "FORMULA_0715" TAB_VERB "%5.2" "-" COMPU_TAB_REF FORMULA_0715_VTAB /end COMPU_METHOD
/begin COMPU_VTAB FORMULA_0715_VTAB "FORMULA_0715_VTAB" TAB_VERB 2 0 "nein" 1 "ja" /end COMPU_VTAB
/begin COMPU_METHOD FORMULA_0716 "FORMULA_0716" TAB_VERB "%5.2" "-" COMPU_TAB_REF FORMULA_0716_VTAB /end COMPU_METHOD
/begin COMPU_VTAB FORMULA_0716_VTAB "FORMULA_0716_VTAB" TAB_VERB 2 0 "nein" 1 "ja" /end COMPU_VTAB
/begin COMPU_METHOD FORMULA_0717 "FORMULA_0717" TAB_VERB "%5.2" "-" COMPU_TAB_REF FORMULA_0717_VTAB /end COMPU_METHOD
/begin COMPU_VTAB FORMULA_0717_VTAB "FORMULA_0717_VTAB" TAB_VERB 2 0 "FST O.K." 8 "FST unplausibel" DEFAULT_VALUE "CAN Fehler." /end COMPU_VTAB
/* ------------------ Abschnitt erzeugt aus hfm.dat ------------------ */
/begin COMPU_METHOD FORMULA_0719 "FORMULA_0719" RAT_FUNC "%6.3" "s" COEFFS 0 0 2.56 0 1 0 /end COMPU_METHOD
/* ------------------ Abschnitt erzeugt aus inj_tb.dat ------------------ */
/begin COMPU_METHOD FORMULA_0723 "FORMULA_0723" TAB_VERB "%3.0" "-" COMPU_TAB_REF FORMULA_0723_VTAB /end COMPU_METHOD
/begin COMPU_VTAB FORMULA_0723_VTAB "FORMULA_0723_VTAB" TAB_VERB 5 0 "Inaktiv" 1 "Aktiv" 2 "TPU-Stop" 4 "ECU-Stop" 8 "Trig-Stop" /end COMPU_VTAB
/begin COMPU_METHOD FORMULA_0724 "FORMULA_0724" RAT_FUNC "%5.0" "us" COEFFS 0 1 0 0 0 10 /end COMPU_METHOD
/begin COMPU_METHOD FORMULA_0725 "FORMULA_0725" RAT_FUNC "%5.0" "Hz" COEFFS 0 1 0 0 0 1 /end COMPU_METHOD
/begin COMPU_METHOD FORMULA_0726 "FORMULA_0726" TAB_VERB "%5.2" "-" COMPU_TAB_REF FORMULA_0726_VTAB /end COMPU_METHOD
/begin COMPU_VTAB FORMULA_0726_VTAB "FORMULA_0726_VTAB" TAB_VERB 2 0 "ITB aus" 1 "ITB ein" DEFAULT_VALUE "undef" /end COMPU_VTAB
/* ------------------ Abschnitt erzeugt aus kats.dat ------------------ */
/begin COMPU_METHOD FORMULA_0727 "FORMULA_0727" TAB_VERB "%5.2" "-" COMPU_TAB_REF FORMULA_0727_VTAB /end COMPU_METHOD
/begin COMPU_VTAB FORMULA_0727_VTAB "FORMULA_0727_VTAB" TAB_VERB 4 0 "keiner" 1 "nkat" 2 "mdl" 4 "vkat" DEFAULT_VALUE "ungueltig" /end COMPU_VTAB
/* ------------------ Abschnitt erzeugt aus kge.dat ------------------ */
/begin COMPU_METHOD FORMULA_0730 "FORMULA_0730" TAB_VERB "%5.2" "-" COMPU_TAB_REF FORMULA_0730_VTAB /end COMPU_METHOD
/begin COMPU_VTAB FORMULA_0730_VTAB "FORMULA_0730_VTAB" TAB_VERB 4 0 "inaktiv" 1 "aktive" 64 "NIO" 128 "IO" /end COMPU_VTAB
/* ------------------ Abschnitt erzeugt aus kt_ibs.dat ------------------ */
/begin COMPU_METHOD FORMULA_0732 "FORMULA_0732" RAT_FUNC "%7.2" "A" COEFFS 0 50 10000 0 0 1 /end COMPU_METHOD
/begin COMPU_METHOD FORMULA_0738 "FORMULA_0738" RAT_FUNC "%5.2" "s" COEFFS 0 1 0 0 0 16 /end COMPU_METHOD
/* ------------------ Abschnitt erzeugt aus kt_oz.dat ------------------ */
/begin COMPU_METHOD FORMULA_0745 "FORMULA_0745" RAT_FUNC "%5.0" "-" COEFFS 0 170 0 0 0 1 /end COMPU_METHOD
/* ------------------ Abschnitt erzeugt aus kva.dat ------------------ */
/begin COMPU_METHOD FORMULA_0746 "FORMULA_0746" RAT_FUNC "%6.1" "l/h" COEFFS 0 8 0 0 0 1 /end COMPU_METHOD
/* ------------------ Abschnitt erzeugt aus la.dat ------------------ */
/begin COMPU_METHOD FORMULA_0748 "FORMULA_0748" TAB_VERB "%7.2" "-" COMPU_TAB_REF FORMULA_0748_VTAB /end COMPU_METHOD
/begin COMPU_VTAB FORMULA_0748_VTAB "FORMULA_0748_VTAB" TAB_VERB 3 1 "Sonde verf" 3 "Sonde FETT" 5 "Sonde MAGER" DEFAULT_VALUE "undefiniert" /end COMPU_VTAB
/begin COMPU_METHOD FORMULA_0749 "FORMULA_0749" TAB_VERB "%7.2" "-" COMPU_TAB_REF FORMULA_0749_VTAB /end COMPU_METHOD
/begin COMPU_VTAB FORMULA_0749_VTAB "FORMULA_0749_VTAB" TAB_VERB 1 0 "GAIN8" DEFAULT_VALUE "GAIN16" /end COMPU_VTAB
/begin COMPU_METHOD FORMULA_0751 "FORMULA_0751" RAT_FUNC "%9.4" "1/ms" COEFFS 0 16384000 0 0 0 1 /end COMPU_METHOD
/begin COMPU_METHOD FORMULA_0752 "FORMULA_0752" RAT_FUNC "%7.2" "mg" COEFFS 0 64 0 0 0 1 /end COMPU_METHOD
/begin COMPU_METHOD FORMULA_0754 "FORMULA_0754" RAT_FUNC "%7.2" "ms" COEFFS 0 1000 0 0 0 32 /end COMPU_METHOD
/begin COMPU_METHOD FORMULA_0756 "FORMULA_0756" TAB_VERB "%7.2" "-" COMPU_TAB_REF FORMULA_0756_VTAB /end COMPU_METHOD
/begin COMPU_VTAB FORMULA_0756_VTAB "FORMULA_0756_VTAB" TAB_VERB 5 1 "LAA-RESET" 2 "LAA-AUS" 4 "LAA-F" 8 "LAA-TE-F" 16 "LAA-OFFS" /end COMPU_VTAB
/begin COMPU_METHOD FORMULA_0757 "FORMULA_0757" TAB_VERB "%7.2" "-" COMPU_TAB_REF FORMULA_0757_VTAB /end COMPU_METHOD
/begin COMPU_VTAB FORMULA_0757_VTAB "FORMULA_0757_VTAB" TAB_VERB 3 0 "-" 1 "F_MIN" 2 "F_MAX" /end COMPU_VTAB
/begin COMPU_METHOD FORMULA_0758 "FORMULA_0758" TAB_VERB "%7.2" "-" COMPU_TAB_REF FORMULA_0758_VTAB /end COMPU_METHOD
/begin COMPU_VTAB FORMULA_0758_VTAB "FORMULA_0758_VTAB" TAB_VERB 3 0 "-" 1 "F_TE_MIN" 2 "F_TE_MAX" /end COMPU_VTAB
/begin COMPU_METHOD FORMULA_0759 "FORMULA_0759" TAB_VERB "%7.2" "-" COMPU_TAB_REF FORMULA_0759_VTAB /end COMPU_METHOD
/begin COMPU_VTAB FORMULA_0759_VTAB "FORMULA_0759_VTAB" TAB_VERB 3 0 "-" 1 "OFFS_MIN" 2 "OFFS_MAX" /end COMPU_VTAB
/begin COMPU_METHOD FORMULA_0760 "FORMULA_0760" TAB_VERB "%7.2" "-" COMPU_TAB_REF FORMULA_0760_VTAB /end COMPU_METHOD
/begin COMPU_VTAB FORMULA_0760_VTAB "FORMULA_0760_VTAB" TAB_VERB 1 0 "-" DEFAULT_VALUE "TI_IST" /end COMPU_VTAB
/begin COMPU_METHOD FORMULA_0761 "FORMULA_0761" TAB_VERB "%7.2" "-" COMPU_TAB_REF FORMULA_0761_VTAB /end COMPU_METHOD
/begin COMPU_VTAB FORMULA_0761_VTAB "FORMULA_0761_VTAB" TAB_VERB 1 0 "no" DEFAULT_VALUE "yes" /end COMPU_VTAB
/begin COMPU_METHOD FORMULA_0763 "FORMULA_0763" RAT_FUNC "%8.3" "-" COEFFS 0 8192 0 0 0 1 /end COMPU_METHOD
/begin COMPU_METHOD FORMULA_0765 "FORMULA_0765" RAT_FUNC "%8.3" "-" COEFFS 0 32768 0 0 0 1 /end COMPU_METHOD
/begin COMPU_METHOD FORMULA_0766 "FORMULA_0766" TAB_VERB "%7.2" "-" COMPU_TAB_REF FORMULA_0766_VTAB /end COMPU_METHOD
/begin COMPU_VTAB FORMULA_0766_VTAB "FORMULA_0766_VTAB" TAB_VERB 1 0 "inaktiv" DEFAULT_VALUE "MS" /end COMPU_VTAB
/begin COMPU_METHOD FORMULA_0767 "FORMULA_0767" TAB_VERB "%7.2" "-" COMPU_TAB_REF FORMULA_0767_VTAB /end COMPU_METHOD
/begin COMPU_VTAB FORMULA_0767_VTAB "FORMULA_0767_VTAB" TAB_VERB 1 0 "inaktiv" DEFAULT_VALUE "ML" /end COMPU_VTAB
/begin COMPU_METHOD FORMULA_0768 "FORMULA_0768" TAB_VERB "%7.2" "-" COMPU_TAB_REF FORMULA_0768_VTAB /end COMPU_METHOD
/begin COMPU_VTAB FORMULA_0768_VTAB "FORMULA_0768_VTAB" TAB_VERB 1 0 "inaktiv" DEFAULT_VALUE "aktiv" /end COMPU_VTAB
/begin COMPU_METHOD FORMULA_0769 "FORMULA_0769" TAB_VERB "%7.2" "-" COMPU_TAB_REF FORMULA_0769_VTAB /end COMPU_METHOD
/begin COMPU_VTAB FORMULA_0769_VTAB "FORMULA_0769_VTAB" TAB_VERB 1 0 "laeuft" DEFAULT_VALUE "fertig" /end COMPU_VTAB
/begin COMPU_METHOD FORMULA_0770 "FORMULA_0770" TAB_VERB "%7.2" "-" COMPU_TAB_REF FORMULA_0770_VTAB /end COMPU_METHOD
/begin COMPU_VTAB FORMULA_0770_VTAB "FORMULA_0770_VTAB" TAB_VERB 1 0 "inaktiv" DEFAULT_VALUE "aktiv" /end COMPU_VTAB
/begin COMPU_METHOD FORMULA_0771 "FORMULA_0771" TAB_VERB "%7.2" "-" COMPU_TAB_REF FORMULA_0771_VTAB /end COMPU_METHOD
/begin COMPU_VTAB FORMULA_0771_VTAB "FORMULA_0771_VTAB" TAB_VERB 1 0 "inaktiv" DEFAULT_VALUE "aktiv" /end COMPU_VTAB
/begin COMPU_METHOD FORMULA_0772 "FORMULA_0772" TAB_VERB "%7.2" "-" COMPU_TAB_REF FORMULA_0772_VTAB /end COMPU_METHOD
/begin COMPU_VTAB FORMULA_0772_VTAB "FORMULA_0772_VTAB" TAB_VERB 1 0 "inaktiv" DEFAULT_VALUE "aktiv" /end COMPU_VTAB
/begin COMPU_METHOD FORMULA_0773 "FORMULA_0773" TAB_VERB "%7.2" "-" COMPU_TAB_REF FORMULA_0773_VTAB /end COMPU_METHOD
/begin COMPU_VTAB FORMULA_0773_VTAB "FORMULA_0773_VTAB" TAB_VERB 1 0 "laeuft" DEFAULT_VALUE "fertig" /end COMPU_VTAB
/begin COMPU_METHOD FORMULA_0774 "FORMULA_0774" TAB_VERB "%7.2" "-" COMPU_TAB_REF FORMULA_0774_VTAB /end COMPU_METHOD
/begin COMPU_VTAB FORMULA_0774_VTAB "FORMULA_0774_VTAB" TAB_VERB 1 0 "inaktiv" DEFAULT_VALUE "Zeit laeuft" /end COMPU_VTAB
/begin COMPU_METHOD FORMULA_0775 "FORMULA_0775" TAB_VERB "%7.2" "-" COMPU_TAB_REF FORMULA_0775_VTAB /end COMPU_METHOD
/begin COMPU_VTAB FORMULA_0775_VTAB "FORMULA_0775_VTAB" TAB_VERB 1 0 "inaktiv" DEFAULT_VALUE "Zeit laeuft" /end COMPU_VTAB
/begin COMPU_METHOD FORMULA_0776 "FORMULA_0776" TAB_VERB "%7.2" "-" COMPU_TAB_REF FORMULA_0776_VTAB /end COMPU_METHOD
/begin COMPU_VTAB FORMULA_0776_VTAB "FORMULA_0776_VTAB" TAB_VERB 1 0 "inaktiv" DEFAULT_VALUE "Zeit laeuft" /end COMPU_VTAB
/begin COMPU_METHOD FORMULA_0777 "FORMULA_0777" TAB_VERB "%7.2" "-" COMPU_TAB_REF FORMULA_0777_VTAB /end COMPU_METHOD
/begin COMPU_VTAB FORMULA_0777_VTAB "FORMULA_0777_VTAB" TAB_VERB 1 0 "inaktiv" DEFAULT_VALUE "Zeit laeuft" /end COMPU_VTAB
/begin COMPU_METHOD FORMULA_0778 "FORMULA_0778" TAB_VERB "%7.2" "-" COMPU_TAB_REF FORMULA_0778_VTAB /end COMPU_METHOD
/begin COMPU_VTAB FORMULA_0778_VTAB "FORMULA_0778_VTAB" TAB_VERB 1 0 "inaktiv" DEFAULT_VALUE "Zeit laeuft" /end COMPU_VTAB
/begin COMPU_METHOD FORMULA_0779 "FORMULA_0779" TAB_VERB "%7.2" "-" COMPU_TAB_REF FORMULA_0779_VTAB /end COMPU_METHOD
/begin COMPU_VTAB FORMULA_0779_VTAB "FORMULA_0779_VTAB" TAB_VERB 1 0 "inaktiv" DEFAULT_VALUE "Zeit laeuft" /end COMPU_VTAB
/begin COMPU_METHOD FORMULA_0780 "FORMULA_0780" TAB_VERB "%7.2" "-" COMPU_TAB_REF FORMULA_0780_VTAB /end COMPU_METHOD
/begin COMPU_VTAB FORMULA_0780_VTAB "FORMULA_0780_VTAB" TAB_VERB 1 0 "-" DEFAULT_VALUE "SCDN" /end COMPU_VTAB
/begin COMPU_METHOD FORMULA_0781 "FORMULA_0781" TAB_VERB "%7.2" "-" COMPU_TAB_REF FORMULA_0781_VTAB /end COMPU_METHOD
/begin COMPU_VTAB FORMULA_0781_VTAB "FORMULA_0781_VTAB" TAB_VERB 1 0 "-" DEFAULT_VALUE "SCDN" /end COMPU_VTAB
/begin COMPU_METHOD FORMULA_0786 "FORMULA_0786" RAT_FUNC "%7.2" "ms" COEFFS 0 1000 0 0 0 1 /end COMPU_METHOD
/* ------------------ Abschnitt erzeugt aus lam_soll.dat ------------------ */
/begin COMPU_METHOD FORMULA_0793 "FORMULA_0793" TAB_VERB "%7.2" "-" COMPU_TAB_REF FORMULA_0793_VTAB /end COMPU_METHOD
/begin COMPU_VTAB FORMULA_0793_VTAB "FORMULA_0793_VTAB" TAB_VERB 21 1 "START" 2 "Normalbetrieb" 4 "SL-Betrieb" 8 "Klopfschutz" 16 "Warmlauf" 32 "Vollast" 64 "SK-Manager" 512 "BEGR-AKTIV" 513 "START/BEGR" 514 "NORMAL/BEGR" 516 "SL/BEGR" 520 "KR-Schutz/BEGR" 528 "WL/BEGR" 544 "VL/BEGR" 576 "SK/BEGR" 1024 "SL-BEGR" 2048 "WL-BEGR" 1536 "SL-BEGR/BEGR" 1540 "SL/BEGR" 2560 "WL-BEGR/BEGR" 2576 "WL/BEGR" DEFAULT_VALUE "undefiniert" /end COMPU_VTAB
/begin COMPU_METHOD FORMULA_0794 "FORMULA_0794" TAB_VERB "%7.2" "-" COMPU_TAB_REF FORMULA_0794_VTAB /end COMPU_METHOD
/begin COMPU_VTAB FORMULA_0794_VTAB "FORMULA_0794_VTAB" TAB_VERB 19 1 "START" 2 "Normalbetrieb" 4 "SL-Betrieb" 8 "Klopfschutz" 16 "Warmlauf" 32 "Vollast" 64 "SK-Manager" 128 "KATS-AKTIV" 129 "KATS-AKTIV" 132 "KATS-AKTIV" 136 "KATS-AKTIV" 144 "KATS-AKTIV" 160 "KATS-AKTIV" 256 "PST-AKTIV" 257 "PST-AKTIV" 260 "PST-AKTIV" 264 "PST-AKTIV" 272 "PST-AKTIV" 288 "PST-AKTIV" DEFAULT_VALUE "undefiniert" /end COMPU_VTAB
/begin COMPU_METHOD FORMULA_0795 "FORMULA_0795" RAT_FUNC "%8.3" "mg" COEFFS 0 40 0 0 0 1 /end COMPU_METHOD
/begin COMPU_METHOD FORMULA_0796 "FORMULA_0796" TAB_VERB "%5.2" "-" COMPU_TAB_REF FORMULA_0796_VTAB /end COMPU_METHOD
/begin COMPU_VTAB FORMULA_0796_VTAB "FORMULA_0796_VTAB" TAB_VERB 1 1 "Triggerung ueber SA" DEFAULT_VALUE "keine Triggerung" /end COMPU_VTAB
/begin COMPU_METHOD FORMULA_0805 "FORMULA_0805" RAT_FUNC "%7.2" "-" COEFFS 0 128 0 0 0 1 /end COMPU_METHOD
/* ------------------ Abschnitt erzeugt aus lank.dat ------------------ */
/begin COMPU_METHOD FORMULA_0808 "FORMULA_0808" TAB_VERB "%5.2" "-" COMPU_TAB_REF FORMULA_0808_VTAB /end COMPU_METHOD
/begin COMPU_VTAB FORMULA_0808_VTAB "FORMULA_0808_VTAB" TAB_VERB 3 0 "unplausibel" 1 "mager" 2 "fett" /end COMPU_VTAB
/begin COMPU_METHOD FORMULA_0809 "FORMULA_0809" TAB_VERB "%7.2" "-" COMPU_TAB_REF FORMULA_0809_VTAB /end COMPU_METHOD
/begin COMPU_VTAB FORMULA_0809_VTAB "FORMULA_0809_VTAB" TAB_VERB 5 0 "-" 1 "Sonde AUS" 2 "UEBERW.EIN" 4 "Sonde EIN" 8 "UEBERW.AUS" /end COMPU_VTAB
/begin COMPU_METHOD FORMULA_0810 "FORMULA_0810" TAB_VERB "%7.2" "-" COMPU_TAB_REF FORMULA_0810_VTAB /end COMPU_METHOD
/begin COMPU_VTAB FORMULA_0810_VTAB "FORMULA_0810_VTAB" TAB_VERB 1 0 "Einschwingzeit aktiv" DEFAULT_VALUE "Einschwingzeit abgelaufen" /end COMPU_VTAB
/begin COMPU_METHOD FORMULA_0811 "FORMULA_0811" TAB_VERB "%7.2" "-" COMPU_TAB_REF FORMULA_0811_VTAB /end COMPU_METHOD
/begin COMPU_VTAB FORMULA_0811_VTAB "FORMULA_0811_VTAB" TAB_VERB 1 0 "i.O." DEFAULT_VALUE "n.i.O." /end COMPU_VTAB
/begin COMPU_METHOD FORMULA_0812 "FORMULA_0812" TAB_VERB "%7.2" "-" COMPU_TAB_REF FORMULA_0812_VTAB /end COMPU_METHOD
/begin COMPU_VTAB FORMULA_0812_VTAB "FORMULA_0812_VTAB" TAB_VERB 1 0 "i.O." DEFAULT_VALUE "n.i.O." /end COMPU_VTAB
/begin COMPU_METHOD FORMULA_0813 "FORMULA_0813" TAB_VERB "%7.2" "-" COMPU_TAB_REF FORMULA_0813_VTAB /end COMPU_METHOD
/begin COMPU_VTAB FORMULA_0813_VTAB "FORMULA_0813_VTAB" TAB_VERB 1 0 "i.O." DEFAULT_VALUE "n.i.O." /end COMPU_VTAB
/begin COMPU_METHOD FORMULA_0814 "FORMULA_0814" TAB_VERB "%7.2" "-" COMPU_TAB_REF FORMULA_0814_VTAB /end COMPU_METHOD
/begin COMPU_VTAB FORMULA_0814_VTAB "FORMULA_0814_VTAB" TAB_VERB 1 0 "i.O." DEFAULT_VALUE "n.i.O." /end COMPU_VTAB
/begin COMPU_METHOD FORMULA_0815 "FORMULA_0815" TAB_VERB "%7.2" "-" COMPU_TAB_REF FORMULA_0815_VTAB /end COMPU_METHOD
/begin COMPU_VTAB FORMULA_0815_VTAB "FORMULA_0815_VTAB" TAB_VERB 1 0 "i.O." DEFAULT_VALUE "SH_TO_UB" /end COMPU_VTAB
/begin COMPU_METHOD FORMULA_0816 "FORMULA_0816" TAB_VERB "%7.2" "-" COMPU_TAB_REF FORMULA_0816_VTAB /end COMPU_METHOD
/begin COMPU_VTAB FORMULA_0816_VTAB "FORMULA_0816_VTAB" TAB_VERB 1 0 "i.O." DEFAULT_VALUE "SH_TO_GND" /end COMPU_VTAB
/begin COMPU_METHOD FORMULA_0817 "FORMULA_0817" TAB_VERB "%7.2" "-" COMPU_TAB_REF FORMULA_0817_VTAB /end COMPU_METHOD
/begin COMPU_VTAB FORMULA_0817_VTAB "FORMULA_0817_VTAB" TAB_VERB 1 0 "i.O." DEFAULT_VALUE "openload" /end COMPU_VTAB
/begin COMPU_METHOD FORMULA_0818 "FORMULA_0818" TAB_VERB "%7.2" "-" COMPU_TAB_REF FORMULA_0818_VTAB /end COMPU_METHOD
/begin COMPU_VTAB FORMULA_0818_VTAB "FORMULA_0818_VTAB" TAB_VERB 1 0 "n.i.O." DEFAULT_VALUE "Temp. i.O." /end COMPU_VTAB
/begin COMPU_METHOD FORMULA_0819 "FORMULA_0819" TAB_VERB "%7.2" "-" COMPU_TAB_REF FORMULA_0819_VTAB /end COMPU_METHOD
/begin COMPU_VTAB FORMULA_0819_VTAB "FORMULA_0819_VTAB" TAB_VERB 1 0 "n.i.O." DEFAULT_VALUE "Signal i.O." /end COMPU_VTAB
/begin COMPU_METHOD FORMULA_0820 "FORMULA_0820" TAB_VERB "%7.2" "-" COMPU_TAB_REF FORMULA_0820_VTAB /end COMPU_METHOD
/begin COMPU_VTAB FORMULA_0820_VTAB "FORMULA_0820_VTAB" TAB_VERB 1 0 "no" DEFAULT_VALUE "yes" /end COMPU_VTAB
/begin COMPU_METHOD FORMULA_0821 "FORMULA_0821" TAB_VERB "%7.2" "-" COMPU_TAB_REF FORMULA_0821_VTAB /end COMPU_METHOD
/begin COMPU_VTAB FORMULA_0821_VTAB "FORMULA_0821_VTAB" TAB_VERB 1 0 "inaktiv." DEFAULT_VALUE "aktiv" /end COMPU_VTAB
/begin COMPU_METHOD FORMULA_0822 "FORMULA_0822" TAB_VERB "%7.2" "-" COMPU_TAB_REF FORMULA_0822_VTAB /end COMPU_METHOD
/begin COMPU_VTAB FORMULA_0822_VTAB "FORMULA_0822_VTAB" TAB_VERB 1 0 "inaktive Diag." DEFAULT_VALUE "aktive Diag." /end COMPU_VTAB
/begin COMPU_METHOD FORMULA_0823 "FORMULA_0823" TAB_VERB "%7.2" "-" COMPU_TAB_REF FORMULA_0823_VTAB /end COMPU_METHOD
/begin COMPU_VTAB FORMULA_0823_VTAB "FORMULA_0823_VTAB" TAB_VERB 1 0 "nicht beendet" DEFAULT_VALUE "Diag. abgelaufen" /end COMPU_VTAB
/begin COMPU_METHOD FORMULA_0824 "FORMULA_0824" TAB_VERB "%7.2" "-" COMPU_TAB_REF FORMULA_0824_VTAB /end COMPU_METHOD
/begin COMPU_VTAB FORMULA_0824_VTAB "FORMULA_0824_VTAB" TAB_VERB 1 0 "nicht erfuellt" DEFAULT_VALUE "def. SA-Phase" /end COMPU_VTAB
/begin COMPU_METHOD FORMULA_0825 "FORMULA_0825" TAB_VERB "%7.2" "-" COMPU_TAB_REF FORMULA_0825_VTAB /end COMPU_METHOD
/begin COMPU_VTAB FORMULA_0825_VTAB "FORMULA_0825_VTAB" TAB_VERB 1 0 "-" DEFAULT_VALUE "Zeit ist beendet" /end COMPU_VTAB
/begin COMPU_METHOD FORMULA_0826 "FORMULA_0826" TAB_VERB "%7.2" "-" COMPU_TAB_REF FORMULA_0826_VTAB /end COMPU_METHOD
/begin COMPU_VTAB FORMULA_0826_VTAB "FORMULA_0826_VTAB" TAB_VERB 1 0 "-" DEFAULT_VALUE "Anfettung ist beendet" /end COMPU_VTAB
/begin COMPU_METHOD FORMULA_0827 "FORMULA_0827" TAB_VERB "%7.2" "-" COMPU_TAB_REF FORMULA_0827_VTAB /end COMPU_METHOD
/begin COMPU_VTAB FORMULA_0827_VTAB "FORMULA_0827_VTAB" TAB_VERB 1 0 "inaktiv" DEFAULT_VALUE "aktiv" /end COMPU_VTAB
/begin COMPU_METHOD FORMULA_0828 "FORMULA_0828" TAB_VERB "%7.2" "-" COMPU_TAB_REF FORMULA_0828_VTAB /end COMPU_METHOD
/begin COMPU_VTAB FORMULA_0828_VTAB "FORMULA_0828_VTAB" TAB_VERB 1 0 "aus MAGER" DEFAULT_VALUE "aus FETT" /end COMPU_VTAB
/begin COMPU_METHOD FORMULA_0829 "FORMULA_0829" TAB_VERB "%7.2" "-" COMPU_TAB_REF FORMULA_0829_VTAB /end COMPU_METHOD
/begin COMPU_VTAB FORMULA_0829_VTAB "FORMULA_0829_VTAB" TAB_VERB 1 0 "aus FETT" DEFAULT_VALUE "aus MAGER" /end COMPU_VTAB
/begin COMPU_METHOD FORMULA_0830 "FORMULA_0830" TAB_VERB "%7.2" "-" COMPU_TAB_REF FORMULA_0830_VTAB /end COMPU_METHOD
/begin COMPU_VTAB FORMULA_0830_VTAB "FORMULA_0830_VTAB" TAB_VERB 1 0 "kein WE" DEFAULT_VALUE "WE erkannt" /end COMPU_VTAB
/begin COMPU_METHOD FORMULA_0831 "FORMULA_0831" TAB_VERB "%7.2" "-" COMPU_TAB_REF FORMULA_0831_VTAB /end COMPU_METHOD
/begin COMPU_VTAB FORMULA_0831_VTAB "FORMULA_0831_VTAB" TAB_VERB 1 0 "no" DEFAULT_VALUE "yes" /end COMPU_VTAB
/begin COMPU_METHOD FORMULA_0833 "FORMULA_0833" TAB_VERB "%7.2" "-" COMPU_TAB_REF FORMULA_0833_VTAB /end COMPU_METHOD
/begin COMPU_VTAB FORMULA_0833_VTAB "FORMULA_0833_VTAB" TAB_VERB 1 0 "-" DEFAULT_VALUE "unterschritten" /end COMPU_VTAB
/begin COMPU_METHOD FORMULA_0834 "FORMULA_0834" TAB_VERB "%7.2" "-" COMPU_TAB_REF FORMULA_0834_VTAB /end COMPU_METHOD
/begin COMPU_VTAB FORMULA_0834_VTAB "FORMULA_0834_VTAB" TAB_VERB 1 0 "-" DEFAULT_VALUE "unterschritten" /end COMPU_VTAB
/begin COMPU_METHOD FORMULA_0835 "FORMULA_0835" TAB_VERB "%7.2" "-" COMPU_TAB_REF FORMULA_0835_VTAB /end COMPU_METHOD
/begin COMPU_VTAB FORMULA_0835_VTAB "FORMULA_0835_VTAB" TAB_VERB 1 0 "no" DEFAULT_VALUE "yes" /end COMPU_VTAB
/begin COMPU_METHOD FORMULA_0836 "FORMULA_0836" TAB_VERB "%7.2" "-" COMPU_TAB_REF FORMULA_0836_VTAB /end COMPU_METHOD
/begin COMPU_VTAB FORMULA_0836_VTAB "FORMULA_0836_VTAB" TAB_VERB 1 0 "inaktiv" DEFAULT_VALUE "aktiv" /end COMPU_VTAB
/begin COMPU_METHOD FORMULA_0837 "FORMULA_0837" TAB_VERB "%7.2" "-" COMPU_TAB_REF FORMULA_0837_VTAB /end COMPU_METHOD
/begin COMPU_VTAB FORMULA_0837_VTAB "FORMULA_0837_VTAB" TAB_VERB 1 0 "im Bereich" DEFAULT_VALUE "ausserhalb Bereich" /end COMPU_VTAB
/begin COMPU_METHOD FORMULA_0839 "FORMULA_0839" TAB_VERB "%5.2" "-" COMPU_TAB_REF FORMULA_0839_VTAB /end COMPU_METHOD
/begin COMPU_VTAB FORMULA_0839_VTAB "FORMULA_0839_VTAB" TAB_VERB 2 0 "inaktiv" 1 "aktiv" /end COMPU_VTAB
/* ------------------ Abschnitt erzeugt aus lavk_obd.dat ------------------ */
/begin COMPU_METHOD FORMULA_0841 "FORMULA_0841" TAB_VERB "%7.2" "-" COMPU_TAB_REF FORMULA_0841_VTAB /end COMPU_METHOD
/begin COMPU_VTAB FORMULA_0841_VTAB "FORMULA_0841_VTAB" TAB_VERB 1 0 "kein OPENLOAD" DEFAULT_VALUE "IA-OPENLOAD" /end COMPU_VTAB
/begin COMPU_METHOD FORMULA_0842 "FORMULA_0842" TAB_VERB "%7.2" "-" COMPU_TAB_REF FORMULA_0842_VTAB /end COMPU_METHOD
/begin COMPU_VTAB FORMULA_0842_VTAB "FORMULA_0842_VTAB" TAB_VERB 1 0 "kein OPENLOAD" DEFAULT_VALUE "IP/VM-OPENLOAD" /end COMPU_VTAB
/begin COMPU_METHOD FORMULA_0843 "FORMULA_0843" TAB_VERB "%7.2" "-" COMPU_TAB_REF FORMULA_0843_VTAB /end COMPU_METHOD
/begin COMPU_VTAB FORMULA_0843_VTAB "FORMULA_0843_VTAB" TAB_VERB 1 0 "kein OPENLOAD" DEFAULT_VALUE "UN-OPENLOAD" /end COMPU_VTAB
/begin COMPU_METHOD FORMULA_0844 "FORMULA_0844" TAB_VERB "%7.2" "-" COMPU_TAB_REF FORMULA_0844_VTAB /end COMPU_METHOD
/begin COMPU_VTAB FORMULA_0844_VTAB "FORMULA_0844_VTAB" TAB_VERB 1 0 "kein OPENLOAD" DEFAULT_VALUE "IP/VM-OPENLOAD" /end COMPU_VTAB
/begin COMPU_METHOD FORMULA_0845 "FORMULA_0845" TAB_VERB "%7.2" "-" COMPU_TAB_REF FORMULA_0845_VTAB /end COMPU_METHOD
/begin COMPU_VTAB FORMULA_0845_VTAB "FORMULA_0845_VTAB" TAB_VERB 1 0 "kein OPENLOAD" DEFAULT_VALUE "IP/VM-VERDACHT" /end COMPU_VTAB
/begin COMPU_METHOD FORMULA_0846 "FORMULA_0846" TAB_VERB "%7.2" "-" COMPU_TAB_REF FORMULA_0846_VTAB /end COMPU_METHOD
/begin COMPU_VTAB FORMULA_0846_VTAB "FORMULA_0846_VTAB" TAB_VERB 1 0 "Diag aktiv" DEFAULT_VALUE "Ausserhalb Band" /end COMPU_VTAB
/begin COMPU_METHOD FORMULA_0847 "FORMULA_0847" TAB_VERB "%7.2" "-" COMPU_TAB_REF FORMULA_0847_VTAB /end COMPU_METHOD
/begin COMPU_VTAB FORMULA_0847_VTAB "FORMULA_0847_VTAB" TAB_VERB 4 1 "Diag. aktiv" 3 "FETT-Plausi" 5 "MAGER-Plausi" 9 "IP/VM-Plausi" DEFAULT_VALUE "inaktiv" /end COMPU_VTAB
/begin COMPU_METHOD FORMULA_0848 "FORMULA_0848" TAB_VERB "%7.2" "-" COMPU_TAB_REF FORMULA_0848_VTAB /end COMPU_METHOD
/begin COMPU_VTAB FORMULA_0848_VTAB "FORMULA_0848_VTAB" TAB_VERB 1 0 "Oszi an" DEFAULT_VALUE "Oszi aus" /end COMPU_VTAB
/begin COMPU_METHOD FORMULA_0849 "FORMULA_0849" TAB_VERB "%7.2" "-" COMPU_TAB_REF FORMULA_0849_VTAB /end COMPU_METHOD
/begin COMPU_VTAB FORMULA_0849_VTAB "FORMULA_0849_VTAB" TAB_VERB 1 0 "--" DEFAULT_VALUE "ENDE" /end COMPU_VTAB
/begin COMPU_METHOD FORMULA_0850 "FORMULA_0850" TAB_VERB "%7.2" "-" COMPU_TAB_REF FORMULA_0850_VTAB /end COMPU_METHOD
/begin COMPU_VTAB FORMULA_0850_VTAB "FORMULA_0850_VTAB" TAB_VERB 2 1 "Diag. aktiv" 3 "Diag. erfolgt" DEFAULT_VALUE "inaktiv" /end COMPU_VTAB
/begin COMPU_METHOD FORMULA_0851 "FORMULA_0851" TAB_VERB "%7.2" "-" COMPU_TAB_REF FORMULA_0851_VTAB /end COMPU_METHOD
/begin COMPU_VTAB FORMULA_0851_VTAB "FORMULA_0851_VTAB" TAB_VERB 1 0 "nicht angefordert" DEFAULT_VALUE "angefordert" /end COMPU_VTAB
/begin COMPU_METHOD FORMULA_0852 "FORMULA_0852" TAB_VERB "%7.2" "-" COMPU_TAB_REF FORMULA_0852_VTAB /end COMPU_METHOD
/begin COMPU_VTAB FORMULA_0852_VTAB "FORMULA_0852_VTAB" TAB_VERB 1 0 "inaktiv" DEFAULT_VALUE "aktiv" /end COMPU_VTAB
/begin COMPU_METHOD FORMULA_0853 "FORMULA_0853" TAB_VERB "%7.2" "-" COMPU_TAB_REF FORMULA_0853_VTAB /end COMPU_METHOD
/begin COMPU_VTAB FORMULA_0853_VTAB "FORMULA_0853_VTAB" TAB_VERB 1 0 "-" DEFAULT_VALUE "i.O." /end COMPU_VTAB
/begin COMPU_METHOD FORMULA_0854 "FORMULA_0854" TAB_VERB "%7.2" "-" COMPU_TAB_REF FORMULA_0854_VTAB /end COMPU_METHOD
/begin COMPU_VTAB FORMULA_0854_VTAB "FORMULA_0854_VTAB" TAB_VERB 1 0 "-" DEFAULT_VALUE "i.O." /end COMPU_VTAB
/begin COMPU_METHOD FORMULA_0855 "FORMULA_0855" TAB_VERB "%7.2" "-" COMPU_TAB_REF FORMULA_0855_VTAB /end COMPU_METHOD
/begin COMPU_VTAB FORMULA_0855_VTAB "FORMULA_0855_VTAB" TAB_VERB 1 0 "-" DEFAULT_VALUE "i.O." /end COMPU_VTAB
/begin COMPU_METHOD FORMULA_0856 "FORMULA_0856" TAB_VERB "%7.2" "-" COMPU_TAB_REF FORMULA_0856_VTAB /end COMPU_METHOD
/begin COMPU_VTAB FORMULA_0856_VTAB "FORMULA_0856_VTAB" TAB_VERB 1 0 "-" DEFAULT_VALUE "i.O." /end COMPU_VTAB
/begin COMPU_METHOD FORMULA_0857 "FORMULA_0857" TAB_VERB "%7.2" "-" COMPU_TAB_REF FORMULA_0857_VTAB /end COMPU_METHOD
/begin COMPU_VTAB FORMULA_0857_VTAB "FORMULA_0857_VTAB" TAB_VERB 1 0 "-" DEFAULT_VALUE "n.i.O." /end COMPU_VTAB
/begin COMPU_METHOD FORMULA_0858 "FORMULA_0858" TAB_VERB "%7.2" "-" COMPU_TAB_REF FORMULA_0858_VTAB /end COMPU_METHOD
/begin COMPU_VTAB FORMULA_0858_VTAB "FORMULA_0858_VTAB" TAB_VERB 1 0 "-" DEFAULT_VALUE "n.i.O." /end COMPU_VTAB
/begin COMPU_METHOD FORMULA_0859 "FORMULA_0859" TAB_VERB "%7.2" "-" COMPU_TAB_REF FORMULA_0859_VTAB /end COMPU_METHOD
/begin COMPU_VTAB FORMULA_0859_VTAB "FORMULA_0859_VTAB" TAB_VERB 1 0 "-" DEFAULT_VALUE "n.i.O." /end COMPU_VTAB
/begin COMPU_METHOD FORMULA_0860 "FORMULA_0860" TAB_VERB "%7.2" "-" COMPU_TAB_REF FORMULA_0860_VTAB /end COMPU_METHOD
/begin COMPU_VTAB FORMULA_0860_VTAB "FORMULA_0860_VTAB" TAB_VERB 1 0 "-" DEFAULT_VALUE "n.i.O." /end COMPU_VTAB
/begin COMPU_METHOD FORMULA_0861 "FORMULA_0861" TAB_VERB "%7.2" "-" COMPU_TAB_REF FORMULA_0861_VTAB /end COMPU_METHOD
/begin COMPU_VTAB FORMULA_0861_VTAB "FORMULA_0861_VTAB" TAB_VERB 1 0 "-" DEFAULT_VALUE "ENDE" /end COMPU_VTAB
/begin COMPU_METHOD FORMULA_0863 "FORMULA_0863" TAB_VERB "%7.2" "-" COMPU_TAB_REF FORMULA_0863_VTAB /end COMPU_METHOD
/begin COMPU_VTAB FORMULA_0863_VTAB "FORMULA_0863_VTAB" TAB_VERB 1 0 "-" DEFAULT_VALUE "OEL-Verduennung" /end COMPU_VTAB
/begin COMPU_METHOD FORMULA_0864 "FORMULA_0864" TAB_VERB "%7.2" "-" COMPU_TAB_REF FORMULA_0864_VTAB /end COMPU_METHOD
/begin COMPU_VTAB FORMULA_0864_VTAB "FORMULA_0864_VTAB" TAB_VERB 1 0 "nicht erfuellt" DEFAULT_VALUE "erfuellt" /end COMPU_VTAB
/begin COMPU_METHOD FORMULA_0865 "FORMULA_0865" TAB_VERB "%7.2" "-" COMPU_TAB_REF FORMULA_0865_VTAB /end COMPU_METHOD
/begin COMPU_VTAB FORMULA_0865_VTAB "FORMULA_0865_VTAB" TAB_VERB 1 0 "-" DEFAULT_VALUE "START-Werte" /end COMPU_VTAB
/begin COMPU_METHOD FORMULA_0866 "FORMULA_0866" TAB_VERB "%7.2" "-" COMPU_TAB_REF FORMULA_0866_VTAB /end COMPU_METHOD
/begin COMPU_VTAB FORMULA_0866_VTAB "FORMULA_0866_VTAB" TAB_VERB 1 0 "laueft" DEFAULT_VALUE "fertig" /end COMPU_VTAB
/begin COMPU_METHOD FORMULA_0867 "FORMULA_0867" TAB_VERB "%7.2" "-" COMPU_TAB_REF FORMULA_0867_VTAB /end COMPU_METHOD
/begin COMPU_VTAB FORMULA_0867_VTAB "FORMULA_0867_VTAB" TAB_VERB 1 0 "-" DEFAULT_VALUE "STOP" /end COMPU_VTAB
/* ------------------ Abschnitt erzeugt aus lavk_spi.dat ------------------ */
/begin COMPU_METHOD FORMULA_0872 "FORMULA_0872" TAB_VERB "%3.0" "-" COMPU_TAB_REF FORMULA_0872_VTAB /end COMPU_METHOD
/begin COMPU_VTAB FORMULA_0872_VTAB "FORMULA_0872_VTAB" TAB_VERB 5 0 "IDLE" 1 "Init Sonde" 2 "RESET Sensor" 3 "Diagnose Sensor" 4 "Chip Code" /end COMPU_VTAB
/begin COMPU_METHOD FORMULA_0873 "FORMULA_0873" TAB_VERB "%5.2" "-" COMPU_TAB_REF FORMULA_0873_VTAB /end COMPU_METHOD
/begin COMPU_VTAB FORMULA_0873_VTAB "FORMULA_0873_VTAB" TAB_VERB 1 0 "Gain 8" DEFAULT_VALUE "Gain 16" /end COMPU_VTAB
/begin COMPU_METHOD FORMULA_0874 "FORMULA_0874" TAB_VERB "%5.2" "-" COMPU_TAB_REF FORMULA_0874_VTAB /end COMPU_METHOD
/begin COMPU_VTAB FORMULA_0874_VTAB "FORMULA_0874_VTAB" TAB_VERB 1 0 "Off" DEFAULT_VALUE "On" /end COMPU_VTAB
/begin COMPU_METHOD FORMULA_0875 "FORMULA_0875" TAB_VERB "%5.2" "-" COMPU_TAB_REF FORMULA_0875_VTAB /end COMPU_METHOD
/begin COMPU_VTAB FORMULA_0875_VTAB "FORMULA_0875_VTAB" TAB_VERB 1 0 "Off" DEFAULT_VALUE "On" /end COMPU_VTAB
/begin COMPU_METHOD FORMULA_0876 "FORMULA_0876" TAB_VERB "%5.2" "-" COMPU_TAB_REF FORMULA_0876_VTAB /end COMPU_METHOD
/begin COMPU_VTAB FORMULA_0876_VTAB "FORMULA_0876_VTAB" TAB_VERB 1 0 "Disable" DEFAULT_VALUE "Enable" /end COMPU_VTAB
/begin COMPU_METHOD FORMULA_0877 "FORMULA_0877" TAB_VERB "%5.2" "-" COMPU_TAB_REF FORMULA_0877_VTAB /end COMPU_METHOD
/begin COMPU_VTAB FORMULA_0877_VTAB "FORMULA_0877_VTAB" TAB_VERB 1 0 "Off" DEFAULT_VALUE "On" /end COMPU_VTAB
/begin COMPU_METHOD FORMULA_0878 "FORMULA_0878" TAB_VERB "%5.2" "-" COMPU_TAB_REF FORMULA_0878_VTAB /end COMPU_METHOD
/begin COMPU_VTAB FORMULA_0878_VTAB "FORMULA_0878_VTAB" TAB_VERB 1 0 "Disable" DEFAULT_VALUE "Enable" /end COMPU_VTAB
/begin COMPU_METHOD FORMULA_0879 "FORMULA_0879" TAB_VERB "%5.2" "-" COMPU_TAB_REF FORMULA_0879_VTAB /end COMPU_METHOD
/begin COMPU_VTAB FORMULA_0879_VTAB "FORMULA_0879_VTAB" TAB_VERB 1 0 "Range 1" DEFAULT_VALUE "Range 2" /end COMPU_VTAB
/begin COMPU_METHOD FORMULA_0932 "FORMULA_0932" RAT_FUNC "%5.0" "s" COEFFS 0 100 0 0 0 1 /end COMPU_METHOD
/begin COMPU_METHOD FORMULA_0984 "FORMULA_0984" RAT_FUNC "%5.0" "mbar" COEFFS 0 16 0 0 0 1 /end COMPU_METHOD
/begin COMPU_METHOD FORMULA_0986 "FORMULA_0986" RAT_FUNC "%8.3" "mbar" COEFFS 0 16 0 0 0 1 /end COMPU_METHOD
/begin COMPU_METHOD FORMULA_0988 "FORMULA_0988" RAT_FUNC "%8.3" "mbar/V" COEFFS 0 80 0 0 0 1 /end COMPU_METHOD
/begin COMPU_METHOD FORMULA_0998 "FORMULA_0998" RAT_FUNC "%7.2" "ms" COEFFS 0 100 0 0 0 1 /end COMPU_METHOD
/* ------------------ Abschnitt erzeugt aus nw.dat ------------------ */
/begin COMPU_METHOD FORMULA_1005 "FORMULA_1005" TAB_VERB "%3.0" "-" COMPU_TAB_REF FORMULA_1005_VTAB /end COMPU_METHOD
/begin COMPU_VTAB FORMULA_1005_VTAB "FORMULA_1005_VTAB" TAB_VERB 2 0 "Schnellsync." 1 "sichere Sync." /end COMPU_VTAB
/begin COMPU_METHOD FORMULA_1034 "FORMULA_1034" RAT_FUNC "%8.3" "-" COEFFS 0 1000 0 0 0 1 /end COMPU_METHOD
/begin COMPU_METHOD FORMULA_1058 "FORMULA_1058" RAT_FUNC "%6.1" "mbar/s" COEFFS 0 16 0 0 0 10 /end COMPU_METHOD
/begin COMPU_METHOD FORMULA_1059 "FORMULA_1059" RAT_FUNC "%7.2" "s" COEFFS 0 0 6553.5 0 1 0 /end COMPU_METHOD
/begin COMPU_METHOD FORMULA_1060 "FORMULA_1060" RAT_FUNC "%7.2" "mbar" COEFFS 0 16 0 0 0 1 /end COMPU_METHOD
/begin COMPU_METHOD FORMULA_1061 "FORMULA_1061" TAB_VERB "%3.0" "-" COMPU_TAB_REF FORMULA_1061_VTAB /end COMPU_METHOD
/begin COMPU_VTAB FORMULA_1061_VTAB "FORMULA_1061_VTAB" TAB_VERB 3 0 "pumg_obd aus" 1 "Modell kontinuierlich" 2 "Modell einmalig" DEFAULT_VALUE "undef" /end COMPU_VTAB
/begin COMPU_METHOD FORMULA_1062 "FORMULA_1062" TAB_VERB "%3.0" "-" COMPU_TAB_REF FORMULA_1062_VTAB /end COMPU_METHOD
/begin COMPU_VTAB FORMULA_1062_VTAB "FORMULA_1062_VTAB" TAB_VERB 2 0 "nur via Modell" 1 "mit Zyklusvergleich" DEFAULT_VALUE "undef" /end COMPU_VTAB
/begin COMPU_METHOD FORMULA_1063 "FORMULA_1063" RAT_FUNC "%5.2" "min" COEFFS 0 60 0 0 0 1 /end COMPU_METHOD
/begin COMPU_METHOD FORMULA_1082 "FORMULA_1082" RAT_FUNC "%6.1" "Hz" COEFFS 0 10 0 0 0 1 /end COMPU_METHOD
/begin COMPU_METHOD FORMULA_1087 "FORMULA_1087" RAT_FUNC "%4.1" "%" COEFFS 0 128 0 0 0 100 /end COMPU_METHOD
/begin COMPU_METHOD FORMULA_1088 "FORMULA_1088" RAT_FUNC "%7.2" "Nm/Upm" COEFFS 0 5120 0 0 0 1 /end COMPU_METHOD
/* ------------------ Abschnitt erzeugt aus sl.dat ------------------ */
/begin COMPU_METHOD FORMULA_1092 "FORMULA_1092" TAB_VERB "%5.2" "-" COMPU_TAB_REF FORMULA_1092_VTAB /end COMPU_METHOD
/begin COMPU_VTAB FORMULA_1092_VTAB "FORMULA_1092_VTAB" TAB_VERB 2 0 "HFM" 1 "LAM" /end COMPU_VTAB
/begin COMPU_METHOD FORMULA_1093 "FORMULA_1093" TAB_VERB "%5.2" "-" COMPU_TAB_REF FORMULA_1093_VTAB /end COMPU_METHOD
/begin COMPU_VTAB FORMULA_1093_VTAB "FORMULA_1093_VTAB" TAB_VERB 2 0 "ohne" 1 "mit" DEFAULT_VALUE "schmarn" /end COMPU_VTAB
/begin COMPU_METHOD FORMULA_1094 "FORMULA_1094" RAT_FUNC "%8.3" "-/100ms" COEFFS 0 32768 0 0 0 1 /end COMPU_METHOD
/begin COMPU_METHOD FORMULA_1095 "FORMULA_1095" RAT_FUNC "%8.3" "delta_lam" COEFFS 0 16384 0 0 0 1 /end COMPU_METHOD
/begin COMPU_METHOD FORMULA_1130 "FORMULA_1130" TAB_VERB "%3.0" "-" COMPU_TAB_REF FORMULA_1130_VTAB /end COMPU_METHOD
/begin COMPU_VTAB FORMULA_1130_VTAB "FORMULA_1130_VTAB" TAB_VERB 4 0 "In tumg, Out tanzyl" 1 "In tumg, Out tan_mw" 2 "In tan_mw, Out tanzyl" 3 "In tan_mw, Out tan_mw" DEFAULT_VALUE "undefiniert" /end COMPU_VTAB
/begin COMPU_METHOD FORMULA_1140 "FORMULA_1140" RAT_FUNC "%5.0" "(kg/(m2*s))2" COEFFS 0 1 0 0 0 9 /end COMPU_METHOD
/begin COMPU_METHOD FORMULA_1142 "FORMULA_1142" RAT_FUNC "%7.2" "10exp-3" COEFFS 0 65 0 0 0 1 /end COMPU_METHOD
/begin COMPU_METHOD FORMULA_1143 "FORMULA_1143" RAT_FUNC "%8.3" "J/kg*K" COEFFS 0 1 0 0 0 1 /end COMPU_METHOD
/begin COMPU_METHOD FORMULA_1144 "FORMULA_1144" RAT_FUNC "%9.4" "-" COEFFS 0 1000 0 0 0 1 /end COMPU_METHOD
/begin COMPU_METHOD FORMULA_1147 "FORMULA_1147" RAT_FUNC "%8.3" "qmm" COEFFS 0 1000 0 0 0 1 /end COMPU_METHOD
/begin COMPU_METHOD FORMULA_1148 "FORMULA_1148" TAB_VERB "%5.2" "-" COMPU_TAB_REF FORMULA_1148_VTAB /end COMPU_METHOD
/begin COMPU_VTAB FORMULA_1148_VTAB "FORMULA_1148_VTAB" TAB_VERB 3 0 "TE inaktiv" 1 "TE aktiv" 2 "te_mks=0 bei TE_OBD" /end COMPU_VTAB
/begin COMPU_METHOD FORMULA_1149 "FORMULA_1149" TAB_VERB "%5.2" "-" COMPU_TAB_REF FORMULA_1149_VTAB /end COMPU_METHOD
/begin COMPU_VTAB FORMULA_1149_VTAB "FORMULA_1149_VTAB" TAB_VERB 2 0 "applikativ" 1 "errechnet" /end COMPU_VTAB
/begin COMPU_METHOD FORMULA_1150 "FORMULA_1150" TAB_VERB "%5.2" "-" COMPU_TAB_REF FORMULA_1150_VTAB /end COMPU_METHOD
/begin COMPU_VTAB FORMULA_1150_VTAB "FORMULA_1150_VTAB" TAB_VERB 2 0 "APPL-Wert" 1 "KF-Wert" /end COMPU_VTAB
/begin COMPU_METHOD FORMULA_1151 "FORMULA_1151" TAB_VERB "%7.2" "-" COMPU_TAB_REF FORMULA_1151_VTAB /end COMPU_METHOD
/begin COMPU_VTAB FORMULA_1151_VTAB "FORMULA_1151_VTAB" TAB_VERB 2 0 "Rampen-Wert" 1 "Appl-Wert" /end COMPU_VTAB
/begin COMPU_METHOD FORMULA_1152 "FORMULA_1152" RAT_FUNC "%5.0" "kg/(m2*s)" COEFFS 0 1 0 0 0 3 /end COMPU_METHOD
/begin COMPU_METHOD FORMULA_1157 "FORMULA_1157" TAB_VERB "%5.2" "-" COMPU_TAB_REF FORMULA_1157_VTAB /end COMPU_METHOD
/begin COMPU_VTAB FORMULA_1157_VTAB "FORMULA_1157_VTAB" TAB_VERB 5 0 "ohne_KKOS_Abwurf LAA_reset" 1 "LAA_freeze" 2 "KKOS_Abwurf" 3 "KKOS_Abwurf LAA_freeze" 4 "RESET" DEFAULT_VALUE "undef." /end COMPU_VTAB
/begin COMPU_METHOD FORMULA_1158 "FORMULA_1158" RAT_FUNC "%6.1" "%/100ms" COEFFS 0 10 0 0 0 1 /end COMPU_METHOD
/* ------------------ Abschnitt erzeugt aus tksm.dat ------------------ */
/begin COMPU_METHOD FORMULA_1189 "FORMULA_1189" TAB_VERB "%3.0" "-" COMPU_TAB_REF FORMULA_1189_VTAB /end COMPU_METHOD
/begin COMPU_VTAB FORMULA_1189_VTAB "FORMULA_1189_VTAB" TAB_VERB 2 0 "Quelle ist Modell" 1 "Quelle ist tmot" DEFAULT_VALUE "undefiniert" /end COMPU_VTAB
/* ------------------ Abschnitt erzeugt aus tz_diag.dat ------------------ */
/begin COMPU_METHOD FORMULA_1190 "FORMULA_1190" RAT_FUNC "%3.0" "seg" COEFFS 0 1 0 0 0 2 /end COMPU_METHOD
/begin COMPU_METHOD FORMULA_1192 "FORMULA_1192" RAT_FUNC "%6.1" "Hz" COEFFS 0 0 1000000 0 1 0 /end COMPU_METHOD
/begin COMPU_METHOD FORMULA_1194 "FORMULA_1194" RAT_FUNC "%6.1" "%" COEFFS 0 10.24 0 0 0 1 /end COMPU_METHOD
/begin COMPU_METHOD FORMULA_1197 "FORMULA_1197" RAT_FUNC "%6.1" "min" COEFFS 0 600 0 0 0 1 /end COMPU_METHOD
/begin COMPU_METHOD FORMULA_1198 "FORMULA_1198" RAT_FUNC "%5.0" "mA" COEFFS 0 1 0 0 0 1 /end COMPU_METHOD
/begin COMPU_METHOD FORMULA_1200 "FORMULA_1200" RAT_FUNC "%9.4" "mA*s/�KW" COEFFS 0 1024 0 0 0 1 /end COMPU_METHOD
/begin COMPU_METHOD FORMULA_1201 "FORMULA_1201" RAT_FUNC "%7.2" "mA/�KW*s" COEFFS 0 65.536 0 0 0 1 /end COMPU_METHOD
/begin COMPU_METHOD FORMULA_1202 "FORMULA_1202" RAT_FUNC "%7.2" "mA/�KW" COEFFS 0 25.6 0 0 0 1 /end COMPU_METHOD
/begin COMPU_METHOD FORMULA_1203 "FORMULA_1203" RAT_FUNC "%8.3" "Ohm" COEFFS 0 1000 0 0 0 1 /end COMPU_METHOD
/begin COMPU_METHOD FORMULA_1205 "FORMULA_1205" RAT_FUNC "%6.1" "�KW/10ms" COEFFS 0 10 0 0 0 1 /end COMPU_METHOD
/begin COMPU_METHOD FORMULA_1211 "FORMULA_1211" RAT_FUNC "%5.0" "mA/10ms" COEFFS 0 1 0 0 0 1 /end COMPU_METHOD
/begin COMPU_METHOD FORMULA_1212 "FORMULA_1212" RAT_FUNC "%5.2" "s" COEFFS 0 0 164 0 1 0 /end COMPU_METHOD
/begin COMPU_METHOD FORMULA_1213 "FORMULA_1213" TAB_VERB "%5.2" "-" COMPU_TAB_REF FORMULA_1213_VTAB /end COMPU_METHOD
/begin COMPU_VTAB FORMULA_1213_VTAB "FORMULA_1213_VTAB" TAB_VERB 3 0 "Flueg" 1 "Hochdr" 2 "MCS" DEFAULT_VALUE "undef." /end COMPU_VTAB
/begin COMPU_METHOD FORMULA_1214 "FORMULA_1214" TAB_VERB "%5.2" "-" COMPU_TAB_REF FORMULA_1214_VTAB /end COMPU_METHOD
/begin COMPU_VTAB FORMULA_1214_VTAB "FORMULA_1214_VTAB" TAB_VERB 8 0 "lls+wdk+ti" 1 "lls+ti" 2 "wdk+ti" 3 "ti" 4 "lls+wdk" 5 "lls" 6 "wdk" 7 "ignore all" DEFAULT_VALUE "undef." /end COMPU_VTAB
/begin COMPU_METHOD FORMULA_1215 "FORMULA_1215" RAT_FUNC "%6.3" "Aend/Sampl" COEFFS 0 256 0 0 0 1 /end COMPU_METHOD
/begin COMPU_METHOD FORMULA_1216 "FORMULA_1216" RAT_FUNC "%3.0" "%" COEFFS 0 2.56 0 0 0 1 /end COMPU_METHOD
/begin COMPU_METHOD FORMULA_1217 "FORMULA_1217" TAB_VERB "%5.2" "-" COMPU_TAB_REF FORMULA_1217_VTAB /end COMPU_METHOD
/begin COMPU_VTAB FORMULA_1217_VTAB "FORMULA_1217_VTAB" TAB_VERB 2 0 "normal" 1 "ohne Ueberschwinger" DEFAULT_VALUE "undef." /end COMPU_VTAB
/begin COMPU_METHOD FORMULA_1218 "FORMULA_1218" TAB_VERB "%5.2" "-" COMPU_TAB_REF FORMULA_1218_VTAB /end COMPU_METHOD
/begin COMPU_VTAB FORMULA_1218_VTAB "FORMULA_1218_VTAB" TAB_VERB 2 0 "Running" 1 "Reset" DEFAULT_VALUE "undef." /end COMPU_VTAB
/begin COMPU_METHOD FORMULA_1219 "FORMULA_1219" TAB_VERB "%5.2" "-" COMPU_TAB_REF FORMULA_1219_VTAB /end COMPU_METHOD
/begin COMPU_VTAB FORMULA_1219_VTAB "FORMULA_1219_VTAB" TAB_VERB 2 0 "normal" 1 "invers" DEFAULT_VALUE "undef." /end COMPU_VTAB
/begin COMPU_METHOD FORMULA_1220 "FORMULA_1220" RAT_FUNC "%3.0" "KW_Zahn" COEFFS 0 1 0 0 0 1 /end COMPU_METHOD
/begin COMPU_METHOD FORMULA_1221 "FORMULA_1221" TAB_VERB "%3.0" "-" COMPU_TAB_REF FORMULA_1221_VTAB /end COMPU_METHOD
/begin COMPU_VTAB FORMULA_1221_VTAB "FORMULA_1221_VTAB" TAB_VERB 2 0 "7Zahn(S54)" 1 "6Zahn" /end COMPU_VTAB
/begin COMPU_METHOD FORMULA_1222 "FORMULA_1222" RAT_FUNC "%3.0" "Zaehne/Asp" COEFFS 0 1 0 0 0 1 /end COMPU_METHOD
/begin COMPU_METHOD FORMULA_1223 "FORMULA_1223" RAT_FUNC "%7.2" "10exp-3" COEFFS 0 100 0 0 0 1 /end COMPU_METHOD
/begin COMPU_METHOD FORMULA_1224 "FORMULA_1224" TAB_VERB "%3.0" "-" COMPU_TAB_REF FORMULA_1224_VTAB /end COMPU_METHOD
/begin COMPU_VTAB FORMULA_1224_VTAB "FORMULA_1224_VTAB" TAB_VERB 2 0 "dr_rel" 1 "md_rf_soll_pt" DEFAULT_VALUE "undef." /end COMPU_VTAB
/begin COMPU_METHOD FORMULA_1225 "FORMULA_1225" RAT_FUNC "%5.0" "mA/Zahn" COEFFS 0 1 0 0 0 1 /end COMPU_METHOD
/begin COMPU_METHOD FORMULA_1227 "FORMULA_1227" RAT_FUNC "%6.1" "%" COEFFS 0 81.92 0 0 0 1 /end COMPU_METHOD
/begin COMPU_METHOD FORMULA_1228 "FORMULA_1228" TAB_VERB "%5.2" "-" COMPU_TAB_REF FORMULA_1228_VTAB /end COMPU_METHOD
/begin COMPU_VTAB FORMULA_1228_VTAB "FORMULA_1228_VTAB" TAB_VERB 2 0 "ohne DSV" 1 "mit DSV" DEFAULT_VALUE "undef." /end COMPU_VTAB
/begin COMPU_METHOD FORMULA_1232 "FORMULA_1232" RAT_FUNC "%5.0" "ASP" COEFFS 0 1 0 0 0 1 /end COMPU_METHOD
/begin COMPU_METHOD FORMULA_1234 "FORMULA_1234" TAB_VERB "%5.2" "-" COMPU_TAB_REF FORMULA_1234_VTAB /end COMPU_METHOD
/begin COMPU_VTAB FORMULA_1234_VTAB "FORMULA_1234_VTAB" TAB_VERB 3 0 "PSAU" 1 "DR_REL" 2 "PSAU+DR_REL" /end COMPU_VTAB
/begin COMPU_METHOD FORMULA_1235 "FORMULA_1235" TAB_VERB "%5.2" "-" COMPU_TAB_REF FORMULA_1235_VTAB /end COMPU_METHOD
/begin COMPU_VTAB FORMULA_1235_VTAB "FORMULA_1235_VTAB" TAB_VERB 2 0 "no" 1 "yes" /end COMPU_VTAB
/begin COMPU_METHOD FORMULA_1236 "FORMULA_1236" TAB_VERB "%5.2" "-" COMPU_TAB_REF FORMULA_1236_VTAB /end COMPU_METHOD
/begin COMPU_VTAB FORMULA_1236_VTAB "FORMULA_1236_VTAB" TAB_VERB 2 0 "-" 1 "OELV_ETA" /end COMPU_VTAB
/begin COMPU_METHOD FORMULA_1237 "FORMULA_1237" RAT_FUNC "%5.2" "-/segment" COEFFS 0 256 0 0 0 1 /end COMPU_METHOD
/* ------------------ Abschnitt erzeugt aus sys_zust.dat ------------------ */ /* ------------------ Abschnitt erzeugt aus tpu_code.dat ------------------ */ /* ------------------ Abschnitt erzeugt aus tpu_kw.dat ------------------ */
/begin CHARACTERISTIC K_TPU_KW_N_MIN "Unterdrehzahl. | EN: Under-speed" VALUE 0x78F3C TKW_VV_VV_UW 100.0 FORMULA_0413 4.0000 10000.0000 /end CHARACTERISTIC
/begin CHARACTERISTIC K_TPU_KW_SYNC_ZAHN "KW Interruptzahn zur NW Sync. | EN: Crankshaft interrupt tooth for camshaft sync" VALUE 0x78F3E TKW_VV_VV_UB 100.0 FORMULA_0003 0.0 59.0000 /end CHARACTERISTIC
/* ------------------ Abschnitt erzeugt aus version.dat ------------------ */
/begin CHARACTERISTIC K_DATENKENNUNG_1_1of5_ "Datenkennsatzkennung Nr. 1" VALUE 0x70272 TKW_VV_VV_UB 100.0 FORMULA_0414 0.0 255.0 /end CHARACTERISTIC
/begin CHARACTERISTIC K_DATENKENNUNG_2_1of5_ "Datenkennsatzkennung Nr. 2" VALUE 0x70283 TKW_VV_VV_UB 100.0 FORMULA_0414 0.0 255.0 /end CHARACTERISTIC
/* ------------------ Abschnitt erzeugt aus bsd.dat ------------------ */ /* ------------------ Abschnitt erzeugt aus bsd_conf.dat ------------------ */ /* ------------------ Abschnitt erzeugt aus bsd_exd.dat ------------------ */ /* ------------------ Abschnitt erzeugt aus cantel.dat ------------------ */ /* ------------------ Abschnitt erzeugt aus can_ev.dat ------------------ */ /* ------------------ Abschnitt erzeugt aus carbtlgr_inj.dat ------------------ */ /* ------------------ Abschnitt erzeugt aus diag_tr.dat ------------------ */ /* ------------------ Abschnitt erzeugt aus dmtl.dat ------------------ */
/begin CHARACTERISTIC K_DMTL_ANZ_DECKEL "Anzahl Deckeldiagnose-Versuche | EN: Diags   0   Anzahl Deckeldiagnose -Versuche" VALUE 0x704BA TKW_VV_VV_UB 100.0 FORMULA_0543 0.0 255.0000 /end CHARACTERISTIC
/begin CHARACTERISTIC K_DMTL_ANZ_DECKEL_LECK "Max. Anzahl Deckeldiagnosen mit Ergebnis Leck | EN: Diags   0   Max. Anzahl Deckeldiagn osen mit Ergebnis Leck" VALUE 0x704BB TKW_VV_VV_UB 100.0 FORMULA_0543 0.0 255.0000 /end CHARACTERISTIC
/begin CHARACTERISTIC K_DMTL_ANZ_FAHRTEN "Anzahl der langen Fahrten  | EN: 0   Anzahl der langen Fahrten" VALUE 0x704BC TKW_VV_VV_UB 100.0 FORMULA_0003 0.0 255.0000 /end CHARACTERISTIC
/begin CHARACTERISTIC K_DMTL_ABBR_FEIN "Anzahl abgebrochene Feindiags | EN: Diags   0   Anzahl abgebrochene Feindiags" VALUE 0x704BD TKW_VV_VV_UB 100.0 FORMULA_0543 0.0 255.0000 /end CHARACTERISTIC
/begin CHARACTERISTIC K_DMTL_ABBR_FEUCHT "Max Anzahl Feuchteabbrueche ohne MIL | EN: Diags   0   Max Anzahl  Feuchteabbrueche ohne MIL" VALUE 0x704BE TKW_VV_VV_UB 100.0 FORMULA_0543 0.0 255.0000 /end CHARACTERISTIC
/begin CHARACTERISTIC K_DMTL_AY_MAX "Maximale Querbeschleunigung bei Deckeldiagnose | EN: Maximale Querbeschleun igung bei Deckeldiagnose" VALUE 0x704C0 TKW_VV_VV_SW 100.0 FORMULA_0132 -20.0000 20.0000 FORMAT "%5.2" /end CHARACTERISTIC
/begin CHARACTERISTIC K_DMTL_CFG "Konfiguration DMTL | EN: 0x0 Ohne DMTL 0x1 Mit DMTL 0x2 Keine Fehle r- heilung ELSE undef. Konfiguration DMTL [V912: differs from V452 160E]" VALUE 0x704C2 TKW_VV_VV_UB 100.0 FORMULA_0646 0.0 255.0 /end CHARACTERISTIC
/begin CHARACTERISTIC K_DMTL_DI_BETANK "DMTL DeltaStrom Betankungserkennung | EN: DMTL DeltaStrom Betankung s-erkennung" VALUE 0x704C4 TKW_VV_VV_UW 100.0 FORMULA_0551 0.0 147.4537 FORMAT "%5.2" /end CHARACTERISTIC
/begin CHARACTERISTIC K_DMTL_DI_DECKEL "DMTL DeltaStrom Tankdeckel | EN: DMTL DeltaStrom Tankdeckel" VALUE 0x704C6 TKW_VV_VV_UW 100.0 FORMULA_0551 0.0 147.4537 FORMAT "%5.2" /end CHARACTERISTIC
/begin CHARACTERISTIC K_DMTL_DI_STABIL "DeltaStrom Stabil | EN: DeltaStrom Stabil" VALUE 0x704C8 TKW_VV_VV_UW 100.0 FORMULA_0551 0.0 147.4537 FORMAT "%5.2" /end CHARACTERISTIC
/begin CHARACTERISTIC K_DMTL_DI_TEV_OFFEN "Strom unter i_min Abbr. TEV | EN: Strom unter i_min Abbr. TEV" VALUE 0x704CA TKW_VV_VV_UW 100.0 FORMULA_0551 0.0 147.4537 FORMAT "%5.2" /end CHARACTERISTIC
/begin CHARACTERISTIC K_DMTL_DU_MAX "Max. Spannungsaenderung ohne Abbruch | EN: Max. Spannungsaenderung ohne Abbruch" VALUE 0x704CC TKW_VV_VV_UB 100.0 FORMULA_0647 0.0 25.5000 /end CHARACTERISTIC
/begin CHARACTERISTIC K_DMTL_FST_MAX "Max. zul. Fuellstand | EN: Max. zul. Fuellstand" VALUE 0x704CD TKW_VV_VV_UB 100.0 FORMULA_0557 0.0 127.5000 /end CHARACTERISTIC
/begin CHARACTERISTIC K_DMTL_FST_MIN "Min. zul. Fuellstand | EN: Min. zul. Fuellstand" VALUE 0x704CE TKW_VV_VV_UB 100.0 FORMULA_0557 0.0 127.5000 /end CHARACTERISTIC
/begin CHARACTERISTIC K_DMTL_FST_ERSATZ "Ersatzwert bei FST-Fehler | EN: Ersatzwert bei FST-Fehler" VALUE 0x704CF TKW_VV_VV_UB 100.0 FORMULA_0557 0.0 127.5000 /end CHARACTERISTIC
/begin CHARACTERISTIC K_DMTL_FST_DECKEL_MAX "Max. zul. Fuellstand fuer Deckelmessung | EN: Max. zul. Fuellstand fuer D e-ckelmessung" VALUE 0x704D0 TKW_VV_VV_UB 100.0 FORMULA_0557 0.0 127.5000 /end CHARACTERISTIC
/begin CHARACTERISTIC K_DMTL_GROB_OHNE_FEIN "Anzahl Grobleckdiags. ohne Feindiag  | EN: Diags   0   Anzahl Grobleckdiags. ohne Feindiag" VALUE 0x704D1 TKW_VV_VV_UB 100.0 FORMULA_0543 0.0 255.0000 /end CHARACTERISTIC
/begin CHARACTERISTIC K_DMTL_I_FAKT_CCDECKEL "Faktor fuer I-ref zur Tankdeckelpruefung | EN: Faktor fuer I -ref zur Tankdeckel-pruefung" VALUE 0x704D2 TKW_VV_VV_UB 100.0 FORMULA_0643 0.0 1.9921 /end CHARACTERISTIC
/begin CHARACTERISTIC K_DMTL_I_FAKT_GROB "Faktor fuer I-ref zur Gobleck | EN: Faktor fuer I-ref zur Gobleck" VALUE 0x704D3 TKW_VV_VV_UB 100.0 FORMULA_0643 0.0 1.9921 /end CHARACTERISTIC
/begin CHARACTERISTIC K_DMTL_I_FAKT_P "Minimaler Strom-Abfall nach Ventil Umschalten  | EN: Minimaler Strom- Abfall nach Ventil Umschalten" VALUE 0x704D4 TKW_VV_VV_UB 100.0 FORMULA_0648 0.0 1.0000 /end CHARACTERISTIC
/begin CHARACTERISTIC K_DMTL_I_KURZSCHL "Stromschwelle fuer Kurzschlu�erkennung | EN: Stromschwelle fuer Kurzschlu ß-erkennung" VALUE 0x704D6 TKW_VV_VV_UW 100.0 FORMULA_0551 0.0 147.4537 FORMAT "%5.2" /end CHARACTERISTIC
/begin CHARACTERISTIC K_DMTL_I_REF_DIFF "max. Referenzstromschwankungen | EN: max. Referenzstromschwanku n-gen" VALUE 0x704D8 TKW_VV_VV_UW 100.0 FORMULA_0551 0.0 147.4537 FORMAT "%5.2" /end CHARACTERISTIC
/begin CHARACTERISTIC K_DMTL_I_REF_MAX "Referenzstrom max. | EN: Maximum reference current [mA]" VALUE 0x704DA TKW_VV_VV_UW 100.0 FORMULA_0551 0.0 147.4537 FORMAT "%5.2" /end CHARACTERISTIC
/begin CHARACTERISTIC K_DMTL_I_REF_MIN "Referenzstrom min. | EN: Minimum reference current [mA]" VALUE 0x704DC TKW_VV_VV_UW 100.0 FORMULA_0551 0.0 147.4537 FORMAT "%5.2" /end CHARACTERISTIC
/begin CHARACTERISTIC K_DMTL_I_REF_1_2_DIFF "max. Unterschied Ref1 und Ref2 | EN: Maximum difference Ref1 and Ref2 [mA]" VALUE 0x704DE TKW_VV_VV_UW 100.0 FORMULA_0551 0.0 147.4537 FORMAT "%5.2" /end CHARACTERISTIC
/begin CHARACTERISTIC K_DMTL_START "Robys INCA Startknubbl" VALUE 0x704E0 TKW_VV_VV_UB 100.0 FORMULA_0649 0.0 255.0 /end CHARACTERISTIC
/begin CHARACTERISTIC K_DMTL_TEMP_MAX "Maximaltemperatur fuer Diagnose | EN: Maximum temperature for diagnosis [°C]" VALUE 0x704E2 TKW_VV_VV_SW 100.0 FORMULA_0023 -50.0000 170.0000 FORMAT "%4.1" /end CHARACTERISTIC
/begin CHARACTERISTIC K_DMTL_TEMP_MIN "Mindesttemperatur fuer Diagnose | EN: Minimum temperature for diagnosis [°C]" VALUE 0x704E4 TKW_VV_VV_SW 100.0 FORMULA_0023 -50.0000 170.0000 FORMAT "%4.1" /end CHARACTERISTIC
/begin CHARACTERISTIC K_DMTL_TEMP_DECKEL_MAX "Maximaltemperatur fuer Deckeldiagnose | EN: Maximum temperature for fuel-cap diagnosis [°C]" VALUE 0x704E6 TKW_VV_VV_SW 100.0 FORMULA_0023 -50.0000 170.0000 FORMAT "%4.1" /end CHARACTERISTIC
/begin CHARACTERISTIC K_DMTL_TEMP_DECKEL_MIN "Mindesttemperatur fuer Deckeldiagnose | EN: Minimum temperature for fuel-cap diagnosis [°C]" VALUE 0x704E8 TKW_VV_VV_SW 100.0 FORMULA_0023 -50.0000 170.0000 FORMAT "%4.1" /end CHARACTERISTIC
/begin CHARACTERISTIC K_DMTL_TEMP_VENT_MIN "Mindesttemperatur fuer Ventilcheck | EN: Minimum temperature for valve check [°C]" VALUE 0x704EA TKW_VV_VV_SW 100.0 FORMULA_0023 -50.0000 170.0000 FORMAT "%4.1" /end CHARACTERISTIC
/begin CHARACTERISTIC K_DMTL_TEMP_START_MIN "min. Motor Startemperatur | EN: Minimum engine start temperature [°C]" VALUE 0x704EC TKW_VV_VV_SW 100.0 FORMULA_0023 -50.0000 170.0000 FORMAT "%4.1" /end CHARACTERISTIC
/begin CHARACTERISTIC K_DMTL_TP_I "Filterzeitkonstante Strom" VALUE 0x704EE TKW_VV_VV_UW 100.0 FORMULA_0650 0.0 655.3500 FORMAT "%4.1" /end CHARACTERISTIC
/begin CHARACTERISTIC K_DMTL_TP_I_BEG "Filterzeitkonstante Strom zu Beginn | EN: Filter time constant, current at start [s]" VALUE 0x704F0 TKW_VV_VV_UB 100.0 FORMULA_0651 0.0051 1.2800 /end CHARACTERISTIC
/begin CHARACTERISTIC K_DMTL_TP_I_ROH "Filterzeitkonstante Roh-Strom | EN: Filter time constant, raw current [ms]" VALUE 0x704F1 TKW_VV_VV_UB 100.0 FORMULA_0652 0.0 255.0000 /end CHARACTERISTIC
/begin CHARACTERISTIC K_DMTL_TP_I_TANK "Filterzeitkonstante Strom Betankungserkennung" VALUE 0x704F2 TKW_VV_VV_UW 100.0 FORMULA_0650 0.0 655.3500 FORMAT "%4.1" /end CHARACTERISTIC
/begin CHARACTERISTIC K_DMTL_TP_UB "Filterzeitkonstante Spannung | EN: Filter time constant, voltage [ms]" VALUE 0x704F4 TKW_VV_VV_UB 100.0 FORMULA_0653 0.0 1275.0000 /end CHARACTERISTIC
/begin CHARACTERISTIC K_DMTL_T_ABSTELL "min. Abstellzeit fuer Diagnosebeginn | EN: Minimum engine-off time for diagnosis start [min]" VALUE 0x704F6 TKW_VV_VV_UW 100.0 FORMULA_0553 0.0 65535.0000 /end CHARACTERISTIC
/begin CHARACTERISTIC K_DMTL_T_AY_DLY "Wartezeit Querbeschleunigung | EN: Wait time, lateral acceleration [s]" VALUE 0x704F8 TKW_VV_VV_UB 100.0 FORMULA_0458 0.0 25.5000 /end CHARACTERISTIC
/begin CHARACTERISTIC K_DMTL_T_CC_DAUER "Max. Anzeigedauer CC Meldung Tankdeckel | EN: Maximum display duration of fuel-cap check-control message [s]" VALUE 0x704FA TKW_VV_VV_UW 100.0 FORMULA_0073 0.0 6553.5000 FORMAT "%4.1" /end CHARACTERISTIC
/begin CHARACTERISTIC K_DMTL_T_DECKEL_ML_MIN "min. Motorlaufzeit fuer Deckel-Diagnosebeginn | EN: Minimum engine run time for fuel-cap diagnosis start [min]" VALUE 0x704FC TKW_VV_VV_UW 100.0 FORMULA_0654 0.0 307.1998 FORMAT "%4.1" /end CHARACTERISTIC
/begin CHARACTERISTIC K_DMTL_T_FEUCHT_DLY "Wartezeit nach Feuchteabbruch | EN: Wait time after humidity abort [s]" VALUE 0x704FE TKW_VV_VV_UW 100.0 FORMULA_0073 0.0 6553.5000 FORMAT "%4.1" /end CHARACTERISTIC
/begin CHARACTERISTIC K_DMTL_T_KURZSCHL "Wartezeit fuer Kurzschlu�erkennung | EN: Wait time for short-circuit detection [ms]" VALUE 0x70500 TKW_VV_VV_UB 100.0 FORMULA_0645 0.0 127.5000 /end CHARACTERISTIC
/begin CHARACTERISTIC K_DMTL_T_MESS_GES "Max. Gesamtmessdauer (ohne Ref-Messung) | EN: Maximum total measurement time (without reference measurement) [s]" VALUE 0x70502 TKW_VV_VV_UW 100.0 FORMULA_0073 0.0 810.0000 FORMAT "%4.1" /end CHARACTERISTIC
/begin CHARACTERISTIC K_DMTL_T_ML_MIN "min. Motorlaufzeit fuer Diagnosebeginn | EN: Minimum engine run time for diagnosis start [min]" VALUE 0x70504 TKW_VV_VV_UW 100.0 FORMULA_0654 0.0 307.1998 FORMAT "%4.1" /end CHARACTERISTIC
/begin CHARACTERISTIC K_DMTL_T_REF "Messzeit Referenzstrom | EN: Messzeit Referenzstrom" VALUE 0x70506 TKW_VV_VV_UB 100.0 FORMULA_0458 0.0 25.5000 /end CHARACTERISTIC
/begin CHARACTERISTIC K_DMTL_T_START_DLY "Wartezeit nach KL15 aus | EN: Wartezeit nach KL15 aus" VALUE 0x70507 TKW_VV_VV_UB 100.0 FORMULA_0458 0.0 25.5000 /end CHARACTERISTIC
/begin CHARACTERISTIC K_DMTL_T_VENT_CHK "Zeit fuer Strompruefung nach Ventil umschalten | EN: Zeit fuer Strompruefung nach Ventil umschalten" VALUE 0x70508 TKW_VV_VV_UB 100.0 FORMULA_0458 0.0 25.5000 /end CHARACTERISTIC
/begin CHARACTERISTIC K_DMTL_T_VENT_UM "Zeit schnelle Stromfilterung nach Schalten | EN: Zeit schnelle Stromfilterung nach Schalten" VALUE 0x70509 TKW_VV_VV_UB 100.0 FORMULA_0458 0.0 25.5000 /end CHARACTERISTIC
/begin CHARACTERISTIC K_DMTL_UB_MAX "max. Diagnosespannung | EN: max. Diagnosespannung" VALUE 0x7050A TKW_VV_VV_SW 100.0 FORMULA_0008 0.0 28.0000 FORMAT "%4.1" /end CHARACTERISTIC
/begin CHARACTERISTIC K_DMTL_UB_MIN "min. Diagnosespannung | EN: min. Diagnosespannung Diagnose Modul Tank Leck Öltemperatursensor (QLT)/ Plausibilität Seite 586 von" VALUE 0x7050C TKW_VV_VV_SW 100.0 FORMULA_0008 0.0 28.0000 FORMAT "%4.1" /end CHARACTERISTIC
/begin CHARACTERISTIC K_DMTL_V_MIN "Mindestgeschwindigkeit fuer Betankungserkennung | EN: Mindestgeschwindigkeit fuer Betankungserkennung" VALUE 0x7050E TKW_VV_VV_SW 100.0 FORMULA_0078 -80.0000 360.0000 FORMAT "%4.1" /end CHARACTERISTIC
/begin CHARACTERISTIC K_DMTL_P_MIN "Minimaler Luftdruck fuer Diagnose | EN: Minimaler Luftdruck fuer Dia g-nose" VALUE 0x70510 TKW_VV_VV_SW 100.0 FORMULA_0077 400.0000 1200.0000 FORMAT "%4.1" /end CHARACTERISTIC
/begin CHARACTERISTIC K_DMTL_FAKT_T_DECKEL "Faktor fuer Deckeldiagnose auf Grobleckzeit | EN: Faktor fuer Deckeldiagnose auf Grobleckzeit" VALUE 0x70512 TKW_VV_VV_UB 100.0 FORMULA_0655 0.0 7.9687 /end CHARACTERISTIC
/begin CHARACTERISTIC K_DMTL_2_STABIL "Stabilkriterium ein oder zweimal zu erfuellen | EN: 0x0 1x Stabilzeit 0x1 2x Stabilzeit ELSE undef. Stabilkriterium ein oder zweimal zu erfuellen" VALUE 0x70513 TKW_VV_VV_UB 100.0 FORMULA_0656 0.0 255.0 /end CHARACTERISTIC
/begin CHARACTERISTIC KL_DMTL_FST_MAX_STAND "Maximaler Fuellstand f�r Diagnosen im Stand | EN: Maximum fill level for diagnoses at standstill" CURVE 0x70514 TKL_SW_VV_UB 100.0 FORMULA_0557 0.0 127.5000 /begin AXIS_DESCR STD_AXIS FORMULA_0132 4 -20.0000 20.0000 FORMAT "%5.2" /end AXIS_DESCR /end CHARACTERISTIC
/begin CHARACTERISTIC KL_DMTL_FST_ERS_LI "Ersatzwert bei Geber Links Fehler | EN: Ersatzwert bei Ge ber Links Fehler" CURVE 0x70522 TKL_UB_VV_UB 100.0 FORMULA_0557 0.0 127.5000 /begin AXIS_DESCR STD_AXIS FORMULA_0557 4 0.0 127.5000 FORMAT "%4.1" /end AXIS_DESCR /end CHARACTERISTIC
/begin CHARACTERISTIC KL_DMTL_FST_ERS_RE "Ersatzwert bei Geber Rechts Fehler | EN: Substitute value for right sender fault" CURVE 0x7052C TKL_UB_VV_UB 100.0 FORMULA_0557 0.0 127.5000 /begin AXIS_DESCR STD_AXIS FORMULA_0557 4 0.0 127.5000 FORMAT "%4.1" /end AXIS_DESCR /end CHARACTERISTIC
/begin CHARACTERISTIC KL_DMTL_HOEHE_KORR "Korrekturfaktor fuer DMTL T-grob/stabil ueber p_umg | EN: Correction factor for tank-leak (DMTL) coarse/stable vs ambient pressure" CURVE 0x70536 TKL_SW_VV_UB 100.0 FORMULA_0643 0.0 1.9921 /begin AXIS_DESCR STD_AXIS FORMULA_0077 3 400.0000 1200.0000 FORMAT "%4.1" /end AXIS_DESCR /end CHARACTERISTIC
/begin CHARACTERISTIC KL_DMTL_I_REF_KORR "Korrektur Referenzstrom fuer Feinleck ueber Fuellstand | EN: Reference-current correction for fine leak vs fill level" CURVE 0x70542 TKL_UB_VV_UB 100.0 FORMULA_0643 0.0 1.9921 /begin AXIS_DESCR STD_AXIS FORMULA_0557 3 0.0 127.5000 FORMAT "%4.1" /end AXIS_DESCR /end CHARACTERISTIC
/begin CHARACTERISTIC KL_DMTL_KORR_FAKT "Korrekturfaktor Pumpenstrom ueber Spannung | EN: Pump-current correction factor vs voltage" CURVE 0x7054A TKL_UW_VV_UW 100.0 FORMULA_0075 0.0 2.0000
 /begin AXIS_DESCR STD_AXIS dmtl_ub_fil FORMULA_0657 5 0.0 25.0000 FORMAT "%5.2" /end AXIS_DESCR
 FORMAT "%6.3" /end CHARACTERISTIC
/begin CHARACTERISTIC KL_DMTL_T_FEIN_MIN "Minimale Feinleck-Messdauer | EN: Minimale Feinleck -Messdauer" CURVE 0x70560 TKL_UB_VV_UB 100.0 FORMULA_0658 0.0 510.0000 /begin AXIS_DESCR STD_AXIS FORMULA_0557 6 0.0 127.5000 FORMAT "%4.1" /end AXIS_DESCR /end CHARACTERISTIC
/begin CHARACTERISTIC KL_DMTL_T_GROB "Maximale Grobleck-Messdauer | EN: Maximale Grobleck -Messdauer" CURVE 0x7056E TKL_UB_VV_UB 100.0 FORMULA_0232 0.0 255.0000 /begin AXIS_DESCR STD_AXIS FORMULA_0557 6 0.0 127.5000 FORMAT "%4.1" /end AXIS_DESCR /end CHARACTERISTIC
/begin CHARACTERISTIC KL_DMTL_T_STABIL "Stabilzeit fuer Feinleck ueber Fuellstand | EN: Stabilzeit fuer Feinleck ueber Fuellstand" CURVE 0x7057C TKL_UB_VV_UB 100.0 FORMULA_0232 0.0 255.0000 /begin AXIS_DESCR STD_AXIS FORMULA_0557 6 0.0 127.5000 FORMAT "%4.1" /end AXIS_DESCR /end CHARACTERISTIC
/* ------------------ Abschnitt erzeugt aus nw.dat ------------------ */
/begin CHARACTERISTIC K_NW_CONFIG "Konfigurationsparameter fuer NW-Synchronisation" VALUE 0x75644 TKW_VV_VV_UB 100.0 FORMULA_1005 0.0 255.0 /end CHARACTERISTIC
/begin CHARACTERISTIC K_NW_IO "Anzahl NW-Impulse fuer erneute NW-Synchronisation | EN: Anzahl NW-Impulse fuer erneute NW-Synchronisation" VALUE 0x75645 TKW_VV_VV_UB 100.0 FORMULA_0003 0.0 255.0000 /end CHARACTERISTIC
/begin CHARACTERISTIC K_NW_SYNC_ION_IO "Anzahl guter Verbrennungen fuer NW-Synchronisation ueber Ionenstrom | EN: Anzahl guter Verbrennungen fuer NW-Synchronisation ueber Ionenstrom" VALUE 0x75646 TKW_VV_VV_UB 100.0 FORMULA_0003 0.0 255.0000 /end CHARACTERISTIC
/begin CHARACTERISTIC K_NW_MFMIN_1of2_ "Untergrenze NW-Messfenster | EN: Untergrenze NW-Messfenster" VALUE 0x75647 TKW_VV_VV_UB 100.0 FORMULA_0003 0.0 255.0000 /end CHARACTERISTIC
/begin CHARACTERISTIC K_NW_MFMIN_2of2_ "Untergrenze NW-Messfenster | EN: Untergrenze NW-Messfenster" VALUE 0x75648 TKW_VV_VV_UB 100.0 FORMULA_0003 0.0 255.0000 /end CHARACTERISTIC
/begin CHARACTERISTIC K_NW_MFMAX_1of2_ "Obergrenze NW-Messfenster | EN: Obergrenze NW-Messfenster" VALUE 0x75649 TKW_VV_VV_UB 100.0 FORMULA_0003 0.0 255.0000 /end CHARACTERISTIC
/begin CHARACTERISTIC K_NW_MFMAX_2of2_ "Obergrenze NW-Messfenster | EN: Obergrenze NW-Messfenster" VALUE 0x7564A TKW_VV_VV_UB 100.0 FORMULA_0003 0.0 255.0000 /end CHARACTERISTIC
/begin CHARACTERISTIC K_NW_NIO "Schwelle fehlende/falsche NW-Impulse fuer NW-Desynchronisation | EN: Schwelle fehlende/falsche NW-Impulse fuer NW-Desynchronisation" VALUE 0x7564B TKW_VV_VV_UB 100.0 FORMULA_0003 0.0 255.0000 /end CHARACTERISTIC
/begin CHARACTERISTIC K_NW_NIO_INC "Inkremente fuer NW-Fehlerzaehler | EN: Inkremente fuer NW-Fehlerzaehler" VALUE 0x7564C TKW_VV_VV_UB 100.0 FORMULA_0003 0.0 255.0000 /end CHARACTERISTIC
/begin CHARACTERISTIC K_NW_IO_ASP "nach x korrekten Arbeitsspielen kein Rueckschalten in 360�-Mode | EN: nach x korrekten Arbeitsspielen kein Rueckschalten in 360ï¿½-Mode" VALUE 0x7564E TKW_VV_VV_UW 100.0 FORMULA_0010 2.0000 65535.0000 /end CHARACTERISTIC
/* ------------------ Abschnitt erzeugt aus pumg.dat ------------------ */
/begin CHARACTERISTIC K_PUMG_DIAG_MIN "Unter Grenze Umgebungsdruck | EN: Lower limit, ambient pressure [mbar] [V912: differs from V452 160E]" VALUE 0x76C18 TKW_VV_VV_SW 100.0 FORMULA_0984 400.0000 1200.0000 /end CHARACTERISTIC
/begin CHARACTERISTIC K_PUMG_DIAG_MAX "Obere Grenze Umgebungsdruck | EN: Upper limit, ambient pressure [mbar]" VALUE 0x76C1A TKW_VV_VV_SW 100.0 FORMULA_0984 400.0000 1200.0000 /end CHARACTERISTIC
/begin CHARACTERISTIC K_PUMG_ERSATZ "Ersatzwert Umgebungsdruck | EN: Substitute value, ambient pressure [mbar]" VALUE 0x76C1C TKW_VV_VV_SW 100.0 FORMULA_0984 400.0000 1200.0000 /end CHARACTERISTIC
/begin CHARACTERISTIC K_PUMG_SENSOR_STEIGUNG "Steigung des Drucksensors | EN: Pressure-sensor slope [mbar/V]" VALUE 0x76C1E TKW_VV_VV_UW 100.0 FORMULA_0988 0.0 275.0000 FORMAT "%6.3" /end CHARACTERISTIC
/begin CHARACTERISTIC K_PUMG_SENSOR_OFFSET "Offset des Drucksensors | EN: Pressure-sensor offset [mbar]" VALUE 0x76C20 TKW_VV_VV_SW 100.0 FORMULA_0986 0.0 625.0000 FORMAT "%6.3" /end CHARACTERISTIC
/begin CHARACTERISTIC K_PUMG_AEBEGR "Gradientenschwelle Sensorerfassung | EN: Gradient threshold, sensor acquisition [mbar/s]" VALUE 0x76C22 TKW_VV_VV_UW 100.0 FORMULA_1058 0.0 40959.3750 FORMAT "%4.1" /end CHARACTERISTIC
/begin CHARACTERISTIC K_PUMG_TAU "Filterkonstante fuer die Umgebungsdruckerfassung | EN: Filter constant for ambient-pressure acquisition [s]" VALUE 0x76C24 TKW_VV_VV_UB 100.0 FORMULA_0683 0.1004 25.6000 /end CHARACTERISTIC
/begin CHARACTERISTIC K_PUMG_OBD_PUMG_TAU "Zeitkonstante fuer pumg-Filterwert Gradienten-Check | EN: Zeitkonstante fuer pumg -Filterwert Gradienten-Check" VALUE 0x76C26 TKW_VV_VV_UW 100.0 FORMULA_1059 0.1000 6553.5000 FORMAT "%5.2" /end CHARACTERISTIC
/begin CHARACTERISTIC K_PUMG_OBD_TIME_ML_MIN "Mindest-time_ml fuer Gradienten- bzw. Modellueberw. | EN: Mindest-time_ml für Gradient - bzw. Modellüberw." VALUE 0x76C28 TKW_VV_VV_UL 100.0 FORMULA_0152 0.0 655.0000 FORMAT "%5.2" /end CHARACTERISTIC
/begin CHARACTERISTIC K_PUMG_OBD_ABW "max. zulaessige Abweichung von pumg zu pumg-Filterwert | EN: max. zulaessige Abweichung von pumg zu pumg-Filterwert" VALUE 0x76C2C TKW_VV_VV_SW 100.0 FORMULA_1060 0.0 1000.0000 FORMAT "%5.2" /end CHARACTERISTIC
/begin CHARACTERISTIC K_PUMG_OBD_ZV_DELTA_MAX "max. Umgebungsdruckdifferenz von Stop bis Start" VALUE 0x76C2E TKW_VV_VV_SW 100.0 FORMULA_0077 0.0 200.0000 FORMAT "%4.1" /end CHARACTERISTIC
/begin CHARACTERISTIC K_PUMG_OBD_MODEL_DELTA_MAX "max. zulaessige pumg-Modellwertabweichung | EN: max. zulaessige pumg -Modellwertabweichung" VALUE 0x76C30 TKW_VV_VV_SW 100.0 FORMULA_0077 0.0 200.0000 FORMAT "%4.1" /end CHARACTERISTIC
/begin CHARACTERISTIC K_PUMG_OBD_MIN_MESS "Mindestanzahl Modellwerte bei VL fuer Integralbildung | EN: Mindestanzahl Modellwerte bei VL fuer Integralbildung" VALUE 0x76C32 TKW_VV_VV_UW 100.0 FORMULA_0010 0.0 65535.0000 /end CHARACTERISTIC
/begin CHARACTERISTIC K_PUMG_OBD_CFG "Schalter Funktion - Ausgang | EN: 0x00 pumg_obd aus 0x01 pumg_obd an ELSE undef Schalter Funktion - Ausgang" VALUE 0x76C34 TKW_VV_VV_UB 100.0 FORMULA_1061 0.0 255.0 /end CHARACTERISTIC
/begin CHARACTERISTIC K_PUMG_RBM_HEILUNG_CFG "Schalter RBM Heilung bei PUMG_OBD_IO_ZYKLUSVERGLEICH" VALUE 0x76C35 TKW_VV_VV_UB 100.0 FORMULA_1062 0.0 255.0 /end CHARACTERISTIC
/begin CHARACTERISTIC K_PUMG_OBD_N_MAX "N-Max-Begrenzung pumg-Modellbewertung" VALUE 0x76C36 TKW_VV_VV_SW 100.0 FORMULA_0006 0.0 10000.0000 /end CHARACTERISTIC
/begin CHARACTERISTIC K_PUMG_OBD_N_MIN "Mindest-N fuer pumg-Modellbewertung" VALUE 0x76C38 TKW_VV_VV_SW 100.0 FORMULA_0006 0.0 10000.0000 /end CHARACTERISTIC
/begin CHARACTERISTIC K_PUMG_OBD_TUMG_MIN "Mindest-tumg fuer pumg-Modellbewertung | EN: Mindest-tumg fuer pumg -Modellbewertung" VALUE 0x76C3A TKW_VV_VV_SW 100.0 FORMULA_0023 -50.0000 170.0000 FORMAT "%4.1" /end CHARACTERISTIC
/begin CHARACTERISTIC K_PUMG_OBD_PWG_MIN "Mindest-pwg_soll fuer pumg-Modellbewertung" VALUE 0x76C3C TKW_VV_VV_SW 100.0 FORMULA_0001 -10.0000 120.0000 FORMAT "%4.1" /end CHARACTERISTIC
/begin CHARACTERISTIC K_PUMG_OBD_V_MAX "v-max-Begrenzung fuer pumg-Modellbewertung" VALUE 0x76C3E TKW_VV_VV_SW 100.0 FORMULA_0078 -80.0000 360.0000 FORMAT "%4.1" /end CHARACTERISTIC
/begin CHARACTERISTIC K_PUMG_OBD_TAN_MAX "Hoechst-tan fuer pumg-Modellbewertung" VALUE 0x76C40 TKW_VV_VV_SW 100.0 FORMULA_0023 -50.0000 170.0000 FORMAT "%4.1" /end CHARACTERISTIC
/begin CHARACTERISTIC K_PUMG_OBD_TAN_MIN "Mindest-tan fuer pumg-Modellbewertung" VALUE 0x76C42 TKW_VV_VV_SW 100.0 FORMULA_0023 -50.0000 170.0000 FORMAT "%4.1" /end CHARACTERISTIC
/begin CHARACTERISTIC K_PUMG_OBD_ML_MS "Zeitdauer von ZUST_ML nach ZUST_MS_A fuer Init | EN: Zeitdauer von ZUST_ML nach ZUST_MS_A für Init" VALUE 0x76C44 TKW_VV_VV_UB 100.0 FORMULA_1063 0.0 4.2500 /end CHARACTERISTIC
/begin CHARACTERISTIC K_PUMG_OBD_FPLAU_ABW_MAX "tolerierte fplau-Abweichung bei pumg-Modellberechnung" VALUE 0x76C46 TKW_VV_VV_SW 100.0 FORMULA_0709 -200.0000 200.0000 FORMAT "%4.1" /end CHARACTERISTIC
/begin CHARACTERISTIC K_PUMG_OBD_FPLAU_ABW_MAX_T "tolerierte Zeit der fplau-Abweichung" VALUE 0x76C48 TKW_VV_VV_UW 100.0 FORMULA_0073 0.0 6553.5000 FORMAT "%4.1" /end CHARACTERISTIC
/begin CHARACTERISTIC KF_PUMG_OBD_RF_MAX_P400 "tumg_obd-Kennfeld tmot-ml-Offset" MAP 0x76C4A TKF_SW_SW_SW 100.0 FORMULA_0007 0.0 2.0000 /begin AXIS_DESCR STD_AXIS FORMULA_0006 20 0.0 10000.0000 /end AXIS_DESCR
 /begin AXIS_DESCR STD_AXIS tan FORMULA_0023 8 -50.0000 170.0000 FORMAT "%4.1" /end AXIS_DESCR
 FORMAT "%6.3" /end CHARACTERISTIC
/begin CHARACTERISTIC KF_PUMG_OBD_RF_MAX_P500 "tumg_obd-Kennfeld tmot-ml-Offset" MAP 0x76DC4 TKF_SW_SW_SW 100.0 FORMULA_0007 0.0 2.0000 /begin AXIS_DESCR STD_AXIS FORMULA_0006 20 0.0 10000.0000 /end AXIS_DESCR
 /begin AXIS_DESCR STD_AXIS tan FORMULA_0023 8 -50.0000 170.0000 FORMAT "%4.1" /end AXIS_DESCR
 FORMAT "%6.3" /end CHARACTERISTIC
/begin CHARACTERISTIC KF_PUMG_OBD_P_STAU_KOMP "pumg-Staudruckkompensation | EN: Ambient-pressure ram-pressure compensation" MAP 0x76F3E TKF_SW_SW_SW 100.0 FORMULA_0077 -500.0000 500.0000 /begin AXIS_DESCR STD_AXIS FORMULA_0006 4 0.0 10000.0000 /end AXIS_DESCR /begin AXIS_DESCR STD_AXIS FORMULA_0078 4 -80.0000 360.0000 FORMAT "%4.1" /end AXIS_DESCR FORMAT "%4.1" /end CHARACTERISTIC
/begin CHARACTERISTIC K_PUMG_MIN_E2 "min. Umgebungsdruck | EN: Min. Umgebungsdruck" VALUE 0x7A2D2 TKW_VV_VV_SW 100.0 FORMULA_0077 250.0000 1200.0000 FORMAT "%4.1" /end CHARACTERISTIC
/begin CHARACTERISTIC K_PUMG_MAX_E2 "max. Umgebungsdruck | EN: Max. Umgebungsdruck" VALUE 0x7A2D4 TKW_VV_VV_SW 100.0 FORMULA_0077 400.0000 1350.0000 FORMAT "%4.1" /end CHARACTERISTIC
/begin CHARACTERISTIC K_PUMG_MAX_NEG_GRAD_E2 "Gradientenschwelle Ebene 2 | EN: Gradientschwelle Ebene2" VALUE 0x7A2D6 TKW_VV_VV_SW 100.0 FORMULA_1058 -20480.0000 0.0 FORMAT "%4.1" /end CHARACTERISTIC
/begin CHARACTERISTIC K_PUMG_MAX_POS_GRAD_E2 "Gradientenschwelle Ebene 2 | EN: Gradientschwelle Ebene2" VALUE 0x7A2D8 TKW_VV_VV_SW 100.0 FORMULA_1058 0.0 20479.3750 FORMAT "%4.1" /end CHARACTERISTIC
/* ------------------ Abschnitt erzeugt aus schalter_inj.dat ------------------ */
/begin CHARACTERISTIC K_SCHALTER_POEL_START_ENDE "Oeldruck-Aufbauzeit | EN: Oil pressure build-up time [s]" VALUE 0x77466 TKW_VV_VV_UW 100.0 FORMULA_0021 0.0 655.0000 FORMAT "%5.2" /end CHARACTERISTIC
/begin CHARACTERISTIC K_SCHALTER_POEL_N_DIAG "Oeldruck Drehzahlschwelle | EN: Oil pressure engine-speed threshold [Upm]" VALUE 0x77468 TKW_VV_VV_SW 100.0 FORMULA_0006 0.0 10000.0000 /end CHARACTERISTIC
/begin CHARACTERISTIC K_SCHALTER_POEL_T_DIAG "Oeldruck-Sperre | EN: Oil pressure lock [s]" VALUE 0x7746A TKW_VV_VV_UW 100.0 FORMULA_0021 0.0 655.0000 FORMAT "%5.2" /end CHARACTERISTIC
/begin CHARACTERISTIC K_SCHALTER_POEL_TOEL "Schwelle Oeltemperatur im Nachlauf | EN: Schwelle Oeltemperatur im Nachlauf [V912: differs from V452 160E]" VALUE 0x7746C TKW_VV_VV_SW 100.0 FORMULA_0023 -50.0000 170.0000 FORMAT "%4.1" /end CHARACTERISTIC
/begin CHARACTERISTIC K_SCHALTER_POEL_N_DELAY "Delay fuer n == 0 bei S_POEL-Diagnose | EN: Delay fuer n == 0 bei S_POEL-Diagnose" VALUE 0x7746E TKW_VV_VV_UW 100.0 FORMULA_0539 0.0 6553500.0000 /end CHARACTERISTIC
/begin CHARACTERISTIC K_SCHALTER_GETR_A0 "Nullpunktadaption Schalter Getriebeleergasse | EN: Nullpunktadaption Schalter Getriebeleergasse" VALUE 0x77470 TKW_VV_VV_SW 100.0 FORMULA_0123 0.0 1023.0000 /end CHARACTERISTIC
/begin CHARACTERISTIC K_SCHALTER_GETR_FIL_TAU "Filterkonstante fuer AD_Wert Getriebeleergasse | EN: Filterkonstante fuer AD_Wert Getriebeleergasse" VALUE 0x77472 TKW_VV_VV_UB 100.0 FORMULA_0664 0.0101 2.5600 /end CHARACTERISTIC
/begin CHARACTERISTIC K_SCHALTER_GETR_LEERGASSE_MIN "minimaler AD-Wert f�r Getriebeleergasse | EN: minimaler AD -Wert für G e-triebeleergasse" VALUE 0x77474 TKW_VV_VV_SW 100.0 FORMULA_0123 -1023.0000 1023.0000 /end CHARACTERISTIC
/begin CHARACTERISTIC K_SCHALTER_GETR_LEERGASSE_MAX "maximaler AD-Wert f�r Getriebeleergasse | EN: maximaler AD -Wert für G e-triebeleergasse" VALUE 0x77476 TKW_VV_VV_SW 100.0 FORMULA_0123 -1023.0000 1023.0000 /end CHARACTERISTIC
/begin CHARACTERISTIC K_SCHALTER_GETR_HYSTERESE_BREITE "Hysterese zwischen Erkennung Leergasse und Gang (in AD Schritten) | EN: Hysterese zwischen Erken- nung Leergasse und Gang (in AD Schritten)" VALUE 0x77478 TKW_VV_VV_SW 100.0 FORMULA_0123 0.0 1023.0000 /end CHARACTERISTIC
/begin CHARACTERISTIC K_SCHALTER_GETR_DIAG_MIN "Short-to-GND Schwelle | EN: Short-to-GND Schwelle" VALUE 0x7747A TKW_VV_VV_SW 100.0 FORMULA_0123 0.0 1023.0000 /end CHARACTERISTIC
/begin CHARACTERISTIC K_SCHALTER_GETR_DIAG_MAX "Short-to-UB Schwelle | EN: Short-to-UB Schwelle" VALUE 0x7747C TKW_VV_VV_SW 100.0 FORMULA_0123 0.0 1023.0000 /end CHARACTERISTIC
/begin CHARACTERISTIC K_SCHALTER_GETR_DIAG_N_VERH_TAU "Filterkonstante fuer gang_n_verh | EN: Filterkonstante fuer gang_n_verh" VALUE 0x7747E TKW_VV_VV_UB 100.0 FORMULA_0683 0.1004 25.6000 /end CHARACTERISTIC
/begin CHARACTERISTIC K_SCHALTER_GETR_DIAG_N_GETR_EIN_MIN "Mindestdrehzahl Getriebeeingang fuer Diagnose | EN: Minimum gearbox input speed for diagnosis [Upm]" VALUE 0x77480 TKW_VV_VV_SW 100.0 FORMULA_0006 0.0 12000.0000 /end CHARACTERISTIC
/begin CHARACTERISTIC K_SCHALTER_GETR_DIAG_V_MIN "Mindestgeschwindigkeit fuer Diagnose | EN: Minimum vehicle speed for diagnosis [km/h]" VALUE 0x77482 TKW_VV_VV_SW 100.0 FORMULA_0078 -80.0000 360.0000 FORMAT "%4.1" /end CHARACTERISTIC
/begin CHARACTERISTIC K_SCHALTER_GETR_DIAG_STABIL "rel. Stabilit�tsgrenze Getriebeuebersetzung fuer Diagnose | EN: Relative stability limit of gearbox ratio for diagnosis [%]" VALUE 0x77484 TKW_VV_VV_UB 100.0 FORMULA_1087 0.0 199.2187 /end CHARACTERISTIC
/begin CHARACTERISTIC K_SCHALTER_GETR_DIAG_T "Timergrenze, um Diagnose zu beenden | EN: Timer limit to end diagnosis [s]" VALUE 0x77486 TKW_VV_VV_UW 100.0 FORMULA_0073 0.0 6553.5000 FORMAT "%4.1" /end CHARACTERISTIC
/begin CHARACTERISTIC K_SCHALTER_KUPP_GESCHL "Schaltschwelle Kupplung geschlossen | EN: Switching threshold, clutch closed [digit]" VALUE 0x77488 TKW_VV_VV_SW 100.0 FORMULA_0123 0.0 1023.0000 /end CHARACTERISTIC
/begin CHARACTERISTIC K_SCHALTER_KUPP_OFFEN "Schaltschwelle Kupplung offen | EN: Switching threshold, clutch open [digit]" VALUE 0x7748A TKW_VV_VV_SW 100.0 FORMULA_0123 0.0 1023.0000 /end CHARACTERISTIC
/begin CHARACTERISTIC K_SCHALTER_KUPP_DIAG_V_MIN "Geschwindigkeit, um Diagnose scharf zu schalten | EN: Vehicle speed to arm diagnosis [km/h]" VALUE 0x7748C TKW_VV_VV_SW 100.0 FORMULA_0078 -80.0000 360.0000 FORMAT "%4.1" /end CHARACTERISTIC
/begin CHARACTERISTIC K_SCHALTER_KUPP_DIAG_V_MAX "Geschwindigkeit, um Diagnosetimer zu starten | EN: Vehicle speed to start diagnosis timer [km/h]" VALUE 0x7748E TKW_VV_VV_SW 100.0 FORMULA_0078 -80.0000 360.0000 FORMAT "%4.1" /end CHARACTERISTIC
/begin CHARACTERISTIC K_SCHALTER_KUPP_DIAG_RF "relative Fuellung, um Diagnosetimer zu starten | EN: Relative charge to start diagnosis timer" VALUE 0x77490 TKW_VV_VV_SW 100.0 FORMULA_0007 0.0 2.0000 FORMAT "%6.3" /end CHARACTERISTIC
/begin CHARACTERISTIC K_SCHALTER_KUPP_DIAG_N "Motordrehzahl, um Diagnosetimer zu starten | EN: Engine speed to start diagnosis timer [Upm]" VALUE 0x77492 TKW_VV_VV_SW 100.0 FORMULA_0006 0.0 10000.0000 /end CHARACTERISTIC
/begin CHARACTERISTIC K_SCHALTER_KUPP_DIAG_T "Timergrenze, um Diagnose zu beenden | EN: Timer limit to end diagnosis [s]" VALUE 0x77494 TKW_VV_VV_UW 100.0 FORMULA_0073 0.0 6553.5000 FORMAT "%4.1" /end CHARACTERISTIC
/begin CHARACTERISTIC K_SCHALTER_KS_N_DIFF_REF "Schaltschwelle Abstand zur Referenzdrehzahl | EN: Switching threshold, distance to reference speed [Upm]" VALUE 0x77496 TKW_VV_VV_SW 100.0 FORMULA_0006 0.0 10000.0000 /end CHARACTERISTIC
/begin CHARACTERISTIC K_SCHALTER_KS_N_DIFF "Drehzahldifferenz Motor - Getriebeeingang | EN: Speed difference engine - gearbox input [Upm]" VALUE 0x77498 TKW_VV_VV_SW 100.0 FORMULA_0006 0.0 10000.0000 /end CHARACTERISTIC
/begin CHARACTERISTIC K_SCHALTER_KS_N_T "Timer Drehzahldifferenz Motor - Getriebeeingang | EN: Timer, speed difference engine - gearbox input [s]" VALUE 0x7749A TKW_VV_VV_UW 100.0 FORMULA_0021 0.0 655.0000 FORMAT "%5.2" /end CHARACTERISTIC
/begin CHARACTERISTIC K_SCHALTER_KS_N_T_AUF "Timer Drehzahldifferenz Motor - Getr Kupplung auf" VALUE 0x7749C TKW_VV_VV_UW 100.0 FORMULA_0021 0.0 655.0000 FORMAT "%5.2" /end CHARACTERISTIC
/begin CHARACTERISTIC K_SCHALTER_KS_SCHALT_T "Timer Schaltung | EN: Timer, gearshift [s]" VALUE 0x7749E TKW_VV_VV_UW 100.0 FORMULA_0021 0.0 655.0000 FORMAT "%5.2" /end CHARACTERISTIC
/begin CHARACTERISTIC KL_SCHALTER_KS_REG "Kennlinie P-Anteil Regler Kraftschluss | EN: Curve: P share of drivetrain-engagement controller" CURVE 0x774A0 TKL_SB_VV_UW 100.0 FORMULA_1088 0.0 8.0000 /begin AXIS_DESCR STD_AXIS Gang_KS FORMULA_0318 8 -1.0000 10.0000 /end AXIS_DESCR FORMAT "%5.2" /end CHARACTERISTIC
/begin CHARACTERISTIC KF_SCHALTER_KS_N_DIFF_AUF "Drehzahldifferenz Kupplung auf | EN: Speed difference, clutch open" MAP 0x774BA TKF_SW_SW_SW 100.0 FORMULA_0006 0.0 10000.0000 /begin AXIS_DESCR STD_AXIS FORMULA_0006 3 0.0 10000.0000 /end AXIS_DESCR /begin AXIS_DESCR STD_AXIS FORMULA_0009 3 -100.0000 1000.0000 FORMAT "%4.1" /end AXIS_DESCR /end CHARACTERISTIC
/* ------------------ Abschnitt erzeugt aus sl.dat ------------------ */
/begin CHARACTERISTIC K_SL_HFM_TAU "Filterkonstante Rohwert | EN: Filterkonstante Rohwert" VALUE 0x77690 TKW_VV_VV_UB 100.0 FORMULA_0651 0.0051 1.2800 /end CHARACTERISTIC
/begin CHARACTERISTIC K_SL_LAM_ABG_TAU "Filterkonstante Rohwert Abgaslambda B1" VALUE 0x77691 TKW_VV_VV_UB 100.0 FORMULA_0651 0.0051 1.2800 /end CHARACTERISTIC
/begin CHARACTERISTIC K_SL_HFM_CFG "Umschaltung Istwert SL-Reg." VALUE 0x77692 TKW_VV_VV_UB 100.0 FORMULA_1092 0.0 255.0 /end CHARACTERISTIC
/begin CHARACTERISTIC K_SL_TKAT_ANSPR "Anspringtemp. Kat fuer NOx-Konv." VALUE 0x77694 TKW_VV_VV_SW 100.0 FORMULA_0023 -1000.0000 1000.0000 FORMAT "%4.1" /end CHARACTERISTIC
/begin CHARACTERISTIC K_SL_I_MAX "I-Anteil Max SL Mengenregelung | EN: I-Anteil Max SL Mengenregelung" VALUE 0x77696 TKW_VV_VV_SW 100.0 FORMULA_0295 -2.0000 1.9999 FORMAT "%7.4" /end CHARACTERISTIC
/begin CHARACTERISTIC K_SL_I_MIN "I-Anteil Min SL Mengenregelung | EN: I-Anteil Min SL Mengenregelung" VALUE 0x77698 TKW_VV_VV_SW 100.0 FORMULA_0295 -2.0000 1.9999 FORMAT "%7.4" /end CHARACTERISTIC
/begin CHARACTERISTIC K_SL_ML_HFM_DIAG_MAX "Diagnoseschelle Max | EN: Diagnoseschelle Max" VALUE 0x7769A TKW_VV_VV_SW 100.0 FORMULA_0112 -100.0000 1400.0000 FORMAT "%4.1" /end CHARACTERISTIC
/begin CHARACTERISTIC K_SL_ML_HFM_DIAG_MIN "Diagnoseschelle Min | EN: Diagnoseschelle Min" VALUE 0x7769C TKW_VV_VV_SW 100.0 FORMULA_0112 -100.0000 1400.0000 FORMAT "%4.1" /end CHARACTERISTIC
/begin CHARACTERISTIC K_SL_ML_HFM_ERSATZ "Ersatzwert im Fehlerfall" VALUE 0x7769E TKW_VV_VV_SW 100.0 FORMULA_0112 -100.0000 1400.0000 FORMAT "%4.1" /end CHARACTERISTIC
/begin CHARACTERISTIC K_SL_LAM_MIN_FAK "Motorlambda B2 Korr-Fak. MIN-Wert" VALUE 0x776A0 TKW_VV_VV_SW 100.0 FORMULA_0075 0.5000 1.0000 FORMAT "%6.3" /end CHARACTERISTIC
/begin CHARACTERISTIC K_SL_LAM_MAX_FAK "Motorlambda B2 Korr-Fak. MAX-Wert | EN: Motorlambda B2 Korr-Fak. MAX-Wert" VALUE 0x776A2 TKW_VV_VV_SW 100.0 FORMULA_0075 0.0 1.5000 FORMAT "%6.3" /end CHARACTERISTIC
/begin CHARACTERISTIC K_SL_LLS_CFG "Konfig fuer LLS(ZWD)" VALUE 0x776A4 TKW_VV_VV_UB 100.0 FORMULA_1093 0.0 255.0 /end CHARACTERISTIC
/begin CHARACTERISTIC KL_SL_P_ANTEIL "P-Anteil SL-Mengenregelung" CURVE 0x776A6 TKL_SW_VV_SW 100.0 FORMULA_0295 -2.0000 1.9999
 /begin AXIS_DESCR STD_AXIS ml FORMULA_0112 7 -100.0000 1400.0000 FORMAT "%4.1" /end AXIS_DESCR
 FORMAT "%7.4" /end CHARACTERISTIC
/begin CHARACTERISTIC KL_SL_I_ANTEIL "I-Anteil SL-Mengenregelung" CURVE 0x776C4 TKL_SW_VV_SW 100.0 FORMULA_0295 -2.0000 1.9999
 /begin AXIS_DESCR STD_AXIS ml FORMULA_0112 7 -100.0000 1400.0000 FORMAT "%4.1" /end AXIS_DESCR
 FORMAT "%7.4" /end CHARACTERISTIC
/begin CHARACTERISTIC KL_SL_LAM_MOT_DELAY "Zeitverzoegerung fuer Motorlambda, offset | EN: Time delay for engine lambda offset" CURVE 0x776E2 TKL_SW_VV_UW 100.0 FORMULA_0021 0.0 655.0000 /begin AXIS_DESCR STD_AXIS FORMULA_0023 6 -50.0000 200.0000 FORMAT "%4.1" /end AXIS_DESCR FORMAT "%5.2" /end CHARACTERISTIC
/begin CHARACTERISTIC KL_SL_LAM_I_ANTEIL "I-Anteil Bankabgleich" CURVE 0x776FC TKL_SW_VV_SW 100.0 FORMULA_1094 -0.5000 0.5000
 /begin AXIS_DESCR STD_AXIS Regelabweichung FORMULA_1095 5 -0.5000 0.5000 FORMAT "%6.3" /end AXIS_DESCR
 FORMAT "%6.3" /end CHARACTERISTIC
/begin CHARACTERISTIC KL_SL_LAMSOL_KALT "Soll Abgaslambda fuer kalten Kat" CURVE 0x77712 TKL_UW_VV_UW 100.0 FORMULA_0025 0.0 3.9990 /begin AXIS_DESCR STD_AXIS t FORMULA_0021 6 0.0 655.0000 FORMAT "%5.2" /end AXIS_DESCR FORMAT "%6.3" /end CHARACTERISTIC
/begin CHARACTERISTIC KL_SL_LAMSOL_WARM "Soll Abgaslambda fuer warmen Kat" CURVE 0x7772C TKL_UW_VV_UW 100.0 FORMULA_0025 0.0 3.9990 /begin AXIS_DESCR STD_AXIS t FORMULA_0021 6 0.0 655.0000 FORMAT "%5.2" /end AXIS_DESCR FORMAT "%6.3" /end CHARACTERISTIC
/begin CHARACTERISTIC KL_SL_HFM_AD "Kennlinie Mini HFM | EN: Curve: mini air-mass meter (secondary air)" CURVE 0x77746 TKL_SW_VV_SW 100.0 FORMULA_0112 -100.0000 1400.0000 /begin AXIS_DESCR STD_AXIS FORMULA_0123 10 0.0 1023.0000 /end AXIS_DESCR FORMAT "%4.1" /end CHARACTERISTIC
/begin CHARACTERISTIC KL_SL_ML_MAX_UB_FAKT "UB Korrektur | EN: Battery-voltage correction" CURVE 0x77770 TKL_SW_VV_UW 100.0 FORMULA_0075 0.0 4.0000 /begin AXIS_DESCR STD_AXIS FORMULA_0008 4 0.0 28.0000 FORMAT "%4.1" /end AXIS_DESCR FORMAT "%6.3" /end CHARACTERISTIC
/begin CHARACTERISTIC KL_SL_ML_MAX_PABG "SL Max Durchfluss abh. von pabg | EN: Secondary air maximum flow vs exhaust back-pressure" CURVE 0x77782 TKL_SW_VV_SW 100.0 FORMULA_0112 -100.0000 1400.0000
 /begin AXIS_DESCR STD_AXIS pabg_diff FORMULA_0077 6 0.0 1000.0000 FORMAT "%4.1" /end AXIS_DESCR
 FORMAT "%4.1" /end CHARACTERISTIC
/begin CHARACTERISTIC KL_SL_LAM_MOT_OFFS_TIME_F "Spreitzung time_ml abh. von Katalterung | EN: Spread of time_ml vs cat aging" CURVE 0x7779C TKL_UW_VV_UW 100.0 FORMULA_0075 0.0 4.0000 /begin AXIS_DESCR STD_AXIS FORMULA_0025 4 0.0 3.9990 FORMAT "%6.3" /end AXIS_DESCR FORMAT "%6.3" /end CHARACTERISTIC
/begin CHARACTERISTIC KL_SL_LAM_MOT_OFFS_KAT_F "Katalterungsfaktor fuer KF_SL_LAM_MOT_OFFS" CURVE 0x777AE TKL_UW_VV_SW 100.0 FORMULA_0075 -4.0000 4.0000 /begin AXIS_DESCR STD_AXIS FORMULA_0025 4 0.0 3.9990 FORMAT "%6.3" /end AXIS_DESCR FORMAT "%6.3" /end CHARACTERISTIC
/begin CHARACTERISTIC KF_SL_VORST_TV "Vorsteuerung SL Tastverhaeltnis" MAP 0x777C0 TKF_SW_SW_SW 100.0 FORMULA_0146 0.0 100.0000
 /begin AXIS_DESCR STD_AXIS pabg_diff FORMULA_0077 6 0.0 500.0000 FORMAT "%4.1" /end AXIS_DESCR
 /begin AXIS_DESCR STD_AXIS FORMULA_0001 6 0.0 100.0000 FORMAT "%4.1" /end AXIS_DESCR
 FORMAT "%4.1" /end CHARACTERISTIC
/begin CHARACTERISTIC KF_SL_LAM_MOT_OFFS "Motorlambdaoffset bei SL [V912: differs from V452 160E]" MAP 0x77822 TKF_SW_SW_SW 100.0 FORMULA_0295 -0.6000 0.6000 /begin AXIS_DESCR STD_AXIS FORMULA_0021 6 0.0 327.0000 FORMAT "%5.2" /end AXIS_DESCR /begin AXIS_DESCR STD_AXIS FORMULA_0023 6 -50.0000 170.0000 FORMAT "%4.1" /end AXIS_DESCR FORMAT "%7.4" /end CHARACTERISTIC
/* ------------------ Abschnitt erzeugt aus tanzyl.dat ------------------ */
/begin CHARACTERISTIC K_TANZYL_CFG "Definition der Quelle und Ausgabe von tanzyl | EN: 0 In tan_mw, Out tanzyl 0x1 In tan_mw, Out tanzyl_delta 0x2 In tumg, Out tanzyl 0x3 In tumg, Out tan" VALUE 0x77B2C TKW_VV_VV_UB 100.0 FORMULA_1130 0.0 255.0 /end CHARACTERISTIC
/begin CHARACTERISTIC K_TANZYL_MR_TAU "Filterkonstante fuer Motorraumtemperatur | EN: Filterkonstante fuer Motor-raumtemperatur" VALUE 0x77B2E TKW_VV_VV_UW 100.0 FORMULA_1059 0.1000 6553.5000 FORMAT "%5.2" /end CHARACTERISTIC
/begin CHARACTERISTIC KL_TANZYL_ML_GES_TAU "Luftmassenstrom zu tau | EN: Air mass flow to time constant [V912: differs from V452 160E]" CURVE 0x77B30 TKL_SW_VV_UW 100.0 FORMULA_1059 0.1000 6553.5000 /begin AXIS_DESCR STD_AXIS FORMULA_0112 6 -100.0000 1400.0000 FORMAT "%4.1" /end AXIS_DESCR FORMAT "%5.2" /end CHARACTERISTIC
/begin CHARACTERISTIC KL_TANZYL_ML_GES_RATIO "Faktor Luftmassenstrom fuer TANZYL-Modell" CURVE 0x77B4A TKL_SW_VV_UW 100.0 FORMULA_0295 0.0 2.0000 /begin AXIS_DESCR STD_AXIS FORMULA_0112 6 -100.0000 1400.0000 FORMAT "%4.1" /end AXIS_DESCR FORMAT "%7.4" /end CHARACTERISTIC
/begin CHARACTERISTIC KL_TANZYL_ABREG "Abregung ueber Zeit | EN: Ramp-down over time" CURVE 0x77B64 TKL_UW_VV_UW 100.0 FORMULA_0295 0.0 2.0000 /begin AXIS_DESCR STD_AXIS FORMULA_0600 6 0.0 1092.2500 FORMAT "%5.2" /end AXIS_DESCR FORMAT "%7.4" /end CHARACTERISTIC
/begin CHARACTERISTIC KL_TANZYL_MR_ABREG "Abregung ueber Temperatur Motorraum" CURVE 0x77B7E TKL_UW_VV_UW 100.0 FORMULA_0295 0.0 2.0000 /begin AXIS_DESCR STD_AXIS FORMULA_0600 6 0.0 1092.2500 FORMAT "%5.2" /end AXIS_DESCR FORMAT "%7.4" /end CHARACTERISTIC
/begin CHARACTERISTIC KL_TANZYL_MR_TUMG_KAL "Wichtung von Differenz tm - tumg" CURVE 0x77B98 TKL_SW_VV_UW 100.0 FORMULA_0295 0.0 2.0000 /begin AXIS_DESCR STD_AXIS FORMULA_0023 6 -50.0000 170.0000 FORMAT "%4.1" /end AXIS_DESCR FORMAT "%7.4" /end CHARACTERISTIC
/* ------------------ Abschnitt erzeugt aus te.dat ------------------ */
/begin CHARACTERISTIC K_TE_A_MIN "min. Querschnittsflaeche TEV | EN: min. Querschnittsflaeche TEV" VALUE 0x77BB4 TKW_VV_VV_UW 100.0 FORMULA_1147 0.0 65.5350 FORMAT "%6.3" /end CHARACTERISTIC
/begin CHARACTERISTIC K_TE_C_AKF_HYS "Hys.-C-AKF-Schwelle f. Dauer-SPUELEN" VALUE 0x77BB6 TKW_VV_VV_UW 100.0 FORMULA_0556 0.0 2.0000 FORMAT "%7.4" /end CHARACTERISTIC
/begin CHARACTERISTIC K_TE_C_AKF_MAX "Abbruch Spuelen, wenn c_akf groesser" VALUE 0x77BB8 TKW_VV_VV_UW 100.0 FORMULA_0556 0.0 6.0000 FORMAT "%7.4" /end CHARACTERISTIC
/begin CHARACTERISTIC K_TE_C_AKF_MAX_HYS "Abbruch-C-AKF-Schwelle f. Dauer-SPUELEN" VALUE 0x77BBA TKW_VV_VV_UW 100.0 FORMULA_0556 0.0 2.0000 FORMAT "%7.4" /end CHARACTERISTIC
/begin CHARACTERISTIC K_TE_C_AKF_MIN "Abbruch Spuelen, wenn c_akf kleiner" VALUE 0x77BBC TKW_VV_VV_UW 100.0 FORMULA_0556 0.0 2.0000 FORMAT "%7.4" /end CHARACTERISTIC
/begin CHARACTERISTIC K_TE_C_AKF_DYN_DELTA_RF "Dynamikschwelle RF f�r c_akf-Filter stoppen" VALUE 0x77BBE TKW_VV_VV_SW 100.0 FORMULA_0007 0.0 2.0000 FORMAT "%6.3" /end CHARACTERISTIC
/begin CHARACTERISTIC K_TE_C_AKF_RESET "RESET C-AKF-Zustandsautomat | EN: 0 inaktiv 1 aktiv RESET C -AKF- Zustandsautomat" VALUE 0x77BC0 TKW_VV_VV_UB 100.0 FORMULA_0839 0.0 1.0 /end CHARACTERISTIC
/begin CHARACTERISTIC K_TE_C_APPL "RESET C-AKF-Konzentration | EN: RESET C -AKF-Konzentration" VALUE 0x77BC2 TKW_VV_VV_UW 100.0 FORMULA_0556 0.0 6.0000 FORMAT "%7.4" /end CHARACTERISTIC
/begin CHARACTERISTIC K_TE_C_LERN_RED_TAU "Filterkonstante c_akf reduziertes Lernen | EN: Filterkonstante c_akf r e-duziertes Lernen" VALUE 0x77BC4 TKW_VV_VV_UW 100.0 FORMULA_1059 0.1000 6553.5000 FORMAT "%5.2" /end CHARACTERISTIC
/begin CHARACTERISTIC K_TE_C_LERN_TAU "Filterkonstante c_akf normal | EN: Filterkonstante c_akf no r-mal" VALUE 0x77BC6 TKW_VV_VV_UW 100.0 FORMULA_1059 0.1000 6553.5000 FORMAT "%5.2" /end CHARACTERISTIC
/begin CHARACTERISTIC K_TE_C_MAX "max. AKF-Konzentration | EN: max. fuer te_c_akf_vor_filt" VALUE 0x77BC8 TKW_VV_VV_UW 100.0 FORMULA_0556 0.0 6.0000 FORMAT "%7.4" /end CHARACTERISTIC
/begin CHARACTERISTIC K_TE_C_MIN "min. AKF-Konzentration | EN: min. fuer te_c_akf_roh" VALUE 0x77BCA TKW_VV_VV_UW 100.0 FORMULA_0556 0.0 2.0000 FORMAT "%7.4" /end CHARACTERISTIC
/begin CHARACTERISTIC K_TE_C_T_SPUEL_MIN "min. SPUEL-Zeit f. K_TE_C_LERN_TAU | EN: min. SPUEL -Zeit f. K_TE_C_LERN_TAU" VALUE 0x77BCC TKW_VV_VV_UW 100.0 FORMULA_0021 0.0 655.0000 FORMAT "%5.2" /end CHARACTERISTIC
/begin CHARACTERISTIC K_TE_C_T_SPUEL_MAX "max. SPUEL-Zeit f. K_TE_C_LERN_TAU | EN: max. SPUEL -Zeit f. K_TE_C_LERN_TAU" VALUE 0x77BCE TKW_VV_VV_UW 100.0 FORMULA_0021 0.0 655.0000 FORMAT "%5.2" /end CHARACTERISTIC
/begin CHARACTERISTIC K_TE_C_ML_SOLL_MG_MIN "min. te_ml_soll_mg fuer C_AKF-Uebernahme | EN: min. te_ml_soll_mg fuer C_AKF-Uebernahme" VALUE 0x77BD0 TKW_VV_VV_UW 100.0 FORMULA_0752 0.0 1023.9843 FORMAT "%5.2" /end CHARACTERISTIC
/begin CHARACTERISTIC K_TE_C_STAT_DELTA "max. C-Abweichung f. eingependelte Adapt. | EN: max. C -Abweichung f. eingependelte Adapt." VALUE 0x77BD2 TKW_VV_VV_UW 100.0 FORMULA_0556 0.0 2.0000 FORMAT "%7.4" /end CHARACTERISTIC
/begin CHARACTERISTIC K_TE_C_STAT_T "min. Zeit f. eingependelte Adapt. | EN: min. Zeit f. eingependelte Adapt." VALUE 0x77BD4 TKW_VV_VV_UW 100.0 FORMULA_0021 0.0 655.0000 FORMAT "%5.2" /end CHARACTERISTIC
/begin CHARACTERISTIC K_TE_C_X_MIN "min. Spuelluftanteil - zu Uebergang LERNEN | EN: min. Spuelluftanteil -  zu Uebergang LERNEN" VALUE 0x77BD6 TKW_VV_VV_UW 100.0 FORMULA_0024 0.0 1.9999 FORMAT "%7.4" /end CHARACTERISTIC
/begin CHARACTERISTIC K_TE_CFG "Freigabe TE" VALUE 0x77BD8 TKW_VV_VV_UB 100.0 FORMULA_1148 0.0 2.0 /end CHARACTERISTIC
/begin CHARACTERISTIC K_TE_DR_REL_MAX_SYNC "n-Schwelle f. sychn. Ansteuerfrequenz" VALUE 0x77BDA TKW_VV_VV_SW 100.0 FORMULA_0115 0.0 199.9938 FORMAT "%5.2" /end CHARACTERISTIC
/begin CHARACTERISTIC K_TE_DYN_DELTA_RF "RF-Delta f. Sperre c_akf-Filterung | EN: RF-Delta f. Sperre c_akf -Filterung" VALUE 0x77BDC TKW_VV_VV_SW 100.0 FORMULA_0007 0.0 2.0000 FORMAT "%6.3" /end CHARACTERISTIC
/begin CHARACTERISTIC K_TE_DYN_RF_T "Sperrzeit c_akf-Filterung nach rf-Dynamik | EN: Sperrzeit c_akf -Filterung nach rf-Dynamik" VALUE 0x77BDE TKW_VV_VV_UW 100.0 FORMULA_0021 0.0 655.0000 FORMAT "%5.2" /end CHARACTERISTIC
/begin CHARACTERISTIC K_TE_GW_F_KATD "Verlaeng. Schliessrampe bei Katdiag | EN: Verlaeng. Schliessrampe bei Katdiag" VALUE 0x77BE0 TKW_VV_VV_UB 100.0 FORMULA_0655 0.0 7.9687 /end CHARACTERISTIC
/begin CHARACTERISTIC K_TE_GW_LAA_FETT "LAA_F_TE-Fett-Schwelle f. GW" VALUE 0x77BE2 TKW_VV_VV_SW 100.0 FORMULA_0024 -1.0000 0.9999 FORMAT "%7.4" /end CHARACTERISTIC
/begin CHARACTERISTIC K_TE_GW_LAM_DELTA_FETT "LAM_Delta_F-Fett-Schwelle f. GW" VALUE 0x77BE4 TKW_VV_VV_SW 100.0 FORMULA_0025 -2.0000 1.9999 FORMAT "%6.3" /end CHARACTERISTIC
/begin CHARACTERISTIC K_TE_GW_LAM_DELTA_MAGER "LAM_Delta-Mager-Schwelle f. GW | EN: LAM_Delta-Mager-Schwelle f. GW" VALUE 0x77BE6 TKW_VV_VV_SW 100.0 FORMULA_0025 -2.0000 1.9999 FORMAT "%6.3" /end CHARACTERISTIC
/begin CHARACTERISTIC K_TE_GW_LAM_DELTA_HYS "LAM_Delta_F-Hysterese f. GW | EN: LAM_Delta_F-Hysterese f. GW" VALUE 0x77BE8 TKW_VV_VV_UW 100.0 FORMULA_0025 0.0 3.9990 FORMAT "%6.3" /end CHARACTERISTIC
/begin CHARACTERISTIC K_TE_GW_LAM_REG_FETT "LAM-REG-Fett-Schwelle f. GW | EN: LAM-REG-Fett-Schwelle f. GW" VALUE 0x77BEA TKW_VV_VV_UW 100.0 FORMULA_0024 0.0 1.9990 FORMAT "%7.4" /end CHARACTERISTIC
/begin CHARACTERISTIC K_TE_GW_LAM_REG_MAGER "LAM-REG-Mager-Schwelle f. GW | EN: LAM-REG-Mager-Schwelle f. GW" VALUE 0x77BEC TKW_VV_VV_UW 100.0 FORMULA_0024 0.0 1.9990 FORMAT "%7.4" /end CHARACTERISTIC
/begin CHARACTERISTIC K_TE_GW_LAM_REG_HYS "LAM-REG-Hysterese f. GW | EN: LAM-REG-Hysterese f. GW" VALUE 0x77BEE TKW_VV_VV_UW 100.0 FORMULA_0024 0.0 1.9990 FORMAT "%7.4" /end CHARACTERISTIC
/begin CHARACTERISTIC K_TE_LAA_F_TE_MCS "MCS-Faktor fuer laa_f_te | EN: 0 inaktiv 1 aktiv MCS-Faktor fuer laa_f_te" VALUE 0x77BF0 TKW_VV_VV_UB 100.0 FORMULA_0839 0.0 1.0 /end CHARACTERISTIC
/begin CHARACTERISTIC K_TE_LAM_SOLL_MAX "max. LA-SOLL-Schwelle f. TE-Freigabe | EN: max. LA-SOLL-Schwelle f. TE-Freigabe" VALUE 0x77BF2 TKW_VV_VV_UW 100.0 FORMULA_0025 0.0 3.9990 FORMAT "%6.3" /end CHARACTERISTIC
/begin CHARACTERISTIC K_TE_LAM_SOLL_MIN "min. LA-SOLL-Schwelle f. TE-Freigabe | EN: min. LA- SOLL-Schwelle f. TE-Freigabe" VALUE 0x77BF4 TKW_VV_VV_UW 100.0 FORMULA_0025 0.0 3.9990 FORMAT "%6.3" /end CHARACTERISTIC
/begin CHARACTERISTIC K_TE_M_MAX_ML_CFG "TE_M_MAX_ML - Auswahl" VALUE 0x77BF6 TKW_VV_VV_UB 100.0 FORMULA_1149 0.0 1.0 /end CHARACTERISTIC
/begin CHARACTERISTIC K_TE_MKS_F_MAX "max Wert fuer te_mks_f | EN: max Wert fuer te_mks_f" VALUE 0x77BF8 TKW_VV_VV_UW 100.0 FORMULA_1142 0.0 1008.2307 FORMAT "%5.2" /end CHARACTERISTIC
/begin CHARACTERISTIC K_TE_MKS_F_AEBG_SCHW_NEG "Schwelle fuer neg. Rampe | EN: Schwelle te_lam_ges fuer neg. Rampe" VALUE 0x77BFA TKW_VV_VV_SW 100.0 FORMULA_0024 0.0 0.9999 FORMAT "%7.4" /end CHARACTERISTIC
/begin CHARACTERISTIC K_TE_MKS_F_AEBG_SCHW_POS "Schwelle fuer pos. Rampe | EN: Schwelle te_lam_ges fuer pos. Rampe" VALUE 0x77BFC TKW_VV_VV_SW 100.0 FORMULA_0024 -1.0000 0.0 FORMAT "%7.4" /end CHARACTERISTIC
/begin CHARACTERISTIC K_TE_MKS_F_NEG "neg. Grad. f. Aenderungsbegr. Faktor auf TE | EN: max. Lambda -Aenderung je Sekunde" VALUE 0x77BFE TKW_VV_VV_UW 100.0 FORMULA_1142 0.0 1008.2307 FORMAT "%5.2" /end CHARACTERISTIC
/begin CHARACTERISTIC K_TE_MKS_F_POS "pos. Grad. f. Aenderungsbegr. Faktor auf TE | EN: max. Lambda- Aenderung je Sekunde" VALUE 0x77C00 TKW_VV_VV_UW 100.0 FORMULA_1142 0.0 1008.2307 FORMAT "%5.2" /end CHARACTERISTIC
/begin CHARACTERISTIC K_TE_MKS_LAM_WICHT "Wichtungsfaktor auf lam_delta fuer te_mks_f-Berechnung" VALUE 0x77C02 TKW_VV_VV_UB 100.0 FORMULA_0643 0.0 1.9921 /end CHARACTERISTIC
/begin CHARACTERISTIC K_TE_MZYL_SEC_F "Wicht-Fakor auf te_ml_soll fuer sec. Einfluss te_ml_ist | EN: Wicht-Fakor auf te_ml_soll fuer sec. Einfluss te_ml_ist" VALUE 0x77C03 TKW_VV_VV_UB 100.0 FORMULA_0643 0.0 1.9921 /end CHARACTERISTIC
/begin CHARACTERISTIC K_TE_N_DYN_DELTA "N-Delta f. Erkennung N-stat." VALUE 0x77C04 TKW_VV_VV_SW 100.0 FORMULA_0006 0.0 10000.0000 /end CHARACTERISTIC
/begin CHARACTERISTIC K_TE_N_MAX_SYNC1 "n-Schwelle f. sychn. Ansteuerfrequenz" VALUE 0x77C06 TKW_VV_VV_SW 100.0 FORMULA_0006 0.0 10000.0000 /end CHARACTERISTIC
/begin CHARACTERISTIC K_TE_R_C3H8 "Gaskonstante C3H8 | EN: Gaskonstante C3H8" VALUE 0x77C08 TKW_VV_VV_UW 100.0 FORMULA_1143 0.0 65535.0000 FORMAT "%6.3" /end CHARACTERISTIC
/begin CHARACTERISTIC K_TE_R_LUFT "Gaskonstante LUFT | EN: Gaskonstante LUFT" VALUE 0x77C0A TKW_VV_VV_UW 100.0 FORMULA_1143 0.0 65535.0000 FORMAT "%6.3" /end CHARACTERISTIC
/begin CHARACTERISTIC K_TE_RESET_CFG "RESET TE-Zustandsautomat" VALUE 0x77C0C TKW_VV_VV_UB 100.0 FORMULA_0839 0.0 1.0 /end CHARACTERISTIC
/begin CHARACTERISTIC K_TE_RF_DYN_DELTA "RF-Delta f. Erkennung RF-stat." VALUE 0x77C0E TKW_VV_VV_SW 100.0 FORMULA_0007 0.0 2.0000 FORMAT "%6.3" /end CHARACTERISTIC
/begin CHARACTERISTIC K_TE_STOECH "stoechometrischer Faktor | EN: stoechometrischer Faktor" VALUE 0x77C10 TKW_VV_VV_UW 100.0 FORMULA_0805 0.0 511.9921 FORMAT "%5.2" /end CHARACTERISTIC
/begin CHARACTERISTIC K_TE_T_LAA "TE-LAA Zeit | EN: TE_LAA und SPUELEN_WARTE_LAA Zeit" VALUE 0x77C12 TKW_VV_VV_UW 100.0 FORMULA_0021 0.0 655.0000 FORMAT "%5.2" /end CHARACTERISTIC
/begin CHARACTERISTIC K_TE_T_LAA_HS_INI "ununterbrech. TE-LAA aus HS" VALUE 0x77C14 TKW_VV_VV_UW 100.0 FORMULA_0021 0.0 655.0000 FORMAT "%5.2" /end CHARACTERISTIC
/begin CHARACTERISTIC K_TE_T_LAA_INI "ununterbrech. TE-LAA | EN: TE_LAA_INI-Zeit Norma l-start" VALUE 0x77C16 TKW_VV_VV_UW 100.0 FORMULA_0021 0.0 655.0000 FORMAT "%5.2" /end CHARACTERISTIC
/begin CHARACTERISTIC K_TE_T_LANG "min te_t_spuel fuer Ueberg. in TE_LAA | EN: min te_t_spuel fuer Ueberg. in TE_LAA" VALUE 0x77C18 TKW_VV_VV_UW 100.0 FORMULA_0021 0.0 655.0000 FORMAT "%5.2" /end CHARACTERISTIC
/begin CHARACTERISTIC K_TE_T_MIN "min. te_t_spuel bei B_TE_ABBR fuer Uebergang in TE_LAA | EN: min. te_t_spuel bei B_TE_ABBR fuer Uebe r- gang in TE_LAA" VALUE 0x77C1A TKW_VV_VV_UW 100.0 FORMULA_0021 0.0 655.0000 FORMAT "%5.2" /end CHARACTERISTIC
/begin CHARACTERISTIC K_TE_T_ML_LANG "time_ml fuer Uebergang TE-SPUELEN LANG" VALUE 0x77C1C TKW_VV_VV_UW 100.0 FORMULA_0021 0.0 655.0000 FORMAT "%5.2" /end CHARACTERISTIC
/begin CHARACTERISTIC K_TE_T_NORM "max. te_t_spuel bei TE-SPUELEN KURZ | EN: max. te_t_spuel bei SPUELEN_KURZ" VALUE 0x77C1E TKW_VV_VV_UW 100.0 FORMULA_0021 0.0 655.0000 FORMAT "%5.2" /end CHARACTERISTIC
/begin CHARACTERISTIC K_TE_T_SPUEL_INI "ununterbrech. TE-SPUELEN | EN: ununterbrech. TE -SPUELEN [V912: differs from V452 160E]" VALUE 0x77C20 TKW_VV_VV_UW 100.0 FORMULA_0021 0.0 655.0000 FORMAT "%5.2" /end CHARACTERISTIC
/begin CHARACTERISTIC K_TE_TAN_MIN_LL "TAN-Schwelle im LL fuer ABBRUCH TE" VALUE 0x77C22 TKW_VV_VV_SW 100.0 FORMULA_0023 -50.0000 170.0000 FORMAT "%4.1" /end CHARACTERISTIC
/begin CHARACTERISTIC K_TE_TI_MIN_DIFF "Min Abstand ti_tpu zu ti_bj.min | EN: Min Abstand ti_tpu zu ti_bj.min" VALUE 0x77C24 TKW_VV_VV_UW 100.0 FORMULA_0786 0.0 65.5350 FORMAT "%5.2" /end CHARACTERISTIC
/begin CHARACTERISTIC K_TE_TMOT "TMOT-Schwelle f. Freigabe | EN: TMOT-Schwelle f. Freig a-be" VALUE 0x77C26 TKW_VV_VV_SW 100.0 FORMULA_0023 -50.0000 170.0000 FORMAT "%4.1" /end CHARACTERISTIC
/begin CHARACTERISTIC K_TE_TMOT_START_HS "min. tmot_start Heisstarterkennung | EN: min. tmot_start Heisstarterkennung" VALUE 0x77C28 TKW_VV_VV_SW 100.0 FORMULA_0023 -50.0000 170.0000 FORMAT "%4.1" /end CHARACTERISTIC
/begin CHARACTERISTIC K_TE_TMOT_START_LANG "min. tmot_start f. TE-SPUELEN-LANG" VALUE 0x77C2A TKW_VV_VV_SW 100.0 FORMULA_0023 -50.0000 170.0000 FORMAT "%4.1" /end CHARACTERISTIC
/begin CHARACTERISTIC K_TE_TV_MIN "min. Tastverhaeltnis TEV | EN: Freigabe TE" VALUE 0x77C2C TKW_VV_VV_UW 100.0 FORMULA_0001 0.0 100.0000 FORMAT "%4.1" /end CHARACTERISTIC
/begin CHARACTERISTIC K_TE_TV_MAX "max. Tastverhaeltnis TEV | EN: max. Tastverhaeltnis TEV" VALUE 0x77C2E TKW_VV_VV_UW 100.0 FORMULA_0001 0.0 100.0000 FORMAT "%4.1" /end CHARACTERISTIC
/begin CHARACTERISTIC K_TE_VAN_DYN_DELTA "VAN_VO-Delta f. Erkennung VAN-VO-stat." VALUE 0x77C30 TKW_VV_VV_SW 100.0 FORMULA_0111 -80.0000 80.0000 FORMAT "%4.1" /end CHARACTERISTIC
/begin CHARACTERISTIC K_TE_X_MKS_APPL "applikativer Soll-MKS-Anteil" VALUE 0x77C32 TKW_VV_VV_UW 100.0 FORMULA_0024 0.0 1.9999 FORMAT "%7.4" /end CHARACTERISTIC
/begin CHARACTERISTIC K_TE_X_MKS_CFG "te_x_mks - Auswahl | EN: te_x_mks - Auswahl" VALUE 0x77C34 TKW_VV_VV_UB 100.0 FORMULA_1150 0.0 1.0 /end CHARACTERISTIC
/begin CHARACTERISTIC K_TE_X_ML_SOLL_APPL "applikatives te_x_ml_soll" VALUE 0x77C36 TKW_VV_VV_UW 100.0 FORMULA_0024 0.0 1.9999 FORMAT "%7.4" /end CHARACTERISTIC
/begin CHARACTERISTIC K_TE_X_ML_SOLL_CFG "te_x_ml_soll - Auswahl | EN: 0 Rampe B1,B2 1 Appl B1, Rampe B2 2 Rampe B1, Appl B2 3 Appl B1,B2 te_x_ml_soll - Auswahl" VALUE 0x77C38 TKW_VV_VV_UW 100.0 FORMULA_1151 0.0 1.0 FORMAT "%5.2" /end CHARACTERISTIC
/begin CHARACTERISTIC K_TE_X_ML_SOLL_MAX "max. Spuelluftanteil f. System | EN: max. Spuelluftanteil f. System" VALUE 0x77C3A TKW_VV_VV_UW 100.0 FORMULA_0024 0.0 1.9999 FORMAT "%7.4" /end CHARACTERISTIC
/begin CHARACTERISTIC K_TE_X_ML_SOLL_MIN "min. gewuenschter Durchsatz | EN: min. gewuenschter Durchsatz" VALUE 0x77C3C TKW_VV_VV_UW 100.0 FORMULA_0024 0.0 1.9999 FORMAT "%7.4" /end CHARACTERISTIC
/begin CHARACTERISTIC K_TE_X_ML_SOLL_GW_MIN "min. Durchsatz bei Grenzwertregelung" VALUE 0x77C3E TKW_VV_VV_UW 100.0 FORMULA_0024 0.0 1.9999 FORMAT "%7.4" /end CHARACTERISTIC
/begin CHARACTERISTIC K_TE_ZU_GW "TEV Zufahrtzeit - Grenzwert" VALUE 0x77C40 TKW_VV_VV_UW 100.0 FORMULA_0073 0.0 6553.5000 FORMAT "%4.1" /end CHARACTERISTIC
/begin CHARACTERISTIC K_TE_ZU_LERN "TEV Zufahrtzeit - LERNEN | EN: TEV Zufahrtzeit - LERNEN" VALUE 0x77C42 TKW_VV_VV_UW 100.0 FORMULA_0073 0.0 6553.5000 FORMAT "%4.1" /end CHARACTERISTIC
/begin CHARACTERISTIC K_TE_ZU_NORM "TEV Zufahrtzeit - Normalbetrieb | EN: TEV Zufahrtzeit - Normal-betrieb" VALUE 0x77C44 TKW_VV_VV_UW 100.0 FORMULA_0073 0.0 6553.5000 FORMAT "%4.1" /end CHARACTERISTIC
/begin CHARACTERISTIC K_TE_ZU_SA "TEV Zufahrtzeit - B_ZUST_SA | EN: TEV Zufahrtzeit -  B_ZUST_SA" VALUE 0x77C46 TKW_VV_VV_UW 100.0 FORMULA_0073 0.0 6553.5000 FORMAT "%4.1" /end CHARACTERISTIC
/begin CHARACTERISTIC KL_TE_FREQ "Ansteuerfrequenz TE" CURVE 0x77C48 TKL_SW_VV_UW 100.0 FORMULA_1082 10.0000 50.0000 /begin AXIS_DESCR STD_AXIS FORMULA_0006 10 0.0 10000.0000 /end AXIS_DESCR FORMAT "%4.1" /end CHARACTERISTIC
/begin CHARACTERISTIC KL_TE_GW_F "Verlaengerung d. Rampenzeit | EN: Extension of ramp time" CURVE 0x77C72 TKL_UW_VV_UW 100.0 FORMULA_0075 0.0 4.0000 /begin AXIS_DESCR STD_AXIS ml FORMULA_0112 5 0.0 3276.8000 FORMAT "%4.1" /end AXIS_DESCR FORMAT "%6.3" /end CHARACTERISTIC
/begin CHARACTERISTIC KL_TE_GW_TI_MIN "Grenzwert ti_min-Regelung | EN: Limit for ti_min control" CURVE 0x77C88 TKL_UW_VV_UW 100.0 FORMULA_0073 0.0 6553.5000
 /begin AXIS_DESCR STD_AXIS te_ti_min_diff FORMULA_0786 5 0.0 65.5350 FORMAT "%5.2" /end AXIS_DESCR
 FORMAT "%4.1" /end CHARACTERISTIC
/begin CHARACTERISTIC KL_TE_MKS_XSI "Ausflusskoeffizient - MKS | EN: Discharge coefficient - injection with clutch closed" CURVE 0x77C9E TKL_SW_VV_UW 100.0 FORMULA_1034 0.0 65.5350
 /begin AXIS_DESCR STD_AXIS psau_rel FORMULA_0115 14 0.0 120.0000 FORMAT "%5.2" /end AXIS_DESCR
 FORMAT "%6.3" /end CHARACTERISTIC
/begin CHARACTERISTIC KL_TE_ML_XSI "Ausflusskoeffizient - ML | EN: Discharge coefficient - air mass" CURVE 0x77CD8 TKL_SW_VV_UW 100.0 FORMULA_1034 0.0 65.5350
 /begin AXIS_DESCR STD_AXIS psau_rel FORMULA_0115 14 0.0 120.0000 FORMAT "%5.2" /end AXIS_DESCR
 FORMAT "%6.3" /end CHARACTERISTIC
/begin CHARACTERISTIC KL_TE_SYNC_FREQ "segm.synch. Ansteuerfrequenz | EN: Segment-synchronous drive frequency" CURVE 0x77D12 TKL_SW_VV_UW 100.0 FORMULA_1082 10.0000 50.0000 /begin AXIS_DESCR STD_AXIS FORMULA_0006 2 0.0 10000.0000 /end AXIS_DESCR FORMAT "%4.1" /end CHARACTERISTIC
/begin CHARACTERISTIC KL_TE_T_BEGIN_MIN "Verzoegerungszeit - TE-Freigabe | EN: Delay time - purge enable" CURVE 0x77D1C TKL_SW_VV_UW 100.0 FORMULA_0021 0.0 655.0000
 /begin AXIS_DESCR STD_AXIS tmot_start FORMULA_0023 6 -50.0000 170.0000 FORMAT "%4.1" /end AXIS_DESCR
 FORMAT "%5.2" /end CHARACTERISTIC
/begin CHARACTERISTIC KL_TE_TI_MIN "TE - TI-Min | EN: Purge - minimum injection time" CURVE 0x77D36 TKL_SW_VV_UW 100.0 FORMULA_0752 0.0 1023.9843 /begin AXIS_DESCR STD_AXIS FORMULA_0118 5 0.0 10.0000 FORMAT "%6.3" /end AXIS_DESCR FORMAT "%5.2" /end CHARACTERISTIC
/begin CHARACTERISTIC KL_TE_YPS_SQRT "Darstellung Wurzel-Stroemungsgeschwindigkeit | EN: Square-root representation of flow velocity" CURVE 0x77D4C TKL_UW_VV_UW 100.0 FORMULA_1152 0.0 196605.0000
 /begin AXIS_DESCR STD_AXIS te_ml_mks_yps_quad FORMULA_1140 10 0.0 589815.0000 /end AXIS_DESCR
/end CHARACTERISTIC
/begin CHARACTERISTIC KF_TE_ANZUGSZEIT "Anzugszeit TEV | EN: Pull-in time, purge valve" MAP 0x77D76 TKF_UW_UW_UW 100.0 FORMULA_0998 0.0 655.3500 /begin AXIS_DESCR STD_AXIS FORMULA_1082 5 10.0000 50.0000 FORMAT "%4.1" /end AXIS_DESCR /begin AXIS_DESCR STD_AXIS FORMULA_0008 5 0.0 28.0000 FORMAT "%4.1" /end AXIS_DESCR FORMAT "%5.2" /end CHARACTERISTIC
/begin CHARACTERISTIC KF_TE_GW_RAMPEN "betriebspunktabh. Rampenzeit | EN: Operating-point-dependent ramp time" MAP 0x77DBE TKF_SW_SW_UW 100.0 FORMULA_0073 0.0 6553.5000
 /begin AXIS_DESCR STD_AXIS te_lam_delta FORMULA_0025 9 -2.0000 1.9999 FORMAT "%6.3" /end AXIS_DESCR
 /begin AXIS_DESCR STD_AXIS FORMULA_0556 5 0.0 2.0000 FORMAT "%7.4" /end AXIS_DESCR
 FORMAT "%4.1" /end CHARACTERISTIC
/begin CHARACTERISTIC KF_TE_M_MAX_ML "max. Durchfluss Luft bei 100% tv und Normbed." MAP 0x77E36 TKF_SW_SW_UW 100.0 FORMULA_0561 0.0 65.5350
 /begin AXIS_DESCR STD_AXIS te_psau_diff FORMULA_0077 12 0.0 2000.0000 FORMAT "%4.1" /end AXIS_DESCR
 /begin AXIS_DESCR STD_AXIS FORMULA_0006 8 0.0 10000.0000 /end AXIS_DESCR
 FORMAT "%6.3" /end CHARACTERISTIC
/begin CHARACTERISTIC KF_TE_TV_NORM "normiertes Tastverhaeltnis | EN: Normalised duty cycle" MAP 0x77F20 TKF_UW_UW_UW 100.0 FORMULA_0001 0.0 100.0000
 /begin AXIS_DESCR STD_AXIS te_tv_rel FORMULA_1144 11 0.0 65.5350 FORMAT "%7.4" /end AXIS_DESCR
 /begin AXIS_DESCR STD_AXIS FORMULA_1082 5 10.0000 50.0000 FORMAT "%4.1" /end AXIS_DESCR
 FORMAT "%4.1" /end CHARACTERISTIC
/begin CHARACTERISTIC KF_TE_X_SOLL_KATD "Spuelluftanteil bei Katdiagnose" MAP 0x77FB0 TKF_SW_SW_UW 100.0 FORMULA_0024 0.0 1.9999 /begin AXIS_DESCR STD_AXIS FORMULA_0006 8 0.0 10000.0000 /end AXIS_DESCR
 /begin AXIS_DESCR STD_AXIS psau.asp FORMULA_0077 8 0.0 2000.0000 FORMAT "%4.1" /end AXIS_DESCR
 FORMAT "%7.4" /end CHARACTERISTIC
/begin CHARACTERISTIC KF_TE_X_SOLL_MKS "betriebspunktabh. Kraftstoffanteil | EN: betriebspunktabh. Kraftstof f-anteil" MAP 0x78052 TKF_SW_SW_UW 100.0 FORMULA_0024 0.0 1.9999 /begin AXIS_DESCR STD_AXIS FORMULA_0006 8 0.0 10000.0000 /end AXIS_DESCR
 /begin AXIS_DESCR STD_AXIS psau.asp FORMULA_0077 8 0.0 2000.0000 FORMAT "%4.1" /end AXIS_DESCR
 FORMAT "%7.4" /end CHARACTERISTIC
/begin CHARACTERISTIC KF_TE_X_SOLL_N_PSAU "Spuelluftanteil im Normalbetrieb" MAP 0x780F4 TKF_SW_SW_UW 100.0 FORMULA_0024 0.0 1.9999 /begin AXIS_DESCR STD_AXIS FORMULA_0006 8 0.0 10000.0000 /end AXIS_DESCR
 /begin AXIS_DESCR STD_AXIS psau.asp FORMULA_0077 8 0.0 2000.0000 FORMAT "%4.1" /end AXIS_DESCR
 FORMAT "%7.4" /end CHARACTERISTIC
/begin CHARACTERISTIC KF_TE_X_SOLL_NOT "Spuelluftanteil bei NOTLAUF | EN: Spuelluftanteil bei NOTLAUF" MAP 0x78196 TKF_SW_SW_UW 100.0 FORMULA_0024 0.0 1.9999 /begin AXIS_DESCR STD_AXIS FORMULA_0006 8 0.0 10000.0000 /end AXIS_DESCR
 /begin AXIS_DESCR STD_AXIS psau.asp FORMULA_0077 8 0.0 2000.0000 FORMAT "%4.1" /end AXIS_DESCR
 FORMAT "%7.4" /end CHARACTERISTIC
/* ------------------ Abschnitt erzeugt aus testfunktion.dat ------------------ */
/begin CHARACTERISTIC K_TEST "Maxwert" VALUE 0x78280 TKW_VV_VV_UW 100.0 FORMULA_0010 0.0 65535.0000 /end CHARACTERISTIC
/begin CHARACTERISTIC K_TEST_X "Testwert-x" VALUE 0x78282 TKW_VV_VV_UW 100.0 FORMULA_0010 0.0 65535.0000 /end CHARACTERISTIC
/begin CHARACTERISTIC K_TEST_Y "Testwert-y" VALUE 0x78284 TKW_VV_VV_UW 100.0 FORMULA_0010 0.0 65535.0000 /end CHARACTERISTIC
/begin CHARACTERISTIC K_TEST_LA_BANK1 "Testarray" VALUE 0x78286 TKW_VV_VV_UB 100.0 FORMULA_0003 0.0 255.0000 /end CHARACTERISTIC
/begin CHARACTERISTIC K_TEST_LA_BANK2 "Testarray" VALUE 0x78287 TKW_VV_VV_UB 100.0 FORMULA_0003 0.0 255.0000 /end CHARACTERISTIC
/begin CHARACTERISTIC K_TEST_MD_ZYL1 "Testarray" VALUE 0x78288 TKW_VV_VV_UB 100.0 FORMULA_0003 0.0 255.0000 /end CHARACTERISTIC
/begin CHARACTERISTIC K_TEST_MD_ZYL2 "Testarray" VALUE 0x78289 TKW_VV_VV_UB 100.0 FORMULA_0003 0.0 255.0000 /end CHARACTERISTIC
/begin CHARACTERISTIC K_TEST_MD_ZYL3 "Testarray" VALUE 0x7828A TKW_VV_VV_UB 100.0 FORMULA_0003 0.0 255.0000 /end CHARACTERISTIC
/begin CHARACTERISTIC K_TEST_MD_ZYL4 "Testarray" VALUE 0x7828B TKW_VV_VV_UB 100.0 FORMULA_0003 0.0 255.0000 /end CHARACTERISTIC
/begin CHARACTERISTIC K_TEST_MD_ZYL5 "Testarray" VALUE 0x7828C TKW_VV_VV_UB 100.0 FORMULA_0003 0.0 255.0000 /end CHARACTERISTIC
/begin CHARACTERISTIC K_TEST_MD_ZYL6 "Testarray" VALUE 0x7828D TKW_VV_VV_UB 100.0 FORMULA_0003 0.0 255.0000 /end CHARACTERISTIC
/begin CHARACTERISTIC K_TEST_MD_ZYL7 "Testarray" VALUE 0x7828E TKW_VV_VV_UB 100.0 FORMULA_0003 0.0 255.0000 /end CHARACTERISTIC
/begin CHARACTERISTIC K_TEST_MD_ZYL8 "Testarray" VALUE 0x7828F TKW_VV_VV_UB 100.0 FORMULA_0003 0.0 255.0000 /end CHARACTERISTIC
/begin CHARACTERISTIC K_TEST_MD_ZYL9 "Testarray" VALUE 0x78290 TKW_VV_VV_UB 100.0 FORMULA_0003 0.0 255.0000 /end CHARACTERISTIC
/begin CHARACTERISTIC K_TEST_MD_ZYL10 "Testarray" VALUE 0x78291 TKW_VV_VV_UB 100.0 FORMULA_0003 0.0 255.0000 /end CHARACTERISTIC
/begin CHARACTERISTIC K_TEST_MD_ZYL11 "Testarray" VALUE 0x78292 TKW_VV_VV_UB 100.0 FORMULA_0003 0.0 255.0000 /end CHARACTERISTIC
/begin CHARACTERISTIC K_TEST_MD_ZYL12 "Testarray" VALUE 0x78293 TKW_VV_VV_UB 100.0 FORMULA_0003 0.0 255.0000 /end CHARACTERISTIC
/begin CHARACTERISTIC KL_TEST_X "Testkennlinie" CURVE 0x78294 TKL_UW_VV_UW 100.0 FORMULA_0083 0.0 65535.0000 /begin AXIS_DESCR STD_AXIS ein_x FORMULA_0010 4 0.0 65535.0000 /end AXIS_DESCR FORMAT "%5.2" /end CHARACTERISTIC
/begin CHARACTERISTIC KF_TEST_XY "Testkennfeld" MAP 0x782A6 TKF_UW_UW_UW 100.0 FORMULA_0010 0.0 65535.0000 /begin AXIS_DESCR STD_AXIS ein_x FORMULA_0010 5 0.0 65535.0000 /end AXIS_DESCR /begin AXIS_DESCR STD_AXIS ein_y FORMULA_0010 3 0.0 65535.0000 /end AXIS_DESCR /end CHARACTERISTIC
/* ------------------ Abschnitt erzeugt aus te_obd.dat ------------------ */
/begin CHARACTERISTIC K_TE_OBD_AUSS_DELTA "min. auss_lp_int-Reaktion fuer OK | EN: min. auss_int -Reaktion fuer OK" VALUE 0x78238 TKW_VV_VV_SW 100.0 FORMULA_0709 -200.0000 200.0000 FORMAT "%4.1" /end CHARACTERISTIC
/begin CHARACTERISTIC K_TE_OBD_AUSS_DELTA_NEG "min. negative auss_lp_int-Reaktion fuer OK | EN: min. negative auss_lp_int -Reaktion fuer OK" VALUE 0x7823A TKW_VV_VV_SW 100.0 FORMULA_0709 -200.0000 200.0000 FORMAT "%4.1" /end CHARACTERISTIC
/begin CHARACTERISTIC K_TE_OBD_AUSS_TAU "Filterzeitkonstante fur auss_lp_int_sum | EN: Filterzeitkonstante fur auss_lp_int_sum" VALUE 0x7823C TKW_VV_VV_UB 100.0 FORMULA_0664 0.0101 2.5600 /end CHARACTERISTIC
/begin CHARACTERISTIC K_TE_OBD_ML_TAU "Filterzeitkonstante fur ml_hfm_roh | EN: Filterzeitkonstante fur ml_hfm_roh" VALUE 0x7823D TKW_VV_VV_UB 100.0 FORMULA_0664 0.0101 2.5600 /end CHARACTERISTIC
/begin CHARACTERISTIC K_TE_OBD_ANZ "max. Anzahl der Durchlaeufe  | EN: 0   max. Anzahl der Durchlaeufe" VALUE 0x7823E TKW_VV_VV_UB 100.0 FORMULA_0003 0.0 255.0000 /end CHARACTERISTIC
/begin CHARACTERISTIC K_TE_OBD_CFG "KKOS-Abwurf / laa_f_bx-Freeze | EN: 0x0 oh- ne_KKOS_Abwurf LAA_reset 0x1 LAA_freeze 0x2 KKOS_Abwurf 0x3 KKOS_Abwurf LAA_freeze 0x4 RESET" VALUE 0x7823F TKW_VV_VV_UB 100.0 FORMULA_1157 0.0 255.0 /end CHARACTERISTIC
/begin CHARACTERISTIC K_TE_OBD_LAM_DELTA "min. Reaktion lam_ist_mw fuer OK | EN: min. Reaktion lam_ist_mw fuer OK" VALUE 0x78240 TKW_VV_VV_UW 100.0 FORMULA_0025 0.0 3.9990 FORMAT "%6.3" /end CHARACTERISTIC
/begin CHARACTERISTIC K_TE_OBD_LAM_FREIG "max. Regelabweichung Reglerfreigabe  | EN: Maximum control error for controller enable" VALUE 0x78242 TKW_VV_VV_UW 100.0 FORMULA_0025 0.0 3.9990 FORMAT "%6.3" /end CHARACTERISTIC
/begin CHARACTERISTIC K_TE_OBD_LL_DELAY "Wartezeit nach Erreichen LL | EN: Wait time after reaching idle [s]" VALUE 0x78244 TKW_VV_VV_UB 100.0 FORMULA_0458 0.0 25.5000 /end CHARACTERISTIC
/begin CHARACTERISTIC K_TE_OBD_LL_DELTA "min. ml/n -Reaktion beim Oeffnen fuer OK | EN: Minimum air mass/rpm reaction on opening for OK [%]" VALUE 0x78246 TKW_VV_VV_SW 100.0 FORMULA_0022 -50.0000 50.0000 FORMAT "%5.2" /end CHARACTERISTIC
/begin CHARACTERISTIC K_TE_OBD_LL_OK "Gesamt-Anzahl noetiger o.K. Reaktionen" VALUE 0x78248 TKW_VV_VV_UB 100.0 FORMULA_0003 0.0 255.0000 /end CHARACTERISTIC
/begin CHARACTERISTIC K_TE_OBD_LAM_OK "Anzahl noetiger LAM-Reaktionen | EN: Number of required lambda reactions" VALUE 0x78249 TKW_VV_VV_UB 100.0 FORMULA_0003 0.0 255.0000 /end CHARACTERISTIC
/begin CHARACTERISTIC K_TE_OBD_LL_ZU_DELTA "min. ml/n-Reaktion beim Schliessen fuer OK | EN: Minimum air mass/rpm reaction on closing for OK [%]" VALUE 0x7824A TKW_VV_VV_SW 100.0 FORMULA_0022 -50.0000 50.0000 FORMAT "%5.2" /end CHARACTERISTIC
/begin CHARACTERISTIC K_TE_OBD_LRW_ABBR "Lenkwinkel-Aenderung fuer Abbruch | EN: Steering-angle change for abort" VALUE 0x7824C TKW_VV_VV_SW 100.0 FORMULA_0141 0.0 1440.1096 FORMAT "%5.2" /end CHARACTERISTIC
/begin CHARACTERISTIC K_TE_OBD_MD_GEN_ABBR "Generatormoment-Aenderung fuer Abbruch | EN: Generator-torque change for abort [Nm]" VALUE 0x7824E TKW_VV_VV_SW 100.0 FORMULA_0121 -3276.8000 3276.7000 FORMAT "%5.2" /end CHARACTERISTIC
/begin CHARACTERISTIC K_TE_OBD_MD_KKOS_ABBR "Md-Aenderung KKOS fuer Abbruch | EN: A/C compressor torque change for abort [Nm]" VALUE 0x78250 TKW_VV_VV_SW 100.0 FORMULA_0129 -100.0000 1000.0000 FORMAT "%4.1" /end CHARACTERISTIC
/begin CHARACTERISTIC K_TE_OBD_ML_MAX "Max. Luftmasse ml_ges | EN: Maximum air mass ml_ges [kg/h]" VALUE 0x78252 TKW_VV_VV_SW 100.0 FORMULA_0112 -100.0000 1400.0000 FORMAT "%4.1" /end CHARACTERISTIC
/begin CHARACTERISTIC K_TE_OBD_N_SOLL_ABBR "Aenderung llr_n_soll fuer Abbruch | EN: Aenderung llr_n_soll fuer Abbruch [V912: differs from V452 160E]" VALUE 0x78254 TKW_VV_VV_SW 100.0 FORMULA_0006 0.0 10000.0000 /end CHARACTERISTIC
/begin CHARACTERISTIC K_TE_OBD_RAMPE_ABBRUCH "Abbruchrampe TEV | EN: Abbruchrampe TEV" VALUE 0x78256 TKW_VV_VV_UW 100.0 FORMULA_1158 0.0 100.0000 FORMAT "%4.1" /end CHARACTERISTIC
/begin CHARACTERISTIC K_TE_OBD_RAMPE_ZU "Abregelrampe TEV | EN: Abregelrampe TEV" VALUE 0x78258 TKW_VV_VV_UW 100.0 FORMULA_1158 0.0 100.0000 FORMAT "%4.1" /end CHARACTERISTIC
/begin CHARACTERISTIC K_TE_OBD_T_LAM_REG_OFF "Max. Sperrzeit Lam-Reg | EN: Max. Sperrzeit Lam-Reg" VALUE 0x7825A TKW_VV_VV_UB 100.0 FORMULA_0458 0.0 25.5000 /end CHARACTERISTIC
/begin CHARACTERISTIC K_TE_OBD_T_MESS_OFFEN "Max. Messzeit bei offenen TEV | EN: Max. Messzeit bei offenen TEV" VALUE 0x7825B TKW_VV_VV_UB 100.0 FORMULA_0458 0.0 25.5000 /end CHARACTERISTIC
/begin CHARACTERISTIC K_TE_OBD_T_MESS_ZU "Max. Messzeit bei geschl. TEV | EN: Max. Messzeit bei geschl. TEV" VALUE 0x7825C TKW_VV_VV_UB 100.0 FORMULA_0458 0.0 25.5000 /end CHARACTERISTIC
/begin CHARACTERISTIC K_TE_OBD_T_ML_MIN "Mindest-Motorlaufzeit | EN: Mindest-Motorlaufzeit" VALUE 0x7825E TKW_VV_VV_UW 100.0 FORMULA_0021 0.0 655.0000 FORMAT "%5.2" /end CHARACTERISTIC
/begin CHARACTERISTIC K_TE_OBD_TOEL_MIN "Mindest toel_modell | EN: Mindest toel_modell" VALUE 0x78260 TKW_VV_VV_SW 100.0 FORMULA_0023 -50.0000 170.0000 FORMAT "%4.1" /end CHARACTERISTIC
/begin CHARACTERISTIC K_TE_OBD_TOEL_MIN_EXD "Mindest toel_modell f�r ext. Diagnose | EN: Mindest toel_modell für ext. Diagnose" VALUE 0x78262 TKW_VV_VV_SW 100.0 FORMULA_0023 -50.0000 170.0000 FORMAT "%4.1" /end CHARACTERISTIC
/begin CHARACTERISTIC K_TE_OBD_TV_MAX "Maximale Oeffnung TEV | EN: Maximum purge-valve opening [%]" VALUE 0x78264 TKW_VV_VV_UW 100.0 FORMULA_0001 0.0 100.0000 FORMAT "%4.1" /end CHARACTERISTIC
/begin CHARACTERISTIC K_TE_OBD_TZ_ABBR "Zuendwinkelaenderung fuer Abbruch | EN: Ignition-angle change for abort [°KW]" VALUE 0x78266 TKW_VV_VV_SW 100.0 FORMULA_0111 -50.0000 60.0000 FORMAT "%4.1" /end CHARACTERISTIC
/begin CHARACTERISTIC K_TE_OBD_UB_ABBR "Spannungsaenderung fuer Abbruch | EN: Voltage change for abort [V]" VALUE 0x78268 TKW_VV_VV_SW 100.0 FORMULA_0008 0.0 28.0000 FORMAT "%4.1" /end CHARACTERISTIC
/begin CHARACTERISTIC KL_TE_OBD_RAMPE "Oeffnungsverlauf beim TEV-Check | EN: Opening profile during purge-valve check" CURVE 0x7826A TKL_UW_VV_UW 100.0 FORMULA_1158 0.0 100.0000
 /begin AXIS_DESCR STD_AXIS te_obd_tv FORMULA_0001 5 0.0 100.0000 FORMAT "%4.1" /end AXIS_DESCR
 FORMAT "%4.1" /end CHARACTERISTIC
/* ------------------ Abschnitt erzeugt aus tksm.dat ------------------ */
/begin CHARACTERISTIC K_TKSM_CFG "Definition der Quelle von tksm" VALUE 0x78EB6 TKW_VV_VV_UB 100.0 FORMULA_1189 0.0 255.0 /end CHARACTERISTIC
/begin CHARACTERISTIC K_TKSM_MR_TAU "Filterkonstante fuer Motorraumtemperatur | EN: Filter constant for engine-bay temperature [s]" VALUE 0x78EB8 TKW_VV_VV_UW 100.0 FORMULA_1059 0.1000 6553.5000 FORMAT "%5.2" /end CHARACTERISTIC
/begin CHARACTERISTIC KL_TKSM_Q_MOT_TAU "Kraftstoffverbrauch zu tau | EN: Fuel consumption to time constant" CURVE 0x78EBA TKL_SW_VV_UW 100.0 FORMULA_1059 0.1000 6553.5000 /begin AXIS_DESCR STD_AXIS FORMULA_0746 6 0.0 256.0000 FORMAT "%4.1" /end AXIS_DESCR FORMAT "%5.2" /end CHARACTERISTIC
/begin CHARACTERISTIC KL_TKSM_Q_MOT_RATIO "Faktor Kraftstoffverbrauch fuer TKSM-Modell | EN: Fuel consumption factor for fuel-temperature model" CURVE 0x78ED4 TKL_SW_VV_UW 100.0 FORMULA_0295 0.0 2.0000 /begin AXIS_DESCR STD_AXIS FORMULA_0746 6 0.0 256.0000 FORMAT "%4.1" /end AXIS_DESCR FORMAT "%7.4" /end CHARACTERISTIC
/begin CHARACTERISTIC KL_TKSM_ABREG "Abregung ueber Zeit | EN: Ramp-down over time" CURVE 0x78EEE TKL_UW_VV_UW 100.0 FORMULA_0295 0.0 2.0000 /begin AXIS_DESCR STD_AXIS FORMULA_0600 6 0.0 1092.2500 FORMAT "%5.2" /end AXIS_DESCR FORMAT "%7.4" /end CHARACTERISTIC
/begin CHARACTERISTIC KL_TKSM_MR_ABREG "Abregung ueber Temperatur Motorraum | EN: Ramp-down over engine-bay temperature" CURVE 0x78F08 TKL_UW_VV_UW 100.0 FORMULA_0295 0.0 2.0000 /begin AXIS_DESCR STD_AXIS FORMULA_0600 6 0.0 1092.2500 FORMAT "%5.2" /end AXIS_DESCR FORMAT "%7.4" /end CHARACTERISTIC
/begin CHARACTERISTIC KL_TKSM_MR_TUMG_KAL "Wichtung von Differenz tm - tumg | EN: Weighting of difference tm - tumg" CURVE 0x78F22 TKL_SW_VV_UW 100.0 FORMULA_0295 0.0 2.0000 /begin AXIS_DESCR STD_AXIS FORMULA_0023 6 -50.0000 170.0000 FORMAT "%4.1" /end AXIS_DESCR FORMAT "%7.4" /end CHARACTERISTIC
/* ------------------ Abschnitt erzeugt aus tpu_code_inj.dat ------------------ */ /* ------------------ Abschnitt erzeugt aus tz_diag.dat ------------------ */
/begin CHARACTERISTIC K_TZ_DIAG_MAX_BESTR "Schwelle fuer Fehlereintrag" VALUE 0x78F3F TKW_VV_VV_UB 100.0 FORMULA_1190 0.0 255.0000 /end CHARACTERISTIC
/* ------------------ Abschnitt erzeugt aus vanos.dat ------------------ */
/begin CHARACTERISTIC K_VAN_ANSCHL_DELTA "Abstand Soll-Anschlag  | EN: Abstand Soll-Anschlag | [Code V452 INJ 0x64154] Distance target-to-stop: I part frozen near the stops; target = stop - delta during the stop-learning/pressure routine." VALUE 0x78F64 TKW_VV_VV_SW 100.0 FORMULA_0111 -80.0000 80.0000 FORMAT "%4.1" /end CHARACTERISTIC
/begin CHARACTERISTIC K_VAN_ANSCHL_HYS "Hysterese Anschlag anfahren | EN: Hysterese Anschlag anfahren" VALUE 0x78F66 TKW_VV_VV_SW 100.0 FORMULA_0111 -80.0000 80.0000 FORMAT "%4.1" /end CHARACTERISTIC
/begin CHARACTERISTIC K_VAN_ANSCHL_I_E1 "Ventilstrom am Anschlag max. Spr. | EN: Ventilstrom am Anschlag max. Spr." VALUE 0x78F68 TKW_VV_VV_SW 100.0 FORMULA_1198 -1000.0000 3000.0000 /end CHARACTERISTIC
/begin CHARACTERISTIC K_VAN_ANSCHL_I_A1 "Ventilstrom am Anschlag max. Spr. | EN: Ventilstrom am Anschlag max. Spr." VALUE 0x78F6A TKW_VV_VV_SW 100.0 FORMULA_1198 -1000.0000 3000.0000 /end CHARACTERISTIC
/begin CHARACTERISTIC K_VAN_ANSCHL_I_E2 "Ventilstrom am Anschlag max. Spr. | EN: Ventilstrom am Anschlag max. Spr." VALUE 0x78F6C TKW_VV_VV_SW 100.0 FORMULA_1198 -1000.0000 3000.0000 /end CHARACTERISTIC
/begin CHARACTERISTIC K_VAN_ANSCHL_I_A2 "Ventilstrom am Anschlag max. Spr. | EN: Ventilstrom am Anschlag max. Spr." VALUE 0x78F6E TKW_VV_VV_SW 100.0 FORMULA_1198 -1000.0000 3000.0000 /end CHARACTERISTIC
/begin CHARACTERISTIC K_VAN_ANSCHL_I_RAMPE "Strom-Rampe zum Anschlag anfahren | EN: Strom-Rampe zum A nschlag anfahren" VALUE 0x78F70 TKW_VV_VV_SW 100.0 FORMULA_1211 -1000.0000 3000.0000 /end CHARACTERISTIC
/begin CHARACTERISTIC K_VAN_ANSCHL_I_START_MAX "Max. Strom Beginn Anschlag anfahren | EN: Max. Strom Beginn A nschlag anfahren" VALUE 0x78F72 TKW_VV_VV_SW 100.0 FORMULA_1198 -1000.0000 3000.0000 /end CHARACTERISTIC
/begin CHARACTERISTIC K_VAN_ANSCHL_T "Dauer Anschlag lernen | EN: Dauer Anschlag lernen" VALUE 0x78F74 TKW_VV_VV_UB 100.0 FORMULA_0317 0.0 2.5500 /end CHARACTERISTIC
/begin CHARACTERISTIC K_VAN_BEGR_AB_FAKT_E "Abregelzeit Min-Begrenzung | [Code V452 INJ 0x64D64] Fade-out step of the cold-start target minimum." VALUE 0x78F75 TKW_VV_VV_UB 100.0 FORMULA_1212 164.0000 0.6431 /end CHARACTERISTIC
/begin CHARACTERISTIC K_VAN_CFG_E1 "Konfig Vanos Steller/Geberrad | EN: 0x0 Flueg 0x1 Hochdr 0x2 MCS ELSE undef. Konfig Vanos Steller/Geberrad" VALUE 0x78F76 TKW_VV_VV_UB 100.0 FORMULA_1213 0.0 255.0 /end CHARACTERISTIC
/begin CHARACTERISTIC K_VAN_CFG_A1 "Konfig Vanos Steller/Geberrad | EN: 0x0 Flueg 0x1 Hochdr 0x2 MCS ELSE undef. Konfig Vanos Steller/Geberrad" VALUE 0x78F77 TKW_VV_VV_UB 100.0 FORMULA_1213 0.0 255.0 /end CHARACTERISTIC
/begin CHARACTERISTIC K_VAN_CFG_E2 "Konfig Vanos Steller/Geberrad | EN: 0x0 Flueg 0x1 Hochdr 0x2 MCS ELSE undef. Konfig Vanos Steller/Geberrad" VALUE 0x78F78 TKW_VV_VV_UB 100.0 FORMULA_1213 0.0 255.0 /end CHARACTERISTIC
/begin CHARACTERISTIC K_VAN_CFG_A2 "Konfig Vanos Steller/Geberrad | EN: 0x0 Flueg 0x1 Hochdr 0x2 MCS ELSE undef. Konfig Vanos Steller/Geberrad" VALUE 0x78F79 TKW_VV_VV_UB 100.0 FORMULA_1213 0.0 255.0 /end CHARACTERISTIC
/begin CHARACTERISTIC K_VAN_ERR_CFG "Ersatz-Sollwert bei Fehler | EN: 0x0 lls+wdk+ti 0x1 lls+ti 0x2 wdk+ti 0x3 ti 0x4 lls+wdk 0x5 lls 0x6 wdk Ersatz-Sollwert bei Fehler 0 | [Code V452 INJ 0x64154] Bit mask selecting which fault conditions switch to K_VAN_SOLL_ERSATZ (bits: throttle safety modes, cylinder cut-off, VANOS safety status). 6 here." VALUE 0x78F7A TKW_VV_VV_UB 100.0 FORMULA_1214 0.0 255.0 /end CHARACTERISTIC
/begin CHARACTERISTIC K_VAN_DRUCK_VERSTELL_E "min. Fr�hverstellung Druckerkennung" VALUE 0x78F7C TKW_VV_VV_SW 100.0 FORMULA_0111 -80.0000 80.0000 FORMAT "%4.1" /end CHARACTERISTIC
/begin CHARACTERISTIC K_VAN_DRUCK_SOLL_OFFSET_E "Soll-Offset auf van_druck_start_e" VALUE 0x78F7E TKW_VV_VV_SW 100.0 FORMULA_0111 -80.0000 80.0000 FORMAT "%4.1" /end CHARACTERISTIC
/begin CHARACTERISTIC K_VAN_DRUCK_CNT "Anzahl Fr�hverstellungen Druckerk." VALUE 0x78F80 TKW_VV_VV_UB 100.0 FORMULA_0003 0.0 10.0000 /end CHARACTERISTIC
/begin CHARACTERISTIC K_VAN_D_XD_TAU_Einlass "Gradient Regelabweichung Filterzeit" VALUE 0x78F81 TKW_VV_VV_UB 100.0 FORMULA_0664 0.0101 2.5600 /end CHARACTERISTIC
/begin CHARACTERISTIC K_VAN_D_XD_TAU_Auslass "Gradient Regelabweichung Filterzeit" VALUE 0x78F82 TKW_VV_VV_UB 100.0 FORMULA_0664 0.0101 2.5600 /end CHARACTERISTIC
/begin CHARACTERISTIC K_VAN_EXD_I_MAX_Einlass "Pr�flauf Ventilstrom max. Spr." VALUE 0x78F84 TKW_VV_VV_SW 100.0 FORMULA_1198 -1000.0000 3000.0000 /end CHARACTERISTIC
/begin CHARACTERISTIC K_VAN_EXD_I_MAX_Auslass "Pr�flauf Ventilstrom max. Spr." VALUE 0x78F86 TKW_VV_VV_SW 100.0 FORMULA_1198 -1000.0000 3000.0000 /end CHARACTERISTIC
/begin CHARACTERISTIC K_VAN_EXD_I_MIN_Einlass "Pr�flauf Ventilstrom min. Spr." VALUE 0x78F88 TKW_VV_VV_SW 100.0 FORMULA_1198 -1000.0000 3000.0000 /end CHARACTERISTIC
/begin CHARACTERISTIC K_VAN_EXD_I_MIN_Auslass "Pr�flauf Ventilstrom min. Spr." VALUE 0x78F8A TKW_VV_VV_SW 100.0 FORMULA_1198 -1000.0000 3000.0000 /end CHARACTERISTIC
/begin CHARACTERISTIC K_VAN_EXD_N_SOLL "Van Prueflauf LLR-Sollwert | EN: Van Prueflauf LLR-Sollwert" VALUE 0x78F8C TKW_VV_VV_SW 100.0 FORMULA_0006 0.0 10000.0000 /end CHARACTERISTIC
/begin CHARACTERISTIC K_VAN_EXD_SPR_MAX_MIN_Einlass "kleinste gelernte MaxSpr f�r min-Pr�fen" VALUE 0x78F8E TKW_VV_VV_SW 100.0 FORMULA_0111 50.0000 160.0000 FORMAT "%4.1" /end CHARACTERISTIC
/begin CHARACTERISTIC K_VAN_EXD_SPR_MAX_MIN_Auslass "kleinste gelernte MaxSpr f�r min-Pr�fen" VALUE 0x78F90 TKW_VV_VV_SW 100.0 FORMULA_0111 50.0000 160.0000 FORMAT "%4.1" /end CHARACTERISTIC
/begin CHARACTERISTIC K_VAN_EXD_T_ANSCHL "Dauer Anschlag pr�fen | EN: Dauer Anschlag prüfen" VALUE 0x78F92 TKW_VV_VV_UB 100.0 FORMULA_0317 0.0 2.5500 /end CHARACTERISTIC
/begin CHARACTERISTIC K_VAN_EXD_T_GUETE "Dauer Ventil-Guete messen" VALUE 0x78F94 TKW_VV_VV_UW 100.0 FORMULA_0021 0.0 655.0000 FORMAT "%5.2" /end CHARACTERISTIC
/begin CHARACTERISTIC K_VAN_EXD_TMOT_MIN "Min. Temp.f�r Pr�flauf | EN: Min. Temp.für Prüflauf" VALUE 0x78F96 TKW_VV_VV_SW 100.0 FORMULA_0023 -50.0000 170.0000 FORMAT "%4.1" /end CHARACTERISTIC
/begin CHARACTERISTIC K_VAN_EXD_GUETE_TAU "Ventilguete Aenderung pro Messung" VALUE 0x78F98 TKW_VV_VV_UB 100.0 FORMULA_1215 0.0 0.9960 /end CHARACTERISTIC
/begin CHARACTERISTIC K_VAN_EXD_VERST_SOLL_MAX_Einlass "grosse Spr bei Verstellzeitmessung" VALUE 0x78F9A TKW_VV_VV_SW 100.0 FORMULA_0111 50.0000 160.0000 FORMAT "%4.1" /end CHARACTERISTIC
/begin CHARACTERISTIC K_VAN_EXD_VERST_SOLL_MAX_Auslass "grosse Spr bei Verstellzeitmessung" VALUE 0x78F9C TKW_VV_VV_SW 100.0 FORMULA_0111 50.0000 160.0000 FORMAT "%4.1" /end CHARACTERISTIC
/begin CHARACTERISTIC K_VAN_EXD_VERST_SOLL_MIN_Einlass "kleine Spr bei Verstellzeitmessung" VALUE 0x78F9E TKW_VV_VV_SW 100.0 FORMULA_0111 50.0000 160.0000 FORMAT "%4.1" /end CHARACTERISTIC
/begin CHARACTERISTIC K_VAN_EXD_VERST_SOLL_MIN_Auslass "kleine Spr bei Verstellzeitmessung" VALUE 0x78FA0 TKW_VV_VV_SW 100.0 FORMULA_0111 50.0000 160.0000 FORMAT "%4.1" /end CHARACTERISTIC
/begin CHARACTERISTIC K_VAN_EXD_VERST_TMAX "Timeout Verstellzeitmessung | EN: Timeout Verstellzeitmessung" VALUE 0x78FA2 TKW_VV_VV_UB 100.0 FORMULA_0317 0.0 2.5500 /end CHARACTERISTIC
/begin CHARACTERISTIC K_VAN_EXD_VERST_TOL "Abweichung Verstellmessung Ende | EN: Abweichung Verstellme ssung Ende" VALUE 0x78FA4 TKW_VV_VV_SW 100.0 FORMULA_0111 -80.0000 80.0000 FORMAT "%4.1" /end CHARACTERISTIC
/begin CHARACTERISTIC K_VAN_EXD_VERST_TOL_START "Abweichung Verstellmessung Start | EN: Abweichung Verstellme ssung Start" VALUE 0x78FA6 TKW_VV_VV_SW 100.0 FORMULA_0111 -80.0000 80.0000 FORMAT "%4.1" /end CHARACTERISTIC
/begin CHARACTERISTIC K_VAN_FILTR_AMPL "Amplitude Sollwertwackeln gegen Filtration" VALUE 0x78FA8 TKW_VV_VV_SW 100.0 FORMULA_0111 -80.0000 80.0000 FORMAT "%4.1" /end CHARACTERISTIC
/begin CHARACTERISTIC K_VAN_FILTR_DAUER "max. Dauer ohne Sollaenderung" VALUE 0x78FAA TKW_VV_VV_UW 100.0 FORMULA_0073 0.0 6553.5000 FORMAT "%4.1" /end CHARACTERISTIC
/begin CHARACTERISTIC K_VAN_FILTR_PERIOD "Periodendauer eines Wackelzyklus" VALUE 0x78FAC TKW_VV_VV_UB 100.0 FORMULA_0458 0.0 25.5000 /end CHARACTERISTIC
/begin CHARACTERISTIC K_VAN_FILTR_SOLL_DELTA "Max. Sollwert-�nderung ohne Filtration" VALUE 0x78FAE TKW_VV_VV_SW 100.0 FORMULA_0111 -80.0000 80.0000 FORMAT "%4.1" /end CHARACTERISTIC
/begin CHARACTERISTIC K_VAN_FILTR_T_ML_MIN "Min. Motorlaufzeit f�r Filtrationsoffset" VALUE 0x78FB0 TKW_VV_VV_UW 100.0 FORMULA_0021 0.0 655.0000 FORMAT "%5.2" /end CHARACTERISTIC
/begin CHARACTERISTIC K_VAN_FILTR_TV_PRUEF "Pruefzeitpunkt Filtrationserkennung" VALUE 0x78FB2 TKW_VV_VV_UB 100.0 FORMULA_1216 0.0 99.6093 /end CHARACTERISTIC
/begin CHARACTERISTIC K_VAN_GUETE_CFG "Auswahl Ventilgueteberechnung" VALUE 0x78FB3 TKW_VV_VV_UB 100.0 FORMULA_1217 0.0 255.0 /end CHARACTERISTIC
/begin CHARACTERISTIC K_VAN_GUETE_DAUER "Dauer Ventilgueteadaption" VALUE 0x78FB4 TKW_VV_VV_UW 100.0 FORMULA_0073 0.0 6553.5000 FORMAT "%4.1" /end CHARACTERISTIC
/begin CHARACTERISTIC K_VAN_GUETE_INIT "Ruecksetz-Wert der Ventilguete" VALUE 0x78FB6 TKW_VV_VV_UW 100.0 FORMULA_0024 0.0 1.9999 FORMAT "%7.4" /end CHARACTERISTIC
/begin CHARACTERISTIC K_VAN_GUETE_PAUSE "Pause zwischen Ventilgueteadaption" VALUE 0x78FB8 TKW_VV_VV_UW 100.0 FORMULA_1197 0.0 109.0000 FORMAT "%4.1" /end CHARACTERISTIC
/begin CHARACTERISTIC K_VAN_GUETE_RESET "Pumpen-Pauli's INCA-RESET Knopf" VALUE 0x78FBA TKW_VV_VV_UB 100.0 FORMULA_1218 0.0 255.0 /end CHARACTERISTIC
/begin CHARACTERISTIC K_VAN_GUETE_RESET_MIN "Min. zulaessige Guete ohne Reset" VALUE 0x78FBC TKW_VV_VV_UW 100.0 FORMULA_0024 0.0 1.9999 FORMAT "%7.4" /end CHARACTERISTIC
/begin CHARACTERISTIC K_VAN_GUETE_RESET_ZEIT "Dauer schlechter Ventilguete bis Reset" VALUE 0x78FBE TKW_VV_VV_UW 100.0 FORMULA_0073 0.0 6553.5000 FORMAT "%4.1" /end CHARACTERISTIC
/begin CHARACTERISTIC K_VAN_FREQU_SPUEL_MIN "min. PWM-Frequenz Ventile spuelen | EN: Min. PWM -Frequenz Ventile spülen" VALUE 0x78FC0 TKW_VV_VV_UW 100.0 FORMULA_1192 16.0000 400.0000 FORMAT "%4.1" /end CHARACTERISTIC
/begin CHARACTERISTIC K_VAN_FREQU_STAND "PWM-Frequenz Ventile Motor steht | EN: PWM-Frequenz Ventile Motor steht" VALUE 0x78FC2 TKW_VV_VV_UW 100.0 FORMULA_1192 16.0000 400.0000 FORMAT "%4.1" /end CHARACTERISTIC
/begin CHARACTERISTIC K_VAN_FREQU_ANSCHL "PWM-Frequenz Ventile am Anschlag | EN: PWM-Frequenz Ventile am Anschlag" VALUE 0x78FC4 TKW_VV_VV_UW 100.0 FORMULA_1192 16.0000 400.0000 FORMAT "%4.1" /end CHARACTERISTIC
/begin CHARACTERISTIC K_VAN_FREQU_WICHT "Wichtung Ventilguete PWM-Frequenz" VALUE 0x78FC6 TKW_VV_VV_UB 100.0 FORMULA_0643 0.0 1.9921 /end CHARACTERISTIC
/begin CHARACTERISTIC K_VAN_GUETE_TAU "Ventilguete Aenderung pro Messung" VALUE 0x78FC7 TKW_VV_VV_UB 100.0 FORMULA_1215 0.0 0.9960 /end CHARACTERISTIC
/begin CHARACTERISTIC K_VAN_GUETE_TMOT "Minimaltemp fuer Gueteberechnung" VALUE 0x78FC8 TKW_VV_VV_SW 100.0 FORMULA_0023 -50.0000 170.0000 FORMAT "%4.1" /end CHARACTERISTIC
/begin CHARACTERISTIC K_VAN_GUETE_TOEL "Minimaltemp fuer Gueteberechnung" VALUE 0x78FCA TKW_VV_VV_SW 100.0 FORMULA_0023 -50.0000 170.0000 FORMAT "%4.1" /end CHARACTERISTIC
/begin CHARACTERISTIC K_VAN_I_I_MAX "Regler I Anteil Maxwert | EN: Controller integral share, maximum [mA] | [Code V452 INJ 0x64154] Upper limit of the controller I part." VALUE 0x78FCC TKW_VV_VV_SW 100.0 FORMULA_1198 -1000.0000 3000.0000 /end CHARACTERISTIC
/begin CHARACTERISTIC K_VAN_I_I_MIN "Regler I Anteil Minwert | EN: Controller integral share, minimum [mA] | [Code V452 INJ 0x64154] Lower limit of the controller I part." VALUE 0x78FCE TKW_VV_VV_SW 100.0 FORMULA_1198 -1000.0000 3000.0000 /end CHARACTERISTIC
/begin CHARACTERISTIC K_VAN_I_MAX "Ventilstrom Maxwert | EN: Valve current, maximum [mA]" VALUE 0x78FD0 TKW_VV_VV_SW 100.0 FORMULA_1198 -1000.0000 3000.0000 /end CHARACTERISTIC
/begin CHARACTERISTIC K_VAN_START_I_MAX_AUSLASS "Ventilstrom im Start  | EN: Valve current during start [mA]" VALUE 0x78FD2 TKW_VV_VV_SW 100.0 FORMULA_1198 -1000.0000 3000.0000 /end CHARACTERISTIC
/begin CHARACTERISTIC K_VAN_INVERT_E1 "Norm: Stromlos => max.Spr | EN: Normalisation: de-energised = maximum spread" VALUE 0x78FD4 TKW_VV_VV_UB 100.0 FORMULA_1219 0.0 255.0 /end CHARACTERISTIC
/begin CHARACTERISTIC K_VAN_INVERT_A1 "Norm: Stromlos => max.Spr | EN: Normalisation: de-energised = maximum spread" VALUE 0x78FD5 TKW_VV_VV_UB 100.0 FORMULA_1219 0.0 255.0 /end CHARACTERISTIC
/begin CHARACTERISTIC K_VAN_INVERT_E2 "Norm: Stromlos => max.Spr | EN: Normalisation: de-energised = maximum spread" VALUE 0x78FD6 TKW_VV_VV_UB 100.0 FORMULA_1219 0.0 255.0 /end CHARACTERISTIC
/begin CHARACTERISTIC K_VAN_INVERT_A2 "Norm: Stromlos => max.Spr | EN: Normalisation: de-energised = maximum spread" VALUE 0x78FD7 TKW_VV_VV_UB 100.0 FORMULA_1219 0.0 255.0 /end CHARACTERISTIC
/begin CHARACTERISTIC K_VAN_KW_SPR_MAX_E1 "KW-Zahn bei max Spreizung | EN: KW-Zahn bei max Spreizung" VALUE 0x78FD8 TKW_VV_VV_SB 100.0 FORMULA_1220 -60.0000 60.0000 /end CHARACTERISTIC
/begin CHARACTERISTIC K_VAN_KW_SPR_MAX_A1 "KW-Zahn bei max Spreizung | EN: KW-Zahn bei max Spreizung" VALUE 0x78FD9 TKW_VV_VV_SB 100.0 FORMULA_1220 -60.0000 60.0000 /end CHARACTERISTIC
/begin CHARACTERISTIC K_VAN_KW_SPR_MAX_E2 "KW-Zahn bei max Spreizung | EN: KW-Zahn bei max Spreizung" VALUE 0x78FDA TKW_VV_VV_SB 100.0 FORMULA_1220 -60.0000 60.0000 /end CHARACTERISTIC
/begin CHARACTERISTIC K_VAN_KW_SPR_MAX_A2 "KW-Zahn bei max Spreizung | EN: KW-Zahn bei max Spreizung" VALUE 0x78FDB TKW_VV_VV_SB 100.0 FORMULA_1220 -60.0000 60.0000 /end CHARACTERISTIC
/begin CHARACTERISTIC K_VAN_KP_XD_KORR_Einlass "Korrektur van_i_p bei xd<0" VALUE 0x78FDC TKW_VV_VV_UB 100.0 FORMULA_0643 0.0 1.9921 /end CHARACTERISTIC
/begin CHARACTERISTIC K_VAN_KP_XD_KORR_Auslass "Korrektur van_i_p bei xd<0" VALUE 0x78FDD TKW_VV_VV_UB 100.0 FORMULA_0643 0.0 1.9921 /end CHARACTERISTIC
/begin CHARACTERISTIC K_VAN_N_OFFSET_MAX_A "AVanos n korr tabg max | [Code V452 INJ 0x64154] Max positive change of the exhaust X input by the charge-exchange factor (n x tabg_lw_verh_wurzel). 0 = correction off." VALUE 0x78FDE TKW_VV_VV_SW 100.0 FORMULA_0006 0.0 10000.0000 /end CHARACTERISTIC
/begin CHARACTERISTIC K_VAN_N_OFFSET_MIN_A "AVanos n korr tabg min | [Code V452 INJ 0x64154] Max negative change of the exhaust X input. 0 = correction off." VALUE 0x78FE0 TKW_VV_VV_SW 100.0 FORMULA_0006 0.0 10000.0000 /end CHARACTERISTIC
/begin CHARACTERISTIC K_VAN_N_OFF "VanosRegler Abschaltdrehzahl | EN: VanosRegler Abschaltdrehzahl" VALUE 0x78FE2 TKW_VV_VV_SW 100.0 FORMULA_0006 0.0 10000.0000 /end CHARACTERISTIC
/begin CHARACTERISTIC K_VAN_N_ON "VanosRegler Einschaltdrehzahl | EN: VanosRegler Einschaltdrehzahl" VALUE 0x78FE4 TKW_VV_VV_SW 100.0 FORMULA_0006 0.0 10000.0000 /end CHARACTERISTIC
/begin CHARACTERISTIC K_VAN_RAD_CFG "Auslass-Geberrad Geometrie" VALUE 0x78FE6 TKW_VV_VV_UB 100.0 FORMULA_1221 0.0 255.0 /end CHARACTERISTIC
/begin CHARACTERISTIC K_VAN_RAD_MIN "min. Anzahl NW-Zaehne | EN: min. Anzahl NW-Zaehne" VALUE 0x78FE7 TKW_VV_VV_UB 100.0 FORMULA_1222 0.0 255.0000 /end CHARACTERISTIC
/begin CHARACTERISTIC K_VAN_RAD_MAX "max. Anzahl NW-Zaehne | EN: max. Anzahl NW-Zaehne" VALUE 0x78FE8 TKW_VV_VV_UB 100.0 FORMULA_1222 0.0 255.0000 /end CHARACTERISTIC
/begin CHARACTERISTIC K_VAN_R20 "Spulenwiderstand bei 20Grad | EN: Coil resistance at 20 deg C [Ohm]" VALUE 0x78FEA TKW_VV_VV_SW 100.0 FORMULA_1203 -32.7680 32.7670 FORMAT "%6.3" /end CHARACTERISTIC
/begin CHARACTERISTIC K_VAN_R_TK "Temperaturkoeffizient Spulenwiderstand | EN: Temperature coefficient of coil resistance [10exp-3]" VALUE 0x78FEC TKW_VV_VV_SW 100.0 FORMULA_1223 0.0 327.6700 FORMAT "%5.2" /end CHARACTERISTIC
/begin CHARACTERISTIC K_VAN_SMG_MD_MIN "Min. Wunschmoment SMG-Schaltung | EN: Minimum desired torque, SMG shift [%] | [Code V452 INJ 0x64154] Min torque demand for the SMG-shift pre-positioning. During an SMG shift both cams are read from KF_VAN_SOLL at the target-gear speed." VALUE 0x78FEE TKW_VV_VV_SW 100.0 FORMULA_0001 0.0 100.0000 FORMAT "%4.1" /end CHARACTERISTIC
/begin CHARACTERISTIC K_VAN_SMG_MD_ABBR "Abbruch-Wunschmoment SMG-Schaltung | EN: Abort desired torque, SMG shift [%] | [Code V452 INJ 0x64154] Abort below this torque demand. During an SMG shift both cams are read from KF_VAN_SOLL at the target-gear speed." VALUE 0x78FF0 TKW_VV_VV_SW 100.0 FORMULA_0001 0.0 100.0000 FORMAT "%4.1" /end CHARACTERISTIC
/begin CHARACTERISTIC K_VAN_SMG_N_MIN "min. Zieldrehzahl SMG-Schaltung | EN: Minimum target speed, SMG shift [Upm] | [Code V452 INJ 0x64154] Min SMG target speed for pre-positioning. During an SMG shift both cams are read from KF_VAN_SOLL at the target-gear speed." VALUE 0x78FF2 TKW_VV_VV_SW 100.0 FORMULA_0006 0.0 10000.0000 /end CHARACTERISTIC
/begin CHARACTERISTIC K_VAN_SMG_N_ABBR "Abbruch Zieldrehzahl SMG-Schaltung | EN: Abort target speed, SMG shift [Upm] | [Code V452 INJ 0x64154] Abort below this target speed. During an SMG shift both cams are read from KF_VAN_SOLL at the target-gear speed." VALUE 0x78FF4 TKW_VV_VV_SW 100.0 FORMULA_0006 0.0 10000.0000 /end CHARACTERISTIC
/begin CHARACTERISTIC K_VAN_SMG_DR_REL "vorgest. dr_rel bei SMG-Schaltung | [Code V452 INJ 0x64154] Y value used during SMG pre-positioning (100 % = WOT row). During an SMG shift both cams are read from KF_VAN_SOLL at the target-gear speed." VALUE 0x78FF6 TKW_VV_VV_SW 100.0 FORMULA_0115 0.0 199.9938 FORMAT "%5.2" /end CHARACTERISTIC
/begin CHARACTERISTIC K_VAN_SMG_DAUER_MAX "max. SMG-Schaltungsdauer | EN: max. SMG-Schaltungsdauer | [Code V452 INJ 0x64154] Max duration of the SMG pre-positioning. During an SMG shift both cams are read from KF_VAN_SOLL at the target-gear speed." VALUE 0x78FF8 TKW_VV_VV_UB 100.0 FORMULA_0317 0.0 2.5500 /end CHARACTERISTIC
/begin CHARACTERISTIC K_VAN_SMG_T_AUFREG "max. Aufregelzeit der Kupplung | EN: max. Aufregelzeit der Kupplung | [Code V452 INJ 0x64154] Pre-positioning only while the clutch ramp-up time is below this. During an SMG shift both cams are read from KF_VAN_SOLL at the target-gear speed." VALUE 0x78FF9 TKW_VV_VV_UB 100.0 FORMULA_0317 0.0 2.5500 /end CHARACTERISTIC
/begin CHARACTERISTIC K_VAN_SOLL_CFG "Sollwert Eingangsgroesse | [Code V452 INJ 0x64154] Y input of the target maps: 1 = md_rf_soll_pt (torque-based fill demand), otherwise dr_rel of the bank (0 here)." VALUE 0x78FFA TKW_VV_VV_UB 100.0 FORMULA_1224 0.0 255.0 /end CHARACTERISTIC
/begin CHARACTERISTIC K_VAN_SOLL_ABSTELL_Einlass "Sollpos nach KL15 aus | [Code V452 INJ 0x64154] Intake target with ignition/engine off (CAN terminal status)." VALUE 0x78FFC TKW_VV_VV_SW 100.0 FORMULA_0111 50.0000 160.0000 FORMAT "%4.1" /end CHARACTERISTIC
/begin CHARACTERISTIC K_VAN_SOLL_ABSTELL_Auslass "Sollpos nach KL15 aus | [Code V452 INJ 0x64154] Exhaust target with ignition/engine off (CAN terminal status)." VALUE 0x78FFE TKW_VV_VV_SW 100.0 FORMULA_0111 50.0000 160.0000 FORMAT "%4.1" /end CHARACTERISTIC
/begin CHARACTERISTIC K_VAN_SOLL_ERSATZ_Einlass "Soll-Ersatzwert | [Code V452 INJ 0x64154] Intake substitute target on faults selected by K_VAN_ERR_CFG (throttle safety mode, cylinder cut, VANOS safety status)." VALUE 0x79000 TKW_VV_VV_SW 100.0 FORMULA_0111 50.0000 160.0000 FORMAT "%4.1" /end CHARACTERISTIC
/begin CHARACTERISTIC K_VAN_SOLL_ERSATZ_Auslass "Soll-Ersatzwert | [Code V452 INJ 0x64154] Exhaust substitute target on faults selected by K_VAN_ERR_CFG (throttle safety mode, cylinder cut, VANOS safety status)." VALUE 0x79002 TKW_VV_VV_SW 100.0 FORMULA_0111 50.0000 160.0000 FORMAT "%4.1" /end CHARACTERISTIC
/begin CHARACTERISTIC K_VAN_SOLL_MAX_Einlass "max. Sollwert | [Code V452 INJ 0x64154] Upper limit of the intake target (applied after offset, change limit and fault substitute)." VALUE 0x79004 TKW_VV_VV_SW 100.0 FORMULA_0111 50.0000 160.0000 FORMAT "%4.1" /end CHARACTERISTIC
/begin CHARACTERISTIC K_VAN_SOLL_MAX_Auslass "max. Sollwert | [Code V452 INJ 0x64154] Upper limit of the exhaust target (applied after offset, change limit and fault substitute)." VALUE 0x79006 TKW_VV_VV_SW 100.0 FORMULA_0111 50.0000 160.0000 FORMAT "%4.1" /end CHARACTERISTIC
/begin CHARACTERISTIC K_VAN_SOLL_MIN_Einlass "min. Sollwert | [Code V452 INJ 0x64154] Lower limit of the intake target. During cold start raised towards the cold-start limit by van_begr_faktor." VALUE 0x79008 TKW_VV_VV_SW 100.0 FORMULA_0111 50.0000 160.0000 FORMAT "%4.1" /end CHARACTERISTIC
/begin CHARACTERISTIC K_VAN_SOLL_MIN_Auslass "min. Sollwert | [Code V452 INJ 0x64154] Lower limit of the exhaust target. During cold start raised towards the cold-start limit by van_begr_faktor." VALUE 0x7900A TKW_VV_VV_SW 100.0 FORMULA_0111 50.0000 160.0000 FORMAT "%4.1" /end CHARACTERISTIC
/begin CHARACTERISTIC K_VAN_SOLL_OFFSET_Einlass "Sollpositionsoffset | [Code V452 INJ 0x64154] Offset added to the intake target after the map/cat-heating blend, before the change limit (0 here)." VALUE 0x7900C TKW_VV_VV_SW 100.0 FORMULA_0111 -80.0000 80.0000 FORMAT "%4.1" /end CHARACTERISTIC
/begin CHARACTERISTIC K_VAN_SOLL_OFFSET_Auslass "Sollpositionsoffset | [Code V452 INJ 0x64154] Offset added to the exhaust target after the map/cat-heating blend, before the change limit (0 here)." VALUE 0x7900E TKW_VV_VV_SW 100.0 FORMULA_0111 -80.0000 80.0000 FORMAT "%4.1" /end CHARACTERISTIC
/begin CHARACTERISTIC K_VAN_SPR_MAX_Einlass "Maximale Spreizung am Anschlag | [Code V452 INJ 0x64154/0x63A6C] Learned-stop reference (max Spreizung at the end stop) for the intake cam; with K_VAN_ANSCHL_DELTA it also freezes the controller I part when the target is beyond the stop." VALUE 0x79010 TKW_VV_VV_SW 100.0 FORMULA_0111 50.0000 160.0000 FORMAT "%4.1" /end CHARACTERISTIC
/begin CHARACTERISTIC K_VAN_SPR_MAX_Auslass "Maximale Spreizung am Anschlag | [Code V452 INJ 0x64154/0x63A6C] Learned-stop reference (max Spreizung at the end stop) for the exhaust cam; with K_VAN_ANSCHL_DELTA it also freezes the controller I part when the target is beyond the stop." VALUE 0x79012 TKW_VV_VV_SW 100.0 FORMULA_0111 50.0000 160.0000 FORMAT "%4.1" /end CHARACTERISTIC
/begin CHARACTERISTIC K_VAN_SPR_MAX_TOL_Einlass "Max. Abweichung Spreizung Anschlag" VALUE 0x79014 TKW_VV_VV_SW 100.0 FORMULA_0111 -80.0000 80.0000 FORMAT "%4.1" /end CHARACTERISTIC
/begin CHARACTERISTIC K_VAN_SPR_MAX_TOL_Auslass "Max. Abweichung Spreizung Anschlag" VALUE 0x79016 TKW_VV_VV_SW 100.0 FORMULA_0111 -80.0000 80.0000 FORMAT "%4.1" /end CHARACTERISTIC
/begin CHARACTERISTIC K_VAN_SPR_MIN_Einlass "Minimale Spreizung am Anschlag | [Code V452 INJ 0x64154] Min Spreizung at the end stop for the intake cam; I part frozen when target and actual are below it + K_VAN_ANSCHL_DELTA." VALUE 0x79018 TKW_VV_VV_SW 100.0 FORMULA_0111 50.0000 160.0000 FORMAT "%4.1" /end CHARACTERISTIC
/begin CHARACTERISTIC K_VAN_SPR_MIN_Auslass "Minimale Spreizung am Anschlag | [Code V452 INJ 0x64154] Min Spreizung at the end stop for the exhaust cam; I part frozen when target and actual are below it + K_VAN_ANSCHL_DELTA." VALUE 0x7901A TKW_VV_VV_SW 100.0 FORMULA_0111 50.0000 160.0000 FORMAT "%4.1" /end CHARACTERISTIC
/begin CHARACTERISTIC K_VAN_SPR_OFFSET_E1 "KW-Zahnflanke zu max Spreizung | EN: KW-Zahnflanke zu max Spre i-zung" VALUE 0x7901C TKW_VV_VV_SW 100.0 FORMULA_0111 -80.0000 80.0000 FORMAT "%4.1" /end CHARACTERISTIC
/begin CHARACTERISTIC K_VAN_SPR_OFFSET_A1 "KW-Zahnflanke zu max Spreizung | EN: KW-Zahnflanke zu max Spre i-zung" VALUE 0x7901E TKW_VV_VV_SW 100.0 FORMULA_0111 -80.0000 80.0000 FORMAT "%4.1" /end CHARACTERISTIC
/begin CHARACTERISTIC K_VAN_SPR_OFFSET_E2 "KW-Zahnflanke zu max Spreizung | EN: KW-Zahnflanke zu max Spre i-zung" VALUE 0x79020 TKW_VV_VV_SW 100.0 FORMULA_0111 -80.0000 80.0000 FORMAT "%4.1" /end CHARACTERISTIC
/begin CHARACTERISTIC K_VAN_SPR_OFFSET_A2 "KW-Zahnflanke zu max Spreizung | EN: KW-Zahnflanke zu max Spre i-zung" VALUE 0x79022 TKW_VV_VV_SW 100.0 FORMULA_0111 -80.0000 80.0000 FORMAT "%4.1" /end CHARACTERISTIC
/begin CHARACTERISTIC K_VAN_SZ_Einlass "Steuerzeit Nockenwelle" VALUE 0x79024 TKW_VV_VV_SW 100.0 FORMULA_0111 -80.0000 350.0000 FORMAT "%4.1" /end CHARACTERISTIC
/begin CHARACTERISTIC K_VAN_SZ_Auslass "Steuerzeit Nockenwelle" VALUE 0x79026 TKW_VV_VV_SW 100.0 FORMULA_0111 -80.0000 350.0000 FORMAT "%4.1" /end CHARACTERISTIC
/begin CHARACTERISTIC K_VAN_TMOT_BEGR_E "Temp.-Schwelle Fr�hbegrenzung | [Code V452 INJ 0x64D64] Coolant temperature below which the cold-start target minimum is active." VALUE 0x79028 TKW_VV_VV_SW 100.0 FORMULA_0023 -50.0000 170.0000 FORMAT "%4.1" /end CHARACTERISTIC
/begin CHARACTERISTIC K_VAN_TV_MCS_E1 "max. Ventil Tastverhaeltnis | EN: max. Ventil Tastverhaeltnis" VALUE 0x7902A TKW_VV_VV_SW 100.0 FORMULA_1194 0.0 100.0000 FORMAT "%4.1" /end CHARACTERISTIC
/begin CHARACTERISTIC K_VAN_TV_MCS_A1 "max. Ventil Tastverhaeltnis | EN: max. Ventil Tastverhaeltnis" VALUE 0x7902C TKW_VV_VV_SW 100.0 FORMULA_1194 0.0 100.0000 FORMAT "%4.1" /end CHARACTERISTIC
/begin CHARACTERISTIC K_VAN_TV_MCS_E2 "max. Ventil Tastverhaeltnis | EN: max. Ventil Tastverhaeltnis" VALUE 0x7902E TKW_VV_VV_SW 100.0 FORMULA_1194 0.0 100.0000 FORMAT "%4.1" /end CHARACTERISTIC
/begin CHARACTERISTIC K_VAN_TV_MCS_A2 "max. Ventil Tastverhaeltnis | EN: max. Ventil Tastverhaeltnis" VALUE 0x79030 TKW_VV_VV_SW 100.0 FORMULA_1194 0.0 100.0000 FORMAT "%4.1" /end CHARACTERISTIC
/begin CHARACTERISTIC K_VAN_UB_ERS "Ersatzwert bei Fehler | EN: Ersatzwert bei Fehler" VALUE 0x79032 TKW_VV_VV_SW 100.0 FORMULA_0008 0.0 28.0000 FORMAT "%4.1" /end CHARACTERISTIC
/begin CHARACTERISTIC K_VAN_UNL_N_MIN_Einlass "min n bei von selbst entriegelt" VALUE 0x79034 TKW_VV_VV_SW 100.0 FORMULA_0006 0.0 10000.0000 /end CHARACTERISTIC
/begin CHARACTERISTIC K_VAN_UNL_N_MIN_Auslass "min n bei von selbst entriegelt" VALUE 0x79036 TKW_VV_VV_SW 100.0 FORMULA_0006 0.0 10000.0000 /end CHARACTERISTIC
/begin CHARACTERISTIC K_VAN_UNLOCK_SPR_Einlass "Pos ab der entriegelt sein muss" VALUE 0x79038 TKW_VV_VV_SW 100.0 FORMULA_0111 50.0000 160.0000 FORMAT "%4.1" /end CHARACTERISTIC
/begin CHARACTERISTIC K_VAN_UNLOCK_SPR_Auslass "Pos ab der entriegelt sein muss" VALUE 0x7903A TKW_VV_VV_SW 100.0 FORMULA_0111 50.0000 160.0000 FORMAT "%4.1" /end CHARACTERISTIC
/begin CHARACTERISTIC K_VAN_UNL_D_I_Einlass "Startwert Delta zum I-Anteil" VALUE 0x7903C TKW_VV_VV_SW 100.0 FORMULA_1198 -1000.0000 3000.0000 /end CHARACTERISTIC
/begin CHARACTERISTIC K_VAN_UNL_D_I_Auslass "Startwert Delta zum I-Anteil" VALUE 0x7903E TKW_VV_VV_SW 100.0 FORMULA_1198 -1000.0000 3000.0000 /end CHARACTERISTIC
/begin CHARACTERISTIC K_VAN_UNL_I_DYN_Einlass "max. Dynamik TV zum Entriegeln" VALUE 0x79040 TKW_VV_VV_SW 100.0 FORMULA_1225 -1000.0000 3000.0000 /end CHARACTERISTIC
/begin CHARACTERISTIC K_VAN_UNL_I_DYN_Auslass "max. Dynamik TV zum Entriegeln" VALUE 0x79042 TKW_VV_VV_SW 100.0 FORMULA_1225 -1000.0000 3000.0000 /end CHARACTERISTIC
/begin CHARACTERISTIC K_VAN_XD_FILT_ED_Einlass "Max. gef. Regelabweichung" VALUE 0x79044 TKW_VV_VV_SW 100.0 FORMULA_0111 -80.0000 80.0000 FORMAT "%4.1" /end CHARACTERISTIC
/begin CHARACTERISTIC K_VAN_XD_FILT_ED_Auslass "Max. gef. Regelabweichung" VALUE 0x79046 TKW_VV_VV_SW 100.0 FORMULA_0111 -80.0000 80.0000 FORMAT "%4.1" /end CHARACTERISTIC
/begin CHARACTERISTIC K_VAN_XD_EINGEREGELT "Max. Regelabweichung bei B_VAN_EINGEREGELT | EN: Maximum control error for B_VAN_EINGEREGELT (settled) [°KW]" VALUE 0x79048 TKW_VV_VV_SW 100.0 FORMULA_0111 -80.0000 80.0000 FORMAT "%4.1" /end CHARACTERISTIC
/begin CHARACTERISTIC K_VAN_XD_SK "Abweichung kleine Spreizung Notprogramm | EN: Deviation, small spread, limp-home program [°KW]" VALUE 0x7904A TKW_VV_VV_SW 100.0 FORMULA_0111 -80.0000 80.0000 FORMAT "%4.1" /end CHARACTERISTIC
/begin CHARACTERISTIC K_VAN_XD_REG_MIN "Min. Regelabweichung f�r ungefilterte Regelung | EN: Minimum control error for unfiltered control [°KW]" VALUE 0x7904C TKW_VV_VV_SW 100.0 FORMULA_0111 -80.0000 80.0000 FORMAT "%4.1" /end CHARACTERISTIC
/begin CHARACTERISTIC KL_VAN_FREQU_ML "PWM-Frequenz Ventile Motor l�uft | EN: Valve PWM frequency, engine running | [Code V452 INJ 0x6553C] Valve PWM frequency over tmot with engine running." CURVE 0x7904E TKL_SW_VV_UW 100.0 FORMULA_1192 16.0000 400.0000 /begin AXIS_DESCR STD_AXIS FORMULA_0023 4 -50.0000 170.0000 FORMAT "%4.1" /end AXIS_DESCR FORMAT "%4.1" /end CHARACTERISTIC
/begin CHARACTERISTIC KL_VAN_FILTR_XD_WICHT "Gewicht Regl-Abw. Vent.Guete" CURVE 0x79060 TKL_SW_VV_UB 100.0 FORMULA_0643 0.0 1.9921 /begin AXIS_DESCR STD_AXIS FORMULA_0023 4 -50.0000 170.0000 FORMAT "%4.1" /end AXIS_DESCR /end CHARACTERISTIC
/begin CHARACTERISTIC KL_VAN_REG_FAKT_TMOT "Regler Korrekturfaktor | [Code V452 INJ 0x6553C] Controller correction factor over coolant temperature." CURVE 0x7906E TKL_SW_VV_UB 100.0 FORMULA_0643 0.0 1.9921 /begin AXIS_DESCR STD_AXIS FORMULA_0023 4 -50.0000 170.0000 FORMAT "%4.1" /end AXIS_DESCR /end CHARACTERISTIC
/begin CHARACTERISTIC KL_VAN_KD_A "Regler D Faktor | [Code V452 INJ 0x64154] D gain over n (exhaust)." CURVE 0x7907C TKL_SW_VV_SW 100.0 FORMULA_1200 -32.0000 31.9990 /begin AXIS_DESCR STD_AXIS FORMULA_0006 5 0.0 10000.0000 /end AXIS_DESCR FORMAT "%7.4" /end CHARACTERISTIC
/begin CHARACTERISTIC KL_VAN_KD_E "Regler D Faktor | [Code V452 INJ 0x64154] D gain over n (intake)." CURVE 0x79092 TKL_SW_VV_SW 100.0 FORMULA_1200 -32.0000 31.9990 /begin AXIS_DESCR STD_AXIS FORMULA_0006 5 0.0 10000.0000 /end AXIS_DESCR FORMAT "%7.4" /end CHARACTERISTIC
/begin CHARACTERISTIC KL_VAN_KI_A "Regler I Faktor | EN: Controller I factor | [Code V452 INJ 0x64154] I gain over control error (exhaust), as KL_VAN_KI_E." CURVE 0x790A8 TKL_SW_VV_SW 100.0 FORMULA_1201 -500.0000 499.9847
 /begin AXIS_DESCR STD_AXIS van_xd FORMULA_0111 5 -80.0000 80.0000 FORMAT "%4.1" /end AXIS_DESCR
 FORMAT "%5.2" /end CHARACTERISTIC
/begin CHARACTERISTIC KL_VAN_KI_E "Regler I Faktor | EN: Controller I factor | [Code V452 INJ 0x64154] I gain over control error van_xd (intake). Integrator limited to K_VAN_I_I_MIN..K_VAN_I_I_MAX; I step = 0 when target/actual are at the end stops (K_VAN_SPR_MAX/MIN +- K_VAN_ANSCHL_DELTA) or the unit is not unlocked (K_VAN_CFG)." CURVE 0x790BE TKL_SW_VV_SW 100.0 FORMULA_1201 -500.0000 499.9847
 /begin AXIS_DESCR STD_AXIS van_xd FORMULA_0111 5 -80.0000 80.0000 FORMAT "%4.1" /end AXIS_DESCR
 FORMAT "%5.2" /end CHARACTERISTIC
/begin CHARACTERISTIC KL_VAN_KP_A "Regler P Faktor | EN: Controller P factor | [Code V452 INJ 0x64154] P gain over n (exhaust)." CURVE 0x790D4 TKL_SW_VV_SW 100.0 FORMULA_1202 -1280.0000 1279.9609 /begin AXIS_DESCR STD_AXIS FORMULA_0006 5 0.0 10000.0000 /end AXIS_DESCR FORMAT "%5.2" /end CHARACTERISTIC
/begin CHARACTERISTIC KL_VAN_KP_E "Regler P Faktor | EN: Controller P factor | [Code V452 INJ 0x64154] P gain over n (intake), van_kp." CURVE 0x790EA TKL_SW_VV_SW 100.0 FORMULA_1202 -1280.0000 1279.9609 /begin AXIS_DESCR STD_AXIS FORMULA_0006 5 0.0 10000.0000 /end AXIS_DESCR FORMAT "%5.2" /end CHARACTERISTIC
/begin CHARACTERISTIC KL_VAN_SOLL_BEGR_E "Min-Begrenzung Kaltstart Einlass | [Code V452 INJ 0x64154] Cold-start minimum intake target over n; blended in by van_begr_faktor (0x64D64: active below K_VAN_TMOT_BEGR_E for KL_VAN_T_SOLL_BEGR_E(tan), faded by K_VAN_BEGR_AB_FAKT_E)." CURVE 0x79100 TKL_SW_VV_SW 100.0 FORMULA_0111 50.0000 160.0000 /begin AXIS_DESCR STD_AXIS FORMULA_0006 5 0.0 10000.0000 /end AXIS_DESCR FORMAT "%4.1" /end CHARACTERISTIC
/begin CHARACTERISTIC KL_VAN_T_SOLL_BEGR_E "Min-Begrenzungsdauer Kaltstart | [Code V452 INJ 0x64D64] Duration of the cold-start target minimum over intake air temperature." CURVE 0x79116 TKL_SW_VV_SW 100.0 FORMULA_0932 -327.6800 327.6700
 /begin AXIS_DESCR STD_AXIS tan_start FORMULA_0023 6 -50.0000 170.0000 FORMAT "%4.1" /end AXIS_DESCR
/end CHARACTERISTIC
/begin CHARACTERISTIC KL_VAN_T_DRUCK_E "Druckerkennungszeit ohne Fehlereintrag | EN: Pressure detection time without fault entry" CURVE 0x79130 TKL_SW_VV_UW 100.0 FORMULA_0073 0.0 6553.5000
 /begin AXIS_DESCR STD_AXIS tmot_start FORMULA_0023 4 -50.0000 170.0000 FORMAT "%4.1" /end AXIS_DESCR
 FORMAT "%4.1" /end CHARACTERISTIC
/begin CHARACTERISTIC KL_VAN_T_START_DLY "Reglerfreigabe nach Motor Start | EN: Controller enable after engine start | [Code V452 INJ 0x6553C] Controller release delay after engine start over start coolant temperature." CURVE 0x79142 TKL_SW_VV_UW 100.0 FORMULA_0021 0.0 655.0000
 /begin AXIS_DESCR STD_AXIS tmot_start FORMULA_0023 4 -50.0000 170.0000 FORMAT "%4.1" /end AXIS_DESCR
 FORMAT "%5.2" /end CHARACTERISTIC
/begin CHARACTERISTIC KF_VAN_I_VORST_E "Vorsteuerung Ventilstrom Einlass | [Code V452 INJ 0x6553C] Pre-control valve current (intake) over n x OIL temperature, added to the controller output (output stage 0x649D4, not fully traced)." MAP 0x79154 TKF_SW_SW_SW 100.0 FORMULA_1198 -1000.0000 3000.0000 /begin AXIS_DESCR STD_AXIS FORMULA_0006 6 0.0 10000.0000 /end AXIS_DESCR /begin AXIS_DESCR STD_AXIS FORMULA_0023 6 -50.0000 170.0000 FORMAT "%4.1" /end AXIS_DESCR /end CHARACTERISTIC
/begin CHARACTERISTIC KF_VAN_I_VORST_A "Vorsteuerung Ventilstrom Auslass | [Code V452 INJ 0x6553C] Pre-control valve current (exhaust) over n x oil temperature." MAP 0x791B6 TKF_SW_SW_SW 100.0 FORMULA_1198 -1000.0000 3000.0000 /begin AXIS_DESCR STD_AXIS FORMULA_0006 6 0.0 10000.0000 /end AXIS_DESCR /begin AXIS_DESCR STD_AXIS FORMULA_0023 6 -50.0000 170.0000 FORMAT "%4.1" /end AXIS_DESCR /end CHARACTERISTIC
/begin CHARACTERISTIC KF_VAN_SOLL_A "Grundkennfeld Vanos Sollwert | EN: Base map, VANOS target | [Code V452 INJ 0x64154] Exhaust VANOS target (Spreizung) over n x dr_rel; same chain as KF_VAN_SOLL_E. X input for exhaust = n x tabg_lw_verh_wurzel limited to n + K_VAN_N_OFFSET_MAX_A / n - K_VAN_N_OFFSET_MIN_A (both 0 here, so plain n). Values limited to K_VAN_SOLL_MIN_Auslass..K_VAN_SOLL_MAX_Auslass." MAP 0x79218 TKF_SW_SW_SW 100.0 FORMULA_0111 50.0000 160.0000 /begin AXIS_DESCR STD_AXIS FORMULA_0006 16 0.0 10000.0000 /end AXIS_DESCR
 /begin AXIS_DESCR STD_AXIS dr_rel_1of2_ FORMULA_0115 12 0.0 199.9938 FORMAT "%5.2" /end AXIS_DESCR
 FORMAT "%4.1" /end CHARACTERISTIC
/begin CHARACTERISTIC KF_VAN_SOLL_E "Grundkennfeld Vanos Sollwert | EN: Base map, VANOS target | [Code V452 INJ 0x64154] Intake VANOS target (Spreizung, degKW) over n x dr_rel of the bank (top row 95 % = WOT). Chain per unit (E1/A1/E2/A2): engine off -> K_VAN_SOLL_ABSTELL; else map -> cat-heating blend to KF_VAN_KH_SOLL_E (factor kh_van_fakt_kf) -> + K_VAN_SOLL_OFFSET -> change limit KF_VAN_SOLL_DMAX -> fault substitute K_VAN_SOLL_ERSATZ (K_VAN_ERR_CFG) -> limit K_VAN_SOLL_MAX / K_VAN_SOLL_MIN (cold start: KL_VAN_SOLL_BEGR_E) -> van_soll. SMG upshift (>= K_VAN_SMG_MD_MIN torque, target speed >= K_VAN_SMG_N_MIN, max K_VAN_SMG_DAUER_MAX): read at the TARGET-gear speed and Y = K_VAN_SMG_DR_REL (bank 1 only)." MAP 0x793D2 TKF_SW_SW_SW 100.0 FORMULA_0111 50.0000 160.0000 /begin AXIS_DESCR STD_AXIS FORMULA_0006 16 0.0 10000.0000 /end AXIS_DESCR
 /begin AXIS_DESCR STD_AXIS dr_rel_1of2_ FORMULA_0115 12 0.0 199.9938 FORMAT "%5.2" /end AXIS_DESCR
 FORMAT "%4.1" /end CHARACTERISTIC
/begin CHARACTERISTIC KF_VAN_KH_SOLL_A "Katheizkennfeld Vanos Sollwert | EN: VANOS cat-heating target map, intake [degKW x/10] | [Code V452 INJ 0x64154] Cat-heating exhaust target, blended as KF_VAN_KH_SOLL_E." MAP 0x7958C TKF_SW_SW_SW 100.0 FORMULA_0111 50.0000 160.0000 /begin AXIS_DESCR STD_AXIS FORMULA_0006 16 0.0 10000.0000 /end AXIS_DESCR
 /begin AXIS_DESCR STD_AXIS dr_rel_1of2_ FORMULA_0115 12 0.0 199.9938 FORMAT "%5.2" /end AXIS_DESCR
 FORMAT "%4.1" /end CHARACTERISTIC
/begin CHARACTERISTIC KF_VAN_KH_SOLL_E "Katheizkennfeld Vanos Sollwert | EN: Catalyst-heating map, VANOS target | [Code V452 INJ 0x64154] Cat-heating intake target; blended in: soll = KF_VAN_SOLL + kh_van_fakt_kf x (KF_VAN_KH_SOLL - KF_VAN_SOLL). Then KF_VAN_KH_SOLL_DMAX replaces KF_VAN_SOLL_DMAX." MAP 0x79746 TKF_SW_SW_SW 100.0 FORMULA_0111 50.0000 160.0000 /begin AXIS_DESCR STD_AXIS FORMULA_0006 16 0.0 10000.0000 /end AXIS_DESCR
 /begin AXIS_DESCR STD_AXIS dr_rel_1of2_ FORMULA_0115 12 0.0 199.9938 FORMAT "%5.2" /end AXIS_DESCR
 FORMAT "%4.1" /end CHARACTERISTIC
/begin CHARACTERISTIC KF_VAN_SOLL_BEGR_A "Min-Begrenzung Kaltstart Auslass | EN: VANOS min. limit cold start, intake [degKW x/10] | [Code V452 INJ 0x64154] Cold-start minimum exhaust target over n x pumg, blended as KL_VAN_SOLL_BEGR_E." MAP 0x79900 TKF_SW_SW_SW 100.0 FORMULA_0111 50.0000 160.0000 /begin AXIS_DESCR STD_AXIS FORMULA_0006 5 0.0 10000.0000 /end AXIS_DESCR /begin AXIS_DESCR STD_AXIS FORMULA_0077 3 400.0000 1200.0000 FORMAT "%4.1" /end AXIS_DESCR FORMAT "%4.1" /end CHARACTERISTIC
/begin CHARACTERISTIC KF_VAN_SOLL_DMAX_A "Aenderungsbegrenzung Sollwert | EN: Rate limit of target value | [Code V452 INJ 0x64154] Max change of the exhaust target per 10 ms (all 60 = no limit here)." MAP 0x79930 TKF_SW_SW_SW 100.0 FORMULA_1205 -80.0000 80.0000 /begin AXIS_DESCR STD_AXIS FORMULA_0006 6 0.0 10000.0000 /end AXIS_DESCR
 /begin AXIS_DESCR STD_AXIS dr_rel_1of2_ FORMULA_0115 6 0.0 199.9938 FORMAT "%5.2" /end AXIS_DESCR
 FORMAT "%4.1" /end CHARACTERISTIC
/begin CHARACTERISTIC KF_VAN_SOLL_DMAX_E "Aenderungsbegrenzung Sollwert | EN: Rate limit of target value | [Code V452 INJ 0x64154] Max change of the intake target per 10 ms (n x dr_rel). Here 0.5-2 degKW/10 ms at 1900-3700 and 5600 rpm for dr_rel 40-93 % - slows intake moves in mid load; 60 (no limit) at dr_rel >= 95 %." MAP 0x79992 TKF_SW_SW_SW 100.0 FORMULA_1205 -80.0000 80.0000 /begin AXIS_DESCR STD_AXIS FORMULA_0006 6 0.0 10000.0000 /end AXIS_DESCR
 /begin AXIS_DESCR STD_AXIS dr_rel_1of2_ FORMULA_0115 6 0.0 199.9938 FORMAT "%5.2" /end AXIS_DESCR
 FORMAT "%4.1" /end CHARACTERISTIC
/begin CHARACTERISTIC KF_VAN_KH_SOLL_DMAX_A "Aenderungsbegrenzung Sollwert Katheizen | EN: VANOS cat-heating rate limit, intake [degKW/10ms] | [Code V452 INJ 0x64154] Change limit used during cat heating instead of KF_VAN_SOLL_DMAX_A." MAP 0x799F4 TKF_SW_SW_SW 100.0 FORMULA_1205 -80.0000 80.0000 /begin AXIS_DESCR STD_AXIS FORMULA_0006 6 0.0 10000.0000 /end AXIS_DESCR
 /begin AXIS_DESCR STD_AXIS dr_rel_1of2_ FORMULA_0115 6 0.0 199.9938 FORMAT "%5.2" /end AXIS_DESCR
 FORMAT "%4.1" /end CHARACTERISTIC
/begin CHARACTERISTIC KF_VAN_KH_SOLL_DMAX_E "Aenderungsbegrenzung Sollwert Katheizen | EN: VANOS cat-heating rate limit, exhaust [degKW/10ms] | [Code V452 INJ 0x64154] Change limit used during cat heating instead of KF_VAN_SOLL_DMAX_E." MAP 0x79A56 TKF_SW_SW_SW 100.0 FORMULA_1205 -80.0000 80.0000 /begin AXIS_DESCR STD_AXIS FORMULA_0006 6 0.0 10000.0000 /end AXIS_DESCR
 /begin AXIS_DESCR STD_AXIS dr_rel_1of2_ FORMULA_0115 6 0.0 199.9938 FORMAT "%5.2" /end AXIS_DESCR
 FORMAT "%4.1" /end CHARACTERISTIC
/begin CHARACTERISTIC KF_VAN_XD_TAU "Filterzeitkonstante Regelabweichung | EN: Filter time constant, control error | [Code V452 INJ 0x6553C] Filter time constant of the control error over n x tmot." MAP 0x79AB8 TKF_SW_SW_SW 100.0 FORMULA_1059 0.2001 6553.5000 /begin AXIS_DESCR STD_AXIS FORMULA_0006 3 0.0 10000.0000 /end AXIS_DESCR /begin AXIS_DESCR STD_AXIS FORMULA_0023 4 -50.0000 170.0000 FORMAT "%4.1" /end AXIS_DESCR FORMAT "%5.2" /end CHARACTERISTIC
/* ------------------ Abschnitt erzeugt aus van_dsv.dat ------------------ */
/begin CHARACTERISTIC K_VAN_DSV_ABFALL_DLY "Abfalldauer Druckspeicherventil | EN: Drop-out time, pressure-accumulator valve [s]" VALUE 0x78F40 TKW_VV_VV_UB 100.0 FORMULA_0458 0.0 25.5000 /end CHARACTERISTIC
/begin CHARACTERISTIC K_VAN_DSV_CFG "Konfig Vanos Druckspeicherventil" VALUE 0x78F41 TKW_VV_VV_UB 100.0 FORMULA_1228 0.0 255.0 /end CHARACTERISTIC
/begin CHARACTERISTIC K_VAN_DSV_N_AUS "Ausschaltschwelle DSV im Start | EN: Switch-off threshold, pressure-accumulator valve during start [Upm]" VALUE 0x78F42 TKW_VV_VV_SW 100.0 FORMULA_0006 0.0 10000.0000 /end CHARACTERISTIC
/begin CHARACTERISTIC K_VAN_DSV_N_EIN "Einschaltschwelle DSV im Start | EN: Switch-on threshold, pressure-accumulator valve during start [Upm]" VALUE 0x78F44 TKW_VV_VV_SW 100.0 FORMULA_0006 0.0 10000.0000 /end CHARACTERISTIC
/begin CHARACTERISTIC K_VAN_DSV_PEAK_TIME "Anzugszeit DSV | EN: Pull-in time, pressure-accumulator valve" VALUE 0x78F46 TKW_VV_VV_UB 100.0 FORMULA_0458 0.0 25.5000 /end CHARACTERISTIC
/begin CHARACTERISTIC KL_VAN_DSV_HOLD_TV "Halte-Tastverhaeltnis DSV | EN: Hold duty cycle, pressure-accumulator valve" CURVE 0x78F48 TKL_SW_VV_SW 100.0 FORMULA_1227 0.0 100.0000 /begin AXIS_DESCR STD_AXIS FORMULA_0008 3 0.0 28.0000 FORMAT "%4.1" /end AXIS_DESCR FORMAT "%4.1" /end CHARACTERISTIC
/begin CHARACTERISTIC KL_VAN_DSV_PEAK_TV "Peak-Tastverhaeltnis DSV | EN: Peak duty cycle, pressure-accumulator valve" CURVE 0x78F56 TKL_SW_VV_SW 100.0 FORMULA_1227 0.0 100.0000 /begin AXIS_DESCR STD_AXIS FORMULA_0008 3 0.0 28.0000 FORMAT "%4.1" /end AXIS_DESCR FORMAT "%4.1" /end CHARACTERISTIC
/* ------------------ Abschnitt erzeugt aus wf.dat ------------------ */
/begin CHARACTERISTIC K_WF_MKS_TI_CFG "Einrechnung WF-MKS | EN: Inclusion of wall-film fuel mass" VALUE 0x79BA8 TKW_VV_VV_UB 100.0 FORMULA_0003 0.0 1.0000 /end CHARACTERISTIC
/begin CHARACTERISTIC K_WF_SOLL_START_PSAU_CFG "Schaler f. realen o. appl. PSAU | EN: Switch for real or calibrated intake pressure" VALUE 0x79BA9 TKW_VV_VV_UB 100.0 FORMULA_0003 0.0 1.0000 /end CHARACTERISTIC
/begin CHARACTERISTIC K_WF_SOLL_START_PSAU "appl. PSAU-Wert im Start | EN: Calibrated intake-pressure value during start [mbar]" VALUE 0x79BAA TKW_VV_VV_SW 100.0 FORMULA_0077 0.0 2000.0000 FORMAT "%4.1" /end CHARACTERISTIC
/begin CHARACTERISTIC K_WF_MKS_AUS_HYS "Hysterese-Faktor f. WF-Deaktivierung | EN: Hysteresis factor for wall-film deactivation" VALUE 0x79BAC TKW_VV_VV_UW 100.0 FORMULA_0075 0.0 4.0000 FORMAT "%6.3" /end CHARACTERISTIC
/begin CHARACTERISTIC K_WF_ASP_START "Anzahl ASP im START | EN: Number of intake strokes in START" VALUE 0x79BAE TKW_VV_VV_UW 100.0 FORMULA_1232 0.0 1279.0000 /end CHARACTERISTIC
/begin CHARACTERISTIC K_WF_IST_PLAU_MAX "max. plausibler WF-Wert | EN: max. plausibler WF-Wert" VALUE 0x79BB0 TKW_VV_VV_UW 100.0 FORMULA_0530 0.0 2000.0000 FORMAT "%5.2" /end CHARACTERISTIC
/begin CHARACTERISTIC K_WF_SOLL_CFG "Auswahl - Ermittlung wf_soll_grund" VALUE 0x79BB2 TKW_VV_VV_UB 100.0 FORMULA_1234 0.0 2.0 /end CHARACTERISTIC
/begin CHARACTERISTIC K_WF_MKS_F_CFG "Einrechnung WF-MKS-Verstaerkungsfaktor" VALUE 0x79BB3 TKW_VV_VV_UB 100.0 FORMULA_1235 0.0 1.0 /end CHARACTERISTIC
/begin CHARACTERISTIC K_WF_MKS_F "Faktor/max. Schwelle Verstaerkungsfaktor" VALUE 0x79BB4 TKW_VV_VV_UW 100.0 FORMULA_0075 0.0 4.0000 FORMAT "%6.3" /end CHARACTERISTIC
/begin CHARACTERISTIC K_WF_IST_CFG "Auswahl - Kraftstoffeintrags ins Oel" VALUE 0x79BB6 TKW_VV_VV_UB 100.0 FORMULA_1236 0.0 2.0 /end CHARACTERISTIC
/begin CHARACTERISTIC KL_WF_DMKS_T1_MS "Abdampfzeitkonstante bei stehenden Motor | EN: Evaporation time constant with engine stopped" CURVE 0x79BB8 TKL_SW_VV_UW 100.0 FORMULA_0062 0.0 65535.0000
 /begin AXIS_DESCR STD_AXIS tsgrw FORMULA_0023 5 -50.0000 170.0000 FORMAT "%4.1" /end AXIS_DESCR
/end CHARACTERISTIC
/begin CHARACTERISTIC KL_WF_SOLL_F_TI_PHI_ENDE "WF-Korrekturfaktor Einspritzende | EN: Wall-film correction factor, end of injection" CURVE 0x79BCE TKL_SW_VV_UW 100.0 FORMULA_0075 0.0 4.0000
 /begin AXIS_DESCR STD_AXIS ti_phi_ende FORMULA_0111 5 -72.0000 1440.0000 FORMAT "%4.1" /end AXIS_DESCR
 FORMAT "%6.3" /end CHARACTERISTIC
/begin CHARACTERISTIC KL_WF_SOLL_F_LAM "WF-Korrekturfaktor Lambda | EN: Wall-film correction factor, lambda" CURVE 0x79BE4 TKL_UW_VV_UW 100.0 FORMULA_0075 0.0 4.0000 /begin AXIS_DESCR STD_AXIS lam_soll FORMULA_0025 5 0.0 3.9990 FORMAT "%6.3" /end AXIS_DESCR FORMAT "%6.3" /end CHARACTERISTIC
/begin CHARACTERISTIC KL_WF_ASP_POS_START "Anzahl ASP f. WF-Aufbau (seq.START) | EN: Number of working cycles for wall-film build-up (sequential start)" CURVE 0x79BFA TKL_SW_VV_UW 100.0 FORMULA_1232 0.0 1279.0000
 /begin AXIS_DESCR STD_AXIS tsgrw FORMULA_0023 6 -50.0000 170.0000 FORMAT "%4.1" /end AXIS_DESCR
/end CHARACTERISTIC
/begin CHARACTERISTIC KL_WF_ASP_NEG_START "Anzahl ASP f. WF-Abbau (seq.START) | EN: Number of working cycles for wall-film decay (sequential start)" CURVE 0x79C14 TKL_SW_VV_UW 100.0 FORMULA_1232 0.0 1279.0000
 /begin AXIS_DESCR STD_AXIS tsgrw FORMULA_0023 6 -50.0000 170.0000 FORMAT "%4.1" /end AXIS_DESCR
/end CHARACTERISTIC
/begin CHARACTERISTIC KL_WF_MD_RF_TAU "Filterkonstanten - WF-PSAU Ermittlung" CURVE 0x79C2E TKL_SW_VV_UB 100.0 FORMULA_1237 0.0040 0.9960 /begin AXIS_DESCR STD_AXIS FORMULA_0006 5 0.0 10000.0000 /end AXIS_DESCR /end CHARACTERISTIC
/begin CHARACTERISTIC KL_WF_MKS_BEGR_NEG_WICHT "Wichtungsfaktor f. neg. WF-MKS-Begrenzung | EN: Weighting factor for negative wall-film fuel-mass limit" CURVE 0x79C40 TKL_SW_VV_UW 100.0 FORMULA_0075 0.0 4.0000
 /begin AXIS_DESCR STD_AXIS tsgrw FORMULA_0023 7 -50.0000 170.0000 FORMAT "%4.1" /end AXIS_DESCR
 FORMAT "%6.3" /end CHARACTERISTIC
/begin CHARACTERISTIC KL_WF_MKS_F_TSGRW "Temp.Saugrohrwand-Schwelle f. WF-Verstaerkungsfaktor" CURVE 0x79C5E TKL_SW_VV_UW 100.0 FORMULA_0075 0.0 4.0000
 /begin AXIS_DESCR STD_AXIS tsgrw FORMULA_0023 7 -50.0000 170.0000 FORMAT "%4.1" /end AXIS_DESCR
 FORMAT "%6.3" /end CHARACTERISTIC
/begin CHARACTERISTIC KF_WF_OELV_ETA "Kraftstoffeintrag ins Oel u. Nachstartverhalten" MAP 0x79C7C TKF_SW_SW_UW 100.0 FORMULA_0295 0.0 1.0000
 /begin AXIS_DESCR STD_AXIS tsgrw FORMULA_0023 7 -50.0000 170.0000 FORMAT "%4.1" /end AXIS_DESCR
 /begin AXIS_DESCR STD_AXIS FORMULA_0021 6 0.0 327.0000 FORMAT "%5.2" /end AXIS_DESCR
 FORMAT "%7.4" /end CHARACTERISTIC
/begin CHARACTERISTIC KF_WF_ASP_POS "Anzahl ASP f. WF-Aufbau | EN: Number of working cycles for wall-film build-up" MAP 0x79CEC TKF_SW_SW_UW 100.0 FORMULA_1232 0.0 1279.0000
 /begin AXIS_DESCR STD_AXIS tsgrw FORMULA_0023 6 -50.0000 170.0000 FORMAT "%4.1" /end AXIS_DESCR
 /begin AXIS_DESCR STD_AXIS FORMULA_0006 5 0.0 10000.0000 /end AXIS_DESCR
/end CHARACTERISTIC
/begin CHARACTERISTIC KF_WF_ASP_NEG "Anzahl ASP f. WF-Abbau | EN: Number of working cycles for wall-film decay" MAP 0x79D40 TKF_SW_SW_UW 100.0 FORMULA_1232 0.0 1279.0000
 /begin AXIS_DESCR STD_AXIS tsgrw FORMULA_0023 6 -50.0000 170.0000 FORMAT "%4.1" /end AXIS_DESCR
 /begin AXIS_DESCR STD_AXIS FORMULA_0006 5 0.0 10000.0000 /end AXIS_DESCR
/end CHARACTERISTIC
/begin CHARACTERISTIC KF_WF_MKS_AKTIV_POS "Aktivschwelle f. pos. WF | EN: Activation threshold for positive wall film" MAP 0x79D94 TKF_SW_SW_UW 100.0 FORMULA_0530 0.0 512.0000
 /begin AXIS_DESCR STD_AXIS tsgrw FORMULA_0023 6 -50.0000 170.0000 FORMAT "%4.1" /end AXIS_DESCR
 /begin AXIS_DESCR STD_AXIS FORMULA_0006 5 0.0 10000.0000 /end AXIS_DESCR
 FORMAT "%5.2" /end CHARACTERISTIC
/begin CHARACTERISTIC KF_WF_MKS_AKTIV_NEG "Aktivschwelle f. neg. WF | EN: Activation threshold for negative wall film" MAP 0x79DE8 TKF_SW_SW_UW 100.0 FORMULA_0530 0.0 512.0000
 /begin AXIS_DESCR STD_AXIS tsgrw FORMULA_0023 6 -50.0000 170.0000 FORMAT "%4.1" /end AXIS_DESCR
 /begin AXIS_DESCR STD_AXIS FORMULA_0006 5 0.0 10000.0000 /end AXIS_DESCR
 FORMAT "%5.2" /end CHARACTERISTIC
/begin CHARACTERISTIC KF_WF_SOLL_F_PUMG "WF-Korrekturfaktor Hoehe/Umgebungsdruck" MAP 0x79E3C TKF_SW_SW_UW 100.0 FORMULA_0075 0.0 4.0000 /begin AXIS_DESCR STD_AXIS FORMULA_0023 5 -50.0000 170.0000 FORMAT "%4.1" /end AXIS_DESCR /begin AXIS_DESCR STD_AXIS FORMULA_0077 5 400.0000 1200.0000 FORMAT "%4.1" /end AXIS_DESCR FORMAT "%6.3" /end CHARACTERISTIC
/begin CHARACTERISTIC KF_WF_SOLL_F_VAN "WF-Korrekturfaktor Ventilueberschneidung | EN: Wall-film correction factor, valve overlap" MAP 0x79E84 TKF_SW_SW_UW 100.0 FORMULA_0075 0.0 4.0000
 /begin AXIS_DESCR STD_AXIS van_vo_filt FORMULA_0111 8 -80.0000 80.0000 FORMAT "%4.1" /end AXIS_DESCR
 /begin AXIS_DESCR STD_AXIS FORMULA_0023 8 -50.0000 170.0000 FORMAT "%4.1" /end AXIS_DESCR
 FORMAT "%6.3" /end CHARACTERISTIC
/begin CHARACTERISTIC KF_WF_MKS_START_MAX "max. benoetigte MKS im START | EN: Max. required wall-film fuel mass during start" MAP 0x79F26 TKF_SW_SW_UW 100.0 FORMULA_0530 0.0 2000.0000 /begin AXIS_DESCR STD_AXIS FORMULA_0600 3 0.0 546.1166 FORMAT "%5.2" /end AXIS_DESCR
 /begin AXIS_DESCR STD_AXIS tsgrw FORMULA_0023 7 -50.0000 170.0000 FORMAT "%4.1" /end AXIS_DESCR
 FORMAT "%5.2" /end CHARACTERISTIC
/begin CHARACTERISTIC KF_WF_PSAU_WICHT "wf_psau-Wichtungskennfeld" MAP 0x79F66 TKF_SW_SW_UW 100.0 FORMULA_0075 0.0 4.0000
 /begin AXIS_DESCR STD_AXIS tsgrw FORMULA_0023 7 -50.0000 170.0000 FORMAT "%4.1" /end AXIS_DESCR
 /begin AXIS_DESCR STD_AXIS rf FORMULA_0007 4 0.0 2.0000 FORMAT "%6.3" /end AXIS_DESCR
 FORMAT "%6.3" /end CHARACTERISTIC
/begin CHARACTERISTIC KF_WF_SOLL_GRUND "SOLL-Grundwandfilmmasse | EN: Target base wall-film mass" MAP 0x79FB6 TKF_SW_SW_UW 100.0 FORMULA_0530 0.0 2000.0000 /begin AXIS_DESCR STD_AXIS psau FORMULA_0077 10 0.0 2000.0000 FORMAT "%4.1" /end AXIS_DESCR
 /begin AXIS_DESCR STD_AXIS tsgrw FORMULA_0023 10 -50.0000 170.0000 FORMAT "%4.1" /end AXIS_DESCR
 FORMAT "%5.2" /end CHARACTERISTIC
/begin CHARACTERISTIC KF_WF_SOLL_GRUND_DR_REL "SOLL-Grundwandfilmmasse - DR_REL" MAP 0x7A0A8 TKF_SW_SW_UW 100.0 FORMULA_0530 0.0 2000.0000 /begin AXIS_DESCR STD_AXIS dr_rel FORMULA_0115 10 0.0 199.9938 FORMAT "%5.2" /end AXIS_DESCR
 /begin AXIS_DESCR STD_AXIS tsgrw FORMULA_0023 10 -50.0000 170.0000 FORMAT "%4.1" /end AXIS_DESCR
 FORMAT "%5.2" /end CHARACTERISTIC
/begin CHARACTERISTIC KF_WF_MKS_F_N_DR_REL "N/RF-Schwelle f. WF-Verstaerkungsfaktor" MAP 0x7A19A TKF_SW_SW_UW 100.0 FORMULA_0075 0.0 4.0000 /begin AXIS_DESCR STD_AXIS FORMULA_0006 6 0.0 10000.0000 /end AXIS_DESCR /begin AXIS_DESCR STD_AXIS dr_rel FORMULA_0115 5 0.0 199.9938 FORMAT "%5.2" /end AXIS_DESCR FORMAT "%6.3" /end CHARACTERISTIC
/begin CHARACTERISTIC KF_WF_MKS_BEGR_POS "max. WF-MKS | EN: Maximum wall-film fuel mass" MAP 0x7A1EE TKF_SW_SW_UW 100.0 FORMULA_0075 0.0 4.0000
 /begin AXIS_DESCR STD_AXIS tsgrw FORMULA_0023 7 -50.0000 170.0000 FORMAT "%4.1" /end AXIS_DESCR
 /begin AXIS_DESCR STD_AXIS FORMULA_0010 4 0.0 32767.0000 /end AXIS_DESCR
 FORMAT "%6.3" /end CHARACTERISTIC
/begin CHARACTERISTIC KF_WF_MKS_BEGR_NEG "min. WF-MKS | EN: Minimum wall-film fuel mass" MAP 0x7A23E TKF_SW_SW_UW 100.0 FORMULA_0075 0.0 4.0000
 /begin AXIS_DESCR STD_AXIS tsgrw FORMULA_0023 7 -50.0000 170.0000 FORMAT "%4.1" /end AXIS_DESCR
 /begin AXIS_DESCR STD_AXIS FORMULA_0010 4 0.0 32767.0000 /end AXIS_DESCR
 FORMAT "%6.3" /end CHARACTERISTIC
/begin FUNCTION Schalter ""
 /begin DEF_CHARACTERISTIC KF_SCHALTER_KS_N_DIFF_AUF KL_SCHALTER_KS_REG K_SCHALTER_GETR_A0 K_SCHALTER_GETR_DIAG_MAX K_SCHALTER_GETR_DIAG_MIN K_SCHALTER_GETR_DIAG_N_GETR_EIN_MIN K_SCHALTER_GETR_DIAG_N_VERH_TAU K_SCHALTER_GETR_DIAG_STABIL K_SCHALTER_GETR_DIAG_T K_SCHALTER_GETR_DIAG_V_MIN K_SCHALTER_GETR_FIL_TAU K_SCHALTER_GETR_HYSTERESE_BREITE K_SCHALTER_GETR_LEERGASSE_MAX K_SCHALTER_GETR_LEERGASSE_MIN K_SCHALTER_KS_N_DIFF K_SCHALTER_KS_N_DIFF_REF K_SCHALTER_KS_N_T K_SCHALTER_KS_N_T_AUF K_SCHALTER_KS_SCHALT_T K_SCHALTER_KUPP_DIAG_N K_SCHALTER_KUPP_DIAG_RF K_SCHALTER_KUPP_DIAG_T K_SCHALTER_KUPP_DIAG_V_MAX K_SCHALTER_KUPP_DIAG_V_MIN K_SCHALTER_KUPP_GESCHL K_SCHALTER_KUPP_OFFEN K_SCHALTER_POEL_N_DELAY K_SCHALTER_POEL_N_DIAG K_SCHALTER_POEL_START_ENDE K_SCHALTER_POEL_TOEL K_SCHALTER_POEL_T_DIAG /end DEF_CHARACTERISTIC
 /begin REF_CHARACTERISTIC /end REF_CHARACTERISTIC
 /begin IN_MEASUREMENT /end IN_MEASUREMENT
 /begin OUT_MEASUREMENT /end OUT_MEASUREMENT
/end FUNCTION
/begin FUNCTION Sekundaerluftreg. ""
 /begin DEF_CHARACTERISTIC KF_SL_LAM_MOT_OFFS KF_SL_VORST_TV KL_SL_HFM_AD KL_SL_I_ANTEIL KL_SL_LAMSOL_KALT KL_SL_LAMSOL_WARM KL_SL_LAM_I_ANTEIL KL_SL_LAM_MOT_DELAY KL_SL_LAM_MOT_OFFS_KAT_F KL_SL_LAM_MOT_OFFS_TIME_F KL_SL_ML_MAX_PABG KL_SL_ML_MAX_UB_FAKT KL_SL_P_ANTEIL K_SL_HFM_CFG K_SL_HFM_TAU K_SL_I_MAX K_SL_I_MIN K_SL_LAM_ABG_TAU K_SL_LAM_MAX_FAK K_SL_LAM_MIN_FAK K_SL_LLS_CFG K_SL_ML_HFM_DIAG_MAX K_SL_ML_HFM_DIAG_MIN K_SL_ML_HFM_ERSATZ K_SL_TKAT_ANSPR /end DEF_CHARACTERISTIC
 /begin REF_CHARACTERISTIC /end REF_CHARACTERISTIC
 /begin IN_MEASUREMENT /end IN_MEASUREMENT
 /begin OUT_MEASUREMENT /end OUT_MEASUREMENT
/end FUNCTION
/begin FUNCTION Systemvariablen "" /begin DEF_CHARACTERISTIC /end DEF_CHARACTERISTIC /begin REF_CHARACTERISTIC /end REF_CHARACTERISTIC /begin IN_MEASUREMENT /end IN_MEASUREMENT /begin OUT_MEASUREMENT /end OUT_MEASUREMENT /end FUNCTION
/begin FUNCTION TE ""
 /begin DEF_CHARACTERISTIC KF_TE_ANZUGSZEIT KF_TE_GW_RAMPEN KF_TE_M_MAX_ML KF_TE_TV_NORM KF_TE_X_SOLL_KATD KF_TE_X_SOLL_MKS KF_TE_X_SOLL_NOT KF_TE_X_SOLL_N_PSAU KL_TE_FREQ KL_TE_GW_F KL_TE_GW_TI_MIN KL_TE_MKS_XSI KL_TE_ML_XSI KL_TE_SYNC_FREQ KL_TE_TI_MIN KL_TE_T_BEGIN_MIN KL_TE_YPS_SQRT K_TE_A_MIN K_TE_CFG K_TE_C_AKF_DYN_DELTA_RF K_TE_C_AKF_HYS K_TE_C_AKF_MAX K_TE_C_AKF_MAX_HYS K_TE_C_AKF_MIN K_TE_C_AKF_RESET K_TE_C_APPL K_TE_C_LERN_RED_TAU K_TE_C_LERN_TAU K_TE_C_MAX K_TE_C_MIN K_TE_C_ML_SOLL_MG_MIN K_TE_C_STAT_DELTA K_TE_C_STAT_T K_TE_C_T_SPUEL_MAX K_TE_C_T_SPUEL_MIN K_TE_C_X_MIN K_TE_DR_REL_MAX_SYNC K_TE_DYN_DELTA_RF K_TE_DYN_RF_T K_TE_GW_F_KATD K_TE_GW_LAA_FETT K_TE_GW_LAM_DELTA_FETT K_TE_GW_LAM_DELTA_HYS K_TE_GW_LAM_DELTA_MAGER K_TE_GW_LAM_REG_FETT K_TE_GW_LAM_REG_HYS K_TE_GW_LAM_REG_MAGER K_TE_LAA_F_TE_MCS K_TE_LAM_SOLL_MAX K_TE_LAM_SOLL_MIN K_TE_MKS_F_AEBG_SCHW_NEG K_TE_MKS_F_AEBG_SCHW_POS K_TE_MKS_F_MAX K_TE_MKS_F_NEG K_TE_MKS_F_POS K_TE_MKS_LAM_WICHT K_TE_MZYL_SEC_F K_TE_M_MAX_ML_CFG K_TE_N_DYN_DELTA K_TE_N_MAX_SYNC1 K_TE_RESET_CFG K_TE_RF_DYN_DELTA K_TE_R_C3H8 K_TE_R_LUFT K_TE_STOECH K_TE_TAN_MIN_LL K_TE_TI_MIN_DIFF K_TE_TMOT K_TE_TMOT_START_HS K_TE_TMOT_START_LANG K_TE_TV_MAX K_TE_TV_MIN K_TE_T_LAA K_TE_T_LAA_HS_INI K_TE_T_LAA_INI K_TE_T_LANG K_TE_T_MIN K_TE_T_ML_LANG K_TE_T_NORM K_TE_T_SPUEL_INI K_TE_VAN_DYN_DELTA K_TE_X_MKS_APPL K_TE_X_MKS_CFG K_TE_X_ML_SOLL_APPL K_TE_X_ML_SOLL_CFG K_TE_X_ML_SOLL_GW_MIN K_TE_X_ML_SOLL_MAX K_TE_X_ML_SOLL_MIN K_TE_ZU_GW K_TE_ZU_LERN K_TE_ZU_NORM K_TE_ZU_SA /end DEF_CHARACTERISTIC
 /begin REF_CHARACTERISTIC /end REF_CHARACTERISTIC
 /begin IN_MEASUREMENT /end IN_MEASUREMENT
 /begin OUT_MEASUREMENT /end OUT_MEASUREMENT
/end FUNCTION
/begin FUNCTION TE_OBD ""
 /begin DEF_CHARACTERISTIC KL_TE_OBD_RAMPE K_TE_OBD_ANZ K_TE_OBD_AUSS_DELTA K_TE_OBD_AUSS_DELTA_NEG K_TE_OBD_AUSS_TAU K_TE_OBD_CFG K_TE_OBD_LAM_DELTA K_TE_OBD_LAM_FREIG K_TE_OBD_LAM_OK K_TE_OBD_LL_DELAY K_TE_OBD_LL_DELTA K_TE_OBD_LL_OK K_TE_OBD_LL_ZU_DELTA K_TE_OBD_LRW_ABBR K_TE_OBD_MD_GEN_ABBR K_TE_OBD_MD_KKOS_ABBR K_TE_OBD_ML_MAX K_TE_OBD_ML_TAU K_TE_OBD_N_SOLL_ABBR K_TE_OBD_RAMPE_ABBRUCH K_TE_OBD_RAMPE_ZU K_TE_OBD_TOEL_MIN K_TE_OBD_TOEL_MIN_EXD K_TE_OBD_TV_MAX K_TE_OBD_TZ_ABBR K_TE_OBD_T_LAM_REG_OFF K_TE_OBD_T_MESS_OFFEN K_TE_OBD_T_MESS_ZU K_TE_OBD_T_ML_MIN K_TE_OBD_UB_ABBR /end DEF_CHARACTERISTIC
 /begin REF_CHARACTERISTIC /end REF_CHARACTERISTIC
 /begin IN_MEASUREMENT /end IN_MEASUREMENT
 /begin OUT_MEASUREMENT /end OUT_MEASUREMENT
/end FUNCTION
/begin FUNCTION TKS ""
 /begin DEF_CHARACTERISTIC KL_TANZYL_ABREG KL_TANZYL_ML_GES_RATIO KL_TANZYL_ML_GES_TAU KL_TANZYL_MR_ABREG KL_TANZYL_MR_TUMG_KAL KL_TKSM_ABREG KL_TKSM_MR_ABREG KL_TKSM_MR_TUMG_KAL KL_TKSM_Q_MOT_RATIO KL_TKSM_Q_MOT_TAU K_TANZYL_CFG K_TANZYL_MR_TAU K_TKSM_CFG K_TKSM_MR_TAU /end DEF_CHARACTERISTIC
 /begin REF_CHARACTERISTIC /end REF_CHARACTERISTIC
 /begin IN_MEASUREMENT /end IN_MEASUREMENT
 /begin OUT_MEASUREMENT /end OUT_MEASUREMENT
/end FUNCTION
/begin FUNCTION TPU ""
 /begin DEF_CHARACTERISTIC K_NW_CONFIG K_NW_IO K_NW_IO_ASP K_NW_MFMAX_1of2_ K_NW_MFMAX_2of2_ K_NW_MFMIN_1of2_ K_NW_MFMIN_2of2_ K_NW_NIO K_NW_NIO_INC K_NW_SYNC_ION_IO K_TPU_KW_N_MIN K_TPU_KW_SYNC_ZAHN /end DEF_CHARACTERISTIC
 /begin REF_CHARACTERISTIC /end REF_CHARACTERISTIC
 /begin IN_MEASUREMENT /end IN_MEASUREMENT
 /begin OUT_MEASUREMENT /end OUT_MEASUREMENT
/end FUNCTION
/begin FUNCTION TZ_DIAG "" /begin DEF_CHARACTERISTIC K_TZ_DIAG_MAX_BESTR /end DEF_CHARACTERISTIC /begin REF_CHARACTERISTIC /end REF_CHARACTERISTIC /begin IN_MEASUREMENT /end IN_MEASUREMENT /begin OUT_MEASUREMENT /end OUT_MEASUREMENT /end FUNCTION
/begin FUNCTION Tankleckdiagnose ""
 /begin DEF_CHARACTERISTIC KL_DMTL_FST_ERS_LI KL_DMTL_FST_ERS_RE KL_DMTL_FST_MAX_STAND KL_DMTL_HOEHE_KORR KL_DMTL_I_REF_KORR KL_DMTL_KORR_FAKT KL_DMTL_T_FEIN_MIN KL_DMTL_T_GROB KL_DMTL_T_STABIL K_DMTL_2_STABIL K_DMTL_ABBR_FEIN K_DMTL_ABBR_FEUCHT K_DMTL_ANZ_DECKEL K_DMTL_ANZ_DECKEL_LECK K_DMTL_ANZ_FAHRTEN K_DMTL_AY_MAX K_DMTL_CFG K_DMTL_DI_BETANK K_DMTL_DI_DECKEL K_DMTL_DI_STABIL K_DMTL_DI_TEV_OFFEN K_DMTL_DU_MAX K_DMTL_FAKT_T_DECKEL K_DMTL_FST_DECKEL_MAX K_DMTL_FST_ERSATZ K_DMTL_FST_MAX K_DMTL_FST_MIN K_DMTL_GROB_OHNE_FEIN K_DMTL_I_FAKT_CCDECKEL K_DMTL_I_FAKT_GROB K_DMTL_I_FAKT_P K_DMTL_I_KURZSCHL K_DMTL_I_REF_1_2_DIFF K_DMTL_I_REF_DIFF K_DMTL_I_REF_MAX K_DMTL_I_REF_MIN K_DMTL_P_MIN K_DMTL_START K_DMTL_TEMP_DECKEL_MAX K_DMTL_TEMP_DECKEL_MIN K_DMTL_TEMP_MAX K_DMTL_TEMP_MIN K_DMTL_TEMP_START_MIN K_DMTL_TEMP_VENT_MIN K_DMTL_TP_I K_DMTL_TP_I_BEG K_DMTL_TP_I_ROH K_DMTL_TP_I_TANK K_DMTL_TP_UB K_DMTL_T_ABSTELL K_DMTL_T_AY_DLY K_DMTL_T_CC_DAUER K_DMTL_T_DECKEL_ML_MIN K_DMTL_T_FEUCHT_DLY K_DMTL_T_KURZSCHL K_DMTL_T_MESS_GES K_DMTL_T_ML_MIN K_DMTL_T_REF K_DMTL_T_START_DLY K_DMTL_T_VENT_CHK K_DMTL_T_VENT_UM K_DMTL_UB_MAX K_DMTL_UB_MIN K_DMTL_V_MIN /end DEF_CHARACTERISTIC
 /begin REF_CHARACTERISTIC /end REF_CHARACTERISTIC
 /begin IN_MEASUREMENT /end IN_MEASUREMENT
 /begin OUT_MEASUREMENT /end OUT_MEASUREMENT
/end FUNCTION
/begin FUNCTION Testfunktion ""
 /begin DEF_CHARACTERISTIC KF_TEST_XY KL_TEST_X K_TEST K_TEST_LA_BANK1 K_TEST_LA_BANK2 K_TEST_MD_ZYL1 K_TEST_MD_ZYL10 K_TEST_MD_ZYL11 K_TEST_MD_ZYL12 K_TEST_MD_ZYL2 K_TEST_MD_ZYL3 K_TEST_MD_ZYL4 K_TEST_MD_ZYL5 K_TEST_MD_ZYL6 K_TEST_MD_ZYL7 K_TEST_MD_ZYL8 K_TEST_MD_ZYL9 K_TEST_X K_TEST_Y /end DEF_CHARACTERISTIC
 /begin REF_CHARACTERISTIC /end REF_CHARACTERISTIC
 /begin IN_MEASUREMENT /end IN_MEASUREMENT
 /begin OUT_MEASUREMENT /end OUT_MEASUREMENT
/end FUNCTION
/begin FUNCTION Umgebungsdruck ""
 /begin DEF_CHARACTERISTIC KF_PUMG_OBD_P_STAU_KOMP KF_PUMG_OBD_RF_MAX_P400 KF_PUMG_OBD_RF_MAX_P500 K_PUMG_AEBEGR K_PUMG_DIAG_MAX K_PUMG_DIAG_MIN K_PUMG_ERSATZ K_PUMG_MAX_E2 K_PUMG_MAX_NEG_GRAD_E2 K_PUMG_MAX_POS_GRAD_E2 K_PUMG_MIN_E2 K_PUMG_OBD_ABW K_PUMG_OBD_CFG K_PUMG_OBD_FPLAU_ABW_MAX K_PUMG_OBD_FPLAU_ABW_MAX_T K_PUMG_OBD_MIN_MESS K_PUMG_OBD_ML_MS K_PUMG_OBD_MODEL_DELTA_MAX K_PUMG_OBD_N_MAX K_PUMG_OBD_N_MIN K_PUMG_OBD_PUMG_TAU K_PUMG_OBD_PWG_MIN K_PUMG_OBD_TAN_MAX K_PUMG_OBD_TAN_MIN K_PUMG_OBD_TIME_ML_MIN K_PUMG_OBD_TUMG_MIN K_PUMG_OBD_V_MAX K_PUMG_OBD_ZV_DELTA_MAX K_PUMG_RBM_HEILUNG_CFG K_PUMG_SENSOR_OFFSET K_PUMG_SENSOR_STEIGUNG K_PUMG_TAU /end DEF_CHARACTERISTIC
 /begin REF_CHARACTERISTIC /end REF_CHARACTERISTIC
 /begin IN_MEASUREMENT /end IN_MEASUREMENT
 /begin OUT_MEASUREMENT /end OUT_MEASUREMENT
/end FUNCTION
/begin FUNCTION Vanos ""
 /begin DEF_CHARACTERISTIC KF_VAN_I_VORST_A KF_VAN_I_VORST_E KF_VAN_KH_SOLL_A KF_VAN_KH_SOLL_DMAX_A KF_VAN_KH_SOLL_DMAX_E KF_VAN_KH_SOLL_E KF_VAN_SOLL_A KF_VAN_SOLL_BEGR_A KF_VAN_SOLL_DMAX_A KF_VAN_SOLL_DMAX_E KF_VAN_SOLL_E KF_VAN_XD_TAU KL_VAN_DSV_HOLD_TV KL_VAN_DSV_PEAK_TV KL_VAN_FILTR_XD_WICHT KL_VAN_FREQU_ML KL_VAN_KD_A KL_VAN_KD_E KL_VAN_KI_A KL_VAN_KI_E KL_VAN_KP_A KL_VAN_KP_E KL_VAN_REG_FAKT_TMOT KL_VAN_SOLL_BEGR_E KL_VAN_T_DRUCK_E KL_VAN_T_SOLL_BEGR_E KL_VAN_T_START_DLY K_VAN_ANSCHL_DELTA K_VAN_ANSCHL_HYS K_VAN_ANSCHL_I_A1 K_VAN_ANSCHL_I_A2 K_VAN_ANSCHL_I_E1 K_VAN_ANSCHL_I_E2 K_VAN_ANSCHL_I_RAMPE K_VAN_ANSCHL_I_START_MAX K_VAN_ANSCHL_T K_VAN_BEGR_AB_FAKT_E K_VAN_CFG_A1 K_VAN_CFG_A2 K_VAN_CFG_E1 K_VAN_CFG_E2 K_VAN_DRUCK_CNT K_VAN_DRUCK_SOLL_OFFSET_E K_VAN_DRUCK_VERSTELL_E K_VAN_DSV_ABFALL_DLY K_VAN_DSV_CFG K_VAN_DSV_N_AUS K_VAN_DSV_N_EIN K_VAN_DSV_PEAK_TIME K_VAN_D_XD_TAU_Auslass K_VAN_D_XD_TAU_Einlass K_VAN_ERR_CFG K_VAN_EXD_GUETE_TAU K_VAN_EXD_I_MAX_Auslass K_VAN_EXD_I_MAX_Einlass K_VAN_EXD_I_MIN_Auslass K_VAN_EXD_I_MIN_Einlass K_VAN_EXD_N_SOLL K_VAN_EXD_SPR_MAX_MIN_Auslass K_VAN_EXD_SPR_MAX_MIN_Einlass K_VAN_EXD_TMOT_MIN K_VAN_EXD_T_ANSCHL K_VAN_EXD_T_GUETE K_VAN_EXD_VERST_SOLL_MAX_Auslass K_VAN_EXD_VERST_SOLL_MAX_Einlass K_VAN_EXD_VERST_SOLL_MIN_Auslass K_VAN_EXD_VERST_SOLL_MIN_Einlass K_VAN_EXD_VERST_TMAX K_VAN_EXD_VERST_TOL K_VAN_EXD_VERST_TOL_START K_VAN_FILTR_AMPL K_VAN_FILTR_DAUER K_VAN_FILTR_PERIOD K_VAN_FILTR_SOLL_DELTA K_VAN_FILTR_TV_PRUEF K_VAN_FILTR_T_ML_MIN K_VAN_FREQU_ANSCHL K_VAN_FREQU_SPUEL_MIN K_VAN_FREQU_STAND K_VAN_FREQU_WICHT K_VAN_GUETE_CFG K_VAN_GUETE_DAUER K_VAN_GUETE_INIT K_VAN_GUETE_PAUSE K_VAN_GUETE_RESET K_VAN_GUETE_RESET_MIN K_VAN_GUETE_RESET_ZEIT K_VAN_GUETE_TAU K_VAN_GUETE_TMOT K_VAN_GUETE_TOEL K_VAN_INVERT_A1 K_VAN_INVERT_A2 K_VAN_INVERT_E1 K_VAN_INVERT_E2 K_VAN_I_I_MAX K_VAN_I_I_MIN K_VAN_I_MAX K_VAN_KP_XD_KORR_Auslass K_VAN_KP_XD_KORR_Einlass K_VAN_KW_SPR_MAX_A1 K_VAN_KW_SPR_MAX_A2 K_VAN_KW_SPR_MAX_E1 K_VAN_KW_SPR_MAX_E2 K_VAN_N_OFF K_VAN_N_OFFSET_MAX_A K_VAN_N_OFFSET_MIN_A K_VAN_N_ON K_VAN_R20 K_VAN_RAD_CFG K_VAN_RAD_MAX K_VAN_RAD_MIN K_VAN_R_TK K_VAN_SMG_DAUER_MAX K_VAN_SMG_DR_REL K_VAN_SMG_MD_ABBR K_VAN_SMG_MD_MIN K_VAN_SMG_N_ABBR K_VAN_SMG_N_MIN K_VAN_SMG_T_AUFREG K_VAN_SOLL_ABSTELL_Auslass K_VAN_SOLL_ABSTELL_Einlass K_VAN_SOLL_CFG K_VAN_SOLL_ERSATZ_Auslass K_VAN_SOLL_ERSATZ_Einlass K_VAN_SOLL_MAX_Auslass K_VAN_SOLL_MAX_Einlass K_VAN_SOLL_MIN_Auslass K_VAN_SOLL_MIN_Einlass K_VAN_SOLL_OFFSET_Auslass K_VAN_SOLL_OFFSET_Einlass K_VAN_SPR_MAX_Auslass K_VAN_SPR_MAX_Einlass K_VAN_SPR_MAX_TOL_Auslass K_VAN_SPR_MAX_TOL_Einlass K_VAN_SPR_MIN_Auslass K_VAN_SPR_MIN_Einlass K_VAN_SPR_OFFSET_A1 K_VAN_SPR_OFFSET_A2 K_VAN_SPR_OFFSET_E1 K_VAN_SPR_OFFSET_E2 K_VAN_START_I_MAX_AUSLASS K_VAN_SZ_Auslass K_VAN_SZ_Einlass K_VAN_TMOT_BEGR_E K_VAN_TV_MCS_A1 K_VAN_TV_MCS_A2 K_VAN_TV_MCS_E1 K_VAN_TV_MCS_E2 K_VAN_UB_ERS K_VAN_UNLOCK_SPR_Auslass K_VAN_UNLOCK_SPR_Einlass K_VAN_UNL_D_I_Auslass K_VAN_UNL_D_I_Einlass K_VAN_UNL_I_DYN_Auslass K_VAN_UNL_I_DYN_Einlass K_VAN_UNL_N_MIN_Auslass K_VAN_UNL_N_MIN_Einlass K_VAN_XD_EINGEREGELT K_VAN_XD_FILT_ED_Auslass K_VAN_XD_FILT_ED_Einlass K_VAN_XD_REG_MIN K_VAN_XD_SK /end DEF_CHARACTERISTIC
 /begin REF_CHARACTERISTIC /end REF_CHARACTERISTIC
 /begin IN_MEASUREMENT /end IN_MEASUREMENT
 /begin OUT_MEASUREMENT /end OUT_MEASUREMENT
/end FUNCTION
/begin FUNCTION Version "" /begin DEF_CHARACTERISTIC K_DATENKENNUNG_1_1of5_ K_DATENKENNUNG_2_1of5_ /end DEF_CHARACTERISTIC /begin REF_CHARACTERISTIC /end REF_CHARACTERISTIC /begin IN_MEASUREMENT /end IN_MEASUREMENT /begin OUT_MEASUREMENT /end OUT_MEASUREMENT /end FUNCTION
/begin FUNCTION Wandfilm ""
 /begin DEF_CHARACTERISTIC KF_WF_ASP_NEG KF_WF_ASP_POS KF_WF_MKS_AKTIV_NEG KF_WF_MKS_AKTIV_POS KF_WF_MKS_BEGR_NEG KF_WF_MKS_BEGR_POS KF_WF_MKS_F_N_DR_REL KF_WF_MKS_START_MAX KF_WF_OELV_ETA KF_WF_PSAU_WICHT KF_WF_SOLL_F_PUMG KF_WF_SOLL_F_VAN KF_WF_SOLL_GRUND KF_WF_SOLL_GRUND_DR_REL KL_WF_ASP_NEG_START KL_WF_ASP_POS_START KL_WF_DMKS_T1_MS KL_WF_MD_RF_TAU KL_WF_MKS_BEGR_NEG_WICHT KL_WF_MKS_F_TSGRW KL_WF_SOLL_F_LAM KL_WF_SOLL_F_TI_PHI_ENDE K_WF_ASP_START K_WF_IST_CFG K_WF_IST_PLAU_MAX K_WF_MKS_AUS_HYS K_WF_MKS_F K_WF_MKS_F_CFG K_WF_MKS_TI_CFG K_WF_SOLL_CFG K_WF_SOLL_START_PSAU K_WF_SOLL_START_PSAU_CFG /end DEF_CHARACTERISTIC
 /begin REF_CHARACTERISTIC /end REF_CHARACTERISTIC
 /begin IN_MEASUREMENT /end IN_MEASUREMENT
 /begin OUT_MEASUREMENT /end OUT_MEASUREMENT
/end FUNCTION
/begin RECORD_LAYOUT TKW_VV_VV_UB FNC_VALUES 1 UBYTE COLUMN_DIR DIRECT /end RECORD_LAYOUT
/begin RECORD_LAYOUT TKW_VV_VV_SB FNC_VALUES 1 SBYTE COLUMN_DIR DIRECT /end RECORD_LAYOUT
/begin RECORD_LAYOUT TKW_VV_VV_UW FNC_VALUES 1 UWORD COLUMN_DIR DIRECT /end RECORD_LAYOUT
/begin RECORD_LAYOUT TKW_VV_VV_SW FNC_VALUES 1 SWORD COLUMN_DIR DIRECT /end RECORD_LAYOUT
/begin RECORD_LAYOUT TKW_VV_VV_UL FNC_VALUES 1 ULONG COLUMN_DIR DIRECT /end RECORD_LAYOUT
/begin RECORD_LAYOUT TKL_UB_VV_UB NO_AXIS_PTS_X 1 UBYTE RESERVED 2 BYTE AXIS_PTS_X 3 UBYTE INDEX_INCR DIRECT FNC_VALUES 4 UBYTE COLUMN_DIR DIRECT /end RECORD_LAYOUT
/begin RECORD_LAYOUT TKL_SB_VV_UW NO_AXIS_PTS_X 1 UBYTE RESERVED 2 BYTE AXIS_PTS_X 3 SBYTE INDEX_INCR DIRECT FNC_VALUES 4 UWORD COLUMN_DIR DIRECT /end RECORD_LAYOUT
/begin RECORD_LAYOUT TKL_UW_VV_UW NO_AXIS_PTS_X 1 UBYTE RESERVED 2 BYTE AXIS_PTS_X 3 UWORD INDEX_INCR DIRECT FNC_VALUES 4 UWORD COLUMN_DIR DIRECT /end RECORD_LAYOUT
/begin RECORD_LAYOUT TKL_UW_VV_SW NO_AXIS_PTS_X 1 UBYTE RESERVED 2 BYTE AXIS_PTS_X 3 UWORD INDEX_INCR DIRECT FNC_VALUES 4 SWORD COLUMN_DIR DIRECT /end RECORD_LAYOUT
/begin RECORD_LAYOUT TKL_SW_VV_UB NO_AXIS_PTS_X 1 UBYTE RESERVED 2 BYTE AXIS_PTS_X 3 SWORD INDEX_INCR DIRECT FNC_VALUES 4 UBYTE COLUMN_DIR DIRECT /end RECORD_LAYOUT
/begin RECORD_LAYOUT TKL_SW_VV_UW NO_AXIS_PTS_X 1 UBYTE RESERVED 2 BYTE AXIS_PTS_X 3 SWORD INDEX_INCR DIRECT FNC_VALUES 4 UWORD COLUMN_DIR DIRECT /end RECORD_LAYOUT
/begin RECORD_LAYOUT TKL_SW_VV_SW NO_AXIS_PTS_X 1 UBYTE RESERVED 2 BYTE AXIS_PTS_X 3 SWORD INDEX_INCR DIRECT FNC_VALUES 4 SWORD COLUMN_DIR DIRECT /end RECORD_LAYOUT
/begin RECORD_LAYOUT TKF_UW_UW_UW NO_AXIS_PTS_X 1 UBYTE NO_AXIS_PTS_Y 2 UBYTE AXIS_PTS_X 3 UWORD INDEX_INCR DIRECT AXIS_PTS_Y 4 UWORD INDEX_INCR DIRECT FNC_VALUES 5 UWORD COLUMN_DIR DIRECT /end RECORD_LAYOUT
/begin RECORD_LAYOUT TKF_SW_SW_UW NO_AXIS_PTS_X 1 UBYTE NO_AXIS_PTS_Y 2 UBYTE AXIS_PTS_X 3 SWORD INDEX_INCR DIRECT AXIS_PTS_Y 4 SWORD INDEX_INCR DIRECT FNC_VALUES 5 UWORD COLUMN_DIR DIRECT /end RECORD_LAYOUT
/begin RECORD_LAYOUT TKF_SW_SW_SW NO_AXIS_PTS_X 1 UBYTE NO_AXIS_PTS_Y 2 UBYTE AXIS_PTS_X 3 SWORD INDEX_INCR DIRECT AXIS_PTS_Y 4 SWORD INDEX_INCR DIRECT FNC_VALUES 5 SWORD COLUMN_DIR DIRECT /end RECORD_LAYOUT
/end MODULE
/end PROJECT
