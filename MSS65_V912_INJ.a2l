/begin PROJECT MSS65-inj-V912 "MSS65 INJ - V912.00-B204.00, data set 0569Q60Z520E"
/begin HEADER "" VERSION "V912.00-B204.00" /end HEADER
/begin MODULE _MSS65-inj "MSS65 INJ - V912.00-B204.00, data 7842800"
/begin MOD_COMMON "" BYTE_ORDER MSB_FIRST /* Default byteorder (Motorola) */ /end MOD_COMMON
/begin COMPU_METHOD FORMULA_0003 "FORMULA_0003" RAT_FUNC "%3.0" "-" COEFFS 0 1 0 0 0 1 /end COMPU_METHOD
/begin COMPU_METHOD FORMULA_0010 "FORMULA_0010" RAT_FUNC "%5.0" "-" COEFFS 0 1 0 0 0 1 /end COMPU_METHOD
/begin COMPU_METHOD FORMULA_0079 "FORMULA_0079" RAT_FUNC "%6.1" "l" COEFFS 0 2 0 0 0 1 /end COMPU_METHOD
/begin CHARACTERISTIC K_ED_FST_MAX "Maximaler Tankfuellstand" VALUE 0x71CC8 TKW_VV_VV_UW 100.0 FORMULA_0079 0.0 32767.5000 FORMAT "%4.1" /end CHARACTERISTIC
/begin CHARACTERISTIC K_ED_HFM1.P_CODE_SH_TO_UB "P-Code fuer die Art SH_TO_UB | EN: Fault code HFM1 - OBD P-code reported for short to battery voltage" VALUE 0x7061E TKW_VV_VV_UW 100.0 FORMULA_0010 0.0 65535.0000 /end CHARACTERISTIC
/begin CHARACTERISTIC K_ED_HFM2.P_CODE_SH_TO_UB "P-Code fuer die Art SH_TO_UB | EN: Fault code HFM2 - OBD P-code reported for short to battery voltage" VALUE 0x70638 TKW_VV_VV_UW 100.0 FORMULA_0010 0.0 65535.0000 /end CHARACTERISTIC
/begin CHARACTERISTIC K_ED_LAVK1.P_CODE_SH_TO_UB "P-Code fuer die Art SH_TO_UB | EN: Fault code LAVK1 - OBD P-code reported for short to battery voltage" VALUE 0x707F2 TKW_VV_VV_UW 100.0 FORMULA_0010 0.0 65535.0000 /end CHARACTERISTIC
/begin CHARACTERISTIC K_ED_LANK1.P_CODE_SH_TO_UB "P-Code fuer die Art SH_TO_UB | EN: Fault code LANK1 - OBD P-code reported for short to battery voltage" VALUE 0x7088E TKW_VV_VV_UW 100.0 FORMULA_0010 0.0 65535.0000 /end CHARACTERISTIC
/begin CHARACTERISTIC K_ED_LANK2.P_CODE_SH_TO_UB "P-Code fuer die Art SH_TO_UB | EN: Fault code LANK2 - OBD P-code reported for short to battery voltage" VALUE 0x708A8 TKW_VV_VV_UW 100.0 FORMULA_0010 0.0 65535.0000 /end CHARACTERISTIC
/begin CHARACTERISTIC K_ED_FPLAU1.P_CODE_SH_TO_UB "P-Code fuer die Art SH_TO_UB | EN: Fault code FPLAU1 - OBD P-code reported for short to battery voltage" VALUE 0x709E0 TKW_VV_VV_UW 100.0 FORMULA_0010 0.0 65535.0000 /end CHARACTERISTIC
/begin CHARACTERISTIC K_ED_FPLAU2.P_CODE_SH_TO_UB "P-Code fuer die Art SH_TO_UB | EN: Fault code FPLAU2 - OBD P-code reported for short to battery voltage" VALUE 0x709FA TKW_VV_VV_UW 100.0 FORMULA_0010 0.0 65535.0000 /end CHARACTERISTIC
/begin CHARACTERISTIC K_ED_LANK1_OBD_S.P_CODE_SH_TO_UB "P-Code fuer die Art SH_TO_UB | EN: Fault code LANK1_OBD_S - OBD P-code reported for short to battery voltage" VALUE 0x70A2E TKW_VV_VV_UW 100.0 FORMULA_0010 0.0 65535.0000 /end CHARACTERISTIC
/begin CHARACTERISTIC K_ED_LANK2_OBD_S.P_CODE_SH_TO_UB "P-Code fuer die Art SH_TO_UB | EN: Fault code LANK2_OBD_S - OBD P-code reported for short to battery voltage" VALUE 0x70A48 TKW_VV_VV_UW 100.0 FORMULA_0010 0.0 65535.0000 /end CHARACTERISTIC
/begin CHARACTERISTIC K_ED_LAVK1_DIAG.P_CODE_SH_TO_UB "P-Code fuer die Art SH_TO_UB | EN: Fault code LAVK1_DIAG - OBD P-code reported for short to battery voltage" VALUE 0x70B9A TKW_VV_VV_UW 100.0 FORMULA_0010 0.0 65535.0000 /end CHARACTERISTIC
/begin CHARACTERISTIC K_ED_LAM1_REG.P_CODE_SH_TO_UB "P-Code fuer die Art SH_TO_UB | EN: Fault code LAM1_REG - OBD P-code reported for short to battery voltage" VALUE 0x70DBC TKW_VV_VV_UW 100.0 FORMULA_0010 0.0 65535.0000 /end CHARACTERISTIC
/begin CHARACTERISTIC K_ED_LAM2_REG.P_CODE_SH_TO_UB "P-Code fuer die Art SH_TO_UB | EN: Fault code LAM2_REG - OBD P-code reported for short to battery voltage" VALUE 0x70DD6 TKW_VV_VV_UW 100.0 FORMULA_0010 0.0 65535.0000 /end CHARACTERISTIC
/begin CHARACTERISTIC K_ED_KAT_OBD1.P_CODE_SH_TO_UB "P-Code fuer die Art SH_TO_UB | EN: Fault code KAT_OBD1 - OBD P-code reported for short to battery voltage" VALUE 0x71234 TKW_VV_VV_UW 100.0 FORMULA_0010 0.0 65535.0000 /end CHARACTERISTIC
/begin CHARACTERISTIC K_ED_KAT_OBD2.P_CODE_SH_TO_UB "P-Code fuer die Art SH_TO_UB | EN: Fault code KAT_OBD2 - OBD P-code reported for short to battery voltage" VALUE 0x7124E TKW_VV_VV_UW 100.0 FORMULA_0010 0.0 65535.0000 /end CHARACTERISTIC
/begin CHARACTERISTIC K_ED_FI_GEN.P_CODE_SH_TO_UB "P-Code fuer die Art SH_TO_UB | EN: Fault code FI_GEN - OBD P-code reported for short to battery voltage" VALUE 0x71282 TKW_VV_VV_UW 100.0 FORMULA_0010 0.0 65535.0000 /end CHARACTERISTIC
/begin CHARACTERISTIC K_ED_FI_QLT.P_CODE_SH_TO_UB "P-Code fuer die Art SH_TO_UB | EN: Fault code FI_QLT - OBD P-code reported for short to battery voltage" VALUE 0x712B6 TKW_VV_VV_UW 100.0 FORMULA_0010 0.0 65535.0000 /end CHARACTERISTIC
/begin CHARACTERISTIC K_ED_FI_IBS1.P_CODE_SH_TO_UB "P-Code fuer die Art SH_TO_UB | EN: Fault code FI_IBS1 - OBD P-code reported for short to battery voltage" VALUE 0x712D0 TKW_VV_VV_UW 100.0 FORMULA_0010 0.0 65535.0000 /end CHARACTERISTIC
/begin CHARACTERISTIC K_ED_FI_IBS2.P_CODE_SH_TO_UB "P-Code fuer die Art SH_TO_UB | EN: Fault code FI_IBS2 - OBD P-code reported for short to battery voltage" VALUE 0x712EA TKW_VV_VV_UW 100.0 FORMULA_0010 0.0 65535.0000 /end CHARACTERISTIC
/begin CHARACTERISTIC K_ED_FI_IBS3.P_CODE_SH_TO_UB "P-Code fuer die Art SH_TO_UB | EN: Fault code FI_IBS3 - OBD P-code reported for short to battery voltage" VALUE 0x71304 TKW_VV_VV_UW 100.0 FORMULA_0010 0.0 65535.0000 /end CHARACTERISTIC
/begin CHARACTERISTIC K_ED_FI_PMBN.P_CODE_SH_TO_UB "P-Code fuer die Art SH_TO_UB | EN: Fault code FI_PMBN - OBD P-code reported for short to battery voltage" VALUE 0x7131E TKW_VV_VV_UW 100.0 FORMULA_0010 0.0 65535.0000 /end CHARACTERISTIC
/begin CHARACTERISTIC K_ED_FI_PMRUHVERL.P_CODE_SH_TO_UB "P-Code fuer die Art SH_TO_UB | EN: Fault code FI_PMRUHVERL - OBD P-code reported for short to battery voltage" VALUE 0x7143C TKW_VV_VV_UW 100.0 FORMULA_0010 0.0 65535.0000 /end CHARACTERISTIC
/begin CHARACTERISTIC K_ED_FI_TOENS.P_CODE_SH_TO_UB "P-Code fuer die Art SH_TO_UB | EN: Fault code FI_TOENS - OBD P-code reported for short to battery voltage" VALUE 0x71456 TKW_VV_VV_UW 100.0 FORMULA_0010 0.0 65535.0000 /end CHARACTERISTIC
/begin CHARACTERISTIC K_ED_KW.P_CODE_SH_TO_UB "P-Code fuer die Art SH_TO_UB | EN: Fault code KW - OBD P-code reported for short to battery voltage" VALUE 0x71574 TKW_VV_VV_UW 100.0 FORMULA_0010 0.0 65535.0000 /end CHARACTERISTIC
/begin CHARACTERISTIC K_ED_LA1_ADAPT.P_CODE_SH_TO_UB "P-Code fuer die Art SH_TO_UB | EN: Fault code LA1_ADAPT - OBD P-code reported for short to battery voltage" VALUE 0x7158E TKW_VV_VV_UW 100.0 FORMULA_0010 0.0 65535.0000 /end CHARACTERISTIC
/begin CHARACTERISTIC K_ED_LA2_ADAPT.P_CODE_SH_TO_UB "P-Code fuer die Art SH_TO_UB | EN: Fault code LA2_ADAPT - OBD P-code reported for short to battery voltage" VALUE 0x715A8 TKW_VV_VV_UW 100.0 FORMULA_0010 0.0 65535.0000 /end CHARACTERISTIC
/begin CHARACTERISTIC K_ED_KGE1.P_CODE_SH_TO_UB "P-Code fuer die Art SH_TO_UB | EN: Fault code KGE1 - OBD P-code reported for short to battery voltage" VALUE 0x715C2 TKW_VV_VV_UW 100.0 FORMULA_0010 0.0 65535.0000 /end CHARACTERISTIC
/begin CHARACTERISTIC K_ED_KGE2.P_CODE_SH_TO_UB "P-Code fuer die Art SH_TO_UB | EN: Fault code KGE2 - OBD P-code reported for short to battery voltage" VALUE 0x715DC TKW_VV_VV_UW 100.0 FORMULA_0010 0.0 65535.0000 /end CHARACTERISTIC
/begin CHARACTERISTIC K_ED_FST.P_CODE_SH_TO_UB "P-Code fuer die Art SH_TO_UB | EN: Fault code FST - OBD P-code reported for short to battery voltage" VALUE 0x715F6 TKW_VV_VV_UW 100.0 FORMULA_0010 0.0 65535.0000 /end CHARACTERISTIC
/begin CHARACTERISTIC K_ED_KSD1.P_CODE_SH_TO_UB "P-Code fuer die Art SH_TO_UB | EN: Fault code KSD1 - OBD P-code reported for short to battery voltage" VALUE 0x7172E TKW_VV_VV_UW 100.0 FORMULA_0010 0.0 65535.0000 /end CHARACTERISTIC
/begin CHARACTERISTIC K_ED_KSD2.P_CODE_SH_TO_UB "P-Code fuer die Art SH_TO_UB | EN: Fault code KSD2 - OBD P-code reported for short to battery voltage" VALUE 0x71748 TKW_VV_VV_UW 100.0 FORMULA_0010 0.0 65535.0000 /end CHARACTERISTIC
/begin CHARACTERISTIC K_ED_KATS_B1.P_CODE_SH_TO_UB "P-Code fuer die Art SH_TO_UB | EN: Fault code KATS_B1 - OBD P-code reported for short to battery voltage" VALUE 0x71762 TKW_VV_VV_UW 100.0 FORMULA_0010 0.0 65535.0000 /end CHARACTERISTIC
/begin CHARACTERISTIC K_ED_KATS_B2.P_CODE_SH_TO_UB "P-Code fuer die Art SH_TO_UB | EN: Fault code KATS_B2 - OBD P-code reported for short to battery voltage" VALUE 0x7177C TKW_VV_VV_UW 100.0 FORMULA_0010 0.0 65535.0000 /end CHARACTERISTIC
/begin CHARACTERISTIC K_ED_FST_GEBER.P_CODE_SH_TO_UB "P-Code fuer die Art SH_TO_UB | EN: Fault code FST_GEBER - OBD P-code reported for short to battery voltage" VALUE 0x717CA TKW_VV_VV_UW 100.0 FORMULA_0010 0.0 65535.0000 /end CHARACTERISTIC
/begin CHARACTERISTIC K_ED_LA1_TRIM_AD.P_CODE_SH_TO_UB "P-Code fuer die Art SH_TO_UB | EN: Fault code LA1_TRIM_AD - OBD P-code reported for short to battery voltage" VALUE 0x71866 TKW_VV_VV_UW 100.0 FORMULA_0010 0.0 65535.0000 /end CHARACTERISTIC
/begin CHARACTERISTIC K_ED_LA2_TRIM_AD.P_CODE_SH_TO_UB "P-Code fuer die Art SH_TO_UB | EN: Fault code LA2_TRIM_AD - OBD P-code reported for short to battery voltage" VALUE 0x71880 TKW_VV_VV_UW 100.0 FORMULA_0010 0.0 65535.0000 /end CHARACTERISTIC
/begin CHARACTERISTIC K_ED_LANK1_OPENLOAD.P_CODE_SH_TO_UB "P-Code fuer die Art SH_TO_UB | EN: Fault code LANK1_OPENLOAD - OBD P-code reported for short to battery voltage" VALUE 0x7189A TKW_VV_VV_UW 100.0 FORMULA_0010 0.0 65535.0000 /end CHARACTERISTIC
/begin CHARACTERISTIC K_ED_LANK2_OPENLOAD.P_CODE_SH_TO_UB "P-Code fuer die Art SH_TO_UB | EN: Fault code LANK2_OPENLOAD - OBD P-code reported for short to battery voltage" VALUE 0x718B4 TKW_VV_VV_UW 100.0 FORMULA_0010 0.0 65535.0000 /end CHARACTERISTIC
/begin CHARACTERISTIC K_ED_LANK1_OBD_WE.P_CODE_SH_TO_UB "P-Code fuer die Art SH_TO_UB | EN: Fault code LANK1_OBD_WE - OBD P-code reported for short to battery voltage" VALUE 0x718CE TKW_VV_VV_UW 100.0 FORMULA_0010 0.0 65535.0000 /end CHARACTERISTIC
/begin CHARACTERISTIC K_ED_LANK2_OBD_WE.P_CODE_SH_TO_UB "P-Code fuer die Art SH_TO_UB | EN: Fault code LANK2_OBD_WE - OBD P-code reported for short to battery voltage" VALUE 0x718E8 TKW_VV_VV_UW 100.0 FORMULA_0010 0.0 65535.0000 /end CHARACTERISTIC
/begin CHARACTERISTIC K_ED_FST_GEBER_LI.P_CODE_SH_TO_UB "P-Code fuer die Art SH_TO_UB" VALUE 0x719EC TKW_VV_VV_UW 100.0 FORMULA_0010 0.0 65535.0000 /end CHARACTERISTIC
/begin CHARACTERISTIC K_ED_FST_GEBER_RE.P_CODE_SH_TO_UB "P-Code fuer die Art SH_TO_UB" VALUE 0x71A06 TKW_VV_VV_UW 100.0 FORMULA_0010 0.0 65535.0000 /end CHARACTERISTIC
/begin CHARACTERISTIC K_ED_LANK1_OBD_SLOPE.P_CODE_SH_TO_UB "P-Code fuer die Art SH_TO_UB" VALUE 0x71A20 TKW_VV_VV_UW 100.0 FORMULA_0010 0.0 65535.0000 /end CHARACTERISTIC
/begin CHARACTERISTIC K_ED_LANK2_OBD_SLOPE.P_CODE_SH_TO_UB "P-Code fuer die Art SH_TO_UB" VALUE 0x71A3A TKW_VV_VV_UW 100.0 FORMULA_0010 0.0 65535.0000 /end CHARACTERISTIC
/begin CHARACTERISTIC K_ED_INDEX_204_INJ.P_CODE_SH_TO_UB "P-Code fuer die Art SH_TO_UB | EN: Fault code INDEX_204_INJ - OBD P-code reported for short to battery voltage" VALUE 0x71AA2 TKW_VV_VV_UW 100.0 FORMULA_0010 0.0 65535.0000 /end CHARACTERISTIC
/begin CHARACTERISTIC K_ED_INDEX_205_INJ.P_CODE_SH_TO_UB "P-Code fuer die Art SH_TO_UB | EN: Fault code INDEX_205_INJ - OBD P-code reported for short to battery voltage" VALUE 0x71ABC TKW_VV_VV_UW 100.0 FORMULA_0010 0.0 65535.0000 /end CHARACTERISTIC
/begin CHARACTERISTIC K_ED_INDEX_206_INJ.P_CODE_SH_TO_UB "P-Code fuer die Art SH_TO_UB | EN: Fault code INDEX_206_INJ - OBD P-code reported for short to battery voltage" VALUE 0x71AD6 TKW_VV_VV_UW 100.0 FORMULA_0010 0.0 65535.0000 /end CHARACTERISTIC
/begin CHARACTERISTIC K_ED_INDEX_207_INJ.P_CODE_SH_TO_UB "P-Code fuer die Art SH_TO_UB | EN: P-Code fuer die Art SH_TO_UB" VALUE 0x71AF0 TKW_VV_VV_UW 100.0 FORMULA_0010 0.0 65535.0000 /end CHARACTERISTIC
/begin CHARACTERISTIC K_ED_INDEX_208_INJ.P_CODE_SH_TO_UB "P-Code fuer die Art SH_TO_UB | EN: P-Code fuer die Art SH_TO_UB" VALUE 0x71B0A TKW_VV_VV_UW 100.0 FORMULA_0010 0.0 65535.0000 /end CHARACTERISTIC
/begin CHARACTERISTIC K_ED_INDEX_209_INJ.P_CODE_SH_TO_UB "P-Code fuer die Art SH_TO_UB" VALUE 0x71B24 TKW_VV_VV_UW 100.0 FORMULA_0010 0.0 65535.0000 /end CHARACTERISTIC
/begin CHARACTERISTIC K_ED_INDEX_210_INJ.P_CODE_SH_TO_UB "P-Code fuer die Art SH_TO_UB" VALUE 0x71B3E TKW_VV_VV_UW 100.0 FORMULA_0010 0.0 65535.0000 /end CHARACTERISTIC
/begin CHARACTERISTIC K_ED_INDEX_211_INJ.P_CODE_SH_TO_UB "P-Code fuer die Art SH_TO_UB | EN: P-Code fuer die Art SH_TO_UB" VALUE 0x71B58 TKW_VV_VV_UW 100.0 FORMULA_0010 0.0 65535.0000 /end CHARACTERISTIC
/begin CHARACTERISTIC K_ED_INDEX_212_INJ.P_CODE_SH_TO_UB "P-Code fuer die Art SH_TO_UB | EN: P-Code fuer die Art SH_TO_UB" VALUE 0x71B72 TKW_VV_VV_UW 100.0 FORMULA_0010 0.0 65535.0000 /end CHARACTERISTIC
/begin CHARACTERISTIC K_ED_INDEX_213_INJ.P_CODE_SH_TO_UB "P-Code fuer die Art SH_TO_UB" VALUE 0x71B8C TKW_VV_VV_UW 100.0 FORMULA_0010 0.0 65535.0000 /end CHARACTERISTIC
/begin CHARACTERISTIC K_ED_INDEX_214_INJ.P_CODE_SH_TO_UB "P-Code fuer die Art SH_TO_UB" VALUE 0x71BA6 TKW_VV_VV_UW 100.0 FORMULA_0010 0.0 65535.0000 /end CHARACTERISTIC
/begin CHARACTERISTIC K_ED_INDEX_215_INJ.P_CODE_SH_TO_UB "P-Code fuer die Art SH_TO_UB | EN: P-Code fuer die Art SH_TO_UB" VALUE 0x71BC0 TKW_VV_VV_UW 100.0 FORMULA_0010 0.0 65535.0000 /end CHARACTERISTIC
/begin CHARACTERISTIC K_ED_INDEX_216_INJ.P_CODE_SH_TO_UB "P-Code fuer die Art SH_TO_UB | EN: P-Code fuer die Art SH_TO_UB" VALUE 0x71BDA TKW_VV_VV_UW 100.0 FORMULA_0010 0.0 65535.0000 /end CHARACTERISTIC
/begin CHARACTERISTIC K_ED_INDEX_217_INJ.P_CODE_SH_TO_UB "P-Code fuer die Art SH_TO_UB | EN: P-Code fuer die Art SH_TO_UB" VALUE 0x71BF4 TKW_VV_VV_UW 100.0 FORMULA_0010 0.0 65535.0000 /end CHARACTERISTIC
/begin CHARACTERISTIC K_ED_INDEX_218_INJ.P_CODE_SH_TO_UB "P-Code fuer die Art SH_TO_UB | EN: P-Code fuer die Art SH_TO_UB" VALUE 0x71C0E TKW_VV_VV_UW 100.0 FORMULA_0010 0.0 65535.0000 /end CHARACTERISTIC
/begin CHARACTERISTIC K_ED_INDEX_219_INJ.P_CODE_SH_TO_UB "P-Code fuer die Art SH_TO_UB | EN: P-Code fuer die Art SH_TO_UB" VALUE 0x71C28 TKW_VV_VV_UW 100.0 FORMULA_0010 0.0 65535.0000 /end CHARACTERISTIC
/begin CHARACTERISTIC K_ED_INDEX_220_INJ.P_CODE_SH_TO_UB "P-Code fuer die Art SH_TO_UB | EN: P-Code fuer die Art SH_TO_UB" VALUE 0x71C42 TKW_VV_VV_UW 100.0 FORMULA_0010 0.0 65535.0000 /end CHARACTERISTIC
/begin CHARACTERISTIC K_ED_INDEX_221_INJ.P_CODE_SH_TO_UB "P-Code fuer die Art SH_TO_UB | EN: P-Code fuer die Art SH_TO_UB" VALUE 0x71C5C TKW_VV_VV_UW 100.0 FORMULA_0010 0.0 65535.0000 /end CHARACTERISTIC
/begin CHARACTERISTIC K_ED_INDEX_222_INJ.P_CODE_SH_TO_UB "P-Code fuer die Art SH_TO_UB | EN: P-Code fuer die Art SH_TO_UB" VALUE 0x71C76 TKW_VV_VV_UW 100.0 FORMULA_0010 0.0 65535.0000 /end CHARACTERISTIC
/begin CHARACTERISTIC K_ED_INDEX_223_INJ.P_CODE_SH_TO_UB "P-Code fuer die Art SH_TO_UB | EN: P-Code fuer die Art SH_TO_UB" VALUE 0x71C90 TKW_VV_VV_UW 100.0 FORMULA_0010 0.0 65535.0000 /end CHARACTERISTIC
/begin CHARACTERISTIC K_ED_HFM1.P_CODE_SH_TO_GND "P-Code fuer die Art SH_TO_GND | EN: Fault code HFM1 - OBD P-code reported for short to ground" VALUE 0x70620 TKW_VV_VV_UW 100.0 FORMULA_0010 0.0 65535.0000 /end CHARACTERISTIC
/begin CHARACTERISTIC K_ED_HFM2.P_CODE_SH_TO_GND "P-Code fuer die Art SH_TO_GND | EN: Fault code HFM2 - OBD P-code reported for short to ground" VALUE 0x7063A TKW_VV_VV_UW 100.0 FORMULA_0010 0.0 65535.0000 /end CHARACTERISTIC
/begin CHARACTERISTIC K_ED_LAVK1.P_CODE_SH_TO_GND "P-Code fuer die Art SH_TO_GND | EN: Fault code LAVK1 - OBD P-code reported for short to ground" VALUE 0x707F4 TKW_VV_VV_UW 100.0 FORMULA_0010 0.0 65535.0000 /end CHARACTERISTIC
/begin CHARACTERISTIC K_ED_LANK1.P_CODE_SH_TO_GND "P-Code fuer die Art SH_TO_GND | EN: Fault code LANK1 - OBD P-code reported for short to ground" VALUE 0x70890 TKW_VV_VV_UW 100.0 FORMULA_0010 0.0 65535.0000 /end CHARACTERISTIC
/begin CHARACTERISTIC K_ED_LANK2.P_CODE_SH_TO_GND "P-Code fuer die Art SH_TO_GND | EN: Fault code LANK2 - OBD P-code reported for short to ground" VALUE 0x708AA TKW_VV_VV_UW 100.0 FORMULA_0010 0.0 65535.0000 /end CHARACTERISTIC
/begin CHARACTERISTIC K_ED_FPLAU1.P_CODE_SH_TO_GND "P-Code fuer die Art SH_TO_GND | EN: Fault code FPLAU1 - OBD P-code reported for short to ground" VALUE 0x709E2 TKW_VV_VV_UW 100.0 FORMULA_0010 0.0 65535.0000 /end CHARACTERISTIC
/begin CHARACTERISTIC K_ED_FPLAU2.P_CODE_SH_TO_GND "P-Code fuer die Art SH_TO_GND | EN: Fault code FPLAU2 - OBD P-code reported for short to ground" VALUE 0x709FC TKW_VV_VV_UW 100.0 FORMULA_0010 0.0 65535.0000 /end CHARACTERISTIC
/begin CHARACTERISTIC K_ED_LANK1_OBD_S.P_CODE_SH_TO_GND "P-Code fuer die Art SH_TO_GND | EN: Fault code LANK1_OBD_S - OBD P-code reported for short to ground" VALUE 0x70A30 TKW_VV_VV_UW 100.0 FORMULA_0010 0.0 65535.0000 /end CHARACTERISTIC
/begin CHARACTERISTIC K_ED_LANK2_OBD_S.P_CODE_SH_TO_GND "P-Code fuer die Art SH_TO_GND | EN: Fault code LANK2_OBD_S - OBD P-code reported for short to ground" VALUE 0x70A4A TKW_VV_VV_UW 100.0 FORMULA_0010 0.0 65535.0000 /end CHARACTERISTIC
/begin CHARACTERISTIC K_ED_LAVK1_DIAG.P_CODE_SH_TO_GND "P-Code fuer die Art SH_TO_GND | EN: Fault code LAVK1_DIAG - OBD P-code reported for short to ground" VALUE 0x70B9C TKW_VV_VV_UW 100.0 FORMULA_0010 0.0 65535.0000 /end CHARACTERISTIC
/begin CHARACTERISTIC K_ED_LAM1_REG.P_CODE_SH_TO_GND "P-Code fuer die Art SH_TO_GND | EN: Fault code LAM1_REG - OBD P-code reported for short to ground" VALUE 0x70DBE TKW_VV_VV_UW 100.0 FORMULA_0010 0.0 65535.0000 /end CHARACTERISTIC
/begin CHARACTERISTIC K_ED_LAM2_REG.P_CODE_SH_TO_GND "P-Code fuer die Art SH_TO_GND | EN: Fault code LAM2_REG - OBD P-code reported for short to ground" VALUE 0x70DD8 TKW_VV_VV_UW 100.0 FORMULA_0010 0.0 65535.0000 /end CHARACTERISTIC
/begin CHARACTERISTIC K_ED_KAT_OBD1.P_CODE_SH_TO_GND "P-Code fuer die Art SH_TO_GND | EN: Fault code KAT_OBD1 - OBD P-code reported for short to ground" VALUE 0x71236 TKW_VV_VV_UW 100.0 FORMULA_0010 0.0 65535.0000 /end CHARACTERISTIC
/begin CHARACTERISTIC K_ED_KAT_OBD2.P_CODE_SH_TO_GND "P-Code fuer die Art SH_TO_GND | EN: Fault code KAT_OBD2 - OBD P-code reported for short to ground" VALUE 0x71250 TKW_VV_VV_UW 100.0 FORMULA_0010 0.0 65535.0000 /end CHARACTERISTIC
/begin CHARACTERISTIC K_ED_FI_QLT.P_CODE_SH_TO_GND "P-Code fuer die Art SH_TO_GND | EN: Fault code FI_QLT - OBD P-code reported for short to ground" VALUE 0x712B8 TKW_VV_VV_UW 100.0 FORMULA_0010 0.0 65535.0000 /end CHARACTERISTIC
/begin CHARACTERISTIC K_ED_FI_PMBN.P_CODE_SH_TO_GND "P-Code fuer die Art SH_TO_GND | EN: Fault code FI_PMBN - OBD P-code reported for short to ground" VALUE 0x71320 TKW_VV_VV_UW 100.0 FORMULA_0010 0.0 65535.0000 /end CHARACTERISTIC
/begin CHARACTERISTIC K_ED_FI_PMBATT.P_CODE_SH_TO_GND "P-Code fuer die Art SH_TO_GND | EN: Fault code FI_PMBATT - OBD P-code reported for short to ground" VALUE 0x7133A TKW_VV_VV_UW 100.0 FORMULA_0010 0.0 65535.0000 /end CHARACTERISTIC
/begin CHARACTERISTIC K_ED_FI_PMRUHVERL.P_CODE_SH_TO_GND "P-Code fuer die Art SH_TO_GND | EN: Fault code FI_PMRUHVERL - OBD P-code reported for short to ground" VALUE 0x7143E TKW_VV_VV_UW 100.0 FORMULA_0010 0.0 65535.0000 /end CHARACTERISTIC
/begin CHARACTERISTIC K_ED_FI_TOENS.P_CODE_SH_TO_GND "P-Code fuer die Art SH_TO_GND | EN: Fault code FI_TOENS - OBD P-code reported for short to ground" VALUE 0x71458 TKW_VV_VV_UW 100.0 FORMULA_0010 0.0 65535.0000 /end CHARACTERISTIC
/begin CHARACTERISTIC K_ED_KW.P_CODE_SH_TO_GND "P-Code fuer die Art SH_TO_GND | EN: Fault code KW - OBD P-code reported for short to ground" VALUE 0x71576 TKW_VV_VV_UW 100.0 FORMULA_0010 0.0 65535.0000 /end CHARACTERISTIC
/begin CHARACTERISTIC K_ED_LA1_ADAPT.P_CODE_SH_TO_GND "P-Code fuer die Art SH_TO_GND | EN: Fault code LA1_ADAPT - OBD P-code reported for short to ground" VALUE 0x71590 TKW_VV_VV_UW 100.0 FORMULA_0010 0.0 65535.0000 /end CHARACTERISTIC
/begin CHARACTERISTIC K_ED_LA2_ADAPT.P_CODE_SH_TO_GND "P-Code fuer die Art SH_TO_GND | EN: Fault code LA2_ADAPT - OBD P-code reported for short to ground" VALUE 0x715AA TKW_VV_VV_UW 100.0 FORMULA_0010 0.0 65535.0000 /end CHARACTERISTIC
/begin CHARACTERISTIC K_ED_KGE1.P_CODE_SH_TO_GND "P-Code fuer die Art SH_TO_GND | EN: Fault code KGE1 - OBD P-code reported for short to ground" VALUE 0x715C4 TKW_VV_VV_UW 100.0 FORMULA_0010 0.0 65535.0000 /end CHARACTERISTIC
/begin CHARACTERISTIC K_ED_KGE2.P_CODE_SH_TO_GND "P-Code fuer die Art SH_TO_GND | EN: Fault code KGE2 - OBD P-code reported for short to ground" VALUE 0x715DE TKW_VV_VV_UW 100.0 FORMULA_0010 0.0 65535.0000 /end CHARACTERISTIC
/begin CHARACTERISTIC K_ED_FST.P_CODE_SH_TO_GND "P-Code fuer die Art SH_TO_GND | EN: Fault code FST - OBD P-code reported for short to ground" VALUE 0x715F8 TKW_VV_VV_UW 100.0 FORMULA_0010 0.0 65535.0000 /end CHARACTERISTIC
/begin CHARACTERISTIC K_ED_KSD1.P_CODE_SH_TO_GND "P-Code fuer die Art SH_TO_GND | EN: Fault code KSD1 - OBD P-code reported for short to ground" VALUE 0x71730 TKW_VV_VV_UW 100.0 FORMULA_0010 0.0 65535.0000 /end CHARACTERISTIC
/begin CHARACTERISTIC K_ED_KSD2.P_CODE_SH_TO_GND "P-Code fuer die Art SH_TO_GND | EN: Fault code KSD2 - OBD P-code reported for short to ground" VALUE 0x7174A TKW_VV_VV_UW 100.0 FORMULA_0010 0.0 65535.0000 /end CHARACTERISTIC
/begin CHARACTERISTIC K_ED_KATS_B1.P_CODE_SH_TO_GND "P-Code fuer die Art SH_TO_GND | EN: Fault code KATS_B1 - OBD P-code reported for short to ground" VALUE 0x71764 TKW_VV_VV_UW 100.0 FORMULA_0010 0.0 65535.0000 /end CHARACTERISTIC
/begin CHARACTERISTIC K_ED_KATS_B2.P_CODE_SH_TO_GND "P-Code fuer die Art SH_TO_GND | EN: Fault code KATS_B2 - OBD P-code reported for short to ground" VALUE 0x7177E TKW_VV_VV_UW 100.0 FORMULA_0010 0.0 65535.0000 /end CHARACTERISTIC
/begin CHARACTERISTIC K_ED_FST_GEBER.P_CODE_SH_TO_GND "P-Code fuer die Art SH_TO_GND | EN: Fault code FST_GEBER - OBD P-code reported for short to ground" VALUE 0x717CC TKW_VV_VV_UW 100.0 FORMULA_0010 0.0 65535.0000 /end CHARACTERISTIC
/begin CHARACTERISTIC K_ED_LA1_TRIM_AD.P_CODE_SH_TO_GND "P-Code fuer die Art SH_TO_GND | EN: Fault code LA1_TRIM_AD - OBD P-code reported for short to ground" VALUE 0x71868 TKW_VV_VV_UW 100.0 FORMULA_0010 0.0 65535.0000 /end CHARACTERISTIC
/begin CHARACTERISTIC K_ED_LA2_TRIM_AD.P_CODE_SH_TO_GND "P-Code fuer die Art SH_TO_GND | EN: Fault code LA2_TRIM_AD - OBD P-code reported for short to ground" VALUE 0x71882 TKW_VV_VV_UW 100.0 FORMULA_0010 0.0 65535.0000 /end CHARACTERISTIC
/begin CHARACTERISTIC K_ED_LANK1_OPENLOAD.P_CODE_SH_TO_GND "P-Code fuer die Art SH_TO_GND | EN: Fault code LANK1_OPENLOAD - OBD P-code reported for short to ground" VALUE 0x7189C TKW_VV_VV_UW 100.0 FORMULA_0010 0.0 65535.0000 /end CHARACTERISTIC
/begin CHARACTERISTIC K_ED_LANK2_OPENLOAD.P_CODE_SH_TO_GND "P-Code fuer die Art SH_TO_GND | EN: Fault code LANK2_OPENLOAD - OBD P-code reported for short to ground" VALUE 0x718B6 TKW_VV_VV_UW 100.0 FORMULA_0010 0.0 65535.0000 /end CHARACTERISTIC
/begin CHARACTERISTIC K_ED_LANK1_OBD_WE.P_CODE_SH_TO_GND "P-Code fuer die Art SH_TO_GND | EN: Fault code LANK1_OBD_WE - OBD P-code reported for short to ground" VALUE 0x718D0 TKW_VV_VV_UW 100.0 FORMULA_0010 0.0 65535.0000 /end CHARACTERISTIC
/begin CHARACTERISTIC K_ED_LANK2_OBD_WE.P_CODE_SH_TO_GND "P-Code fuer die Art SH_TO_GND | EN: Fault code LANK2_OBD_WE - OBD P-code reported for short to ground" VALUE 0x718EA TKW_VV_VV_UW 100.0 FORMULA_0010 0.0 65535.0000 /end CHARACTERISTIC
/begin CHARACTERISTIC K_ED_FST_GEBER_LI.P_CODE_SH_TO_GND "P-Code fuer die Art SH_TO_GND" VALUE 0x719EE TKW_VV_VV_UW 100.0 FORMULA_0010 0.0 65535.0000 /end CHARACTERISTIC
/begin CHARACTERISTIC K_ED_FST_GEBER_RE.P_CODE_SH_TO_GND "P-Code fuer die Art SH_TO_GND" VALUE 0x71A08 TKW_VV_VV_UW 100.0 FORMULA_0010 0.0 65535.0000 /end CHARACTERISTIC
/begin CHARACTERISTIC K_ED_LANK1_OBD_SLOPE.P_CODE_SH_TO_GND "P-Code fuer die Art SH_TO_GND" VALUE 0x71A22 TKW_VV_VV_UW 100.0 FORMULA_0010 0.0 65535.0000 /end CHARACTERISTIC
/begin CHARACTERISTIC K_ED_LANK2_OBD_SLOPE.P_CODE_SH_TO_GND "P-Code fuer die Art SH_TO_GND" VALUE 0x71A3C TKW_VV_VV_UW 100.0 FORMULA_0010 0.0 65535.0000 /end CHARACTERISTIC
/begin CHARACTERISTIC K_ED_INDEX_204_INJ.P_CODE_SH_TO_GND "P-Code fuer die Art SH_TO_GND | EN: Fault code INDEX_204_INJ - OBD P-code reported for short to ground" VALUE 0x71AA4 TKW_VV_VV_UW 100.0 FORMULA_0010 0.0 65535.0000 /end CHARACTERISTIC
/begin CHARACTERISTIC K_ED_INDEX_205_INJ.P_CODE_SH_TO_GND "P-Code fuer die Art SH_TO_GND | EN: Fault code INDEX_205_INJ - OBD P-code reported for short to ground" VALUE 0x71ABE TKW_VV_VV_UW 100.0 FORMULA_0010 0.0 65535.0000 /end CHARACTERISTIC
/begin CHARACTERISTIC K_ED_INDEX_206_INJ.P_CODE_SH_TO_GND "P-Code fuer die Art SH_TO_GND | EN: Fault code INDEX_206_INJ - OBD P-code reported for short to ground" VALUE 0x71AD8 TKW_VV_VV_UW 100.0 FORMULA_0010 0.0 65535.0000 /end CHARACTERISTIC
/begin CHARACTERISTIC K_ED_INDEX_207_INJ.P_CODE_SH_TO_GND "P-Code fuer die Art SH_TO_GND | EN: P-Code fuer die Art SH_TO_GND" VALUE 0x71AF2 TKW_VV_VV_UW 100.0 FORMULA_0010 0.0 65535.0000 /end CHARACTERISTIC
/begin CHARACTERISTIC K_ED_INDEX_208_INJ.P_CODE_SH_TO_GND "P-Code fuer die Art SH_TO_GND | EN: P-Code fuer die Art SH_TO_GND" VALUE 0x71B0C TKW_VV_VV_UW 100.0 FORMULA_0010 0.0 65535.0000 /end CHARACTERISTIC
/begin CHARACTERISTIC K_ED_INDEX_209_INJ.P_CODE_SH_TO_GND "P-Code fuer die Art SH_TO_GND" VALUE 0x71B26 TKW_VV_VV_UW 100.0 FORMULA_0010 0.0 65535.0000 /end CHARACTERISTIC
/begin CHARACTERISTIC K_ED_INDEX_210_INJ.P_CODE_SH_TO_GND "P-Code fuer die Art SH_TO_GND" VALUE 0x71B40 TKW_VV_VV_UW 100.0 FORMULA_0010 0.0 65535.0000 /end CHARACTERISTIC
/begin CHARACTERISTIC K_ED_INDEX_211_INJ.P_CODE_SH_TO_GND "P-Code fuer die Art SH_TO_GND | EN: P-Code fuer die Art SH_TO_GND" VALUE 0x71B5A TKW_VV_VV_UW 100.0 FORMULA_0010 0.0 65535.0000 /end CHARACTERISTIC
/begin CHARACTERISTIC K_ED_INDEX_212_INJ.P_CODE_SH_TO_GND "P-Code fuer die Art SH_TO_GND | EN: P-Code fuer die Art SH_TO_GND" VALUE 0x71B74 TKW_VV_VV_UW 100.0 FORMULA_0010 0.0 65535.0000 /end CHARACTERISTIC
/begin CHARACTERISTIC K_ED_INDEX_213_INJ.P_CODE_SH_TO_GND "P-Code fuer die Art SH_TO_GND" VALUE 0x71B8E TKW_VV_VV_UW 100.0 FORMULA_0010 0.0 65535.0000 /end CHARACTERISTIC
/begin CHARACTERISTIC K_ED_INDEX_214_INJ.P_CODE_SH_TO_GND "P-Code fuer die Art SH_TO_GND" VALUE 0x71BA8 TKW_VV_VV_UW 100.0 FORMULA_0010 0.0 65535.0000 /end CHARACTERISTIC
/begin CHARACTERISTIC K_ED_INDEX_215_INJ.P_CODE_SH_TO_GND "P-Code fuer die Art SH_TO_GND | EN: P-Code fuer die Art SH_TO_GND" VALUE 0x71BC2 TKW_VV_VV_UW 100.0 FORMULA_0010 0.0 65535.0000 /end CHARACTERISTIC
/begin CHARACTERISTIC K_ED_INDEX_216_INJ.P_CODE_SH_TO_GND "P-Code fuer die Art SH_TO_GND | EN: P-Code fuer die Art SH_TO_GND" VALUE 0x71BDC TKW_VV_VV_UW 100.0 FORMULA_0010 0.0 65535.0000 /end CHARACTERISTIC
/begin CHARACTERISTIC K_ED_INDEX_217_INJ.P_CODE_SH_TO_GND "P-Code fuer die Art SH_TO_GND | EN: P-Code fuer die Art SH_TO_GND" VALUE 0x71BF6 TKW_VV_VV_UW 100.0 FORMULA_0010 0.0 65535.0000 /end CHARACTERISTIC
/begin CHARACTERISTIC K_ED_INDEX_218_INJ.P_CODE_SH_TO_GND "P-Code fuer die Art SH_TO_GND | EN: P-Code fuer die Art SH_TO_GND" VALUE 0x71C10 TKW_VV_VV_UW 100.0 FORMULA_0010 0.0 65535.0000 /end CHARACTERISTIC
/begin CHARACTERISTIC K_ED_INDEX_219_INJ.P_CODE_SH_TO_GND "P-Code fuer die Art SH_TO_GND | EN: P-Code fuer die Art SH_TO_GND" VALUE 0x71C2A TKW_VV_VV_UW 100.0 FORMULA_0010 0.0 65535.0000 /end CHARACTERISTIC
/begin CHARACTERISTIC K_ED_INDEX_220_INJ.P_CODE_SH_TO_GND "P-Code fuer die Art SH_TO_GND | EN: P-Code fuer die Art SH_TO_GND" VALUE 0x71C44 TKW_VV_VV_UW 100.0 FORMULA_0010 0.0 65535.0000 /end CHARACTERISTIC
/begin CHARACTERISTIC K_ED_INDEX_221_INJ.P_CODE_SH_TO_GND "P-Code fuer die Art SH_TO_GND | EN: P-Code fuer die Art SH_TO_GND" VALUE 0x71C5E TKW_VV_VV_UW 100.0 FORMULA_0010 0.0 65535.0000 /end CHARACTERISTIC
/begin CHARACTERISTIC K_ED_INDEX_222_INJ.P_CODE_SH_TO_GND "P-Code fuer die Art SH_TO_GND | EN: P-Code fuer die Art SH_TO_GND" VALUE 0x71C78 TKW_VV_VV_UW 100.0 FORMULA_0010 0.0 65535.0000 /end CHARACTERISTIC
/begin CHARACTERISTIC K_ED_INDEX_223_INJ.P_CODE_SH_TO_GND "P-Code fuer die Art SH_TO_GND | EN: P-Code fuer die Art SH_TO_GND" VALUE 0x71C92 TKW_VV_VV_UW 100.0 FORMULA_0010 0.0 65535.0000 /end CHARACTERISTIC
/begin CHARACTERISTIC K_ED_LAVK1.P_CODE_OPENLOAD "P-Code fuer die Art OPENLOAD | EN: Fault code LAVK1 - OBD P-code reported for open circuit" VALUE 0x707F6 TKW_VV_VV_UW 100.0 FORMULA_0010 0.0 65535.0000 /end CHARACTERISTIC
/begin CHARACTERISTIC K_ED_LANK1.P_CODE_OPENLOAD "P-Code fuer die Art OPENLOAD | EN: Fault code LANK1 - OBD P-code reported for open circuit" VALUE 0x70892 TKW_VV_VV_UW 100.0 FORMULA_0010 0.0 65535.0000 /end CHARACTERISTIC
/begin CHARACTERISTIC K_ED_LANK2.P_CODE_OPENLOAD "P-Code fuer die Art OPENLOAD | EN: Fault code LANK2 - OBD P-code reported for open circuit" VALUE 0x708AC TKW_VV_VV_UW 100.0 FORMULA_0010 0.0 65535.0000 /end CHARACTERISTIC
/begin CHARACTERISTIC K_ED_FPLAU1.P_CODE_OPENLOAD "P-Code fuer die Art OPENLOAD | EN: Fault code FPLAU1 - OBD P-code reported for open circuit" VALUE 0x709E4 TKW_VV_VV_UW 100.0 FORMULA_0010 0.0 65535.0000 /end CHARACTERISTIC
/begin CHARACTERISTIC K_ED_FPLAU2.P_CODE_OPENLOAD "P-Code fuer die Art OPENLOAD | EN: Fault code FPLAU2 - OBD P-code reported for open circuit" VALUE 0x709FE TKW_VV_VV_UW 100.0 FORMULA_0010 0.0 65535.0000 /end CHARACTERISTIC
/begin CHARACTERISTIC K_ED_LANK1_OBD_S.P_CODE_OPENLOAD "P-Code fuer die Art OPENLOAD | EN: Fault code LANK1_OBD_S - OBD P-code reported for open circuit" VALUE 0x70A32 TKW_VV_VV_UW 100.0 FORMULA_0010 0.0 65535.0000 /end CHARACTERISTIC
/begin CHARACTERISTIC K_ED_LANK2_OBD_S.P_CODE_OPENLOAD "P-Code fuer die Art OPENLOAD | EN: Fault code LANK2_OBD_S - OBD P-code reported for open circuit" VALUE 0x70A4C TKW_VV_VV_UW 100.0 FORMULA_0010 0.0 65535.0000 /end CHARACTERISTIC
/begin CHARACTERISTIC K_ED_LAVK1_DIAG.P_CODE_OPENLOAD "P-Code fuer die Art OPENLOAD | EN: Fault code LAVK1_DIAG - OBD P-code reported for open circuit" VALUE 0x70B9E TKW_VV_VV_UW 100.0 FORMULA_0010 0.0 65535.0000 /end CHARACTERISTIC
/begin CHARACTERISTIC K_ED_LAM1_REG.P_CODE_OPENLOAD "P-Code fuer die Art OPENLOAD | EN: Fault code LAM1_REG - OBD P-code reported for open circuit" VALUE 0x70DC0 TKW_VV_VV_UW 100.0 FORMULA_0010 0.0 65535.0000 /end CHARACTERISTIC
/begin CHARACTERISTIC K_ED_LAM2_REG.P_CODE_OPENLOAD "P-Code fuer die Art OPENLOAD | EN: Fault code LAM2_REG - OBD P-code reported for open circuit" VALUE 0x70DDA TKW_VV_VV_UW 100.0 FORMULA_0010 0.0 65535.0000 /end CHARACTERISTIC
/begin CHARACTERISTIC K_ED_KAT_OBD1.P_CODE_OPENLOAD "P-Code fuer die Art OPENLOAD | EN: Fault code KAT_OBD1 - OBD P-code reported for open circuit" VALUE 0x71238 TKW_VV_VV_UW 100.0 FORMULA_0010 0.0 65535.0000 /end CHARACTERISTIC
/begin CHARACTERISTIC K_ED_KAT_OBD2.P_CODE_OPENLOAD "P-Code fuer die Art OPENLOAD | EN: Fault code KAT_OBD2 - OBD P-code reported for open circuit" VALUE 0x71252 TKW_VV_VV_UW 100.0 FORMULA_0010 0.0 65535.0000 /end CHARACTERISTIC
/begin CHARACTERISTIC K_ED_FI_GEN.P_CODE_OPENLOAD "P-Code fuer die Art OPENLOAD | EN: Fault code FI_GEN - OBD P-code reported for open circuit" VALUE 0x71286 TKW_VV_VV_UW 100.0 FORMULA_0010 0.0 65535.0000 /end CHARACTERISTIC
/begin CHARACTERISTIC K_ED_FI_QLT.P_CODE_OPENLOAD "P-Code fuer die Art OPENLOAD | EN: Fault code FI_QLT - OBD P-code reported for open circuit" VALUE 0x712BA TKW_VV_VV_UW 100.0 FORMULA_0010 0.0 65535.0000 /end CHARACTERISTIC
/begin CHARACTERISTIC K_ED_FI_IBS1.P_CODE_OPENLOAD "P-Code fuer die Art OPENLOAD | EN: Fault code FI_IBS1 - OBD P-code reported for open circuit" VALUE 0x712D4 TKW_VV_VV_UW 100.0 FORMULA_0010 0.0 65535.0000 /end CHARACTERISTIC
/begin CHARACTERISTIC K_ED_FI_IBS2.P_CODE_OPENLOAD "P-Code fuer die Art OPENLOAD | EN: Fault code FI_IBS2 - OBD P-code reported for open circuit" VALUE 0x712EE TKW_VV_VV_UW 100.0 FORMULA_0010 0.0 65535.0000 /end CHARACTERISTIC
/begin CHARACTERISTIC K_ED_FI_IBS3.P_CODE_OPENLOAD "P-Code fuer die Art OPENLOAD | EN: Fault code FI_IBS3 - OBD P-code reported for open circuit" VALUE 0x71308 TKW_VV_VV_UW 100.0 FORMULA_0010 0.0 65535.0000 /end CHARACTERISTIC
/begin CHARACTERISTIC K_ED_FI_PMBN.P_CODE_OPENLOAD "P-Code fuer die Art OPENLOAD | EN: Fault code FI_PMBN - OBD P-code reported for open circuit" VALUE 0x71322 TKW_VV_VV_UW 100.0 FORMULA_0010 0.0 65535.0000 /end CHARACTERISTIC
/begin CHARACTERISTIC K_ED_FI_PMRUHVERL.P_CODE_OPENLOAD "P-Code fuer die Art OPENLOAD | EN: Fault code FI_PMRUHVERL - OBD P-code reported for open circuit" VALUE 0x71440 TKW_VV_VV_UW 100.0 FORMULA_0010 0.0 65535.0000 /end CHARACTERISTIC
/begin CHARACTERISTIC K_ED_FI_TOENS.P_CODE_OPENLOAD "P-Code fuer die Art OPENLOAD | EN: Fault code FI_TOENS - OBD P-code reported for open circuit" VALUE 0x7145A TKW_VV_VV_UW 100.0 FORMULA_0010 0.0 65535.0000 /end CHARACTERISTIC
/begin CHARACTERISTIC K_ED_KW.P_CODE_OPENLOAD "P-Code fuer die Art OPENLOAD | EN: Fault code KW - OBD P-code reported for open circuit" VALUE 0x71578 TKW_VV_VV_UW 100.0 FORMULA_0010 0.0 65535.0000 /end CHARACTERISTIC
/begin CHARACTERISTIC K_ED_LA1_ADAPT.P_CODE_OPENLOAD "P-Code fuer die Art OPENLOAD | EN: Fault code LA1_ADAPT - OBD P-code reported for open circuit" VALUE 0x71592 TKW_VV_VV_UW 100.0 FORMULA_0010 0.0 65535.0000 /end CHARACTERISTIC
/begin CHARACTERISTIC K_ED_LA2_ADAPT.P_CODE_OPENLOAD "P-Code fuer die Art OPENLOAD | EN: Fault code LA2_ADAPT - OBD P-code reported for open circuit" VALUE 0x715AC TKW_VV_VV_UW 100.0 FORMULA_0010 0.0 65535.0000 /end CHARACTERISTIC
/begin CHARACTERISTIC K_ED_KGE1.P_CODE_OPENLOAD "P-Code fuer die Art OPENLOAD | EN: Fault code KGE1 - OBD P-code reported for open circuit" VALUE 0x715C6 TKW_VV_VV_UW 100.0 FORMULA_0010 0.0 65535.0000 /end CHARACTERISTIC
/begin CHARACTERISTIC K_ED_KGE2.P_CODE_OPENLOAD "P-Code fuer die Art OPENLOAD | EN: Fault code KGE2 - OBD P-code reported for open circuit" VALUE 0x715E0 TKW_VV_VV_UW 100.0 FORMULA_0010 0.0 65535.0000 /end CHARACTERISTIC
/begin CHARACTERISTIC K_ED_FST.P_CODE_OPENLOAD "P-Code fuer die Art OPENLOAD | EN: Fault code FST - OBD P-code reported for open circuit" VALUE 0x715FA TKW_VV_VV_UW 100.0 FORMULA_0010 0.0 65535.0000 /end CHARACTERISTIC
/begin CHARACTERISTIC K_ED_KSD1.P_CODE_OPENLOAD "P-Code fuer die Art OPENLOAD | EN: Fault code KSD1 - OBD P-code reported for open circuit" VALUE 0x71732 TKW_VV_VV_UW 100.0 FORMULA_0010 0.0 65535.0000 /end CHARACTERISTIC
/begin CHARACTERISTIC K_ED_KSD2.P_CODE_OPENLOAD "P-Code fuer die Art OPENLOAD | EN: Fault code KSD2 - OBD P-code reported for open circuit" VALUE 0x7174C TKW_VV_VV_UW 100.0 FORMULA_0010 0.0 65535.0000 /end CHARACTERISTIC
/begin CHARACTERISTIC K_ED_KATS_B1.P_CODE_OPENLOAD "P-Code fuer die Art OPENLOAD | EN: Fault code KATS_B1 - OBD P-code reported for open circuit" VALUE 0x71766 TKW_VV_VV_UW 100.0 FORMULA_0010 0.0 65535.0000 /end CHARACTERISTIC
/begin CHARACTERISTIC K_ED_KATS_B2.P_CODE_OPENLOAD "P-Code fuer die Art OPENLOAD | EN: Fault code KATS_B2 - OBD P-code reported for open circuit" VALUE 0x71780 TKW_VV_VV_UW 100.0 FORMULA_0010 0.0 65535.0000 /end CHARACTERISTIC
/begin CHARACTERISTIC K_ED_FST_GEBER.P_CODE_OPENLOAD "P-Code fuer die Art OPENLOAD | EN: Fault code FST_GEBER - OBD P-code reported for open circuit" VALUE 0x717CE TKW_VV_VV_UW 100.0 FORMULA_0010 0.0 65535.0000 /end CHARACTERISTIC
/begin CHARACTERISTIC K_ED_LA1_TRIM_AD.P_CODE_OPENLOAD "P-Code fuer die Art OPENLOAD | EN: Fault code LA1_TRIM_AD - OBD P-code reported for open circuit" VALUE 0x7186A TKW_VV_VV_UW 100.0 FORMULA_0010 0.0 65535.0000 /end CHARACTERISTIC
/begin CHARACTERISTIC K_ED_LA2_TRIM_AD.P_CODE_OPENLOAD "P-Code fuer die Art OPENLOAD | EN: Fault code LA2_TRIM_AD - OBD P-code reported for open circuit" VALUE 0x71884 TKW_VV_VV_UW 100.0 FORMULA_0010 0.0 65535.0000 /end CHARACTERISTIC
/begin CHARACTERISTIC K_ED_LANK1_OPENLOAD.P_CODE_OPENLOAD "P-Code fuer die Art OPENLOAD | EN: Fault code LANK1_OPENLOAD - OBD P-code reported for open circuit" VALUE 0x7189E TKW_VV_VV_UW 100.0 FORMULA_0010 0.0 65535.0000 /end CHARACTERISTIC
/begin CHARACTERISTIC K_ED_LANK2_OPENLOAD.P_CODE_OPENLOAD "P-Code fuer die Art OPENLOAD | EN: Fault code LANK2_OPENLOAD - OBD P-code reported for open circuit" VALUE 0x718B8 TKW_VV_VV_UW 100.0 FORMULA_0010 0.0 65535.0000 /end CHARACTERISTIC
/begin CHARACTERISTIC K_ED_LANK1_OBD_WE.P_CODE_OPENLOAD "P-Code fuer die Art OPENLOAD | EN: Fault code LANK1_OBD_WE - OBD P-code reported for open circuit" VALUE 0x718D2 TKW_VV_VV_UW 100.0 FORMULA_0010 0.0 65535.0000 /end CHARACTERISTIC
/begin CHARACTERISTIC K_ED_LANK2_OBD_WE.P_CODE_OPENLOAD "P-Code fuer die Art OPENLOAD | EN: Fault code LANK2_OBD_WE - OBD P-code reported for open circuit" VALUE 0x718EC TKW_VV_VV_UW 100.0 FORMULA_0010 0.0 65535.0000 /end CHARACTERISTIC
/begin CHARACTERISTIC K_ED_FST_GEBER_LI.P_CODE_OPENLOAD "P-Code fuer die Art OPENLOAD" VALUE 0x719F0 TKW_VV_VV_UW 100.0 FORMULA_0010 0.0 65535.0000 /end CHARACTERISTIC
/begin CHARACTERISTIC K_ED_FST_GEBER_RE.P_CODE_OPENLOAD "P-Code fuer die Art OPENLOAD" VALUE 0x71A0A TKW_VV_VV_UW 100.0 FORMULA_0010 0.0 65535.0000 /end CHARACTERISTIC
/begin CHARACTERISTIC K_ED_LANK1_OBD_SLOPE.P_CODE_OPENLOAD "P-Code fuer die Art OPENLOAD" VALUE 0x71A24 TKW_VV_VV_UW 100.0 FORMULA_0010 0.0 65535.0000 /end CHARACTERISTIC
/begin CHARACTERISTIC K_ED_LANK2_OBD_SLOPE.P_CODE_OPENLOAD "P-Code fuer die Art OPENLOAD" VALUE 0x71A3E TKW_VV_VV_UW 100.0 FORMULA_0010 0.0 65535.0000 /end CHARACTERISTIC
/begin CHARACTERISTIC K_ED_INDEX_204_INJ.P_CODE_OPENLOAD "P-Code fuer die Art OPENLOAD | EN: Fault code INDEX_204_INJ - OBD P-code reported for open circuit" VALUE 0x71AA6 TKW_VV_VV_UW 100.0 FORMULA_0010 0.0 65535.0000 /end CHARACTERISTIC
/begin CHARACTERISTIC K_ED_INDEX_205_INJ.P_CODE_OPENLOAD "P-Code fuer die Art OPENLOAD | EN: Fault code INDEX_205_INJ - OBD P-code reported for open circuit" VALUE 0x71AC0 TKW_VV_VV_UW 100.0 FORMULA_0010 0.0 65535.0000 /end CHARACTERISTIC
/begin CHARACTERISTIC K_ED_INDEX_206_INJ.P_CODE_OPENLOAD "P-Code fuer die Art OPENLOAD | EN: Fault code INDEX_206_INJ - OBD P-code reported for open circuit" VALUE 0x71ADA TKW_VV_VV_UW 100.0 FORMULA_0010 0.0 65535.0000 /end CHARACTERISTIC
/begin CHARACTERISTIC K_ED_INDEX_207_INJ.P_CODE_OPENLOAD "P-Code fuer die Art OPENLOAD | EN: P-Code fuer die Art OPENLOAD" VALUE 0x71AF4 TKW_VV_VV_UW 100.0 FORMULA_0010 0.0 65535.0000 /end CHARACTERISTIC
/begin CHARACTERISTIC K_ED_INDEX_208_INJ.P_CODE_OPENLOAD "P-Code fuer die Art OPENLOAD | EN: P-Code fuer die Art OPENLOAD" VALUE 0x71B0E TKW_VV_VV_UW 100.0 FORMULA_0010 0.0 65535.0000 /end CHARACTERISTIC
/begin CHARACTERISTIC K_ED_INDEX_209_INJ.P_CODE_OPENLOAD "P-Code fuer die Art OPENLOAD" VALUE 0x71B28 TKW_VV_VV_UW 100.0 FORMULA_0010 0.0 65535.0000 /end CHARACTERISTIC
/begin CHARACTERISTIC K_ED_INDEX_210_INJ.P_CODE_OPENLOAD "P-Code fuer die Art OPENLOAD" VALUE 0x71B42 TKW_VV_VV_UW 100.0 FORMULA_0010 0.0 65535.0000 /end CHARACTERISTIC
/begin CHARACTERISTIC K_ED_INDEX_211_INJ.P_CODE_OPENLOAD "P-Code fuer die Art OPENLOAD" VALUE 0x71B5C TKW_VV_VV_UW 100.0 FORMULA_0010 0.0 65535.0000 /end CHARACTERISTIC
/begin CHARACTERISTIC K_ED_INDEX_212_INJ.P_CODE_OPENLOAD "P-Code fuer die Art OPENLOAD | EN: P-Code fuer die Art OPENLOAD" VALUE 0x71B76 TKW_VV_VV_UW 100.0 FORMULA_0010 0.0 65535.0000 /end CHARACTERISTIC
/begin CHARACTERISTIC K_ED_INDEX_213_INJ.P_CODE_OPENLOAD "P-Code fuer die Art OPENLOAD" VALUE 0x71B90 TKW_VV_VV_UW 100.0 FORMULA_0010 0.0 65535.0000 /end CHARACTERISTIC
/begin CHARACTERISTIC K_ED_INDEX_214_INJ.P_CODE_OPENLOAD "P-Code fuer die Art OPENLOAD" VALUE 0x71BAA TKW_VV_VV_UW 100.0 FORMULA_0010 0.0 65535.0000 /end CHARACTERISTIC
/begin CHARACTERISTIC K_ED_INDEX_215_INJ.P_CODE_OPENLOAD "P-Code fuer die Art OPENLOAD" VALUE 0x71BC4 TKW_VV_VV_UW 100.0 FORMULA_0010 0.0 65535.0000 /end CHARACTERISTIC
/begin CHARACTERISTIC K_ED_INDEX_216_INJ.P_CODE_OPENLOAD "P-Code fuer die Art OPENLOAD | EN: P-Code fuer die Art OPENLOAD" VALUE 0x71BDE TKW_VV_VV_UW 100.0 FORMULA_0010 0.0 65535.0000 /end CHARACTERISTIC
/begin CHARACTERISTIC K_ED_INDEX_217_INJ.P_CODE_OPENLOAD "P-Code fuer die Art OPENLOAD | EN: P-Code fuer die Art OPENLOAD" VALUE 0x71BF8 TKW_VV_VV_UW 100.0 FORMULA_0010 0.0 65535.0000 /end CHARACTERISTIC
/begin CHARACTERISTIC K_ED_INDEX_218_INJ.P_CODE_OPENLOAD "P-Code fuer die Art OPENLOAD | EN: P-Code fuer die Art OPENLOAD" VALUE 0x71C12 TKW_VV_VV_UW 100.0 FORMULA_0010 0.0 65535.0000 /end CHARACTERISTIC
/begin CHARACTERISTIC K_ED_INDEX_219_INJ.P_CODE_OPENLOAD "P-Code fuer die Art OPENLOAD | EN: P-Code fuer die Art OPENLOAD" VALUE 0x71C2C TKW_VV_VV_UW 100.0 FORMULA_0010 0.0 65535.0000 /end CHARACTERISTIC
/begin CHARACTERISTIC K_ED_INDEX_220_INJ.P_CODE_OPENLOAD "P-Code fuer die Art OPENLOAD | EN: P-Code fuer die Art OPENLOAD" VALUE 0x71C46 TKW_VV_VV_UW 100.0 FORMULA_0010 0.0 65535.0000 /end CHARACTERISTIC
/begin CHARACTERISTIC K_ED_INDEX_221_INJ.P_CODE_OPENLOAD "P-Code fuer die Art OPENLOAD | EN: P-Code fuer die Art OPENLOAD" VALUE 0x71C60 TKW_VV_VV_UW 100.0 FORMULA_0010 0.0 65535.0000 /end CHARACTERISTIC
/begin CHARACTERISTIC K_ED_INDEX_222_INJ.P_CODE_OPENLOAD "P-Code fuer die Art OPENLOAD | EN: P-Code fuer die Art OPENLOAD" VALUE 0x71C7A TKW_VV_VV_UW 100.0 FORMULA_0010 0.0 65535.0000 /end CHARACTERISTIC
/begin CHARACTERISTIC K_ED_INDEX_223_INJ.P_CODE_OPENLOAD "P-Code fuer die Art OPENLOAD | EN: P-Code fuer die Art OPENLOAD" VALUE 0x71C94 TKW_VV_VV_UW 100.0 FORMULA_0010 0.0 65535.0000 /end CHARACTERISTIC
/begin CHARACTERISTIC K_ED_LAVK1.P_CODE_UNPLAUSIBEL "P-Code fuer die Art UNPLAUSIBEL | EN: Fault code LAVK1 - OBD P-code reported for implausible signal" VALUE 0x707F8 TKW_VV_VV_UW 100.0 FORMULA_0010 0.0 65535.0000 /end CHARACTERISTIC
/begin CHARACTERISTIC K_ED_LANK1.P_CODE_UNPLAUSIBEL "P-Code fuer die Art UNPLAUSIBEL | EN: Fault code LANK1 - OBD P-code reported for implausible signal" VALUE 0x70894 TKW_VV_VV_UW 100.0 FORMULA_0010 0.0 65535.0000 /end CHARACTERISTIC
/begin CHARACTERISTIC K_ED_LANK2.P_CODE_UNPLAUSIBEL "P-Code fuer die Art UNPLAUSIBEL | EN: Fault code LANK2 - OBD P-code reported for implausible signal" VALUE 0x708AE TKW_VV_VV_UW 100.0 FORMULA_0010 0.0 65535.0000 /end CHARACTERISTIC
/begin CHARACTERISTIC K_ED_FPLAU1.P_CODE_UNPLAUSIBEL "P-Code fuer die Art UNPLAUSIBEL | EN: Fault code FPLAU1 - OBD P-code reported for implausible signal" VALUE 0x709E6 TKW_VV_VV_UW 100.0 FORMULA_0010 0.0 65535.0000 /end CHARACTERISTIC
/begin CHARACTERISTIC K_ED_FPLAU2.P_CODE_UNPLAUSIBEL "P-Code fuer die Art UNPLAUSIBEL | EN: Fault code FPLAU2 - OBD P-code reported for implausible signal" VALUE 0x70A00 TKW_VV_VV_UW 100.0 FORMULA_0010 0.0 65535.0000 /end CHARACTERISTIC
/begin CHARACTERISTIC K_ED_LANK1_OBD_S.P_CODE_UNPLAUSIBEL "P-Code fuer die Art UNPLAUSIBEL | EN: Fault code LANK1_OBD_S - OBD P-code reported for implausible signal" VALUE 0x70A34 TKW_VV_VV_UW 100.0 FORMULA_0010 0.0 65535.0000 /end CHARACTERISTIC
/begin CHARACTERISTIC K_ED_LANK2_OBD_S.P_CODE_UNPLAUSIBEL "P-Code fuer die Art UNPLAUSIBEL | EN: Fault code LANK2_OBD_S - OBD P-code reported for implausible signal" VALUE 0x70A4E TKW_VV_VV_UW 100.0 FORMULA_0010 0.0 65535.0000 /end CHARACTERISTIC
/begin CHARACTERISTIC K_ED_LAVK1_DIAG.P_CODE_UNPLAUSIBEL "P-Code fuer die Art UNPLAUSIBEL | EN: Fault code LAVK1_DIAG - OBD P-code reported for implausible signal" VALUE 0x70BA0 TKW_VV_VV_UW 100.0 FORMULA_0010 0.0 65535.0000 /end CHARACTERISTIC
/begin CHARACTERISTIC K_ED_LAM1_REG.P_CODE_UNPLAUSIBEL "P-Code fuer die Art UNPLAUSIBEL | EN: Fault code LAM1_REG - OBD P-code reported for implausible signal" VALUE 0x70DC2 TKW_VV_VV_UW 100.0 FORMULA_0010 0.0 65535.0000 /end CHARACTERISTIC
/begin CHARACTERISTIC K_ED_LAM2_REG.P_CODE_UNPLAUSIBEL "P-Code fuer die Art UNPLAUSIBEL | EN: Fault code LAM2_REG - OBD P-code reported for implausible signal" VALUE 0x70DDC TKW_VV_VV_UW 100.0 FORMULA_0010 0.0 65535.0000 /end CHARACTERISTIC
/begin CHARACTERISTIC K_ED_KAT_OBD1.P_CODE_UNPLAUSIBEL "P-Code fuer die Art UNPLAUSIBEL | EN: Fault code KAT_OBD1 - OBD P-code reported for implausible signal" VALUE 0x7123A TKW_VV_VV_UW 100.0 FORMULA_0010 0.0 65535.0000 /end CHARACTERISTIC
/begin CHARACTERISTIC K_ED_KAT_OBD2.P_CODE_UNPLAUSIBEL "P-Code fuer die Art UNPLAUSIBEL | EN: Fault code KAT_OBD2 - OBD P-code reported for implausible signal" VALUE 0x71254 TKW_VV_VV_UW 100.0 FORMULA_0010 0.0 65535.0000 /end CHARACTERISTIC
/begin CHARACTERISTIC K_ED_FI_GEN.P_CODE_UNPLAUSIBEL "P-Code fuer die Art UNPLAUSIBEL | EN: Fault code FI_GEN - OBD P-code reported for implausible signal" VALUE 0x71288 TKW_VV_VV_UW 100.0 FORMULA_0010 0.0 65535.0000 /end CHARACTERISTIC
/begin CHARACTERISTIC K_ED_FI_BSD.P_CODE_UNPLAUSIBEL "P-Code fuer die Art UNPLAUSIBEL | EN: Fault code FI_BSD - OBD P-code reported for implausible signal" VALUE 0x712A2 TKW_VV_VV_UW 100.0 FORMULA_0010 0.0 65535.0000 /end CHARACTERISTIC
/begin CHARACTERISTIC K_ED_FI_QLT.P_CODE_UNPLAUSIBEL "P-Code fuer die Art UNPLAUSIBEL | EN: Fault code FI_QLT - OBD P-code reported for implausible signal" VALUE 0x712BC TKW_VV_VV_UW 100.0 FORMULA_0010 0.0 65535.0000 /end CHARACTERISTIC
/begin CHARACTERISTIC K_ED_FI_IBS1.P_CODE_UNPLAUSIBEL "P-Code fuer die Art UNPLAUSIBEL | EN: Fault code FI_IBS1 - OBD P-code reported for implausible signal" VALUE 0x712D6 TKW_VV_VV_UW 100.0 FORMULA_0010 0.0 65535.0000 /end CHARACTERISTIC
/begin CHARACTERISTIC K_ED_FI_IBS2.P_CODE_UNPLAUSIBEL "P-Code fuer die Art UNPLAUSIBEL | EN: Fault code FI_IBS2 - OBD P-code reported for implausible signal" VALUE 0x712F0 TKW_VV_VV_UW 100.0 FORMULA_0010 0.0 65535.0000 /end CHARACTERISTIC
/begin CHARACTERISTIC K_ED_FI_IBS3.P_CODE_UNPLAUSIBEL "P-Code fuer die Art UNPLAUSIBEL | EN: Fault code FI_IBS3 - OBD P-code reported for implausible signal" VALUE 0x7130A TKW_VV_VV_UW 100.0 FORMULA_0010 0.0 65535.0000 /end CHARACTERISTIC
/begin CHARACTERISTIC K_ED_FI_PMBN.P_CODE_UNPLAUSIBEL "P-Code fuer die Art UNPLAUSIBEL | EN: Fault code FI_PMBN - OBD P-code reported for implausible signal" VALUE 0x71324 TKW_VV_VV_UW 100.0 FORMULA_0010 0.0 65535.0000 /end CHARACTERISTIC
/begin CHARACTERISTIC K_ED_FI_PMBATT.P_CODE_UNPLAUSIBEL "P-Code fuer die Art UNPLAUSIBEL | EN: Fault code FI_PMBATT - OBD P-code reported for implausible signal" VALUE 0x7133E TKW_VV_VV_UW 100.0 FORMULA_0010 0.0 65535.0000 /end CHARACTERISTIC
/begin CHARACTERISTIC K_ED_FI_PMRUHVERL.P_CODE_UNPLAUSIBEL "P-Code fuer die Art UNPLAUSIBEL | EN: Fault code FI_PMRUHVERL - OBD P-code reported for implausible signal" VALUE 0x71442 TKW_VV_VV_UW 100.0 FORMULA_0010 0.0 65535.0000 /end CHARACTERISTIC
/begin CHARACTERISTIC K_ED_FI_TOENS.P_CODE_UNPLAUSIBEL "P-Code fuer die Art UNPLAUSIBEL | EN: Fault code FI_TOENS - OBD P-code reported for implausible signal" VALUE 0x7145C TKW_VV_VV_UW 100.0 FORMULA_0010 0.0 65535.0000 /end CHARACTERISTIC
/begin CHARACTERISTIC K_ED_KW.P_CODE_UNPLAUSIBEL "P-Code fuer die Art UNPLAUSIBEL | EN: Fault code KW - OBD P-code reported for implausible signal" VALUE 0x7157A TKW_VV_VV_UW 100.0 FORMULA_0010 0.0 65535.0000 /end CHARACTERISTIC
/begin CHARACTERISTIC K_ED_LA1_ADAPT.P_CODE_UNPLAUSIBEL "P-Code fuer die Art UNPLAUSIBEL | EN: Fault code LA1_ADAPT - OBD P-code reported for implausible signal" VALUE 0x71594 TKW_VV_VV_UW 100.0 FORMULA_0010 0.0 65535.0000 /end CHARACTERISTIC
/begin CHARACTERISTIC K_ED_LA2_ADAPT.P_CODE_UNPLAUSIBEL "P-Code fuer die Art UNPLAUSIBEL | EN: Fault code LA2_ADAPT - OBD P-code reported for implausible signal" VALUE 0x715AE TKW_VV_VV_UW 100.0 FORMULA_0010 0.0 65535.0000 /end CHARACTERISTIC
/begin CHARACTERISTIC K_ED_KGE1.P_CODE_UNPLAUSIBEL "P-Code fuer die Art UNPLAUSIBEL | EN: Fault code KGE1 - OBD P-code reported for implausible signal" VALUE 0x715C8 TKW_VV_VV_UW 100.0 FORMULA_0010 0.0 65535.0000 /end CHARACTERISTIC
/begin CHARACTERISTIC K_ED_KGE2.P_CODE_UNPLAUSIBEL "P-Code fuer die Art UNPLAUSIBEL | EN: Fault code KGE2 - OBD P-code reported for implausible signal" VALUE 0x715E2 TKW_VV_VV_UW 100.0 FORMULA_0010 0.0 65535.0000 /end CHARACTERISTIC
/begin CHARACTERISTIC K_ED_FST.P_CODE_UNPLAUSIBEL "P-Code fuer die Art UNPLAUSIBEL | EN: Fault code FST - OBD P-code reported for implausible signal" VALUE 0x715FC TKW_VV_VV_UW 100.0 FORMULA_0010 0.0 65535.0000 /end CHARACTERISTIC
/begin CHARACTERISTIC K_ED_KSD1.P_CODE_UNPLAUSIBEL "P-Code fuer die Art UNPLAUSIBEL | EN: Fault code KSD1 - OBD P-code reported for implausible signal" VALUE 0x71734 TKW_VV_VV_UW 100.0 FORMULA_0010 0.0 65535.0000 /end CHARACTERISTIC
/begin CHARACTERISTIC K_ED_KSD2.P_CODE_UNPLAUSIBEL "P-Code fuer die Art UNPLAUSIBEL | EN: Fault code KSD2 - OBD P-code reported for implausible signal" VALUE 0x7174E TKW_VV_VV_UW 100.0 FORMULA_0010 0.0 65535.0000 /end CHARACTERISTIC
/begin CHARACTERISTIC K_ED_KATS_B1.P_CODE_UNPLAUSIBEL "P-Code fuer die Art UNPLAUSIBEL | EN: Fault code KATS_B1 - OBD P-code reported for implausible signal" VALUE 0x71768 TKW_VV_VV_UW 100.0 FORMULA_0010 0.0 65535.0000 /end CHARACTERISTIC
/begin CHARACTERISTIC K_ED_KATS_B2.P_CODE_UNPLAUSIBEL "P-Code fuer die Art UNPLAUSIBEL | EN: Fault code KATS_B2 - OBD P-code reported for implausible signal" VALUE 0x71782 TKW_VV_VV_UW 100.0 FORMULA_0010 0.0 65535.0000 /end CHARACTERISTIC
/begin CHARACTERISTIC K_ED_FST_GEBER.P_CODE_UNPLAUSIBEL "P-Code fuer die Art UNPLAUSIBEL | EN: Fault code FST_GEBER - OBD P-code reported for implausible signal" VALUE 0x717D0 TKW_VV_VV_UW 100.0 FORMULA_0010 0.0 65535.0000 /end CHARACTERISTIC
/begin CHARACTERISTIC K_ED_LA1_TRIM_AD.P_CODE_UNPLAUSIBEL "P-Code fuer die Art UNPLAUSIBEL | EN: Fault code LA1_TRIM_AD - OBD P-code reported for implausible signal" VALUE 0x7186C TKW_VV_VV_UW 100.0 FORMULA_0010 0.0 65535.0000 /end CHARACTERISTIC
/begin CHARACTERISTIC K_ED_LA2_TRIM_AD.P_CODE_UNPLAUSIBEL "P-Code fuer die Art UNPLAUSIBEL | EN: Fault code LA2_TRIM_AD - OBD P-code reported for implausible signal" VALUE 0x71886 TKW_VV_VV_UW 100.0 FORMULA_0010 0.0 65535.0000 /end CHARACTERISTIC
/begin CHARACTERISTIC K_ED_LANK1_OPENLOAD.P_CODE_UNPLAUSIBEL "P-Code fuer die Art UNPLAUSIBEL | EN: Fault code LANK1_OPENLOAD - OBD P-code reported for implausible signal" VALUE 0x718A0 TKW_VV_VV_UW 100.0 FORMULA_0010 0.0 65535.0000 /end CHARACTERISTIC
/begin CHARACTERISTIC K_ED_LANK2_OPENLOAD.P_CODE_UNPLAUSIBEL "P-Code fuer die Art UNPLAUSIBEL | EN: Fault code LANK2_OPENLOAD - OBD P-code reported for implausible signal" VALUE 0x718BA TKW_VV_VV_UW 100.0 FORMULA_0010 0.0 65535.0000 /end CHARACTERISTIC
/begin CHARACTERISTIC K_ED_LANK1_OBD_WE.P_CODE_UNPLAUSIBEL "P-Code fuer die Art UNPLAUSIBEL | EN: Fault code LANK1_OBD_WE - OBD P-code reported for implausible signal" VALUE 0x718D4 TKW_VV_VV_UW 100.0 FORMULA_0010 0.0 65535.0000 /end CHARACTERISTIC
/begin CHARACTERISTIC K_ED_LANK2_OBD_WE.P_CODE_UNPLAUSIBEL "P-Code fuer die Art UNPLAUSIBEL | EN: Fault code LANK2_OBD_WE - OBD P-code reported for implausible signal" VALUE 0x718EE TKW_VV_VV_UW 100.0 FORMULA_0010 0.0 65535.0000 /end CHARACTERISTIC
/begin CHARACTERISTIC K_ED_FST_GEBER_LI.P_CODE_UNPLAUSIBEL "P-Code fuer die Art UNPLAUSIBEL" VALUE 0x719F2 TKW_VV_VV_UW 100.0 FORMULA_0010 0.0 65535.0000 /end CHARACTERISTIC
/begin CHARACTERISTIC K_ED_FST_GEBER_RE.P_CODE_UNPLAUSIBEL "P-Code fuer die Art UNPLAUSIBEL" VALUE 0x71A0C TKW_VV_VV_UW 100.0 FORMULA_0010 0.0 65535.0000 /end CHARACTERISTIC
/begin CHARACTERISTIC K_ED_LANK1_OBD_SLOPE.P_CODE_UNPLAUSIBEL "P-Code fuer die Art UNPLAUSIBEL" VALUE 0x71A26 TKW_VV_VV_UW 100.0 FORMULA_0010 0.0 65535.0000 /end CHARACTERISTIC
/begin CHARACTERISTIC K_ED_LANK2_OBD_SLOPE.P_CODE_UNPLAUSIBEL "P-Code fuer die Art UNPLAUSIBEL" VALUE 0x71A40 TKW_VV_VV_UW 100.0 FORMULA_0010 0.0 65535.0000 /end CHARACTERISTIC
/begin CHARACTERISTIC K_ED_INDEX_204_INJ.P_CODE_UNPLAUSIBEL "P-Code fuer die Art UNPLAUSIBEL | EN: Fault code INDEX_204_INJ - OBD P-code reported for implausible signal" VALUE 0x71AA8 TKW_VV_VV_UW 100.0 FORMULA_0010 0.0 65535.0000 /end CHARACTERISTIC
/begin CHARACTERISTIC K_ED_INDEX_205_INJ.P_CODE_UNPLAUSIBEL "P-Code fuer die Art UNPLAUSIBEL | EN: Fault code INDEX_205_INJ - OBD P-code reported for implausible signal" VALUE 0x71AC2 TKW_VV_VV_UW 100.0 FORMULA_0010 0.0 65535.0000 /end CHARACTERISTIC
/begin CHARACTERISTIC K_ED_INDEX_206_INJ.P_CODE_UNPLAUSIBEL "P-Code fuer die Art UNPLAUSIBEL | EN: Fault code INDEX_206_INJ - OBD P-code reported for implausible signal" VALUE 0x71ADC TKW_VV_VV_UW 100.0 FORMULA_0010 0.0 65535.0000 /end CHARACTERISTIC
/begin CHARACTERISTIC K_ED_INDEX_207_INJ.P_CODE_UNPLAUSIBEL "P-Code fuer die Art UNPLAUSIBEL" VALUE 0x71AF6 TKW_VV_VV_UW 100.0 FORMULA_0010 0.0 65535.0000 /end CHARACTERISTIC
/begin CHARACTERISTIC K_ED_INDEX_208_INJ.P_CODE_UNPLAUSIBEL "P-Code fuer die Art UNPLAUSIBEL" VALUE 0x71B10 TKW_VV_VV_UW 100.0 FORMULA_0010 0.0 65535.0000 /end CHARACTERISTIC
/begin CHARACTERISTIC K_ED_INDEX_209_INJ.P_CODE_UNPLAUSIBEL "P-Code fuer die Art UNPLAUSIBEL" VALUE 0x71B2A TKW_VV_VV_UW 100.0 FORMULA_0010 0.0 65535.0000 /end CHARACTERISTIC
/begin CHARACTERISTIC K_ED_INDEX_210_INJ.P_CODE_UNPLAUSIBEL "P-Code fuer die Art UNPLAUSIBEL" VALUE 0x71B44 TKW_VV_VV_UW 100.0 FORMULA_0010 0.0 65535.0000 /end CHARACTERISTIC
/begin CHARACTERISTIC K_ED_INDEX_211_INJ.P_CODE_UNPLAUSIBEL "P-Code fuer die Art UNPLAUSIBEL" VALUE 0x71B5E TKW_VV_VV_UW 100.0 FORMULA_0010 0.0 65535.0000 /end CHARACTERISTIC
/begin CHARACTERISTIC K_ED_INDEX_212_INJ.P_CODE_UNPLAUSIBEL "P-Code fuer die Art UNPLAUSIBEL | EN: P-Code fuer die Art UNPLAUSIBEL" VALUE 0x71B78 TKW_VV_VV_UW 100.0 FORMULA_0010 0.0 65535.0000 /end CHARACTERISTIC
/begin CHARACTERISTIC K_ED_INDEX_213_INJ.P_CODE_UNPLAUSIBEL "P-Code fuer die Art UNPLAUSIBEL" VALUE 0x71B92 TKW_VV_VV_UW 100.0 FORMULA_0010 0.0 65535.0000 /end CHARACTERISTIC
/begin CHARACTERISTIC K_ED_INDEX_214_INJ.P_CODE_UNPLAUSIBEL "P-Code fuer die Art UNPLAUSIBEL" VALUE 0x71BAC TKW_VV_VV_UW 100.0 FORMULA_0010 0.0 65535.0000 /end CHARACTERISTIC
/begin CHARACTERISTIC K_ED_INDEX_215_INJ.P_CODE_UNPLAUSIBEL "P-Code fuer die Art UNPLAUSIBEL" VALUE 0x71BC6 TKW_VV_VV_UW 100.0 FORMULA_0010 0.0 65535.0000 /end CHARACTERISTIC
/begin CHARACTERISTIC K_ED_INDEX_216_INJ.P_CODE_UNPLAUSIBEL "P-Code fuer die Art UNPLAUSIBEL | EN: P-Code fuer die Art UNPLAUSIBEL" VALUE 0x71BE0 TKW_VV_VV_UW 100.0 FORMULA_0010 0.0 65535.0000 /end CHARACTERISTIC
/begin CHARACTERISTIC K_ED_INDEX_217_INJ.P_CODE_UNPLAUSIBEL "P-Code fuer die Art UNPLAUSIBEL | EN: P-Code fuer die Art UNPLAUSIBEL" VALUE 0x71BFA TKW_VV_VV_UW 100.0 FORMULA_0010 0.0 65535.0000 /end CHARACTERISTIC
/begin CHARACTERISTIC K_ED_INDEX_218_INJ.P_CODE_UNPLAUSIBEL "P-Code fuer die Art UNPLAUSIBEL | EN: P-Code fuer die Art UNPLAUSIBEL" VALUE 0x71C14 TKW_VV_VV_UW 100.0 FORMULA_0010 0.0 65535.0000 /end CHARACTERISTIC
/begin CHARACTERISTIC K_ED_INDEX_219_INJ.P_CODE_UNPLAUSIBEL "P-Code fuer die Art UNPLAUSIBEL | EN: P-Code fuer die Art UNPLAUSIBEL" VALUE 0x71C2E TKW_VV_VV_UW 100.0 FORMULA_0010 0.0 65535.0000 /end CHARACTERISTIC
/begin CHARACTERISTIC K_ED_INDEX_220_INJ.P_CODE_UNPLAUSIBEL "P-Code fuer die Art UNPLAUSIBEL | EN: P-Code fuer die Art UNPLAUSIBEL" VALUE 0x71C48 TKW_VV_VV_UW 100.0 FORMULA_0010 0.0 65535.0000 /end CHARACTERISTIC
/begin CHARACTERISTIC K_ED_INDEX_221_INJ.P_CODE_UNPLAUSIBEL "P-Code fuer die Art UNPLAUSIBEL | EN: P-Code fuer die Art UNPLAUSIBEL" VALUE 0x71C62 TKW_VV_VV_UW 100.0 FORMULA_0010 0.0 65535.0000 /end CHARACTERISTIC
/begin CHARACTERISTIC K_ED_INDEX_222_INJ.P_CODE_UNPLAUSIBEL "P-Code fuer die Art UNPLAUSIBEL" VALUE 0x71C7C TKW_VV_VV_UW 100.0 FORMULA_0010 0.0 65535.0000 /end CHARACTERISTIC
/begin CHARACTERISTIC K_ED_INDEX_223_INJ.P_CODE_UNPLAUSIBEL "P-Code fuer die Art UNPLAUSIBEL" VALUE 0x71C96 TKW_VV_VV_UW 100.0 FORMULA_0010 0.0 65535.0000 /end CHARACTERISTIC
/begin CHARACTERISTIC K_ED_HFM1.FEHLERSCHWELLE "Filterschwelle fuer Fehlereintrag | EN: Fault code HFM1 - debounce filter threshold for setting the fault" VALUE 0x70626 TKW_VV_VV_UB 100.0 FORMULA_0003 0.0 255.0000 /end CHARACTERISTIC
/begin CHARACTERISTIC K_ED_HFM2.FEHLERSCHWELLE "Filterschwelle fuer Fehlereintrag | EN: Fault code HFM2 - debounce filter threshold for setting the fault" VALUE 0x70640 TKW_VV_VV_UB 100.0 FORMULA_0003 0.0 255.0000 /end CHARACTERISTIC
/begin CHARACTERISTIC K_ED_LAVK1.FEHLERSCHWELLE "Filterschwelle fuer Fehlereintrag | EN: Fault code LAVK1 - debounce filter threshold for setting the fault" VALUE 0x707FA TKW_VV_VV_UB 100.0 FORMULA_0003 0.0 255.0000 /end CHARACTERISTIC
/begin CHARACTERISTIC K_ED_LANK1.FEHLERSCHWELLE "Filterschwelle fuer Fehlereintrag | EN: Fault code LANK1 - debounce filter threshold for setting the fault" VALUE 0x70896 TKW_VV_VV_UB 100.0 FORMULA_0003 0.0 255.0000 /end CHARACTERISTIC
/begin CHARACTERISTIC K_ED_LANK2.FEHLERSCHWELLE "Filterschwelle fuer Fehlereintrag | EN: Fault code LANK2 - debounce filter threshold for setting the fault" VALUE 0x708B0 TKW_VV_VV_UB 100.0 FORMULA_0003 0.0 255.0000 /end CHARACTERISTIC
/begin CHARACTERISTIC K_ED_FPLAU1.FEHLERSCHWELLE "Filterschwelle fuer Fehlereintrag | EN: Fault code FPLAU1 - debounce filter threshold for setting the fault" VALUE 0x709E8 TKW_VV_VV_UB 100.0 FORMULA_0003 0.0 255.0000 /end CHARACTERISTIC
/begin CHARACTERISTIC K_ED_FPLAU2.FEHLERSCHWELLE "Filterschwelle fuer Fehlereintrag | EN: Fault code FPLAU2 - debounce filter threshold for setting the fault" VALUE 0x70A02 TKW_VV_VV_UB 100.0 FORMULA_0003 0.0 255.0000 /end CHARACTERISTIC
/begin CHARACTERISTIC K_ED_LANK1_OBD_S.FEHLERSCHWELLE "Filterschwelle fuer Fehlereintrag | EN: Fault code LANK1_OBD_S - debounce filter threshold for setting the fault [V912: differs from V452 160E]" VALUE 0x70A36 TKW_VV_VV_UB 100.0 FORMULA_0003 0.0 255.0000 /end CHARACTERISTIC
/begin CHARACTERISTIC K_ED_LANK2_OBD_S.FEHLERSCHWELLE "Filterschwelle fuer Fehlereintrag | EN: Fault code LANK2_OBD_S - debounce filter threshold for setting the fault [V912: differs from V452 160E]" VALUE 0x70A50 TKW_VV_VV_UB 100.0 FORMULA_0003 0.0 255.0000 /end CHARACTERISTIC
/begin CHARACTERISTIC K_ED_LAVK1_DIAG.FEHLERSCHWELLE "Filterschwelle fuer Fehlereintrag | EN: Fault code LAVK1_DIAG - debounce filter threshold for setting the fault" VALUE 0x70BA2 TKW_VV_VV_UB 100.0 FORMULA_0003 0.0 255.0000 /end CHARACTERISTIC
/begin CHARACTERISTIC K_ED_LAM1_REG.FEHLERSCHWELLE "Filterschwelle fuer Fehlereintrag | EN: Fault code LAM1_REG - debounce filter threshold for setting the fault" VALUE 0x70DC4 TKW_VV_VV_UB 100.0 FORMULA_0003 0.0 255.0000 /end CHARACTERISTIC
/begin CHARACTERISTIC K_ED_LAM2_REG.FEHLERSCHWELLE "Filterschwelle fuer Fehlereintrag | EN: Fault code LAM2_REG - debounce filter threshold for setting the fault" VALUE 0x70DDE TKW_VV_VV_UB 100.0 FORMULA_0003 0.0 255.0000 /end CHARACTERISTIC
/begin CHARACTERISTIC K_ED_KAT_OBD1.FEHLERSCHWELLE "Filterschwelle fuer Fehlereintrag | EN: Fault code KAT_OBD1 - debounce filter threshold for setting the fault" VALUE 0x7123C TKW_VV_VV_UB 100.0 FORMULA_0003 0.0 255.0000 /end CHARACTERISTIC
/begin CHARACTERISTIC K_ED_KAT_OBD2.FEHLERSCHWELLE "Filterschwelle fuer Fehlereintrag | EN: Fault code KAT_OBD2 - debounce filter threshold for setting the fault" VALUE 0x71256 TKW_VV_VV_UB 100.0 FORMULA_0003 0.0 255.0000 /end CHARACTERISTIC
/begin CHARACTERISTIC K_ED_FI_GEN.FEHLERSCHWELLE "Filterschwelle fuer Fehlereintrag | EN: Fault code FI_GEN - debounce filter threshold for setting the fault" VALUE 0x7128A TKW_VV_VV_UB 100.0 FORMULA_0003 0.0 255.0000 /end CHARACTERISTIC
/begin CHARACTERISTIC K_ED_FI_BSD.FEHLERSCHWELLE "Filterschwelle fuer Fehlereintrag | EN: Fault code FI_BSD - debounce filter threshold for setting the fault" VALUE 0x712A4 TKW_VV_VV_UB 100.0 FORMULA_0003 0.0 255.0000 /end CHARACTERISTIC
/begin CHARACTERISTIC K_ED_FI_QLT.FEHLERSCHWELLE "Filterschwelle fuer Fehlereintrag | EN: Fault code FI_QLT - debounce filter threshold for setting the fault" VALUE 0x712BE TKW_VV_VV_UB 100.0 FORMULA_0003 0.0 255.0000 /end CHARACTERISTIC
/begin CHARACTERISTIC K_ED_FI_IBS1.FEHLERSCHWELLE "Filterschwelle fuer Fehlereintrag | EN: Fault code FI_IBS1 - debounce filter threshold for setting the fault" VALUE 0x712D8 TKW_VV_VV_UB 100.0 FORMULA_0003 0.0 255.0000 /end CHARACTERISTIC
/begin CHARACTERISTIC K_ED_FI_IBS2.FEHLERSCHWELLE "Filterschwelle fuer Fehlereintrag | EN: Fault code FI_IBS2 - debounce filter threshold for setting the fault" VALUE 0x712F2 TKW_VV_VV_UB 100.0 FORMULA_0003 0.0 255.0000 /end CHARACTERISTIC
/begin CHARACTERISTIC K_ED_FI_IBS3.FEHLERSCHWELLE "Filterschwelle fuer Fehlereintrag | EN: Fault code FI_IBS3 - debounce filter threshold for setting the fault" VALUE 0x7130C TKW_VV_VV_UB 100.0 FORMULA_0003 0.0 255.0000 /end CHARACTERISTIC
/begin CHARACTERISTIC K_ED_FI_PMBN.FEHLERSCHWELLE "Filterschwelle fuer Fehlereintrag | EN: Fault code FI_PMBN - debounce filter threshold for setting the fault" VALUE 0x71326 TKW_VV_VV_UB 100.0 FORMULA_0003 0.0 255.0000 /end CHARACTERISTIC
/begin CHARACTERISTIC K_ED_FI_PMBATT.FEHLERSCHWELLE "Filterschwelle fuer Fehlereintrag | EN: Fault code FI_PMBATT - debounce filter threshold for setting the fault" VALUE 0x71340 TKW_VV_VV_UB 100.0 FORMULA_0003 0.0 255.0000 /end CHARACTERISTIC
/begin CHARACTERISTIC K_ED_FI_BSD_0.FEHLERSCHWELLE "Filterschwelle fuer Fehlereintrag | EN: Fault code FI_BSD_0 - debounce filter threshold for setting the fault" VALUE 0x713F6 TKW_VV_VV_UB 100.0 FORMULA_0003 0.0 255.0000 /end CHARACTERISTIC
/begin CHARACTERISTIC K_ED_FI_BSDGLOB.FEHLERSCHWELLE "Filterschwelle fuer Fehlereintrag | EN: Fault code FI_BSDGLOB - debounce filter threshold for setting the fault" VALUE 0x7142A TKW_VV_VV_UB 100.0 FORMULA_0003 0.0 255.0000 /end CHARACTERISTIC
/begin CHARACTERISTIC K_ED_FI_PMRUHVERL.FEHLERSCHWELLE "Filterschwelle fuer Fehlereintrag | EN: Fault code FI_PMRUHVERL - debounce filter threshold for setting the fault" VALUE 0x71444 TKW_VV_VV_UB 100.0 FORMULA_0003 0.0 255.0000 /end CHARACTERISTIC
/begin CHARACTERISTIC K_ED_FI_TOENS.FEHLERSCHWELLE "Filterschwelle fuer Fehlereintrag | EN: Fault code FI_TOENS - debounce filter threshold for setting the fault" VALUE 0x7145E TKW_VV_VV_UB 100.0 FORMULA_0003 0.0 255.0000 /end CHARACTERISTIC
/begin CHARACTERISTIC K_ED_KW.FEHLERSCHWELLE "Filterschwelle fuer Fehlereintrag | EN: Fault code KW - debounce filter threshold for setting the fault" VALUE 0x7157C TKW_VV_VV_UB 100.0 FORMULA_0003 0.0 255.0000 /end CHARACTERISTIC
/begin CHARACTERISTIC K_ED_LA1_ADAPT.FEHLERSCHWELLE "Filterschwelle fuer Fehlereintrag | EN: Fault code LA1_ADAPT - debounce filter threshold for setting the fault" VALUE 0x71596 TKW_VV_VV_UB 100.0 FORMULA_0003 0.0 255.0000 /end CHARACTERISTIC
/begin CHARACTERISTIC K_ED_LA2_ADAPT.FEHLERSCHWELLE "Filterschwelle fuer Fehlereintrag | EN: Fault code LA2_ADAPT - debounce filter threshold for setting the fault" VALUE 0x715B0 TKW_VV_VV_UB 100.0 FORMULA_0003 0.0 255.0000 /end CHARACTERISTIC
/begin CHARACTERISTIC K_ED_KGE1.FEHLERSCHWELLE "Filterschwelle fuer Fehlereintrag | EN: Fault code KGE1 - debounce filter threshold for setting the fault" VALUE 0x715CA TKW_VV_VV_UB 100.0 FORMULA_0003 0.0 255.0000 /end CHARACTERISTIC
/begin CHARACTERISTIC K_ED_KGE2.FEHLERSCHWELLE "Filterschwelle fuer Fehlereintrag | EN: Fault code KGE2 - debounce filter threshold for setting the fault" VALUE 0x715E4 TKW_VV_VV_UB 100.0 FORMULA_0003 0.0 255.0000 /end CHARACTERISTIC
/begin CHARACTERISTIC K_ED_FST.FEHLERSCHWELLE "Filterschwelle fuer Fehlereintrag | EN: Fault code FST - debounce filter threshold for setting the fault" VALUE 0x715FE TKW_VV_VV_UB 100.0 FORMULA_0003 0.0 255.0000 /end CHARACTERISTIC
/begin CHARACTERISTIC K_ED_KSD1.FEHLERSCHWELLE "Filterschwelle fuer Fehlereintrag | EN: Fault code KSD1 - debounce filter threshold for setting the fault" VALUE 0x71736 TKW_VV_VV_UB 100.0 FORMULA_0003 0.0 255.0000 /end CHARACTERISTIC
/begin CHARACTERISTIC K_ED_KSD2.FEHLERSCHWELLE "Filterschwelle fuer Fehlereintrag | EN: Fault code KSD2 - debounce filter threshold for setting the fault" VALUE 0x71750 TKW_VV_VV_UB 100.0 FORMULA_0003 0.0 255.0000 /end CHARACTERISTIC
/begin CHARACTERISTIC K_ED_KATS_B1.FEHLERSCHWELLE "Filterschwelle fuer Fehlereintrag | EN: Fault code KATS_B1 - debounce filter threshold for setting the fault" VALUE 0x7176A TKW_VV_VV_UB 100.0 FORMULA_0003 0.0 255.0000 /end CHARACTERISTIC
/begin CHARACTERISTIC K_ED_KATS_B2.FEHLERSCHWELLE "Filterschwelle fuer Fehlereintrag | EN: Fault code KATS_B2 - debounce filter threshold for setting the fault" VALUE 0x71784 TKW_VV_VV_UB 100.0 FORMULA_0003 0.0 255.0000 /end CHARACTERISTIC
/begin CHARACTERISTIC K_ED_FST_GEBER.FEHLERSCHWELLE "Filterschwelle fuer Fehlereintrag | EN: Fault code FST_GEBER - debounce filter threshold for setting the fault" VALUE 0x717D2 TKW_VV_VV_UB 100.0 FORMULA_0003 0.0 255.0000 /end CHARACTERISTIC
/begin CHARACTERISTIC K_ED_LA1_TRIM_AD.FEHLERSCHWELLE "Filterschwelle fuer Fehlereintrag | EN: Fault code LA1_TRIM_AD - debounce filter threshold for setting the fault" VALUE 0x7186E TKW_VV_VV_UB 100.0 FORMULA_0003 0.0 255.0000 /end CHARACTERISTIC
/begin CHARACTERISTIC K_ED_LA2_TRIM_AD.FEHLERSCHWELLE "Filterschwelle fuer Fehlereintrag | EN: Fault code LA2_TRIM_AD - debounce filter threshold for setting the fault" VALUE 0x71888 TKW_VV_VV_UB 100.0 FORMULA_0003 0.0 255.0000 /end CHARACTERISTIC
/begin CHARACTERISTIC K_ED_LANK1_OPENLOAD.FEHLERSCHWELLE "Filterschwelle fuer Fehlereintrag | EN: Fault code LANK1_OPENLOAD - debounce filter threshold for setting the fault" VALUE 0x718A2 TKW_VV_VV_UB 100.0 FORMULA_0003 0.0 255.0000 /end CHARACTERISTIC
/begin CHARACTERISTIC K_ED_LANK2_OPENLOAD.FEHLERSCHWELLE "Filterschwelle fuer Fehlereintrag | EN: Fault code LANK2_OPENLOAD - debounce filter threshold for setting the fault" VALUE 0x718BC TKW_VV_VV_UB 100.0 FORMULA_0003 0.0 255.0000 /end CHARACTERISTIC
/begin CHARACTERISTIC K_ED_LANK1_OBD_WE.FEHLERSCHWELLE "Filterschwelle fuer Fehlereintrag | EN: Fault code LANK1_OBD_WE - debounce filter threshold for setting the fault" VALUE 0x718D6 TKW_VV_VV_UB 100.0 FORMULA_0003 0.0 255.0000 /end CHARACTERISTIC
/begin CHARACTERISTIC K_ED_LANK2_OBD_WE.FEHLERSCHWELLE "Filterschwelle fuer Fehlereintrag | EN: Fault code LANK2_OBD_WE - debounce filter threshold for setting the fault" VALUE 0x718F0 TKW_VV_VV_UB 100.0 FORMULA_0003 0.0 255.0000 /end CHARACTERISTIC
/begin CHARACTERISTIC K_ED_FST_GEBER_LI.FEHLERSCHWELLE "Filterschwelle fuer Fehlereintrag" VALUE 0x719F4 TKW_VV_VV_UB 100.0 FORMULA_0003 0.0 255.0000 /end CHARACTERISTIC
/begin CHARACTERISTIC K_ED_FST_GEBER_RE.FEHLERSCHWELLE "Filterschwelle fuer Fehlereintrag" VALUE 0x71A0E TKW_VV_VV_UB 100.0 FORMULA_0003 0.0 255.0000 /end CHARACTERISTIC
/begin CHARACTERISTIC K_ED_LANK1_OBD_SLOPE.FEHLERSCHWELLE "Filterschwelle fuer Fehlereintrag" VALUE 0x71A28 TKW_VV_VV_UB 100.0 FORMULA_0003 0.0 255.0000 /end CHARACTERISTIC
/begin CHARACTERISTIC K_ED_LANK2_OBD_SLOPE.FEHLERSCHWELLE "Filterschwelle fuer Fehlereintrag" VALUE 0x71A42 TKW_VV_VV_UB 100.0 FORMULA_0003 0.0 255.0000 /end CHARACTERISTIC
/begin CHARACTERISTIC K_ED_INDEX_204_INJ.FEHLERSCHWELLE "Filterschwelle fuer Fehlereintrag | EN: Fault code INDEX_204_INJ - debounce filter threshold for setting the fault" VALUE 0x71AAA TKW_VV_VV_UB 100.0 FORMULA_0003 0.0 255.0000 /end CHARACTERISTIC
/begin CHARACTERISTIC K_ED_INDEX_205_INJ.FEHLERSCHWELLE "Filterschwelle fuer Fehlereintrag | EN: Fault code INDEX_205_INJ - debounce filter threshold for setting the fault" VALUE 0x71AC4 TKW_VV_VV_UB 100.0 FORMULA_0003 0.0 255.0000 /end CHARACTERISTIC
/begin CHARACTERISTIC K_ED_INDEX_206_INJ.FEHLERSCHWELLE "Filterschwelle fuer Fehlereintrag | EN: Fault code INDEX_206_INJ - debounce filter threshold for setting the fault" VALUE 0x71ADE TKW_VV_VV_UB 100.0 FORMULA_0003 0.0 255.0000 /end CHARACTERISTIC
/begin CHARACTERISTIC K_ED_INDEX_207_INJ.FEHLERSCHWELLE "Filterschwelle fuer Fehlereintrag" VALUE 0x71AF8 TKW_VV_VV_UB 100.0 FORMULA_0003 0.0 255.0000 /end CHARACTERISTIC
/begin CHARACTERISTIC K_ED_INDEX_208_INJ.FEHLERSCHWELLE "Filterschwelle fuer Fehlereintrag" VALUE 0x71B12 TKW_VV_VV_UB 100.0 FORMULA_0003 0.0 255.0000 /end CHARACTERISTIC
/begin CHARACTERISTIC K_ED_INDEX_209_INJ.FEHLERSCHWELLE "Filterschwelle fuer Fehlereintrag" VALUE 0x71B2C TKW_VV_VV_UB 100.0 FORMULA_0003 0.0 255.0000 /end CHARACTERISTIC
/begin CHARACTERISTIC K_ED_INDEX_210_INJ.FEHLERSCHWELLE "Filterschwelle fuer Fehlereintrag" VALUE 0x71B46 TKW_VV_VV_UB 100.0 FORMULA_0003 0.0 255.0000 /end CHARACTERISTIC
/begin CHARACTERISTIC K_ED_INDEX_211_INJ.FEHLERSCHWELLE "Filterschwelle fuer Fehlereintrag | EN: Filterschwelle fuer Fehlereintrag" VALUE 0x71B60 TKW_VV_VV_UB 100.0 FORMULA_0003 0.0 255.0000 /end CHARACTERISTIC
/begin CHARACTERISTIC K_ED_INDEX_212_INJ.FEHLERSCHWELLE "Filterschwelle fuer Fehlereintrag | EN: Filterschwelle fuer Fehlereintrag" VALUE 0x71B7A TKW_VV_VV_UB 100.0 FORMULA_0003 0.0 255.0000 /end CHARACTERISTIC
/begin CHARACTERISTIC K_ED_INDEX_213_INJ.FEHLERSCHWELLE "Filterschwelle fuer Fehlereintrag" VALUE 0x71B94 TKW_VV_VV_UB 100.0 FORMULA_0003 0.0 255.0000 /end CHARACTERISTIC
/begin CHARACTERISTIC K_ED_INDEX_214_INJ.FEHLERSCHWELLE "Filterschwelle fuer Fehlereintrag" VALUE 0x71BAE TKW_VV_VV_UB 100.0 FORMULA_0003 0.0 255.0000 /end CHARACTERISTIC
/begin CHARACTERISTIC K_ED_INDEX_215_INJ.FEHLERSCHWELLE "Filterschwelle fuer Fehlereintrag" VALUE 0x71BC8 TKW_VV_VV_UB 100.0 FORMULA_0003 0.0 255.0000 /end CHARACTERISTIC
/begin CHARACTERISTIC K_ED_INDEX_216_INJ.FEHLERSCHWELLE "Filterschwelle fuer Fehlereintrag" VALUE 0x71BE2 TKW_VV_VV_UB 100.0 FORMULA_0003 0.0 255.0000 /end CHARACTERISTIC
/begin CHARACTERISTIC K_ED_INDEX_217_INJ.FEHLERSCHWELLE "Filterschwelle fuer Fehlereintrag" VALUE 0x71BFC TKW_VV_VV_UB 100.0 FORMULA_0003 0.0 255.0000 /end CHARACTERISTIC
/begin CHARACTERISTIC K_ED_INDEX_218_INJ.FEHLERSCHWELLE "Filterschwelle fuer Fehlereintrag" VALUE 0x71C16 TKW_VV_VV_UB 100.0 FORMULA_0003 0.0 255.0000 /end CHARACTERISTIC
/begin CHARACTERISTIC K_ED_INDEX_219_INJ.FEHLERSCHWELLE "Filterschwelle fuer Fehlereintrag" VALUE 0x71C30 TKW_VV_VV_UB 100.0 FORMULA_0003 0.0 255.0000 /end CHARACTERISTIC
/begin CHARACTERISTIC K_ED_INDEX_220_INJ.FEHLERSCHWELLE "Filterschwelle fuer Fehlereintrag" VALUE 0x71C4A TKW_VV_VV_UB 100.0 FORMULA_0003 0.0 255.0000 /end CHARACTERISTIC
/begin CHARACTERISTIC K_ED_INDEX_221_INJ.FEHLERSCHWELLE "Filterschwelle fuer Fehlereintrag" VALUE 0x71C64 TKW_VV_VV_UB 100.0 FORMULA_0003 0.0 255.0000 /end CHARACTERISTIC
/begin CHARACTERISTIC K_ED_INDEX_222_INJ.FEHLERSCHWELLE "Filterschwelle fuer Fehlereintrag" VALUE 0x71C7E TKW_VV_VV_UB 100.0 FORMULA_0003 0.0 255.0000 /end CHARACTERISTIC
/begin CHARACTERISTIC K_ED_INDEX_223_INJ.FEHLERSCHWELLE "Filterschwelle fuer Fehlereintrag" VALUE 0x71C98 TKW_VV_VV_UB 100.0 FORMULA_0003 0.0 255.0000 /end CHARACTERISTIC
/begin CHARACTERISTIC K_ED_HFM1.OK_SCHWELLE "Filterschwelle fuer Fehleraustrag | EN: Fault code HFM1 - debounce filter threshold for clearing (healing) the fault" VALUE 0x70627 TKW_VV_VV_UB 100.0 FORMULA_0003 0.0 255.0000 /end CHARACTERISTIC
/begin CHARACTERISTIC K_ED_HFM2.OK_SCHWELLE "Filterschwelle fuer Fehleraustrag | EN: Fault code HFM2 - debounce filter threshold for clearing (healing) the fault" VALUE 0x70641 TKW_VV_VV_UB 100.0 FORMULA_0003 0.0 255.0000 /end CHARACTERISTIC
/begin CHARACTERISTIC K_ED_LAVK1.OK_SCHWELLE "Filterschwelle fuer Fehleraustrag | EN: Fault code LAVK1 - debounce filter threshold for clearing (healing) the fault" VALUE 0x707FB TKW_VV_VV_UB 100.0 FORMULA_0003 0.0 255.0000 /end CHARACTERISTIC
/begin CHARACTERISTIC K_ED_LANK1.OK_SCHWELLE "Filterschwelle fuer Fehleraustrag | EN: Fault code LANK1 - debounce filter threshold for clearing (healing) the fault" VALUE 0x70897 TKW_VV_VV_UB 100.0 FORMULA_0003 0.0 255.0000 /end CHARACTERISTIC
/begin CHARACTERISTIC K_ED_LANK2.OK_SCHWELLE "Filterschwelle fuer Fehleraustrag | EN: Fault code LANK2 - debounce filter threshold for clearing (healing) the fault" VALUE 0x708B1 TKW_VV_VV_UB 100.0 FORMULA_0003 0.0 255.0000 /end CHARACTERISTIC
/begin CHARACTERISTIC K_ED_FPLAU1.OK_SCHWELLE "Filterschwelle fuer Fehleraustrag | EN: Fault code FPLAU1 - debounce filter threshold for clearing (healing) the fault" VALUE 0x709E9 TKW_VV_VV_UB 100.0 FORMULA_0003 0.0 255.0000 /end CHARACTERISTIC
/begin CHARACTERISTIC K_ED_FPLAU2.OK_SCHWELLE "Filterschwelle fuer Fehleraustrag | EN: Fault code FPLAU2 - debounce filter threshold for clearing (healing) the fault" VALUE 0x70A03 TKW_VV_VV_UB 100.0 FORMULA_0003 0.0 255.0000 /end CHARACTERISTIC
/begin CHARACTERISTIC K_ED_LANK1_OBD_S.OK_SCHWELLE "Filterschwelle fuer Fehleraustrag | EN: Fault code LANK1_OBD_S - debounce filter threshold for clearing (healing) the fault [V912: differs from V452 160E]" VALUE 0x70A37 TKW_VV_VV_UB 100.0 FORMULA_0003 0.0 255.0000 /end CHARACTERISTIC
/begin CHARACTERISTIC K_ED_LANK2_OBD_S.OK_SCHWELLE "Filterschwelle fuer Fehleraustrag | EN: Fault code LANK2_OBD_S - debounce filter threshold for clearing (healing) the fault [V912: differs from V452 160E]" VALUE 0x70A51 TKW_VV_VV_UB 100.0 FORMULA_0003 0.0 255.0000 /end CHARACTERISTIC
/begin CHARACTERISTIC K_ED_LAVK1_DIAG.OK_SCHWELLE "Filterschwelle fuer Fehleraustrag | EN: Fault code LAVK1_DIAG - debounce filter threshold for clearing (healing) the fault" VALUE 0x70BA3 TKW_VV_VV_UB 100.0 FORMULA_0003 0.0 255.0000 /end CHARACTERISTIC
/begin CHARACTERISTIC K_ED_LAM1_REG.OK_SCHWELLE "Filterschwelle fuer Fehleraustrag | EN: Fault code LAM1_REG - debounce filter threshold for clearing (healing) the fault" VALUE 0x70DC5 TKW_VV_VV_UB 100.0 FORMULA_0003 0.0 255.0000 /end CHARACTERISTIC
/begin CHARACTERISTIC K_ED_LAM2_REG.OK_SCHWELLE "Filterschwelle fuer Fehleraustrag | EN: Fault code LAM2_REG - debounce filter threshold for clearing (healing) the fault" VALUE 0x70DDF TKW_VV_VV_UB 100.0 FORMULA_0003 0.0 255.0000 /end CHARACTERISTIC
/begin CHARACTERISTIC K_ED_KAT_OBD1.OK_SCHWELLE "Filterschwelle fuer Fehleraustrag | EN: Fault code KAT_OBD1 - debounce filter threshold for clearing (healing) the fault" VALUE 0x7123D TKW_VV_VV_UB 100.0 FORMULA_0003 0.0 255.0000 /end CHARACTERISTIC
/begin CHARACTERISTIC K_ED_KAT_OBD2.OK_SCHWELLE "Filterschwelle fuer Fehleraustrag | EN: Fault code KAT_OBD2 - debounce filter threshold for clearing (healing) the fault" VALUE 0x71257 TKW_VV_VV_UB 100.0 FORMULA_0003 0.0 255.0000 /end CHARACTERISTIC
/begin CHARACTERISTIC K_ED_FI_GEN.OK_SCHWELLE "Filterschwelle fuer Fehleraustrag | EN: Fault code FI_GEN - debounce filter threshold for clearing (healing) the fault" VALUE 0x7128B TKW_VV_VV_UB 100.0 FORMULA_0003 0.0 255.0000 /end CHARACTERISTIC
/begin CHARACTERISTIC K_ED_FI_BSD.OK_SCHWELLE "Filterschwelle fuer Fehleraustrag | EN: Fault code FI_BSD - debounce filter threshold for clearing (healing) the fault" VALUE 0x712A5 TKW_VV_VV_UB 100.0 FORMULA_0003 0.0 255.0000 /end CHARACTERISTIC
/begin CHARACTERISTIC K_ED_FI_QLT.OK_SCHWELLE "Filterschwelle fuer Fehleraustrag | EN: Fault code FI_QLT - debounce filter threshold for clearing (healing) the fault" VALUE 0x712BF TKW_VV_VV_UB 100.0 FORMULA_0003 0.0 255.0000 /end CHARACTERISTIC
/begin CHARACTERISTIC K_ED_FI_IBS1.OK_SCHWELLE "Filterschwelle fuer Fehleraustrag | EN: Fault code FI_IBS1 - debounce filter threshold for clearing (healing) the fault" VALUE 0x712D9 TKW_VV_VV_UB 100.0 FORMULA_0003 0.0 255.0000 /end CHARACTERISTIC
/begin CHARACTERISTIC K_ED_FI_IBS2.OK_SCHWELLE "Filterschwelle fuer Fehleraustrag | EN: Fault code FI_IBS2 - debounce filter threshold for clearing (healing) the fault" VALUE 0x712F3 TKW_VV_VV_UB 100.0 FORMULA_0003 0.0 255.0000 /end CHARACTERISTIC
/begin CHARACTERISTIC K_ED_FI_IBS3.OK_SCHWELLE "Filterschwelle fuer Fehleraustrag | EN: Fault code FI_IBS3 - debounce filter threshold for clearing (healing) the fault" VALUE 0x7130D TKW_VV_VV_UB 100.0 FORMULA_0003 0.0 255.0000 /end CHARACTERISTIC
/begin CHARACTERISTIC K_ED_FI_PMBN.OK_SCHWELLE "Filterschwelle fuer Fehleraustrag | EN: Fault code FI_PMBN - debounce filter threshold for clearing (healing) the fault" VALUE 0x71327 TKW_VV_VV_UB 100.0 FORMULA_0003 0.0 255.0000 /end CHARACTERISTIC
/begin CHARACTERISTIC K_ED_FI_PMBATT.OK_SCHWELLE "Filterschwelle fuer Fehleraustrag | EN: Fault code FI_PMBATT - debounce filter threshold for clearing (healing) the fault" VALUE 0x71341 TKW_VV_VV_UB 100.0 FORMULA_0003 0.0 255.0000 /end CHARACTERISTIC
/begin CHARACTERISTIC K_ED_FI_BSD_0.OK_SCHWELLE "Filterschwelle fuer Fehleraustrag | EN: Fault code FI_BSD_0 - debounce filter threshold for clearing (healing) the fault" VALUE 0x713F7 TKW_VV_VV_UB 100.0 FORMULA_0003 0.0 255.0000 /end CHARACTERISTIC
/begin CHARACTERISTIC K_ED_FI_BSD_6.OK_SCHWELLE "Filterschwelle fuer Fehleraustrag | EN: Fault code FI_BSD_6 - debounce filter threshold for clearing (healing) the fault" VALUE 0x71411 TKW_VV_VV_UB 100.0 FORMULA_0003 0.0 255.0000 /end CHARACTERISTIC
/begin CHARACTERISTIC K_ED_FI_BSDGLOB.OK_SCHWELLE "Filterschwelle fuer Fehleraustrag | EN: Fault code FI_BSDGLOB - debounce filter threshold for clearing (healing) the fault" VALUE 0x7142B TKW_VV_VV_UB 100.0 FORMULA_0003 0.0 255.0000 /end CHARACTERISTIC
/begin CHARACTERISTIC K_ED_FI_PMRUHVERL.OK_SCHWELLE "Filterschwelle fuer Fehleraustrag | EN: Fault code FI_PMRUHVERL - debounce filter threshold for clearing (healing) the fault" VALUE 0x71445 TKW_VV_VV_UB 100.0 FORMULA_0003 0.0 255.0000 /end CHARACTERISTIC
/begin CHARACTERISTIC K_ED_FI_TOENS.OK_SCHWELLE "Filterschwelle fuer Fehleraustrag | EN: Fault code FI_TOENS - debounce filter threshold for clearing (healing) the fault" VALUE 0x7145F TKW_VV_VV_UB 100.0 FORMULA_0003 0.0 255.0000 /end CHARACTERISTIC
/begin CHARACTERISTIC K_ED_KW.OK_SCHWELLE "Filterschwelle fuer Fehleraustrag | EN: Fault code KW - debounce filter threshold for clearing (healing) the fault" VALUE 0x7157D TKW_VV_VV_UB 100.0 FORMULA_0003 0.0 255.0000 /end CHARACTERISTIC
/begin CHARACTERISTIC K_ED_LA1_ADAPT.OK_SCHWELLE "Filterschwelle fuer Fehleraustrag | EN: Fault code LA1_ADAPT - debounce filter threshold for clearing (healing) the fault" VALUE 0x71597 TKW_VV_VV_UB 100.0 FORMULA_0003 0.0 255.0000 /end CHARACTERISTIC
/begin CHARACTERISTIC K_ED_LA2_ADAPT.OK_SCHWELLE "Filterschwelle fuer Fehleraustrag | EN: Fault code LA2_ADAPT - debounce filter threshold for clearing (healing) the fault" VALUE 0x715B1 TKW_VV_VV_UB 100.0 FORMULA_0003 0.0 255.0000 /end CHARACTERISTIC
/begin CHARACTERISTIC K_ED_KGE1.OK_SCHWELLE "Filterschwelle fuer Fehleraustrag | EN: Fault code KGE1 - debounce filter threshold for clearing (healing) the fault" VALUE 0x715CB TKW_VV_VV_UB 100.0 FORMULA_0003 0.0 255.0000 /end CHARACTERISTIC
/begin CHARACTERISTIC K_ED_KGE2.OK_SCHWELLE "Filterschwelle fuer Fehleraustrag | EN: Fault code KGE2 - debounce filter threshold for clearing (healing) the fault" VALUE 0x715E5 TKW_VV_VV_UB 100.0 FORMULA_0003 0.0 255.0000 /end CHARACTERISTIC
/begin CHARACTERISTIC K_ED_FST.OK_SCHWELLE "Filterschwelle fuer Fehleraustrag | EN: Fault code FST - debounce filter threshold for clearing (healing) the fault" VALUE 0x715FF TKW_VV_VV_UB 100.0 FORMULA_0003 0.0 255.0000 /end CHARACTERISTIC
/begin CHARACTERISTIC K_ED_KSD1.OK_SCHWELLE "Filterschwelle fuer Fehleraustrag | EN: Fault code KSD1 - debounce filter threshold for clearing (healing) the fault" VALUE 0x71737 TKW_VV_VV_UB 100.0 FORMULA_0003 0.0 255.0000 /end CHARACTERISTIC
/begin CHARACTERISTIC K_ED_KSD2.OK_SCHWELLE "Filterschwelle fuer Fehleraustrag | EN: Fault code KSD2 - debounce filter threshold for clearing (healing) the fault" VALUE 0x71751 TKW_VV_VV_UB 100.0 FORMULA_0003 0.0 255.0000 /end CHARACTERISTIC
/begin CHARACTERISTIC K_ED_KATS_B1.OK_SCHWELLE "Filterschwelle fuer Fehleraustrag | EN: Fault code KATS_B1 - debounce filter threshold for clearing (healing) the fault" VALUE 0x7176B TKW_VV_VV_UB 100.0 FORMULA_0003 0.0 255.0000 /end CHARACTERISTIC
/begin CHARACTERISTIC K_ED_KATS_B2.OK_SCHWELLE "Filterschwelle fuer Fehleraustrag | EN: Fault code KATS_B2 - debounce filter threshold for clearing (healing) the fault" VALUE 0x71785 TKW_VV_VV_UB 100.0 FORMULA_0003 0.0 255.0000 /end CHARACTERISTIC
/begin CHARACTERISTIC K_ED_FST_GEBER.OK_SCHWELLE "Filterschwelle fuer Fehleraustrag | EN: Fault code FST_GEBER - debounce filter threshold for clearing (healing) the fault" VALUE 0x717D3 TKW_VV_VV_UB 100.0 FORMULA_0003 0.0 255.0000 /end CHARACTERISTIC
/begin CHARACTERISTIC K_ED_LA1_TRIM_AD.OK_SCHWELLE "Filterschwelle fuer Fehleraustrag | EN: Fault code LA1_TRIM_AD - debounce filter threshold for clearing (healing) the fault" VALUE 0x7186F TKW_VV_VV_UB 100.0 FORMULA_0003 0.0 255.0000 /end CHARACTERISTIC
/begin CHARACTERISTIC K_ED_LA2_TRIM_AD.OK_SCHWELLE "Filterschwelle fuer Fehleraustrag | EN: Fault code LA2_TRIM_AD - debounce filter threshold for clearing (healing) the fault" VALUE 0x71889 TKW_VV_VV_UB 100.0 FORMULA_0003 0.0 255.0000 /end CHARACTERISTIC
/begin CHARACTERISTIC K_ED_LANK1_OPENLOAD.OK_SCHWELLE "Filterschwelle fuer Fehleraustrag | EN: Fault code LANK1_OPENLOAD - debounce filter threshold for clearing (healing) the fault" VALUE 0x718A3 TKW_VV_VV_UB 100.0 FORMULA_0003 0.0 255.0000 /end CHARACTERISTIC
/begin CHARACTERISTIC K_ED_LANK2_OPENLOAD.OK_SCHWELLE "Filterschwelle fuer Fehleraustrag | EN: Fault code LANK2_OPENLOAD - debounce filter threshold for clearing (healing) the fault" VALUE 0x718BD TKW_VV_VV_UB 100.0 FORMULA_0003 0.0 255.0000 /end CHARACTERISTIC
/begin CHARACTERISTIC K_ED_LANK1_OBD_WE.OK_SCHWELLE "Filterschwelle fuer Fehleraustrag | EN: Fault code LANK1_OBD_WE - debounce filter threshold for clearing (healing) the fault" VALUE 0x718D7 TKW_VV_VV_UB 100.0 FORMULA_0003 0.0 255.0000 /end CHARACTERISTIC
/begin CHARACTERISTIC K_ED_LANK2_OBD_WE.OK_SCHWELLE "Filterschwelle fuer Fehleraustrag | EN: Fault code LANK2_OBD_WE - debounce filter threshold for clearing (healing) the fault" VALUE 0x718F1 TKW_VV_VV_UB 100.0 FORMULA_0003 0.0 255.0000 /end CHARACTERISTIC
/begin CHARACTERISTIC K_ED_FST_GEBER_LI.OK_SCHWELLE "Filterschwelle fuer Fehleraustrag" VALUE 0x719F5 TKW_VV_VV_UB 100.0 FORMULA_0003 0.0 255.0000 /end CHARACTERISTIC
/begin CHARACTERISTIC K_ED_FST_GEBER_RE.OK_SCHWELLE "Filterschwelle fuer Fehleraustrag" VALUE 0x71A0F TKW_VV_VV_UB 100.0 FORMULA_0003 0.0 255.0000 /end CHARACTERISTIC
/begin CHARACTERISTIC K_ED_LANK1_OBD_SLOPE.OK_SCHWELLE "Filterschwelle fuer Fehleraustrag" VALUE 0x71A29 TKW_VV_VV_UB 100.0 FORMULA_0003 0.0 255.0000 /end CHARACTERISTIC
/begin CHARACTERISTIC K_ED_LANK2_OBD_SLOPE.OK_SCHWELLE "Filterschwelle fuer Fehleraustrag" VALUE 0x71A43 TKW_VV_VV_UB 100.0 FORMULA_0003 0.0 255.0000 /end CHARACTERISTIC
/begin CHARACTERISTIC K_ED_INDEX_204_INJ.OK_SCHWELLE "Filterschwelle fuer Fehleraustrag | EN: Fault code INDEX_204_INJ - debounce filter threshold for clearing (healing) the fault" VALUE 0x71AAB TKW_VV_VV_UB 100.0 FORMULA_0003 0.0 255.0000 /end CHARACTERISTIC
/begin CHARACTERISTIC K_ED_INDEX_205_INJ.OK_SCHWELLE "Filterschwelle fuer Fehleraustrag | EN: Fault code INDEX_205_INJ - debounce filter threshold for clearing (healing) the fault" VALUE 0x71AC5 TKW_VV_VV_UB 100.0 FORMULA_0003 0.0 255.0000 /end CHARACTERISTIC
/begin CHARACTERISTIC K_ED_INDEX_206_INJ.OK_SCHWELLE "Filterschwelle fuer Fehleraustrag | EN: Fault code INDEX_206_INJ - debounce filter threshold for clearing (healing) the fault" VALUE 0x71ADF TKW_VV_VV_UB 100.0 FORMULA_0003 0.0 255.0000 /end CHARACTERISTIC
/begin CHARACTERISTIC K_ED_INDEX_207_INJ.OK_SCHWELLE "Filterschwelle fuer Fehleraustrag" VALUE 0x71AF9 TKW_VV_VV_UB 100.0 FORMULA_0003 0.0 255.0000 /end CHARACTERISTIC
/begin CHARACTERISTIC K_ED_INDEX_208_INJ.OK_SCHWELLE "Filterschwelle fuer Fehleraustrag" VALUE 0x71B13 TKW_VV_VV_UB 100.0 FORMULA_0003 0.0 255.0000 /end CHARACTERISTIC
/begin CHARACTERISTIC K_ED_INDEX_209_INJ.OK_SCHWELLE "Filterschwelle fuer Fehleraustrag" VALUE 0x71B2D TKW_VV_VV_UB 100.0 FORMULA_0003 0.0 255.0000 /end CHARACTERISTIC
/begin CHARACTERISTIC K_ED_INDEX_210_INJ.OK_SCHWELLE "Filterschwelle fuer Fehleraustrag" VALUE 0x71B47 TKW_VV_VV_UB 100.0 FORMULA_0003 0.0 255.0000 /end CHARACTERISTIC
/begin CHARACTERISTIC K_ED_INDEX_211_INJ.OK_SCHWELLE "Filterschwelle fuer Fehleraustrag | EN: Filterschwelle fuer Fehleraustrag" VALUE 0x71B61 TKW_VV_VV_UB 100.0 FORMULA_0003 0.0 255.0000 /end CHARACTERISTIC
/begin CHARACTERISTIC K_ED_INDEX_212_INJ.OK_SCHWELLE "Filterschwelle fuer Fehleraustrag | EN: Filterschwelle fuer Fehleraustrag" VALUE 0x71B7B TKW_VV_VV_UB 100.0 FORMULA_0003 0.0 255.0000 /end CHARACTERISTIC
/begin CHARACTERISTIC K_ED_INDEX_213_INJ.OK_SCHWELLE "Filterschwelle fuer Fehleraustrag" VALUE 0x71B95 TKW_VV_VV_UB 100.0 FORMULA_0003 0.0 255.0000 /end CHARACTERISTIC
/begin CHARACTERISTIC K_ED_INDEX_214_INJ.OK_SCHWELLE "Filterschwelle fuer Fehleraustrag" VALUE 0x71BAF TKW_VV_VV_UB 100.0 FORMULA_0003 0.0 255.0000 /end CHARACTERISTIC
/begin CHARACTERISTIC K_ED_INDEX_215_INJ.OK_SCHWELLE "Filterschwelle fuer Fehleraustrag" VALUE 0x71BC9 TKW_VV_VV_UB 100.0 FORMULA_0003 0.0 255.0000 /end CHARACTERISTIC
/begin CHARACTERISTIC K_ED_INDEX_216_INJ.OK_SCHWELLE "Filterschwelle fuer Fehleraustrag" VALUE 0x71BE3 TKW_VV_VV_UB 100.0 FORMULA_0003 0.0 255.0000 /end CHARACTERISTIC
/begin CHARACTERISTIC K_ED_INDEX_217_INJ.OK_SCHWELLE "Filterschwelle fuer Fehleraustrag" VALUE 0x71BFD TKW_VV_VV_UB 100.0 FORMULA_0003 0.0 255.0000 /end CHARACTERISTIC
/begin CHARACTERISTIC K_ED_INDEX_218_INJ.OK_SCHWELLE "Filterschwelle fuer Fehleraustrag" VALUE 0x71C17 TKW_VV_VV_UB 100.0 FORMULA_0003 0.0 255.0000 /end CHARACTERISTIC
/begin CHARACTERISTIC K_ED_INDEX_219_INJ.OK_SCHWELLE "Filterschwelle fuer Fehleraustrag" VALUE 0x71C31 TKW_VV_VV_UB 100.0 FORMULA_0003 0.0 255.0000 /end CHARACTERISTIC
/begin CHARACTERISTIC K_ED_INDEX_220_INJ.OK_SCHWELLE "Filterschwelle fuer Fehleraustrag" VALUE 0x71C4B TKW_VV_VV_UB 100.0 FORMULA_0003 0.0 255.0000 /end CHARACTERISTIC
/begin CHARACTERISTIC K_ED_INDEX_221_INJ.OK_SCHWELLE "Filterschwelle fuer Fehleraustrag" VALUE 0x71C65 TKW_VV_VV_UB 100.0 FORMULA_0003 0.0 255.0000 /end CHARACTERISTIC
/begin CHARACTERISTIC K_ED_INDEX_222_INJ.OK_SCHWELLE "Filterschwelle fuer Fehleraustrag" VALUE 0x71C7F TKW_VV_VV_UB 100.0 FORMULA_0003 0.0 255.0000 /end CHARACTERISTIC
/begin CHARACTERISTIC K_ED_INDEX_223_INJ.OK_SCHWELLE "Filterschwelle fuer Fehleraustrag" VALUE 0x71C99 TKW_VV_VV_UB 100.0 FORMULA_0003 0.0 255.0000 /end CHARACTERISTIC
/begin CHARACTERISTIC K_ED_HFM1.INC_VOR_EINTRAG "Filtererhoehung vorm Fehlerspeichereintrag | EN: Fault code HFM1 - debounce filter increment before fault-memory entry" VALUE 0x70628 TKW_VV_VV_UB 100.0 FORMULA_0003 0.0 255.0000 /end CHARACTERISTIC
/begin CHARACTERISTIC K_ED_HFM2.INC_VOR_EINTRAG "Filtererhoehung vorm Fehlerspeichereintrag | EN: Fault code HFM2 - debounce filter increment before fault-memory entry" VALUE 0x70642 TKW_VV_VV_UB 100.0 FORMULA_0003 0.0 255.0000 /end CHARACTERISTIC
/begin CHARACTERISTIC K_ED_LAVK1.INC_VOR_EINTRAG "Filtererhoehung vorm Fehlerspeichereintrag | EN: Fault code LAVK1 - debounce filter increment before fault-memory entry" VALUE 0x707FC TKW_VV_VV_UB 100.0 FORMULA_0003 0.0 255.0000 /end CHARACTERISTIC
/begin CHARACTERISTIC K_ED_LANK1.INC_VOR_EINTRAG "Filtererhoehung vorm Fehlerspeichereintrag | EN: Fault code LANK1 - debounce filter increment before fault-memory entry" VALUE 0x70898 TKW_VV_VV_UB 100.0 FORMULA_0003 0.0 255.0000 /end CHARACTERISTIC
/begin CHARACTERISTIC K_ED_LANK2.INC_VOR_EINTRAG "Filtererhoehung vorm Fehlerspeichereintrag | EN: Fault code LANK2 - debounce filter increment before fault-memory entry" VALUE 0x708B2 TKW_VV_VV_UB 100.0 FORMULA_0003 0.0 255.0000 /end CHARACTERISTIC
/begin CHARACTERISTIC K_ED_FPLAU1.INC_VOR_EINTRAG "Filtererhoehung vorm Fehlerspeichereintrag | EN: Fault code FPLAU1 - debounce filter increment before fault-memory entry" VALUE 0x709EA TKW_VV_VV_UB 100.0 FORMULA_0003 0.0 255.0000 /end CHARACTERISTIC
/begin CHARACTERISTIC K_ED_FPLAU2.INC_VOR_EINTRAG "Filtererhoehung vorm Fehlerspeichereintrag | EN: Fault code FPLAU2 - debounce filter increment before fault-memory entry" VALUE 0x70A04 TKW_VV_VV_UB 100.0 FORMULA_0003 0.0 255.0000 /end CHARACTERISTIC
/begin CHARACTERISTIC K_ED_LANK1_OBD_S.INC_VOR_EINTRAG "Filtererhoehung vorm Fehlerspeichereintrag | EN: Fault code LANK1_OBD_S - debounce filter increment before fault-memory entry" VALUE 0x70A38 TKW_VV_VV_UB 100.0 FORMULA_0003 0.0 255.0000 /end CHARACTERISTIC
/begin CHARACTERISTIC K_ED_LANK2_OBD_S.INC_VOR_EINTRAG "Filtererhoehung vorm Fehlerspeichereintrag | EN: Fault code LANK2_OBD_S - debounce filter increment before fault-memory entry" VALUE 0x70A52 TKW_VV_VV_UB 100.0 FORMULA_0003 0.0 255.0000 /end CHARACTERISTIC
/begin CHARACTERISTIC K_ED_LAVK1_DIAG.INC_VOR_EINTRAG "Filtererhoehung vorm Fehlerspeichereintrag | EN: Fault code LAVK1_DIAG - debounce filter increment before fault-memory entry" VALUE 0x70BA4 TKW_VV_VV_UB 100.0 FORMULA_0003 0.0 255.0000 /end CHARACTERISTIC
/begin CHARACTERISTIC K_ED_LAM1_REG.INC_VOR_EINTRAG "Filtererhoehung vorm Fehlerspeichereintrag | EN: Fault code LAM1_REG - debounce filter increment before fault-memory entry" VALUE 0x70DC6 TKW_VV_VV_UB 100.0 FORMULA_0003 0.0 255.0000 /end CHARACTERISTIC
/begin CHARACTERISTIC K_ED_LAM2_REG.INC_VOR_EINTRAG "Filtererhoehung vorm Fehlerspeichereintrag | EN: Fault code LAM2_REG - debounce filter increment before fault-memory entry" VALUE 0x70DE0 TKW_VV_VV_UB 100.0 FORMULA_0003 0.0 255.0000 /end CHARACTERISTIC
/begin CHARACTERISTIC K_ED_KAT_OBD1.INC_VOR_EINTRAG "Filtererhoehung vorm Fehlerspeichereintrag | EN: Fault code KAT_OBD1 - debounce filter increment before fault-memory entry" VALUE 0x7123E TKW_VV_VV_UB 100.0 FORMULA_0003 0.0 255.0000 /end CHARACTERISTIC
/begin CHARACTERISTIC K_ED_KAT_OBD2.INC_VOR_EINTRAG "Filtererhoehung vorm Fehlerspeichereintrag | EN: Fault code KAT_OBD2 - debounce filter increment before fault-memory entry" VALUE 0x71258 TKW_VV_VV_UB 100.0 FORMULA_0003 0.0 255.0000 /end CHARACTERISTIC
/begin CHARACTERISTIC K_ED_FI_BSD.INC_VOR_EINTRAG "Filtererhoehung vorm Fehlerspeichereintrag | EN: Fault code FI_BSD - debounce filter increment before fault-memory entry" VALUE 0x712A6 TKW_VV_VV_UB 100.0 FORMULA_0003 0.0 255.0000 /end CHARACTERISTIC
/begin CHARACTERISTIC K_ED_FI_QLT.INC_VOR_EINTRAG "Filtererhoehung vorm Fehlerspeichereintrag | EN: Fault code FI_QLT - debounce filter increment before fault-memory entry" VALUE 0x712C0 TKW_VV_VV_UB 100.0 FORMULA_0003 0.0 255.0000 /end CHARACTERISTIC
/begin CHARACTERISTIC K_ED_FI_IBS1.INC_VOR_EINTRAG "Filtererhoehung vorm Fehlerspeichereintrag | EN: Fault code FI_IBS1 - debounce filter increment before fault-memory entry" VALUE 0x712DA TKW_VV_VV_UB 100.0 FORMULA_0003 0.0 255.0000 /end CHARACTERISTIC
/begin CHARACTERISTIC K_ED_FI_IBS2.INC_VOR_EINTRAG "Filtererhoehung vorm Fehlerspeichereintrag | EN: Fault code FI_IBS2 - debounce filter increment before fault-memory entry" VALUE 0x712F4 TKW_VV_VV_UB 100.0 FORMULA_0003 0.0 255.0000 /end CHARACTERISTIC
/begin CHARACTERISTIC K_ED_FI_IBS3.INC_VOR_EINTRAG "Filtererhoehung vorm Fehlerspeichereintrag | EN: Fault code FI_IBS3 - debounce filter increment before fault-memory entry" VALUE 0x7130E TKW_VV_VV_UB 100.0 FORMULA_0003 0.0 255.0000 /end CHARACTERISTIC
/begin CHARACTERISTIC K_ED_FI_PMBN.INC_VOR_EINTRAG "Filtererhoehung vorm Fehlerspeichereintrag | EN: Fault code FI_PMBN - debounce filter increment before fault-memory entry" VALUE 0x71328 TKW_VV_VV_UB 100.0 FORMULA_0003 0.0 255.0000 /end CHARACTERISTIC
/begin CHARACTERISTIC K_ED_FI_PMBATT.INC_VOR_EINTRAG "Filtererhoehung vorm Fehlerspeichereintrag | EN: Fault code FI_PMBATT - debounce filter increment before fault-memory entry" VALUE 0x71342 TKW_VV_VV_UB 100.0 FORMULA_0003 0.0 255.0000 /end CHARACTERISTIC
/begin CHARACTERISTIC K_ED_FI_BSD_0.INC_VOR_EINTRAG "Filtererhoehung vorm Fehlerspeichereintrag | EN: Fault code FI_BSD_0 - debounce filter increment before fault-memory entry" VALUE 0x713F8 TKW_VV_VV_UB 100.0 FORMULA_0003 0.0 255.0000 /end CHARACTERISTIC
/begin CHARACTERISTIC K_ED_FI_BSD_6.INC_VOR_EINTRAG "Filtererhoehung vorm Fehlerspeichereintrag | EN: Fault code FI_BSD_6 - debounce filter increment before fault-memory entry" VALUE 0x71412 TKW_VV_VV_UB 100.0 FORMULA_0003 0.0 255.0000 /end CHARACTERISTIC
/begin CHARACTERISTIC K_ED_FI_BSDGLOB.INC_VOR_EINTRAG "Filtererhoehung vorm Fehlerspeichereintrag | EN: Fault code FI_BSDGLOB - debounce filter increment before fault-memory entry" VALUE 0x7142C TKW_VV_VV_UB 100.0 FORMULA_0003 0.0 255.0000 /end CHARACTERISTIC
/begin CHARACTERISTIC K_ED_FI_PMRUHVERL.INC_VOR_EINTRAG "Filtererhoehung vorm Fehlerspeichereintrag | EN: Fault code FI_PMRUHVERL - debounce filter increment before fault-memory entry" VALUE 0x71446 TKW_VV_VV_UB 100.0 FORMULA_0003 0.0 255.0000 /end CHARACTERISTIC
/begin CHARACTERISTIC K_ED_FI_TOENS.INC_VOR_EINTRAG "Filtererhoehung vorm Fehlerspeichereintrag | EN: Fault code FI_TOENS - debounce filter increment before fault-memory entry" VALUE 0x71460 TKW_VV_VV_UB 100.0 FORMULA_0003 0.0 255.0000 /end CHARACTERISTIC
/begin CHARACTERISTIC K_ED_KW.INC_VOR_EINTRAG "Filtererhoehung vorm Fehlerspeichereintrag | EN: Fault code KW - debounce filter increment before fault-memory entry" VALUE 0x7157E TKW_VV_VV_UB 100.0 FORMULA_0003 0.0 255.0000 /end CHARACTERISTIC
/begin CHARACTERISTIC K_ED_LA1_ADAPT.INC_VOR_EINTRAG "Filtererhoehung vorm Fehlerspeichereintrag | EN: Fault code LA1_ADAPT - debounce filter increment before fault-memory entry" VALUE 0x71598 TKW_VV_VV_UB 100.0 FORMULA_0003 0.0 255.0000 /end CHARACTERISTIC
/begin CHARACTERISTIC K_ED_LA2_ADAPT.INC_VOR_EINTRAG "Filtererhoehung vorm Fehlerspeichereintrag | EN: Fault code LA2_ADAPT - debounce filter increment before fault-memory entry" VALUE 0x715B2 TKW_VV_VV_UB 100.0 FORMULA_0003 0.0 255.0000 /end CHARACTERISTIC
/begin CHARACTERISTIC K_ED_KGE1.INC_VOR_EINTRAG "Filtererhoehung vorm Fehlerspeichereintrag | EN: Fault code KGE1 - debounce filter increment before fault-memory entry" VALUE 0x715CC TKW_VV_VV_UB 100.0 FORMULA_0003 0.0 255.0000 /end CHARACTERISTIC
/begin CHARACTERISTIC K_ED_KGE2.INC_VOR_EINTRAG "Filtererhoehung vorm Fehlerspeichereintrag | EN: Fault code KGE2 - debounce filter increment before fault-memory entry" VALUE 0x715E6 TKW_VV_VV_UB 100.0 FORMULA_0003 0.0 255.0000 /end CHARACTERISTIC
/begin CHARACTERISTIC K_ED_FST.INC_VOR_EINTRAG "Filtererhoehung vorm Fehlerspeichereintrag | EN: Fault code FST - debounce filter increment before fault-memory entry" VALUE 0x71600 TKW_VV_VV_UB 100.0 FORMULA_0003 0.0 255.0000 /end CHARACTERISTIC
/begin CHARACTERISTIC K_ED_KSD1.INC_VOR_EINTRAG "Filtererhoehung vorm Fehlerspeichereintrag | EN: Fault code KSD1 - debounce filter increment before fault-memory entry" VALUE 0x71738 TKW_VV_VV_UB 100.0 FORMULA_0003 0.0 255.0000 /end CHARACTERISTIC
/begin CHARACTERISTIC K_ED_KSD2.INC_VOR_EINTRAG "Filtererhoehung vorm Fehlerspeichereintrag | EN: Fault code KSD2 - debounce filter increment before fault-memory entry" VALUE 0x71752 TKW_VV_VV_UB 100.0 FORMULA_0003 0.0 255.0000 /end CHARACTERISTIC
/begin CHARACTERISTIC K_ED_KATS_B1.INC_VOR_EINTRAG "Filtererhoehung vorm Fehlerspeichereintrag | EN: Fault code KATS_B1 - debounce filter increment before fault-memory entry" VALUE 0x7176C TKW_VV_VV_UB 100.0 FORMULA_0003 0.0 255.0000 /end CHARACTERISTIC
/begin CHARACTERISTIC K_ED_KATS_B2.INC_VOR_EINTRAG "Filtererhoehung vorm Fehlerspeichereintrag | EN: Fault code KATS_B2 - debounce filter increment before fault-memory entry" VALUE 0x71786 TKW_VV_VV_UB 100.0 FORMULA_0003 0.0 255.0000 /end CHARACTERISTIC
/begin CHARACTERISTIC K_ED_FST_GEBER.INC_VOR_EINTRAG "Filtererhoehung vorm Fehlerspeichereintrag | EN: Fault code FST_GEBER - debounce filter increment before fault-memory entry" VALUE 0x717D4 TKW_VV_VV_UB 100.0 FORMULA_0003 0.0 255.0000 /end CHARACTERISTIC
/begin CHARACTERISTIC K_ED_LA1_TRIM_AD.INC_VOR_EINTRAG "Filtererhoehung vorm Fehlerspeichereintrag | EN: Fault code LA1_TRIM_AD - debounce filter increment before fault-memory entry" VALUE 0x71870 TKW_VV_VV_UB 100.0 FORMULA_0003 0.0 255.0000 /end CHARACTERISTIC
/begin CHARACTERISTIC K_ED_LA2_TRIM_AD.INC_VOR_EINTRAG "Filtererhoehung vorm Fehlerspeichereintrag | EN: Fault code LA2_TRIM_AD - debounce filter increment before fault-memory entry" VALUE 0x7188A TKW_VV_VV_UB 100.0 FORMULA_0003 0.0 255.0000 /end CHARACTERISTIC
/begin CHARACTERISTIC K_ED_LANK1_OPENLOAD.INC_VOR_EINTRAG "Filtererhoehung vorm Fehlerspeichereintrag | EN: Fault code LANK1_OPENLOAD - debounce filter increment before fault-memory entry" VALUE 0x718A4 TKW_VV_VV_UB 100.0 FORMULA_0003 0.0 255.0000 /end CHARACTERISTIC
/begin CHARACTERISTIC K_ED_LANK2_OPENLOAD.INC_VOR_EINTRAG "Filtererhoehung vorm Fehlerspeichereintrag | EN: Fault code LANK2_OPENLOAD - debounce filter increment before fault-memory entry" VALUE 0x718BE TKW_VV_VV_UB 100.0 FORMULA_0003 0.0 255.0000 /end CHARACTERISTIC
/begin CHARACTERISTIC K_ED_LANK1_OBD_WE.INC_VOR_EINTRAG "Filtererhoehung vorm Fehlerspeichereintrag | EN: Fault code LANK1_OBD_WE - debounce filter increment before fault-memory entry" VALUE 0x718D8 TKW_VV_VV_UB 100.0 FORMULA_0003 0.0 255.0000 /end CHARACTERISTIC
/begin CHARACTERISTIC K_ED_LANK2_OBD_WE.INC_VOR_EINTRAG "Filtererhoehung vorm Fehlerspeichereintrag | EN: Fault code LANK2_OBD_WE - debounce filter increment before fault-memory entry" VALUE 0x718F2 TKW_VV_VV_UB 100.0 FORMULA_0003 0.0 255.0000 /end CHARACTERISTIC
/begin CHARACTERISTIC K_ED_FST_GEBER_LI.INC_VOR_EINTRAG "Filtererhoehung vorm Fehlerspeichereintrag" VALUE 0x719F6 TKW_VV_VV_UB 100.0 FORMULA_0003 0.0 255.0000 /end CHARACTERISTIC
/begin CHARACTERISTIC K_ED_FST_GEBER_RE.INC_VOR_EINTRAG "Filtererhoehung vorm Fehlerspeichereintrag" VALUE 0x71A10 TKW_VV_VV_UB 100.0 FORMULA_0003 0.0 255.0000 /end CHARACTERISTIC
/begin CHARACTERISTIC K_ED_LANK1_OBD_SLOPE.INC_VOR_EINTRAG "Filtererhoehung vorm Fehlerspeichereintrag" VALUE 0x71A2A TKW_VV_VV_UB 100.0 FORMULA_0003 0.0 255.0000 /end CHARACTERISTIC
/begin CHARACTERISTIC K_ED_LANK2_OBD_SLOPE.INC_VOR_EINTRAG "Filtererhoehung vorm Fehlerspeichereintrag" VALUE 0x71A44 TKW_VV_VV_UB 100.0 FORMULA_0003 0.0 255.0000 /end CHARACTERISTIC
/begin CHARACTERISTIC K_ED_INDEX_204_INJ.INC_VOR_EINTRAG "Filtererhoehung vorm Fehlerspeichereintrag | EN: Fault code INDEX_204_INJ - debounce filter increment before fault-memory entry" VALUE 0x71AAC TKW_VV_VV_UB 100.0 FORMULA_0003 0.0 255.0000 /end CHARACTERISTIC
/begin CHARACTERISTIC K_ED_INDEX_205_INJ.INC_VOR_EINTRAG "Filtererhoehung vorm Fehlerspeichereintrag | EN: Fault code INDEX_205_INJ - debounce filter increment before fault-memory entry" VALUE 0x71AC6 TKW_VV_VV_UB 100.0 FORMULA_0003 0.0 255.0000 /end CHARACTERISTIC
/begin CHARACTERISTIC K_ED_INDEX_206_INJ.INC_VOR_EINTRAG "Filtererhoehung vorm Fehlerspeichereintrag | EN: Fault code INDEX_206_INJ - debounce filter increment before fault-memory entry" VALUE 0x71AE0 TKW_VV_VV_UB 100.0 FORMULA_0003 0.0 255.0000 /end CHARACTERISTIC
/begin CHARACTERISTIC K_ED_INDEX_207_INJ.INC_VOR_EINTRAG "Filtererhoehung vorm Fehlerspeichereintrag" VALUE 0x71AFA TKW_VV_VV_UB 100.0 FORMULA_0003 0.0 255.0000 /end CHARACTERISTIC
/begin CHARACTERISTIC K_ED_INDEX_208_INJ.INC_VOR_EINTRAG "Filtererhoehung vorm Fehlerspeichereintrag" VALUE 0x71B14 TKW_VV_VV_UB 100.0 FORMULA_0003 0.0 255.0000 /end CHARACTERISTIC
/begin CHARACTERISTIC K_ED_INDEX_209_INJ.INC_VOR_EINTRAG "Filtererhoehung vorm Fehlerspeichereintrag" VALUE 0x71B2E TKW_VV_VV_UB 100.0 FORMULA_0003 0.0 255.0000 /end CHARACTERISTIC
/begin CHARACTERISTIC K_ED_INDEX_210_INJ.INC_VOR_EINTRAG "Filtererhoehung vorm Fehlerspeichereintrag" VALUE 0x71B48 TKW_VV_VV_UB 100.0 FORMULA_0003 0.0 255.0000 /end CHARACTERISTIC
/begin CHARACTERISTIC K_ED_INDEX_211_INJ.INC_VOR_EINTRAG "Filtererhoehung vorm Fehlerspeichereintrag | EN: Filtererhoehung vorm Fehlerspeichereintrag" VALUE 0x71B62 TKW_VV_VV_UB 100.0 FORMULA_0003 0.0 255.0000 /end CHARACTERISTIC
/begin CHARACTERISTIC K_ED_INDEX_212_INJ.INC_VOR_EINTRAG "Filtererhoehung vorm Fehlerspeichereintrag | EN: Filtererhoehung vorm Fehlerspeichereintrag" VALUE 0x71B7C TKW_VV_VV_UB 100.0 FORMULA_0003 0.0 255.0000 /end CHARACTERISTIC
/begin CHARACTERISTIC K_ED_INDEX_213_INJ.INC_VOR_EINTRAG "Filtererhoehung vorm Fehlerspeichereintrag" VALUE 0x71B96 TKW_VV_VV_UB 100.0 FORMULA_0003 0.0 255.0000 /end CHARACTERISTIC
/begin CHARACTERISTIC K_ED_INDEX_214_INJ.INC_VOR_EINTRAG "Filtererhoehung vorm Fehlerspeichereintrag" VALUE 0x71BB0 TKW_VV_VV_UB 100.0 FORMULA_0003 0.0 255.0000 /end CHARACTERISTIC
/begin CHARACTERISTIC K_ED_INDEX_215_INJ.INC_VOR_EINTRAG "Filtererhoehung vorm Fehlerspeichereintrag" VALUE 0x71BCA TKW_VV_VV_UB 100.0 FORMULA_0003 0.0 255.0000 /end CHARACTERISTIC
/begin CHARACTERISTIC K_ED_INDEX_216_INJ.INC_VOR_EINTRAG "Filtererhoehung vorm Fehlerspeichereintrag" VALUE 0x71BE4 TKW_VV_VV_UB 100.0 FORMULA_0003 0.0 255.0000 /end CHARACTERISTIC
/begin CHARACTERISTIC K_ED_INDEX_217_INJ.INC_VOR_EINTRAG "Filtererhoehung vorm Fehlerspeichereintrag" VALUE 0x71BFE TKW_VV_VV_UB 100.0 FORMULA_0003 0.0 255.0000 /end CHARACTERISTIC
/begin CHARACTERISTIC K_ED_INDEX_218_INJ.INC_VOR_EINTRAG "Filtererhoehung vorm Fehlerspeichereintrag" VALUE 0x71C18 TKW_VV_VV_UB 100.0 FORMULA_0003 0.0 255.0000 /end CHARACTERISTIC
/begin CHARACTERISTIC K_ED_INDEX_219_INJ.INC_VOR_EINTRAG "Filtererhoehung vorm Fehlerspeichereintrag" VALUE 0x71C32 TKW_VV_VV_UB 100.0 FORMULA_0003 0.0 255.0000 /end CHARACTERISTIC
/begin CHARACTERISTIC K_ED_INDEX_220_INJ.INC_VOR_EINTRAG "Filtererhoehung vorm Fehlerspeichereintrag" VALUE 0x71C4C TKW_VV_VV_UB 100.0 FORMULA_0003 0.0 255.0000 /end CHARACTERISTIC
/begin CHARACTERISTIC K_ED_INDEX_221_INJ.INC_VOR_EINTRAG "Filtererhoehung vorm Fehlerspeichereintrag" VALUE 0x71C66 TKW_VV_VV_UB 100.0 FORMULA_0003 0.0 255.0000 /end CHARACTERISTIC
/begin CHARACTERISTIC K_ED_INDEX_222_INJ.INC_VOR_EINTRAG "Filtererhoehung vorm Fehlerspeichereintrag" VALUE 0x71C80 TKW_VV_VV_UB 100.0 FORMULA_0003 0.0 255.0000 /end CHARACTERISTIC
/begin CHARACTERISTIC K_ED_INDEX_223_INJ.INC_VOR_EINTRAG "Filtererhoehung vorm Fehlerspeichereintrag" VALUE 0x71C9A TKW_VV_VV_UB 100.0 FORMULA_0003 0.0 255.0000 /end CHARACTERISTIC
/begin CHARACTERISTIC K_ED_HFM1.DEC_VOR_EINTRAG "Filterverringerung vorm Fehlerspeichereintrag | EN: Fault code HFM1 - debounce filter decrement before fault-memory entry" VALUE 0x70629 TKW_VV_VV_UB 100.0 FORMULA_0003 0.0 255.0000 /end CHARACTERISTIC
/begin CHARACTERISTIC K_ED_HFM2.DEC_VOR_EINTRAG "Filterverringerung vorm Fehlerspeichereintrag | EN: Fault code HFM2 - debounce filter decrement before fault-memory entry" VALUE 0x70643 TKW_VV_VV_UB 100.0 FORMULA_0003 0.0 255.0000 /end CHARACTERISTIC
/begin CHARACTERISTIC K_ED_LAVK1.DEC_VOR_EINTRAG "Filterverringerung vorm Fehlerspeichereintrag | EN: Fault code LAVK1 - debounce filter decrement before fault-memory entry" VALUE 0x707FD TKW_VV_VV_UB 100.0 FORMULA_0003 0.0 255.0000 /end CHARACTERISTIC
/begin CHARACTERISTIC K_ED_LANK1.DEC_VOR_EINTRAG "Filterverringerung vorm Fehlerspeichereintrag | EN: Fault code LANK1 - debounce filter decrement before fault-memory entry" VALUE 0x70899 TKW_VV_VV_UB 100.0 FORMULA_0003 0.0 255.0000 /end CHARACTERISTIC
/begin CHARACTERISTIC K_ED_LANK2.DEC_VOR_EINTRAG "Filterverringerung vorm Fehlerspeichereintrag | EN: Fault code LANK2 - debounce filter decrement before fault-memory entry" VALUE 0x708B3 TKW_VV_VV_UB 100.0 FORMULA_0003 0.0 255.0000 /end CHARACTERISTIC
/begin CHARACTERISTIC K_ED_FPLAU1.DEC_VOR_EINTRAG "Filterverringerung vorm Fehlerspeichereintrag | EN: Fault code FPLAU1 - debounce filter decrement before fault-memory entry" VALUE 0x709EB TKW_VV_VV_UB 100.0 FORMULA_0003 0.0 255.0000 /end CHARACTERISTIC
/begin CHARACTERISTIC K_ED_FPLAU2.DEC_VOR_EINTRAG "Filterverringerung vorm Fehlerspeichereintrag | EN: Fault code FPLAU2 - debounce filter decrement before fault-memory entry" VALUE 0x70A05 TKW_VV_VV_UB 100.0 FORMULA_0003 0.0 255.0000 /end CHARACTERISTIC
/begin CHARACTERISTIC K_ED_LANK1_OBD_S.DEC_VOR_EINTRAG "Filterverringerung vorm Fehlerspeichereintrag | EN: Fault code LANK1_OBD_S - debounce filter decrement before fault-memory entry" VALUE 0x70A39 TKW_VV_VV_UB 100.0 FORMULA_0003 0.0 255.0000 /end CHARACTERISTIC
/begin CHARACTERISTIC K_ED_LANK2_OBD_S.DEC_VOR_EINTRAG "Filterverringerung vorm Fehlerspeichereintrag | EN: Fault code LANK2_OBD_S - debounce filter decrement before fault-memory entry" VALUE 0x70A53 TKW_VV_VV_UB 100.0 FORMULA_0003 0.0 255.0000 /end CHARACTERISTIC
/begin CHARACTERISTIC K_ED_LAVK1_DIAG.DEC_VOR_EINTRAG "Filterverringerung vorm Fehlerspeichereintrag | EN: Fault code LAVK1_DIAG - debounce filter decrement before fault-memory entry" VALUE 0x70BA5 TKW_VV_VV_UB 100.0 FORMULA_0003 0.0 255.0000 /end CHARACTERISTIC
/begin CHARACTERISTIC K_ED_LAM1_REG.DEC_VOR_EINTRAG "Filterverringerung vorm Fehlerspeichereintrag | EN: Fault code LAM1_REG - debounce filter decrement before fault-memory entry" VALUE 0x70DC7 TKW_VV_VV_UB 100.0 FORMULA_0003 0.0 255.0000 /end CHARACTERISTIC
/begin CHARACTERISTIC K_ED_LAM2_REG.DEC_VOR_EINTRAG "Filterverringerung vorm Fehlerspeichereintrag | EN: Fault code LAM2_REG - debounce filter decrement before fault-memory entry" VALUE 0x70DE1 TKW_VV_VV_UB 100.0 FORMULA_0003 0.0 255.0000 /end CHARACTERISTIC
/begin CHARACTERISTIC K_ED_KAT_OBD1.DEC_VOR_EINTRAG "Filterverringerung vorm Fehlerspeichereintrag | EN: Fault code KAT_OBD1 - debounce filter decrement before fault-memory entry" VALUE 0x7123F TKW_VV_VV_UB 100.0 FORMULA_0003 0.0 255.0000 /end CHARACTERISTIC
/begin CHARACTERISTIC K_ED_KAT_OBD2.DEC_VOR_EINTRAG "Filterverringerung vorm Fehlerspeichereintrag | EN: Fault code KAT_OBD2 - debounce filter decrement before fault-memory entry" VALUE 0x71259 TKW_VV_VV_UB 100.0 FORMULA_0003 0.0 255.0000 /end CHARACTERISTIC
/begin CHARACTERISTIC K_ED_FI_GEN.DEC_VOR_EINTRAG "Filterverringerung vorm Fehlerspeichereintrag | EN: Fault code FI_GEN - debounce filter decrement before fault-memory entry" VALUE 0x7128D TKW_VV_VV_UB 100.0 FORMULA_0003 0.0 255.0000 /end CHARACTERISTIC
/begin CHARACTERISTIC K_ED_FI_BSD.DEC_VOR_EINTRAG "Filterverringerung vorm Fehlerspeichereintrag | EN: Fault code FI_BSD - debounce filter decrement before fault-memory entry" VALUE 0x712A7 TKW_VV_VV_UB 100.0 FORMULA_0003 0.0 255.0000 /end CHARACTERISTIC
/begin CHARACTERISTIC K_ED_FI_QLT.DEC_VOR_EINTRAG "Filterverringerung vorm Fehlerspeichereintrag | EN: Fault code FI_QLT - debounce filter decrement before fault-memory entry" VALUE 0x712C1 TKW_VV_VV_UB 100.0 FORMULA_0003 0.0 255.0000 /end CHARACTERISTIC
/begin CHARACTERISTIC K_ED_FI_IBS1.DEC_VOR_EINTRAG "Filterverringerung vorm Fehlerspeichereintrag | EN: Fault code FI_IBS1 - debounce filter decrement before fault-memory entry" VALUE 0x712DB TKW_VV_VV_UB 100.0 FORMULA_0003 0.0 255.0000 /end CHARACTERISTIC
/begin CHARACTERISTIC K_ED_FI_IBS2.DEC_VOR_EINTRAG "Filterverringerung vorm Fehlerspeichereintrag | EN: Fault code FI_IBS2 - debounce filter decrement before fault-memory entry" VALUE 0x712F5 TKW_VV_VV_UB 100.0 FORMULA_0003 0.0 255.0000 /end CHARACTERISTIC
/begin CHARACTERISTIC K_ED_FI_IBS3.DEC_VOR_EINTRAG "Filterverringerung vorm Fehlerspeichereintrag | EN: Fault code FI_IBS3 - debounce filter decrement before fault-memory entry" VALUE 0x7130F TKW_VV_VV_UB 100.0 FORMULA_0003 0.0 255.0000 /end CHARACTERISTIC
/begin CHARACTERISTIC K_ED_FI_PMBN.DEC_VOR_EINTRAG "Filterverringerung vorm Fehlerspeichereintrag | EN: Fault code FI_PMBN - debounce filter decrement before fault-memory entry" VALUE 0x71329 TKW_VV_VV_UB 100.0 FORMULA_0003 0.0 255.0000 /end CHARACTERISTIC
/begin CHARACTERISTIC K_ED_FI_PMBATT.DEC_VOR_EINTRAG "Filterverringerung vorm Fehlerspeichereintrag | EN: Fault code FI_PMBATT - debounce filter decrement before fault-memory entry" VALUE 0x71343 TKW_VV_VV_UB 100.0 FORMULA_0003 0.0 255.0000 /end CHARACTERISTIC
/begin CHARACTERISTIC K_ED_FI_BSD_0.DEC_VOR_EINTRAG "Filterverringerung vorm Fehlerspeichereintrag | EN: Fault code FI_BSD_0 - debounce filter decrement before fault-memory entry" VALUE 0x713F9 TKW_VV_VV_UB 100.0 FORMULA_0003 0.0 255.0000 /end CHARACTERISTIC
/begin CHARACTERISTIC K_ED_FI_BSD_6.DEC_VOR_EINTRAG "Filterverringerung vorm Fehlerspeichereintrag | EN: Fault code FI_BSD_6 - debounce filter decrement before fault-memory entry" VALUE 0x71413 TKW_VV_VV_UB 100.0 FORMULA_0003 0.0 255.0000 /end CHARACTERISTIC
/begin CHARACTERISTIC K_ED_FI_BSDGLOB.DEC_VOR_EINTRAG "Filterverringerung vorm Fehlerspeichereintrag | EN: Fault code FI_BSDGLOB - debounce filter decrement before fault-memory entry" VALUE 0x7142D TKW_VV_VV_UB 100.0 FORMULA_0003 0.0 255.0000 /end CHARACTERISTIC
/begin CHARACTERISTIC K_ED_FI_PMRUHVERL.DEC_VOR_EINTRAG "Filterverringerung vorm Fehlerspeichereintrag | EN: Fault code FI_PMRUHVERL - debounce filter decrement before fault-memory entry" VALUE 0x71447 TKW_VV_VV_UB 100.0 FORMULA_0003 0.0 255.0000 /end CHARACTERISTIC
/begin CHARACTERISTIC K_ED_FI_TOENS.DEC_VOR_EINTRAG "Filterverringerung vorm Fehlerspeichereintrag | EN: Fault code FI_TOENS - debounce filter decrement before fault-memory entry" VALUE 0x71461 TKW_VV_VV_UB 100.0 FORMULA_0003 0.0 255.0000 /end CHARACTERISTIC
/begin CHARACTERISTIC K_ED_KW.DEC_VOR_EINTRAG "Filterverringerung vorm Fehlerspeichereintrag | EN: Fault code KW - debounce filter decrement before fault-memory entry" VALUE 0x7157F TKW_VV_VV_UB 100.0 FORMULA_0003 0.0 255.0000 /end CHARACTERISTIC
/begin CHARACTERISTIC K_ED_LA1_ADAPT.DEC_VOR_EINTRAG "Filterverringerung vorm Fehlerspeichereintrag | EN: Fault code LA1_ADAPT - debounce filter decrement before fault-memory entry" VALUE 0x71599 TKW_VV_VV_UB 100.0 FORMULA_0003 0.0 255.0000 /end CHARACTERISTIC
/begin CHARACTERISTIC K_ED_LA2_ADAPT.DEC_VOR_EINTRAG "Filterverringerung vorm Fehlerspeichereintrag | EN: Fault code LA2_ADAPT - debounce filter decrement before fault-memory entry" VALUE 0x715B3 TKW_VV_VV_UB 100.0 FORMULA_0003 0.0 255.0000 /end CHARACTERISTIC
/begin CHARACTERISTIC K_ED_KGE1.DEC_VOR_EINTRAG "Filterverringerung vorm Fehlerspeichereintrag | EN: Fault code KGE1 - debounce filter decrement before fault-memory entry" VALUE 0x715CD TKW_VV_VV_UB 100.0 FORMULA_0003 0.0 255.0000 /end CHARACTERISTIC
/begin CHARACTERISTIC K_ED_KGE2.DEC_VOR_EINTRAG "Filterverringerung vorm Fehlerspeichereintrag | EN: Fault code KGE2 - debounce filter decrement before fault-memory entry" VALUE 0x715E7 TKW_VV_VV_UB 100.0 FORMULA_0003 0.0 255.0000 /end CHARACTERISTIC
/begin CHARACTERISTIC K_ED_FST.DEC_VOR_EINTRAG "Filterverringerung vorm Fehlerspeichereintrag | EN: Fault code FST - debounce filter decrement before fault-memory entry" VALUE 0x71601 TKW_VV_VV_UB 100.0 FORMULA_0003 0.0 255.0000 /end CHARACTERISTIC
/begin CHARACTERISTIC K_ED_KSD1.DEC_VOR_EINTRAG "Filterverringerung vorm Fehlerspeichereintrag | EN: Fault code KSD1 - debounce filter decrement before fault-memory entry" VALUE 0x71739 TKW_VV_VV_UB 100.0 FORMULA_0003 0.0 255.0000 /end CHARACTERISTIC
/begin CHARACTERISTIC K_ED_KSD2.DEC_VOR_EINTRAG "Filterverringerung vorm Fehlerspeichereintrag | EN: Fault code KSD2 - debounce filter decrement before fault-memory entry" VALUE 0x71753 TKW_VV_VV_UB 100.0 FORMULA_0003 0.0 255.0000 /end CHARACTERISTIC
/begin CHARACTERISTIC K_ED_KATS_B1.DEC_VOR_EINTRAG "Filterverringerung vorm Fehlerspeichereintrag | EN: Fault code KATS_B1 - debounce filter decrement before fault-memory entry" VALUE 0x7176D TKW_VV_VV_UB 100.0 FORMULA_0003 0.0 255.0000 /end CHARACTERISTIC
/begin CHARACTERISTIC K_ED_KATS_B2.DEC_VOR_EINTRAG "Filterverringerung vorm Fehlerspeichereintrag | EN: Fault code KATS_B2 - debounce filter decrement before fault-memory entry" VALUE 0x71787 TKW_VV_VV_UB 100.0 FORMULA_0003 0.0 255.0000 /end CHARACTERISTIC
/begin CHARACTERISTIC K_ED_FST_GEBER.DEC_VOR_EINTRAG "Filterverringerung vorm Fehlerspeichereintrag | EN: Fault code FST_GEBER - debounce filter decrement before fault-memory entry" VALUE 0x717D5 TKW_VV_VV_UB 100.0 FORMULA_0003 0.0 255.0000 /end CHARACTERISTIC
/begin CHARACTERISTIC K_ED_LA1_TRIM_AD.DEC_VOR_EINTRAG "Filterverringerung vorm Fehlerspeichereintrag | EN: Fault code LA1_TRIM_AD - debounce filter decrement before fault-memory entry" VALUE 0x71871 TKW_VV_VV_UB 100.0 FORMULA_0003 0.0 255.0000 /end CHARACTERISTIC
/begin CHARACTERISTIC K_ED_LA2_TRIM_AD.DEC_VOR_EINTRAG "Filterverringerung vorm Fehlerspeichereintrag | EN: Fault code LA2_TRIM_AD - debounce filter decrement before fault-memory entry" VALUE 0x7188B TKW_VV_VV_UB 100.0 FORMULA_0003 0.0 255.0000 /end CHARACTERISTIC
/begin CHARACTERISTIC K_ED_LANK1_OPENLOAD.DEC_VOR_EINTRAG "Filterverringerung vorm Fehlerspeichereintrag | EN: Fault code LANK1_OPENLOAD - debounce filter decrement before fault-memory entry" VALUE 0x718A5 TKW_VV_VV_UB 100.0 FORMULA_0003 0.0 255.0000 /end CHARACTERISTIC
/begin CHARACTERISTIC K_ED_LANK2_OPENLOAD.DEC_VOR_EINTRAG "Filterverringerung vorm Fehlerspeichereintrag | EN: Fault code LANK2_OPENLOAD - debounce filter decrement before fault-memory entry" VALUE 0x718BF TKW_VV_VV_UB 100.0 FORMULA_0003 0.0 255.0000 /end CHARACTERISTIC
/begin CHARACTERISTIC K_ED_LANK1_OBD_WE.DEC_VOR_EINTRAG "Filterverringerung vorm Fehlerspeichereintrag | EN: Fault code LANK1_OBD_WE - debounce filter decrement before fault-memory entry" VALUE 0x718D9 TKW_VV_VV_UB 100.0 FORMULA_0003 0.0 255.0000 /end CHARACTERISTIC
/begin CHARACTERISTIC K_ED_LANK2_OBD_WE.DEC_VOR_EINTRAG "Filterverringerung vorm Fehlerspeichereintrag | EN: Fault code LANK2_OBD_WE - debounce filter decrement before fault-memory entry" VALUE 0x718F3 TKW_VV_VV_UB 100.0 FORMULA_0003 0.0 255.0000 /end CHARACTERISTIC
/begin CHARACTERISTIC K_ED_FST_GEBER_LI.DEC_VOR_EINTRAG "Filterverringerung vorm Fehlerspeichereintrag" VALUE 0x719F7 TKW_VV_VV_UB 100.0 FORMULA_0003 0.0 255.0000 /end CHARACTERISTIC
/begin CHARACTERISTIC K_ED_FST_GEBER_RE.DEC_VOR_EINTRAG "Filterverringerung vorm Fehlerspeichereintrag" VALUE 0x71A11 TKW_VV_VV_UB 100.0 FORMULA_0003 0.0 255.0000 /end CHARACTERISTIC
/begin CHARACTERISTIC K_ED_LANK1_OBD_SLOPE.DEC_VOR_EINTRAG "Filterverringerung vorm Fehlerspeichereintrag" VALUE 0x71A2B TKW_VV_VV_UB 100.0 FORMULA_0003 0.0 255.0000 /end CHARACTERISTIC
/begin CHARACTERISTIC K_ED_LANK2_OBD_SLOPE.DEC_VOR_EINTRAG "Filterverringerung vorm Fehlerspeichereintrag" VALUE 0x71A45 TKW_VV_VV_UB 100.0 FORMULA_0003 0.0 255.0000 /end CHARACTERISTIC
/begin CHARACTERISTIC K_ED_INDEX_204_INJ.DEC_VOR_EINTRAG "Filterverringerung vorm Fehlerspeichereintrag | EN: Fault code INDEX_204_INJ - debounce filter decrement before fault-memory entry" VALUE 0x71AAD TKW_VV_VV_UB 100.0 FORMULA_0003 0.0 255.0000 /end CHARACTERISTIC
/begin CHARACTERISTIC K_ED_INDEX_205_INJ.DEC_VOR_EINTRAG "Filterverringerung vorm Fehlerspeichereintrag | EN: Fault code INDEX_205_INJ - debounce filter decrement before fault-memory entry" VALUE 0x71AC7 TKW_VV_VV_UB 100.0 FORMULA_0003 0.0 255.0000 /end CHARACTERISTIC
/begin CHARACTERISTIC K_ED_INDEX_206_INJ.DEC_VOR_EINTRAG "Filterverringerung vorm Fehlerspeichereintrag | EN: Fault code INDEX_206_INJ - debounce filter decrement before fault-memory entry" VALUE 0x71AE1 TKW_VV_VV_UB 100.0 FORMULA_0003 0.0 255.0000 /end CHARACTERISTIC
/begin CHARACTERISTIC K_ED_INDEX_207_INJ.DEC_VOR_EINTRAG "Filterverringerung vorm Fehlerspeichereintrag" VALUE 0x71AFB TKW_VV_VV_UB 100.0 FORMULA_0003 0.0 255.0000 /end CHARACTERISTIC
/begin CHARACTERISTIC K_ED_INDEX_208_INJ.DEC_VOR_EINTRAG "Filterverringerung vorm Fehlerspeichereintrag" VALUE 0x71B15 TKW_VV_VV_UB 100.0 FORMULA_0003 0.0 255.0000 /end CHARACTERISTIC
/begin CHARACTERISTIC K_ED_INDEX_209_INJ.DEC_VOR_EINTRAG "Filterverringerung vorm Fehlerspeichereintrag" VALUE 0x71B2F TKW_VV_VV_UB 100.0 FORMULA_0003 0.0 255.0000 /end CHARACTERISTIC
/begin CHARACTERISTIC K_ED_INDEX_210_INJ.DEC_VOR_EINTRAG "Filterverringerung vorm Fehlerspeichereintrag" VALUE 0x71B49 TKW_VV_VV_UB 100.0 FORMULA_0003 0.0 255.0000 /end CHARACTERISTIC
/begin CHARACTERISTIC K_ED_INDEX_211_INJ.DEC_VOR_EINTRAG "Filterverringerung vorm Fehlerspeichereintrag | EN: Filterverringerung vorm Fehlerspeichereintrag" VALUE 0x71B63 TKW_VV_VV_UB 100.0 FORMULA_0003 0.0 255.0000 /end CHARACTERISTIC
/begin CHARACTERISTIC K_ED_INDEX_212_INJ.DEC_VOR_EINTRAG "Filterverringerung vorm Fehlerspeichereintrag" VALUE 0x71B7D TKW_VV_VV_UB 100.0 FORMULA_0003 0.0 255.0000 /end CHARACTERISTIC
/begin CHARACTERISTIC K_ED_INDEX_213_INJ.DEC_VOR_EINTRAG "Filterverringerung vorm Fehlerspeichereintrag" VALUE 0x71B97 TKW_VV_VV_UB 100.0 FORMULA_0003 0.0 255.0000 /end CHARACTERISTIC
/begin CHARACTERISTIC K_ED_INDEX_214_INJ.DEC_VOR_EINTRAG "Filterverringerung vorm Fehlerspeichereintrag" VALUE 0x71BB1 TKW_VV_VV_UB 100.0 FORMULA_0003 0.0 255.0000 /end CHARACTERISTIC
/begin CHARACTERISTIC K_ED_INDEX_215_INJ.DEC_VOR_EINTRAG "Filterverringerung vorm Fehlerspeichereintrag" VALUE 0x71BCB TKW_VV_VV_UB 100.0 FORMULA_0003 0.0 255.0000 /end CHARACTERISTIC
/begin CHARACTERISTIC K_ED_INDEX_216_INJ.DEC_VOR_EINTRAG "Filterverringerung vorm Fehlerspeichereintrag" VALUE 0x71BE5 TKW_VV_VV_UB 100.0 FORMULA_0003 0.0 255.0000 /end CHARACTERISTIC
/begin CHARACTERISTIC K_ED_INDEX_217_INJ.DEC_VOR_EINTRAG "Filterverringerung vorm Fehlerspeichereintrag" VALUE 0x71BFF TKW_VV_VV_UB 100.0 FORMULA_0003 0.0 255.0000 /end CHARACTERISTIC
/begin CHARACTERISTIC K_ED_INDEX_218_INJ.DEC_VOR_EINTRAG "Filterverringerung vorm Fehlerspeichereintrag" VALUE 0x71C19 TKW_VV_VV_UB 100.0 FORMULA_0003 0.0 255.0000 /end CHARACTERISTIC
/begin CHARACTERISTIC K_ED_INDEX_219_INJ.DEC_VOR_EINTRAG "Filterverringerung vorm Fehlerspeichereintrag" VALUE 0x71C33 TKW_VV_VV_UB 100.0 FORMULA_0003 0.0 255.0000 /end CHARACTERISTIC
/begin CHARACTERISTIC K_ED_INDEX_220_INJ.DEC_VOR_EINTRAG "Filterverringerung vorm Fehlerspeichereintrag" VALUE 0x71C4D TKW_VV_VV_UB 100.0 FORMULA_0003 0.0 255.0000 /end CHARACTERISTIC
/begin CHARACTERISTIC K_ED_INDEX_221_INJ.DEC_VOR_EINTRAG "Filterverringerung vorm Fehlerspeichereintrag" VALUE 0x71C67 TKW_VV_VV_UB 100.0 FORMULA_0003 0.0 255.0000 /end CHARACTERISTIC
/begin CHARACTERISTIC K_ED_INDEX_222_INJ.DEC_VOR_EINTRAG "Filterverringerung vorm Fehlerspeichereintrag" VALUE 0x71C81 TKW_VV_VV_UB 100.0 FORMULA_0003 0.0 255.0000 /end CHARACTERISTIC
/begin CHARACTERISTIC K_ED_INDEX_223_INJ.DEC_VOR_EINTRAG "Filterverringerung vorm Fehlerspeichereintrag" VALUE 0x71C9B TKW_VV_VV_UB 100.0 FORMULA_0003 0.0 255.0000 /end CHARACTERISTIC
/begin CHARACTERISTIC K_ED_HFM1.INC_NACH_EINTRAG "Filtererhoehung nach Fehlerspeichereintrag | EN: Fault code HFM1 - debounce filter increment after fault-memory entry" VALUE 0x7062A TKW_VV_VV_UB 100.0 FORMULA_0003 0.0 255.0000 /end CHARACTERISTIC
/begin CHARACTERISTIC K_ED_HFM2.INC_NACH_EINTRAG "Filtererhoehung nach Fehlerspeichereintrag | EN: Fault code HFM2 - debounce filter increment after fault-memory entry" VALUE 0x70644 TKW_VV_VV_UB 100.0 FORMULA_0003 0.0 255.0000 /end CHARACTERISTIC
/begin CHARACTERISTIC K_ED_LAVK1.INC_NACH_EINTRAG "Filtererhoehung nach Fehlerspeichereintrag | EN: Fault code LAVK1 - debounce filter increment after fault-memory entry" VALUE 0x707FE TKW_VV_VV_UB 100.0 FORMULA_0003 0.0 255.0000 /end CHARACTERISTIC
/begin CHARACTERISTIC K_ED_LANK1.INC_NACH_EINTRAG "Filtererhoehung nach Fehlerspeichereintrag | EN: Fault code LANK1 - debounce filter increment after fault-memory entry" VALUE 0x7089A TKW_VV_VV_UB 100.0 FORMULA_0003 0.0 255.0000 /end CHARACTERISTIC
/begin CHARACTERISTIC K_ED_LANK2.INC_NACH_EINTRAG "Filtererhoehung nach Fehlerspeichereintrag | EN: Fault code LANK2 - debounce filter increment after fault-memory entry" VALUE 0x708B4 TKW_VV_VV_UB 100.0 FORMULA_0003 0.0 255.0000 /end CHARACTERISTIC
/begin CHARACTERISTIC K_ED_FPLAU1.INC_NACH_EINTRAG "Filtererhoehung nach Fehlerspeichereintrag | EN: Fault code FPLAU1 - debounce filter increment after fault-memory entry" VALUE 0x709EC TKW_VV_VV_UB 100.0 FORMULA_0003 0.0 255.0000 /end CHARACTERISTIC
/begin CHARACTERISTIC K_ED_FPLAU2.INC_NACH_EINTRAG "Filtererhoehung nach Fehlerspeichereintrag | EN: Fault code FPLAU2 - debounce filter increment after fault-memory entry" VALUE 0x70A06 TKW_VV_VV_UB 100.0 FORMULA_0003 0.0 255.0000 /end CHARACTERISTIC
/begin CHARACTERISTIC K_ED_LANK1_OBD_S.INC_NACH_EINTRAG "Filtererhoehung nach Fehlerspeichereintrag | EN: Fault code LANK1_OBD_S - debounce filter increment after fault-memory entry" VALUE 0x70A3A TKW_VV_VV_UB 100.0 FORMULA_0003 0.0 255.0000 /end CHARACTERISTIC
/begin CHARACTERISTIC K_ED_LANK2_OBD_S.INC_NACH_EINTRAG "Filtererhoehung nach Fehlerspeichereintrag | EN: Fault code LANK2_OBD_S - debounce filter increment after fault-memory entry" VALUE 0x70A54 TKW_VV_VV_UB 100.0 FORMULA_0003 0.0 255.0000 /end CHARACTERISTIC
/begin CHARACTERISTIC K_ED_LAVK1_DIAG.INC_NACH_EINTRAG "Filtererhoehung nach Fehlerspeichereintrag | EN: Fault code LAVK1_DIAG - debounce filter increment after fault-memory entry" VALUE 0x70BA6 TKW_VV_VV_UB 100.0 FORMULA_0003 0.0 255.0000 /end CHARACTERISTIC
/begin CHARACTERISTIC K_ED_LAM1_REG.INC_NACH_EINTRAG "Filtererhoehung nach Fehlerspeichereintrag | EN: Fault code LAM1_REG - debounce filter increment after fault-memory entry" VALUE 0x70DC8 TKW_VV_VV_UB 100.0 FORMULA_0003 0.0 255.0000 /end CHARACTERISTIC
/begin CHARACTERISTIC K_ED_LAM2_REG.INC_NACH_EINTRAG "Filtererhoehung nach Fehlerspeichereintrag | EN: Fault code LAM2_REG - debounce filter increment after fault-memory entry" VALUE 0x70DE2 TKW_VV_VV_UB 100.0 FORMULA_0003 0.0 255.0000 /end CHARACTERISTIC
/begin CHARACTERISTIC K_ED_KAT_OBD1.INC_NACH_EINTRAG "Filtererhoehung nach Fehlerspeichereintrag | EN: Fault code KAT_OBD1 - debounce filter increment after fault-memory entry" VALUE 0x71240 TKW_VV_VV_UB 100.0 FORMULA_0003 0.0 255.0000 /end CHARACTERISTIC
/begin CHARACTERISTIC K_ED_KAT_OBD2.INC_NACH_EINTRAG "Filtererhoehung nach Fehlerspeichereintrag | EN: Fault code KAT_OBD2 - debounce filter increment after fault-memory entry" VALUE 0x7125A TKW_VV_VV_UB 100.0 FORMULA_0003 0.0 255.0000 /end CHARACTERISTIC
/begin CHARACTERISTIC K_ED_FI_GEN.INC_NACH_EINTRAG "Filtererhoehung nach Fehlerspeichereintrag | EN: Fault code FI_GEN - debounce filter increment after fault-memory entry" VALUE 0x7128E TKW_VV_VV_UB 100.0 FORMULA_0003 0.0 255.0000 /end CHARACTERISTIC
/begin CHARACTERISTIC K_ED_FI_BSD.INC_NACH_EINTRAG "Filtererhoehung nach Fehlerspeichereintrag | EN: Fault code FI_BSD - debounce filter increment after fault-memory entry" VALUE 0x712A8 TKW_VV_VV_UB 100.0 FORMULA_0003 0.0 255.0000 /end CHARACTERISTIC
/begin CHARACTERISTIC K_ED_FI_QLT.INC_NACH_EINTRAG "Filtererhoehung nach Fehlerspeichereintrag | EN: Fault code FI_QLT - debounce filter increment after fault-memory entry" VALUE 0x712C2 TKW_VV_VV_UB 100.0 FORMULA_0003 0.0 255.0000 /end CHARACTERISTIC
/begin CHARACTERISTIC K_ED_FI_IBS1.INC_NACH_EINTRAG "Filtererhoehung nach Fehlerspeichereintrag | EN: Fault code FI_IBS1 - debounce filter increment after fault-memory entry" VALUE 0x712DC TKW_VV_VV_UB 100.0 FORMULA_0003 0.0 255.0000 /end CHARACTERISTIC
/begin CHARACTERISTIC K_ED_FI_IBS2.INC_NACH_EINTRAG "Filtererhoehung nach Fehlerspeichereintrag | EN: Fault code FI_IBS2 - debounce filter increment after fault-memory entry" VALUE 0x712F6 TKW_VV_VV_UB 100.0 FORMULA_0003 0.0 255.0000 /end CHARACTERISTIC
/begin CHARACTERISTIC K_ED_FI_IBS3.INC_NACH_EINTRAG "Filtererhoehung nach Fehlerspeichereintrag | EN: Fault code FI_IBS3 - debounce filter increment after fault-memory entry" VALUE 0x71310 TKW_VV_VV_UB 100.0 FORMULA_0003 0.0 255.0000 /end CHARACTERISTIC
/begin CHARACTERISTIC K_ED_FI_PMBN.INC_NACH_EINTRAG "Filtererhoehung nach Fehlerspeichereintrag | EN: Fault code FI_PMBN - debounce filter increment after fault-memory entry" VALUE 0x7132A TKW_VV_VV_UB 100.0 FORMULA_0003 0.0 255.0000 /end CHARACTERISTIC
/begin CHARACTERISTIC K_ED_FI_PMBATT.INC_NACH_EINTRAG "Filtererhoehung nach Fehlerspeichereintrag | EN: Fault code FI_PMBATT - debounce filter increment after fault-memory entry" VALUE 0x71344 TKW_VV_VV_UB 100.0 FORMULA_0003 0.0 255.0000 /end CHARACTERISTIC
/begin CHARACTERISTIC K_ED_FI_BSD_0.INC_NACH_EINTRAG "Filtererhoehung nach Fehlerspeichereintrag | EN: Fault code FI_BSD_0 - debounce filter increment after fault-memory entry" VALUE 0x713FA TKW_VV_VV_UB 100.0 FORMULA_0003 0.0 255.0000 /end CHARACTERISTIC
/begin CHARACTERISTIC K_ED_FI_BSD_6.INC_NACH_EINTRAG "Filtererhoehung nach Fehlerspeichereintrag | EN: Fault code FI_BSD_6 - debounce filter increment after fault-memory entry" VALUE 0x71414 TKW_VV_VV_UB 100.0 FORMULA_0003 0.0 255.0000 /end CHARACTERISTIC
/begin CHARACTERISTIC K_ED_FI_BSDGLOB.INC_NACH_EINTRAG "Filtererhoehung nach Fehlerspeichereintrag | EN: Fault code FI_BSDGLOB - debounce filter increment after fault-memory entry" VALUE 0x7142E TKW_VV_VV_UB 100.0 FORMULA_0003 0.0 255.0000 /end CHARACTERISTIC
/begin CHARACTERISTIC K_ED_FI_PMRUHVERL.INC_NACH_EINTRAG "Filtererhoehung nach Fehlerspeichereintrag | EN: Fault code FI_PMRUHVERL - debounce filter increment after fault-memory entry" VALUE 0x71448 TKW_VV_VV_UB 100.0 FORMULA_0003 0.0 255.0000 /end CHARACTERISTIC
/begin CHARACTERISTIC K_ED_FI_TOENS.INC_NACH_EINTRAG "Filtererhoehung nach Fehlerspeichereintrag | EN: Fault code FI_TOENS - debounce filter increment after fault-memory entry" VALUE 0x71462 TKW_VV_VV_UB 100.0 FORMULA_0003 0.0 255.0000 /end CHARACTERISTIC
/begin CHARACTERISTIC K_ED_KW.INC_NACH_EINTRAG "Filtererhoehung nach Fehlerspeichereintrag | EN: Fault code KW - debounce filter increment after fault-memory entry" VALUE 0x71580 TKW_VV_VV_UB 100.0 FORMULA_0003 0.0 255.0000 /end CHARACTERISTIC
/begin CHARACTERISTIC K_ED_LA1_ADAPT.INC_NACH_EINTRAG "Filtererhoehung nach Fehlerspeichereintrag | EN: Fault code LA1_ADAPT - debounce filter increment after fault-memory entry" VALUE 0x7159A TKW_VV_VV_UB 100.0 FORMULA_0003 0.0 255.0000 /end CHARACTERISTIC
/begin CHARACTERISTIC K_ED_LA2_ADAPT.INC_NACH_EINTRAG "Filtererhoehung nach Fehlerspeichereintrag | EN: Fault code LA2_ADAPT - debounce filter increment after fault-memory entry" VALUE 0x715B4 TKW_VV_VV_UB 100.0 FORMULA_0003 0.0 255.0000 /end CHARACTERISTIC
/begin CHARACTERISTIC K_ED_KGE1.INC_NACH_EINTRAG "Filtererhoehung nach Fehlerspeichereintrag | EN: Fault code KGE1 - debounce filter increment after fault-memory entry" VALUE 0x715CE TKW_VV_VV_UB 100.0 FORMULA_0003 0.0 255.0000 /end CHARACTERISTIC
/begin CHARACTERISTIC K_ED_KGE2.INC_NACH_EINTRAG "Filtererhoehung nach Fehlerspeichereintrag | EN: Fault code KGE2 - debounce filter increment after fault-memory entry" VALUE 0x715E8 TKW_VV_VV_UB 100.0 FORMULA_0003 0.0 255.0000 /end CHARACTERISTIC
/begin CHARACTERISTIC K_ED_FST.INC_NACH_EINTRAG "Filtererhoehung nach Fehlerspeichereintrag | EN: Fault code FST - debounce filter increment after fault-memory entry" VALUE 0x71602 TKW_VV_VV_UB 100.0 FORMULA_0003 0.0 255.0000 /end CHARACTERISTIC
/begin CHARACTERISTIC K_ED_KSD1.INC_NACH_EINTRAG "Filtererhoehung nach Fehlerspeichereintrag | EN: Fault code KSD1 - debounce filter increment after fault-memory entry" VALUE 0x7173A TKW_VV_VV_UB 100.0 FORMULA_0003 0.0 255.0000 /end CHARACTERISTIC
/begin CHARACTERISTIC K_ED_KSD2.INC_NACH_EINTRAG "Filtererhoehung nach Fehlerspeichereintrag | EN: Fault code KSD2 - debounce filter increment after fault-memory entry" VALUE 0x71754 TKW_VV_VV_UB 100.0 FORMULA_0003 0.0 255.0000 /end CHARACTERISTIC
/begin CHARACTERISTIC K_ED_KATS_B1.INC_NACH_EINTRAG "Filtererhoehung nach Fehlerspeichereintrag | EN: Fault code KATS_B1 - debounce filter increment after fault-memory entry" VALUE 0x7176E TKW_VV_VV_UB 100.0 FORMULA_0003 0.0 255.0000 /end CHARACTERISTIC
/begin CHARACTERISTIC K_ED_KATS_B2.INC_NACH_EINTRAG "Filtererhoehung nach Fehlerspeichereintrag | EN: Fault code KATS_B2 - debounce filter increment after fault-memory entry" VALUE 0x71788 TKW_VV_VV_UB 100.0 FORMULA_0003 0.0 255.0000 /end CHARACTERISTIC
/begin CHARACTERISTIC K_ED_FST_GEBER.INC_NACH_EINTRAG "Filtererhoehung nach Fehlerspeichereintrag | EN: Fault code FST_GEBER - debounce filter increment after fault-memory entry" VALUE 0x717D6 TKW_VV_VV_UB 100.0 FORMULA_0003 0.0 255.0000 /end CHARACTERISTIC
/begin CHARACTERISTIC K_ED_LA1_TRIM_AD.INC_NACH_EINTRAG "Filtererhoehung nach Fehlerspeichereintrag | EN: Fault code LA1_TRIM_AD - debounce filter increment after fault-memory entry" VALUE 0x71872 TKW_VV_VV_UB 100.0 FORMULA_0003 0.0 255.0000 /end CHARACTERISTIC
/begin CHARACTERISTIC K_ED_LA2_TRIM_AD.INC_NACH_EINTRAG "Filtererhoehung nach Fehlerspeichereintrag | EN: Fault code LA2_TRIM_AD - debounce filter increment after fault-memory entry" VALUE 0x7188C TKW_VV_VV_UB 100.0 FORMULA_0003 0.0 255.0000 /end CHARACTERISTIC
/begin CHARACTERISTIC K_ED_LANK1_OPENLOAD.INC_NACH_EINTRAG "Filtererhoehung nach Fehlerspeichereintrag | EN: Fault code LANK1_OPENLOAD - debounce filter increment after fault-memory entry" VALUE 0x718A6 TKW_VV_VV_UB 100.0 FORMULA_0003 0.0 255.0000 /end CHARACTERISTIC
/begin CHARACTERISTIC K_ED_LANK2_OPENLOAD.INC_NACH_EINTRAG "Filtererhoehung nach Fehlerspeichereintrag | EN: Fault code LANK2_OPENLOAD - debounce filter increment after fault-memory entry" VALUE 0x718C0 TKW_VV_VV_UB 100.0 FORMULA_0003 0.0 255.0000 /end CHARACTERISTIC
/begin CHARACTERISTIC K_ED_LANK1_OBD_WE.INC_NACH_EINTRAG "Filtererhoehung nach Fehlerspeichereintrag | EN: Fault code LANK1_OBD_WE - debounce filter increment after fault-memory entry" VALUE 0x718DA TKW_VV_VV_UB 100.0 FORMULA_0003 0.0 255.0000 /end CHARACTERISTIC
/begin CHARACTERISTIC K_ED_LANK2_OBD_WE.INC_NACH_EINTRAG "Filtererhoehung nach Fehlerspeichereintrag | EN: Fault code LANK2_OBD_WE - debounce filter increment after fault-memory entry" VALUE 0x718F4 TKW_VV_VV_UB 100.0 FORMULA_0003 0.0 255.0000 /end CHARACTERISTIC
/begin CHARACTERISTIC K_ED_FST_GEBER_LI.INC_NACH_EINTRAG "Filtererhoehung nach Fehlerspeichereintrag" VALUE 0x719F8 TKW_VV_VV_UB 100.0 FORMULA_0003 0.0 255.0000 /end CHARACTERISTIC
/begin CHARACTERISTIC K_ED_FST_GEBER_RE.INC_NACH_EINTRAG "Filtererhoehung nach Fehlerspeichereintrag" VALUE 0x71A12 TKW_VV_VV_UB 100.0 FORMULA_0003 0.0 255.0000 /end CHARACTERISTIC
/begin CHARACTERISTIC K_ED_LANK1_OBD_SLOPE.INC_NACH_EINTRAG "Filtererhoehung nach Fehlerspeichereintrag" VALUE 0x71A2C TKW_VV_VV_UB 100.0 FORMULA_0003 0.0 255.0000 /end CHARACTERISTIC
/begin CHARACTERISTIC K_ED_LANK2_OBD_SLOPE.INC_NACH_EINTRAG "Filtererhoehung nach Fehlerspeichereintrag" VALUE 0x71A46 TKW_VV_VV_UB 100.0 FORMULA_0003 0.0 255.0000 /end CHARACTERISTIC
/begin CHARACTERISTIC K_ED_INDEX_204_INJ.INC_NACH_EINTRAG "Filtererhoehung nach Fehlerspeichereintrag | EN: Fault code INDEX_204_INJ - debounce filter increment after fault-memory entry" VALUE 0x71AAE TKW_VV_VV_UB 100.0 FORMULA_0003 0.0 255.0000 /end CHARACTERISTIC
/begin CHARACTERISTIC K_ED_INDEX_205_INJ.INC_NACH_EINTRAG "Filtererhoehung nach Fehlerspeichereintrag | EN: Fault code INDEX_205_INJ - debounce filter increment after fault-memory entry" VALUE 0x71AC8 TKW_VV_VV_UB 100.0 FORMULA_0003 0.0 255.0000 /end CHARACTERISTIC
/begin CHARACTERISTIC K_ED_INDEX_206_INJ.INC_NACH_EINTRAG "Filtererhoehung nach Fehlerspeichereintrag | EN: Fault code INDEX_206_INJ - debounce filter increment after fault-memory entry" VALUE 0x71AE2 TKW_VV_VV_UB 100.0 FORMULA_0003 0.0 255.0000 /end CHARACTERISTIC
/begin CHARACTERISTIC K_ED_INDEX_207_INJ.INC_NACH_EINTRAG "Filtererhoehung nach Fehlerspeichereintrag" VALUE 0x71AFC TKW_VV_VV_UB 100.0 FORMULA_0003 0.0 255.0000 /end CHARACTERISTIC
/begin CHARACTERISTIC K_ED_INDEX_208_INJ.INC_NACH_EINTRAG "Filtererhoehung nach Fehlerspeichereintrag" VALUE 0x71B16 TKW_VV_VV_UB 100.0 FORMULA_0003 0.0 255.0000 /end CHARACTERISTIC
/begin CHARACTERISTIC K_ED_INDEX_209_INJ.INC_NACH_EINTRAG "Filtererhoehung nach Fehlerspeichereintrag" VALUE 0x71B30 TKW_VV_VV_UB 100.0 FORMULA_0003 0.0 255.0000 /end CHARACTERISTIC
/begin CHARACTERISTIC K_ED_INDEX_210_INJ.INC_NACH_EINTRAG "Filtererhoehung nach Fehlerspeichereintrag" VALUE 0x71B4A TKW_VV_VV_UB 100.0 FORMULA_0003 0.0 255.0000 /end CHARACTERISTIC
/begin CHARACTERISTIC K_ED_INDEX_211_INJ.INC_NACH_EINTRAG "Filtererhoehung nach Fehlerspeichereintrag | EN: Filtererhoehung nach Fehlerspeichereintrag" VALUE 0x71B64 TKW_VV_VV_UB 100.0 FORMULA_0003 0.0 255.0000 /end CHARACTERISTIC
/begin CHARACTERISTIC K_ED_INDEX_212_INJ.INC_NACH_EINTRAG "Filtererhoehung nach Fehlerspeichereintrag" VALUE 0x71B7E TKW_VV_VV_UB 100.0 FORMULA_0003 0.0 255.0000 /end CHARACTERISTIC
/begin CHARACTERISTIC K_ED_INDEX_213_INJ.INC_NACH_EINTRAG "Filtererhoehung nach Fehlerspeichereintrag" VALUE 0x71B98 TKW_VV_VV_UB 100.0 FORMULA_0003 0.0 255.0000 /end CHARACTERISTIC
/begin CHARACTERISTIC K_ED_INDEX_214_INJ.INC_NACH_EINTRAG "Filtererhoehung nach Fehlerspeichereintrag" VALUE 0x71BB2 TKW_VV_VV_UB 100.0 FORMULA_0003 0.0 255.0000 /end CHARACTERISTIC
/begin CHARACTERISTIC K_ED_INDEX_215_INJ.INC_NACH_EINTRAG "Filtererhoehung nach Fehlerspeichereintrag" VALUE 0x71BCC TKW_VV_VV_UB 100.0 FORMULA_0003 0.0 255.0000 /end CHARACTERISTIC
/begin CHARACTERISTIC K_ED_INDEX_216_INJ.INC_NACH_EINTRAG "Filtererhoehung nach Fehlerspeichereintrag" VALUE 0x71BE6 TKW_VV_VV_UB 100.0 FORMULA_0003 0.0 255.0000 /end CHARACTERISTIC
/begin CHARACTERISTIC K_ED_INDEX_217_INJ.INC_NACH_EINTRAG "Filtererhoehung nach Fehlerspeichereintrag" VALUE 0x71C00 TKW_VV_VV_UB 100.0 FORMULA_0003 0.0 255.0000 /end CHARACTERISTIC
/begin CHARACTERISTIC K_ED_INDEX_218_INJ.INC_NACH_EINTRAG "Filtererhoehung nach Fehlerspeichereintrag" VALUE 0x71C1A TKW_VV_VV_UB 100.0 FORMULA_0003 0.0 255.0000 /end CHARACTERISTIC
/begin CHARACTERISTIC K_ED_INDEX_219_INJ.INC_NACH_EINTRAG "Filtererhoehung nach Fehlerspeichereintrag" VALUE 0x71C34 TKW_VV_VV_UB 100.0 FORMULA_0003 0.0 255.0000 /end CHARACTERISTIC
/begin CHARACTERISTIC K_ED_INDEX_220_INJ.INC_NACH_EINTRAG "Filtererhoehung nach Fehlerspeichereintrag" VALUE 0x71C4E TKW_VV_VV_UB 100.0 FORMULA_0003 0.0 255.0000 /end CHARACTERISTIC
/begin CHARACTERISTIC K_ED_INDEX_221_INJ.INC_NACH_EINTRAG "Filtererhoehung nach Fehlerspeichereintrag" VALUE 0x71C68 TKW_VV_VV_UB 100.0 FORMULA_0003 0.0 255.0000 /end CHARACTERISTIC
/begin CHARACTERISTIC K_ED_INDEX_222_INJ.INC_NACH_EINTRAG "Filtererhoehung nach Fehlerspeichereintrag" VALUE 0x71C82 TKW_VV_VV_UB 100.0 FORMULA_0003 0.0 255.0000 /end CHARACTERISTIC
/begin CHARACTERISTIC K_ED_INDEX_223_INJ.INC_NACH_EINTRAG "Filtererhoehung nach Fehlerspeichereintrag" VALUE 0x71C9C TKW_VV_VV_UB 100.0 FORMULA_0003 0.0 255.0000 /end CHARACTERISTIC
/begin CHARACTERISTIC K_ED_HFM1.DEC_NACH_EINTRAG "Filterverringerung nach Fehlerspeichereintrag | EN: Fault code HFM1 - debounce filter decrement after fault-memory entry" VALUE 0x7062B TKW_VV_VV_UB 100.0 FORMULA_0003 0.0 255.0000 /end CHARACTERISTIC
/begin CHARACTERISTIC K_ED_HFM2.DEC_NACH_EINTRAG "Filterverringerung nach Fehlerspeichereintrag | EN: Fault code HFM2 - debounce filter decrement after fault-memory entry" VALUE 0x70645 TKW_VV_VV_UB 100.0 FORMULA_0003 0.0 255.0000 /end CHARACTERISTIC
/begin CHARACTERISTIC K_ED_LAVK1.DEC_NACH_EINTRAG "Filterverringerung nach Fehlerspeichereintrag | EN: Fault code LAVK1 - debounce filter decrement after fault-memory entry" VALUE 0x707FF TKW_VV_VV_UB 100.0 FORMULA_0003 0.0 255.0000 /end CHARACTERISTIC
/begin CHARACTERISTIC K_ED_LANK1.DEC_NACH_EINTRAG "Filterverringerung nach Fehlerspeichereintrag | EN: Fault code LANK1 - debounce filter decrement after fault-memory entry" VALUE 0x7089B TKW_VV_VV_UB 100.0 FORMULA_0003 0.0 255.0000 /end CHARACTERISTIC
/begin CHARACTERISTIC K_ED_LANK2.DEC_NACH_EINTRAG "Filterverringerung nach Fehlerspeichereintrag | EN: Fault code LANK2 - debounce filter decrement after fault-memory entry" VALUE 0x708B5 TKW_VV_VV_UB 100.0 FORMULA_0003 0.0 255.0000 /end CHARACTERISTIC
/begin CHARACTERISTIC K_ED_FPLAU1.DEC_NACH_EINTRAG "Filterverringerung nach Fehlerspeichereintrag | EN: Fault code FPLAU1 - debounce filter decrement after fault-memory entry" VALUE 0x709ED TKW_VV_VV_UB 100.0 FORMULA_0003 0.0 255.0000 /end CHARACTERISTIC
/begin CHARACTERISTIC K_ED_FPLAU2.DEC_NACH_EINTRAG "Filterverringerung nach Fehlerspeichereintrag | EN: Fault code FPLAU2 - debounce filter decrement after fault-memory entry" VALUE 0x70A07 TKW_VV_VV_UB 100.0 FORMULA_0003 0.0 255.0000 /end CHARACTERISTIC
/begin CHARACTERISTIC K_ED_LANK1_OBD_S.DEC_NACH_EINTRAG "Filterverringerung nach Fehlerspeichereintrag | EN: Fault code LANK1_OBD_S - debounce filter decrement after fault-memory entry" VALUE 0x70A3B TKW_VV_VV_UB 100.0 FORMULA_0003 0.0 255.0000 /end CHARACTERISTIC
/begin CHARACTERISTIC K_ED_LANK2_OBD_S.DEC_NACH_EINTRAG "Filterverringerung nach Fehlerspeichereintrag | EN: Fault code LANK2_OBD_S - debounce filter decrement after fault-memory entry" VALUE 0x70A55 TKW_VV_VV_UB 100.0 FORMULA_0003 0.0 255.0000 /end CHARACTERISTIC
/begin CHARACTERISTIC K_ED_LAVK1_DIAG.DEC_NACH_EINTRAG "Filterverringerung nach Fehlerspeichereintrag | EN: Fault code LAVK1_DIAG - debounce filter decrement after fault-memory entry" VALUE 0x70BA7 TKW_VV_VV_UB 100.0 FORMULA_0003 0.0 255.0000 /end CHARACTERISTIC
/begin CHARACTERISTIC K_ED_LAM1_REG.DEC_NACH_EINTRAG "Filterverringerung nach Fehlerspeichereintrag | EN: Fault code LAM1_REG - debounce filter decrement after fault-memory entry" VALUE 0x70DC9 TKW_VV_VV_UB 100.0 FORMULA_0003 0.0 255.0000 /end CHARACTERISTIC
/begin CHARACTERISTIC K_ED_LAM2_REG.DEC_NACH_EINTRAG "Filterverringerung nach Fehlerspeichereintrag | EN: Fault code LAM2_REG - debounce filter decrement after fault-memory entry" VALUE 0x70DE3 TKW_VV_VV_UB 100.0 FORMULA_0003 0.0 255.0000 /end CHARACTERISTIC
/begin CHARACTERISTIC K_ED_KAT_OBD1.DEC_NACH_EINTRAG "Filterverringerung nach Fehlerspeichereintrag | EN: Fault code KAT_OBD1 - debounce filter decrement after fault-memory entry" VALUE 0x71241 TKW_VV_VV_UB 100.0 FORMULA_0003 0.0 255.0000 /end CHARACTERISTIC
/begin CHARACTERISTIC K_ED_KAT_OBD2.DEC_NACH_EINTRAG "Filterverringerung nach Fehlerspeichereintrag | EN: Fault code KAT_OBD2 - debounce filter decrement after fault-memory entry" VALUE 0x7125B TKW_VV_VV_UB 100.0 FORMULA_0003 0.0 255.0000 /end CHARACTERISTIC
/begin CHARACTERISTIC K_ED_FI_GEN.DEC_NACH_EINTRAG "Filterverringerung nach Fehlerspeichereintrag | EN: Fault code FI_GEN - debounce filter decrement after fault-memory entry" VALUE 0x7128F TKW_VV_VV_UB 100.0 FORMULA_0003 0.0 255.0000 /end CHARACTERISTIC
/begin CHARACTERISTIC K_ED_FI_BSD.DEC_NACH_EINTRAG "Filterverringerung nach Fehlerspeichereintrag | EN: Fault code FI_BSD - debounce filter decrement after fault-memory entry" VALUE 0x712A9 TKW_VV_VV_UB 100.0 FORMULA_0003 0.0 255.0000 /end CHARACTERISTIC
/begin CHARACTERISTIC K_ED_FI_QLT.DEC_NACH_EINTRAG "Filterverringerung nach Fehlerspeichereintrag | EN: Fault code FI_QLT - debounce filter decrement after fault-memory entry" VALUE 0x712C3 TKW_VV_VV_UB 100.0 FORMULA_0003 0.0 255.0000 /end CHARACTERISTIC
/begin CHARACTERISTIC K_ED_FI_IBS1.DEC_NACH_EINTRAG "Filterverringerung nach Fehlerspeichereintrag | EN: Fault code FI_IBS1 - debounce filter decrement after fault-memory entry" VALUE 0x712DD TKW_VV_VV_UB 100.0 FORMULA_0003 0.0 255.0000 /end CHARACTERISTIC
/begin CHARACTERISTIC K_ED_FI_IBS2.DEC_NACH_EINTRAG "Filterverringerung nach Fehlerspeichereintrag | EN: Fault code FI_IBS2 - debounce filter decrement after fault-memory entry" VALUE 0x712F7 TKW_VV_VV_UB 100.0 FORMULA_0003 0.0 255.0000 /end CHARACTERISTIC
/begin CHARACTERISTIC K_ED_FI_IBS3.DEC_NACH_EINTRAG "Filterverringerung nach Fehlerspeichereintrag | EN: Fault code FI_IBS3 - debounce filter decrement after fault-memory entry" VALUE 0x71311 TKW_VV_VV_UB 100.0 FORMULA_0003 0.0 255.0000 /end CHARACTERISTIC
/begin CHARACTERISTIC K_ED_FI_PMBN.DEC_NACH_EINTRAG "Filterverringerung nach Fehlerspeichereintrag | EN: Fault code FI_PMBN - debounce filter decrement after fault-memory entry" VALUE 0x7132B TKW_VV_VV_UB 100.0 FORMULA_0003 0.0 255.0000 /end CHARACTERISTIC
/begin CHARACTERISTIC K_ED_FI_PMBATT.DEC_NACH_EINTRAG "Filterverringerung nach Fehlerspeichereintrag | EN: Fault code FI_PMBATT - debounce filter decrement after fault-memory entry" VALUE 0x71345 TKW_VV_VV_UB 100.0 FORMULA_0003 0.0 255.0000 /end CHARACTERISTIC
/begin CHARACTERISTIC K_ED_FI_BSD_0.DEC_NACH_EINTRAG "Filterverringerung nach Fehlerspeichereintrag | EN: Fault code FI_BSD_0 - debounce filter decrement after fault-memory entry" VALUE 0x713FB TKW_VV_VV_UB 100.0 FORMULA_0003 0.0 255.0000 /end CHARACTERISTIC
/begin CHARACTERISTIC K_ED_FI_BSD_6.DEC_NACH_EINTRAG "Filterverringerung nach Fehlerspeichereintrag | EN: Fault code FI_BSD_6 - debounce filter decrement after fault-memory entry" VALUE 0x71415 TKW_VV_VV_UB 100.0 FORMULA_0003 0.0 255.0000 /end CHARACTERISTIC
/begin CHARACTERISTIC K_ED_FI_BSDGLOB.DEC_NACH_EINTRAG "Filterverringerung nach Fehlerspeichereintrag | EN: Fault code FI_BSDGLOB - debounce filter decrement after fault-memory entry" VALUE 0x7142F TKW_VV_VV_UB 100.0 FORMULA_0003 0.0 255.0000 /end CHARACTERISTIC
/begin CHARACTERISTIC K_ED_FI_PMRUHVERL.DEC_NACH_EINTRAG "Filterverringerung nach Fehlerspeichereintrag | EN: Fault code FI_PMRUHVERL - debounce filter decrement after fault-memory entry" VALUE 0x71449 TKW_VV_VV_UB 100.0 FORMULA_0003 0.0 255.0000 /end CHARACTERISTIC
/begin CHARACTERISTIC K_ED_FI_TOENS.DEC_NACH_EINTRAG "Filterverringerung nach Fehlerspeichereintrag | EN: Fault code FI_TOENS - debounce filter decrement after fault-memory entry" VALUE 0x71463 TKW_VV_VV_UB 100.0 FORMULA_0003 0.0 255.0000 /end CHARACTERISTIC
/begin CHARACTERISTIC K_ED_KW.DEC_NACH_EINTRAG "Filterverringerung nach Fehlerspeichereintrag | EN: Fault code KW - debounce filter decrement after fault-memory entry" VALUE 0x71581 TKW_VV_VV_UB 100.0 FORMULA_0003 0.0 255.0000 /end CHARACTERISTIC
/begin CHARACTERISTIC K_ED_LA1_ADAPT.DEC_NACH_EINTRAG "Filterverringerung nach Fehlerspeichereintrag | EN: Fault code LA1_ADAPT - debounce filter decrement after fault-memory entry" VALUE 0x7159B TKW_VV_VV_UB 100.0 FORMULA_0003 0.0 255.0000 /end CHARACTERISTIC
/begin CHARACTERISTIC K_ED_LA2_ADAPT.DEC_NACH_EINTRAG "Filterverringerung nach Fehlerspeichereintrag | EN: Fault code LA2_ADAPT - debounce filter decrement after fault-memory entry" VALUE 0x715B5 TKW_VV_VV_UB 100.0 FORMULA_0003 0.0 255.0000 /end CHARACTERISTIC
/begin CHARACTERISTIC K_ED_KGE1.DEC_NACH_EINTRAG "Filterverringerung nach Fehlerspeichereintrag | EN: Fault code KGE1 - debounce filter decrement after fault-memory entry" VALUE 0x715CF TKW_VV_VV_UB 100.0 FORMULA_0003 0.0 255.0000 /end CHARACTERISTIC
/begin CHARACTERISTIC K_ED_KGE2.DEC_NACH_EINTRAG "Filterverringerung nach Fehlerspeichereintrag | EN: Fault code KGE2 - debounce filter decrement after fault-memory entry" VALUE 0x715E9 TKW_VV_VV_UB 100.0 FORMULA_0003 0.0 255.0000 /end CHARACTERISTIC
/begin CHARACTERISTIC K_ED_FST.DEC_NACH_EINTRAG "Filterverringerung nach Fehlerspeichereintrag | EN: Fault code FST - debounce filter decrement after fault-memory entry" VALUE 0x71603 TKW_VV_VV_UB 100.0 FORMULA_0003 0.0 255.0000 /end CHARACTERISTIC
/begin CHARACTERISTIC K_ED_KSD1.DEC_NACH_EINTRAG "Filterverringerung nach Fehlerspeichereintrag | EN: Fault code KSD1 - debounce filter decrement after fault-memory entry" VALUE 0x7173B TKW_VV_VV_UB 100.0 FORMULA_0003 0.0 255.0000 /end CHARACTERISTIC
/begin CHARACTERISTIC K_ED_KSD2.DEC_NACH_EINTRAG "Filterverringerung nach Fehlerspeichereintrag | EN: Fault code KSD2 - debounce filter decrement after fault-memory entry" VALUE 0x71755 TKW_VV_VV_UB 100.0 FORMULA_0003 0.0 255.0000 /end CHARACTERISTIC
/begin CHARACTERISTIC K_ED_KATS_B1.DEC_NACH_EINTRAG "Filterverringerung nach Fehlerspeichereintrag | EN: Fault code KATS_B1 - debounce filter decrement after fault-memory entry" VALUE 0x7176F TKW_VV_VV_UB 100.0 FORMULA_0003 0.0 255.0000 /end CHARACTERISTIC
/begin CHARACTERISTIC K_ED_KATS_B2.DEC_NACH_EINTRAG "Filterverringerung nach Fehlerspeichereintrag | EN: Fault code KATS_B2 - debounce filter decrement after fault-memory entry" VALUE 0x71789 TKW_VV_VV_UB 100.0 FORMULA_0003 0.0 255.0000 /end CHARACTERISTIC
/begin CHARACTERISTIC K_ED_FST_GEBER.DEC_NACH_EINTRAG "Filterverringerung nach Fehlerspeichereintrag | EN: Fault code FST_GEBER - debounce filter decrement after fault-memory entry" VALUE 0x717D7 TKW_VV_VV_UB 100.0 FORMULA_0003 0.0 255.0000 /end CHARACTERISTIC
/begin CHARACTERISTIC K_ED_LA1_TRIM_AD.DEC_NACH_EINTRAG "Filterverringerung nach Fehlerspeichereintrag | EN: Fault code LA1_TRIM_AD - debounce filter decrement after fault-memory entry" VALUE 0x71873 TKW_VV_VV_UB 100.0 FORMULA_0003 0.0 255.0000 /end CHARACTERISTIC
/begin CHARACTERISTIC K_ED_LA2_TRIM_AD.DEC_NACH_EINTRAG "Filterverringerung nach Fehlerspeichereintrag | EN: Fault code LA2_TRIM_AD - debounce filter decrement after fault-memory entry" VALUE 0x7188D TKW_VV_VV_UB 100.0 FORMULA_0003 0.0 255.0000 /end CHARACTERISTIC
/begin CHARACTERISTIC K_ED_LANK1_OPENLOAD.DEC_NACH_EINTRAG "Filterverringerung nach Fehlerspeichereintrag | EN: Fault code LANK1_OPENLOAD - debounce filter decrement after fault-memory entry" VALUE 0x718A7 TKW_VV_VV_UB 100.0 FORMULA_0003 0.0 255.0000 /end CHARACTERISTIC
/begin CHARACTERISTIC K_ED_LANK2_OPENLOAD.DEC_NACH_EINTRAG "Filterverringerung nach Fehlerspeichereintrag | EN: Fault code LANK2_OPENLOAD - debounce filter decrement after fault-memory entry" VALUE 0x718C1 TKW_VV_VV_UB 100.0 FORMULA_0003 0.0 255.0000 /end CHARACTERISTIC
/begin CHARACTERISTIC K_ED_LANK1_OBD_WE.DEC_NACH_EINTRAG "Filterverringerung nach Fehlerspeichereintrag | EN: Fault code LANK1_OBD_WE - debounce filter decrement after fault-memory entry" VALUE 0x718DB TKW_VV_VV_UB 100.0 FORMULA_0003 0.0 255.0000 /end CHARACTERISTIC
/begin CHARACTERISTIC K_ED_LANK2_OBD_WE.DEC_NACH_EINTRAG "Filterverringerung nach Fehlerspeichereintrag | EN: Fault code LANK2_OBD_WE - debounce filter decrement after fault-memory entry" VALUE 0x718F5 TKW_VV_VV_UB 100.0 FORMULA_0003 0.0 255.0000 /end CHARACTERISTIC
/begin CHARACTERISTIC K_ED_FST_GEBER_LI.DEC_NACH_EINTRAG "Filterverringerung nach Fehlerspeichereintrag" VALUE 0x719F9 TKW_VV_VV_UB 100.0 FORMULA_0003 0.0 255.0000 /end CHARACTERISTIC
/begin CHARACTERISTIC K_ED_FST_GEBER_RE.DEC_NACH_EINTRAG "Filterverringerung nach Fehlerspeichereintrag" VALUE 0x71A13 TKW_VV_VV_UB 100.0 FORMULA_0003 0.0 255.0000 /end CHARACTERISTIC
/begin CHARACTERISTIC K_ED_LANK1_OBD_SLOPE.DEC_NACH_EINTRAG "Filterverringerung nach Fehlerspeichereintrag" VALUE 0x71A2D TKW_VV_VV_UB 100.0 FORMULA_0003 0.0 255.0000 /end CHARACTERISTIC
/begin CHARACTERISTIC K_ED_LANK2_OBD_SLOPE.DEC_NACH_EINTRAG "Filterverringerung nach Fehlerspeichereintrag" VALUE 0x71A47 TKW_VV_VV_UB 100.0 FORMULA_0003 0.0 255.0000 /end CHARACTERISTIC
/begin CHARACTERISTIC K_ED_INDEX_204_INJ.DEC_NACH_EINTRAG "Filterverringerung nach Fehlerspeichereintrag | EN: Fault code INDEX_204_INJ - debounce filter decrement after fault-memory entry" VALUE 0x71AAF TKW_VV_VV_UB 100.0 FORMULA_0003 0.0 255.0000 /end CHARACTERISTIC
/begin CHARACTERISTIC K_ED_INDEX_205_INJ.DEC_NACH_EINTRAG "Filterverringerung nach Fehlerspeichereintrag | EN: Fault code INDEX_205_INJ - debounce filter decrement after fault-memory entry" VALUE 0x71AC9 TKW_VV_VV_UB 100.0 FORMULA_0003 0.0 255.0000 /end CHARACTERISTIC
/begin CHARACTERISTIC K_ED_INDEX_206_INJ.DEC_NACH_EINTRAG "Filterverringerung nach Fehlerspeichereintrag | EN: Fault code INDEX_206_INJ - debounce filter decrement after fault-memory entry" VALUE 0x71AE3 TKW_VV_VV_UB 100.0 FORMULA_0003 0.0 255.0000 /end CHARACTERISTIC
/begin CHARACTERISTIC K_ED_INDEX_207_INJ.DEC_NACH_EINTRAG "Filterverringerung nach Fehlerspeichereintrag" VALUE 0x71AFD TKW_VV_VV_UB 100.0 FORMULA_0003 0.0 255.0000 /end CHARACTERISTIC
/begin CHARACTERISTIC K_ED_INDEX_208_INJ.DEC_NACH_EINTRAG "Filterverringerung nach Fehlerspeichereintrag" VALUE 0x71B17 TKW_VV_VV_UB 100.0 FORMULA_0003 0.0 255.0000 /end CHARACTERISTIC
/begin CHARACTERISTIC K_ED_INDEX_209_INJ.DEC_NACH_EINTRAG "Filterverringerung nach Fehlerspeichereintrag" VALUE 0x71B31 TKW_VV_VV_UB 100.0 FORMULA_0003 0.0 255.0000 /end CHARACTERISTIC
/begin CHARACTERISTIC K_ED_INDEX_210_INJ.DEC_NACH_EINTRAG "Filterverringerung nach Fehlerspeichereintrag" VALUE 0x71B4B TKW_VV_VV_UB 100.0 FORMULA_0003 0.0 255.0000 /end CHARACTERISTIC
/begin CHARACTERISTIC K_ED_INDEX_211_INJ.DEC_NACH_EINTRAG "Filterverringerung nach Fehlerspeichereintrag | EN: Filterverringerung nach Fehlerspeichereintrag" VALUE 0x71B65 TKW_VV_VV_UB 100.0 FORMULA_0003 0.0 255.0000 /end CHARACTERISTIC
/begin CHARACTERISTIC K_ED_INDEX_212_INJ.DEC_NACH_EINTRAG "Filterverringerung nach Fehlerspeichereintrag" VALUE 0x71B7F TKW_VV_VV_UB 100.0 FORMULA_0003 0.0 255.0000 /end CHARACTERISTIC
/begin CHARACTERISTIC K_ED_INDEX_213_INJ.DEC_NACH_EINTRAG "Filterverringerung nach Fehlerspeichereintrag" VALUE 0x71B99 TKW_VV_VV_UB 100.0 FORMULA_0003 0.0 255.0000 /end CHARACTERISTIC
/begin CHARACTERISTIC K_ED_INDEX_214_INJ.DEC_NACH_EINTRAG "Filterverringerung nach Fehlerspeichereintrag" VALUE 0x71BB3 TKW_VV_VV_UB 100.0 FORMULA_0003 0.0 255.0000 /end CHARACTERISTIC
/begin CHARACTERISTIC K_ED_INDEX_215_INJ.DEC_NACH_EINTRAG "Filterverringerung nach Fehlerspeichereintrag" VALUE 0x71BCD TKW_VV_VV_UB 100.0 FORMULA_0003 0.0 255.0000 /end CHARACTERISTIC
/begin CHARACTERISTIC K_ED_INDEX_216_INJ.DEC_NACH_EINTRAG "Filterverringerung nach Fehlerspeichereintrag" VALUE 0x71BE7 TKW_VV_VV_UB 100.0 FORMULA_0003 0.0 255.0000 /end CHARACTERISTIC
/begin CHARACTERISTIC K_ED_INDEX_217_INJ.DEC_NACH_EINTRAG "Filterverringerung nach Fehlerspeichereintrag" VALUE 0x71C01 TKW_VV_VV_UB 100.0 FORMULA_0003 0.0 255.0000 /end CHARACTERISTIC
/begin CHARACTERISTIC K_ED_INDEX_218_INJ.DEC_NACH_EINTRAG "Filterverringerung nach Fehlerspeichereintrag" VALUE 0x71C1B TKW_VV_VV_UB 100.0 FORMULA_0003 0.0 255.0000 /end CHARACTERISTIC
/begin CHARACTERISTIC K_ED_INDEX_219_INJ.DEC_NACH_EINTRAG "Filterverringerung nach Fehlerspeichereintrag" VALUE 0x71C35 TKW_VV_VV_UB 100.0 FORMULA_0003 0.0 255.0000 /end CHARACTERISTIC
/begin CHARACTERISTIC K_ED_INDEX_220_INJ.DEC_NACH_EINTRAG "Filterverringerung nach Fehlerspeichereintrag" VALUE 0x71C4F TKW_VV_VV_UB 100.0 FORMULA_0003 0.0 255.0000 /end CHARACTERISTIC
/begin CHARACTERISTIC K_ED_INDEX_221_INJ.DEC_NACH_EINTRAG "Filterverringerung nach Fehlerspeichereintrag" VALUE 0x71C69 TKW_VV_VV_UB 100.0 FORMULA_0003 0.0 255.0000 /end CHARACTERISTIC
/begin CHARACTERISTIC K_ED_INDEX_222_INJ.DEC_NACH_EINTRAG "Filterverringerung nach Fehlerspeichereintrag" VALUE 0x71C83 TKW_VV_VV_UB 100.0 FORMULA_0003 0.0 255.0000 /end CHARACTERISTIC
/begin CHARACTERISTIC K_ED_INDEX_223_INJ.DEC_NACH_EINTRAG "Filterverringerung nach Fehlerspeichereintrag" VALUE 0x71C9D TKW_VV_VV_UB 100.0 FORMULA_0003 0.0 255.0000 /end CHARACTERISTIC
/begin CHARACTERISTIC K_ED_HFM1.KLASSENINDEX "Auswahl der Fehlerklasse | EN: Fault code HFM1 - fault class selection (lamp / warning behaviour)" VALUE 0x7062C TKW_VV_VV_UB 100.0 FORMULA_0003 0.0 8.0000 /end CHARACTERISTIC
/begin CHARACTERISTIC K_ED_HFM2.KLASSENINDEX "Auswahl der Fehlerklasse | EN: Fault code HFM2 - fault class selection (lamp / warning behaviour)" VALUE 0x70646 TKW_VV_VV_UB 100.0 FORMULA_0003 0.0 8.0000 /end CHARACTERISTIC
/begin CHARACTERISTIC K_ED_LAVK1.KLASSENINDEX "Auswahl der Fehlerklasse | EN: Fault code LAVK1 - fault class selection (lamp / warning behaviour)" VALUE 0x70800 TKW_VV_VV_UB 100.0 FORMULA_0003 0.0 8.0000 /end CHARACTERISTIC
/begin CHARACTERISTIC K_ED_LANK1.KLASSENINDEX "Auswahl der Fehlerklasse | EN: Fault code LANK1 - fault class selection (lamp / warning behaviour)" VALUE 0x7089C TKW_VV_VV_UB 100.0 FORMULA_0003 0.0 8.0000 /end CHARACTERISTIC
/begin CHARACTERISTIC K_ED_LANK2.KLASSENINDEX "Auswahl der Fehlerklasse | EN: Fault code LANK2 - fault class selection (lamp / warning behaviour)" VALUE 0x708B6 TKW_VV_VV_UB 100.0 FORMULA_0003 0.0 8.0000 /end CHARACTERISTIC
/begin CHARACTERISTIC K_ED_FPLAU1.KLASSENINDEX "Auswahl der Fehlerklasse | EN: Fault code FPLAU1 - fault class selection (lamp / warning behaviour)" VALUE 0x709EE TKW_VV_VV_UB 100.0 FORMULA_0003 0.0 8.0000 /end CHARACTERISTIC
/begin CHARACTERISTIC K_ED_FPLAU2.KLASSENINDEX "Auswahl der Fehlerklasse | EN: Fault code FPLAU2 - fault class selection (lamp / warning behaviour)" VALUE 0x70A08 TKW_VV_VV_UB 100.0 FORMULA_0003 0.0 8.0000 /end CHARACTERISTIC
/begin CHARACTERISTIC K_ED_LANK1_OBD_S.KLASSENINDEX "Auswahl der Fehlerklasse | EN: Fault code LANK1_OBD_S - fault class selection (lamp / warning behaviour)" VALUE 0x70A3C TKW_VV_VV_UB 100.0 FORMULA_0003 0.0 8.0000 /end CHARACTERISTIC
/begin CHARACTERISTIC K_ED_LANK2_OBD_S.KLASSENINDEX "Auswahl der Fehlerklasse | EN: Fault code LANK2_OBD_S - fault class selection (lamp / warning behaviour)" VALUE 0x70A56 TKW_VV_VV_UB 100.0 FORMULA_0003 0.0 8.0000 /end CHARACTERISTIC
/begin CHARACTERISTIC K_ED_LAVK1_DIAG.KLASSENINDEX "Auswahl der Fehlerklasse | EN: Fault code LAVK1_DIAG - fault class selection (lamp / warning behaviour)" VALUE 0x70BA8 TKW_VV_VV_UB 100.0 FORMULA_0003 0.0 8.0000 /end CHARACTERISTIC
/begin CHARACTERISTIC K_ED_LAM1_REG.KLASSENINDEX "Auswahl der Fehlerklasse | EN: Fault code LAM1_REG - fault class selection (lamp / warning behaviour)" VALUE 0x70DCA TKW_VV_VV_UB 100.0 FORMULA_0003 0.0 8.0000 /end CHARACTERISTIC
/begin CHARACTERISTIC K_ED_LAM2_REG.KLASSENINDEX "Auswahl der Fehlerklasse | EN: Fault code LAM2_REG - fault class selection (lamp / warning behaviour)" VALUE 0x70DE4 TKW_VV_VV_UB 100.0 FORMULA_0003 0.0 8.0000 /end CHARACTERISTIC
/begin CHARACTERISTIC K_ED_KAT_OBD1.KLASSENINDEX "Auswahl der Fehlerklasse | EN: Fault code KAT_OBD1 - fault class selection (lamp / warning behaviour)" VALUE 0x71242 TKW_VV_VV_UB 100.0 FORMULA_0003 0.0 8.0000 /end CHARACTERISTIC
/begin CHARACTERISTIC K_ED_KAT_OBD2.KLASSENINDEX "Auswahl der Fehlerklasse | EN: Fault code KAT_OBD2 - fault class selection (lamp / warning behaviour)" VALUE 0x7125C TKW_VV_VV_UB 100.0 FORMULA_0003 0.0 8.0000 /end CHARACTERISTIC
/begin CHARACTERISTIC K_ED_FI_QLT.KLASSENINDEX "Auswahl der Fehlerklasse | EN: Fault code FI_QLT - fault class selection (lamp / warning behaviour)" VALUE 0x712C4 TKW_VV_VV_UB 100.0 FORMULA_0003 0.0 8.0000 /end CHARACTERISTIC
/begin CHARACTERISTIC K_ED_FI_PMBN.KLASSENINDEX "Auswahl der Fehlerklasse | EN: Fault code FI_PMBN - fault class selection (lamp / warning behaviour)" VALUE 0x7132C TKW_VV_VV_UB 100.0 FORMULA_0003 0.0 8.0000 /end CHARACTERISTIC
/begin CHARACTERISTIC K_ED_FI_PMRUHVERL.KLASSENINDEX "Auswahl der Fehlerklasse | EN: Fault code FI_PMRUHVERL - fault class selection (lamp / warning behaviour)" VALUE 0x7144A TKW_VV_VV_UB 100.0 FORMULA_0003 0.0 8.0000 /end CHARACTERISTIC
/begin CHARACTERISTIC K_ED_FI_TOENS.KLASSENINDEX "Auswahl der Fehlerklasse | EN: Fault code FI_TOENS - fault class selection (lamp / warning behaviour)" VALUE 0x71464 TKW_VV_VV_UB 100.0 FORMULA_0003 0.0 8.0000 /end CHARACTERISTIC
/begin CHARACTERISTIC K_ED_KW.KLASSENINDEX "Auswahl der Fehlerklasse | EN: Fault code KW - fault class selection (lamp / warning behaviour)" VALUE 0x71582 TKW_VV_VV_UB 100.0 FORMULA_0003 0.0 8.0000 /end CHARACTERISTIC
/begin CHARACTERISTIC K_ED_LA1_ADAPT.KLASSENINDEX "Auswahl der Fehlerklasse | EN: Fault code LA1_ADAPT - fault class selection (lamp / warning behaviour)" VALUE 0x7159C TKW_VV_VV_UB 100.0 FORMULA_0003 0.0 8.0000 /end CHARACTERISTIC
/begin CHARACTERISTIC K_ED_LA2_ADAPT.KLASSENINDEX "Auswahl der Fehlerklasse | EN: Fault code LA2_ADAPT - fault class selection (lamp / warning behaviour)" VALUE 0x715B6 TKW_VV_VV_UB 100.0 FORMULA_0003 0.0 8.0000 /end CHARACTERISTIC
/begin CHARACTERISTIC K_ED_KGE1.KLASSENINDEX "Auswahl der Fehlerklasse | EN: Fault code KGE1 - fault class selection (lamp / warning behaviour) [V912: differs from V452 160E]" VALUE 0x715D0 TKW_VV_VV_UB 100.0 FORMULA_0003 0.0 8.0000 /end CHARACTERISTIC
/begin CHARACTERISTIC K_ED_KGE2.KLASSENINDEX "Auswahl der Fehlerklasse | EN: Fault code KGE2 - fault class selection (lamp / warning behaviour) [V912: differs from V452 160E]" VALUE 0x715EA TKW_VV_VV_UB 100.0 FORMULA_0003 0.0 8.0000 /end CHARACTERISTIC
/begin CHARACTERISTIC K_ED_FST.KLASSENINDEX "Auswahl der Fehlerklasse | EN: Fault code FST - fault class selection (lamp / warning behaviour)" VALUE 0x71604 TKW_VV_VV_UB 100.0 FORMULA_0003 0.0 8.0000 /end CHARACTERISTIC
/begin CHARACTERISTIC K_ED_KSD1.KLASSENINDEX "Auswahl der Fehlerklasse | EN: Fault code KSD1 - fault class selection (lamp / warning behaviour)" VALUE 0x7173C TKW_VV_VV_UB 100.0 FORMULA_0003 0.0 8.0000 /end CHARACTERISTIC
/begin CHARACTERISTIC K_ED_KSD2.KLASSENINDEX "Auswahl der Fehlerklasse | EN: Fault code KSD2 - fault class selection (lamp / warning behaviour)" VALUE 0x71756 TKW_VV_VV_UB 100.0 FORMULA_0003 0.0 8.0000 /end CHARACTERISTIC
/begin CHARACTERISTIC K_ED_KATS_B1.KLASSENINDEX "Auswahl der Fehlerklasse | EN: Fault code KATS_B1 - fault class selection (lamp / warning behaviour)" VALUE 0x71770 TKW_VV_VV_UB 100.0 FORMULA_0003 0.0 8.0000 /end CHARACTERISTIC
/begin CHARACTERISTIC K_ED_KATS_B2.KLASSENINDEX "Auswahl der Fehlerklasse | EN: Fault code KATS_B2 - fault class selection (lamp / warning behaviour)" VALUE 0x7178A TKW_VV_VV_UB 100.0 FORMULA_0003 0.0 8.0000 /end CHARACTERISTIC
/begin CHARACTERISTIC K_ED_FST_GEBER.KLASSENINDEX "Auswahl der Fehlerklasse | EN: Fault code FST_GEBER - fault class selection (lamp / warning behaviour)" VALUE 0x717D8 TKW_VV_VV_UB 100.0 FORMULA_0003 0.0 8.0000 /end CHARACTERISTIC
/begin CHARACTERISTIC K_ED_LA1_TRIM_AD.KLASSENINDEX "Auswahl der Fehlerklasse | EN: Fault code LA1_TRIM_AD - fault class selection (lamp / warning behaviour)" VALUE 0x71874 TKW_VV_VV_UB 100.0 FORMULA_0003 0.0 8.0000 /end CHARACTERISTIC
/begin CHARACTERISTIC K_ED_LA2_TRIM_AD.KLASSENINDEX "Auswahl der Fehlerklasse | EN: Fault code LA2_TRIM_AD - fault class selection (lamp / warning behaviour)" VALUE 0x7188E TKW_VV_VV_UB 100.0 FORMULA_0003 0.0 8.0000 /end CHARACTERISTIC
/begin CHARACTERISTIC K_ED_LANK1_OPENLOAD.KLASSENINDEX "Auswahl der Fehlerklasse | EN: Fault code LANK1_OPENLOAD - fault class selection (lamp / warning behaviour) [V912: differs from V452 160E]" VALUE 0x718A8 TKW_VV_VV_UB 100.0 FORMULA_0003 0.0 8.0000 /end CHARACTERISTIC
/begin CHARACTERISTIC K_ED_LANK2_OPENLOAD.KLASSENINDEX "Auswahl der Fehlerklasse | EN: Fault code LANK2_OPENLOAD - fault class selection (lamp / warning behaviour) [V912: differs from V452 160E]" VALUE 0x718C2 TKW_VV_VV_UB 100.0 FORMULA_0003 0.0 8.0000 /end CHARACTERISTIC
/begin CHARACTERISTIC K_ED_LANK1_OBD_WE.KLASSENINDEX "Auswahl der Fehlerklasse | EN: Fault code LANK1_OBD_WE - fault class selection (lamp / warning behaviour) [V912: differs from V452 160E]" VALUE 0x718DC TKW_VV_VV_UB 100.0 FORMULA_0003 0.0 8.0000 /end CHARACTERISTIC
/begin CHARACTERISTIC K_ED_LANK2_OBD_WE.KLASSENINDEX "Auswahl der Fehlerklasse | EN: Fault code LANK2_OBD_WE - fault class selection (lamp / warning behaviour) [V912: differs from V452 160E]" VALUE 0x718F6 TKW_VV_VV_UB 100.0 FORMULA_0003 0.0 8.0000 /end CHARACTERISTIC
/begin CHARACTERISTIC K_ED_FST_GEBER_LI.KLASSENINDEX "Auswahl der Fehlerklasse" VALUE 0x719FA TKW_VV_VV_UB 100.0 FORMULA_0003 0.0 8.0000 /end CHARACTERISTIC
/begin CHARACTERISTIC K_ED_FST_GEBER_RE.KLASSENINDEX "Auswahl der Fehlerklasse" VALUE 0x71A14 TKW_VV_VV_UB 100.0 FORMULA_0003 0.0 8.0000 /end CHARACTERISTIC
/begin CHARACTERISTIC K_ED_LANK1_OBD_SLOPE.KLASSENINDEX "Auswahl der Fehlerklasse [V912: differs from V452 160E]" VALUE 0x71A2E TKW_VV_VV_UB 100.0 FORMULA_0003 0.0 8.0000 /end CHARACTERISTIC
/begin CHARACTERISTIC K_ED_LANK2_OBD_SLOPE.KLASSENINDEX "Auswahl der Fehlerklasse [V912: differs from V452 160E]" VALUE 0x71A48 TKW_VV_VV_UB 100.0 FORMULA_0003 0.0 8.0000 /end CHARACTERISTIC
/begin CHARACTERISTIC K_ED_INDEX_204_INJ.KLASSENINDEX "Auswahl der Fehlerklasse | EN: Fault code INDEX_204_INJ - fault class selection (lamp / warning behaviour)" VALUE 0x71AB0 TKW_VV_VV_UB 100.0 FORMULA_0003 0.0 8.0000 /end CHARACTERISTIC
/begin CHARACTERISTIC K_ED_INDEX_205_INJ.KLASSENINDEX "Auswahl der Fehlerklasse | EN: Fault code INDEX_205_INJ - fault class selection (lamp / warning behaviour)" VALUE 0x71ACA TKW_VV_VV_UB 100.0 FORMULA_0003 0.0 8.0000 /end CHARACTERISTIC
/begin CHARACTERISTIC K_ED_INDEX_206_INJ.KLASSENINDEX "Auswahl der Fehlerklasse | EN: Fault code INDEX_206_INJ - fault class selection (lamp / warning behaviour)" VALUE 0x71AE4 TKW_VV_VV_UB 100.0 FORMULA_0003 0.0 8.0000 /end CHARACTERISTIC
/begin CHARACTERISTIC K_ED_INDEX_207_INJ.KLASSENINDEX "Auswahl der Fehlerklasse" VALUE 0x71AFE TKW_VV_VV_UB 100.0 FORMULA_0003 0.0 8.0000 /end CHARACTERISTIC
/begin CHARACTERISTIC K_ED_INDEX_208_INJ.KLASSENINDEX "Auswahl der Fehlerklasse" VALUE 0x71B18 TKW_VV_VV_UB 100.0 FORMULA_0003 0.0 8.0000 /end CHARACTERISTIC
/begin CHARACTERISTIC K_ED_INDEX_209_INJ.KLASSENINDEX "Auswahl der Fehlerklasse" VALUE 0x71B32 TKW_VV_VV_UB 100.0 FORMULA_0003 0.0 8.0000 /end CHARACTERISTIC
/begin CHARACTERISTIC K_ED_INDEX_210_INJ.KLASSENINDEX "Auswahl der Fehlerklasse" VALUE 0x71B4C TKW_VV_VV_UB 100.0 FORMULA_0003 0.0 8.0000 /end CHARACTERISTIC
/begin CHARACTERISTIC K_ED_INDEX_211_INJ.KLASSENINDEX "Auswahl der Fehlerklasse" VALUE 0x71B66 TKW_VV_VV_UB 100.0 FORMULA_0003 0.0 8.0000 /end CHARACTERISTIC
/begin CHARACTERISTIC K_ED_INDEX_212_INJ.KLASSENINDEX "Auswahl der Fehlerklasse" VALUE 0x71B80 TKW_VV_VV_UB 100.0 FORMULA_0003 0.0 8.0000 /end CHARACTERISTIC
/begin CHARACTERISTIC K_ED_INDEX_213_INJ.KLASSENINDEX "Auswahl der Fehlerklasse" VALUE 0x71B9A TKW_VV_VV_UB 100.0 FORMULA_0003 0.0 8.0000 /end CHARACTERISTIC
/begin CHARACTERISTIC K_ED_INDEX_214_INJ.KLASSENINDEX "Auswahl der Fehlerklasse" VALUE 0x71BB4 TKW_VV_VV_UB 100.0 FORMULA_0003 0.0 8.0000 /end CHARACTERISTIC
/begin CHARACTERISTIC K_ED_INDEX_215_INJ.KLASSENINDEX "Auswahl der Fehlerklasse" VALUE 0x71BCE TKW_VV_VV_UB 100.0 FORMULA_0003 0.0 8.0000 /end CHARACTERISTIC
/begin CHARACTERISTIC K_ED_INDEX_216_INJ.KLASSENINDEX "Auswahl der Fehlerklasse | EN: Auswahl der Fehlerklasse" VALUE 0x71BE8 TKW_VV_VV_UB 100.0 FORMULA_0003 0.0 8.0000 /end CHARACTERISTIC
/begin CHARACTERISTIC K_ED_INDEX_217_INJ.KLASSENINDEX "Auswahl der Fehlerklasse | EN: Auswahl der Fehlerklasse" VALUE 0x71C02 TKW_VV_VV_UB 100.0 FORMULA_0003 0.0 8.0000 /end CHARACTERISTIC
/begin CHARACTERISTIC K_ED_INDEX_218_INJ.KLASSENINDEX "Auswahl der Fehlerklasse | EN: Auswahl der Fehlerklasse" VALUE 0x71C1C TKW_VV_VV_UB 100.0 FORMULA_0003 0.0 8.0000 /end CHARACTERISTIC
/begin CHARACTERISTIC K_ED_INDEX_219_INJ.KLASSENINDEX "Auswahl der Fehlerklasse | EN: Auswahl der Fehlerklasse" VALUE 0x71C36 TKW_VV_VV_UB 100.0 FORMULA_0003 0.0 8.0000 /end CHARACTERISTIC
/begin CHARACTERISTIC K_ED_INDEX_220_INJ.KLASSENINDEX "Auswahl der Fehlerklasse | EN: Auswahl der Fehlerklasse" VALUE 0x71C50 TKW_VV_VV_UB 100.0 FORMULA_0003 0.0 8.0000 /end CHARACTERISTIC
/begin CHARACTERISTIC K_ED_INDEX_221_INJ.KLASSENINDEX "Auswahl der Fehlerklasse" VALUE 0x71C6A TKW_VV_VV_UB 100.0 FORMULA_0003 0.0 8.0000 /end CHARACTERISTIC
/begin CHARACTERISTIC K_ED_INDEX_222_INJ.KLASSENINDEX "Auswahl der Fehlerklasse" VALUE 0x71C84 TKW_VV_VV_UB 100.0 FORMULA_0003 0.0 8.0000 /end CHARACTERISTIC
/begin CHARACTERISTIC K_ED_INDEX_223_INJ.KLASSENINDEX "Auswahl der Fehlerklasse" VALUE 0x71C9E TKW_VV_VV_UB 100.0 FORMULA_0003 0.0 8.0000 /end CHARACTERISTIC
/begin FUNCTION Eigendiagnose ""
 /begin DEF_CHARACTERISTIC K_ED_FI_BSD.DEC_NACH_EINTRAG K_ED_FI_BSD.DEC_VOR_EINTRAG K_ED_FI_BSD.FEHLERSCHWELLE K_ED_FI_BSD.INC_NACH_EINTRAG K_ED_FI_BSD.INC_VOR_EINTRAG K_ED_FI_BSD.OK_SCHWELLE K_ED_FI_BSD.P_CODE_UNPLAUSIBEL K_ED_FI_BSDGLOB.DEC_NACH_EINTRAG K_ED_FI_BSDGLOB.DEC_VOR_EINTRAG K_ED_FI_BSDGLOB.FEHLERSCHWELLE K_ED_FI_BSDGLOB.INC_NACH_EINTRAG K_ED_FI_BSDGLOB.INC_VOR_EINTRAG K_ED_FI_BSDGLOB.OK_SCHWELLE K_ED_FI_BSD_0.DEC_NACH_EINTRAG K_ED_FI_BSD_0.DEC_VOR_EINTRAG K_ED_FI_BSD_0.FEHLERSCHWELLE K_ED_FI_BSD_0.INC_NACH_EINTRAG K_ED_FI_BSD_0.INC_VOR_EINTRAG K_ED_FI_BSD_0.OK_SCHWELLE K_ED_FI_BSD_6.DEC_NACH_EINTRAG K_ED_FI_BSD_6.DEC_VOR_EINTRAG K_ED_FI_BSD_6.INC_NACH_EINTRAG K_ED_FI_BSD_6.INC_VOR_EINTRAG K_ED_FI_BSD_6.OK_SCHWELLE K_ED_FI_GEN.DEC_NACH_EINTRAG K_ED_FI_GEN.DEC_VOR_EINTRAG K_ED_FI_GEN.FEHLERSCHWELLE K_ED_FI_GEN.INC_NACH_EINTRAG K_ED_FI_GEN.OK_SCHWELLE K_ED_FI_GEN.P_CODE_OPENLOAD K_ED_FI_GEN.P_CODE_SH_TO_UB K_ED_FI_GEN.P_CODE_UNPLAUSIBEL K_ED_FI_IBS1.DEC_NACH_EINTRAG K_ED_FI_IBS1.DEC_VOR_EINTRAG K_ED_FI_IBS1.FEHLERSCHWELLE K_ED_FI_IBS1.INC_NACH_EINTRAG K_ED_FI_IBS1.INC_VOR_EINTRAG K_ED_FI_IBS1.OK_SCHWELLE K_ED_FI_IBS1.P_CODE_OPENLOAD K_ED_FI_IBS1.P_CODE_SH_TO_UB K_ED_FI_IBS1.P_CODE_UNPLAUSIBEL K_ED_FI_IBS2.DEC_NACH_EINTRAG K_ED_FI_IBS2.DEC_VOR_EINTRAG K_ED_FI_IBS2.FEHLERSCHWELLE K_ED_FI_IBS2.INC_NACH_EINTRAG K_ED_FI_IBS2.INC_VOR_EINTRAG K_ED_FI_IBS2.OK_SCHWELLE K_ED_FI_IBS2.P_CODE_OPENLOAD K_ED_FI_IBS2.P_CODE_SH_TO_UB K_ED_FI_IBS2.P_CODE_UNPLAUSIBEL K_ED_FI_IBS3.DEC_NACH_EINTRAG K_ED_FI_IBS3.DEC_VOR_EINTRAG K_ED_FI_IBS3.FEHLERSCHWELLE K_ED_FI_IBS3.INC_NACH_EINTRAG K_ED_FI_IBS3.INC_VOR_EINTRAG K_ED_FI_IBS3.OK_SCHWELLE K_ED_FI_IBS3.P_CODE_OPENLOAD K_ED_FI_IBS3.P_CODE_SH_TO_UB K_ED_FI_IBS3.P_CODE_UNPLAUSIBEL K_ED_FI_PMBATT.DEC_NACH_EINTRAG K_ED_FI_PMBATT.DEC_VOR_EINTRAG K_ED_FI_PMBATT.FEHLERSCHWELLE K_ED_FI_PMBATT.INC_NACH_EINTRAG K_ED_FI_PMBATT.INC_VOR_EINTRAG K_ED_FI_PMBATT.OK_SCHWELLE K_ED_FI_PMBATT.P_CODE_SH_TO_GND K_ED_FI_PMBATT.P_CODE_UNPLAUSIBEL K_ED_FI_PMBN.DEC_NACH_EINTRAG K_ED_FI_PMBN.DEC_VOR_EINTRAG K_ED_FI_PMBN.FEHLERSCHWELLE K_ED_FI_PMBN.INC_NACH_EINTRAG K_ED_FI_PMBN.INC_VOR_EINTRAG K_ED_FI_PMBN.KLASSENINDEX K_ED_FI_PMBN.OK_SCHWELLE K_ED_FI_PMBN.P_CODE_OPENLOAD K_ED_FI_PMBN.P_CODE_SH_TO_GND K_ED_FI_PMBN.P_CODE_SH_TO_UB K_ED_FI_PMBN.P_CODE_UNPLAUSIBEL K_ED_FI_PMRUHVERL.DEC_NACH_EINTRAG K_ED_FI_PMRUHVERL.DEC_VOR_EINTRAG K_ED_FI_PMRUHVERL.FEHLERSCHWELLE K_ED_FI_PMRUHVERL.INC_NACH_EINTRAG K_ED_FI_PMRUHVERL.INC_VOR_EINTRAG K_ED_FI_PMRUHVERL.KLASSENINDEX K_ED_FI_PMRUHVERL.OK_SCHWELLE K_ED_FI_PMRUHVERL.P_CODE_OPENLOAD K_ED_FI_PMRUHVERL.P_CODE_SH_TO_GND K_ED_FI_PMRUHVERL.P_CODE_SH_TO_UB K_ED_FI_PMRUHVERL.P_CODE_UNPLAUSIBEL K_ED_FI_QLT.DEC_NACH_EINTRAG K_ED_FI_QLT.DEC_VOR_EINTRAG K_ED_FI_QLT.FEHLERSCHWELLE K_ED_FI_QLT.INC_NACH_EINTRAG K_ED_FI_QLT.INC_VOR_EINTRAG K_ED_FI_QLT.KLASSENINDEX K_ED_FI_QLT.OK_SCHWELLE K_ED_FI_QLT.P_CODE_OPENLOAD K_ED_FI_QLT.P_CODE_SH_TO_GND K_ED_FI_QLT.P_CODE_SH_TO_UB K_ED_FI_QLT.P_CODE_UNPLAUSIBEL K_ED_FI_TOENS.DEC_NACH_EINTRAG K_ED_FI_TOENS.DEC_VOR_EINTRAG K_ED_FI_TOENS.FEHLERSCHWELLE K_ED_FI_TOENS.INC_NACH_EINTRAG K_ED_FI_TOENS.INC_VOR_EINTRAG K_ED_FI_TOENS.KLASSENINDEX K_ED_FI_TOENS.OK_SCHWELLE K_ED_FI_TOENS.P_CODE_OPENLOAD K_ED_FI_TOENS.P_CODE_SH_TO_GND K_ED_FI_TOENS.P_CODE_SH_TO_UB K_ED_FI_TOENS.P_CODE_UNPLAUSIBEL K_ED_FPLAU1.DEC_NACH_EINTRAG K_ED_FPLAU1.DEC_VOR_EINTRAG K_ED_FPLAU1.FEHLERSCHWELLE K_ED_FPLAU1.INC_NACH_EINTRAG K_ED_FPLAU1.INC_VOR_EINTRAG K_ED_FPLAU1.KLASSENINDEX K_ED_FPLAU1.OK_SCHWELLE K_ED_FPLAU1.P_CODE_OPENLOAD K_ED_FPLAU1.P_CODE_SH_TO_GND K_ED_FPLAU1.P_CODE_SH_TO_UB K_ED_FPLAU1.P_CODE_UNPLAUSIBEL K_ED_FPLAU2.DEC_NACH_EINTRAG K_ED_FPLAU2.DEC_VOR_EINTRAG K_ED_FPLAU2.FEHLERSCHWELLE K_ED_FPLAU2.INC_NACH_EINTRAG K_ED_FPLAU2.INC_VOR_EINTRAG K_ED_FPLAU2.KLASSENINDEX K_ED_FPLAU2.OK_SCHWELLE K_ED_FPLAU2.P_CODE_OPENLOAD K_ED_FPLAU2.P_CODE_SH_TO_GND K_ED_FPLAU2.P_CODE_SH_TO_UB K_ED_FPLAU2.P_CODE_UNPLAUSIBEL K_ED_FST.DEC_NACH_EINTRAG K_ED_FST.DEC_VOR_EINTRAG K_ED_FST.FEHLERSCHWELLE K_ED_FST.INC_NACH_EINTRAG K_ED_FST.INC_VOR_EINTRAG K_ED_FST.KLASSENINDEX K_ED_FST.OK_SCHWELLE K_ED_FST.P_CODE_OPENLOAD K_ED_FST.P_CODE_SH_TO_GND K_ED_FST.P_CODE_SH_TO_UB K_ED_FST.P_CODE_UNPLAUSIBEL K_ED_FST_GEBER.DEC_NACH_EINTRAG K_ED_FST_GEBER.DEC_VOR_EINTRAG K_ED_FST_GEBER.FEHLERSCHWELLE K_ED_FST_GEBER.INC_NACH_EINTRAG K_ED_FST_GEBER.INC_VOR_EINTRAG K_ED_FST_GEBER.KLASSENINDEX K_ED_FST_GEBER.OK_SCHWELLE K_ED_FST_GEBER.P_CODE_OPENLOAD K_ED_FST_GEBER.P_CODE_SH_TO_GND K_ED_FST_GEBER.P_CODE_SH_TO_UB K_ED_FST_GEBER.P_CODE_UNPLAUSIBEL K_ED_FST_GEBER_LI.DEC_NACH_EINTRAG K_ED_FST_GEBER_LI.DEC_VOR_EINTRAG K_ED_FST_GEBER_LI.FEHLERSCHWELLE K_ED_FST_GEBER_LI.INC_NACH_EINTRAG K_ED_FST_GEBER_LI.INC_VOR_EINTRAG K_ED_FST_GEBER_LI.KLASSENINDEX K_ED_FST_GEBER_LI.OK_SCHWELLE K_ED_FST_GEBER_LI.P_CODE_OPENLOAD K_ED_FST_GEBER_LI.P_CODE_SH_TO_GND K_ED_FST_GEBER_LI.P_CODE_SH_TO_UB K_ED_FST_GEBER_LI.P_CODE_UNPLAUSIBEL K_ED_FST_GEBER_RE.DEC_NACH_EINTRAG K_ED_FST_GEBER_RE.DEC_VOR_EINTRAG K_ED_FST_GEBER_RE.FEHLERSCHWELLE K_ED_FST_GEBER_RE.INC_NACH_EINTRAG K_ED_FST_GEBER_RE.INC_VOR_EINTRAG K_ED_FST_GEBER_RE.KLASSENINDEX K_ED_FST_GEBER_RE.OK_SCHWELLE K_ED_FST_GEBER_RE.P_CODE_OPENLOAD K_ED_FST_GEBER_RE.P_CODE_SH_TO_GND K_ED_FST_GEBER_RE.P_CODE_SH_TO_UB K_ED_FST_GEBER_RE.P_CODE_UNPLAUSIBEL K_ED_FST_MAX K_ED_HFM1.DEC_NACH_EINTRAG K_ED_HFM1.DEC_VOR_EINTRAG K_ED_HFM1.FEHLERSCHWELLE K_ED_HFM1.INC_NACH_EINTRAG K_ED_HFM1.INC_VOR_EINTRAG K_ED_HFM1.KLASSENINDEX K_ED_HFM1.OK_SCHWELLE K_ED_HFM1.P_CODE_SH_TO_GND K_ED_HFM1.P_CODE_SH_TO_UB K_ED_HFM2.DEC_NACH_EINTRAG K_ED_HFM2.DEC_VOR_EINTRAG K_ED_HFM2.FEHLERSCHWELLE K_ED_HFM2.INC_NACH_EINTRAG K_ED_HFM2.INC_VOR_EINTRAG K_ED_HFM2.KLASSENINDEX K_ED_HFM2.OK_SCHWELLE K_ED_HFM2.P_CODE_SH_TO_GND K_ED_HFM2.P_CODE_SH_TO_UB K_ED_INDEX_204_INJ.DEC_NACH_EINTRAG K_ED_INDEX_204_INJ.DEC_VOR_EINTRAG K_ED_INDEX_204_INJ.FEHLERSCHWELLE K_ED_INDEX_204_INJ.INC_NACH_EINTRAG K_ED_INDEX_204_INJ.INC_VOR_EINTRAG K_ED_INDEX_204_INJ.KLASSENINDEX K_ED_INDEX_204_INJ.OK_SCHWELLE K_ED_INDEX_204_INJ.P_CODE_OPENLOAD K_ED_INDEX_204_INJ.P_CODE_SH_TO_GND K_ED_INDEX_204_INJ.P_CODE_SH_TO_UB K_ED_INDEX_204_INJ.P_CODE_UNPLAUSIBEL K_ED_INDEX_205_INJ.DEC_NACH_EINTRAG K_ED_INDEX_205_INJ.DEC_VOR_EINTRAG K_ED_INDEX_205_INJ.FEHLERSCHWELLE K_ED_INDEX_205_INJ.INC_NACH_EINTRAG K_ED_INDEX_205_INJ.INC_VOR_EINTRAG K_ED_INDEX_205_INJ.KLASSENINDEX K_ED_INDEX_205_INJ.OK_SCHWELLE K_ED_INDEX_205_INJ.P_CODE_OPENLOAD K_ED_INDEX_205_INJ.P_CODE_SH_TO_GND K_ED_INDEX_205_INJ.P_CODE_SH_TO_UB K_ED_INDEX_205_INJ.P_CODE_UNPLAUSIBEL K_ED_INDEX_206_INJ.DEC_NACH_EINTRAG K_ED_INDEX_206_INJ.DEC_VOR_EINTRAG K_ED_INDEX_206_INJ.FEHLERSCHWELLE K_ED_INDEX_206_INJ.INC_NACH_EINTRAG K_ED_INDEX_206_INJ.INC_VOR_EINTRAG K_ED_INDEX_206_INJ.KLASSENINDEX K_ED_INDEX_206_INJ.OK_SCHWELLE K_ED_INDEX_206_INJ.P_CODE_OPENLOAD K_ED_INDEX_206_INJ.P_CODE_SH_TO_GND K_ED_INDEX_206_INJ.P_CODE_SH_TO_UB K_ED_INDEX_206_INJ.P_CODE_UNPLAUSIBEL K_ED_INDEX_207_INJ.DEC_NACH_EINTRAG K_ED_INDEX_207_INJ.DEC_VOR_EINTRAG K_ED_INDEX_207_INJ.FEHLERSCHWELLE K_ED_INDEX_207_INJ.INC_NACH_EINTRAG K_ED_INDEX_207_INJ.INC_VOR_EINTRAG K_ED_INDEX_207_INJ.KLASSENINDEX K_ED_INDEX_207_INJ.OK_SCHWELLE K_ED_INDEX_207_INJ.P_CODE_OPENLOAD K_ED_INDEX_207_INJ.P_CODE_SH_TO_GND K_ED_INDEX_207_INJ.P_CODE_SH_TO_UB K_ED_INDEX_207_INJ.P_CODE_UNPLAUSIBEL K_ED_INDEX_208_INJ.DEC_NACH_EINTRAG K_ED_INDEX_208_INJ.DEC_VOR_EINTRAG K_ED_INDEX_208_INJ.FEHLERSCHWELLE K_ED_INDEX_208_INJ.INC_NACH_EINTRAG K_ED_INDEX_208_INJ.INC_VOR_EINTRAG K_ED_INDEX_208_INJ.KLASSENINDEX K_ED_INDEX_208_INJ.OK_SCHWELLE K_ED_INDEX_208_INJ.P_CODE_OPENLOAD K_ED_INDEX_208_INJ.P_CODE_SH_TO_GND K_ED_INDEX_208_INJ.P_CODE_SH_TO_UB K_ED_INDEX_208_INJ.P_CODE_UNPLAUSIBEL K_ED_INDEX_209_INJ.DEC_NACH_EINTRAG K_ED_INDEX_209_INJ.DEC_VOR_EINTRAG K_ED_INDEX_209_INJ.FEHLERSCHWELLE K_ED_INDEX_209_INJ.INC_NACH_EINTRAG K_ED_INDEX_209_INJ.INC_VOR_EINTRAG K_ED_INDEX_209_INJ.KLASSENINDEX K_ED_INDEX_209_INJ.OK_SCHWELLE K_ED_INDEX_209_INJ.P_CODE_OPENLOAD K_ED_INDEX_209_INJ.P_CODE_SH_TO_GND K_ED_INDEX_209_INJ.P_CODE_SH_TO_UB K_ED_INDEX_209_INJ.P_CODE_UNPLAUSIBEL K_ED_INDEX_210_INJ.DEC_NACH_EINTRAG K_ED_INDEX_210_INJ.DEC_VOR_EINTRAG K_ED_INDEX_210_INJ.FEHLERSCHWELLE K_ED_INDEX_210_INJ.INC_NACH_EINTRAG K_ED_INDEX_210_INJ.INC_VOR_EINTRAG K_ED_INDEX_210_INJ.KLASSENINDEX K_ED_INDEX_210_INJ.OK_SCHWELLE K_ED_INDEX_210_INJ.P_CODE_OPENLOAD K_ED_INDEX_210_INJ.P_CODE_SH_TO_GND K_ED_INDEX_210_INJ.P_CODE_SH_TO_UB K_ED_INDEX_210_INJ.P_CODE_UNPLAUSIBEL K_ED_INDEX_211_INJ.DEC_NACH_EINTRAG K_ED_INDEX_211_INJ.DEC_VOR_EINTRAG K_ED_INDEX_211_INJ.FEHLERSCHWELLE K_ED_INDEX_211_INJ.INC_NACH_EINTRAG K_ED_INDEX_211_INJ.INC_VOR_EINTRAG K_ED_INDEX_211_INJ.KLASSENINDEX K_ED_INDEX_211_INJ.OK_SCHWELLE K_ED_INDEX_211_INJ.P_CODE_OPENLOAD K_ED_INDEX_211_INJ.P_CODE_SH_TO_GND K_ED_INDEX_211_INJ.P_CODE_SH_TO_UB K_ED_INDEX_211_INJ.P_CODE_UNPLAUSIBEL K_ED_INDEX_212_INJ.DEC_NACH_EINTRAG K_ED_INDEX_212_INJ.DEC_VOR_EINTRAG K_ED_INDEX_212_INJ.FEHLERSCHWELLE K_ED_INDEX_212_INJ.INC_NACH_EINTRAG K_ED_INDEX_212_INJ.INC_VOR_EINTRAG K_ED_INDEX_212_INJ.KLASSENINDEX K_ED_INDEX_212_INJ.OK_SCHWELLE K_ED_INDEX_212_INJ.P_CODE_OPENLOAD K_ED_INDEX_212_INJ.P_CODE_SH_TO_GND K_ED_INDEX_212_INJ.P_CODE_SH_TO_UB K_ED_INDEX_212_INJ.P_CODE_UNPLAUSIBEL K_ED_INDEX_213_INJ.DEC_NACH_EINTRAG K_ED_INDEX_213_INJ.DEC_VOR_EINTRAG K_ED_INDEX_213_INJ.FEHLERSCHWELLE K_ED_INDEX_213_INJ.INC_NACH_EINTRAG K_ED_INDEX_213_INJ.INC_VOR_EINTRAG K_ED_INDEX_213_INJ.KLASSENINDEX K_ED_INDEX_213_INJ.OK_SCHWELLE K_ED_INDEX_213_INJ.P_CODE_OPENLOAD K_ED_INDEX_213_INJ.P_CODE_SH_TO_GND K_ED_INDEX_213_INJ.P_CODE_SH_TO_UB K_ED_INDEX_213_INJ.P_CODE_UNPLAUSIBEL K_ED_INDEX_214_INJ.DEC_NACH_EINTRAG K_ED_INDEX_214_INJ.DEC_VOR_EINTRAG K_ED_INDEX_214_INJ.FEHLERSCHWELLE K_ED_INDEX_214_INJ.INC_NACH_EINTRAG K_ED_INDEX_214_INJ.INC_VOR_EINTRAG K_ED_INDEX_214_INJ.KLASSENINDEX K_ED_INDEX_214_INJ.OK_SCHWELLE K_ED_INDEX_214_INJ.P_CODE_OPENLOAD K_ED_INDEX_214_INJ.P_CODE_SH_TO_GND K_ED_INDEX_214_INJ.P_CODE_SH_TO_UB K_ED_INDEX_214_INJ.P_CODE_UNPLAUSIBEL K_ED_INDEX_215_INJ.DEC_NACH_EINTRAG K_ED_INDEX_215_INJ.DEC_VOR_EINTRAG K_ED_INDEX_215_INJ.FEHLERSCHWELLE K_ED_INDEX_215_INJ.INC_NACH_EINTRAG K_ED_INDEX_215_INJ.INC_VOR_EINTRAG K_ED_INDEX_215_INJ.KLASSENINDEX K_ED_INDEX_215_INJ.OK_SCHWELLE K_ED_INDEX_215_INJ.P_CODE_OPENLOAD K_ED_INDEX_215_INJ.P_CODE_SH_TO_GND K_ED_INDEX_215_INJ.P_CODE_SH_TO_UB K_ED_INDEX_215_INJ.P_CODE_UNPLAUSIBEL K_ED_INDEX_216_INJ.DEC_NACH_EINTRAG K_ED_INDEX_216_INJ.DEC_VOR_EINTRAG K_ED_INDEX_216_INJ.FEHLERSCHWELLE K_ED_INDEX_216_INJ.INC_NACH_EINTRAG K_ED_INDEX_216_INJ.INC_VOR_EINTRAG K_ED_INDEX_216_INJ.KLASSENINDEX K_ED_INDEX_216_INJ.OK_SCHWELLE K_ED_INDEX_216_INJ.P_CODE_OPENLOAD K_ED_INDEX_216_INJ.P_CODE_SH_TO_GND K_ED_INDEX_216_INJ.P_CODE_SH_TO_UB K_ED_INDEX_216_INJ.P_CODE_UNPLAUSIBEL K_ED_INDEX_217_INJ.DEC_NACH_EINTRAG K_ED_INDEX_217_INJ.DEC_VOR_EINTRAG K_ED_INDEX_217_INJ.FEHLERSCHWELLE K_ED_INDEX_217_INJ.INC_NACH_EINTRAG K_ED_INDEX_217_INJ.INC_VOR_EINTRAG K_ED_INDEX_217_INJ.KLASSENINDEX K_ED_INDEX_217_INJ.OK_SCHWELLE K_ED_INDEX_217_INJ.P_CODE_OPENLOAD K_ED_INDEX_217_INJ.P_CODE_SH_TO_GND K_ED_INDEX_217_INJ.P_CODE_SH_TO_UB K_ED_INDEX_217_INJ.P_CODE_UNPLAUSIBEL K_ED_INDEX_218_INJ.DEC_NACH_EINTRAG K_ED_INDEX_218_INJ.DEC_VOR_EINTRAG K_ED_INDEX_218_INJ.FEHLERSCHWELLE K_ED_INDEX_218_INJ.INC_NACH_EINTRAG K_ED_INDEX_218_INJ.INC_VOR_EINTRAG K_ED_INDEX_218_INJ.KLASSENINDEX K_ED_INDEX_218_INJ.OK_SCHWELLE K_ED_INDEX_218_INJ.P_CODE_OPENLOAD K_ED_INDEX_218_INJ.P_CODE_SH_TO_GND K_ED_INDEX_218_INJ.P_CODE_SH_TO_UB K_ED_INDEX_218_INJ.P_CODE_UNPLAUSIBEL K_ED_INDEX_219_INJ.DEC_NACH_EINTRAG K_ED_INDEX_219_INJ.DEC_VOR_EINTRAG K_ED_INDEX_219_INJ.FEHLERSCHWELLE K_ED_INDEX_219_INJ.INC_NACH_EINTRAG K_ED_INDEX_219_INJ.INC_VOR_EINTRAG K_ED_INDEX_219_INJ.KLASSENINDEX K_ED_INDEX_219_INJ.OK_SCHWELLE K_ED_INDEX_219_INJ.P_CODE_OPENLOAD K_ED_INDEX_219_INJ.P_CODE_SH_TO_GND K_ED_INDEX_219_INJ.P_CODE_SH_TO_UB K_ED_INDEX_219_INJ.P_CODE_UNPLAUSIBEL K_ED_INDEX_220_INJ.DEC_NACH_EINTRAG K_ED_INDEX_220_INJ.DEC_VOR_EINTRAG K_ED_INDEX_220_INJ.FEHLERSCHWELLE K_ED_INDEX_220_INJ.INC_NACH_EINTRAG K_ED_INDEX_220_INJ.INC_VOR_EINTRAG K_ED_INDEX_220_INJ.KLASSENINDEX K_ED_INDEX_220_INJ.OK_SCHWELLE K_ED_INDEX_220_INJ.P_CODE_OPENLOAD K_ED_INDEX_220_INJ.P_CODE_SH_TO_GND K_ED_INDEX_220_INJ.P_CODE_SH_TO_UB K_ED_INDEX_220_INJ.P_CODE_UNPLAUSIBEL K_ED_INDEX_221_INJ.DEC_NACH_EINTRAG K_ED_INDEX_221_INJ.DEC_VOR_EINTRAG K_ED_INDEX_221_INJ.FEHLERSCHWELLE K_ED_INDEX_221_INJ.INC_NACH_EINTRAG K_ED_INDEX_221_INJ.INC_VOR_EINTRAG K_ED_INDEX_221_INJ.KLASSENINDEX K_ED_INDEX_221_INJ.OK_SCHWELLE K_ED_INDEX_221_INJ.P_CODE_OPENLOAD K_ED_INDEX_221_INJ.P_CODE_SH_TO_GND K_ED_INDEX_221_INJ.P_CODE_SH_TO_UB K_ED_INDEX_221_INJ.P_CODE_UNPLAUSIBEL K_ED_INDEX_222_INJ.DEC_NACH_EINTRAG K_ED_INDEX_222_INJ.DEC_VOR_EINTRAG K_ED_INDEX_222_INJ.FEHLERSCHWELLE K_ED_INDEX_222_INJ.INC_NACH_EINTRAG K_ED_INDEX_222_INJ.INC_VOR_EINTRAG K_ED_INDEX_222_INJ.KLASSENINDEX K_ED_INDEX_222_INJ.OK_SCHWELLE K_ED_INDEX_222_INJ.P_CODE_OPENLOAD K_ED_INDEX_222_INJ.P_CODE_SH_TO_GND K_ED_INDEX_222_INJ.P_CODE_SH_TO_UB K_ED_INDEX_222_INJ.P_CODE_UNPLAUSIBEL K_ED_INDEX_223_INJ.DEC_NACH_EINTRAG K_ED_INDEX_223_INJ.DEC_VOR_EINTRAG K_ED_INDEX_223_INJ.FEHLERSCHWELLE K_ED_INDEX_223_INJ.INC_NACH_EINTRAG K_ED_INDEX_223_INJ.INC_VOR_EINTRAG K_ED_INDEX_223_INJ.KLASSENINDEX K_ED_INDEX_223_INJ.OK_SCHWELLE K_ED_INDEX_223_INJ.P_CODE_OPENLOAD K_ED_INDEX_223_INJ.P_CODE_SH_TO_GND K_ED_INDEX_223_INJ.P_CODE_SH_TO_UB K_ED_INDEX_223_INJ.P_CODE_UNPLAUSIBEL K_ED_KATS_B1.DEC_NACH_EINTRAG K_ED_KATS_B1.DEC_VOR_EINTRAG K_ED_KATS_B1.FEHLERSCHWELLE K_ED_KATS_B1.INC_NACH_EINTRAG K_ED_KATS_B1.INC_VOR_EINTRAG K_ED_KATS_B1.KLASSENINDEX K_ED_KATS_B1.OK_SCHWELLE K_ED_KATS_B1.P_CODE_OPENLOAD K_ED_KATS_B1.P_CODE_SH_TO_GND K_ED_KATS_B1.P_CODE_SH_TO_UB K_ED_KATS_B1.P_CODE_UNPLAUSIBEL K_ED_KATS_B2.DEC_NACH_EINTRAG K_ED_KATS_B2.DEC_VOR_EINTRAG K_ED_KATS_B2.FEHLERSCHWELLE K_ED_KATS_B2.INC_NACH_EINTRAG K_ED_KATS_B2.INC_VOR_EINTRAG K_ED_KATS_B2.KLASSENINDEX K_ED_KATS_B2.OK_SCHWELLE K_ED_KATS_B2.P_CODE_OPENLOAD K_ED_KATS_B2.P_CODE_SH_TO_GND K_ED_KATS_B2.P_CODE_SH_TO_UB K_ED_KATS_B2.P_CODE_UNPLAUSIBEL K_ED_KAT_OBD1.DEC_NACH_EINTRAG K_ED_KAT_OBD1.DEC_VOR_EINTRAG K_ED_KAT_OBD1.FEHLERSCHWELLE K_ED_KAT_OBD1.INC_NACH_EINTRAG K_ED_KAT_OBD1.INC_VOR_EINTRAG K_ED_KAT_OBD1.KLASSENINDEX K_ED_KAT_OBD1.OK_SCHWELLE K_ED_KAT_OBD1.P_CODE_OPENLOAD K_ED_KAT_OBD1.P_CODE_SH_TO_GND K_ED_KAT_OBD1.P_CODE_SH_TO_UB K_ED_KAT_OBD1.P_CODE_UNPLAUSIBEL K_ED_KAT_OBD2.DEC_NACH_EINTRAG K_ED_KAT_OBD2.DEC_VOR_EINTRAG K_ED_KAT_OBD2.FEHLERSCHWELLE K_ED_KAT_OBD2.INC_NACH_EINTRAG K_ED_KAT_OBD2.INC_VOR_EINTRAG K_ED_KAT_OBD2.KLASSENINDEX K_ED_KAT_OBD2.OK_SCHWELLE K_ED_KAT_OBD2.P_CODE_OPENLOAD K_ED_KAT_OBD2.P_CODE_SH_TO_GND K_ED_KAT_OBD2.P_CODE_SH_TO_UB K_ED_KAT_OBD2.P_CODE_UNPLAUSIBEL K_ED_KGE1.DEC_NACH_EINTRAG K_ED_KGE1.DEC_VOR_EINTRAG K_ED_KGE1.FEHLERSCHWELLE K_ED_KGE1.INC_NACH_EINTRAG K_ED_KGE1.INC_VOR_EINTRAG K_ED_KGE1.KLASSENINDEX K_ED_KGE1.OK_SCHWELLE K_ED_KGE1.P_CODE_OPENLOAD K_ED_KGE1.P_CODE_SH_TO_GND K_ED_KGE1.P_CODE_SH_TO_UB K_ED_KGE1.P_CODE_UNPLAUSIBEL K_ED_KGE2.DEC_NACH_EINTRAG K_ED_KGE2.DEC_VOR_EINTRAG K_ED_KGE2.FEHLERSCHWELLE K_ED_KGE2.INC_NACH_EINTRAG K_ED_KGE2.INC_VOR_EINTRAG K_ED_KGE2.KLASSENINDEX K_ED_KGE2.OK_SCHWELLE K_ED_KGE2.P_CODE_OPENLOAD K_ED_KGE2.P_CODE_SH_TO_GND K_ED_KGE2.P_CODE_SH_TO_UB K_ED_KGE2.P_CODE_UNPLAUSIBEL K_ED_KSD1.DEC_NACH_EINTRAG K_ED_KSD1.DEC_VOR_EINTRAG K_ED_KSD1.FEHLERSCHWELLE K_ED_KSD1.INC_NACH_EINTRAG K_ED_KSD1.INC_VOR_EINTRAG K_ED_KSD1.KLASSENINDEX K_ED_KSD1.OK_SCHWELLE K_ED_KSD1.P_CODE_OPENLOAD K_ED_KSD1.P_CODE_SH_TO_GND K_ED_KSD1.P_CODE_SH_TO_UB K_ED_KSD1.P_CODE_UNPLAUSIBEL K_ED_KSD2.DEC_NACH_EINTRAG K_ED_KSD2.DEC_VOR_EINTRAG K_ED_KSD2.FEHLERSCHWELLE K_ED_KSD2.INC_NACH_EINTRAG K_ED_KSD2.INC_VOR_EINTRAG K_ED_KSD2.KLASSENINDEX K_ED_KSD2.OK_SCHWELLE K_ED_KSD2.P_CODE_OPENLOAD K_ED_KSD2.P_CODE_SH_TO_GND K_ED_KSD2.P_CODE_SH_TO_UB K_ED_KSD2.P_CODE_UNPLAUSIBEL K_ED_KW.DEC_NACH_EINTRAG K_ED_KW.DEC_VOR_EINTRAG K_ED_KW.FEHLERSCHWELLE K_ED_KW.INC_NACH_EINTRAG K_ED_KW.INC_VOR_EINTRAG K_ED_KW.KLASSENINDEX K_ED_KW.OK_SCHWELLE K_ED_KW.P_CODE_OPENLOAD K_ED_KW.P_CODE_SH_TO_GND K_ED_KW.P_CODE_SH_TO_UB K_ED_KW.P_CODE_UNPLAUSIBEL K_ED_LA1_ADAPT.DEC_NACH_EINTRAG K_ED_LA1_ADAPT.DEC_VOR_EINTRAG K_ED_LA1_ADAPT.FEHLERSCHWELLE K_ED_LA1_ADAPT.INC_NACH_EINTRAG K_ED_LA1_ADAPT.INC_VOR_EINTRAG K_ED_LA1_ADAPT.KLASSENINDEX K_ED_LA1_ADAPT.OK_SCHWELLE K_ED_LA1_ADAPT.P_CODE_OPENLOAD K_ED_LA1_ADAPT.P_CODE_SH_TO_GND K_ED_LA1_ADAPT.P_CODE_SH_TO_UB K_ED_LA1_ADAPT.P_CODE_UNPLAUSIBEL K_ED_LA1_TRIM_AD.DEC_NACH_EINTRAG K_ED_LA1_TRIM_AD.DEC_VOR_EINTRAG K_ED_LA1_TRIM_AD.FEHLERSCHWELLE K_ED_LA1_TRIM_AD.INC_NACH_EINTRAG K_ED_LA1_TRIM_AD.INC_VOR_EINTRAG K_ED_LA1_TRIM_AD.KLASSENINDEX K_ED_LA1_TRIM_AD.OK_SCHWELLE K_ED_LA1_TRIM_AD.P_CODE_OPENLOAD K_ED_LA1_TRIM_AD.P_CODE_SH_TO_GND K_ED_LA1_TRIM_AD.P_CODE_SH_TO_UB K_ED_LA1_TRIM_AD.P_CODE_UNPLAUSIBEL K_ED_LA2_ADAPT.DEC_NACH_EINTRAG K_ED_LA2_ADAPT.DEC_VOR_EINTRAG K_ED_LA2_ADAPT.FEHLERSCHWELLE K_ED_LA2_ADAPT.INC_NACH_EINTRAG K_ED_LA2_ADAPT.INC_VOR_EINTRAG K_ED_LA2_ADAPT.KLASSENINDEX K_ED_LA2_ADAPT.OK_SCHWELLE K_ED_LA2_ADAPT.P_CODE_OPENLOAD K_ED_LA2_ADAPT.P_CODE_SH_TO_GND K_ED_LA2_ADAPT.P_CODE_SH_TO_UB K_ED_LA2_ADAPT.P_CODE_UNPLAUSIBEL K_ED_LA2_TRIM_AD.DEC_NACH_EINTRAG K_ED_LA2_TRIM_AD.DEC_VOR_EINTRAG K_ED_LA2_TRIM_AD.FEHLERSCHWELLE K_ED_LA2_TRIM_AD.INC_NACH_EINTRAG K_ED_LA2_TRIM_AD.INC_VOR_EINTRAG K_ED_LA2_TRIM_AD.KLASSENINDEX K_ED_LA2_TRIM_AD.OK_SCHWELLE K_ED_LA2_TRIM_AD.P_CODE_OPENLOAD K_ED_LA2_TRIM_AD.P_CODE_SH_TO_GND K_ED_LA2_TRIM_AD.P_CODE_SH_TO_UB K_ED_LA2_TRIM_AD.P_CODE_UNPLAUSIBEL K_ED_LAM1_REG.DEC_NACH_EINTRAG K_ED_LAM1_REG.DEC_VOR_EINTRAG K_ED_LAM1_REG.FEHLERSCHWELLE K_ED_LAM1_REG.INC_NACH_EINTRAG K_ED_LAM1_REG.INC_VOR_EINTRAG K_ED_LAM1_REG.KLASSENINDEX K_ED_LAM1_REG.OK_SCHWELLE K_ED_LAM1_REG.P_CODE_OPENLOAD K_ED_LAM1_REG.P_CODE_SH_TO_GND K_ED_LAM1_REG.P_CODE_SH_TO_UB K_ED_LAM1_REG.P_CODE_UNPLAUSIBEL K_ED_LAM2_REG.DEC_NACH_EINTRAG K_ED_LAM2_REG.DEC_VOR_EINTRAG K_ED_LAM2_REG.FEHLERSCHWELLE K_ED_LAM2_REG.INC_NACH_EINTRAG K_ED_LAM2_REG.INC_VOR_EINTRAG K_ED_LAM2_REG.KLASSENINDEX K_ED_LAM2_REG.OK_SCHWELLE K_ED_LAM2_REG.P_CODE_OPENLOAD K_ED_LAM2_REG.P_CODE_SH_TO_GND K_ED_LAM2_REG.P_CODE_SH_TO_UB K_ED_LAM2_REG.P_CODE_UNPLAUSIBEL K_ED_LANK1.DEC_NACH_EINTRAG K_ED_LANK1.DEC_VOR_EINTRAG K_ED_LANK1.FEHLERSCHWELLE K_ED_LANK1.INC_NACH_EINTRAG K_ED_LANK1.INC_VOR_EINTRAG K_ED_LANK1.KLASSENINDEX K_ED_LANK1.OK_SCHWELLE K_ED_LANK1.P_CODE_OPENLOAD K_ED_LANK1.P_CODE_SH_TO_GND K_ED_LANK1.P_CODE_SH_TO_UB K_ED_LANK1.P_CODE_UNPLAUSIBEL K_ED_LANK1_OBD_S.DEC_NACH_EINTRAG K_ED_LANK1_OBD_S.DEC_VOR_EINTRAG K_ED_LANK1_OBD_S.FEHLERSCHWELLE K_ED_LANK1_OBD_S.INC_NACH_EINTRAG K_ED_LANK1_OBD_S.INC_VOR_EINTRAG K_ED_LANK1_OBD_S.KLASSENINDEX K_ED_LANK1_OBD_S.OK_SCHWELLE K_ED_LANK1_OBD_S.P_CODE_OPENLOAD K_ED_LANK1_OBD_S.P_CODE_SH_TO_GND K_ED_LANK1_OBD_S.P_CODE_SH_TO_UB K_ED_LANK1_OBD_S.P_CODE_UNPLAUSIBEL K_ED_LANK1_OBD_SLOPE.DEC_NACH_EINTRAG K_ED_LANK1_OBD_SLOPE.DEC_VOR_EINTRAG K_ED_LANK1_OBD_SLOPE.FEHLERSCHWELLE K_ED_LANK1_OBD_SLOPE.INC_NACH_EINTRAG K_ED_LANK1_OBD_SLOPE.INC_VOR_EINTRAG K_ED_LANK1_OBD_SLOPE.KLASSENINDEX K_ED_LANK1_OBD_SLOPE.OK_SCHWELLE K_ED_LANK1_OBD_SLOPE.P_CODE_OPENLOAD K_ED_LANK1_OBD_SLOPE.P_CODE_SH_TO_GND K_ED_LANK1_OBD_SLOPE.P_CODE_SH_TO_UB K_ED_LANK1_OBD_SLOPE.P_CODE_UNPLAUSIBEL K_ED_LANK1_OBD_WE.DEC_NACH_EINTRAG K_ED_LANK1_OBD_WE.DEC_VOR_EINTRAG K_ED_LANK1_OBD_WE.FEHLERSCHWELLE K_ED_LANK1_OBD_WE.INC_NACH_EINTRAG K_ED_LANK1_OBD_WE.INC_VOR_EINTRAG K_ED_LANK1_OBD_WE.KLASSENINDEX K_ED_LANK1_OBD_WE.OK_SCHWELLE K_ED_LANK1_OBD_WE.P_CODE_OPENLOAD K_ED_LANK1_OBD_WE.P_CODE_SH_TO_GND K_ED_LANK1_OBD_WE.P_CODE_SH_TO_UB K_ED_LANK1_OBD_WE.P_CODE_UNPLAUSIBEL K_ED_LANK1_OPENLOAD.DEC_NACH_EINTRAG K_ED_LANK1_OPENLOAD.DEC_VOR_EINTRAG K_ED_LANK1_OPENLOAD.FEHLERSCHWELLE K_ED_LANK1_OPENLOAD.INC_NACH_EINTRAG K_ED_LANK1_OPENLOAD.INC_VOR_EINTRAG K_ED_LANK1_OPENLOAD.KLASSENINDEX K_ED_LANK1_OPENLOAD.OK_SCHWELLE K_ED_LANK1_OPENLOAD.P_CODE_OPENLOAD K_ED_LANK1_OPENLOAD.P_CODE_SH_TO_GND K_ED_LANK1_OPENLOAD.P_CODE_SH_TO_UB K_ED_LANK1_OPENLOAD.P_CODE_UNPLAUSIBEL K_ED_LANK2.DEC_NACH_EINTRAG K_ED_LANK2.DEC_VOR_EINTRAG K_ED_LANK2.FEHLERSCHWELLE K_ED_LANK2.INC_NACH_EINTRAG K_ED_LANK2.INC_VOR_EINTRAG K_ED_LANK2.KLASSENINDEX K_ED_LANK2.OK_SCHWELLE K_ED_LANK2.P_CODE_OPENLOAD K_ED_LANK2.P_CODE_SH_TO_GND K_ED_LANK2.P_CODE_SH_TO_UB K_ED_LANK2.P_CODE_UNPLAUSIBEL K_ED_LANK2_OBD_S.DEC_NACH_EINTRAG K_ED_LANK2_OBD_S.DEC_VOR_EINTRAG K_ED_LANK2_OBD_S.FEHLERSCHWELLE K_ED_LANK2_OBD_S.INC_NACH_EINTRAG K_ED_LANK2_OBD_S.INC_VOR_EINTRAG K_ED_LANK2_OBD_S.KLASSENINDEX K_ED_LANK2_OBD_S.OK_SCHWELLE K_ED_LANK2_OBD_S.P_CODE_OPENLOAD K_ED_LANK2_OBD_S.P_CODE_SH_TO_GND K_ED_LANK2_OBD_S.P_CODE_SH_TO_UB K_ED_LANK2_OBD_S.P_CODE_UNPLAUSIBEL K_ED_LANK2_OBD_SLOPE.DEC_NACH_EINTRAG K_ED_LANK2_OBD_SLOPE.DEC_VOR_EINTRAG K_ED_LANK2_OBD_SLOPE.FEHLERSCHWELLE K_ED_LANK2_OBD_SLOPE.INC_NACH_EINTRAG K_ED_LANK2_OBD_SLOPE.INC_VOR_EINTRAG K_ED_LANK2_OBD_SLOPE.KLASSENINDEX K_ED_LANK2_OBD_SLOPE.OK_SCHWELLE K_ED_LANK2_OBD_SLOPE.P_CODE_OPENLOAD K_ED_LANK2_OBD_SLOPE.P_CODE_SH_TO_GND K_ED_LANK2_OBD_SLOPE.P_CODE_SH_TO_UB K_ED_LANK2_OBD_SLOPE.P_CODE_UNPLAUSIBEL K_ED_LANK2_OBD_WE.DEC_NACH_EINTRAG K_ED_LANK2_OBD_WE.DEC_VOR_EINTRAG K_ED_LANK2_OBD_WE.FEHLERSCHWELLE K_ED_LANK2_OBD_WE.INC_NACH_EINTRAG K_ED_LANK2_OBD_WE.INC_VOR_EINTRAG K_ED_LANK2_OBD_WE.KLASSENINDEX K_ED_LANK2_OBD_WE.OK_SCHWELLE K_ED_LANK2_OBD_WE.P_CODE_OPENLOAD K_ED_LANK2_OBD_WE.P_CODE_SH_TO_GND K_ED_LANK2_OBD_WE.P_CODE_SH_TO_UB K_ED_LANK2_OBD_WE.P_CODE_UNPLAUSIBEL K_ED_LANK2_OPENLOAD.DEC_NACH_EINTRAG K_ED_LANK2_OPENLOAD.DEC_VOR_EINTRAG K_ED_LANK2_OPENLOAD.FEHLERSCHWELLE K_ED_LANK2_OPENLOAD.INC_NACH_EINTRAG K_ED_LANK2_OPENLOAD.INC_VOR_EINTRAG K_ED_LANK2_OPENLOAD.KLASSENINDEX K_ED_LANK2_OPENLOAD.OK_SCHWELLE K_ED_LANK2_OPENLOAD.P_CODE_OPENLOAD K_ED_LANK2_OPENLOAD.P_CODE_SH_TO_GND K_ED_LANK2_OPENLOAD.P_CODE_SH_TO_UB K_ED_LANK2_OPENLOAD.P_CODE_UNPLAUSIBEL K_ED_LAVK1.DEC_NACH_EINTRAG K_ED_LAVK1.DEC_VOR_EINTRAG K_ED_LAVK1.FEHLERSCHWELLE K_ED_LAVK1.INC_NACH_EINTRAG K_ED_LAVK1.INC_VOR_EINTRAG K_ED_LAVK1.KLASSENINDEX K_ED_LAVK1.OK_SCHWELLE K_ED_LAVK1.P_CODE_OPENLOAD K_ED_LAVK1.P_CODE_SH_TO_GND K_ED_LAVK1.P_CODE_SH_TO_UB K_ED_LAVK1.P_CODE_UNPLAUSIBEL K_ED_LAVK1_DIAG.DEC_NACH_EINTRAG K_ED_LAVK1_DIAG.DEC_VOR_EINTRAG K_ED_LAVK1_DIAG.FEHLERSCHWELLE K_ED_LAVK1_DIAG.INC_NACH_EINTRAG K_ED_LAVK1_DIAG.INC_VOR_EINTRAG K_ED_LAVK1_DIAG.KLASSENINDEX K_ED_LAVK1_DIAG.OK_SCHWELLE K_ED_LAVK1_DIAG.P_CODE_OPENLOAD K_ED_LAVK1_DIAG.P_CODE_SH_TO_GND K_ED_LAVK1_DIAG.P_CODE_SH_TO_UB K_ED_LAVK1_DIAG.P_CODE_UNPLAUSIBEL /end DEF_CHARACTERISTIC
/end FUNCTION
/begin RECORD_LAYOUT TKW_VV_VV_UB FNC_VALUES 1 UBYTE COLUMN_DIR DIRECT /end RECORD_LAYOUT
/begin RECORD_LAYOUT TKW_VV_VV_UW FNC_VALUES 1 UWORD COLUMN_DIR DIRECT /end RECORD_LAYOUT
/end MODULE
/end PROJECT
