/begin PROJECT MSS65-inj-V912 "MSS65 INJ - V912.00-B204.00, data set 0569Q60Z520E"
/begin HEADER "" VERSION "V912.00-B204.00" /end HEADER
/begin MODULE _MSS65-inj "MSS65 INJ - V912.00-B204.00, data 7842800"
/begin MOD_COMMON "" BYTE_ORDER MSB_FIRST /* Default byteorder (Motorola) */ /end MOD_COMMON
/begin COMPU_METHOD FORMULA_0003 "FORMULA_0003" RAT_FUNC "%3.0" "-" COEFFS 0 1 0 0 0 1 /end COMPU_METHOD
/begin COMPU_METHOD FORMULA_0006 "FORMULA_0006" RAT_FUNC "%5.0" "Upm" COEFFS 0 1 0 0 0 1 /end COMPU_METHOD
/begin COMPU_METHOD FORMULA_0007 "FORMULA_0007" RAT_FUNC "%8.3" "-" COEFFS 0 10000 0 0 0 1 /end COMPU_METHOD
/begin COMPU_METHOD FORMULA_0008 "FORMULA_0008" RAT_FUNC "%6.1" "V" COEFFS 0 10 0 0 0 1 /end COMPU_METHOD
/begin COMPU_METHOD FORMULA_0010 "FORMULA_0010" RAT_FUNC "%5.0" "-" COEFFS 0 1 0 0 0 1 /end COMPU_METHOD
/begin COMPU_METHOD FORMULA_0020 "FORMULA_0020" RAT_FUNC "%5.0" "qmm/s" COEFFS 0 1 0 0 0 20 /end COMPU_METHOD
/begin COMPU_METHOD FORMULA_0021 "FORMULA_0021" RAT_FUNC "%7.2" "s" COEFFS 0 100 0 0 0 1 /end COMPU_METHOD
/* ------------------ Abschnitt erzeugt aus adapt_glob.dat ------------------ */
/begin COMPU_METHOD FORMULA_0023 "FORMULA_0023" RAT_FUNC "%6.1" "�C" COEFFS 0 10 2732 0 0 1 /end COMPU_METHOD
/begin COMPU_METHOD FORMULA_0024 "FORMULA_0024" RAT_FUNC "%9.4" "-" COEFFS 0 32768 0 0 0 1 /end COMPU_METHOD
/begin COMPU_METHOD FORMULA_0025 "FORMULA_0025" RAT_FUNC "%8.3" "-" COEFFS 0 16384 0 0 0 1 /end COMPU_METHOD
/begin COMPU_METHOD FORMULA_0032 "FORMULA_0032" RAT_FUNC "%3.0" "%" COEFFS 0 1 0 0 0 1 /end COMPU_METHOD
/begin COMPU_METHOD FORMULA_0033 "FORMULA_0033" RAT_FUNC "%5.2" "-" COEFFS 0 1 0 0 0 1 /end COMPU_METHOD
/begin COMPU_METHOD FORMULA_0062 "FORMULA_0062" RAT_FUNC "%5.0" "s" COEFFS 0 1 0 0 0 1 /end COMPU_METHOD
/begin COMPU_METHOD FORMULA_0073 "FORMULA_0073" RAT_FUNC "%6.1" "s" COEFFS 0 10 0 0 0 1 /end COMPU_METHOD
/begin COMPU_METHOD FORMULA_0075 "FORMULA_0075" RAT_FUNC "%8.3" "-" COEFFS 0 1024 0 0 0 1 /end COMPU_METHOD
/begin COMPU_METHOD FORMULA_0076 "FORMULA_0076" RAT_FUNC "%6.1" "Kelvin" COEFFS 0 10 0 0 0 1 /end COMPU_METHOD
/begin COMPU_METHOD FORMULA_0077 "FORMULA_0077" RAT_FUNC "%6.1" "mbar" COEFFS 0 16 0 0 0 1 /end COMPU_METHOD
/begin COMPU_METHOD FORMULA_0078 "FORMULA_0078" RAT_FUNC "%6.1" "km/h" COEFFS 0 16 0 0 0 1 /end COMPU_METHOD
/* ------------------ Abschnitt erzeugt aus glob.dat ------------------ */
/begin COMPU_METHOD FORMULA_0083 "FORMULA_0083" RAT_FUNC "%7.2" "-" COEFFS 0 1 0 0 0 1 /end COMPU_METHOD
/begin COMPU_METHOD FORMULA_0111 "FORMULA_0111" RAT_FUNC "%6.1" "�KW" COEFFS 0 10 0 0 0 1 /end COMPU_METHOD
/begin COMPU_METHOD FORMULA_0112 "FORMULA_0112" RAT_FUNC "%6.1" "kg/h" COEFFS 0 10 0 0 0 1 /end COMPU_METHOD
/begin COMPU_METHOD FORMULA_0115 "FORMULA_0115" RAT_FUNC "%7.2" "%" COEFFS 0 16384 0 0 0 100 /end COMPU_METHOD
/begin COMPU_METHOD FORMULA_0118 "FORMULA_0118" RAT_FUNC "%8.3" "bar" COEFFS 0 1000 0 0 0 1 /end COMPU_METHOD
/begin COMPU_METHOD FORMULA_0123 "FORMULA_0123" RAT_FUNC "%5.0" "digit" COEFFS 0 1 0 0 0 1 /end COMPU_METHOD
/begin COMPU_METHOD FORMULA_0132 "FORMULA_0132" RAT_FUNC "%7.2" "m/(s*s)" COEFFS 0 40 0 0 0 1 /end COMPU_METHOD
/begin COMPU_METHOD FORMULA_0147 "FORMULA_0147" RAT_FUNC "%6.1" "qmm" COEFFS 0 10 0 0 0 1 /end COMPU_METHOD
/begin COMPU_METHOD FORMULA_0161 "FORMULA_0161" TAB_VERB "%7.2" "-" COMPU_TAB_REF FORMULA_0161_VTAB /end COMPU_METHOD
/begin COMPU_VTAB FORMULA_0161_VTAB "FORMULA_0161_VTAB" TAB_VERB 2 0 "kein Druck" 1 "Oeldruck" /end COMPU_VTAB
/begin COMPU_METHOD FORMULA_0162 "FORMULA_0162" TAB_VERB "%7.2" "-" COMPU_TAB_REF FORMULA_0162_VTAB /end COMPU_METHOD
/begin COMPU_VTAB FORMULA_0162_VTAB "FORMULA_0162_VTAB" TAB_VERB 2 0 "Motor abstellen" 1 "O.K." /end COMPU_VTAB
/begin COMPU_METHOD FORMULA_0163 "FORMULA_0163" TAB_VERB "%7.2" "-" COMPU_TAB_REF FORMULA_0163_VTAB /end COMPU_METHOD
/begin COMPU_VTAB FORMULA_0163_VTAB "FORMULA_0163_VTAB" TAB_VERB 2 0 "offen" 1 "Kraftschluss" /end COMPU_VTAB
/begin COMPU_METHOD FORMULA_0164 "FORMULA_0164" TAB_VERB "%5.2" "-" COMPU_TAB_REF FORMULA_0164_VTAB /end COMPU_METHOD
/begin COMPU_VTAB FORMULA_0164_VTAB "FORMULA_0164_VTAB" TAB_VERB 2 0 "AUS" 1 "EIN" DEFAULT_VALUE "ungueltig" /end COMPU_VTAB
/begin COMPU_METHOD FORMULA_0165 "FORMULA_0165" TAB_VERB "%3.0" "-" COMPU_TAB_REF FORMULA_0165_VTAB /end COMPU_METHOD
/begin COMPU_VTAB FORMULA_0165_VTAB "FORMULA_0165_VTAB" TAB_VERB 5 1 "Init" 2 "Awake" 3 "Ring" 4 "GoSleep" 5 "BusSleep" /end COMPU_VTAB
/begin COMPU_METHOD FORMULA_0166 "FORMULA_0166" TAB_VERB "%5.2" "-" COMPU_TAB_REF FORMULA_0166_VTAB /end COMPU_METHOD
/begin COMPU_VTAB FORMULA_0166_VTAB "FORMULA_0166_VTAB" TAB_VERB 2 0 "Inaktiv" 1 "Aktiv" /end COMPU_VTAB
/begin COMPU_METHOD FORMULA_0167 "FORMULA_0167" TAB_VERB "%5.2" "-" COMPU_TAB_REF FORMULA_0167_VTAB /end COMPU_METHOD
/begin COMPU_VTAB FORMULA_0167_VTAB "FORMULA_0167_VTAB" TAB_VERB 2 0 "Inaktiv" 1 "Aktiv" /end COMPU_VTAB
/begin COMPU_METHOD FORMULA_0168 "FORMULA_0168" TAB_VERB "%3.0" "-" COMPU_TAB_REF FORMULA_0168_VTAB /end COMPU_METHOD
/begin COMPU_VTAB FORMULA_0168_VTAB "FORMULA_0168_VTAB" TAB_VERB 3 0 "Konfigmodus" 1 "Aus" 2 "Ein" DEFAULT_VALUE "undef" /end COMPU_VTAB
/begin COMPU_METHOD FORMULA_0169 "FORMULA_0169" TAB_VERB "%3.0" "-" COMPU_TAB_REF FORMULA_0169_VTAB /end COMPU_METHOD
/begin COMPU_VTAB FORMULA_0169_VTAB "FORMULA_0169_VTAB" TAB_VERB 3 0 "Komfort" 1 "Normal" 2 "Sport" DEFAULT_VALUE "undef" /end COMPU_VTAB
/begin COMPU_METHOD FORMULA_0170 "FORMULA_0170" RAT_FUNC "%6.3" "�C" COEFFS 0 1 48 0 0 1 /end COMPU_METHOD
/begin COMPU_METHOD FORMULA_0171 "FORMULA_0171" RAT_FUNC "%3.0" "Upm" COEFFS 0 1 0 0 0 50 /end COMPU_METHOD
/begin COMPU_METHOD FORMULA_0172 "FORMULA_0172" TAB_VERB "%3.0" "-" COMPU_TAB_REF FORMULA_0172_VTAB /end COMPU_METHOD
/begin COMPU_VTAB FORMULA_0172_VTAB "FORMULA_0172_VTAB" TAB_VERB 1 0 "kein Fehler" /end COMPU_VTAB
/begin COMPU_METHOD FORMULA_0173 "FORMULA_0173" TAB_VERB "%3.0" "-" COMPU_TAB_REF FORMULA_0173_VTAB /end COMPU_METHOD
/begin COMPU_VTAB FORMULA_0173_VTAB "FORMULA_0173_VTAB" TAB_VERB 2 0 "inaktiv" 1 "aktiv" /end COMPU_VTAB
/begin COMPU_METHOD FORMULA_0174 "FORMULA_0174" TAB_VERB "%3.0" "-" COMPU_TAB_REF FORMULA_0174_VTAB /end COMPU_METHOD
/begin COMPU_VTAB FORMULA_0174_VTAB "FORMULA_0174_VTAB" TAB_VERB 2 0 "inaktiv" 1 "aktiv" /end COMPU_VTAB
/begin COMPU_METHOD FORMULA_0175 "FORMULA_0175" TAB_VERB "%3.0" "-" COMPU_TAB_REF FORMULA_0175_VTAB /end COMPU_METHOD
/begin COMPU_VTAB FORMULA_0175_VTAB "FORMULA_0175_VTAB" TAB_VERB 8 0 "iO" 1 "LA" 4 "LAA" 5 "LA+LAA" 16 "Mager" 17 "LA+Mager" 20 "LAA+Mager" 21 "LA+LAA+Mager" /end COMPU_VTAB
/begin COMPU_METHOD FORMULA_0176 "FORMULA_0176" TAB_VERB "%3.0" "-" COMPU_TAB_REF FORMULA_0176_VTAB /end COMPU_METHOD
/begin COMPU_VTAB FORMULA_0176_VTAB "FORMULA_0176_VTAB" TAB_VERB 8 0 "iO" 2 "LA" 8 "LAA" 10 "LA+LAA" 32 "Mager" 34 "LA+Mager" 40 "LAA+Mager" 42 "LA+LAA+Mager" /end COMPU_VTAB
/begin COMPU_METHOD FORMULA_0177 "FORMULA_0177" TAB_VERB "%3.0" "-" COMPU_TAB_REF FORMULA_0177_VTAB /end COMPU_METHOD
/begin COMPU_VTAB FORMULA_0177_VTAB "FORMULA_0177_VTAB" TAB_VERB 4 0 "iO" 1 "B1-Notl" 2 "B2-Notl" 3 "B1+B2-Notl" /end COMPU_VTAB
/begin COMPU_METHOD FORMULA_0178 "FORMULA_0178" TAB_VERB "%3.0" "-" COMPU_TAB_REF FORMULA_0178_VTAB /end COMPU_METHOD
/begin COMPU_VTAB FORMULA_0178_VTAB "FORMULA_0178_VTAB" TAB_VERB 2 0 "iO" 1 "PKS-Notlauf" /end COMPU_VTAB
/begin COMPU_METHOD FORMULA_0179 "FORMULA_0179" TAB_VERB "%3.0" "-" COMPU_TAB_REF FORMULA_0179_VTAB /end COMPU_METHOD
/begin COMPU_VTAB FORMULA_0179_VTAB "FORMULA_0179_VTAB" TAB_VERB 2 0 "iO" 1 "LLRA-Sperre" /end COMPU_VTAB
/begin COMPU_METHOD FORMULA_0180 "FORMULA_0180" TAB_VERB "%3.0" "-" COMPU_TAB_REF FORMULA_0180_VTAB /end COMPU_METHOD
/begin COMPU_VTAB FORMULA_0180_VTAB "FORMULA_0180_VTAB" TAB_VERB 2 0 "iO" 1 "FRA-Sperre" /end COMPU_VTAB
/begin COMPU_METHOD FORMULA_0181 "FORMULA_0181" TAB_VERB "%3.0" "-" COMPU_TAB_REF FORMULA_0181_VTAB /end COMPU_METHOD
/begin COMPU_VTAB FORMULA_0181_VTAB "FORMULA_0181_VTAB" TAB_VERB 2 0 "iO" 1 "KH-Sperre" /end COMPU_VTAB
/begin COMPU_METHOD FORMULA_0182 "FORMULA_0182" TAB_VERB "%3.0" "-" COMPU_TAB_REF FORMULA_0182_VTAB /end COMPU_METHOD
/begin COMPU_VTAB FORMULA_0182_VTAB "FORMULA_0182_VTAB" TAB_VERB 3 0 "iO" 1 "HFM" 2 "AQ" /end COMPU_VTAB
/begin COMPU_METHOD FORMULA_0183 "FORMULA_0183" TAB_VERB "%3.0" "-" COMPU_TAB_REF FORMULA_0183_VTAB /end COMPU_METHOD
/begin COMPU_VTAB FORMULA_0183_VTAB "FORMULA_0183_VTAB" TAB_VERB 2 0 "iO" 1 "FR-Sperre" /end COMPU_VTAB
/begin COMPU_METHOD FORMULA_0184 "FORMULA_0184" TAB_VERB "%5.0" "-" COMPU_TAB_REF FORMULA_0184_VTAB /end COMPU_METHOD
/begin COMPU_VTAB FORMULA_0184_VTAB "FORMULA_0184_VTAB" TAB_VERB 1 0 "alle ein" /end COMPU_VTAB
/begin COMPU_METHOD FORMULA_0185 "FORMULA_0185" TAB_VERB "%7.2" "-" COMPU_TAB_REF FORMULA_0185_VTAB /end COMPU_METHOD
/begin COMPU_VTAB FORMULA_0185_VTAB "FORMULA_0185_VTAB" TAB_VERB 2 0 "-" 1 "zulaessig" /end COMPU_VTAB
/begin COMPU_METHOD FORMULA_0186 "FORMULA_0186" TAB_VERB "%7.2" "-" COMPU_TAB_REF FORMULA_0186_VTAB /end COMPU_METHOD
/begin COMPU_VTAB FORMULA_0186_VTAB "FORMULA_0186_VTAB" TAB_VERB 2 0 "-" 1 "aktiv" /end COMPU_VTAB
/begin COMPU_METHOD FORMULA_0187 "FORMULA_0187" TAB_VERB "%7.2" "-" COMPU_TAB_REF FORMULA_0187_VTAB /end COMPU_METHOD
/begin COMPU_VTAB FORMULA_0187_VTAB "FORMULA_0187_VTAB" TAB_VERB 2 0 "-" 1 "Abbruch" /end COMPU_VTAB
/begin COMPU_METHOD FORMULA_0188 "FORMULA_0188" TAB_VERB "%7.2" "-" COMPU_TAB_REF FORMULA_0188_VTAB /end COMPU_METHOD
/begin COMPU_VTAB FORMULA_0188_VTAB "FORMULA_0188_VTAB" TAB_VERB 2 0 "-" 1 "STOP" /end COMPU_VTAB
/begin COMPU_METHOD FORMULA_0189 "FORMULA_0189" TAB_VERB "%7.2" "-" COMPU_TAB_REF FORMULA_0189_VTAB /end COMPU_METHOD
/begin COMPU_VTAB FORMULA_0189_VTAB "FORMULA_0189_VTAB" TAB_VERB 2 0 "-" 1 "DAUER" /end COMPU_VTAB
/begin COMPU_METHOD FORMULA_0190 "FORMULA_0190" TAB_VERB "%7.2" "-" COMPU_TAB_REF FORMULA_0190_VTAB /end COMPU_METHOD
/begin COMPU_VTAB FORMULA_0190_VTAB "FORMULA_0190_VTAB" TAB_VERB 2 0 "no" 1 "yes" /end COMPU_VTAB
/begin COMPU_METHOD FORMULA_0191 "FORMULA_0191" TAB_VERB "%7.2" "-" COMPU_TAB_REF FORMULA_0191_VTAB /end COMPU_METHOD
/begin COMPU_VTAB FORMULA_0191_VTAB "FORMULA_0191_VTAB" TAB_VERB 2 0 "no" 1 "yes" /end COMPU_VTAB
/begin COMPU_METHOD FORMULA_0192 "FORMULA_0192" TAB_VERB "%7.2" "-" COMPU_TAB_REF FORMULA_0192_VTAB /end COMPU_METHOD
/begin COMPU_VTAB FORMULA_0192_VTAB "FORMULA_0192_VTAB" TAB_VERB 2 0 "no" 1 "yes" /end COMPU_VTAB
/begin COMPU_METHOD FORMULA_0193 "FORMULA_0193" TAB_VERB "%7.2" "-" COMPU_TAB_REF FORMULA_0193_VTAB /end COMPU_METHOD
/begin COMPU_VTAB FORMULA_0193_VTAB "FORMULA_0193_VTAB" TAB_VERB 2 0 "no" 1 "yes" /end COMPU_VTAB
/begin COMPU_METHOD FORMULA_0194 "FORMULA_0194" TAB_VERB "%7.2" "-" COMPU_TAB_REF FORMULA_0194_VTAB /end COMPU_METHOD
/begin COMPU_VTAB FORMULA_0194_VTAB "FORMULA_0194_VTAB" TAB_VERB 2 0 "no" 1 "yes" /end COMPU_VTAB
/begin COMPU_METHOD FORMULA_0195 "FORMULA_0195" TAB_VERB "%7.2" "-" COMPU_TAB_REF FORMULA_0195_VTAB /end COMPU_METHOD
/begin COMPU_VTAB FORMULA_0195_VTAB "FORMULA_0195_VTAB" TAB_VERB 2 0 "i.O." 1 "SH_TO_X_SPERREN" /end COMPU_VTAB
/begin COMPU_METHOD FORMULA_0196 "FORMULA_0196" TAB_VERB "%7.2" "-" COMPU_TAB_REF FORMULA_0196_VTAB /end COMPU_METHOD
/begin COMPU_VTAB FORMULA_0196_VTAB "FORMULA_0196_VTAB" TAB_VERB 2 0 "i.O." 1 "SH_TO_X_SPERREN" /end COMPU_VTAB
/begin COMPU_METHOD FORMULA_0197 "FORMULA_0197" TAB_VERB "%7.2" "-" COMPU_TAB_REF FORMULA_0197_VTAB /end COMPU_METHOD
/begin COMPU_VTAB FORMULA_0197_VTAB "FORMULA_0197_VTAB" TAB_VERB 5 1 "SPUELEN-INI" 2 "TE-LAA-INI" 4 "SPUELEN KURZ" 8 "SPUELEN LANG" 16 "TE-LAA" DEFAULT_VALUE "nicht verf." /end COMPU_VTAB
/begin COMPU_METHOD FORMULA_0198 "FORMULA_0198" TAB_VERB "%7.2" "-" COMPU_TAB_REF FORMULA_0198_VTAB /end COMPU_METHOD
/begin COMPU_VTAB FORMULA_0198_VTAB "FORMULA_0198_VTAB" TAB_VERB 14 0 "AUS" 1 "WAIT" 2 "HFM-DIAG" 4 "ML-PLAUS" 8 "MDF-WAIT" 16 "MDF-DIAG" 32 "ZWD-100" 64 "ZWD-0" 128 "ZWD-OFF" 256 "SLV-DIAG" 512 "Abgas Lambda" 8192 "DIAG Ende Abbruch" 16384 "DIAG Ende IO" 32768 "DIAG Ende NIO" DEFAULT_VALUE "Ende mit Fehler" /end COMPU_VTAB
/begin COMPU_METHOD FORMULA_0199 "FORMULA_0199" TAB_VERB "%5.0" "-" COMPU_TAB_REF FORMULA_0199_VTAB /end COMPU_METHOD
/begin COMPU_VTAB FORMULA_0199_VTAB "FORMULA_0199_VTAB" TAB_VERB 13 0 "Motor steht" 1 "Normalbetrieb" 2 "Notlauf" 5 "Normal/Warmlauf" 8 "nBegr" 12 "nBegr/Warmlauf" 16 "vBegr" 20 "vBegr/Warmlauf" 32 "DSC" 36 "DSC/Warmlauf" 64 "Getr" 68 "Getr/Warmlauf" 128 "Rollenbetrieb" DEFAULT_VALUE "undef" /end COMPU_VTAB
/begin COMPU_METHOD FORMULA_0200 "FORMULA_0200" TAB_VERB "%5.2" "-" COMPU_TAB_REF FORMULA_0200_VTAB /end COMPU_METHOD
/begin COMPU_VTAB FORMULA_0200_VTAB "FORMULA_0200_VTAB" TAB_VERB 1 1 "time_ms Ok" DEFAULT_VALUE "aus" /end COMPU_VTAB
/begin COMPU_METHOD FORMULA_0201 "FORMULA_0201" TAB_VERB "%3.0" "-" COMPU_TAB_REF FORMULA_0201_VTAB /end COMPU_METHOD
/begin COMPU_VTAB FORMULA_0201_VTAB "FORMULA_0201_VTAB" TAB_VERB 3 0 "ATIC39-Treiber aus [ELUP aus]" 1 "ATIC39-Treiber an [ELUP an]" 2 "wg. SHT_TO_UB ATIC39-Treiber+ELUP aus" DEFAULT_VALUE "undef" /end COMPU_VTAB
/begin COMPU_METHOD FORMULA_0202 "FORMULA_0202" TAB_VERB "%5.0" "-" COMPU_TAB_REF FORMULA_0202_VTAB /end COMPU_METHOD
/begin COMPU_VTAB FORMULA_0202_VTAB "FORMULA_0202_VTAB" TAB_VERB 10 0 "AUS" 1 "Ger 2.5" 2 "Ger 5.5" 4 "Ger" 8 "Rampe" 16 "TV 100%" 32 "TV 65%" 64 "TV 65% FW 100%" 16384 "Abbruch" 32768 "Ende" /end COMPU_VTAB
/begin COMPU_METHOD FORMULA_0203 "FORMULA_0203" RAT_FUNC "%8.3" "-/10ms" COEFFS 0 10000 0 0 0 1 /end COMPU_METHOD
/begin COMPU_METHOD FORMULA_0204 "FORMULA_0204" RAT_FUNC "%8.3" "100/10ms" COEFFS 0 100 0 0 0 1 /end COMPU_METHOD
/begin COMPU_METHOD FORMULA_0205 "FORMULA_0205" TAB_VERB "%5.2" "-" COMPU_TAB_REF FORMULA_0205_VTAB /end COMPU_METHOD
/begin COMPU_VTAB FORMULA_0205_VTAB "FORMULA_0205_VTAB" TAB_VERB 4 0 "in Ordnung" 1 "kein Wert empf." 128 "Err/TUMG" 129 "Fehler/TAN" /end COMPU_VTAB
/begin COMPU_METHOD FORMULA_0206 "FORMULA_0206" TAB_VERB "%5.2" "-" COMPU_TAB_REF FORMULA_0206_VTAB /end COMPU_METHOD
/begin COMPU_VTAB FORMULA_0206_VTAB "FORMULA_0206_VTAB" TAB_VERB 4 0 "in Ordnung" 1 "Abs-Err" 2 "Rel-Err" 3 "Abs-Rel-Err" /end COMPU_VTAB
/begin COMPU_METHOD FORMULA_0207 "FORMULA_0207" RAT_FUNC "%5.0" "Tage" COEFFS 0 1 0 0 0 1 /end COMPU_METHOD
/begin COMPU_METHOD FORMULA_0208 "FORMULA_0208" TAB_VERB "%5.2" "-" COMPU_TAB_REF FORMULA_0208_VTAB /end COMPU_METHOD
/begin COMPU_VTAB FORMULA_0208_VTAB "FORMULA_0208_VTAB" TAB_VERB 7 0 "in Ordnung" 1 "Range" 2 "Reserve" 4 "Fst links" 8 "Fst rechts" 16 "Fst Summe" 32 "km-Stand" DEFAULT_VALUE "selbstrechnen" /end COMPU_VTAB
/begin COMPU_METHOD FORMULA_0209 "FORMULA_0209" RAT_FUNC "%3.0" "�C" COEFFS 0 1 55.2 0 0 0.9 /end COMPU_METHOD
/begin COMPU_METHOD FORMULA_0210 "FORMULA_0210" TAB_VERB "%7.2" "-" COMPU_TAB_REF FORMULA_0210_VTAB /end COMPU_METHOD
/begin COMPU_VTAB FORMULA_0210_VTAB "FORMULA_0210_VTAB" TAB_VERB 10 0 "init" 1 "an" 2 "Bauteilschutz" 4 "an OBD" 8 "aus ED" 16 "Abbruch" 32 "aus" 64 "aus Restlaufzeit" 128 "an Restlaufzeit" 256 "an Prueflauf" DEFAULT_VALUE "undef" /end COMPU_VTAB
/begin COMPU_METHOD FORMULA_0211 "FORMULA_0211" TAB_VERB "%5.2" "-" COMPU_TAB_REF FORMULA_0211_VTAB /end COMPU_METHOD
/begin COMPU_VTAB FORMULA_0211_VTAB "FORMULA_0211_VTAB" TAB_VERB 4 0 "aus" 1 "an" 2 "an OBD" 4 "aus ED" DEFAULT_VALUE "ungueltig" /end COMPU_VTAB
/begin COMPU_METHOD FORMULA_0212 "FORMULA_0212" TAB_VERB "%3.0" "-" COMPU_TAB_REF FORMULA_0212_VTAB /end COMPU_METHOD
/begin COMPU_VTAB FORMULA_0212_VTAB "FORMULA_0212_VTAB" TAB_VERB 4 0 "iO" 1 "Kombi-Err" 2 "ACC-Err" 4 "FGR-Err" DEFAULT_VALUE "Mehrfach" /end COMPU_VTAB
/begin COMPU_METHOD FORMULA_0213 "FORMULA_0213" TAB_VERB "%3.0" "-" COMPU_TAB_REF FORMULA_0213_VTAB /end COMPU_METHOD
/begin COMPU_VTAB FORMULA_0213_VTAB "FORMULA_0213_VTAB" TAB_VERB 2 0 "Aus" 1 "Ein" /end COMPU_VTAB
/begin COMPU_METHOD FORMULA_0214 "FORMULA_0214" TAB_VERB "%3.0" "-" COMPU_TAB_REF FORMULA_0214_VTAB /end COMPU_METHOD
/begin COMPU_VTAB FORMULA_0214_VTAB "FORMULA_0214_VTAB" TAB_VERB 2 0 "Aus" 1 "Ein" /end COMPU_VTAB
/begin COMPU_METHOD FORMULA_0215 "FORMULA_0215" TAB_VERB "%3.0" "-" COMPU_TAB_REF FORMULA_0215_VTAB /end COMPU_METHOD
/begin COMPU_VTAB FORMULA_0215_VTAB "FORMULA_0215_VTAB" TAB_VERB 2 0 "Nein" 1 "Ja" /end COMPU_VTAB
/begin COMPU_METHOD FORMULA_0216 "FORMULA_0216" TAB_VERB "%5.2" "-" COMPU_TAB_REF FORMULA_0216_VTAB /end COMPU_METHOD
/begin COMPU_VTAB FORMULA_0216_VTAB "FORMULA_0216_VTAB" TAB_VERB 2 0 "nein" 1 "ja" /end COMPU_VTAB
/begin COMPU_METHOD FORMULA_0217 "FORMULA_0217" TAB_VERB "%5.2" "-" COMPU_TAB_REF FORMULA_0217_VTAB /end COMPU_METHOD
/begin COMPU_VTAB FORMULA_0217_VTAB "FORMULA_0217_VTAB" TAB_VERB 2 0 "nein" 1 "ja" /end COMPU_VTAB
/begin COMPU_METHOD FORMULA_0218 "FORMULA_0218" TAB_VERB "%5.2" "-" COMPU_TAB_REF FORMULA_0218_VTAB /end COMPU_METHOD
/begin COMPU_VTAB FORMULA_0218_VTAB "FORMULA_0218_VTAB" TAB_VERB 2 0 "nein" 1 "ja" /end COMPU_VTAB
/begin COMPU_METHOD FORMULA_0219 "FORMULA_0219" TAB_VERB "%5.2" "-" COMPU_TAB_REF FORMULA_0219_VTAB /end COMPU_METHOD
/begin COMPU_VTAB FORMULA_0219_VTAB "FORMULA_0219_VTAB" TAB_VERB 2 0 "nein" 1 "ja" /end COMPU_VTAB
/begin COMPU_METHOD FORMULA_0220 "FORMULA_0220" TAB_VERB "%5.2" "-" COMPU_TAB_REF FORMULA_0220_VTAB /end COMPU_METHOD
/begin COMPU_VTAB FORMULA_0220_VTAB "FORMULA_0220_VTAB" TAB_VERB 2 0 "nein" 1 "ja" /end COMPU_VTAB
/begin COMPU_METHOD FORMULA_0221 "FORMULA_0221" TAB_VERB "%5.2" "-" COMPU_TAB_REF FORMULA_0221_VTAB /end COMPU_METHOD
/begin COMPU_VTAB FORMULA_0221_VTAB "FORMULA_0221_VTAB" TAB_VERB 2 0 "nein" 1 "ja" /end COMPU_VTAB
/begin COMPU_METHOD FORMULA_0222 "FORMULA_0222" TAB_VERB "%5.2" "-" COMPU_TAB_REF FORMULA_0222_VTAB /end COMPU_METHOD
/begin COMPU_VTAB FORMULA_0222_VTAB "FORMULA_0222_VTAB" TAB_VERB 2 0 "nein" 1 "ja" /end COMPU_VTAB
/begin COMPU_METHOD FORMULA_0223 "FORMULA_0223" TAB_VERB "%5.2" "-" COMPU_TAB_REF FORMULA_0223_VTAB /end COMPU_METHOD
/begin COMPU_VTAB FORMULA_0223_VTAB "FORMULA_0223_VTAB" TAB_VERB 2 0 "nein" 1 "ja" /end COMPU_VTAB
/begin COMPU_METHOD FORMULA_0224 "FORMULA_0224" TAB_VERB "%3.0" "-" COMPU_TAB_REF FORMULA_0224_VTAB /end COMPU_METHOD
/begin COMPU_VTAB FORMULA_0224_VTAB "FORMULA_0224_VTAB" TAB_VERB 3 0 "Fahrzeugbetrieb" 1 "Pruefstandbetrieb" 2 "Rollenbetrieb" DEFAULT_VALUE "undef" /end COMPU_VTAB
/begin COMPU_METHOD FORMULA_0225 "FORMULA_0225" TAB_VERB "%3.0" "-" COMPU_TAB_REF FORMULA_0225_VTAB /end COMPU_METHOD
/begin COMPU_VTAB FORMULA_0225_VTAB "FORMULA_0225_VTAB" TAB_VERB 3 0 "Treiber aus [SSP an]" 1 "Treiber an [SSP aus]" 2 "Sperre SH_TO_UB" /end COMPU_VTAB
/begin COMPU_METHOD FORMULA_0226 "FORMULA_0226" TAB_VERB "%3.0" "-" COMPU_TAB_REF FORMULA_0226_VTAB /end COMPU_METHOD
/begin COMPU_VTAB FORMULA_0226_VTAB "FORMULA_0226_VTAB" TAB_VERB 7 0 "-------------------" 1 "SSP-Diag-Freigabe" 2 "SSP-Diag abgelaufen" 4 "SSP-Diag i. O." 8 "SSP-Diag n. i. O." 16 "SSP-Diag Stop exd" 32 "SSP-Diag Start exd" DEFAULT_VALUE "undefiniert" /end COMPU_VTAB
/begin COMPU_METHOD FORMULA_0227 "FORMULA_0227" TAB_VERB "%3.0" "-" COMPU_TAB_REF FORMULA_0227_VTAB /end COMPU_METHOD
/begin COMPU_VTAB FORMULA_0227_VTAB "FORMULA_0227_VTAB" TAB_VERB 2 0 "niO" 1 "ok" /end COMPU_VTAB
/begin COMPU_METHOD FORMULA_0229 "FORMULA_0229" TAB_VERB "%3.0" "-" COMPU_TAB_REF FORMULA_0229_VTAB /end COMPU_METHOD
/begin COMPU_VTAB FORMULA_0229_VTAB "FORMULA_0229_VTAB" TAB_VERB 1 0 "alles i.O" DEFAULT_VALUE "Fehler oder Ansteuerung" /end COMPU_VTAB
/begin COMPU_METHOD FORMULA_0230 "FORMULA_0230" TAB_VERB "%5.2" "-" COMPU_TAB_REF FORMULA_0230_VTAB /end COMPU_METHOD
/begin COMPU_VTAB FORMULA_0230_VTAB "FORMULA_0230_VTAB" TAB_VERB 2 0 "nein" 1 "ja" /end COMPU_VTAB
/begin COMPU_METHOD FORMULA_0231 "FORMULA_0231" TAB_VERB "%3.0" "-" COMPU_TAB_REF FORMULA_0231_VTAB /end COMPU_METHOD
/begin COMPU_VTAB FORMULA_0231_VTAB "FORMULA_0231_VTAB" TAB_VERB 6 17 "FP im RAM" 51 "FP warten" 119 "FP fertig" 136 "Rueckflashen" 170 "RF warten" 238 "RF fertig" /end COMPU_VTAB
/begin COMPU_METHOD FORMULA_0235 "FORMULA_0235" TAB_VERB "%3.0" "-" COMPU_TAB_REF FORMULA_0235_VTAB /end COMPU_METHOD
/begin COMPU_VTAB FORMULA_0235_VTAB "FORMULA_0235_VTAB" TAB_VERB 1 0 "k. Aenderung" /end COMPU_VTAB
/begin COMPU_METHOD FORMULA_0239 "FORMULA_0239" TAB_VERB "%3.0" "-" COMPU_TAB_REF FORMULA_0239_VTAB /end COMPU_METHOD
/begin COMPU_VTAB FORMULA_0239_VTAB "FORMULA_0239_VTAB" TAB_VERB 2 0 "nicht angehoben" 1 "angehoben" DEFAULT_VALUE "undef" /end COMPU_VTAB
/begin COMPU_METHOD FORMULA_0240 "FORMULA_0240" TAB_VERB "%3.0" "-" COMPU_TAB_REF FORMULA_0240_VTAB /end COMPU_METHOD
/begin COMPU_VTAB FORMULA_0240_VTAB "FORMULA_0240_VTAB" TAB_VERB 3 0 "kein R" 1 "R" 2 "Fehler" /end COMPU_VTAB
/begin COMPU_METHOD FORMULA_0241 "FORMULA_0241" TAB_VERB "%5.2" "-" COMPU_TAB_REF FORMULA_0241_VTAB /end COMPU_METHOD
/begin COMPU_VTAB FORMULA_0241_VTAB "FORMULA_0241_VTAB" TAB_VERB 2 0 "aus" 1 "ein" /end COMPU_VTAB
/begin COMPU_METHOD FORMULA_0242 "FORMULA_0242" TAB_VERB "%5.2" "-" COMPU_TAB_REF FORMULA_0242_VTAB /end COMPU_METHOD
/begin COMPU_VTAB FORMULA_0242_VTAB "FORMULA_0242_VTAB" TAB_VERB 4 0 "Ok" 1 "SH_TO_GND" 2 "SH_TO_UB" 255 "Init" DEFAULT_VALUE "unused" /end COMPU_VTAB
/begin COMPU_METHOD FORMULA_0243 "FORMULA_0243" RAT_FUNC "%10.3" "�KW" COEFFS 0 81920 0 0 0 1 /end COMPU_METHOD
/begin COMPU_METHOD FORMULA_0244 "FORMULA_0244" RAT_FUNC "%8.1" "�KW" COEFFS 0 10 0 0 0 1 /end COMPU_METHOD
/begin COMPU_METHOD FORMULA_0245 "FORMULA_0245" RAT_FUNC "%7.2" "nSs" COEFFS 0 1 0 0 0 0.01952206 /end COMPU_METHOD
/begin COMPU_METHOD FORMULA_0246 "FORMULA_0246" TAB_VERB "%5.0" "-" COMPU_TAB_REF FORMULA_0246_VTAB /end COMPU_METHOD
/begin COMPU_VTAB FORMULA_0246_VTAB "FORMULA_0246_VTAB" TAB_VERB 13 0 "Aus" 391 "Aktiv" 389 "Einspr. aus" 385 "Zuendung aus" 263 "Doppelzuendung" 261 "Doppelzuendung" 257 "Doppelzuendung" 135 "Fehlerspeicher" 133 "Fehlerspeicher" 129 "Fehlerspeicher" 7 "Fehlerspeicher" 5 "Fehlerspeicher" 1 "Fehlerspeicher" DEFAULT_VALUE "Idle" /end COMPU_VTAB
/begin COMPU_METHOD FORMULA_0247 "FORMULA_0247" TAB_VERB "%5.0" "-" COMPU_TAB_REF FORMULA_0247_VTAB /end COMPU_METHOD
/begin COMPU_VTAB FORMULA_0247_VTAB "FORMULA_0247_VTAB" TAB_VERB 15 0 "Aus" 62975 "Aktiv" 46591 "Lambda" 58877 "Einspr. aus" 62973 "Einspr. aus" 58870 "Zuendung aus" 62966 "Zuendung aus" 58871 "N Schwelle" 58863 "RF Schwelle" 58847 "Pos. Dynamik" 58831 "Neg. Dynamik" 58783 "Dynamik" 62847 "Doppelzuendung" 54783 "TZ Gradient" 30207 "FeTraWe" DEFAULT_VALUE "Idle" /end COMPU_VTAB
/begin COMPU_METHOD FORMULA_0248 "FORMULA_0248" TAB_VERB "%5.0" "-" COMPU_TAB_REF FORMULA_0248_VTAB /end COMPU_METHOD
/begin COMPU_VTAB FORMULA_0248_VTAB "FORMULA_0248_VTAB" TAB_VERB 15 0 "Aus" 48127 "Aktiv" 44029 "Einspr. aus" 48125 "Einspr. aus" 44022 "Zuendung aus" 48118 "Zuendung aus" 44023 "N Schwelle" 44015 "RF Schwelle" 43999 "Pos. Dynamik" 43983 "Neg. Dynamik" 43935 "Dynamik" 47999 "Doppelzuendung" 39935 "TZ Gradient" 46079 "Nach Start" 15359 "FeTraWe" DEFAULT_VALUE "Idle" /end COMPU_VTAB
/begin COMPU_METHOD FORMULA_0249 "FORMULA_0249" RAT_FUNC "%8.3" "�KW/Segm" COEFFS 0 10 0 0 0 1 /end COMPU_METHOD
/begin COMPU_METHOD FORMULA_0250 "FORMULA_0250" TAB_VERB "%5.0" "-" COMPU_TAB_REF FORMULA_0250_VTAB /end COMPU_METHOD
/begin COMPU_VTAB FORMULA_0250_VTAB "FORMULA_0250_VTAB" TAB_VERB 1 0 "Kein Aussetzer" DEFAULT_VALUE "Aussetzer erkannt" /end COMPU_VTAB
/begin COMPU_METHOD FORMULA_0251 "FORMULA_0251" TAB_VERB "%5.0" "-" COMPU_TAB_REF FORMULA_0251_VTAB /end COMPU_METHOD
/begin COMPU_VTAB FORMULA_0251_VTAB "FORMULA_0251_VTAB" TAB_VERB 1 0 "Zyl. 1 ok." DEFAULT_VALUE "Auss. Zyl. 1." /end COMPU_VTAB
/begin COMPU_METHOD FORMULA_0252 "FORMULA_0252" TAB_VERB "%5.0" "-" COMPU_TAB_REF FORMULA_0252_VTAB /end COMPU_METHOD
/begin COMPU_VTAB FORMULA_0252_VTAB "FORMULA_0252_VTAB" TAB_VERB 1 0 "Zyl. 2 ok." DEFAULT_VALUE "Auss. Zyl. 2." /end COMPU_VTAB
/begin COMPU_METHOD FORMULA_0253 "FORMULA_0253" TAB_VERB "%5.0" "-" COMPU_TAB_REF FORMULA_0253_VTAB /end COMPU_METHOD
/begin COMPU_VTAB FORMULA_0253_VTAB "FORMULA_0253_VTAB" TAB_VERB 1 0 "Zyl. 3 ok." DEFAULT_VALUE "Auss. Zyl. 3." /end COMPU_VTAB
/begin COMPU_METHOD FORMULA_0254 "FORMULA_0254" TAB_VERB "%5.0" "-" COMPU_TAB_REF FORMULA_0254_VTAB /end COMPU_METHOD
/begin COMPU_VTAB FORMULA_0254_VTAB "FORMULA_0254_VTAB" TAB_VERB 1 0 "Zyl. 4 ok." DEFAULT_VALUE "Auss. Zyl. 4." /end COMPU_VTAB
/begin COMPU_METHOD FORMULA_0255 "FORMULA_0255" TAB_VERB "%5.0" "-" COMPU_TAB_REF FORMULA_0255_VTAB /end COMPU_METHOD
/begin COMPU_VTAB FORMULA_0255_VTAB "FORMULA_0255_VTAB" TAB_VERB 1 0 "Zyl. 5 ok." DEFAULT_VALUE "Auss. Zyl. 5." /end COMPU_VTAB
/begin COMPU_METHOD FORMULA_0256 "FORMULA_0256" TAB_VERB "%5.0" "-" COMPU_TAB_REF FORMULA_0256_VTAB /end COMPU_METHOD
/begin COMPU_VTAB FORMULA_0256_VTAB "FORMULA_0256_VTAB" TAB_VERB 1 0 "Zyl. 6 ok." DEFAULT_VALUE "Auss. Zyl. 6." /end COMPU_VTAB
/begin COMPU_METHOD FORMULA_0257 "FORMULA_0257" TAB_VERB "%5.0" "-" COMPU_TAB_REF FORMULA_0257_VTAB /end COMPU_METHOD
/begin COMPU_VTAB FORMULA_0257_VTAB "FORMULA_0257_VTAB" TAB_VERB 1 0 "Zyl. 7 ok." DEFAULT_VALUE "Auss. Zyl. 7." /end COMPU_VTAB
/begin COMPU_METHOD FORMULA_0258 "FORMULA_0258" TAB_VERB "%5.0" "-" COMPU_TAB_REF FORMULA_0258_VTAB /end COMPU_METHOD
/begin COMPU_VTAB FORMULA_0258_VTAB "FORMULA_0258_VTAB" TAB_VERB 1 0 "Zyl. 8 ok." DEFAULT_VALUE "Auss. Zyl. 8." /end COMPU_VTAB
/begin COMPU_METHOD FORMULA_0259 "FORMULA_0259" TAB_VERB "%5.0" "-" COMPU_TAB_REF FORMULA_0259_VTAB /end COMPU_METHOD
/begin COMPU_VTAB FORMULA_0259_VTAB "FORMULA_0259_VTAB" TAB_VERB 1 0 "Zyl. 9 ok." DEFAULT_VALUE "Auss. Zyl. 9." /end COMPU_VTAB
/begin COMPU_METHOD FORMULA_0260 "FORMULA_0260" TAB_VERB "%5.0" "-" COMPU_TAB_REF FORMULA_0260_VTAB /end COMPU_METHOD
/begin COMPU_VTAB FORMULA_0260_VTAB "FORMULA_0260_VTAB" TAB_VERB 1 0 "Zyl. 10 ok." DEFAULT_VALUE "Auss. Zyl. 10." /end COMPU_VTAB
/begin COMPU_METHOD FORMULA_0261 "FORMULA_0261" TAB_VERB "%3.0" "-" COMPU_TAB_REF FORMULA_0261_VTAB /end COMPU_METHOD
/begin COMPU_VTAB FORMULA_0261_VTAB "FORMULA_0261_VTAB" TAB_VERB 8 0 "Reset" 1 "Inaktiv" 2 "LLR oKS" 3 "LLR mKS" 4 "Abst. B1" 5 "Abst. B2" 6 "Stop" 7 "Fehler" DEFAULT_VALUE "undef" /end COMPU_VTAB
/begin COMPU_METHOD FORMULA_0262 "FORMULA_0262" TAB_VERB "%5.2" "-" COMPU_TAB_REF FORMULA_0262_VTAB /end COMPU_METHOD
/begin COMPU_VTAB FORMULA_0262_VTAB "FORMULA_0262_VTAB" TAB_VERB 2 0 "Nein" 1 "Ja" /end COMPU_VTAB
/begin COMPU_METHOD FORMULA_0263 "FORMULA_0263" TAB_VERB "%5.2" "-" COMPU_TAB_REF FORMULA_0263_VTAB /end COMPU_METHOD
/begin COMPU_VTAB FORMULA_0263_VTAB "FORMULA_0263_VTAB" TAB_VERB 2 0 "Inaktiv" 1 "Aktiv" /end COMPU_VTAB
/begin COMPU_METHOD FORMULA_0264 "FORMULA_0264" TAB_VERB "%5.2" "-" COMPU_TAB_REF FORMULA_0264_VTAB /end COMPU_METHOD
/begin COMPU_VTAB FORMULA_0264_VTAB "FORMULA_0264_VTAB" TAB_VERB 2 0 "Inaktiv" 1 "Aktiv" /end COMPU_VTAB
/begin COMPU_METHOD FORMULA_0265 "FORMULA_0265" RAT_FUNC "%7.2" "V" COEFFS 0 1966080 0 0 0 200 /end COMPU_METHOD
/begin COMPU_METHOD FORMULA_0266 "FORMULA_0266" TAB_VERB "%5.2" "-" COMPU_TAB_REF FORMULA_0266_VTAB /end COMPU_METHOD
/begin COMPU_VTAB FORMULA_0266_VTAB "FORMULA_0266_VTAB" TAB_VERB 2 0 "kein Kickdown" 1 "Kickdown" /end COMPU_VTAB
/begin COMPU_METHOD FORMULA_0267 "FORMULA_0267" TAB_VERB "%3.0" "-" COMPU_TAB_REF FORMULA_0267_VTAB /end COMPU_METHOD
/begin COMPU_VTAB FORMULA_0267_VTAB "FORMULA_0267_VTAB" TAB_VERB 6 0 "O.K." 1 "Kanalfilter" 2 "Kanalfehler" 3 "PWG2_Fehler" 4 "PWG1_Fehler" 5 "Totalausfall" DEFAULT_VALUE "undefiniert" /end COMPU_VTAB
/begin COMPU_METHOD FORMULA_0268 "FORMULA_0268" TAB_VERB "%3.0" "-" COMPU_TAB_REF FORMULA_0268_VTAB /end COMPU_METHOD
/begin COMPU_VTAB FORMULA_0268_VTAB "FORMULA_0268_VTAB" TAB_VERB 5 0 "unbegrenzt" 1 "TZ-Begr" 2 "DK-Begr" 3 "TZ-DK-Begr" 15 "ungueltig" /end COMPU_VTAB
/begin COMPU_METHOD FORMULA_0269 "FORMULA_0269" TAB_VERB "%3.0" "-" COMPU_TAB_REF FORMULA_0269_VTAB /end COMPU_METHOD
/begin COMPU_VTAB FORMULA_0269_VTAB "FORMULA_0269_VTAB" TAB_VERB 6 0 "frei" 1 "CAN sperrt" 2 "DME sperrt" 3 "CAN/DME" 4 "DSC sperrt" 6 "DME/DSC" DEFAULT_VALUE "Mehrfach" /end COMPU_VTAB
/begin COMPU_METHOD FORMULA_0270 "FORMULA_0270" TAB_VERB "%5.2" "-" COMPU_TAB_REF FORMULA_0270_VTAB /end COMPU_METHOD
/begin COMPU_VTAB FORMULA_0270_VTAB "FORMULA_0270_VTAB" TAB_VERB 4 0 "Inaktiv" 1 "Bereit" 2 "Aktiv" 3 "Aktiv" /end COMPU_VTAB
/begin COMPU_METHOD FORMULA_0271 "FORMULA_0271" TAB_VERB "%5.2" "-" COMPU_TAB_REF FORMULA_0271_VTAB /end COMPU_METHOD
/begin COMPU_VTAB FORMULA_0271_VTAB "FORMULA_0271_VTAB" TAB_VERB 4 0 "Inaktiv" 1 "Trigger" 2 "Aktiv" 3 "Aktiv" /end COMPU_VTAB
/begin COMPU_METHOD FORMULA_0272 "FORMULA_0272" TAB_VERB "%5.2" "-" COMPU_TAB_REF FORMULA_0272_VTAB /end COMPU_METHOD
/begin COMPU_VTAB FORMULA_0272_VTAB "FORMULA_0272_VTAB" TAB_VERB 4 0 "Inaktiv" 1 "CUF" 2 "VMA" 3 "CUF+VMA" DEFAULT_VALUE "undef" /end COMPU_VTAB
/begin COMPU_METHOD FORMULA_0273 "FORMULA_0273" TAB_VERB "%5.2" "-" COMPU_TAB_REF FORMULA_0273_VTAB /end COMPU_METHOD
/begin COMPU_VTAB FORMULA_0273_VTAB "FORMULA_0273_VTAB" TAB_VERB 2 0 "not ready" 1 "ready" /end COMPU_VTAB
/begin COMPU_METHOD FORMULA_0274 "FORMULA_0274" TAB_VERB "%5.2" "-" COMPU_TAB_REF FORMULA_0274_VTAB /end COMPU_METHOD
/begin COMPU_VTAB FORMULA_0274_VTAB "FORMULA_0274_VTAB" TAB_VERB 3 0 "iO" 1 "Spalt" 2 "Klemmen" /end COMPU_VTAB
/begin COMPU_METHOD FORMULA_0275 "FORMULA_0275" TAB_VERB "%5.2" "-" COMPU_TAB_REF FORMULA_0275_VTAB /end COMPU_METHOD
/begin COMPU_VTAB FORMULA_0275_VTAB "FORMULA_0275_VTAB" TAB_VERB 4 0 "Inaktiv" 1 "MSR" 2 "ASC" 130 "ASC+SA" DEFAULT_VALUE "undef" /end COMPU_VTAB
/begin COMPU_METHOD FORMULA_0276 "FORMULA_0276" RAT_FUNC "%5.0" "%/s" COEFFS 0 1 0 0 0 20 /end COMPU_METHOD
/begin COMPU_METHOD FORMULA_0277 "FORMULA_0277" RAT_FUNC "%8.3" "V" COEFFS 0 1 0 0 0 0.00155892 /end COMPU_METHOD
/begin COMPU_METHOD FORMULA_0278 "FORMULA_0278" TAB_VERB "%3.0" "-" COMPU_TAB_REF FORMULA_0278_VTAB /end COMPU_METHOD
/begin COMPU_VTAB FORMULA_0278_VTAB "FORMULA_0278_VTAB" TAB_VERB 9 0 "kein Fehler" 1 "nGetr" 2 "nZiel" 4 "nAnfahr" 8 "mKupp" 16 "axMess" 32 "KuppSt" 64 "GetrSt" 128 "Modul" /end COMPU_VTAB
/begin COMPU_METHOD FORMULA_0279 "FORMULA_0279" RAT_FUNC "%3.0" ".Prog" COEFFS 0 1 0 0 0 1 /end COMPU_METHOD
/begin COMPU_METHOD FORMULA_0280 "FORMULA_0280" TAB_VERB "%5.2" "-" COMPU_TAB_REF FORMULA_0280_VTAB /end COMPU_METHOD
/begin COMPU_VTAB FORMULA_0280_VTAB "FORMULA_0280_VTAB" TAB_VERB 2 0 "KL87 aus" 1 "KL87 ein" /end COMPU_VTAB
/begin COMPU_METHOD FORMULA_0281 "FORMULA_0281" TAB_VERB "%5.2" "-" COMPU_TAB_REF FORMULA_0281_VTAB /end COMPU_METHOD
/begin COMPU_VTAB FORMULA_0281_VTAB "FORMULA_0281_VTAB" TAB_VERB 2 0 "MM aus" 1 "MM ein" /end COMPU_VTAB
/begin COMPU_METHOD FORMULA_0282 "FORMULA_0282" TAB_VERB "%3.0" "-" COMPU_TAB_REF FORMULA_0282_VTAB /end COMPU_METHOD
/begin COMPU_VTAB FORMULA_0282_VTAB "FORMULA_0282_VTAB" TAB_VERB 4 0 "kein Fehler" 1 "SAT-Err" 2 "Differenz" 4 "Bereich" DEFAULT_VALUE "Mehrfach" /end COMPU_VTAB
/begin COMPU_METHOD FORMULA_0283 "FORMULA_0283" TAB_VERB "%5.2" "-" COMPU_TAB_REF FORMULA_0283_VTAB /end COMPU_METHOD
/begin COMPU_VTAB FORMULA_0283_VTAB "FORMULA_0283_VTAB" TAB_VERB 6 0 "Inaktiv" 1 "Aktiv" 3 "Aktiv+SA" 4 "TZ frei" 5 "Aktiv+TZ" 7 "Aktiv+TZ+SA" DEFAULT_VALUE "undef" /end COMPU_VTAB
/begin COMPU_METHOD FORMULA_0284 "FORMULA_0284" TAB_VERB "%5.2" "-" COMPU_TAB_REF FORMULA_0284_VTAB /end COMPU_METHOD
/begin COMPU_VTAB FORMULA_0284_VTAB "FORMULA_0284_VTAB" TAB_VERB 2 0 "Inaktiv" 1 "Aktiv" /end COMPU_VTAB
/begin COMPU_METHOD FORMULA_0285 "FORMULA_0285" TAB_VERB "%5.2" "-" COMPU_TAB_REF FORMULA_0285_VTAB /end COMPU_METHOD
/begin COMPU_VTAB FORMULA_0285_VTAB "FORMULA_0285_VTAB" TAB_VERB 2 0 "LL-Eingr" 1 "TL-Eingr" /end COMPU_VTAB
/begin COMPU_METHOD FORMULA_0286 "FORMULA_0286" TAB_VERB "%5.2" "-" COMPU_TAB_REF FORMULA_0286_VTAB /end COMPU_METHOD
/begin COMPU_VTAB FORMULA_0286_VTAB "FORMULA_0286_VTAB" TAB_VERB 2 0 "Inaktiv" 1 "Aktiv" /end COMPU_VTAB
/begin COMPU_METHOD FORMULA_0287 "FORMULA_0287" TAB_VERB "%3.0" "-" COMPU_TAB_REF FORMULA_0287_VTAB /end COMPU_METHOD
/begin COMPU_VTAB FORMULA_0287_VTAB "FORMULA_0287_VTAB" TAB_VERB 13 0 "undef" 1 "Anfahren" 2 "Anfahren-KD" 3 "Wait-RS" 4 "Anfahren-RS" 5 "Schalten" 6 "Einkuppeln" 7 "Anhalten" 8 "Abwuergen" 9 "Radabriss" 11 "ABS-Eingr" 12 "Trampeln" 15 "Fehler" /end COMPU_VTAB
/begin COMPU_METHOD FORMULA_0288 "FORMULA_0288" TAB_VERB "%5.2" "-" COMPU_TAB_REF FORMULA_0288_VTAB /end COMPU_METHOD
/begin COMPU_VTAB FORMULA_0288_VTAB "FORMULA_0288_VTAB" TAB_VERB 22 0 "Fahrer" 1 "Getr" 2 "ASC" 3 "MSR" 4 "Schub" 5 "MCS" 16 "Fahrer+LLR" 17 "Getr+LLR" 18 "ASC+LLR" 19 "MSR+LLR" 32 "Fahrer+AR" 33 "Getr+AR" 34 "ASC+AR" 35 "MSR+AR" 64 "Fahrer+Begr" 65 "Getr+Begr" 66 "ASC+Begr" 67 "MSR+Begr" 128 "Fahrer+SK" 129 "Getr+SK" 130 "ASC+SK" 131 "MSR+SK" DEFAULT_VALUE "Mehrfach" /end COMPU_VTAB
/begin COMPU_METHOD FORMULA_0289 "FORMULA_0289" TAB_VERB "%3.0" "-" COMPU_TAB_REF FORMULA_0289_VTAB /end COMPU_METHOD
/begin COMPU_VTAB FORMULA_0289_VTAB "FORMULA_0289_VTAB" TAB_VERB 2 0 "Sperre Aus" 1 "Sperre Ein" /end COMPU_VTAB
/begin COMPU_METHOD FORMULA_0290 "FORMULA_0290" RAT_FUNC "%7.2" "Nms2" COEFFS 0 512 0 0 0 1 /end COMPU_METHOD
/begin COMPU_METHOD FORMULA_0291 "FORMULA_0291" TAB_VERB "%7.2" "-" COMPU_TAB_REF FORMULA_0291_VTAB /end COMPU_METHOD
/begin COMPU_VTAB FORMULA_0291_VTAB "FORMULA_0291_VTAB" TAB_VERB 2 0 "BLTS aus" 1 "BLTS ein" /end COMPU_VTAB
/begin COMPU_METHOD FORMULA_0292 "FORMULA_0292" TAB_VERB "%7.2" "-" COMPU_TAB_REF FORMULA_0292_VTAB /end COMPU_METHOD
/begin COMPU_VTAB FORMULA_0292_VTAB "FORMULA_0292_VTAB" TAB_VERB 2 0 "Sleep" 1 "Wakeup" /end COMPU_VTAB
/begin COMPU_METHOD FORMULA_0293 "FORMULA_0293" TAB_VERB "%7.2" "-" COMPU_TAB_REF FORMULA_0293_VTAB /end COMPU_METHOD
/begin COMPU_VTAB FORMULA_0293_VTAB "FORMULA_0293_VTAB" TAB_VERB 2 0 "Kl87 aus" 1 "Kl87 ein" /end COMPU_VTAB
/begin COMPU_METHOD FORMULA_0294 "FORMULA_0294" TAB_VERB "%7.2" "-" COMPU_TAB_REF FORMULA_0294_VTAB /end COMPU_METHOD
/begin COMPU_VTAB FORMULA_0294_VTAB "FORMULA_0294_VTAB" TAB_VERB 2 0 "offen" 1 "Kraftschluss" /end COMPU_VTAB
/begin COMPU_METHOD FORMULA_0295 "FORMULA_0295" RAT_FUNC "%9.4" "-" COEFFS 0 16384 0 0 0 1 /end COMPU_METHOD
/begin COMPU_METHOD FORMULA_0296 "FORMULA_0296" TAB_VERB "%7.2" "-" COMPU_TAB_REF FORMULA_0296_VTAB /end COMPU_METHOD
/begin COMPU_VTAB FORMULA_0296_VTAB "FORMULA_0296_VTAB" TAB_VERB 1 2365 "aktiv" DEFAULT_VALUE "nicht aktiv" /end COMPU_VTAB
/begin COMPU_METHOD FORMULA_0297 "FORMULA_0297" TAB_VERB "%7.2" "-" COMPU_TAB_REF FORMULA_0297_VTAB /end COMPU_METHOD
/begin COMPU_VTAB FORMULA_0297_VTAB "FORMULA_0297_VTAB" TAB_VERB 2 0 "sperrt" 1 "aktiv" /end COMPU_VTAB
/begin COMPU_METHOD FORMULA_0298 "FORMULA_0298" TAB_VERB "%7.2" "-" COMPU_TAB_REF FORMULA_0298_VTAB /end COMPU_METHOD
/begin COMPU_VTAB FORMULA_0298_VTAB "FORMULA_0298_VTAB" TAB_VERB 2 0 "inaktiv" 1 "aktiv" /end COMPU_VTAB
/begin COMPU_METHOD FORMULA_0299 "FORMULA_0299" TAB_VERB "%7.2" "-" COMPU_TAB_REF FORMULA_0299_VTAB /end COMPU_METHOD
/begin COMPU_VTAB FORMULA_0299_VTAB "FORMULA_0299_VTAB" TAB_VERB 2 0 "sperrt" 1 "aktiv" /end COMPU_VTAB
/begin COMPU_METHOD FORMULA_0300 "FORMULA_0300" TAB_VERB "%7.2" "-" COMPU_TAB_REF FORMULA_0300_VTAB /end COMPU_METHOD
/begin COMPU_VTAB FORMULA_0300_VTAB "FORMULA_0300_VTAB" TAB_VERB 2 0 "sperrt" 1 "aktiv" /end COMPU_VTAB
/begin COMPU_METHOD FORMULA_0301 "FORMULA_0301" TAB_VERB "%7.2" "-" COMPU_TAB_REF FORMULA_0301_VTAB /end COMPU_METHOD
/begin COMPU_VTAB FORMULA_0301_VTAB "FORMULA_0301_VTAB" TAB_VERB 2 0 "sperrt" 1 "aktiv" /end COMPU_VTAB
/begin COMPU_METHOD FORMULA_0302 "FORMULA_0302" TAB_VERB "%7.2" "-" COMPU_TAB_REF FORMULA_0302_VTAB /end COMPU_METHOD
/begin COMPU_VTAB FORMULA_0302_VTAB "FORMULA_0302_VTAB" TAB_VERB 2 0 "sperrt" 1 "aktiv" /end COMPU_VTAB
/begin COMPU_METHOD FORMULA_0303 "FORMULA_0303" TAB_VERB "%7.2" "-" COMPU_TAB_REF FORMULA_0303_VTAB /end COMPU_METHOD
/begin COMPU_VTAB FORMULA_0303_VTAB "FORMULA_0303_VTAB" TAB_VERB 2 0 "aus" 1 "aktiv" /end COMPU_VTAB
/begin COMPU_METHOD FORMULA_0304 "FORMULA_0304" TAB_VERB "%7.2" "-" COMPU_TAB_REF FORMULA_0304_VTAB /end COMPU_METHOD
/begin COMPU_VTAB FORMULA_0304_VTAB "FORMULA_0304_VTAB" TAB_VERB 2 0 "aus" 1 "aktiv" /end COMPU_VTAB
/begin COMPU_METHOD FORMULA_0305 "FORMULA_0305" TAB_VERB "%7.2" "-" COMPU_TAB_REF FORMULA_0305_VTAB /end COMPU_METHOD
/begin COMPU_VTAB FORMULA_0305_VTAB "FORMULA_0305_VTAB" TAB_VERB 2 0 "sperrt" 1 "aktiv" /end COMPU_VTAB
/begin COMPU_METHOD FORMULA_0306 "FORMULA_0306" TAB_VERB "%7.2" "-" COMPU_TAB_REF FORMULA_0306_VTAB /end COMPU_METHOD
/begin COMPU_VTAB FORMULA_0306_VTAB "FORMULA_0306_VTAB" TAB_VERB 2 0 "aus" 1 "aktiv" /end COMPU_VTAB
/begin COMPU_METHOD FORMULA_0307 "FORMULA_0307" TAB_VERB "%7.2" "-" COMPU_TAB_REF FORMULA_0307_VTAB /end COMPU_METHOD
/begin COMPU_VTAB FORMULA_0307_VTAB "FORMULA_0307_VTAB" TAB_VERB 2 0 "aus" 1 "aktiv" /end COMPU_VTAB
/begin COMPU_METHOD FORMULA_0308 "FORMULA_0308" TAB_VERB "%7.2" "-" COMPU_TAB_REF FORMULA_0308_VTAB /end COMPU_METHOD
/begin COMPU_VTAB FORMULA_0308_VTAB "FORMULA_0308_VTAB" TAB_VERB 2 0 "aus" 1 "aktiv" /end COMPU_VTAB
/begin COMPU_METHOD FORMULA_0309 "FORMULA_0309" TAB_VERB "%5.2" "-" COMPU_TAB_REF FORMULA_0309_VTAB /end COMPU_METHOD
/begin COMPU_VTAB FORMULA_0309_VTAB "FORMULA_0309_VTAB" TAB_VERB 6 0 "Inaktiv" 1 "Abregeln" 2 "Schalten" 3 "Aufregeln" 4 "Ende" 15 "Error" /end COMPU_VTAB
/begin COMPU_METHOD FORMULA_0310 "FORMULA_0310" TAB_VERB "%7.2" "-" COMPU_TAB_REF FORMULA_0310_VTAB /end COMPU_METHOD
/begin COMPU_VTAB FORMULA_0310_VTAB "FORMULA_0310_VTAB" TAB_VERB 2 0 "Schubbetrieb" 1 "Zugbetrieb" /end COMPU_VTAB
/begin COMPU_METHOD FORMULA_0311 "FORMULA_0311" TAB_VERB "%7.2" "-" COMPU_TAB_REF FORMULA_0311_VTAB /end COMPU_METHOD
/begin COMPU_VTAB FORMULA_0311_VTAB "FORMULA_0311_VTAB" TAB_VERB 3 0 "keine Schaltung" 1 "Hochschaltung" 2 "Rueckschaltung" DEFAULT_VALUE "undef" /end COMPU_VTAB
/begin COMPU_METHOD FORMULA_0312 "FORMULA_0312" TAB_VERB "%7.2" "-" COMPU_TAB_REF FORMULA_0312_VTAB /end COMPU_METHOD
/begin COMPU_VTAB FORMULA_0312_VTAB "FORMULA_0312_VTAB" TAB_VERB 2 0 "Manuell" 1 "Automat" /end COMPU_VTAB
/begin COMPU_METHOD FORMULA_0313 "FORMULA_0313" TAB_VERB "%7.2" "-" COMPU_TAB_REF FORMULA_0313_VTAB /end COMPU_METHOD
/begin COMPU_VTAB FORMULA_0313_VTAB "FORMULA_0313_VTAB" TAB_VERB 2 0 "mit Eingriff" 1 "ohne Eingriff" /end COMPU_VTAB
/begin COMPU_METHOD FORMULA_0314 "FORMULA_0314" TAB_VERB "%7.2" "-" COMPU_TAB_REF FORMULA_0314_VTAB /end COMPU_METHOD
/begin COMPU_VTAB FORMULA_0314_VTAB "FORMULA_0314_VTAB" TAB_VERB 2 0 "nein" 1 "ja" /end COMPU_VTAB
/begin COMPU_METHOD FORMULA_0315 "FORMULA_0315" TAB_VERB "%7.2" "-" COMPU_TAB_REF FORMULA_0315_VTAB /end COMPU_METHOD
/begin COMPU_VTAB FORMULA_0315_VTAB "FORMULA_0315_VTAB" TAB_VERB 2 0 "nein" 1 "ja" /end COMPU_VTAB
/begin COMPU_METHOD FORMULA_0316 "FORMULA_0316" TAB_VERB "%7.2" "-" COMPU_TAB_REF FORMULA_0316_VTAB /end COMPU_METHOD
/begin COMPU_VTAB FORMULA_0316_VTAB "FORMULA_0316_VTAB" TAB_VERB 2 0 "nein" 1 "ja" /end COMPU_VTAB
/begin COMPU_METHOD FORMULA_0319 "FORMULA_0319" TAB_VERB "%7.2" "-" COMPU_TAB_REF FORMULA_0319_VTAB /end COMPU_METHOD
/begin COMPU_VTAB FORMULA_0319_VTAB "FORMULA_0319_VTAB" TAB_VERB 2 0 "bekannt" 1 "unbekannt" /end COMPU_VTAB
/begin COMPU_METHOD FORMULA_0320 "FORMULA_0320" TAB_VERB "%7.2" "-" COMPU_TAB_REF FORMULA_0320_VTAB /end COMPU_METHOD
/begin COMPU_VTAB FORMULA_0320_VTAB "FORMULA_0320_VTAB" TAB_VERB 2 0 "nicht ungerade" 1 "ungerade" /end COMPU_VTAB
/begin COMPU_METHOD FORMULA_0321 "FORMULA_0321" TAB_VERB "%7.2" "-" COMPU_TAB_REF FORMULA_0321_VTAB /end COMPU_METHOD
/begin COMPU_VTAB FORMULA_0321_VTAB "FORMULA_0321_VTAB" TAB_VERB 2 0 "nicht gerade" 1 "gerade" /end COMPU_VTAB
/begin COMPU_METHOD FORMULA_0322 "FORMULA_0322" TAB_VERB "%7.2" "-" COMPU_TAB_REF FORMULA_0322_VTAB /end COMPU_METHOD
/begin COMPU_VTAB FORMULA_0322_VTAB "FORMULA_0322_VTAB" TAB_VERB 2 0 "keine Aktion" 1 "Aktion" /end COMPU_VTAB
/begin COMPU_METHOD FORMULA_0323 "FORMULA_0323" TAB_VERB "%7.2" "-" COMPU_TAB_REF FORMULA_0323_VTAB /end COMPU_METHOD
/begin COMPU_VTAB FORMULA_0323_VTAB "FORMULA_0323_VTAB" TAB_VERB 2 0 "nicht plausibel" 1 "plausibel" /end COMPU_VTAB
/begin COMPU_METHOD FORMULA_0324 "FORMULA_0324" TAB_VERB "%7.2" "-" COMPU_TAB_REF FORMULA_0324_VTAB /end COMPU_METHOD
/begin COMPU_VTAB FORMULA_0324_VTAB "FORMULA_0324_VTAB" TAB_VERB 2 0 "nicht berechnen" 1 "neu berechnen" /end COMPU_VTAB
/begin COMPU_METHOD FORMULA_0325 "FORMULA_0325" TAB_VERB "%7.2" "-" COMPU_TAB_REF FORMULA_0325_VTAB /end COMPU_METHOD
/begin COMPU_VTAB FORMULA_0325_VTAB "FORMULA_0325_VTAB" TAB_VERB 2 0 "Gang halten" 1 "Gang uebernehmen" /end COMPU_VTAB
/begin COMPU_METHOD FORMULA_0326 "FORMULA_0326" TAB_VERB "%3.0" "-" COMPU_TAB_REF FORMULA_0326_VTAB /end COMPU_METHOD
/begin COMPU_VTAB FORMULA_0326_VTAB "FORMULA_0326_VTAB" TAB_VERB 3 0 "aus" 1 "inaktiv" 2 "aktiv" /end COMPU_VTAB
/begin COMPU_METHOD FORMULA_0327 "FORMULA_0327" TAB_VERB "%3.0" "-" COMPU_TAB_REF FORMULA_0327_VTAB /end COMPU_METHOD
/begin COMPU_VTAB FORMULA_0327_VTAB "FORMULA_0327_VTAB" TAB_VERB 2 0 "aus" 1 "ein" /end COMPU_VTAB
/begin COMPU_METHOD FORMULA_0328 "FORMULA_0328" TAB_VERB "%3.0" "-" COMPU_TAB_REF FORMULA_0328_VTAB /end COMPU_METHOD
/begin COMPU_VTAB FORMULA_0328_VTAB "FORMULA_0328_VTAB" TAB_VERB 4 0 "Inaktiv" 1 "HUD ein" 2 "NotAcpt" 3 "Ein+NotAcpt" /end COMPU_VTAB
/begin COMPU_METHOD FORMULA_0329 "FORMULA_0329" RAT_FUNC "%6.1" "km/h" COEFFS 0 10 0 0 0 1 /end COMPU_METHOD
/begin COMPU_METHOD FORMULA_0330 "FORMULA_0330" TAB_VERB "%3.0" "-" COMPU_TAB_REF FORMULA_0330_VTAB /end COMPU_METHOD
/begin COMPU_VTAB FORMULA_0330_VTAB "FORMULA_0330_VTAB" TAB_VERB 13 0 "Verriegelt" 1 "Aus" 2 "Ein / Aus" 3 "Passiv" 4 "Abschalt Rampe" 5 "Wiederaufnahme" 6 "Set" 7 "Konstantfahrt" 8 "Tipp plus" 9 "Tipp minus" 10 "Beschleunigung" 11 "Verzoegern" 12 "Ueberholen" DEFAULT_VALUE "undef" /end COMPU_VTAB
/begin COMPU_METHOD FORMULA_0331 "FORMULA_0331" TAB_VERB "%4.1" "-" COMPU_TAB_REF FORMULA_0331_VTAB /end COMPU_METHOD
/begin COMPU_VTAB FORMULA_0331_VTAB "FORMULA_0331_VTAB" TAB_VERB 2 0 "SA freigegeben" 1 "SA gesperrt" /end COMPU_VTAB
/begin COMPU_METHOD FORMULA_0332 "FORMULA_0332" TAB_VERB "%3.0" "-" COMPU_TAB_REF FORMULA_0332_VTAB /end COMPU_METHOD
/begin COMPU_VTAB FORMULA_0332_VTAB "FORMULA_0332_VTAB" TAB_VERB 4 0 "keine" 1 "Bank1" 2 "Bank2" 3 "Bank1+2" /end COMPU_VTAB
/begin COMPU_METHOD FORMULA_0333 "FORMULA_0333" RAT_FUNC "%7.2" "�C" COEFFS 0 20 5463 0 0 1 /end COMPU_METHOD
/begin COMPU_METHOD FORMULA_0334 "FORMULA_0334" TAB_VERB "%5.2" "-" COMPU_TAB_REF FORMULA_0334_VTAB /end COMPU_METHOD
/begin COMPU_VTAB FORMULA_0334_VTAB "FORMULA_0334_VTAB" TAB_VERB 1 0 "Abregeln_B1" DEFAULT_VALUE "Aufregeln_B1" /end COMPU_VTAB
/begin COMPU_METHOD FORMULA_0335 "FORMULA_0335" TAB_VERB "%5.2" "-" COMPU_TAB_REF FORMULA_0335_VTAB /end COMPU_METHOD
/begin COMPU_VTAB FORMULA_0335_VTAB "FORMULA_0335_VTAB" TAB_VERB 1 0 "Abregeln_B2" DEFAULT_VALUE "Aufregeln_B2" /end COMPU_VTAB
/begin COMPU_METHOD FORMULA_0336 "FORMULA_0336" TAB_VERB "%5.2" "-" COMPU_TAB_REF FORMULA_0336_VTAB /end COMPU_METHOD
/begin COMPU_VTAB FORMULA_0336_VTAB "FORMULA_0336_VTAB" TAB_VERB 1 0 "No_Grad_B1" DEFAULT_VALUE "Gradient_B1" /end COMPU_VTAB
/begin COMPU_METHOD FORMULA_0337 "FORMULA_0337" TAB_VERB "%5.2" "-" COMPU_TAB_REF FORMULA_0337_VTAB /end COMPU_METHOD
/begin COMPU_VTAB FORMULA_0337_VTAB "FORMULA_0337_VTAB" TAB_VERB 1 0 "No_Grad_B2" DEFAULT_VALUE "Gradient_B2" /end COMPU_VTAB
/begin COMPU_METHOD FORMULA_0338 "FORMULA_0338" TAB_VERB "%5.2" "-" COMPU_TAB_REF FORMULA_0338_VTAB /end COMPU_METHOD
/begin COMPU_VTAB FORMULA_0338_VTAB "FORMULA_0338_VTAB" TAB_VERB 1 0 "No_Init_B1" DEFAULT_VALUE "Init_B1" /end COMPU_VTAB
/begin COMPU_METHOD FORMULA_0339 "FORMULA_0339" TAB_VERB "%5.2" "-" COMPU_TAB_REF FORMULA_0339_VTAB /end COMPU_METHOD
/begin COMPU_VTAB FORMULA_0339_VTAB "FORMULA_0339_VTAB" TAB_VERB 1 0 "No_Init_B2" DEFAULT_VALUE "Init_B2" /end COMPU_VTAB
/begin COMPU_METHOD FORMULA_0340 "FORMULA_0340" RAT_FUNC "%11.4" "�C" COEFFS 0 10240 2797056 0 0 1 /end COMPU_METHOD
/begin COMPU_METHOD FORMULA_0341 "FORMULA_0341" TAB_VERB "%3.0" "-" COMPU_TAB_REF FORMULA_0341_VTAB /end COMPU_METHOD
/begin COMPU_VTAB FORMULA_0341_VTAB "FORMULA_0341_VTAB" TAB_VERB 4 0 "Lampe aus" 1 "Lampe gelb" 2 "Lampe rot" 3 "Lampe rot" /end COMPU_VTAB
/begin COMPU_METHOD FORMULA_0342 "FORMULA_0342" TAB_VERB "%3.0" "-" COMPU_TAB_REF FORMULA_0342_VTAB /end COMPU_METHOD
/begin COMPU_VTAB FORMULA_0342_VTAB "FORMULA_0342_VTAB" TAB_VERB 2 0 "Inaktiv" 1 "Aktiv" /end COMPU_VTAB
/begin COMPU_METHOD FORMULA_0343 "FORMULA_0343" TAB_VERB "%4.1" "-" COMPU_TAB_REF FORMULA_0343_VTAB /end COMPU_METHOD
/begin COMPU_VTAB FORMULA_0343_VTAB "FORMULA_0343_VTAB" TAB_VERB 2 0 "gesperrt" 1 "senden" /end COMPU_VTAB
/begin COMPU_METHOD FORMULA_0426 "FORMULA_0426" RAT_FUNC "%5.0" "�C" COEFFS 0 10 0 0 0 1 /end COMPU_METHOD
/begin COMPU_METHOD FORMULA_0431 "FORMULA_0431" RAT_FUNC "%5.2" "mm" COEFFS 0 256 0 0 0 75 /end COMPU_METHOD
/* ------------------ Abschnitt erzeugt aus dgen.dat ------------------ */
/begin COMPU_METHOD FORMULA_0458 "FORMULA_0458" RAT_FUNC "%4.1" "s" COEFFS 0 10 0 0 0 1 /end COMPU_METHOD
/begin COMPU_METHOD FORMULA_0471 "FORMULA_0471" RAT_FUNC "%5.2" "%" COEFFS 0 256 0 0 0 100 /end COMPU_METHOD
/begin COMPU_METHOD FORMULA_0529 "FORMULA_0529" RAT_FUNC "%7.2" "mg" COEFFS 0 4 0 0 0 1 /end COMPU_METHOD
/begin COMPU_METHOD FORMULA_0532 "FORMULA_0532" RAT_FUNC "%5.0" "mV" COEFFS 0 1024 0 0 0 5000 /end COMPU_METHOD
/begin COMPU_METHOD FORMULA_0537 "FORMULA_0537" RAT_FUNC "%6.1" "Ohm" COEFFS 0 10 0 0 0 1 /end COMPU_METHOD
/begin COMPU_METHOD FORMULA_0538 "FORMULA_0538" RAT_FUNC "%5.0" "ms" COEFFS 0 1 0 0 0 10 /end COMPU_METHOD
/begin COMPU_METHOD FORMULA_0539 "FORMULA_0539" RAT_FUNC "%5.0" "ms" COEFFS 0 1 0 0 0 100 /end COMPU_METHOD
/begin COMPU_METHOD FORMULA_0555 "FORMULA_0555" RAT_FUNC "%8.3" "%" COEFFS 0 32768 0 0 0 100 /end COMPU_METHOD
/begin COMPU_METHOD FORMULA_0556 "FORMULA_0556" RAT_FUNC "%9.4" "-" COEFFS 0 10000 0 0 0 1 /end COMPU_METHOD
/begin COMPU_METHOD FORMULA_0557 "FORMULA_0557" RAT_FUNC "%4.1" "l" COEFFS 0 2 0 0 0 1 /end COMPU_METHOD
/begin COMPU_METHOD FORMULA_0562 "FORMULA_0562" RAT_FUNC "%6.1" "kg*5ms/h" COEFFS 0 10 0 0 0 1 /end COMPU_METHOD
/begin COMPU_METHOD FORMULA_0600 "FORMULA_0600" RAT_FUNC "%7.2" "min" COEFFS 0 60 0 0 0 1 /end COMPU_METHOD
/begin COMPU_METHOD FORMULA_0606 "FORMULA_0606" RAT_FUNC "%7.2" "mm" COEFFS 0 337 0 0 0 100 /end COMPU_METHOD
/begin COMPU_METHOD FORMULA_0616 "FORMULA_0616" RAT_FUNC "%5.0" "km" COEFFS 0 1 0 0 0 1 /end COMPU_METHOD
/begin COMPU_METHOD FORMULA_0651 "FORMULA_0651" RAT_FUNC "%6.3" "s" COEFFS 0 0 1.28 0 1 0 /end COMPU_METHOD
/begin COMPU_METHOD FORMULA_0664 "FORMULA_0664" RAT_FUNC "%5.2" "s" COEFFS 0 0 2.56 0 1 0 /end COMPU_METHOD
/begin COMPU_METHOD FORMULA_0666 "FORMULA_0666" RAT_FUNC "%5.0" ".Gang" COEFFS 0 1 0 0 0 1 /end COMPU_METHOD
/begin COMPU_METHOD FORMULA_0672 "FORMULA_0672" RAT_FUNC "%6.1" "ms" COEFFS 0 10 0 0 0 6 /end COMPU_METHOD
/begin COMPU_METHOD FORMULA_0675 "FORMULA_0675" TAB_VERB "%3.0" "-" COMPU_TAB_REF FORMULA_0675_VTAB /end COMPU_METHOD
/begin COMPU_VTAB FORMULA_0675_VTAB "FORMULA_0675_VTAB" TAB_VERB 4 0 "aut. Typerkennung" 1 "600W" 2 "850W" 128 "TEMIC DC 850W invers" DEFAULT_VALUE "undef" /end COMPU_VTAB
/begin COMPU_METHOD FORMULA_0676 "FORMULA_0676" RAT_FUNC "%7.2" "%/100ms" COEFFS 0 512 0 0 0 1 /end COMPU_METHOD
/begin COMPU_METHOD FORMULA_0677 "FORMULA_0677" RAT_FUNC "%6.3" "-" COEFFS 0 128 0 0 0 1 /end COMPU_METHOD
/begin COMPU_METHOD FORMULA_0683 "FORMULA_0683" RAT_FUNC "%5.2" "s" COEFFS 0 0 25.6 0 1 0 /end COMPU_METHOD
/begin COMPU_METHOD FORMULA_0720 "FORMULA_0720" TAB_VERB "%5.2" "-" COMPU_TAB_REF FORMULA_0720_VTAB /end COMPU_METHOD
/begin COMPU_VTAB FORMULA_0720_VTAB "FORMULA_0720_VTAB" TAB_VERB 3 0 "S85_BG2" 1 "S85_BG3" 2 "S65" DEFAULT_VALUE "ungueltig" /end COMPU_VTAB
/begin COMPU_METHOD FORMULA_0721 "FORMULA_0721" TAB_VERB "%5.2" "-" COMPU_TAB_REF FORMULA_0721_VTAB /end COMPU_METHOD
/begin COMPU_VTAB FORMULA_0721_VTAB "FORMULA_0721_VTAB" TAB_VERB 2 0 "Keine Popelung" 1 "Mit Popelung" DEFAULT_VALUE "ungueltig" /end COMPU_VTAB
/begin COMPU_METHOD FORMULA_0722 "FORMULA_0722" TAB_VERB "%5.2" "-" COMPU_TAB_REF FORMULA_0722_VTAB /end COMPU_METHOD
/begin COMPU_VTAB FORMULA_0722_VTAB "FORMULA_0722_VTAB" TAB_VERB 2 0 "aus mzyl_sek_aq_mvac" 1 "aus mvac_ml_sr" /end COMPU_VTAB
/begin COMPU_METHOD FORMULA_0728 "FORMULA_0728" RAT_FUNC "%8.3" "-/s" COEFFS 0 16384 0 0 0 10 /end COMPU_METHOD
/begin COMPU_METHOD FORMULA_0729 "FORMULA_0729" TAB_VERB "%3.0" "-" COMPU_TAB_REF FORMULA_0729_VTAB /end COMPU_METHOD
/begin COMPU_VTAB FORMULA_0729_VTAB "FORMULA_0729_VTAB" TAB_VERB 2 0 "TNKAT aus MDL" 1 "TNKAT aus tabg_kat" DEFAULT_VALUE "undef" /end COMPU_VTAB
/begin COMPU_METHOD FORMULA_0731 "FORMULA_0731" RAT_FUNC "%5.2" "mm" COEFFS 0 337 0 0 0 100 /end COMPU_METHOD
/* ------------------ Abschnitt erzeugt aus kva.dat ------------------ */
/begin COMPU_METHOD FORMULA_0746 "FORMULA_0746" RAT_FUNC "%6.1" "l/h" COEFFS 0 8 0 0 0 1 /end COMPU_METHOD
/begin COMPU_METHOD FORMULA_0747 "FORMULA_0747" RAT_FUNC "%9.4" "kg/l=mg/ul" COEFFS 0 8192 0 0 0 1 /end COMPU_METHOD
/begin COMPU_METHOD FORMULA_0752 "FORMULA_0752" RAT_FUNC "%7.2" "mg" COEFFS 0 64 0 0 0 1 /end COMPU_METHOD
/begin COMPU_METHOD FORMULA_0755 "FORMULA_0755" RAT_FUNC "%7.2" "-" COEFFS 0 256 0 0 0 1 /end COMPU_METHOD
/begin COMPU_METHOD FORMULA_0782 "FORMULA_0782" TAB_VERB "%7.2" "-" COMPU_TAB_REF FORMULA_0782_VTAB /end COMPU_METHOD
/begin COMPU_VTAB FORMULA_0782_VTAB "FORMULA_0782_VTAB" TAB_VERB 2 0 "automatisch" 1 "manuell" /end COMPU_VTAB
/begin COMPU_METHOD FORMULA_0784 "FORMULA_0784" TAB_VERB "%7.2" "-" COMPU_TAB_REF FORMULA_0784_VTAB /end COMPU_METHOD
/begin COMPU_VTAB FORMULA_0784_VTAB "FORMULA_0784_VTAB" TAB_VERB 2 0 "ADAPTION" 1 "RESET" /end COMPU_VTAB
/begin COMPU_METHOD FORMULA_0786 "FORMULA_0786" RAT_FUNC "%7.2" "ms" COEFFS 0 1000 0 0 0 1 /end COMPU_METHOD
/begin COMPU_METHOD FORMULA_0791 "FORMULA_0791" RAT_FUNC "%5.0" "�C" COEFFS 0 1 0 0 0 1 /end COMPU_METHOD
/begin COMPU_METHOD FORMULA_0798 "FORMULA_0798" TAB_VERB "%7.2" "-" COMPU_TAB_REF FORMULA_0798_VTAB /end COMPU_METHOD
/begin COMPU_VTAB FORMULA_0798_VTAB "FORMULA_0798_VTAB" TAB_VERB 2 0 "inaktiv" 1 "aktiv" /end COMPU_VTAB
/begin COMPU_METHOD FORMULA_0799 "FORMULA_0799" RAT_FUNC "%5.0" "sec" COEFFS 0 1 0 0 0 1 /end COMPU_METHOD
/begin COMPU_METHOD FORMULA_0800 "FORMULA_0800" RAT_FUNC "%6.1" "�C" COEFFS 0 10 0 0 0 1 /end COMPU_METHOD
/begin COMPU_METHOD FORMULA_0805 "FORMULA_0805" RAT_FUNC "%7.2" "-" COEFFS 0 128 0 0 0 1 /end COMPU_METHOD
/begin COMPU_METHOD FORMULA_0832 "FORMULA_0832" RAT_FUNC "%5.0" "mg" COEFFS 0 1 0 0 0 1 /end COMPU_METHOD
/begin COMPU_METHOD FORMULA_0839 "FORMULA_0839" TAB_VERB "%5.2" "-" COMPU_TAB_REF FORMULA_0839_VTAB /end COMPU_METHOD
/begin COMPU_VTAB FORMULA_0839_VTAB "FORMULA_0839_VTAB" TAB_VERB 2 0 "inaktiv" 1 "aktiv" /end COMPU_VTAB
/begin COMPU_METHOD FORMULA_0840 "FORMULA_0840" RAT_FUNC "%6.1" "%" COEFFS 0 1024 0 0 0 100 /end COMPU_METHOD
/begin COMPU_METHOD FORMULA_0862 "FORMULA_0862" RAT_FUNC "%5.0" "s" COEFFS 0 10 0 0 0 1 /end COMPU_METHOD
/begin COMPU_METHOD FORMULA_0868 "FORMULA_0868" TAB_VERB "%7.2" "-" COMPU_TAB_REF FORMULA_0868_VTAB /end COMPU_METHOD
/begin COMPU_VTAB FORMULA_0868_VTAB "FORMULA_0868_VTAB" TAB_VERB 2 0 "OBD-Plausi inaktiv" 1 "OBD-Plausi aktiv" /end COMPU_VTAB
/begin COMPU_METHOD FORMULA_0869 "FORMULA_0869" TAB_VERB "%7.2" "-" COMPU_TAB_REF FORMULA_0869_VTAB /end COMPU_METHOD
/begin COMPU_VTAB FORMULA_0869_VTAB "FORMULA_0869_VTAB" TAB_VERB 2 0 "OBD-SA inaktiv" 1 "OBD-SA aktiv" /end COMPU_VTAB
/begin COMPU_METHOD FORMULA_0870 "FORMULA_0870" TAB_VERB "%7.2" "-" COMPU_TAB_REF FORMULA_0870_VTAB /end COMPU_METHOD
/begin COMPU_VTAB FORMULA_0870_VTAB "FORMULA_0870_VTAB" TAB_VERB 2 0 "OBD-TL/VL inaktiv" 1 "OBD-TL/VL aktiv" /end COMPU_VTAB
/begin COMPU_METHOD FORMULA_0871 "FORMULA_0871" TAB_VERB "%7.2" "-" COMPU_TAB_REF FORMULA_0871_VTAB /end COMPU_METHOD
/begin COMPU_VTAB FORMULA_0871_VTAB "FORMULA_0871_VTAB" TAB_VERB 2 0 "KDS inaktiv" 1 "KSD aktiv" /end COMPU_VTAB
/begin COMPU_METHOD FORMULA_0931 "FORMULA_0931" RAT_FUNC "%7.2" "%" COEFFS 0 8192 0 0 0 100 /end COMPU_METHOD
/begin COMPU_METHOD FORMULA_0945 "FORMULA_0945" RAT_FUNC "%5.0" "mV" COEFFS 0 1024 0 0 0 5000 /end COMPU_METHOD
/begin COMPU_METHOD FORMULA_0946 "FORMULA_0946" RAT_FUNC "%7.2" "%" COEFFS 0 2048 0 0 0 100 /end COMPU_METHOD
/begin COMPU_METHOD FORMULA_0957 "FORMULA_0957" TAB_VERB "%7.2" "-" COMPU_TAB_REF FORMULA_0957_VTAB /end COMPU_METHOD
/begin COMPU_VTAB FORMULA_0957_VTAB "FORMULA_0957_VTAB" TAB_VERB 2 0 "keine Heizung" 1 "Heizung" DEFAULT_VALUE "undefiniert" /end COMPU_VTAB
/begin COMPU_METHOD FORMULA_0958 "FORMULA_0958" RAT_FUNC "%7.2" "%/�C" COEFFS 0 1024 0 0 0 1 /end COMPU_METHOD
/begin COMPU_METHOD FORMULA_0959 "FORMULA_0959" RAT_FUNC "%6.1" "V/s" COEFFS 0 10 0 0 0 1 /end COMPU_METHOD
/begin COMPU_METHOD FORMULA_0960 "FORMULA_0960" RAT_FUNC "%5.0" "-" COEFFS 0 1 0 0 0 100 /end COMPU_METHOD
/begin COMPU_METHOD FORMULA_0961 "FORMULA_0961" TAB_VERB "%7.2" "-" COMPU_TAB_REF FORMULA_0961_VTAB /end COMPU_METHOD
/begin COMPU_VTAB FORMULA_0961_VTAB "FORMULA_0961_VTAB" TAB_VERB 2 0 "tmot_start" 1 "tabg_hys" /end COMPU_VTAB
/begin COMPU_METHOD FORMULA_0962 "FORMULA_0962" RAT_FUNC "%5.0" "-" COEFFS 0 32768 0 0 0 1 /end COMPU_METHOD
/begin COMPU_METHOD FORMULA_1011 "FORMULA_1011" TAB_VERB "%3.0" "-" COMPU_TAB_REF FORMULA_1011_VTAB /end COMPU_METHOD
/begin COMPU_VTAB FORMULA_1011_VTAB "FORMULA_1011_VTAB" TAB_VERB 2 0 "Speichern" 1 "Reset" DEFAULT_VALUE "undef" /end COMPU_VTAB
/* ------------------ Abschnitt erzeugt aus pksr.dat ------------------ */
/begin COMPU_METHOD FORMULA_1041 "FORMULA_1041" RAT_FUNC "%4.1" "bar/s" COEFFS 0 10 0 0 0 1 /end COMPU_METHOD
/begin COMPU_METHOD FORMULA_1046 "FORMULA_1046" TAB_VERB "%5.2" "-" COMPU_TAB_REF FORMULA_1046_VTAB /end COMPU_METHOD
/begin COMPU_VTAB FORMULA_1046_VTAB "FORMULA_1046_VTAB" TAB_VERB 5 0 "EKP2 n, Si.gen. AUS" 1 "EKP2 j, Si.gen. AUS" 2 "EKP2 n, Si.gen. EIN" 3 "EKP2 ja, Si.gen. EIN" 4 "EKP_100" /end COMPU_VTAB
/begin COMPU_METHOD FORMULA_1047 "FORMULA_1047" TAB_VERB "%5.2" "-" COMPU_TAB_REF FORMULA_1047_VTAB /end COMPU_METHOD
/begin COMPU_VTAB FORMULA_1047_VTAB "FORMULA_1047_VTAB" TAB_VERB 2 0 "EKP-Diagnose AUS" 1 "EKP-Diagnose EIN" DEFAULT_VALUE "ungueltig" /end COMPU_VTAB
/begin COMPU_METHOD FORMULA_1048 "FORMULA_1048" RAT_FUNC "%6.1" "ms" COEFFS 0 1000 0 0 0 1 /end COMPU_METHOD
/begin COMPU_METHOD FORMULA_1049 "FORMULA_1049" RAT_FUNC "%9.4" "-/5ms" COEFFS 0 10000 0 0 0 1 /end COMPU_METHOD
/begin COMPU_METHOD FORMULA_1050 "FORMULA_1050" TAB_VERB "%5.2" "-" COMPU_TAB_REF FORMULA_1050_VTAB /end COMPU_METHOD
/begin COMPU_VTAB FORMULA_1050_VTAB "FORMULA_1050_VTAB" TAB_VERB 2 0 "kein Reset" 1 "Reset aktiv" /end COMPU_VTAB
/begin COMPU_METHOD FORMULA_1051 "FORMULA_1051" RAT_FUNC "%4.1" "%" COEFFS 0 255 0 0 0 100 /end COMPU_METHOD
/begin COMPU_METHOD FORMULA_1052 "FORMULA_1052" RAT_FUNC "%6.1" "%/bar" COEFFS 0 20.97152 0 0 0 1 /end COMPU_METHOD
/begin COMPU_METHOD FORMULA_1053 "FORMULA_1053" RAT_FUNC "%6.1" "%/(bar*s)" COEFFS 0 6.7109 0 0 0 1 /end COMPU_METHOD
/* ------------------ Abschnitt erzeugt aus tgetr.dat ------------------ */
/begin COMPU_METHOD FORMULA_1159 "FORMULA_1159" RAT_FUNC "%8.3" "�C" COEFFS 0 40 10926 0 0 1 /end COMPU_METHOD
/begin COMPU_METHOD FORMULA_1161 "FORMULA_1161" RAT_FUNC "%8.3" "�C" COEFFS 0 40 0 0 0 1 /end COMPU_METHOD
/* ------------------ Abschnitt erzeugt aus ti.dat ------------------ */
/begin COMPU_METHOD FORMULA_1162 "FORMULA_1162" RAT_FUNC "%8.3" "mg/ms" COEFFS 0 1024 0 0 0 1 /end COMPU_METHOD
/begin COMPU_METHOD FORMULA_1163 "FORMULA_1163" RAT_FUNC "%7.2" "mg/ASP" COEFFS 0 32 0 0 0 1 /end COMPU_METHOD
/begin COMPU_METHOD FORMULA_1164 "FORMULA_1164" RAT_FUNC "%7.2" "m/s" COEFFS 0 10 0 0 0 1 /end COMPU_METHOD
/begin COMPU_METHOD FORMULA_1165 "FORMULA_1165" RAT_FUNC "%8.3" "m2/s2" COEFFS 0 40 0 0 0 1 /end COMPU_METHOD
/begin COMPU_METHOD FORMULA_1167 "FORMULA_1167" RAT_FUNC "%5.0" "Segmente" COEFFS 0 1 0 0 0 1 /end COMPU_METHOD
/begin COMPU_METHOD FORMULA_1172 "FORMULA_1172" TAB_VERB "%7.2" "-" COMPU_TAB_REF FORMULA_1172_VTAB /end COMPU_METHOD
/begin COMPU_VTAB FORMULA_1172_VTAB "FORMULA_1172_VTAB" TAB_VERB 2 0 "Einfluss" 1 "kein Einfluss" /end COMPU_VTAB
/begin COMPU_METHOD FORMULA_1173 "FORMULA_1173" TAB_VERB "%5.2" "-" COMPU_TAB_REF FORMULA_1173_VTAB /end COMPU_METHOD
/begin COMPU_VTAB FORMULA_1173_VTAB "FORMULA_1173_VTAB" TAB_VERB 2 0 "kein TE-Einfluss" 1 "mit TE-Einfluss" /end COMPU_VTAB
/begin COMPU_METHOD FORMULA_1174 "FORMULA_1174" TAB_VERB "%5.2" "-" COMPU_TAB_REF FORMULA_1174_VTAB /end COMPU_METHOD
/begin COMPU_VTAB FORMULA_1174_VTAB "FORMULA_1174_VTAB" TAB_VERB 2 0 "kein OELV-Einfluss" 1 "mit OELV-Einfluss" /end COMPU_VTAB
/begin COMPU_METHOD FORMULA_1175 "FORMULA_1175" TAB_VERB "%5.2" "-" COMPU_TAB_REF FORMULA_1175_VTAB /end COMPU_METHOD
/begin COMPU_VTAB FORMULA_1175_VTAB "FORMULA_1175_VTAB" TAB_VERB 2 0 "kein LWV-Einfluss" 1 "mit LWV-Einfluss" /end COMPU_VTAB
/begin COMPU_METHOD FORMULA_1176 "FORMULA_1176" TAB_VERB "%5.2" "-" COMPU_TAB_REF FORMULA_1176_VTAB /end COMPU_METHOD
/begin COMPU_VTAB FORMULA_1176_VTAB "FORMULA_1176_VTAB" TAB_VERB 2 0 "mks_start" 1 "mks_grund" /end COMPU_VTAB
/begin COMPU_METHOD FORMULA_1177 "FORMULA_1177" TAB_VERB "%5.2" "-" COMPU_TAB_REF FORMULA_1177_VTAB /end COMPU_METHOD
/begin COMPU_VTAB FORMULA_1177_VTAB "FORMULA_1177_VTAB" TAB_VERB 2 0 "kein Einfluss" 1 "mit START-Einfluss" /end COMPU_VTAB
/begin COMPU_METHOD FORMULA_1178 "FORMULA_1178" TAB_VERB "%5.2" "-" COMPU_TAB_REF FORMULA_1178_VTAB /end COMPU_METHOD
/begin COMPU_VTAB FORMULA_1178_VTAB "FORMULA_1178_VTAB" TAB_VERB 2 0 "ohne AQ-Einfluss" 1 "mit AQ-Einfluss" /end COMPU_VTAB
/begin COMPU_METHOD FORMULA_1179 "FORMULA_1179" RAT_FUNC "%7.2" "mm2" COEFFS 0 10 0 0 0 1 /end COMPU_METHOD
/begin COMPU_METHOD FORMULA_1180 "FORMULA_1180" RAT_FUNC "%7.2" "mm" COEFFS 0 10 0 0 0 1 /end COMPU_METHOD
/begin COMPU_METHOD FORMULA_1181 "FORMULA_1181" RAT_FUNC "%7.2" "kg/dm3" COEFFS 0 100 0 0 0 1 /end COMPU_METHOD
/begin COMPU_METHOD FORMULA_1182 "FORMULA_1182" RAT_FUNC "%9.4" "m" COEFFS 0 16384 0 0 0 1 /end COMPU_METHOD
/begin COMPU_METHOD FORMULA_1183 "FORMULA_1183" TAB_VERB "%5.2" "-" COMPU_TAB_REF FORMULA_1183_VTAB /end COMPU_METHOD
/begin COMPU_VTAB FORMULA_1183_VTAB "FORMULA_1183_VTAB" TAB_VERB 2 0 "lam_ist" 1 "lam_ist_seg" /end COMPU_VTAB
/begin COMPU_METHOD FORMULA_1184 "FORMULA_1184" RAT_FUNC "%8.3" "ms" COEFFS 0 1000 0 0 0 32 /end COMPU_METHOD
/begin COMPU_METHOD FORMULA_1185 "FORMULA_1185" TAB_VERB "%5.2" "-" COMPU_TAB_REF FORMULA_1185_VTAB /end COMPU_METHOD
/begin COMPU_VTAB FORMULA_1185_VTAB "FORMULA_1185_VTAB" TAB_VERB 2 0 "keine Adaption" 1 "Adaption" /end COMPU_VTAB
/begin COMPU_METHOD FORMULA_1186 "FORMULA_1186" TAB_VERB "%5.2" "-" COMPU_TAB_REF FORMULA_1186_VTAB /end COMPU_METHOD
/begin COMPU_VTAB FORMULA_1186_VTAB "FORMULA_1186_VTAB" TAB_VERB 2 0 "-" 1 "RESET" /end COMPU_VTAB
/begin COMPU_METHOD FORMULA_1187 "FORMULA_1187" RAT_FUNC "%5.0" "-" COEFFS 0 -1 1 0 0 -1 /end COMPU_METHOD
/begin COMPU_METHOD FORMULA_1188 "FORMULA_1188" RAT_FUNC "%5.0" "-" COEFFS 0 10 0 0 0 1 /end COMPU_METHOD
/begin COMPU_METHOD FORMULA_1230 "FORMULA_1230" TAB_VERB "%5.2" "-" COMPU_TAB_REF FORMULA_1230_VTAB /end COMPU_METHOD
/begin COMPU_VTAB FORMULA_1230_VTAB "FORMULA_1230_VTAB" TAB_VERB 2 0 "Inaktiv" 1 "Aktiv" DEFAULT_VALUE "undef" /end COMPU_VTAB
/begin CHARACTERISTIC K_ED_WUC_TMOT_MIN "Min. Temperatur fuer Warmupcycle | EN: Minimum temperature for an OBD warm-up cycle" VALUE 0x71CB2 TKW_VV_VV_SW 100.0 FORMULA_0023 -50.0000 170.0000 FORMAT "%4.1" /end CHARACTERISTIC
/begin CHARACTERISTIC K_ED_WUC_DELTA_TMOT "Min. Temperaturerhoehung fuer Warmupcycle | EN: Minimum temperature rise for an OBD warm-up cycle" VALUE 0x71CB4 TKW_VV_VV_SW 100.0 FORMULA_0076 -1000.0000 1000.0000 FORMAT "%4.1" /end CHARACTERISTIC
/* ------------------ Abschnitt erzeugt aus oztemp.dat ------------------ */ /* ------------------ Abschnitt erzeugt aus dgen.dat ------------------ */
/begin CHARACTERISTIC K_MSKGENDFP "Bitmaske Generator Fehler-> DFP" VALUE 0x704AD TKW_VV_VV_UB 100.0 FORMULA_0003 0.0 255.0000 /end CHARACTERISTIC
/* ------------------ Abschnitt erzeugt aus imdgen_1pr.dat ------------------ */ /* ------------------ Abschnitt erzeugt aus ldstgen.dat ------------------ */
/begin CHARACTERISTIC K_TNNSTART "Zeittriggerschwelle nach Motorstart" VALUE 0x74CEA TKW_VV_VV_UW 100.0 FORMULA_0021 0.0 655.3500 FORMAT "%5.2" /end CHARACTERISTIC
/begin CHARACTERISTIC K_APPUPLLDST "Applikationswert St_ldstgen f�r Nachlauf | EN: Calibration value St_ldstgen for run-on" VALUE 0x74CEC TKW_VV_VV_UB 100.0 FORMULA_0003 0.0 255.0000 /end CHARACTERISTIC
/begin CHARACTERISTIC K_DFS_MAX "DF-Auslastung Maximalschwelle | EN: DF-Auslastung Maximalschwelle" VALUE 0x74CEE TKW_VV_VV_UB 100.0 FORMULA_0471 0.0 99.6093 /end CHARACTERISTIC
/begin CHARACTERISTIC K_DFS_MIN "DF-Auslastung Minimalschwelle | EN: DF-Auslastung Minimalschwelle" VALUE 0x74CEF TKW_VV_VV_UB 100.0 FORMULA_0471 0.0 99.6093 /end CHARACTERISTIC
/begin CHARACTERISTIC K_DFS_MITT "DF-Auslastung Mittelschwelle | EN: DF-Auslastung Mittelschwelle" VALUE 0x74CF0 TKW_VV_VV_UB 100.0 FORMULA_0471 0.0 99.6093 /end CHARACTERISTIC
/begin CHARACTERISTIC K_GENLDDFMAX "Schwell Anzeige maximaler Auslastungsgrad Generator | EN: Schwell Anzeige maximaler Auslastungsgrad Generator" VALUE 0x74CF1 TKW_VV_VV_UB 100.0 FORMULA_0471 0.0 99.6093 /end CHARACTERISTIC
/begin CHARACTERISTIC KL_GENLDST "Auslastungsgrad Generator | EN: Generator utilisation [V912: differs from V452 160E]" CURVE 0x74CF4 TKL_SW_VV_UB 100.0 FORMULA_0471 0.0 99.6093 /begin AXIS_DESCR STD_AXIS FORMULA_0426 6 -3276.8000 3276.7000 /end AXIS_DESCR /end CHARACTERISTIC
/begin CHARACTERISTIC K_ED_VAN_VENT_E1.P_CODE_SH_TO_UB "P-Code fuer die Art SH_TO_UB | EN: Fault code VAN_VENT_E1 - OBD P-code reported for short to battery voltage" VALUE 0x70E58 TKW_VV_VV_UW 100.0 FORMULA_0010 0.0 65535.0000 /end CHARACTERISTIC
/begin CHARACTERISTIC K_ED_VAN_VENT_A1.P_CODE_SH_TO_UB "P-Code fuer die Art SH_TO_UB | EN: Fault code VAN_VENT_A1 - OBD P-code reported for short to battery voltage" VALUE 0x70E72 TKW_VV_VV_UW 100.0 FORMULA_0010 0.0 65535.0000 /end CHARACTERISTIC
/begin CHARACTERISTIC K_ED_VAN_VENT_E2.P_CODE_SH_TO_UB "P-Code fuer die Art SH_TO_UB | EN: Fault code VAN_VENT_E2 - OBD P-code reported for short to battery voltage" VALUE 0x70E8C TKW_VV_VV_UW 100.0 FORMULA_0010 0.0 65535.0000 /end CHARACTERISTIC
/begin CHARACTERISTIC K_ED_VAN_VENT_A2.P_CODE_SH_TO_UB "P-Code fuer die Art SH_TO_UB | EN: Fault code VAN_VENT_A2 - OBD P-code reported for short to battery voltage" VALUE 0x70EA6 TKW_VV_VV_UW 100.0 FORMULA_0010 0.0 65535.0000 /end CHARACTERISTIC
/begin CHARACTERISTIC K_ED_VAN_VENT_E1.P_CODE_SH_TO_GND "P-Code fuer die Art SH_TO_GND | EN: Fault code VAN_VENT_E1 - OBD P-code reported for short to ground" VALUE 0x70E5A TKW_VV_VV_UW 100.0 FORMULA_0010 0.0 65535.0000 /end CHARACTERISTIC
/begin CHARACTERISTIC K_ED_VAN_VENT_A1.P_CODE_SH_TO_GND "P-Code fuer die Art SH_TO_GND | EN: Fault code VAN_VENT_A1 - OBD P-code reported for short to ground" VALUE 0x70E74 TKW_VV_VV_UW 100.0 FORMULA_0010 0.0 65535.0000 /end CHARACTERISTIC
/begin CHARACTERISTIC K_ED_VAN_VENT_E2.P_CODE_SH_TO_GND "P-Code fuer die Art SH_TO_GND | EN: Fault code VAN_VENT_E2 - OBD P-code reported for short to ground" VALUE 0x70E8E TKW_VV_VV_UW 100.0 FORMULA_0010 0.0 65535.0000 /end CHARACTERISTIC
/begin CHARACTERISTIC K_ED_VAN_VENT_A2.P_CODE_SH_TO_GND "P-Code fuer die Art SH_TO_GND | EN: Fault code VAN_VENT_A2 - OBD P-code reported for short to ground" VALUE 0x70EA8 TKW_VV_VV_UW 100.0 FORMULA_0010 0.0 65535.0000 /end CHARACTERISTIC
/begin CHARACTERISTIC K_ED_VAN_VENT_E1.P_CODE_OPENLOAD "P-Code fuer die Art OPENLOAD | EN: Fault code VAN_VENT_E1 - OBD P-code reported for open circuit" VALUE 0x70E5C TKW_VV_VV_UW 100.0 FORMULA_0010 0.0 65535.0000 /end CHARACTERISTIC
/begin CHARACTERISTIC K_ED_VAN_VENT_A1.P_CODE_OPENLOAD "P-Code fuer die Art OPENLOAD | EN: Fault code VAN_VENT_A1 - OBD P-code reported for open circuit" VALUE 0x70E76 TKW_VV_VV_UW 100.0 FORMULA_0010 0.0 65535.0000 /end CHARACTERISTIC
/begin CHARACTERISTIC K_ED_VAN_VENT_E2.P_CODE_OPENLOAD "P-Code fuer die Art OPENLOAD | EN: Fault code VAN_VENT_E2 - OBD P-code reported for open circuit" VALUE 0x70E90 TKW_VV_VV_UW 100.0 FORMULA_0010 0.0 65535.0000 /end CHARACTERISTIC
/begin CHARACTERISTIC K_ED_VAN_VENT_A2.P_CODE_OPENLOAD "P-Code fuer die Art OPENLOAD | EN: Fault code VAN_VENT_A2 - OBD P-code reported for open circuit" VALUE 0x70EAA TKW_VV_VV_UW 100.0 FORMULA_0010 0.0 65535.0000 /end CHARACTERISTIC
/begin CHARACTERISTIC K_ED_VAN_VENT_E1.P_CODE_UNPLAUSIBEL "P-Code fuer die Art UNPLAUSIBEL | EN: Fault code VAN_VENT_E1 - OBD P-code reported for implausible signal" VALUE 0x70E5E TKW_VV_VV_UW 100.0 FORMULA_0010 0.0 65535.0000 /end CHARACTERISTIC
/begin CHARACTERISTIC K_ED_VAN_VENT_A1.P_CODE_UNPLAUSIBEL "P-Code fuer die Art UNPLAUSIBEL | EN: Fault code VAN_VENT_A1 - OBD P-code reported for implausible signal" VALUE 0x70E78 TKW_VV_VV_UW 100.0 FORMULA_0010 0.0 65535.0000 /end CHARACTERISTIC
/begin CHARACTERISTIC K_ED_VAN_VENT_E2.P_CODE_UNPLAUSIBEL "P-Code fuer die Art UNPLAUSIBEL | EN: Fault code VAN_VENT_E2 - OBD P-code reported for implausible signal" VALUE 0x70E92 TKW_VV_VV_UW 100.0 FORMULA_0010 0.0 65535.0000 /end CHARACTERISTIC
/begin CHARACTERISTIC K_ED_VAN_VENT_A2.P_CODE_UNPLAUSIBEL "P-Code fuer die Art UNPLAUSIBEL | EN: Fault code VAN_VENT_A2 - OBD P-code reported for implausible signal" VALUE 0x70EAC TKW_VV_VV_UW 100.0 FORMULA_0010 0.0 65535.0000 /end CHARACTERISTIC
/begin CHARACTERISTIC K_ED_VAN_VENT_E1.FEHLERSCHWELLE "Filterschwelle fuer Fehlereintrag | EN: Fault code VAN_VENT_E1 - debounce filter threshold for setting the fault" VALUE 0x70E60 TKW_VV_VV_UB 100.0 FORMULA_0003 0.0 255.0000 /end CHARACTERISTIC
/begin CHARACTERISTIC K_ED_VAN_VENT_E2.FEHLERSCHWELLE "Filterschwelle fuer Fehlereintrag | EN: Fault code VAN_VENT_E2 - debounce filter threshold for setting the fault" VALUE 0x70E94 TKW_VV_VV_UB 100.0 FORMULA_0003 0.0 255.0000 /end CHARACTERISTIC
/begin CHARACTERISTIC K_ED_VAN_VENT_A2.FEHLERSCHWELLE "Filterschwelle fuer Fehlereintrag | EN: Fault code VAN_VENT_A2 - debounce filter threshold for setting the fault" VALUE 0x70EAE TKW_VV_VV_UB 100.0 FORMULA_0003 0.0 255.0000 /end CHARACTERISTIC
/begin CHARACTERISTIC K_ED_VAN_VENT_E1.OK_SCHWELLE "Filterschwelle fuer Fehleraustrag | EN: Fault code VAN_VENT_E1 - debounce filter threshold for clearing (healing) the fault" VALUE 0x70E61 TKW_VV_VV_UB 100.0 FORMULA_0003 0.0 255.0000 /end CHARACTERISTIC
/begin CHARACTERISTIC K_ED_VAN_VENT_A1.OK_SCHWELLE "Filterschwelle fuer Fehleraustrag | EN: Fault code VAN_VENT_A1 - debounce filter threshold for clearing (healing) the fault" VALUE 0x70E7B TKW_VV_VV_UB 100.0 FORMULA_0003 0.0 255.0000 /end CHARACTERISTIC
/begin CHARACTERISTIC K_ED_VAN_VENT_E2.OK_SCHWELLE "Filterschwelle fuer Fehleraustrag | EN: Fault code VAN_VENT_E2 - debounce filter threshold for clearing (healing) the fault" VALUE 0x70E95 TKW_VV_VV_UB 100.0 FORMULA_0003 0.0 255.0000 /end CHARACTERISTIC
/begin CHARACTERISTIC K_ED_VAN_VENT_A2.OK_SCHWELLE "Filterschwelle fuer Fehleraustrag | EN: Fault code VAN_VENT_A2 - debounce filter threshold for clearing (healing) the fault" VALUE 0x70EAF TKW_VV_VV_UB 100.0 FORMULA_0003 0.0 255.0000 /end CHARACTERISTIC
/begin CHARACTERISTIC K_ED_VAN_VENT_E1.INC_VOR_EINTRAG "Filtererhoehung vorm Fehlerspeichereintrag | EN: Fault code VAN_VENT_E1 - debounce filter increment before fault-memory entry" VALUE 0x70E62 TKW_VV_VV_UB 100.0 FORMULA_0003 0.0 255.0000 /end CHARACTERISTIC
/begin CHARACTERISTIC K_ED_VAN_VENT_E2.INC_VOR_EINTRAG "Filtererhoehung vorm Fehlerspeichereintrag | EN: Fault code VAN_VENT_E2 - debounce filter increment before fault-memory entry" VALUE 0x70E96 TKW_VV_VV_UB 100.0 FORMULA_0003 0.0 255.0000 /end CHARACTERISTIC
/begin CHARACTERISTIC K_ED_VAN_VENT_A2.INC_VOR_EINTRAG "Filtererhoehung vorm Fehlerspeichereintrag | EN: Fault code VAN_VENT_A2 - debounce filter increment before fault-memory entry" VALUE 0x70EB0 TKW_VV_VV_UB 100.0 FORMULA_0003 0.0 255.0000 /end CHARACTERISTIC
/begin CHARACTERISTIC K_ED_VAN_VENT_E1.DEC_VOR_EINTRAG "Filterverringerung vorm Fehlerspeichereintrag | EN: Fault code VAN_VENT_E1 - debounce filter decrement before fault-memory entry" VALUE 0x70E63 TKW_VV_VV_UB 100.0 FORMULA_0003 0.0 255.0000 /end CHARACTERISTIC
/begin CHARACTERISTIC K_ED_VAN_VENT_E2.DEC_VOR_EINTRAG "Filterverringerung vorm Fehlerspeichereintrag | EN: Fault code VAN_VENT_E2 - debounce filter decrement before fault-memory entry" VALUE 0x70E97 TKW_VV_VV_UB 100.0 FORMULA_0003 0.0 255.0000 /end CHARACTERISTIC
/begin CHARACTERISTIC K_ED_VAN_VENT_A2.DEC_VOR_EINTRAG "Filterverringerung vorm Fehlerspeichereintrag | EN: Fault code VAN_VENT_A2 - debounce filter decrement before fault-memory entry" VALUE 0x70EB1 TKW_VV_VV_UB 100.0 FORMULA_0003 0.0 255.0000 /end CHARACTERISTIC
/begin CHARACTERISTIC K_ED_VAN_VENT_E1.INC_NACH_EINTRAG "Filtererhoehung nach Fehlerspeichereintrag | EN: Fault code VAN_VENT_E1 - debounce filter increment after fault-memory entry" VALUE 0x70E64 TKW_VV_VV_UB 100.0 FORMULA_0003 0.0 255.0000 /end CHARACTERISTIC
/begin CHARACTERISTIC K_ED_VAN_VENT_E2.INC_NACH_EINTRAG "Filtererhoehung nach Fehlerspeichereintrag | EN: Fault code VAN_VENT_E2 - debounce filter increment after fault-memory entry" VALUE 0x70E98 TKW_VV_VV_UB 100.0 FORMULA_0003 0.0 255.0000 /end CHARACTERISTIC
/begin CHARACTERISTIC K_ED_VAN_VENT_A2.INC_NACH_EINTRAG "Filtererhoehung nach Fehlerspeichereintrag | EN: Fault code VAN_VENT_A2 - debounce filter increment after fault-memory entry" VALUE 0x70EB2 TKW_VV_VV_UB 100.0 FORMULA_0003 0.0 255.0000 /end CHARACTERISTIC
/begin CHARACTERISTIC K_ED_VAN_VENT_E1.DEC_NACH_EINTRAG "Filterverringerung nach Fehlerspeichereintrag | EN: Fault code VAN_VENT_E1 - debounce filter decrement after fault-memory entry" VALUE 0x70E65 TKW_VV_VV_UB 100.0 FORMULA_0003 0.0 255.0000 /end CHARACTERISTIC
/begin CHARACTERISTIC K_ED_VAN_VENT_E2.DEC_NACH_EINTRAG "Filterverringerung nach Fehlerspeichereintrag | EN: Fault code VAN_VENT_E2 - debounce filter decrement after fault-memory entry" VALUE 0x70E99 TKW_VV_VV_UB 100.0 FORMULA_0003 0.0 255.0000 /end CHARACTERISTIC
/begin CHARACTERISTIC K_ED_VAN_VENT_A2.DEC_NACH_EINTRAG "Filterverringerung nach Fehlerspeichereintrag | EN: Fault code VAN_VENT_A2 - debounce filter decrement after fault-memory entry" VALUE 0x70EB3 TKW_VV_VV_UB 100.0 FORMULA_0003 0.0 255.0000 /end CHARACTERISTIC
/begin CHARACTERISTIC K_ED_VAN_VENT_E1.KLASSENINDEX "Auswahl der Fehlerklasse | EN: Fault code VAN_VENT_E1 - fault class selection (lamp / warning behaviour)" VALUE 0x70E66 TKW_VV_VV_UB 100.0 FORMULA_0003 0.0 8.0000 /end CHARACTERISTIC
/begin CHARACTERISTIC K_ED_VAN_VENT_A1.KLASSENINDEX "Auswahl der Fehlerklasse | EN: Fault code VAN_VENT_A1 - fault class selection (lamp / warning behaviour)" VALUE 0x70E80 TKW_VV_VV_UB 100.0 FORMULA_0003 0.0 8.0000 /end CHARACTERISTIC
/begin CHARACTERISTIC K_ED_VAN_VENT_E2.KLASSENINDEX "Auswahl der Fehlerklasse | EN: Fault code VAN_VENT_E2 - fault class selection (lamp / warning behaviour)" VALUE 0x70E9A TKW_VV_VV_UB 100.0 FORMULA_0003 0.0 8.0000 /end CHARACTERISTIC
/begin CHARACTERISTIC K_ED_VAN_VENT_A2.KLASSENINDEX "Auswahl der Fehlerklasse | EN: Fault code VAN_VENT_A2 - fault class selection (lamp / warning behaviour)" VALUE 0x70EB4 TKW_VV_VV_UB 100.0 FORMULA_0003 0.0 8.0000 /end CHARACTERISTIC
/* ------------------ Abschnitt erzeugt aus elu.dat ------------------ */
/begin CHARACTERISTIC K_ELU_TCR2_TICS "Periodendauer | EN: Periodendauer" VALUE 0x71D04 TKW_VV_VV_UW 100.0 FORMULA_0672 9.6000 79.8000 FORMAT "%4.1" /end CHARACTERISTIC
/begin CHARACTERISTIC K_ELU_TCR2_TICS_NL "Periodendauer bei Nachlaufanforderung | EN: Periodendauer bei Nachlaufanforderung" VALUE 0x71D06 TKW_VV_VV_UW 100.0 FORMULA_0672 91.2000 111.0000 FORMAT "%4.1" /end CHARACTERISTIC
/begin CHARACTERISTIC K_ELU_TYP_CFG "Schalter fuer ELU-Typ" VALUE 0x71D08 TKW_VV_VV_UB 100.0 FORMULA_0675 0.0 255.0 /end CHARACTERISTIC
/begin CHARACTERISTIC K_ELU_HYS_SCHLEPP "Hysterese Schleppzeiger | EN: Hysterese Schleppzeiger" VALUE 0x71D09 TKW_VV_VV_UB 100.0 FORMULA_0032 0.0 100.0000 /end CHARACTERISTIC
/begin CHARACTERISTIC K_ELU_TKA_TMOT_DIFF "Differenz zu tmot bei defektem Kuehleraustritt" VALUE 0x71D0A TKW_VV_VV_SW 100.0 FORMULA_0076 -1000.0000 1000.0000 FORMAT "%4.1" /end CHARACTERISTIC
/begin CHARACTERISTIC K_ELU_PWM_OFFS "Offset fuer berechnetes Tastverhaeltnis bei Luefterfunktion | EN: Offset fuer berechnetes Tastverhaeltnis bei Luefterfunktion" VALUE 0x71D0C TKW_VV_VV_SB 100.0 FORMULA_0032 -30.0000 30.0000 /end CHARACTERISTIC
/begin CHARACTERISTIC K_ELU_PWM_MIN_ML "Minimal ausgegebenes Tastverhaeltnis bei Luefterfunktion | EN: Minimal ausgegebenes Tastverhaeltnis bei Luefterfunktion" VALUE 0x71D0D TKW_VV_VV_UB 100.0 FORMULA_0032 0.0 49.0000 /end CHARACTERISTIC
/begin CHARACTERISTIC K_ELU_PWM_MAX_ML "Maximal ausgegebenes Tastverhaeltnis | EN: Maximal ausgegebenes Tastverhaeltnis" VALUE 0x71D0E TKW_VV_VV_UB 100.0 FORMULA_0032 50.0000 100.0000 /end CHARACTERISTIC
/begin CHARACTERISTIC K_ELU_PWM_AUS "Tastverhaeltnis bei ausgeschaltenem Luefter | EN: Tastverhaeltnis bei ausgeschaltenem Luefter" VALUE 0x71D0F TKW_VV_VV_UB 100.0 FORMULA_0032 5.0000 9.0000 /end CHARACTERISTIC
/begin CHARACTERISTIC K_ELU_PWM_MIN_MS "minimal ausgegebenes Tastverhaeltnis bei Nachlaufanforderung | EN: minimal ausgegebenes Tastverhaeltnis bei Nachlaufanforderung" VALUE 0x71D10 TKW_VV_VV_UB 100.0 FORMULA_0032 0.0 49.0000 /end CHARACTERISTIC
/begin CHARACTERISTIC K_ELU_PWM_MAX_MS "Maximal ausgegebenes Tastverhaeltnis bei Nachlaufanforderung | EN: Maximal ausgegebenes Tastverhaeltnis bei Nachlaufanforderung" VALUE 0x71D11 TKW_VV_VV_UB 100.0 FORMULA_0032 50.0000 100.0000 /end CHARACTERISTIC
/begin CHARACTERISTIC K_ELU_PWM_GRAD_ZUL "max. zulaessiger Gradient des Tastverhaeltnisses | EN: max. zulaessiger Gradient des Tastverhaeltnisses" VALUE 0x71D12 TKW_VV_VV_UW 100.0 FORMULA_0676 0.0 5.0000 FORMAT "%5.2" /end CHARACTERISTIC
/begin CHARACTERISTIC K_ELU_T_ML_MIN "Verweilzeit nach Startende | EN: Verweilzeit nach Startende" VALUE 0x71D14 TKW_VV_VV_UW 100.0 FORMULA_0538 0.0 655350.0000 /end CHARACTERISTIC
/begin CHARACTERISTIC K_ELU_T_MS_MAX "zeitliche Begr. des PWM-Signals der NL-Anforderung | EN: zeitliche Begr. des PWM -Signals der NL-Anforderung" VALUE 0x71D16 TKW_VV_VV_UW 100.0 FORMULA_0062 0.0 15.0000 /end CHARACTERISTIC
/begin CHARACTERISTIC K_ELU_TAN_DREH_ERSATZ "Ersatzluefterdrehzahl bei TAN-Fehler | EN: Ersatzluefterdrehzahl bei TAN-Fehler" VALUE 0x71D18 TKW_VV_VV_UB 100.0 FORMULA_0032 0.0 100.0000 /end CHARACTERISTIC
/begin CHARACTERISTIC K_ELU_IDENT_CYCLE_TIME_BEGR "Begrenzung der ELU-Identifikationszykluszeit" VALUE 0x71D1A TKW_VV_VV_UW 100.0 FORMULA_0539 0.0 30000.0000 /end CHARACTERISTIC
/begin CHARACTERISTIC K_ELU_IDENT_CYCLE_CNT_BEGR "Begrenzung der durchlaufenen ELU-Identifikationszyklen" VALUE 0x71D1C TKW_VV_VV_UB 100.0 FORMULA_0003 0.0 255.0000 /end CHARACTERISTIC
/begin CHARACTERISTIC K_ELU_PWM_IDENT "Tastverhaeltnis fuer Schnittstellendiagnose" VALUE 0x71D1D TKW_VV_VV_UB 100.0 FORMULA_0032 96.0000 99.0000 /end CHARACTERISTIC
/begin CHARACTERISTIC K_ELU_IDENT_RESP_600W_MIN "untere Grenze Antwortzeit 600W-ELU" VALUE 0x71D1E TKW_VV_VV_UW 100.0 FORMULA_0539 1200.0000 2300.0000 /end CHARACTERISTIC
/begin CHARACTERISTIC K_ELU_IDENT_RESP_600W_MAX "obere Grenze Antwortzeit 600W-ELU" VALUE 0x71D20 TKW_VV_VV_UW 100.0 FORMULA_0539 1200.0000 2300.0000 /end CHARACTERISTIC
/begin CHARACTERISTIC K_ELU_IDENT_RESP_850W_MIN "untere Grenze Antwortzeit 850W-ELU" VALUE 0x71D22 TKW_VV_VV_UW 100.0 FORMULA_0539 2200.0000 3300.0000 /end CHARACTERISTIC
/begin CHARACTERISTIC K_ELU_IDENT_RESP_850W_MAX "obere Grenze Antwortzeit 850W-ELU" VALUE 0x71D24 TKW_VV_VV_UW 100.0 FORMULA_0539 2200.0000 3300.0000 /end CHARACTERISTIC
/begin CHARACTERISTIC K_ELU_ED_SH_TO_UB_DELAY "Delay fuer Entprellung von SH_TO_UB | EN: Delay for debouncing short to battery [ms]" VALUE 0x71D26 TKW_VV_VV_UW 100.0 FORMULA_0539 0.0 3000.0000 /end CHARACTERISTIC
/begin CHARACTERISTIC K_ELU_ED_SH_TO_UB_OFF_TIME "Abschaltzeit der ATIC39-Endstufe bei SH_TO_UB | EN: Switch-off time of ATIC39 output stage on short to battery [ms]" VALUE 0x71D28 TKW_VV_VV_UW 100.0 FORMULA_0539 5000.0000 20000.0000 /end CHARACTERISTIC
/begin CHARACTERISTIC K_ELU_ED_BLOCKIERT_MAX "max. Zeitdauer fuer die Erkennung der ELU-Fehlermeldung | EN: Maximum time for detecting the fan fault message [ms]" VALUE 0x71D2A TKW_VV_VV_UW 100.0 FORMULA_0539 4700.0000 7300.0000 /end CHARACTERISTIC
/begin CHARACTERISTIC K_ELU_ED_BLOCKIERT_MIN "min. Zeitdauer fuer die Erkennung der ELU-Fehlermeldung | EN: Minimum time for detecting the fan fault message [ms]" VALUE 0x71D2C TKW_VV_VV_UW 100.0 FORMULA_0539 4700.0000 7300.0000 /end CHARACTERISTIC
/begin CHARACTERISTIC K_ELU_ED_BLOCKIER_ZYKLUS_TIME "Zeitdauer bis zur naechsten erwarteten ELU-Fehlermeldung | EN: Time until the next expected fan fault message [ms]" VALUE 0x71D2E TKW_VV_VV_UW 100.0 FORMULA_0539 25000.0000 35000.0000 /end CHARACTERISTIC
/begin CHARACTERISTIC K_ELU_ED_BLOCKIERT_CNT "Counter zur zusaetzlichen Entprellung von ELU_BLOCKIERT | EN: Counter for additional debouncing of fan blocked" VALUE 0x71D30 TKW_VV_VV_UB 100.0 FORMULA_0003 0.0 255.0000 /end CHARACTERISTIC
/begin CHARACTERISTIC K_ELU_ED_SH_TO_GND_CNT "Counter zur zusaetzlichen Entprellung von SH_TO_GND | EN: Counter for additional debouncing of short to ground" VALUE 0x71D31 TKW_VV_VV_UB 100.0 FORMULA_0003 0.0 255.0000 /end CHARACTERISTIC
/begin CHARACTERISTIC K_ELU_ED_OPENLOAD_CNT "Counter zur zusaetzlichen Entprellung von OPENLOAD | EN: Counter for additional debouncing of open load" VALUE 0x71D32 TKW_VV_VV_UB 100.0 FORMULA_0003 0.0 255.0000 /end CHARACTERISTIC
/begin CHARACTERISTIC KL_ELU_TKA "Kennlinie ELU-Drehzahl von TKA" CURVE 0x71D34 TKL_SW_VV_UB 100.0 FORMULA_0032 0.0 100.0000 /begin AXIS_DESCR STD_AXIS FORMULA_0023 6 -50.0000 170.0000 FORMAT "%4.1" /end AXIS_DESCR /end CHARACTERISTIC
/begin CHARACTERISTIC KL_ELU_TKAT "Kennlinie ELU-Drehzahl von TKAT | EN: Curve: electric-fan speed from catalyst temperature" CURVE 0x71D48 TKL_SW_VV_UB 100.0 FORMULA_0032 0.0 100.0000
 /begin AXIS_DESCR STD_AXIS elu_tabg_nkat FORMULA_0023 6 400.0000 1100.0000 FORMAT "%4.1" /end AXIS_DESCR
/end CHARACTERISTIC
/begin CHARACTERISTIC KL_ELU_KKOS "Kennlinie ELU-Drehzahl bei CAN-KKOS-Anforderung | EN: Curve: electric-fan speed on CAN A/C request" CURVE 0x71D5C TKL_UB_VV_UB 100.0 FORMULA_0032 0.0 100.0000 /begin AXIS_DESCR STD_AXIS FORMULA_0003 16 0.0 15.0000 /end AXIS_DESCR /end CHARACTERISTIC
/begin CHARACTERISTIC KL_ELU_TAN "Kennlinie ELU-Drehzahl von TAN | EN: Curve: electric-fan speed from intake air temperature" CURVE 0x71D7E TKL_SW_VV_UB 100.0 FORMULA_0032 0.0 100.0000
 /begin AXIS_DESCR STD_AXIS elu_tan FORMULA_0023 6 -50.0000 170.0000 FORMAT "%4.1" /end AXIS_DESCR
/end CHARACTERISTIC
/begin CHARACTERISTIC KL_ELU_V_KORR "Kennlinie ELU_V" CURVE 0x71D92 TKL_SW_VV_UB 100.0 FORMULA_0677 0.0 1.0000 /begin AXIS_DESCR STD_AXIS FORMULA_0078 6 -80.0000 360.0000 FORMAT "%4.1" /end AXIS_DESCR /end CHARACTERISTIC
/begin CHARACTERISTIC KF_ELU_PWM_MS "Kennfeld E-Luefter-Nachlaufanforderung | EN: Map: electric-fan run-on request" MAP 0x71DA6 TKF_SW_SW_UB 100.0 FORMULA_0032 0.0 255.0000
 /begin AXIS_DESCR STD_AXIS elu_tabg_nkat FORMULA_0023 5 400.0000 1100.0000 FORMAT "%4.1" /end AXIS_DESCR
 /begin AXIS_DESCR STD_AXIS FORMULA_0023 6 -50.0000 170.0000 FORMAT "%4.1" /end AXIS_DESCR
/end CHARACTERISTIC
/* ------------------ Abschnitt erzeugt aus hfm.dat ------------------ */
/begin CHARACTERISTIC K_HFM_DIAG_ML_MAX "MAX ML fuer Diagnose " VALUE 0x7204A TKW_VV_VV_SW 100.0 FORMULA_0112 -50.0000 1400.0000 FORMAT "%4.1" /end CHARACTERISTIC
/begin CHARACTERISTIC K_HFM_DIAG_ML_MIN "MAX ML fuer Diagnose " VALUE 0x7204C TKW_VV_VV_SW 100.0 FORMULA_0112 -50.0000 1400.0000 FORMAT "%4.1" /end CHARACTERISTIC
/begin CHARACTERISTIC K_HFM_ERSATZ "Ersatzwert fuer HFM" VALUE 0x7204E TKW_VV_VV_SW 100.0 FORMULA_0112 -50.0000 1400.0000 FORMAT "%4.1" /end CHARACTERISTIC
/begin CHARACTERISTIC K_HFM_KL_CFG "Auswahl HFM KL" VALUE 0x72050 TKW_VV_VV_UB 100.0 FORMULA_0720 0.0 255.0 /end CHARACTERISTIC
/begin CHARACTERISTIC K_HFM_N_RF_KORR_CFG "HFM Popel KF Aktivierung" VALUE 0x72051 TKW_VV_VV_UB 100.0 FORMULA_0721 0.0 255.0 /end CHARACTERISTIC
/begin CHARACTERISTIC K_HFM_OBD_DYN_DELTA_RF "rf Differnez fuer Dynamikerkennung | EN: rf Differnez fuer Dynamikerkennung" VALUE 0x72056 TKW_VV_VV_SW 100.0 FORMULA_0007 0.0 2.0000 FORMAT "%6.3" /end CHARACTERISTIC
/begin CHARACTERISTIC K_HFM_OBD_DYN_RF_T "Sperrzeit fuer Ruecknahme rf-Dynamik" VALUE 0x72058 TKW_VV_VV_UW 100.0 FORMULA_0021 0.0 655.3500 FORMAT "%5.2" /end CHARACTERISTIC
/begin CHARACTERISTIC K_HFM_MVAC_CFG "Konfig fuer Einrechnung MVAC" VALUE 0x7205A TKW_VV_VV_UB 100.0 FORMULA_0722 0.0 255.0 /end CHARACTERISTIC
/begin CHARACTERISTIC KL_HFM_ANZ_SEG_N "Anzahl der Seg. fuer die MW" CURVE 0x7205C TKL_SW_VV_UW 100.0 FORMULA_0083 1.0000 6.0000 /begin AXIS_DESCR STD_AXIS FORMULA_0006 4 0.0 10000.0000 /end AXIS_DESCR FORMAT "%5.2" /end CHARACTERISTIC
/begin CHARACTERISTIC KL_RF_TAN_KORR "-" CURVE 0x7206E TKL_SW_VV_UW 100.0 FORMULA_0075 0.0 4.0000
 /begin AXIS_DESCR STD_AXIS temperatur FORMULA_0023 8 -50.0000 170.0000 FORMAT "%4.1" /end AXIS_DESCR
 FORMAT "%6.3" /end CHARACTERISTIC
/begin CHARACTERISTIC KL_RF_TANZYL_KORR "-" CURVE 0x72090 TKL_SW_VV_UW 100.0 FORMULA_0075 0.0 4.0000
 /begin AXIS_DESCR STD_AXIS temperatur FORMULA_0023 8 -50.0000 170.0000 FORMAT "%4.1" /end AXIS_DESCR
 FORMAT "%6.3" /end CHARACTERISTIC
/begin CHARACTERISTIC KL_RF_PUMG_KORR "Korrekturfaktor in Abh. vom Luftdruck" CURVE 0x720B2 TKL_SW_VV_UW 100.0 FORMULA_0075 0.0 4.0000 /begin AXIS_DESCR STD_AXIS FORMULA_0077 8 400.0000 1200.0000 FORMAT "%4.1" /end AXIS_DESCR FORMAT "%6.3" /end CHARACTERISTIC
/begin CHARACTERISTIC KL_HFM_KORR_ML_FZG "ML Korrektur im FZG" CURVE 0x720D4 TKL_SW_VV_UW 100.0 FORMULA_0075 0.0 4.0000
 /begin AXIS_DESCR STD_AXIS ml FORMULA_0112 8 -100.0000 1400.0000 FORMAT "%4.1" /end AXIS_DESCR
 FORMAT "%6.3" /end CHARACTERISTIC
/begin CHARACTERISTIC KL_HFM_KORR_ML_PST "ML Korrektur im PST" CURVE 0x720F6 TKL_SW_VV_UW 100.0 FORMULA_0075 0.0 4.0000
 /begin AXIS_DESCR STD_AXIS ml FORMULA_0112 8 -100.0000 1400.0000 FORMAT "%4.1" /end AXIS_DESCR
 FORMAT "%6.3" /end CHARACTERISTIC
/begin CHARACTERISTIC KL_HFM_FAK_S65_B1 "Faktor fuer Aufteileung des HFM am S65" CURVE 0x72118 TKL_SW_VV_UW 100.0 FORMULA_0075 0.0 4.0000 /begin AXIS_DESCR STD_AXIS FORMULA_0006 4 0.0 10000.0000 /end AXIS_DESCR FORMAT "%6.3" /end CHARACTERISTIC
/begin CHARACTERISTIC KL_HFM_FAK_S65_B2 "Faktor fuer Aufteileung des HFM am S65" CURVE 0x7212A TKL_SW_VV_UW 100.0 FORMULA_0075 0.0 4.0000 /begin AXIS_DESCR STD_AXIS FORMULA_0006 4 0.0 10000.0000 /end AXIS_DESCR FORMAT "%6.3" /end CHARACTERISTIC
/begin CHARACTERISTIC KF_HFM_KORR_ML_TAN "ml Korrektur ueber TAN und ml" MAP 0x7213C TKF_SW_SW_UW 100.0 FORMULA_0075 0.0 4.0000
 /begin AXIS_DESCR STD_AXIS ml FORMULA_0112 4 -100.0000 1400.0000 FORMAT "%4.1" /end AXIS_DESCR
 /begin AXIS_DESCR STD_AXIS temperatur FORMULA_0023 4 -50.0000 170.0000 FORMAT "%4.1" /end AXIS_DESCR
 FORMAT "%6.3" /end CHARACTERISTIC
/begin CHARACTERISTIC KF_HFM_KORR_N_RF "HFM Popel KF" MAP 0x7216E TKF_SW_SW_UW 100.0 FORMULA_0075 0.0 4.0000 /begin AXIS_DESCR STD_AXIS FORMULA_0006 6 0.0 10000.0000 /end AXIS_DESCR /begin AXIS_DESCR STD_AXIS FORMULA_0007 6 0.0 2.0000 FORMAT "%6.3" /end AXIS_DESCR FORMAT "%6.3" /end CHARACTERISTIC
/begin CHARACTERISTIC KF_HFM_TAU "Filterkonstanten fuer die HFM Erfassung" MAP 0x721D0 TKF_SW_SW_UB 100.0 FORMULA_0664 0.0101 2.5600 /begin AXIS_DESCR STD_AXIS FORMULA_0006 4 0.0 10000.0000 /end AXIS_DESCR /begin AXIS_DESCR STD_AXIS FORMULA_0020 6 -30000.0000 30000.0000 /end AXIS_DESCR /end CHARACTERISTIC
/* ------------------ Abschnitt erzeugt aus inj_tb.dat ------------------ */ /* ------------------ Abschnitt erzeugt aus kats.dat ------------------ */
/begin CHARACTERISTIC K_KATS_LAM_MIN "Lambda min fuer Katschutz | EN: Lambda min fuer Katschutz | [Code V452 INJ 0xF2014] Richest cat-protection lambda (0.70)." VALUE 0x7374C TKW_VV_VV_UW 100.0 FORMULA_0025 0.0 3.9990 FORMAT "%6.3" /end CHARACTERISTIC
/begin CHARACTERISTIC K_KATS_LAM_GRAD_POS "Aenderungsbegr. pos | EN: Aenderungsbegr. pos | [Code V452 INJ 0xF2014] Rate limit of the cat-protection lambda towards lean (per s)." VALUE 0x7374E TKW_VV_VV_UW 100.0 FORMULA_0728 0.0 3.9990 FORMAT "%6.3" /end CHARACTERISTIC
/begin CHARACTERISTIC K_KATS_LAM_GRAD_NEG "Aenderungsbegr. neg | EN: Aenderungsbegr. neg | [Code V452 INJ 0xF2014] Rate limit of the cat-protection lambda towards rich (per s)." VALUE 0x73750 TKW_VV_VV_UW 100.0 FORMULA_0728 0.0 3.9990 FORMAT "%6.3" /end CHARACTERISTIC
/begin CHARACTERISTIC K_KATS_I_MAX "Max I-Anteil | EN: Max I-Anteil | [Code V452 INJ 0xF2014] Upper limit of the cat-protection I part." VALUE 0x73752 TKW_VV_VV_SW 100.0 FORMULA_0025 0.0 0.4000 FORMAT "%6.3" /end CHARACTERISTIC
/begin CHARACTERISTIC K_KATS_I_MIN "Max I-Anteil | EN: Min I-Anteil | [Code V452 INJ 0xF2014] Lower (rich) limit of the cat-protection I part." VALUE 0x73754 TKW_VV_VV_SW 100.0 FORMULA_0295 -0.4000 0.0 FORMAT "%7.4" /end CHARACTERISTIC
/begin CHARACTERISTIC K_KATS_T_MAX "Maximale Kattemperatur | EN: Maximum catalyst temperature [°C] | [Code V452 INJ 0xF2014] Max cat/exhaust temperature for the cat-protection model (950 degC); K_KATS_T_MAX_PST in test mode." VALUE 0x73756 TKW_VV_VV_SW 100.0 FORMULA_0023 300.0000 1100.0000 FORMAT "%4.1" /end CHARACTERISTIC
/begin CHARACTERISTIC K_KATS_LAM_P_DELTA_MAX "Gradientenschwelle fuer Uergang Einfangen -> Eingeregelt | EN: Gradientenschwelle fuer Uergang Einfangen - > Eingeregelt" VALUE 0x73758 TKW_VV_VV_SW 100.0 FORMULA_0295 -2.0000 1.9999 FORMAT "%7.4" /end CHARACTERISTIC
/begin CHARACTERISTIC K_KATS_T_MAX_PST "Maximale Kattemperatur fuer Pruefstand | EN: Maximum catalyst temperature for test bench [°C] | [Code V452 INJ 0xF2014] Max temperature used instead of K_KATS_T_MAX in PST/test-bench mode." VALUE 0x7375A TKW_VV_VV_SW 100.0 FORMULA_0023 300.0000 1100.0000 FORMAT "%4.1" /end CHARACTERISTIC
/begin CHARACTERISTIC K_KATS_TKAT_MESS_MAX "Maximale Kattemperatur fuer Diagnose | EN: Maximale Kattemperatur fuer Diagnose" VALUE 0x7375C TKW_VV_VV_SW 100.0 FORMULA_0023 -80.0000 1400.0000 FORMAT "%4.1" /end CHARACTERISTIC
/begin CHARACTERISTIC K_KATS_T_LAM_MIN "Fehlerzeit in der kats_lam_soll gleich K_KATS_LAM_MIN | EN: Fehlerzeit in der kats_lam_soll gleich K_KATS_LAM_MIN" VALUE 0x7375E TKW_VV_VV_UW 100.0 FORMULA_0073 0.0 6553.5000 FORMAT "%4.1" /end CHARACTERISTIC
/begin CHARACTERISTIC K_KATS_CFG "Schalter fuer KATS Konfig | [Code V452 INJ 0xF2014] Cat-protection enable/config (1 here). Cat protection gives kats_lam_soll_b; the final target is min(target, kats_lam_soll) (richer wins) when active." VALUE 0x73760 TKW_VV_VV_UB 100.0 FORMULA_0729 0.0 255.0 /end CHARACTERISTIC
/begin CHARACTERISTIC KL_KATS_NKAT_LAM_OFFS "Lambda offset Katschutz | EN: Lambda offset for catalyst protection - post-cat temperature | [Code V452 INJ 0xF2014] P enrichment over rear-cat temperature delta (all 0 here)." CURVE 0x73762 TKL_SW_VV_SW 100.0 FORMULA_0025 -0.5000 0.5000
 /begin AXIS_DESCR STD_AXIS tabg_nkat_delta FORMULA_0076 4 -500.0000 500.0000 FORMAT "%4.1" /end AXIS_DESCR
 FORMAT "%6.3" /end CHARACTERISTIC
/begin CHARACTERISTIC KL_KATS_VKAT_LAM_OFFS "Lambda offset Katschutz | EN: Lambda offset for catalyst protection - pre-cat temperature | [Code V452 INJ 0xF2014] P enrichment over front-cat temperature delta (tabg_vkat_delta): -0.07 at -60 K, -0.30 at +20 K. The richest of the VKAT/NKAT/model offsets is used as P part." CURVE 0x73774 TKL_SW_VV_SW 100.0 FORMULA_0025 -0.5000 0.5000
 /begin AXIS_DESCR STD_AXIS tabg_vkat_delta FORMULA_0076 4 -500.0000 500.0000 FORMAT "%4.1" /end AXIS_DESCR
 FORMAT "%6.3" /end CHARACTERISTIC
/begin CHARACTERISTIC KL_KATS_MDL_LAM_OFFS "Lambda offset Katschutz | EN: Lambda offset for catalyst protection - catalyst exhaust temperature | [Code V452 INJ 0xF2014] P enrichment over modelled exhaust temperature delta: -0.03 at 0 K, -0.25 at +40 K." CURVE 0x73786 TKL_SW_VV_SW 100.0 FORMULA_0025 -0.5000 0.5000
 /begin AXIS_DESCR STD_AXIS tabg_mdl_delta FORMULA_0076 4 -500.0000 500.0000 FORMAT "%4.1" /end AXIS_DESCR
 FORMAT "%6.3" /end CHARACTERISTIC
/begin CHARACTERISTIC KL_KATS_LAM_I "I-Anteil Katschutz | EN: Integral share, catalyst protection | [Code V452 INJ 0xF2014] I part rate over middle-cat temperature delta (all 0 here); limited K_KATS_I_MIN..K_KATS_I_MAX." CURVE 0x73798 TKL_SW_VV_SW 100.0 FORMULA_0295 -0.5000 0.5000
 /begin AXIS_DESCR STD_AXIS tabg_mkat_b1 FORMULA_0076 4 -500.0000 500.0000 FORMAT "%4.1" /end AXIS_DESCR
 FORMAT "%7.4" /end CHARACTERISTIC
/* ------------------ Abschnitt erzeugt aus kge.dat ------------------ */
/begin CHARACTERISTIC K_KGE_HFM_TAU "Tau fuer hfm_5ms [V912: differs from V452 160E]" VALUE 0x737AA TKW_VV_VV_UB 100.0 FORMULA_0651 0.0051 1.2800 /end CHARACTERISTIC
/begin CHARACTERISTIC K_KGE_LL_T_DELAY "Delayzeit fuer Diagnose-Start im LL | EN: Delayzeit fuer Diagnose-Start im LL" VALUE 0x737AC TKW_VV_VV_UW 100.0 FORMULA_0021 0.0 655.0000 FORMAT "%5.2" /end CHARACTERISTIC
/begin CHARACTERISTIC K_KGE_LL_T_DIAG "LL-Zeit nach der die Diagnose ausgewertet wird" VALUE 0x737AE TKW_VV_VV_UW 100.0 FORMULA_0021 0.0 655.0000 FORMAT "%5.2" /end CHARACTERISTIC
/begin CHARACTERISTIC K_KGE_RSTART_T "Zeit nach abgelaufener Diagnose bis Diagnose neu startet" VALUE 0x737B0 TKW_VV_VV_UW 100.0 FORMULA_0021 0.0 655.0000 FORMAT "%5.2" /end CHARACTERISTIC
/begin CHARACTERISTIC K_KGE_TMOT "TMOT-Schwelle f. Freigabe" VALUE 0x737B2 TKW_VV_VV_SW 100.0 FORMULA_0023 -50.0000 170.0000 FORMAT "%4.1" /end CHARACTERISTIC
/begin CHARACTERISTIC K_KGE_TOEL "toel_modell-Schwelle f. Freigabe" VALUE 0x737B4 TKW_VV_VV_SW 100.0 FORMULA_0023 -50.0000 170.0000 FORMAT "%4.1" /end CHARACTERISTIC
/begin CHARACTERISTIC K_KGE_AY "Querbeschleunigung f. Sperren" VALUE 0x737B6 TKW_VV_VV_SW 100.0 FORMULA_0132 -20.0000 20.0000 FORMAT "%5.2" /end CHARACTERISTIC
/begin CHARACTERISTIC K_KGE_AX_BERG "Laengsbeschleunigung-Berg f. Sperren" VALUE 0x737B8 TKW_VV_VV_SW 100.0 FORMULA_0132 -20.0000 20.0000 FORMAT "%5.2" /end CHARACTERISTIC
/begin CHARACTERISTIC K_KGE_TIME_ML "Sperrzeit Diagnose nach Start" VALUE 0x737BA TKW_VV_VV_UW 100.0 FORMULA_0021 0.0 655.0000 FORMAT "%5.2" /end CHARACTERISTIC
/begin CHARACTERISTIC K_KGE_OZ_NIVR_MIN "Sperrniveau fuer min Oelniveau" VALUE 0x737BC TKW_VV_VV_UB 100.0 FORMULA_0731 0.1000 75.0000 /end CHARACTERISTIC
/begin CHARACTERISTIC K_KGE_SEG_IDX_INTG_1of2_ "Segmentindex fuer das Abweichungsintegral" VALUE 0x737BD TKW_VV_VV_UB 100.0 FORMULA_0033 0.0 255.0000 /end CHARACTERISTIC
/begin CHARACTERISTIC K_KGE_SEG_IDX_INTG_2of2_ "Segmentindex fuer das Abweichungsintegral | EN: Segmentindex fuer das Abweichungsintegral" VALUE 0x737BE TKW_VV_VV_UB 100.0 FORMULA_0033 0.0 255.0000 /end CHARACTERISTIC
/begin CHARACTERISTIC K_KGE_OZ_NIVR_MAX "Sperrniveau fuer max Oelniveau" VALUE 0x737BF TKW_VV_VV_UB 100.0 FORMULA_0431 0.0 74.7070 /end CHARACTERISTIC
/begin CHARACTERISTIC K_KGE_PUMG_MAX "Sperrniveau fuer max Pumg" VALUE 0x737C0 TKW_VV_VV_SW 100.0 FORMULA_0077 400.0000 1200.0000 FORMAT "%4.1" /end CHARACTERISTIC
/begin CHARACTERISTIC KL_KGE_MIN_INTG_B1 "Min-Schwelle fuer Integralwert IO Bank1 [V912: differs from V452 160E]" CURVE 0x737C2 TKL_SW_VV_UW 100.0 FORMULA_0562 0.0 6553.5000 /begin AXIS_DESCR STD_AXIS FORMULA_0077 4 400.0000 1200.0000 FORMAT "%4.1" /end AXIS_DESCR FORMAT "%4.1" /end CHARACTERISTIC
/begin CHARACTERISTIC KL_KGE_MIN_INTG_B2 "Min-Schwelle fuer Integralwert IO Bank2" CURVE 0x737D4 TKL_SW_VV_UW 100.0 FORMULA_0562 0.0 6553.5000 /begin AXIS_DESCR STD_AXIS FORMULA_0077 4 400.0000 1200.0000 FORMAT "%4.1" /end AXIS_DESCR FORMAT "%4.1" /end CHARACTERISTIC
/begin CHARACTERISTIC KL_KGE_OZ_NIVR_KOR "Korrektur ueber OZ_NIV" CURVE 0x737E6 TKL_UW_VV_UW 100.0 FORMULA_0075 0.0 4.0000 /begin AXIS_DESCR STD_AXIS FORMULA_0606 3 0.1000 75.0000 FORMAT "%5.2" /end AXIS_DESCR FORMAT "%6.3" /end CHARACTERISTIC
/* ------------------ Abschnitt erzeugt aus kt_oz.dat ------------------ */ /* ------------------ Abschnitt erzeugt aus kva.dat ------------------ */
/begin CHARACTERISTIC K_KVA_Q_MOT_TAU "Tau Kraftstoffverbrauch Motor." VALUE 0x7384A TKW_VV_VV_UB 100.0 FORMULA_0651 0.0051 1.2800 /end CHARACTERISTIC
/begin CHARACTERISTIC K_KVA_SPEC_WEIGHT "Dichte von Ottokraftstoff unverbleit." VALUE 0x7384C TKW_VV_VV_UW 100.0 FORMULA_0747 0.0002 0.9998 FORMAT "%7.4" /end CHARACTERISTIC
/* ------------------ Abschnitt erzeugt aus kw_diag_inj.dat ------------------ */
/begin CHARACTERISTIC K_KW_ED_DELTA_N "Max zul. Nockenwellendrehzahl im Startversuch bei n immer noch null. | EN: Max zul. Nockenwellendrehzahl im Startversuch bei n immer noch null." VALUE 0x7384E TKW_VV_VV_SW 100.0 FORMULA_0006 0.0 10000.0000 /end CHARACTERISTIC
/begin CHARACTERISTIC K_KW_ED_N_DROP "Max zul. Abrissdrehzahl. | EN: Max zul. Abrissdrehzahl." VALUE 0x73850 TKW_VV_VV_SW 100.0 FORMULA_0006 0.0 10000.0000 /end CHARACTERISTIC
/begin CHARACTERISTIC K_KW_ED_DELTA_U "Max zul. Abweichung der mittleren Differenzspannung. | EN: Max zul. Abweichung der mittleren Differenzspannung." VALUE 0x73852 TKW_VV_VV_SW 100.0 FORMULA_0123 0.0 1023.0000 /end CHARACTERISTIC
/begin CHARACTERISTIC K_KW_ED_DELTA_N_RATE "Fehlerrate Startversuch. | EN: Fehlerrate Startversuch." VALUE 0x73854 TKW_VV_VV_UW 100.0 FORMULA_0010 0.0 65535.0000 /end CHARACTERISTIC
/begin CHARACTERISTIC K_KW_ED_N_DROP_RATE "Fehlerrate Abriss. | EN: Fehlerrate Abriss." VALUE 0x73856 TKW_VV_VV_UW 100.0 FORMULA_0010 0.0 65535.0000 /end CHARACTERISTIC
/begin CHARACTERISTIC K_KW_ED_SH_TO_UB_RATE "Fehlerrate Kurzschluss nach Ub. | EN: Fehlerrate Kurzschluss nach Ub." VALUE 0x73858 TKW_VV_VV_UW 100.0 FORMULA_0010 0.0 65535.0000 /end CHARACTERISTIC
/begin CHARACTERISTIC K_KW_ED_SH_TO_GND_RATE "Fehlerrate Kurzschluss nach Masse. | EN: Fehlerrate Kurzschluss nach Masse." VALUE 0x7385A TKW_VV_VV_UW 100.0 FORMULA_0010 0.0 65535.0000 /end CHARACTERISTIC
/begin CHARACTERISTIC K_KW_ED_MAX_RATE "Max zul. Fehlerrate." VALUE 0x7385C TKW_VV_VV_UW 100.0 FORMULA_0010 0.0 65535.0000 /end CHARACTERISTIC
/* ------------------ Abschnitt erzeugt aus lavk_obd.dat ------------------ */
/begin CHARACTERISTIC K_LAVK_OBD_SA_DIAG_OL "VKAT-Lambda MAGER-Schwelle f. OPELNLOAD-Diag. | EN: VKAT-Lambda MAGER-Schwelle f. OPELNLOAD-Diag." VALUE 0x74C0C TKW_VV_VV_UW 100.0 FORMULA_0532 0.0 5000.0000 /end CHARACTERISTIC
/begin CHARACTERISTIC K_LA_OBD_DYN_DELTA_RF "rf Differnez fuer Dynamikerkennung | EN: rf Differnez fuer Dynamikerkennung" VALUE 0x74C0E TKW_VV_VV_SW 100.0 FORMULA_0007 0.0 2.0000 FORMAT "%6.3" /end CHARACTERISTIC
/begin CHARACTERISTIC K_LA_OBD_DYN_DELTA_PUMP_RF "rf Differnez fuer Dynamikerkennung gegen Pumpen | EN: rf Differnez fuer Dynamikerkennung gegen Pumpen" VALUE 0x74C10 TKW_VV_VV_SW 100.0 FORMULA_0007 0.0 2.0000 FORMAT "%6.3" /end CHARACTERISTIC
/begin CHARACTERISTIC K_LA_OBD_DYN_DELTA_CNT "Anzahl der dyn Triggers bis status gesetzt wird | EN: Anzahl der dyn Triggers bis status gesetzt wird" VALUE 0x74C12 TKW_VV_VV_UW 100.0 FORMULA_0083 0.0 65535.0000 FORMAT "%5.2" /end CHARACTERISTIC
/begin CHARACTERISTIC K_LA_OBD_DYN_CNT_INC "Counter increments fuer rf_dyn_la_cnt | EN: Counter increments fuer rf_dyn_la_cnt" VALUE 0x74C14 TKW_VV_VV_UB 100.0 FORMULA_0033 0.0 255.0000 /end CHARACTERISTIC
/begin CHARACTERISTIC K_LA_OBD_DYN_RF_T "Sperrzeit fuer Ruecknahme rf-Dynamik | EN: Sperrzeit fuer Ruecknahme rf-Dynamik" VALUE 0x74C16 TKW_VV_VV_UW 100.0 FORMULA_0021 0.0 655.3500 FORMAT "%5.2" /end CHARACTERISTIC
/begin CHARACTERISTIC K_LAVK_OBD_PLAU_CFG "Freigabe OBD-Plausibilitaet | EN: Freigabe OBD-Plausibilitaet" VALUE 0x74C18 TKW_VV_VV_UW 100.0 FORMULA_0868 0.0 1.0 FORMAT "%5.2" /end CHARACTERISTIC
/begin CHARACTERISTIC K_LAVK_OBD_TMOT "min. TMOT-Schwelle f. OBD-PLAUSI | EN: min. TMOT-Schwelle f. OBD-PLAUSI" VALUE 0x74C1A TKW_VV_VV_SW 100.0 FORMULA_0023 -50.0000 170.0000 FORMAT "%4.1" /end CHARACTERISTIC
/begin CHARACTERISTIC K_LAVK_OBD_PLAU_RF_MAX "max. relative F�llung f. OBD-Plausi | EN: Maximum relative charge for OBD plausibility" VALUE 0x74C1C TKW_VV_VV_SW 100.0 FORMULA_0007 0.0 2.0000 FORMAT "%6.3" /end CHARACTERISTIC
/begin CHARACTERISTIC K_LAVK_OBD_PLAU_RF_MIN "min. relative F�llung f. OBD-Plausi | EN: Minimum relative charge for OBD plausibility" VALUE 0x74C1E TKW_VV_VV_SW 100.0 FORMULA_0007 0.0 2.0000 FORMAT "%6.3" /end CHARACTERISTIC
/begin CHARACTERISTIC K_LAVK_OBD_PLAU_TKAT_MIN "min. KAT-Temperatur f. OBD-Plausi | EN: Minimum catalyst temperature for OBD plausibility [°C]" VALUE 0x74C20 TKW_VV_VV_SW 100.0 FORMULA_0023 -50.0000 1200.0000 FORMAT "%4.1" /end CHARACTERISTIC
/begin CHARACTERISTIC K_LAVK_OBD_PLAU_TKAT_MAX "max. KAT-Temperatur f. OBD-Plausi | EN: Maximum catalyst temperature for OBD plausibility [°C]" VALUE 0x74C22 TKW_VV_VV_SW 100.0 FORMULA_0023 -50.0000 1200.0000 FORMAT "%4.1" /end CHARACTERISTIC
/begin CHARACTERISTIC K_LAVK_OBD_PLAU_LANK_MIN "NKAT-Signal FETT-Schwelle f. OBD-Plausi | EN: Post-cat signal RICH threshold for OBD plausibility" VALUE 0x74C24 TKW_VV_VV_UW 100.0 FORMULA_0532 0.0 1200.0000 /end CHARACTERISTIC
/begin CHARACTERISTIC K_LAVK_OBD_PLAU_LANK_MAX "NKAT-Signal MAGER-Schwelle f. OBD-Plausi | EN: Post-cat signal LEAN threshold for OBD plausibility" VALUE 0x74C26 TKW_VV_VV_UW 100.0 FORMULA_0532 0.0 1200.0000 /end CHARACTERISTIC
/begin CHARACTERISTIC K_LAVK_OBD_PLAU_UN_SCHW "VKAT-Schwelle f. UN-OPENLOAD-Diag. | EN: Pre-cat threshold for open-load diagnosis [mV]" VALUE 0x74C28 TKW_VV_VV_UW 100.0 FORMULA_0532 0.0 5000.0000 /end CHARACTERISTIC
/begin CHARACTERISTIC K_LAVK_OBD_PLAU_LAM_FETT "VKAT-Lambda FETT-Schwelle f. OBD-Plausi | EN: Pre-cat lambda RICH threshold for OBD plausibility" VALUE 0x74C2A TKW_VV_VV_UW 100.0 FORMULA_0025 0.0 3.9990 FORMAT "%6.3" /end CHARACTERISTIC
/begin CHARACTERISTIC K_LAVK_OBD_PLAU_LAM_MAGER "VKAT-Lambda MAGER-Schwelle f. OBD-Plausi | EN: Pre-cat lambda LEAN threshold for OBD plausibility" VALUE 0x74C2C TKW_VV_VV_UW 100.0 FORMULA_0025 0.0 3.9990 FORMAT "%6.3" /end CHARACTERISTIC
/begin CHARACTERISTIC K_LAVK_OBD_PLAU_LAM_MIN "VKAT-Lambda MIN-Schwelle f. OBD-Plausi | EN: Pre-cat lambda MIN threshold for OBD plausibility" VALUE 0x74C2E TKW_VV_VV_UW 100.0 FORMULA_0025 0.0 3.9990 FORMAT "%6.3" /end CHARACTERISTIC
/begin CHARACTERISTIC K_LAVK_OBD_PLAU_LAM_MAX "VKAT-Lambda MIN-Schwelle f. OBD-Plausi | EN: Pre-cat lambda MIN threshold for OBD plausibility" VALUE 0x74C30 TKW_VV_VV_UW 100.0 FORMULA_0025 0.0 3.9990 FORMAT "%6.3" /end CHARACTERISTIC
/begin CHARACTERISTIC K_LAVK_OBD_PLAU_F_CNT "FETT-Plausi Fehlerzaehler | EN: RICH plausibility fault counter" VALUE 0x74C32 TKW_VV_VV_UW 100.0 FORMULA_0010 0.0 255.0000 /end CHARACTERISTIC
/begin CHARACTERISTIC K_LAVK_OBD_PLAU_M_CNT "MAGER-Plausi Fehlerzaehler | EN: LEAN plausibility fault counter" VALUE 0x74C34 TKW_VV_VV_UW 100.0 FORMULA_0010 0.0 255.0000 /end CHARACTERISTIC
/begin CHARACTERISTIC K_LAVK_OBD_PLAU_OL_CNT "F/M-Plausi Fehlerzaehler | EN: Rich/lean plausibility fault counter" VALUE 0x74C36 TKW_VV_VV_UW 100.0 FORMULA_0010 0.0 65535.0000 /end CHARACTERISTIC
/begin CHARACTERISTIC K_LAVK_OBD_PLAU_T "Verzoegerungszeit OBD-Plausibilisierung | EN: Delay time for OBD plausibility check [s] [V912: differs from V452 160E]" VALUE 0x74C38 TKW_VV_VV_UW 100.0 FORMULA_0073 0.0 6553.5000 FORMAT "%4.1" /end CHARACTERISTIC
/begin CHARACTERISTIC K_LAVK_OBD_PLAU_UN_OSZI_OFF "Ausschaltzeit des ATIC42-Oszi f. UN-OL-Diag. | EN: Ausschaltzeit des ATIC42-Oszi f. UN-OL-Diag." VALUE 0x74C3A TKW_VV_VV_UW 100.0 FORMULA_0073 0.0 6553.5000 FORMAT "%4.1" /end CHARACTERISTIC
/begin CHARACTERISTIC K_LAVK_OBD_PLAU_ML_SUM "min. aufsummierte Luftmassenstr. nach SA_WE | EN: min. aufsummierte Luftmassenstr. nach SA_WE" VALUE 0x74C3C TKW_VV_VV_UW 100.0 FORMULA_0832 0.0 65535.0000 /end CHARACTERISTIC
/begin CHARACTERISTIC K_LAVK_OBD_PLAU_IP_STABIL_T "min. Zeit auf Erkennung DYNAMIK | EN: min. Zeit auf Erkennung DYNAMIK" VALUE 0x74C3E TKW_VV_VV_UW 100.0 FORMULA_0539 0.0 6553500.0000 /end CHARACTERISTIC
/begin CHARACTERISTIC K_LAVK_OBD_PLAU_IP_REG_MIN "min. Regelabweichung bei IP/VM-Openload-Verdacht | EN: min. Regelabweichung bei IP/VM-Openload-Verdacht" VALUE 0x74C40 TKW_VV_VV_UW 100.0 FORMULA_0024 0.0 1.9990 FORMAT "%7.4" /end CHARACTERISTIC
/begin CHARACTERISTIC K_LAVK_OBD_PLAU_IP_REG_MAX "max. Regelabweichung bei IP/VM-Openload-Verdacht | EN: max. Regelabweichung bei IP/VM-Openload-Verdacht" VALUE 0x74C42 TKW_VV_VV_UW 100.0 FORMULA_0024 0.0 1.9990 FORMAT "%7.4" /end CHARACTERISTIC
/begin CHARACTERISTIC K_LAVK_OBD_PLAU_IP_N_MAX "max. Drehzahl f. IP-/VM-Verdacht bei Plausi-Diag. | EN: max. Drehzahl f. IP-/VM-Verdacht bei Plausi-Diag." VALUE 0x74C44 TKW_VV_VV_SW 100.0 FORMULA_0006 0.0 10000.0000 /end CHARACTERISTIC
/begin CHARACTERISTIC K_LAVK_OBD_PLAU_IP_N_MIN "min. Drehzahl f. IP-/VM-Verdacht bei Plausi-Diag. | EN: min. Drehzahl f. IP-/VM-Verdacht bei Plausi-Diag." VALUE 0x74C46 TKW_VV_VV_SW 100.0 FORMULA_0006 0.0 10000.0000 /end CHARACTERISTIC
/begin CHARACTERISTIC K_LAVK_OBD_SA_CFG "Freigabe OBD-SA-Pruefung | EN: 0 OBD-SA inaktiv 1 OBD-SA aktiv Freigabe OBD-SA-Pruefung" VALUE 0x74C48 TKW_VV_VV_UW 100.0 FORMULA_0869 0.0 1.0 FORMAT "%5.2" /end CHARACTERISTIC
/begin CHARACTERISTIC K_LAVK_OBD_SA_CNT "SA-Diag.-Fehlerzaehler | EN: SA-Diag.-Fehlerzaehler" VALUE 0x74C4A TKW_VV_VV_UW 100.0 FORMULA_0010 0.0 65535.0000 /end CHARACTERISTIC
/begin CHARACTERISTIC K_LAVK_OBD_SA_T "Verzoegerungszeit OBD-SA-Pruefung | EN: Verzoegerungszeit OBD -SA-Pruefung" VALUE 0x74C4C TKW_VV_VV_UW 100.0 FORMULA_0073 0.0 6553.5000 FORMAT "%4.1" /end CHARACTERISTIC
/begin CHARACTERISTIC K_LAVK_OBD_SA_SCHW "SA-Diag.-Schwelle AD-Wert | EN: SA-Diag.-Schwelle AD-Wert" VALUE 0x74C4E TKW_VV_VV_UW 100.0 FORMULA_0532 0.0 5000.0000 /end CHARACTERISTIC
/begin CHARACTERISTIC K_LAVK_OBD_SA_ML_SUM "min. aufsummierte Luftmassenstr. im ZUST_SA | EN: min. aufsummierte Luftmassenstr. im ZUST_SA" VALUE 0x74C50 TKW_VV_VV_UW 100.0 FORMULA_0832 0.0 65535.0000 /end CHARACTERISTIC
/begin CHARACTERISTIC K_LAVK_OBD_VK_TEMP "min. Sondentemperatur fuer Freigabe | EN: min. Sondentemperatur fuer Freigabe" VALUE 0x74C52 TKW_VV_VV_SW 100.0 FORMULA_0791 -50.0000 1250.0000 /end CHARACTERISTIC
/begin CHARACTERISTIC K_LAVK_OBD_TL_CFG "Freigabe OBD-TL/VL-Diagnose | EN: Freigabe OBD-TL/VL-Diagnose" VALUE 0x74C54 TKW_VV_VV_UW 100.0 FORMULA_0870 0.0 1.0 FORMAT "%5.2" /end CHARACTERISTIC
/begin CHARACTERISTIC K_LAVK_OBD_TL_CNT "TL/VL-Diag.-Fehlerzaehler | EN: TL/VL-Diag.-Fehlerzaehler" VALUE 0x74C56 TKW_VV_VV_UW 100.0 FORMULA_0010 0.0 65535.0000 /end CHARACTERISTIC
/begin CHARACTERISTIC K_LAVK_OBD_TL_T "Verzoegerungszeit OBD-TL/VL-Diagnose | EN: Verzoegerungszeit OBD-TL/VL-Diagnose" VALUE 0x74C58 TKW_VV_VV_UW 100.0 FORMULA_0073 0.0 6553.5000 FORMAT "%4.1" /end CHARACTERISTIC
/begin CHARACTERISTIC K_LAVK_OBD_TL_ML_SUM "min. aufsummierte Luftmassenstr. nach SA_WE | EN: min. aufsummierte Luftmassenstr. nach SA_WE" VALUE 0x74C5A TKW_VV_VV_UW 100.0 FORMULA_0832 0.0 65535.0000 /end CHARACTERISTIC
/begin CHARACTERISTIC K_LAVK_OBD_TL_SCHW_MAX "VKAT-Lambda MAGER-Schwelle f. OPELNLOAD-Diag. | EN: VKAT-Lambda MAGER-Schwelle f. OPELNLOAD-Diag." VALUE 0x74C5C TKW_VV_VV_UW 100.0 FORMULA_0532 0.0 5000.0000 /end CHARACTERISTIC
/begin CHARACTERISTIC K_LAVK_OBD_TL_SCHW_MIN "VKAT-Lambda MAGER-Schwelle f. OPELNLOAD-Diag. | EN: VKAT-Lambda MAGER-Schwelle f. OPELNLOAD-Diag." VALUE 0x74C5E TKW_VV_VV_UW 100.0 FORMULA_0532 0.0 5000.0000 /end CHARACTERISTIC
/begin CHARACTERISTIC K_LAVK_OBD_ACT_TRIM_F "Fehlersimulation TRIM_FETT_FEHLER" VALUE 0x74C60 TKW_VV_VV_UW 100.0 FORMULA_0798 0.0 1.0 FORMAT "%5.2" /end CHARACTERISTIC
/begin CHARACTERISTIC K_LAVK_OBD_ACT_TRIM_M "Fehlersimulation TRIM_MAGER_FEHLER" VALUE 0x74C62 TKW_VV_VV_UW 100.0 FORMULA_0798 0.0 1.0 FORMAT "%5.2" /end CHARACTERISTIC
/begin CHARACTERISTIC K_LAVK_OBD_ACT_CFG "Freigabe aktive Plausi-Diagnose" VALUE 0x74C64 TKW_VV_VV_UW 100.0 FORMULA_0798 0.0 1.0 FORMAT "%5.2" /end CHARACTERISTIC
/begin CHARACTERISTIC K_LAVK_OBD_ACT_TKAT "min. KAT-Temperatur - aktive Plausi.Diag. | EN: Minimum catalyst temperature - active plausibility diagnosis [°C]" VALUE 0x74C66 TKW_VV_VV_SW 100.0 FORMULA_0023 -50.0000 1200.0000 FORMAT "%4.1" /end CHARACTERISTIC
/begin CHARACTERISTIC K_LAVK_OBD_ACT_ML_SUM "min. aufsummierte Luftmassenstr. nach SA_WE | EN: Minimum summed air mass flow after start [mg]" VALUE 0x74C68 TKW_VV_VV_UW 100.0 FORMULA_0832 0.0 65535.0000 /end CHARACTERISTIC
/begin CHARACTERISTIC K_LAVK_OBD_ACT_RF_MAX "max. relative F�llung f. aktive Plausi-Diag. | EN: Maximum relative charge for active plausibility diagnosis" VALUE 0x74C6A TKW_VV_VV_SW 100.0 FORMULA_0007 0.0 2.0000 FORMAT "%6.3" /end CHARACTERISTIC
/begin CHARACTERISTIC K_LAVK_OBD_ACT_RF_MIN "min. relative F�llung f. aktive Plausi-Diag. | EN: Minimum relative charge for active plausibility diagnosis" VALUE 0x74C6C TKW_VV_VV_SW 100.0 FORMULA_0007 0.0 2.0000 FORMAT "%6.3" /end CHARACTERISTIC
/begin CHARACTERISTIC K_LAVK_OBD_ACT_N_MAX "max. Drehzahl f. aktive Plausi-Diag. | EN: Maximum engine speed for active plausibility diagnosis [Upm]" VALUE 0x74C6E TKW_VV_VV_SW 100.0 FORMULA_0006 0.0 10000.0000 /end CHARACTERISTIC
/begin CHARACTERISTIC K_LAVK_OBD_ACT_N_MIN "min. Drehzahl f. aktive Plausi-Diag. | EN: Minimum engine speed for active plausibility diagnosis [Upm]" VALUE 0x74C70 TKW_VV_VV_SW 100.0 FORMULA_0006 0.0 10000.0000 /end CHARACTERISTIC
/begin CHARACTERISTIC K_LAVK_OBD_ACT_M_T "MAGER-Verzoegerungszeit - aktive Plausi-Diag. | EN: LEAN delay time - active plausibility diagnosis [s]" VALUE 0x74C72 TKW_VV_VV_UW 100.0 FORMULA_0073 0.0 6553.5000 FORMAT "%4.1" /end CHARACTERISTIC
/begin CHARACTERISTIC K_LAVK_OBD_ACT_F_T "FETT-Verzoegerungszeit - aktive Plausi-Diag. | EN: FETT-Verzoegerungszeit - aktive Plausi-Diag." VALUE 0x74C74 TKW_VV_VV_UW 100.0 FORMULA_0073 0.0 6553.5000 FORMAT "%4.1" /end CHARACTERISTIC
/begin CHARACTERISTIC K_LAVK_OBD_ACT_LAM_SOLL_M "SOLL-Lambda - MAGER-Diagnose | EN: SOLL-Lambda - MAGER-Diagnose" VALUE 0x74C76 TKW_VV_VV_UW 100.0 FORMULA_0025 0.0 3.9990 FORMAT "%6.3" /end CHARACTERISTIC
/begin CHARACTERISTIC K_LAVK_OBD_ACT_LAM_SOLL_F "SOLL-Lambda - FETT-Diagnose | EN: SOLL-Lambda - FETT-Diagnose" VALUE 0x74C78 TKW_VV_VV_UW 100.0 FORMULA_0025 0.0 3.9990 FORMAT "%6.3" /end CHARACTERISTIC
/begin CHARACTERISTIC K_LAVK_OBD_ACT_LAM_IST_M "LA-Schwelle f. MAGER-Fehler | EN: LA-Schwelle f. MAGER-Fehler" VALUE 0x74C7A TKW_VV_VV_UW 100.0 FORMULA_0025 0.0 3.9990 FORMAT "%6.3" /end CHARACTERISTIC
/begin CHARACTERISTIC K_LAVK_OBD_ACT_LAM_IST_F "LA-Schwelle f. FETT-Fehler | EN: LA-Schwelle f. FETT-Fehler" VALUE 0x74C7C TKW_VV_VV_UW 100.0 FORMULA_0025 0.0 3.9990 FORMAT "%6.3" /end CHARACTERISTIC
/begin CHARACTERISTIC K_LAVK_OBD_ACT_LANK_M "NKAT-Schwelle f. MAGER-Fehler | EN: NKAT-Schwelle f. M AGER-Fehler" VALUE 0x74C7E TKW_VV_VV_UW 100.0 FORMULA_0532 0.0 1200.0000 /end CHARACTERISTIC
/begin CHARACTERISTIC K_LAVK_OBD_ACT_LANK_F "NKAT-Schwelle f. FETT-Fehler | EN: NKAT-Schwelle f. FETT-Fehler" VALUE 0x74C80 TKW_VV_VV_UW 100.0 FORMULA_0532 0.0 1200.0000 /end CHARACTERISTIC
/begin CHARACTERISTIC K_LAVK_OBD_ACT_VK_M_CNT "VKAT Fehlerzaehler - MAGER-Diagnose | EN: VKAT Fehlerzaehler - MAGER-Diagnose" VALUE 0x74C82 TKW_VV_VV_UW 100.0 FORMULA_0010 0.0 65535.0000 /end CHARACTERISTIC
/begin CHARACTERISTIC K_LAVK_OBD_ACT_NK_M_CNT "NKAT Fehlerzaehler - MAGER-Diagnose | EN: NKAT Fehlerzaehler -  MA-GER-Diagnose" VALUE 0x74C84 TKW_VV_VV_UW 100.0 FORMULA_0010 0.0 65535.0000 /end CHARACTERISTIC
/begin CHARACTERISTIC K_LAVK_OBD_ACT_VK_F_CNT "VKAT Fehlerzaehler - FETT-Diagnose | EN: VKAT Fehlerzaehler -  FETT-Diagnose" VALUE 0x74C86 TKW_VV_VV_UW 100.0 FORMULA_0010 0.0 65535.0000 /end CHARACTERISTIC
/begin CHARACTERISTIC K_LAVK_OBD_ACT_NK_F_CNT "NKAT Fehlerzaehler - FETT-Diagnose | EN: NKAT Fehlerzaehler -  FETT-Diagnose" VALUE 0x74C88 TKW_VV_VV_UW 100.0 FORMULA_0010 0.0 65535.0000 /end CHARACTERISTIC
/begin CHARACTERISTIC K_LAVK_OBD_ACT_EXD_N_SOLL "Prueflauf - angeforderte Drehzahl | EN: Prueflauf - angeforderte Dreh-zahl" VALUE 0x74C8A TKW_VV_VV_SW 100.0 FORMULA_0006 0.0 10000.0000 /end CHARACTERISTIC
/begin CHARACTERISTIC K_LAVK_OBD_ACT_EXD_TIME "Prueflauf Freigabezeit | EN: Prueflauf Freigabezeit" VALUE 0x74C8C TKW_VV_VV_UW 100.0 FORMULA_0862 0.0 6553.5000 /end CHARACTERISTIC
/begin CHARACTERISTIC K_KSD_OBD_OEL_SPERR_MAX "Schwelle fuer Erkennung Oelverduennung" VALUE 0x74C8E TKW_VV_VV_UB 100.0 FORMULA_0003 0.0 255.0000 /end CHARACTERISTIC
/begin CHARACTERISTIC K_KSD_OBD_CFG "Freigabe Kraftstoffsystemdiagnose" VALUE 0x74C90 TKW_VV_VV_UW 100.0 FORMULA_0871 0.0 1.0 FORMAT "%5.2" /end CHARACTERISTIC
/begin CHARACTERISTIC K_KSD_OBD_TMOT_MIN "min. TMOT-Schwelle f. KSD" VALUE 0x74C92 TKW_VV_VV_SW 100.0 FORMULA_0023 -50.0000 170.0000 FORMAT "%4.1" /end CHARACTERISTIC
/begin CHARACTERISTIC K_KSD_OBD_RF_MAX "max. relative F�llung f. KSD" VALUE 0x74C94 TKW_VV_VV_SW 100.0 FORMULA_0007 0.0 2.0000 FORMAT "%6.3" /end CHARACTERISTIC
/begin CHARACTERISTIC K_KSD_OBD_RF_MIN "min. relative F�llung f. KSD" VALUE 0x74C96 TKW_VV_VV_SW 100.0 FORMULA_0007 0.0 2.0000 FORMAT "%6.3" /end CHARACTERISTIC
/begin CHARACTERISTIC K_KSD_OBD_N_MAX "max. Drehzahl f. KSD" VALUE 0x74C98 TKW_VV_VV_SW 100.0 FORMULA_0006 0.0 10000.0000 /end CHARACTERISTIC
/begin CHARACTERISTIC K_KSD_OBD_N_MIN "min. Drehzahl f. KSD" VALUE 0x74C9A TKW_VV_VV_SW 100.0 FORMULA_0006 0.0 10000.0000 /end CHARACTERISTIC
/begin CHARACTERISTIC K_KSD_OBD_TAN "max. TAN-Schwelle" VALUE 0x74C9C TKW_VV_VV_SW 100.0 FORMULA_0023 -50.0000 170.0000 FORMAT "%4.1" /end CHARACTERISTIC
/begin CHARACTERISTIC K_KSD_OBD_PUMG_MIN "min. Umgebungsdruck" VALUE 0x74C9E TKW_VV_VV_SW 100.0 FORMULA_0077 400.0000 1200.0000 FORMAT "%4.1" /end CHARACTERISTIC
/begin CHARACTERISTIC K_KSD_OBD_V "max. Fahrzeuggeschwindigkeit f. LL-KSD" VALUE 0x74CA0 TKW_VV_VV_SW 100.0 FORMULA_0078 -80.0000 360.0000 FORMAT "%4.1" /end CHARACTERISTIC
/begin CHARACTERISTIC K_KSD_OBD_DIAG_T "KSD-Diagnosezeit" VALUE 0x74CA2 TKW_VV_VV_UW 100.0 FORMULA_0862 0.0 6553.5000 /end CHARACTERISTIC
/begin CHARACTERISTIC K_KSD_OBD_LL_MAX_T "Zeit - MAX-Ueberschr. im LL [V912: differs from V452 160E]" VALUE 0x74CA4 TKW_VV_VV_UW 100.0 FORMULA_0862 0.0 6553.5000 /end CHARACTERISTIC
/begin CHARACTERISTIC K_KSD_OBD_LL_MIN_T "Zeit - MIN-Ueberschr. im LL" VALUE 0x74CA6 TKW_VV_VV_UW 100.0 FORMULA_0862 0.0 6553.5000 /end CHARACTERISTIC
/begin CHARACTERISTIC K_KSD_OBD_TL_MAX_T "Zeit - MAX-Ueberschr. in TL" VALUE 0x74CA8 TKW_VV_VV_UW 100.0 FORMULA_0862 0.0 6553.5000 /end CHARACTERISTIC
/begin CHARACTERISTIC K_KSD_OBD_TL_MIN_T "Zeit - MIN-Ueberschr. in TL" VALUE 0x74CAA TKW_VV_VV_UW 100.0 FORMULA_0862 0.0 6553.5000 /end CHARACTERISTIC
/begin CHARACTERISTIC K_KSD_OBD_LL_LAM_MAX "MAX-Gesamtabweichung Lambda KSD im LL [V912: differs from V452 160E]" VALUE 0x74CAC TKW_VV_VV_UW 100.0 FORMULA_0024 0.0 1.9990 FORMAT "%7.4" /end CHARACTERISTIC
/begin CHARACTERISTIC K_KSD_OBD_LL_LAM_MIN "MIN-Gesamtabweichung Lambda KSD im LL [V912: differs from V452 160E]" VALUE 0x74CAE TKW_VV_VV_UW 100.0 FORMULA_0024 0.0 1.9990 FORMAT "%7.4" /end CHARACTERISTIC
/begin CHARACTERISTIC K_KSD_OBD_TL_LAM_MAX "MAX-Gesamtabweichung Lambda KSD in TL" VALUE 0x74CB0 TKW_VV_VV_UW 100.0 FORMULA_0024 0.0 1.9990 FORMAT "%7.4" /end CHARACTERISTIC
/begin CHARACTERISTIC K_KSD_OBD_TL_LAM_MIN "MIN-Gesamtabweichung Lambda KSD im LL" VALUE 0x74CB2 TKW_VV_VV_UW 100.0 FORMULA_0024 0.0 1.9990 FORMAT "%7.4" /end CHARACTERISTIC
/begin CHARACTERISTIC K_KSD_OBD_T_ML "Verzoegerungszeit nach Startende" VALUE 0x74CB4 TKW_VV_VV_UW 100.0 FORMULA_0021 0.0 655.0000 FORMAT "%5.2" /end CHARACTERISTIC
/begin CHARACTERISTIC KL_KSD_OBD_OEL_INC "INC-Wert fuer Oel-Verduennung" CURVE 0x74CB6 TKL_SW_VV_UB 100.0 FORMULA_0003 0.0 255.0000 /begin AXIS_DESCR STD_AXIS FORMULA_0023 4 -50.0000 170.0000 FORMAT "%4.1" /end AXIS_DESCR /end CHARACTERISTIC
/begin CHARACTERISTIC KL_KSD_OBD_OEL_DEC "DEC-Wert fuer Oel-Verduennung" CURVE 0x74CC4 TKL_SW_VV_UB 100.0 FORMULA_0003 0.0 255.0000 /begin AXIS_DESCR STD_AXIS FORMULA_0023 4 -50.0000 170.0000 FORMAT "%4.1" /end AXIS_DESCR /end CHARACTERISTIC
/* ------------------ Abschnitt erzeugt aus lsh_nk.dat ------------------ */
/begin CHARACTERISTIC K_LSHNK_DIAG_CFG "Freigabe d. elektrischen Diag. LSH-NKAT | EN: 0 inaktiv 1 aktiv Freigabe d. elektrischen Diag. LSH-NKAT" VALUE 0x74EC4 TKW_VV_VV_UB 100.0 FORMULA_0839 0.0 1.0 /end CHARACTERISTIC
/begin CHARACTERISTIC K_LSHNK_UB_MAX "max. UB-Spannung | EN: max. UB-Spannung" VALUE 0x74EC6 TKW_VV_VV_SW 100.0 FORMULA_0008 0.0 28.0000 FORMAT "%4.1" /end CHARACTERISTIC
/begin CHARACTERISTIC K_LSHNK_RF_HYS "Hysterese f. RF-Schwelle | EN: Hysterese f. RF-Schwelle" VALUE 0x74EC8 TKW_VV_VV_SW 100.0 FORMULA_0007 0.0 2.0000 FORMAT "%6.3" /end CHARACTERISTIC
/begin CHARACTERISTIC K_LSHNK_TKAT_MAX "max. KAT-Temperatur | EN: max. KAT-Temperatur" VALUE 0x74ECA TKW_VV_VV_SW 100.0 FORMULA_0023 -50.0000 1250.0000 FORMAT "%4.1" /end CHARACTERISTIC
/begin CHARACTERISTIC K_LSHNK_TAUP "Taupunkttemperatur | EN: Taupunkttemperatur" VALUE 0x74ECC TKW_VV_VV_SW 100.0 FORMULA_0023 0.0 250.0000 FORMAT "%4.1" /end CHARACTERISTIC
/begin CHARACTERISTIC K_LSHNK_TA_MAX "max. Tastverh�ltnis" VALUE 0x74ECE TKW_VV_VV_UW 100.0 FORMULA_0931 0.0 99.9900 FORMAT "%5.2" /end CHARACTERISTIC
/begin CHARACTERISTIC K_LSHNK_DIAG_R_TAU "Zeitkonstante zur Mittelung NKAT | EN: Zeitkonstante zur Mittelung NKAT" VALUE 0x74ED0 TKW_VV_VV_UB 100.0 FORMULA_0664 0.0101 2.5600 /end CHARACTERISTIC
/begin CHARACTERISTIC K_LSHNK_DIAG_TAUP_T "Zeitschwelle ab Taupunktueberschr. | EN: Zeitschwelle ab Taupunktueberschr." VALUE 0x74ED2 TKW_VV_VV_UW 100.0 FORMULA_0021 0.0 655.0000 FORMAT "%5.2" /end CHARACTERISTIC
/begin CHARACTERISTIC K_LSHNK_DIAG_RO "obere NKAT-Widerstandsschwelle | EN: Upper post-cat resistance threshold [Ohm]" VALUE 0x74ED4 TKW_VV_VV_UW 100.0 FORMULA_0537 0.0 6553.5000 FORMAT "%4.1" /end CHARACTERISTIC
/begin CHARACTERISTIC K_LSHNK_DIAG_RU "untere NKAT-Widerstandsschwelle | EN: Lower post-cat resistance threshold [Ohm]" VALUE 0x74ED6 TKW_VV_VV_UW 100.0 FORMULA_0537 0.0 6553.5000 FORMAT "%4.1" /end CHARACTERISTIC
/begin CHARACTERISTIC K_LSHNK_AKTIV_T "Heizzeit der LSH | EN: Sensor heating time [s]" VALUE 0x74ED8 TKW_VV_VV_UW 100.0 FORMULA_0021 0.0 655.0000 FORMAT "%5.2" /end CHARACTERISTIC
/begin CHARACTERISTIC KL_LSHNK_T_EIN "Verzoegerungszeit NKAT | EN: Delay time, post-cat" CURVE 0x74EDA TKL_SW_VV_UW 100.0 FORMULA_0799 0.0 65535.0000 /begin AXIS_DESCR STD_AXIS FORMULA_0023 3 -50.0000 170.0000 FORMAT "%4.1" /end AXIS_DESCR /end CHARACTERISTIC
/begin CHARACTERISTIC KL_LSHNK_RF_AUS "RF-Schwelle - Ausschaltbedingung | EN: Relative-charge threshold - switch-off condition" CURVE 0x74EE8 TKL_SW_VV_SW 100.0 FORMULA_0007 0.0 2.0000 /begin AXIS_DESCR STD_AXIS FORMULA_0006 5 0.0 10000.0000 /end AXIS_DESCR FORMAT "%6.3" /end CHARACTERISTIC
/begin CHARACTERISTIC KL_LSHNK_TA "Tastverhaeltnis | EN: Duty cycle" CURVE 0x74EFE TKL_SW_VV_UW 100.0 FORMULA_0931 0.0 100.0000 /begin AXIS_DESCR STD_AXIS FORMULA_0008 4 0.0 28.0000 FORMAT "%4.1" /end AXIS_DESCR FORMAT "%5.2" /end CHARACTERISTIC
/begin CHARACTERISTIC KL_LSHNK_SOND_TEMP "NKAT-Sondentemperatur | EN: Post-cat sensor temperature" CURVE 0x74F10 TKL_UW_VV_SW 100.0 FORMULA_0023 -50.0000 1250.0000
 /begin AXIS_DESCR STD_AXIS lshnk_r_gmw FORMULA_0537 8 0.0 100.0000 FORMAT "%4.1" /end AXIS_DESCR
 FORMAT "%4.1" /end CHARACTERISTIC
/* ------------------ Abschnitt erzeugt aus lsh_vk.dat ------------------ */
/begin CHARACTERISTIC K_LSHVK_CFG "LSH-Freigabe | EN: 0x0 keine Heizung 0x1 Heizung ELSE undefiniert LSH-Freigabe" VALUE 0x74F32 TKW_VV_VV_UW 100.0 FORMULA_0957 0.0 65535.0 FORMAT "%5.2" /end CHARACTERISTIC
/begin CHARACTERISTIC K_LSHVK_T_KL15_MAX "max. Heizdauer bei KL15 an | EN: max. Heizdauer bei KL15 an" VALUE 0x74F34 TKW_VV_VV_UW 100.0 FORMULA_0021 0.0 655.0000 FORMAT "%5.2" /end CHARACTERISTIC
/begin CHARACTERISTIC K_LSHVK_TABG_HYS "Hysterese Abgastemperatur" VALUE 0x74F36 TKW_VV_VV_SW 100.0 FORMULA_0800 -1000.0000 1250.0000 FORMAT "%4.1" /end CHARACTERISTIC
/begin CHARACTERISTIC K_LSHVK_TEMP_FILT_TAU "" VALUE 0x74F38 TKW_VV_VV_UW 100.0 FORMULA_0755 0.0 255.9960 FORMAT "%5.2" /end CHARACTERISTIC
/begin CHARACTERISTIC K_LSHVK_REG_K "Verstaerkungsfaktor PI-Regler | EN: Verstaerkungsfaktor PI -Regler" VALUE 0x74F3A TKW_VV_VV_UW 100.0 FORMULA_0958 0.0 1.0000 FORMAT "%5.2" /end CHARACTERISTIC
/begin CHARACTERISTIC K_LSHVK_REG_TN "Nachstellzeit PI-Regler | EN: Nachstellzeit PI-Regler" VALUE 0x74F3C TKW_VV_VV_UW 100.0 FORMULA_0062 1.0000 65535.0000 /end CHARACTERISTIC
/begin CHARACTERISTIC K_LSHVK_TV_KORR_MIN "min. Tastverhaeltnis VKAT | EN: min. Tastverhaeltnis VKAT" VALUE 0x74F3E TKW_VV_VV_UW 100.0 FORMULA_0946 0.0 99.9500 FORMAT "%5.2" /end CHARACTERISTIC
/begin CHARACTERISTIC K_LSHVK_UB_NORM "Normbordspannung | EN: Normbordspannung" VALUE 0x74F40 TKW_VV_VV_UW 100.0 FORMULA_0008 0.0 25.0000 FORMAT "%4.1" /end CHARACTERISTIC
/begin CHARACTERISTIC K_LSHVK_UB_MAX "max. Bordspannung | EN: max. Bordspannung" VALUE 0x74F42 TKW_VV_VV_UW 100.0 FORMULA_0008 0.0 25.0000 FORMAT "%4.1" /end CHARACTERISTIC
/begin CHARACTERISTIC K_LSHVK_UEFF_GRAD "Effektivspannungsgradient | EN: Effektivspannungsgradient" VALUE 0x74F44 TKW_VV_VV_UW 100.0 FORMULA_0959 0.0 25.0000 FORMAT "%4.1" /end CHARACTERISTIC
/begin CHARACTERISTIC K_LSHVK_TEMP_MAX "max. Sondentemperatur | EN: Maximum sensor temperature [°C]" VALUE 0x74F46 TKW_VV_VV_SW 100.0 FORMULA_0791 -50.0000 1250.0000 /end CHARACTERISTIC
/begin CHARACTERISTIC K_LSHVK_TEMP_MIN "min. Sondentemperatur | EN: Minimum sensor temperature [°C]" VALUE 0x74F48 TKW_VV_VV_SW 100.0 FORMULA_0791 -50.0000 1250.0000 /end CHARACTERISTIC
/begin CHARACTERISTIC K_LSHVK_TEMP_REG_MIN "min. Sondentemperatur f. REG-Aktivierung | EN: Minimum sensor temperature for controller activation [°C]" VALUE 0x74F4A TKW_VV_VV_SW 100.0 FORMULA_0791 -50.0000 1250.0000 /end CHARACTERISTIC
/begin CHARACTERISTIC K_LSHVK_TEMP_DIF_ZUL "zulaessige Temp-Differenz | EN: Permitted temperature difference [°C]" VALUE 0x74F4C TKW_VV_VV_SW 100.0 FORMULA_0791 -50.0000 1250.0000 /end CHARACTERISTIC
/begin CHARACTERISTIC K_LSHVK_TEMP_IST_SCHW "Umschalttemperatur f. Filterkonstante | EN: Switchover temperature for filter constant [°C]" VALUE 0x74F4E TKW_VV_VV_SW 100.0 FORMULA_0791 -50.0000 1250.0000 /end CHARACTERISTIC
/begin CHARACTERISTIC K_LSHVK_RI_RANGE_SCHW "Umschalttemperatur ATIC42 zwischen Range1/2 Ri-Messung | EN: ATIC42 switchover temperature between range 1/2 Ri measurement [°C]" VALUE 0x74F50 TKW_VV_VV_SW 100.0 FORMULA_0791 -50.0000 1250.0000 /end CHARACTERISTIC
/begin CHARACTERISTIC K_LSHVK_TEMP_IST_ENABLE_IP_LOOP "Einschalttemperatur ATIC42 IP Control loop | EN: Switch-on temperature for ATIC42 IP control loop [°C]" VALUE 0x74F52 TKW_VV_VV_SW 100.0 FORMULA_0791 -50.0000 1250.0000 /end CHARACTERISTIC
/begin CHARACTERISTIC K_LSHVK_DIAG_CFG "Freigabe d. elektrischen Diag. LSH-VKAT" VALUE 0x74F54 TKW_VV_VV_UB 100.0 FORMULA_0839 0.0 1.0 /end CHARACTERISTIC
/begin CHARACTERISTIC K_LSHVK_DIAG_TEMP_IST_MIN "min. Sondentemperatur fuer LSHVK-Diag. | EN: Minimum sensor temperature for pre-cat heater diagnosis [°C]" VALUE 0x74F56 TKW_VV_VV_SW 100.0 FORMULA_0791 -50.0000 1250.0000 /end CHARACTERISTIC
/begin CHARACTERISTIC K_LSHVK_DIAG_TEMP_IST_MAX "max. Sondentemperatur fuer LSHVK-Diag. | EN: Maximum sensor temperature for pre-cat heater diagnosis [°C]" VALUE 0x74F58 TKW_VV_VV_SW 100.0 FORMULA_0791 -50.0000 1250.0000 /end CHARACTERISTIC
/begin CHARACTERISTIC K_LSHVK_DIAG_R_TAU "Zeitkonstante zur Mittelung VKAT | EN: Time constant for pre-cat averaging [s]" VALUE 0x74F5A TKW_VV_VV_UB 100.0 FORMULA_0683 0.1004 25.6000 /end CHARACTERISTIC
/begin CHARACTERISTIC K_LSHVK_DIAG_RO "obere VKAT-Widerstandsschwelle | EN: Upper pre-cat resistance threshold [Ohm] [V912: differs from V452 160E]" VALUE 0x74F5C TKW_VV_VV_UW 100.0 FORMULA_0537 0.0 6553.5000 FORMAT "%4.1" /end CHARACTERISTIC
/begin CHARACTERISTIC K_LSHVK_DIAG_RU "untere VKAT-Widerstandsschwelle | EN: Lower pre-cat resistance threshold [Ohm]" VALUE 0x74F5E TKW_VV_VV_UW 100.0 FORMULA_0537 0.0 6553.5000 FORMAT "%4.1" /end CHARACTERISTIC
/begin CHARACTERISTIC K_LSHVK_DIAG_R_OFFSET "LSHVK-Heizleistungs-Diagnoseoffset | EN: Pre-cat heater power diagnosis offset [Ohm]" VALUE 0x74F60 TKW_VV_VV_UW 100.0 FORMULA_0537 0.0 6553.5000 FORMAT "%4.1" /end CHARACTERISTIC
/begin CHARACTERISTIC K_LSHVK_DIAG_R_ADAPT "INIT-Wert der R-Adption | EN: Initial value of resistance adaptation [Ohm]" VALUE 0x74F62 TKW_VV_VV_UW 100.0 FORMULA_0537 0.0 6553.5000 FORMAT "%4.1" /end CHARACTERISTIC
/begin CHARACTERISTIC K_LSHVK_DIAG_ANZ_MESS "Anzahl gueltiger Messungen | EN: Number of valid measurements [V912: differs from V452 160E]" VALUE 0x74F64 TKW_VV_VV_UW 100.0 FORMULA_0010 0.0 65535.0000 /end CHARACTERISTIC
/begin CHARACTERISTIC K_LSRVK_OBD_CFG "Freigabe Sondeninnenwiderstandsdiag. LSH-VKAT" VALUE 0x74F66 TKW_VV_VV_UB 100.0 FORMULA_0839 0.0 1.0 /end CHARACTERISTIC
/begin CHARACTERISTIC K_LSRVK_OBD_ML_SUM "min. aufsummierte Luftmassenstr. nach SA_WE | EN: Minimum summed air mass flow after start [mg]" VALUE 0x74F68 TKW_VV_VV_UW 100.0 FORMULA_0832 0.0 65535.0000 /end CHARACTERISTIC
/begin CHARACTERISTIC K_LSRVK_OBD_TKAT_MIN "min. KAT-Temperatur f. LSRVK-OBD-Diag. | EN: Minimum catalyst temperature for pre-cat sensor OBD diagnosis [°C]" VALUE 0x74F6A TKW_VV_VV_SW 100.0 FORMULA_0023 -50.0000 1200.0000 FORMAT "%4.1" /end CHARACTERISTIC
/begin CHARACTERISTIC K_LSRVK_OBD_TKAT_MAX "max. KAT-Temperatur f. LSRVK-OBD-Diag. | EN: Maximum catalyst temperature for pre-cat sensor OBD diagnosis [°C]" VALUE 0x74F6C TKW_VV_VV_SW 100.0 FORMULA_0023 -50.0000 1200.0000 FORMAT "%4.1" /end CHARACTERISTIC
/begin CHARACTERISTIC K_LSRVK_OBD_REG_T "Diag.zeit fuer d. max. Anschlagszeit d. Heizungsreglers | EN: Diagnosis time for maximum end-stop time of heater controller [s]" VALUE 0x74F6E TKW_VV_VV_UW 100.0 FORMULA_0062 0.0 65535.0000 /end CHARACTERISTIC
/begin CHARACTERISTIC K_LSRVK_OBD_START_R "max. Ri-Schwelle f. Diag. nach Motorstart | EN: Maximum Ri threshold for diagnosis after engine start" VALUE 0x74F70 TKW_VV_VV_UW 100.0 FORMULA_0945 0.0 5000.0000 /end CHARACTERISTIC
/begin CHARACTERISTIC K_LSHVK_AD_TEST "Umschaltung d. Sonden-Ri-Adaption" VALUE 0x74F72 TKW_VV_VV_UW 100.0 FORMULA_0782 0.0 1.0 FORMAT "%5.2" /end CHARACTERISTIC
/begin CHARACTERISTIC K_LSHVK_R_AD_RESET "RESET d. Sonden-Ri-Adaption" VALUE 0x74F74 TKW_VV_VV_UW 100.0 FORMULA_0784 0.0 1.0 FORMAT "%5.2" /end CHARACTERISTIC
/begin CHARACTERISTIC K_LSHVK_R_REF "Referenzspannung Ri | EN: Ri reference voltage [mV]" VALUE 0x74F76 TKW_VV_VV_UW 100.0 FORMULA_0532 0.0 5000.0000 /end CHARACTERISTIC
/begin CHARACTERISTIC K_LSHVK_R_REF_OFFS "Referenzspannung Ri fuer OFFSET-Adaption | EN: Ri reference voltage for offset adaptation [mV]" VALUE 0x74F78 TKW_VV_VV_UW 100.0 FORMULA_0532 0.0 5000.0000 /end CHARACTERISTIC
/begin CHARACTERISTIC K_LSHVK_R_AD_OFFS_CNT_MIN "MIN-Zaehler fuer OFFSET-Sonden-Ri-Adaption | EN: Minimum counter for sensor Ri offset adaptation" VALUE 0x74F7A TKW_VV_VV_UW 100.0 FORMULA_0010 0.0 65535.0000 /end CHARACTERISTIC
/begin CHARACTERISTIC K_LSHVK_R_AD_OFFS_CNT "Zaehler fuer OFFSET-Sonden-Ri-Adaption | EN: Counter for sensor Ri offset adaptation" VALUE 0x74F7C TKW_VV_VV_UW 100.0 FORMULA_0010 0.0 65535.0000 /end CHARACTERISTIC
/begin CHARACTERISTIC K_LSHVK_R_AD_GAIN_CNT_MIN "MIN-Zaehler fuer GAIN-Sonden-Ri-Adaption | EN: Minimum counter for sensor Ri gain adaptation" VALUE 0x74F7E TKW_VV_VV_UW 100.0 FORMULA_0010 0.0 65535.0000 /end CHARACTERISTIC
/begin CHARACTERISTIC K_LSHVK_R_AD_GAIN_CNT "Zaehler fuer GAIN-Sonden-Ri-Adaption | EN: Counter for sensor Ri gain adaptation" VALUE 0x74F80 TKW_VV_VV_UW 100.0 FORMULA_0010 0.0 65535.0000 /end CHARACTERISTIC
/begin CHARACTERISTIC K_LSHVK_R_AD_OFFS_T "MIN-Zeit zwischen zwei OFFSET-Adapt. | EN: Minimum time between two offset adaptations [s]" VALUE 0x74F82 TKW_VV_VV_UW 100.0 FORMULA_0021 0.0 655.0000 FORMAT "%5.2" /end CHARACTERISTIC
/begin CHARACTERISTIC K_LSHVK_R_AD_GAIN_T "MIN-Zeit zwischen zwei GAIN-Adapt. | EN: Minimum time between two gain adaptations [s]" VALUE 0x74F84 TKW_VV_VV_UW 100.0 FORMULA_0021 0.0 655.0000 FORMAT "%5.2" /end CHARACTERISTIC
/begin CHARACTERISTIC K_LSHVK_R_AD_OFFS_T1 "Filterkoeffizient - OFFSET-Sonden-Ri-Adapt. | EN: Filter coefficient - sensor Ri offset adaptation" VALUE 0x74F86 TKW_VV_VV_UW 100.0 FORMULA_0960 0.0 6553500.0000 /end CHARACTERISTIC
/begin CHARACTERISTIC K_LSHVK_R_AD_GAIN_T1 "Filterkoeffizient - GAIN-Sonden-Ri-Adapt. | EN: Filter coefficient - sensor Ri gain adaptation" VALUE 0x74F88 TKW_VV_VV_UW 100.0 FORMULA_0960 0.0 6553500.0000 /end CHARACTERISTIC
/begin CHARACTERISTIC K_LSHVK_R_AD_OFFS_MIN "MIN-Schwelle f. Offset-Sonden-Ri-Adapt. | EN: Minimum threshold for sensor Ri offset adaptation [mV]" VALUE 0x74F8A TKW_VV_VV_SW 100.0 FORMULA_0532 -2500.0000 2500.0000 /end CHARACTERISTIC
/begin CHARACTERISTIC K_LSHVK_R_AD_OFFS_MAX "MAX-Schwelle f. Offset-Sonden-Ri-Adapt. | EN: Maximum threshold for sensor Ri offset adaptation [mV]" VALUE 0x74F8C TKW_VV_VV_SW 100.0 FORMULA_0532 -2500.0000 2500.0000 /end CHARACTERISTIC
/begin CHARACTERISTIC K_LSHVK_R_AD_GAIN_MIN "MIN-Schwelle f. GAIN-Sonden-Ri-Adapt. | EN: Minimum threshold for sensor Ri gain adaptation [mV]" VALUE 0x74F8E TKW_VV_VV_UW 100.0 FORMULA_0532 0.0 5000.0000 /end CHARACTERISTIC
/begin CHARACTERISTIC K_LSHVK_R_AD_GAIN_MAX "MAX-Schwelle f. GAIN-Sonden-Ri-Adapt. | EN: Maximum threshold for sensor Ri gain adaptation [mV]" VALUE 0x74F90 TKW_VV_VV_UW 100.0 FORMULA_0532 0.0 5000.0000 /end CHARACTERISTIC
/begin CHARACTERISTIC K_LSHVK_R_AD_OFFS_GRAD "max. OFFEST-Gradient | EN: Maximum offset gradient [mV]" VALUE 0x74F92 TKW_VV_VV_UW 100.0 FORMULA_0532 0.0 5000.0000 /end CHARACTERISTIC
/begin CHARACTERISTIC K_LSHVK_R_AD_GAIN_GRAD "max. GAIN-Gradient | EN: Maximum gain gradient" VALUE 0x74F94 TKW_VV_VV_UW 100.0 FORMULA_0075 0.0 4.0000 FORMAT "%6.3" /end CHARACTERISTIC
/begin CHARACTERISTIC K_LSRVK_OBD_REF_GAIN_MIN "min. GAIN-Ri-Schwelle - Referenzwiderstandsdiag. | EN: Minimum gain Ri threshold - reference current diagnosis" VALUE 0x74F96 TKW_VV_VV_UW 100.0 FORMULA_0075 0.0 4.0000 FORMAT "%6.3" /end CHARACTERISTIC
/begin CHARACTERISTIC K_LSRVK_OBD_REF_GAIN_MAX "max. GAIN-Ri-Schwelle - Referenzwiderstandsdiag. | EN: max. GAIN -Ri-Schwelle - Referenzstromdiag." VALUE 0x74F98 TKW_VV_VV_UW 100.0 FORMULA_0075 0.0 4.0000 FORMAT "%6.3" /end CHARACTERISTIC
/begin CHARACTERISTIC K_LSRVK_OBD_REF_CNT "Schwelle LA-Ri-GAIN-Ermittlungen f. Referenzwiderstandsdiagnose | EN: Schwelle LA- Ri-GAIN- Ermittlungen f. Referen z- stromdiagnose" VALUE 0x74F9A TKW_VV_VV_UW 100.0 FORMULA_0010 0.0 65535.0000 /end CHARACTERISTIC
/begin CHARACTERISTIC K_LSRVK_OBD_REF_OFFS_MAX "max. OFFSET-Ri-Schwelle - Referenzwiderstandsdiag. | EN: max. OFFSET -Ri- Schwelle - Referenzstromdiag." VALUE 0x74F9C TKW_VV_VV_SW 100.0 FORMULA_0532 -5000.0000 5000.0000 /end CHARACTERISTIC
/begin CHARACTERISTIC K_LSRVK_OBD_REF_OFFS_MIN "min. OFFSET-Ri-Schwelle - Referenzwiderstandsdiag. | EN: min. OFFSET-Ri-Schwelle - Referenzstromdiag." VALUE 0x74F9E TKW_VV_VV_SW 100.0 FORMULA_0532 -5000.0000 5000.0000 /end CHARACTERISTIC
/begin CHARACTERISTIC K_LSRVK_OBD_REF_OFFS_CNT "Schwelle LA-Ri-OFFSET-Ermittlungen f. Referenzwiderstandsdiagnose | EN: Schwelle LA-Ri-OFFSET-Ermittlungen f. Referenzwiderstandsdiagnose" VALUE 0x74FA0 TKW_VV_VV_UW 100.0 FORMULA_0010 0.0 65535.0000 /end CHARACTERISTIC
/begin CHARACTERISTIC K_LSH_UB_TAU "Zeitkonstante LSH-UB | EN: Zeitkonstante LSH-UB" VALUE 0x74FA2 TKW_VV_VV_UB 100.0 FORMULA_0683 0.1004 25.6000 /end CHARACTERISTIC
/begin CHARACTERISTIC K_LSHVK_R_AD_OFFS_NV_MAX "max. Grenze fuer OFFEST-Sonden-Ri-Adapt. | EN: max. Grenze fuer OFFEST -Sonden-Ri-Adapt." VALUE 0x74FA4 TKW_VV_VV_SW 100.0 FORMULA_0532 -5000.0000 5000.0000 /end CHARACTERISTIC
/begin CHARACTERISTIC K_LSHVK_R_AD_OFFS_NV_MIN "min. Grenze fuer OFFEST-Sonden-Ri-Adapt. | EN: min. Grenze fuer OFFEST -Sonden-Ri-Adapt." VALUE 0x74FA6 TKW_VV_VV_SW 100.0 FORMULA_0532 -5000.0000 5000.0000 /end CHARACTERISTIC
/begin CHARACTERISTIC K_LSHVK_R_AD_GAIN_NV_MAX "max. Grenze fuer GAIN-Sonden-Ri-Adapt. | EN: max. Grenze fuer GAIN -Sonden-Ri-Adapt." VALUE 0x74FA8 TKW_VV_VV_UW 100.0 FORMULA_0075 0.0 4.0000 FORMAT "%6.3" /end CHARACTERISTIC
/begin CHARACTERISTIC K_LSHVK_R_AD_GAIN_NV_MIN "min. Grenze fuer GAIN-Sonden-Ri-Adapt. | EN: min. Grenze fuer GAIN -Sonden-Ri-Adapt." VALUE 0x74FAA TKW_VV_VV_UW 100.0 FORMULA_0075 0.0 4.0000 FORMAT "%6.3" /end CHARACTERISTIC
/begin CHARACTERISTIC K_LSHVK_WSS_CFG "Wasserschlag-Konfiguration" VALUE 0x74FAC TKW_VV_VV_UW 100.0 FORMULA_0961 0.0 65535.0 FORMAT "%5.2" /end CHARACTERISTIC
/begin CHARACTERISTIC KL_LSHVK_TEMP_IST_HIGH "IST-Temp. d. Sonde | EN: Actual sensor temperature" CURVE 0x74FAE TKL_UW_VV_SW 100.0 FORMULA_0791 -50.0000 1250.0000 /begin AXIS_DESCR STD_AXIS lshvk_r_mess_korr FORMULA_0945 16 0.0 5000.0000 /end AXIS_DESCR /end CHARACTERISTIC
/begin CHARACTERISTIC KL_LSHVK_TEMP_IST_LOW "IST-Temp. d. Sonde m. Range 2 ATIC 42 | EN: Actual sensor temperature with ATIC42 range 2" CURVE 0x74FF0 TKL_UW_VV_SW 100.0 FORMULA_0791 -50.0000 1250.0000 /begin AXIS_DESCR STD_AXIS lshvk_r_mess_korr FORMULA_0945 16 0.0 5000.0000 /end AXIS_DESCR /end CHARACTERISTIC
/begin CHARACTERISTIC KL_LSHVK_TEMP_SOLL_MS "SOLL-Temp. bei Motor steht | EN: Target sensor temperature with engine stopped" CURVE 0x75032 TKL_SW_VV_SW 100.0 FORMULA_0791 -50.0000 1250.0000 /begin AXIS_DESCR STD_AXIS FORMULA_0023 6 -50.0000 170.0000 FORMAT "%4.1" /end AXIS_DESCR /end CHARACTERISTIC
/begin CHARACTERISTIC KL_LSHVK_R_MESS_F "Adapt.Faktor Sonde | EN: Sensor adaptation factor" CURVE 0x7504C TKL_UW_VV_UW 100.0 FORMULA_0962 0.0 1.9999 /begin AXIS_DESCR STD_AXIS Abgasbank FORMULA_0010 2 1.0000 2.0000 /end AXIS_DESCR /end CHARACTERISTIC
/begin CHARACTERISTIC KL_LSHVK_R_MESS_OFFS "Adapt.Offset Sonde | EN: Sensor adaptation offset" CURVE 0x75056 TKL_UW_VV_SW 100.0 FORMULA_0945 -160000.0000 159995.1171 /begin AXIS_DESCR STD_AXIS Abgasbank FORMULA_0010 2 1.0000 2.0000 /end AXIS_DESCR /end CHARACTERISTIC
/begin CHARACTERISTIC KL_LSHVK_SOND_TEMP "VKAT-Sondentemperatur ueber Heizerwiderstand | EN: Pre-cat sensor temperature from heater resistance" CURVE 0x75060 TKL_UW_VV_SW 100.0 FORMULA_0023 -50.0000 1250.0000 /begin AXIS_DESCR STD_AXIS lshvk_r FORMULA_0537 8 0.0 100.0000 FORMAT "%4.1" /end AXIS_DESCR FORMAT "%4.1" /end CHARACTERISTIC
/begin CHARACTERISTIC KL_LSRVK_OBD_START_TML "Zeit, bis VKAT-Arbeitstemperatur erreicht [V912: differs from V452 160E]" CURVE 0x75082 TKL_SW_VV_UW 100.0 FORMULA_0021 0.0 655.0000 /begin AXIS_DESCR STD_AXIS FORMULA_0023 4 -50.0000 170.0000 FORMAT "%4.1" /end AXIS_DESCR FORMAT "%5.2" /end CHARACTERISTIC
/begin CHARACTERISTIC KL_LSHVK_UEFF_MAX "max. eff. Heizerspannung | EN: Maximum effective heater voltage" CURVE 0x75094 TKL_SW_VV_UW 100.0 FORMULA_0008 0.0 25.0000
 /begin AXIS_DESCR STD_AXIS tabg_vkat FORMULA_0023 6 -50.0000 1250.0000 FORMAT "%4.1" /end AXIS_DESCR
 FORMAT "%4.1" /end CHARACTERISTIC
/begin CHARACTERISTIC KL_LSHVK_DIAG_TIME_ML "Verzoegerungszeit nach Startende | EN: Verzoegerungszeit nach Startende [V912: differs from V452 160E]" CURVE 0x750AE TKL_SW_VV_UW 100.0 FORMULA_0021 0.0 655.3500 /begin AXIS_DESCR STD_AXIS FORMULA_0023 4 -50.0000 170.0000 FORMAT "%4.1" /end AXIS_DESCR FORMAT "%5.2" /end CHARACTERISTIC
/begin CHARACTERISTIC KL_LSRVK_OBD_TML "Verzoegerungszeit nach Startende [V912: differs from V452 160E]" CURVE 0x750C0 TKL_SW_VV_UW 100.0 FORMULA_0021 0.0 655.0000 /begin AXIS_DESCR STD_AXIS FORMULA_0023 4 -50.0000 170.0000 FORMAT "%4.1" /end AXIS_DESCR FORMAT "%5.2" /end CHARACTERISTIC
/begin CHARACTERISTIC KF_LSHVK_TV_VORST "Vorsteuertastverhaeltnis LSHVK | EN: Pre-control duty cycle, pre-cat sensor heater" MAP 0x750D2 TKF_SW_SW_UW 100.0 FORMULA_0946 0.0 99.9500
 /begin AXIS_DESCR STD_AXIS tabg FORMULA_0023 6 -50.0000 1250.0000 FORMAT "%4.1" /end AXIS_DESCR
 /begin AXIS_DESCR STD_AXIS lshvk_temp_soll FORMULA_0791 6 -50.0000 1250.0000 /end AXIS_DESCR
 FORMAT "%5.2" /end CHARACTERISTIC
/begin CHARACTERISTIC KF_LSHVK_TV_KORR_MAX "max. Tastverhaeltnis VKAT | EN: Maximum duty cycle, pre-cat sensor heater" MAP 0x75134 TKF_SW_SW_UW 100.0 FORMULA_0946 0.0 99.9500 /begin AXIS_DESCR STD_AXIS FORMULA_0021 6 0.0 327.0000 FORMAT "%5.2" /end AXIS_DESCR /begin AXIS_DESCR STD_AXIS FORMULA_0008 6 0.0 28.0000 FORMAT "%4.1" /end AXIS_DESCR FORMAT "%5.2" /end CHARACTERISTIC
/begin CHARACTERISTIC KF_LSHVK_TEMP_SOLL "SOLL-Temp. bei Motor laeuft [V912: differs from V452 160E]" MAP 0x75196 TKF_SW_SW_SW 100.0 FORMULA_0791 -50.0000 1250.0000
 /begin AXIS_DESCR STD_AXIS tabg_hys-tmot_start FORMULA_0023 10 -50.0000 1250.0000 FORMAT "%4.1" /end AXIS_DESCR
 /begin AXIS_DESCR STD_AXIS FORMULA_0021 10 0.0 327.0000 FORMAT "%5.2" /end AXIS_DESCR
/end CHARACTERISTIC
/* ------------------ Abschnitt erzeugt aus pksr.dat ------------------ */
/begin CHARACTERISTIC K_PKS_OBD_SOLL_DYN_TAU "Filterkonstante fuer Kraftstoffpumpen-Solldruck | EN: Filterkonstante fuer Kraf t-stoffpumpen-Solldruck" VALUE 0x75FF4 TKW_VV_VV_UB 100.0 FORMULA_0664 0.0101 2.5600 /end CHARACTERISTIC
/begin CHARACTERISTIC K_PKSR_P_SSP_SA "Kraftstoffdruck an SSPs bei SA | EN: bar 0 3 x/1000 Kraftstoffdruck an SSPs bei SA" VALUE 0x75FF6 TKW_VV_VV_SW 100.0 FORMULA_0118 0.0 10.0000 FORMAT "%6.3" /end CHARACTERISTIC
/begin CHARACTERISTIC K_PKSR_PSOLL_MECH "Kraftstoffsolldruck des mechanischen Druckreglers | EN: bar 0 3 x/1000 Kraftstoffsolldruck des m e-chanischen Druckreglers" VALUE 0x75FF8 TKW_VV_VV_SW 100.0 FORMULA_0118 0.0 10.0000 FORMAT "%6.3" /end CHARACTERISTIC
/begin CHARACTERISTIC K_PKSR_I_ANTEIL_MIN "I-Anteil Min-Wert | EN: % -50p 1 (X*100)/1024 I-Anteil Min-Wert" VALUE 0x75FFA TKW_VV_VV_SW 100.0 FORMULA_0840 -50.0000 50.0000 FORMAT "%4.1" /end CHARACTERISTIC
/begin CHARACTERISTIC K_PKSR_I_ANTEIL_MAX "I-Anteil Max-Wert | EN: % -50p 1 (X*100)/1024 I-Anteil Max-Wert" VALUE 0x75FFC TKW_VV_VV_SW 100.0 FORMULA_0840 -50.0000 50.0000 FORMAT "%4.1" /end CHARACTERISTIC
/begin CHARACTERISTIC K_PKSR_TMIN_EKP2 "Mindesteinschaltzeit d. EKP2 | EN: s 0p 2 X/100 Mindesteinschaltzeit d. EKP2" VALUE 0x75FFE TKW_VV_VV_SW 100.0 FORMULA_0021 0.0 10.0000 FORMAT "%5.2" /end CHARACTERISTIC
/begin CHARACTERISTIC K_PKSR_N_EKP2 "Einschaltschwelle Motordrehzahl f. EKP2 | EN: Upm 0p 0 x Einschaltschwelle Motordreh-zahl f. EKP2" VALUE 0x76000 TKW_VV_VV_SW 100.0 FORMULA_0006 0.0 10000.0000 /end CHARACTERISTIC
/begin CHARACTERISTIC K_PKSR_N_HYS_EKP2 "Hysterese Motordrehzahl f. Ein-/Ausschalten der EKP2 | EN: Upm 0p 0 x Hysterese Motordrehzahl f. Ein-/Ausschalten der EKP2" VALUE 0x76002 TKW_VV_VV_SW 100.0 FORMULA_0006 0.0 10000.0000 /end CHARACTERISTIC
/begin CHARACTERISTIC K_PKSR_MLSOLL_EKP2 "Einschaltschwelle Fuellungsvorgabe f. EKP2 | EN: kg/h -100p 1 x/10 Einschaltschwelle Fuellung s-vorgabe f. EKP2" VALUE 0x76004 TKW_VV_VV_SW 100.0 FORMULA_0112 -100.0000 1400.0000 FORMAT "%4.1" /end CHARACTERISTIC
/begin CHARACTERISTIC K_PKSR_MLSOLL_HYS_EKP2 "Hysterese Fuellungsvorgabe f. Ein-/Ausschalten der EKP2 | EN: kg/h -100p 1 x/10 Hysterese Fuellungsvorgabe f. Ein-/Ausschalten der EKP2" VALUE 0x76006 TKW_VV_VV_SW 100.0 FORMULA_0112 -100.0000 1400.0000 FORMAT "%4.1" /end CHARACTERISTIC
/begin CHARACTERISTIC K_PKSR_CFG "Konfiguration Kraftstoffdruckregelung | EN: pksr_cfg.equ Konfiguration Kraftstoffdruc k-regelung" VALUE 0x76008 TKW_VV_VV_UB 100.0 FORMULA_1046 0.0 255.0 /end CHARACTERISTIC
/begin CHARACTERISTIC K_PKSR_EKP_100_PSOLL_RAMPE "Delta fuer Rampe nach EKP_100Prozent auf Sollwert | EN: Delta fuer Rampe nach EKP_100Prozent auf Sollwert" VALUE 0x76009 TKW_VV_VV_UB 100.0 FORMULA_1041 0.0 10.0000 /end CHARACTERISTIC
/begin CHARACTERISTIC K_PKSR_TV_DIAG "vorerst Ersatz f. Diagnose: auszugebender TV-Wert" VALUE 0x7600A TKW_VV_VV_SW 100.0 FORMULA_0840 0.0 100.0000 FORMAT "%4.1" /end CHARACTERISTIC
/begin CHARACTERISTIC K_PKSR_DIAG "Diagnosebedingung f. Kraftstoffdruckregelung setzen" VALUE 0x7600C TKW_VV_VV_UB 100.0 FORMULA_1047 0.0 255.0 /end CHARACTERISTIC
/begin CHARACTERISTIC K_PKSR_T_VORLAUF "Vorlaufzeit der EKP bei KL15 EIN | EN: Vorlaufzeit der EKP bei KL15 EIN" VALUE 0x7600E TKW_VV_VV_UW 100.0 FORMULA_0021 0.0 655.0000 FORMAT "%5.2" /end CHARACTERISTIC
/begin CHARACTERISTIC K_PKSR_T_ABST "Nachlauf nach KLA | EN: Nachlauf nach KLA" VALUE 0x76010 TKW_VV_VV_UW 100.0 FORMULA_0021 0.0 655.0000 FORMAT "%5.2" /end CHARACTERISTIC
/begin CHARACTERISTIC K_PKSR_PERIOD "Periodendauer der EKP-PWM | EN: Period of the fuel-pump PWM [ms]" VALUE 0x76012 TKW_VV_VV_UW 100.0 FORMULA_1048 1.0000 65.0000 FORMAT "%4.1" /end CHARACTERISTIC
/begin CHARACTERISTIC K_PKSR_ADAP_DELTA_OFF "PKSR-Adaptions Offset increment/decrement | EN: PKSR-Adaptions Offset i n-crement/decrement" VALUE 0x76014 TKW_VV_VV_SW 100.0 FORMULA_0555 0.0 1.0000 FORMAT "%6.3" /end CHARACTERISTIC
/begin CHARACTERISTIC K_PKSR_ADAP_OFF_ML_MAX "ML Schwelle fuer Offset Adaption aus" VALUE 0x76016 TKW_VV_VV_SW 100.0 FORMULA_0112 -100.0000 1400.0000 FORMAT "%4.1" /end CHARACTERISTIC
/begin CHARACTERISTIC K_PKSR_ADAP_OFF_N_MAX "n Schwelle fuer Offset Adaption aus" VALUE 0x76018 TKW_VV_VV_SW 100.0 FORMULA_0006 0.0 10000.0000 /end CHARACTERISTIC
/begin CHARACTERISTIC K_PKSR_ADAP_OFF_N_NORM "n Normierungswert fuer Verhaeltnis" VALUE 0x7601A TKW_VV_VV_SW 100.0 FORMULA_0006 0.0 10000.0000 /end CHARACTERISTIC
/begin CHARACTERISTIC K_PKSR_ADAP_DELTA_FAK "PKSR-Adaptionsfaktor inc/-decrement" VALUE 0x7601C TKW_VV_VV_SW 100.0 FORMULA_1049 0.0 3.2000 FORMAT "%7.4" /end CHARACTERISTIC
/begin CHARACTERISTIC K_PKSR_ADAP_FAK_ML_MIN "ml Schwelle fuer Faktor-Adaption ein | EN: ml Schwelle fuer Faktor -Adaption ein" VALUE 0x7601E TKW_VV_VV_SW 100.0 FORMULA_0112 -100.0000 1400.0000 FORMAT "%4.1" /end CHARACTERISTIC
/begin CHARACTERISTIC K_PKSR_ADAP_FAK_N_MIN "n Schwelle fuer Faktor-Adaption ein" VALUE 0x76020 TKW_VV_VV_SW 100.0 FORMULA_0006 0.0 10000.0000 /end CHARACTERISTIC
/begin CHARACTERISTIC K_PKSR_ADAP_RESET "Reset der Adaption | EN: & 0x1 0x0 kein Reset 0x1 Reset aktiv Reset der Adaption" VALUE 0x76022 TKW_VV_VV_UB 100.0 FORMULA_1050 0.0 255.0 BIT_MASK 0x1 /end CHARACTERISTIC
/begin CHARACTERISTIC K_PKSR_ADAP_OFF_MAX "Max Adaptionsoffset | EN: Max Adaptionsoffset" VALUE 0x76024 TKW_VV_VV_SW 100.0 FORMULA_0555 0.0 15.0000 FORMAT "%6.3" /end CHARACTERISTIC
/begin CHARACTERISTIC K_PKSR_ADAP_OFF_MIN "Min Adaptionsoffset | EN: Min Adaptionsoffset" VALUE 0x76026 TKW_VV_VV_SW 100.0 FORMULA_0555 -15.0000 0.0 FORMAT "%6.3" /end CHARACTERISTIC
/begin CHARACTERISTIC K_PKSR_ADAP_FAK_MIN "Min Adaptionsfaktor | EN: Min Adaptionsfaktor" VALUE 0x76028 TKW_VV_VV_UW 100.0 FORMULA_0556 0.5000 1.0000 FORMAT "%7.4" /end CHARACTERISTIC
/begin CHARACTERISTIC K_PKSR_ADAP_FAK_MAX "Max Adaptionsfaktor | EN: Max Adaptionsfaktor" VALUE 0x7602A TKW_VV_VV_UW 100.0 FORMULA_0556 1.0000 2.0000 FORMAT "%7.4" /end CHARACTERISTIC
/begin CHARACTERISTIC K_PKSR_EXD_DELTA_TV "Schwelle fuer max. Abweichung der Vorsteuerung und Regler" VALUE 0x7602C TKW_VV_VV_SW 100.0 FORMULA_0840 0.0 20.0000 FORMAT "%4.1" /end CHARACTERISTIC
/begin CHARACTERISTIC K_PKSR_EXD_PDELTA_DR "Schwelle fuer min. Druckanstieg Oeff.beginn und Ende" VALUE 0x7602E TKW_VV_VV_SW 100.0 FORMULA_0118 0.0 2.0000 FORMAT "%6.3" /end CHARACTERISTIC
/begin CHARACTERISTIC K_PKSR_EXD_FSTLITH_MIN "Min.Schwelle fuer Fuelstand linke Tankhaelfte zu Diagnose" VALUE 0x76030 TKW_VV_VV_UB 100.0 FORMULA_0557 0.0 100.0000 /end CHARACTERISTIC
/begin CHARACTERISTIC K_PKSR_EXD_V_SSPLITH "Schwelle SSP Delta" VALUE 0x76031 TKW_VV_VV_UB 100.0 FORMULA_0557 0.0 100.0000 /end CHARACTERISTIC
/begin CHARACTERISTIC K_PKSR_EXD_DELTA_P_VL "Schwelle Druckabfall Vorlauf" VALUE 0x76032 TKW_VV_VV_SW 100.0 FORMULA_0118 0.0 5.0000 FORMAT "%6.3" /end CHARACTERISTIC
/begin CHARACTERISTIC K_PKSR_EXD_DELTA_P_VL_FE "Schwelle Druckabfall Vorlauf im Fertigungsmode | EN: Schwelle Druckabfall Vorlauf im Fertigungsmode" VALUE 0x76034 TKW_VV_VV_SW 100.0 FORMULA_0118 0.0 5.0000 FORMAT "%6.3" /end CHARACTERISTIC
/begin CHARACTERISTIC K_PKSR_EXD_EKP1_TV_MAX "Max. TV fuer EKP1 ohne EKP2 | EN: Max. TV fuer EKP1 ohne EKP2" VALUE 0x76036 TKW_VV_VV_SW 100.0 FORMULA_0840 0.0 100.0000 FORMAT "%4.1" /end CHARACTERISTIC
/begin CHARACTERISTIC K_PKSR_MAX_TV_GEREGELT "Max. TV fuer geregelten Betrieb | EN: % -100p 1 (x*100)/1024 Max. TV fuer geregelten B e-trieb" VALUE 0x76038 TKW_VV_VV_SW 100.0 FORMULA_0840 -100.0000 100.0000 FORMAT "%4.1" /end CHARACTERISTIC
/begin CHARACTERISTIC K_PKSR_EXD_TAU_PKS_PL "Filterkonstante fuer pks_rel Prueflauf" VALUE 0x7603A TKW_VV_VV_UB 100.0 FORMULA_0664 0.0101 2.5600 /end CHARACTERISTIC
/begin CHARACTERISTIC K_PKSR_EXD_TAU_PDIF_PL "Filterkonstante fuer pksr_exd_pdif delta" VALUE 0x7603B TKW_VV_VV_UB 100.0 FORMULA_0683 0.1004 25.6000 /end CHARACTERISTIC
/begin CHARACTERISTIC K_PKSR_EXD_PDIF_T_ADAP "Adaptionszeit Gradient Druckanstieg" VALUE 0x7603C TKW_VV_VV_UB 100.0 FORMULA_0458 0.0 25.5000 /end CHARACTERISTIC
/begin CHARACTERISTIC K_PKSR_EXD_P_GRAD_REL "Rel. Gradientenschwelle Erkennung DR-Oeffnungsbeginn" VALUE 0x7603D TKW_VV_VV_UB 100.0 FORMULA_1051 0.0 100.0000 /end CHARACTERISTIC
/begin CHARACTERISTIC K_PKSR_EXD_NMAX "N-MAX bei Prueflauf7 | EN: N-MAX bei Prueflauf7" VALUE 0x7603E TKW_VV_VV_SW 100.0 FORMULA_0006 0.0 10000.0000 /end CHARACTERISTIC
/begin CHARACTERISTIC K_PKSR_EKP_VORL_RESET "Reset fuer EKP Vorlaufsperre | EN: Reset fuer EKP Vorlaufsperre" VALUE 0x76040 TKW_VV_VV_UW 100.0 FORMULA_0600 0.0 120.0000 FORMAT "%5.2" /end CHARACTERISTIC
/begin CHARACTERISTIC K_PKSR_ADAP_DIAG_T "Zeit im Adationsanschlag bis Fehlereintrag | EN: Zeit im Adationsanschlag bis Fehlereintrag" VALUE 0x76042 TKW_VV_VV_UW 100.0 FORMULA_0062 0.0 120.0000 /end CHARACTERISTIC
/begin CHARACTERISTIC K_PKSR_EXD_TV_65 "TV bei fuer Ermittlung Druckabfall | EN: TV bei fuer Ermittlung Druc k-abfall" VALUE 0x76044 TKW_VV_VV_SW 100.0 FORMULA_0840 -100.0000 100.0000 FORMAT "%4.1" /end CHARACTERISTIC
/begin CHARACTERISTIC KL_PKSR_QSSP_PKS "Volumenstrom SSPs �ber Istdruck (rel.) | EN: Volume flow of jet pumps vs pressure" CURVE 0x76058 TKL_SW_VV_SW 100.0 FORMULA_0746 0.0 250.0000 /begin AXIS_DESCR STD_AXIS FORMULA_0118 5 0.0 10.0000 FORMAT "%6.3" /end AXIS_DESCR FORMAT "%4.1" /end CHARACTERISTIC
/begin CHARACTERISTIC KL_PKSR_P_FAKTOR "P-Faktor ueber Druckabweichung | EN: P-factor vs pressure deviation (map over volume flow in V762)" CURVE 0x7606E TKL_SW_VV_UW 100.0 FORMULA_1052 0.0 500.0000
 /begin AXIS_DESCR STD_AXIS p_diff FORMULA_0118 5 -10.0000 10.0000 FORMAT "%6.3" /end AXIS_DESCR
 FORMAT "%4.1" /end CHARACTERISTIC
/begin CHARACTERISTIC KL_PKSR_I_FAKTOR "I-Faktor �ber Druckabweichung | EN: I-factor vs pressure deviation (map over volume flow in V762)" CURVE 0x76084 TKL_SW_VV_UW 100.0 FORMULA_1053 0.0 1000.0000
 /begin AXIS_DESCR STD_AXIS p_diff FORMULA_0118 5 -10.0000 10.0000 FORMAT "%6.3" /end AXIS_DESCR
 FORMAT "%4.1" /end CHARACTERISTIC
/begin CHARACTERISTIC KL_PKSR_TKSM_PSOLL "Kraftstoffsolldruck ueber Temperatur | EN: Target fuel pressure vs temperature" CURVE 0x7609A TKL_SW_VV_SW 100.0 FORMULA_0118 0.0 10.0000 /begin AXIS_DESCR STD_AXIS FORMULA_0023 4 -50.0000 170.0000 FORMAT "%4.1" /end AXIS_DESCR FORMAT "%6.3" /end CHARACTERISTIC
/begin CHARACTERISTIC KL_PKSR_TV_HARDWARE "Korrekturkennlinie TV f. Helbako A-Muster | EN: Correction curve duty cycle for Helbako A-sample" CURVE 0x760AC TKL_SW_VV_SW 100.0 FORMULA_0840 0.0 100.0000 /begin AXIS_DESCR STD_AXIS tv_in FORMULA_0840 2 0.0 100.0000 FORMAT "%4.1" /end AXIS_DESCR FORMAT "%4.1" /end CHARACTERISTIC
/begin CHARACTERISTIC KL_PKSR_100P_DAUER_TMOT "Dauer 100% Laufzeit bei kaltem Motor | EN: Duration of 100% run with cold engine" CURVE 0x760B6 TKL_SW_VV_UW 100.0 FORMULA_0021 0.0 655.0000
 /begin AXIS_DESCR STD_AXIS tmot_start FORMULA_0023 6 -50.0000 170.0000 FORMAT "%4.1" /end AXIS_DESCR
 FORMAT "%5.2" /end CHARACTERISTIC
/begin CHARACTERISTIC KF_PKSR_PSOLL_QSOLL_TV "Tastverhaeltnis �ber Absolut-Solldruck u. Volumenstrom | EN: Duty cycle vs absolute target pressure and volume flow" MAP 0x760D0 TKF_SW_SW_SW 100.0 FORMULA_0840 -100.0000 3199.9023
 /begin AXIS_DESCR STD_AXIS Volumenstrom FORMULA_0746 10 0.0 400.0000 FORMAT "%4.1" /end AXIS_DESCR
 /begin AXIS_DESCR STD_AXIS FORMULA_0118 8 0.0 20.0000 FORMAT "%6.3" /end AXIS_DESCR
 FORMAT "%4.1" /end CHARACTERISTIC
/begin CHARACTERISTIC KF_PKSR_RF_N_PSOLL "Kraftstoffsolldruck (rel.) �ber Motorlast u. Drehzahl | EN: Target fuel pressure (relative) vs engine load and speed" MAP 0x76196 TKF_SW_SW_SW 100.0 FORMULA_0118 0.0 10.0000 /begin AXIS_DESCR STD_AXIS rf FORMULA_0007 6 0.0 2.0000 FORMAT "%6.3" /end AXIS_DESCR /begin AXIS_DESCR STD_AXIS FORMULA_0006 8 0.0 10000.0000 /end AXIS_DESCR FORMAT "%6.3" /end CHARACTERISTIC
/* ------------------ Abschnitt erzeugt aus tgetr.dat ------------------ */
/begin CHARACTERISTIC K_TGETR_DIAG_TUMG_MIN "Untere Diagnosegrenze Umgebungstemperatur | EN: Untere Diagnosegrenze Umgebungstemperatur" VALUE 0x782D6 TKW_VV_VV_SW 100.0 FORMULA_0023 -50.0000 170.0000 FORMAT "%4.1" /end CHARACTERISTIC
/begin CHARACTERISTIC K_TGETR_DIAG_MIN "Untere Grenze Getriebetemperatur | EN: Untere Grenze Getriebetemperatur" VALUE 0x782D8 TKW_VV_VV_SW 100.0 FORMULA_1159 -50.0000 190.0000 FORMAT "%6.3" /end CHARACTERISTIC
/begin CHARACTERISTIC K_TGETR_DIAG_MAX "Obere Grenze Getriebetemperatur | EN: Obere Grenze Getriebetemperatur" VALUE 0x782DA TKW_VV_VV_SW 100.0 FORMULA_1159 -50.0000 190.0000 FORMAT "%6.3" /end CHARACTERISTIC
/begin CHARACTERISTIC K_TGETR_CC_HIGH "Obere Grenze CC Meldung Getriebetemperatur | EN: Obere Grenze CC Meldung Getriebetemperatur" VALUE 0x782DC TKW_VV_VV_SW 100.0 FORMULA_1159 -50.0000 190.0000 FORMAT "%6.3" /end CHARACTERISTIC
/begin CHARACTERISTIC K_TGETR_CC_HYST "Hysterese CC Meldung Getriebetemperatur | EN: Hysterese CC Meldung Getriebetemperatur" VALUE 0x782DE TKW_VV_VV_SW 100.0 FORMULA_1161 -50.0000 170.0000 FORMAT "%6.3" /end CHARACTERISTIC
/begin CHARACTERISTIC K_TGETR_TAU "Filterkonstante fuer die Getriebetemperatur | EN: Filterkonstante fuer die Getriebetemperatur" VALUE 0x782E0 TKW_VV_VV_UB 100.0 FORMULA_0683 0.1004 25.6000 /end CHARACTERISTIC
/begin CHARACTERISTIC KL_TGETR_NTC "Kennlinie Getriebetemperatur | EN: Gearbox temperature curve" CURVE 0x782E2 TKL_SW_VV_SW 100.0 FORMULA_1159 -50.0000 190.0000 /begin AXIS_DESCR STD_AXIS FORMULA_0123 8 0.0 1023.0000 /end AXIS_DESCR FORMAT "%6.3" /end CHARACTERISTIC
/* ------------------ Abschnitt erzeugt aus ti.dat ------------------ */
/begin CHARACTERISTIC K_TI_MAX_RESET "Einfluss von ti_rf_max unterdruecken | EN: 0 Einfluss 1 kein Einfluss Einfluss von ti_rf_max unter- druecken | [Code V452 INJ 0x60654] <> 0 clears ti_pks_up_st every cycle (suppresses the ti_rf_max influence)." VALUE 0x78304 TKW_VV_VV_UW 100.0 FORMULA_1172 0.0 1.0 FORMAT "%5.2" /end CHARACTERISTIC
/begin CHARACTERISTIC K_TI_MKS_TE_CFG "Einrechnung TE-MKS | EN: Include tank-vent fuel mass in MKS (0/1)" VALUE 0x78306 TKW_VV_VV_UB 100.0 FORMULA_1173 0.0 1.0 /end CHARACTERISTIC
/begin CHARACTERISTIC K_TI_MKS_OELV_CFG "Einrechnung OELV-MKS" VALUE 0x78307 TKW_VV_VV_UB 100.0 FORMULA_1174 0.0 1.0 /end CHARACTERISTIC
/begin CHARACTERISTIC K_TI_MKS_LWV_CFG "Einrechnung LWV-MKS | EN: Include LWV fuel mass in MKS (0/1)" VALUE 0x78308 TKW_VV_VV_UB 100.0 FORMULA_1175 0.0 1.0 /end CHARACTERISTIC
/begin CHARACTERISTIC K_TI_NS_CFG "Motor laeuft ueber... | EN: Post-start base: 0 ti_mks_start, 1 ti_mks_grund, 2 ti_mks_roh" VALUE 0x78309 TKW_VV_VV_UB 100.0 FORMULA_1176 0.0 1.0 /end CHARACTERISTIC
/begin CHARACTERISTIC K_TI_MKS_START_CFG "Einrechnung START-MKS | EN: Include START/post-start fuel mass in MKS (0/1)" VALUE 0x7830A TKW_VV_VV_UB 100.0 FORMULA_1177 0.0 1.0 /end CHARACTERISTIC
/begin CHARACTERISTIC K_TI_WL_CFG "WL-Korrektur waehrend KH | EN: 0 ohne AQ/Hoehen- Korr. 1 mit AQ/ohne Hoe- hen-Korr 2 ohne AQ/mit Hoe- hen-Korr 3 mit AQ/Hoehen- Kor" VALUE 0x7830B TKW_VV_VV_UB 100.0 FORMULA_1178 0.0 1.0 /end CHARACTERISTIC
/begin CHARACTERISTIC K_TI_GA "Grundadaptionsfaktor | EN: Base adaptation factor | [Code V452 INJ 0x60654] Global factor applied to every cylinder right after KF_TI_TU_F (x/128): ti_tpu = ti x KF_TI_TU_F x K_TI_GA. 1.00 here. Changes all cylinders equally (lambda control will correct it back)." VALUE 0x7830C TKW_VV_VV_UW 100.0 FORMULA_0805 0.0 10.0000 FORMAT "%5.2" /end CHARACTERISTIC
/begin CHARACTERISTIC K_TI_GRUND_STOECH "stoechometrischer Faktor | EN: Stoichiometric factor | [Code V452 INJ 0x60654] Stoichiometric factor (14.2) used to convert the ti headroom into ti_b[j].ml_max -> ti_rf_max (max. relative fill the injectors can serve)." VALUE 0x7830E TKW_VV_VV_UW 100.0 FORMULA_0805 0.0 511.9921 FORMAT "%5.2" /end CHARACTERISTIC
/begin CHARACTERISTIC K_TI_MAX_OFFS "Offset f. max. TI | EN: Offset for maximum injection time | [Code V452 INJ 0x60654] Offset subtracted from ti_max (= available time per 720 degKW from n) together with ub_offs -> ti_max_lim, the threshold for the fuel-pressure-raise request." VALUE 0x78310 TKW_VV_VV_SW 100.0 FORMULA_0786 -32.7680 32.7670 FORMAT "%5.2" /end CHARACTERISTIC
/begin CHARACTERISTIC K_TI_MIN_MAX_HYS "Hysterese f. MIN/MAX-TI | EN: Hysteresis for MIN/MAX injection time [ms] | [Code V452 INJ 0x60654] Hysteresis below ti_max_lim for clearing the per-cylinder pressure-raise bit (ti_pks_up_st)." VALUE 0x78312 TKW_VV_VV_UW 100.0 FORMULA_0786 0.0 65.5350 FORMAT "%5.2" /end CHARACTERISTIC
/begin CHARACTERISTIC K_TI_PHI_ENDE_A_ZYL "Zylinderflaeche | EN: Cylinder (bore) area [mm2]" VALUE 0x78314 TKW_VV_VV_UW 100.0 FORMULA_1179 0.0 6553.5000 FORMAT "%5.2" /end CHARACTERISTIC
/begin CHARACTERISTIC K_TI_PHI_ENDE_S_HUB "Kolbenhub | EN: Piston stroke [mm]" VALUE 0x78316 TKW_VV_VV_UW 100.0 FORMULA_1180 0.0 150.0000 FORMAT "%5.2" /end CHARACTERISTIC
/begin CHARACTERISTIC K_TI_PHI_ENDE_A_SAUG "mittlerer Saugrohrquerschnitt | EN: Mean intake-runner cross-section [mm2]" VALUE 0x78318 TKW_VV_VV_UW 100.0 FORMULA_1179 0.0 2000.0000 FORMAT "%5.2" /end CHARACTERISTIC
/begin CHARACTERISTIC K_TI_PHI_ENDE_ROH_KST "Kraftstoffdichte | EN: Fuel density [kg/dm3]" VALUE 0x7831A TKW_VV_VV_UW 100.0 FORMULA_1181 0.0 2.0000 FORMAT "%5.2" /end CHARACTERISTIC
/begin CHARACTERISTIC K_TI_PHI_ENDE_S_ESV_EV "Strecke zwischen EV zu EV | EN: Distance from injector to intake valve [m]" VALUE 0x7831C TKW_VV_VV_UW 100.0 FORMULA_1182 0.0 0.6103 FORMAT "%7.4" /end CHARACTERISTIC
/begin CHARACTERISTIC K_TI_MIN_OFF_TIME "Minimale Ventilauszeit. | EN: Minimum valve off-time [us, x/1000 ms]" VALUE 0x7831E TKW_VV_VV_UW 100.0 FORMULA_0786 0.0 65.5350 FORMAT "%5.2" /end CHARACTERISTIC
/begin CHARACTERISTIC K_TI_NMIN_KL50OFF "N-Einschaltschwelle bei !S_KL50 | EN: Injection enable speed threshold when starter (KL50) is off" VALUE 0x78320 TKW_VV_VV_SW 100.0 FORMULA_0006 0.0 10000.0000 /end CHARACTERISTIC
/begin CHARACTERISTIC K_TI_OFF_CFG "TI-Abschaltung | EN: Injection cut-off cylinder mask (bitmask)" VALUE 0x78322 TKW_VV_VV_UW 100.0 FORMULA_0010 0.0 1023.0000 /end CHARACTERISTIC
/begin CHARACTERISTIC K_TI_RF_MAX_DLY "Verzoegerungszeit ueber Anzahl Segmente | EN: Delay (segments) before ti_rf_max torque limit request is withdrawn | [Code V452 INJ 0x60654] Hold time (segments) for ti_rf_max_dly after a cylinder reaches ti_max_lim." VALUE 0x78324 TKW_VV_VV_UW 100.0 FORMULA_1167 0.0 65535.0000 /end CHARACTERISTIC
/begin CHARACTERISTIC K_ZGLA_N_MAX "max. N-Schwelle fuer Zylindergleichstellung" VALUE 0x78326 TKW_VV_VV_SW 100.0 FORMULA_0006 0.0 10000.0000 /end CHARACTERISTIC
/begin CHARACTERISTIC K_ZGLA_RF_MAX "max. RF-Schwelle fuer Zylindergleichstellung" VALUE 0x78328 TKW_VV_VV_SW 100.0 FORMULA_0007 0.0 2.0000 FORMAT "%6.3" /end CHARACTERISTIC
/begin CHARACTERISTIC K_ZGLA_RF_MIN "min. RF-Schwelle fuer Zylindergleichstellung" VALUE 0x7832A TKW_VV_VV_SW 100.0 FORMULA_0007 0.0 2.0000 FORMAT "%6.3" /end CHARACTERISTIC
/begin CHARACTERISTIC K_ZGLA_TMOT_MIN "min. TMOT-Schwelle fuer Zylindergleichstellung" VALUE 0x7832C TKW_VV_VV_SW 100.0 FORMULA_0023 -50.0000 170.0000 FORMAT "%4.1" /end CHARACTERISTIC
/begin CHARACTERISTIC K_ZGLA_LAM_IST_MAX "max. LAM-IST-MW-Schwelle fuer Zylindergleichstellung" VALUE 0x7832E TKW_VV_VV_UW 100.0 FORMULA_0025 0.0 3.9990 FORMAT "%6.3" /end CHARACTERISTIC
/begin CHARACTERISTIC K_ZGLA_LAM_IST_MIN "min. LAM-IST-MW-Schwelle fuer Zylindergleichstellung" VALUE 0x78330 TKW_VV_VV_UW 100.0 FORMULA_0025 0.0 3.9990 FORMAT "%6.3" /end CHARACTERISTIC
/begin CHARACTERISTIC K_ZGLA_INPUT_CFG "Auswahl Input - Zylindergleichstellung" VALUE 0x78332 TKW_VV_VV_UB 100.0 FORMULA_1183 0.0 1.0 /end CHARACTERISTIC
/begin CHARACTERISTIC K_ZGLA_FILT_T1 "Filterzeit" VALUE 0x78334 TKW_VV_VV_UW 100.0 FORMULA_1184 0.0 2097.0000 FORMAT "%6.3" /end CHARACTERISTIC
/begin CHARACTERISTIC K_ZGLA_ADAPT_CFG "Freigabe Adaption - Zylindergleichstellung" VALUE 0x78336 TKW_VV_VV_UB 100.0 FORMULA_1185 0.0 1.0 /end CHARACTERISTIC
/begin CHARACTERISTIC K_ZGLA_RESET_CFG "RESET Adaption - Zylindergleichstellung" VALUE 0x78337 TKW_VV_VV_UB 100.0 FORMULA_1186 0.0 1.0 /end CHARACTERISTIC
/begin CHARACTERISTIC K_ZGLA_I "Integratoranteil - Zylindergleichstellung" VALUE 0x78338 TKW_VV_VV_UW 100.0 FORMULA_0024 0.0 1.9990 FORMAT "%7.4" /end CHARACTERISTIC
/begin CHARACTERISTIC K_ZGLA_F_MAX "max. Adaptionsschwelle - Zylindergleichstellung" VALUE 0x7833A TKW_VV_VV_UW 100.0 FORMULA_0024 0.0 1.9990 FORMAT "%7.4" /end CHARACTERISTIC
/begin CHARACTERISTIC K_ZGLA_F_MIN "min. Adaptionsschwelle - Zylindergleichstellung" VALUE 0x7833C TKW_VV_VV_UW 100.0 FORMULA_0024 0.0 1.9990 FORMAT "%7.4" /end CHARACTERISTIC
/begin CHARACTERISTIC K_TI_OFF_EXD_N_MAX "max. Drehzahl f. externe TI_OFF-Ansteuerung" VALUE 0x7833E TKW_VV_VV_SW 100.0 FORMULA_0006 0.0 10000.0000 /end CHARACTERISTIC
/begin CHARACTERISTIC KL_TI_SOLL_RHO_F "Kompensationsfak. Kraftsoffdichte | EN: Fuel-density compensation factor | [Code V452 INJ 0x60654] Fuel-density factor over fuel temperature tksm; numerator of ti_soll_zyl = ti_mks_soll x RHO_F / QSTAT_F (applied to all cylinders before the trim)." CURVE 0x78340 TKL_SW_VV_UW 100.0 FORMULA_0805 0.0 10.0000 /begin AXIS_DESCR STD_AXIS FORMULA_0023 4 -50.0000 170.0000 FORMAT "%4.1" /end AXIS_DESCR FORMAT "%5.2" /end CHARACTERISTIC
/begin CHARACTERISTIC KL_TI_SOLL_QSTAT_F "proportionaler Ventilparameter | EN: Proportional injector valve parameter | [Code V452 INJ 0x60654] Injector static flow (mg/ms) over pressure difference pdiff = pks_ist - psau; divisor of ti_soll_zyl (all cylinders, before the trim). Injector-change table." CURVE 0x78352 TKL_SW_VV_UW 100.0 FORMULA_1162 0.0 6.0000 /begin AXIS_DESCR STD_AXIS pdiff FORMULA_0118 8 0.0 10.0000 FORMAT "%6.3" /end AXIS_DESCR FORMAT "%6.3" /end CHARACTERISTIC
/begin CHARACTERISTIC KL_TI_SOLL_LIN_OFFS "Linearisierungskompensation | EN: Linearisation compensation | [Code V452 INJ 0x60654] Small-pulse linearisation offset over ti_soll, added per cylinder: ti_berech_zyl = ti_soll_zyl + this (before KF_TI_SOLL_MIN and the trim)." CURVE 0x78374 TKL_UW_VV_SW 100.0 FORMULA_0786 -2.0000 2.0000 /begin AXIS_DESCR STD_AXIS ti_soll FORMULA_0786 6 0.0 65.5350 FORMAT "%5.2" /end AXIS_DESCR FORMAT "%5.2" /end CHARACTERISTIC
/begin CHARACTERISTIC KL_TI_PHI_ENDE_START "ti_ende im START | EN: End of injection during start" CURVE 0x7838E TKL_SW_VV_SW 100.0 FORMULA_0111 -72.0000 1440.0000 /begin AXIS_DESCR STD_AXIS FORMULA_0023 7 -50.0000 170.0000 FORMAT "%4.1" /end AXIS_DESCR FORMAT "%4.1" /end CHARACTERISTIC
/begin CHARACTERISTIC KL_TI_PHI_ENDE_GRAD "Gradient fuer Aenderungsbegr. ti_ende | EN: Gradient for rate limit of ti_ende" CURVE 0x783AC TKL_SW_VV_SW 100.0 FORMULA_0111 0.0 1440.0000
 /begin AXIS_DESCR STD_AXIS ti_phi_ende FORMULA_0111 3 -72.0000 1440.0000 FORMAT "%4.1" /end AXIS_DESCR
 FORMAT "%4.1" /end CHARACTERISTIC
/begin CHARACTERISTIC KL_TI_PHI_EV_WURZEL "Darstellung Wurzel-Fluggeschwindigkeit | EN: Square-root representation of flow velocity" CURVE 0x783BA TKL_UW_VV_SW 100.0 FORMULA_1164 0.0 220.0000 /begin AXIS_DESCR STD_AXIS FORMULA_1165 10 0.0 1638.3750 FORMAT "%6.3" /end AXIS_DESCR FORMAT "%5.2" /end CHARACTERISTIC
/begin CHARACTERISTIC KL_TI_SOLL_UB_OFFS_T_KORR_F "Kraftsofftemperatur Faktor | EN: Fuel-temperature factor | [Code V452 INJ 0x60654] Fuel-temperature factor (tsgrw) on KF_TI_SOLL_UB_OFFS (x/1024). All 1.00 here." CURVE 0x783E4 TKL_SW_VV_UW 100.0 FORMULA_0075 0.0 4.0000 /begin AXIS_DESCR STD_AXIS FORMULA_0023 6 -50.0000 170.0000 FORMAT "%4.1" /end AXIS_DESCR FORMAT "%6.3" /end CHARACTERISTIC
/begin CHARACTERISTIC KL_TI_NS_VERLUSTE "Verluste Kraftsoffmenge | EN: Fuel quantity losses" CURVE 0x783FE TKL_SW_VV_UW 100.0 FORMULA_0075 0.0 4.0000
 /begin AXIS_DESCR STD_AXIS tsgrw FORMULA_0023 7 -50.0000 170.0000 FORMAT "%4.1" /end AXIS_DESCR
 FORMAT "%6.3" /end CHARACTERISTIC
/begin CHARACTERISTIC KL_TI_PHI_ENDE_ES "Schliesswinkel Einlassventil | EN: Intake valve closing angle" CURVE 0x7841C TKL_SW_VV_SW 100.0 FORMULA_0111 -72.0000 1440.0000 /begin AXIS_DESCR STD_AXIS FORMULA_0006 3 0.0 10000.0000 /end AXIS_DESCR FORMAT "%4.1" /end CHARACTERISTIC
/begin CHARACTERISTIC KL_TI_START_PUMG_F "Umgebungsdruckwichtung im START | EN: Ambient-pressure weighting during start" CURVE 0x7842A TKL_SW_VV_UW 100.0 FORMULA_0075 0.0 4.0000 /begin AXIS_DESCR STD_AXIS FORMULA_0077 5 400.0000 1200.0000 FORMAT "%4.1" /end AXIS_DESCR FORMAT "%6.3" /end CHARACTERISTIC
/begin CHARACTERISTIC KF_TI_SOLL_UB_OFFS "UB-abhaengiger TI-Offset  | EN: Battery-voltage-dependent injection offset (dead time) | [Code V452 INJ 0x60654] Injector opening (battery) offset over ub x pdiff, x KL_TI_SOLL_UB_OFFS_T_KORR_F/1024 -> ti_b[j].ub_offs. Added by the TPU to ti_tpu_zyl (not scaled by KF_TI_TU_F). Also lowers ti_max_lim." MAP 0x78440 TKF_SW_SW_UW 100.0 FORMULA_0786 0.0 65.5350 /begin AXIS_DESCR STD_AXIS FORMULA_0008 5 0.0 28.0000 FORMAT "%4.1" /end AXIS_DESCR /begin AXIS_DESCR STD_AXIS pks-psau FORMULA_0118 8 0.0 10.0000 FORMAT "%6.3" /end AXIS_DESCR FORMAT "%5.2" /end CHARACTERISTIC
/begin CHARACTERISTIC KF_TI_SOLL_MIN "minimale Einspritzzeit | EN: Minimum injection time | [Code V452 INJ 0x60654] Minimum injection time over ub x pdiff (pks-psau). Applied BEFORE KF_TI_TU_F/K_TI_GA (ti = max(ti_berech, this)), so a trim < 1.0 can take the output below this value." MAP 0x784AC TKF_SW_SW_UW 100.0 FORMULA_0786 0.0 65.5350 /begin AXIS_DESCR STD_AXIS FORMULA_0008 5 0.0 28.0000 FORMAT "%4.1" /end AXIS_DESCR /begin AXIS_DESCR STD_AXIS pks-psau FORMULA_0118 4 0.0 10.0000 FORMAT "%6.3" /end AXIS_DESCR FORMAT "%5.2" /end CHARACTERISTIC
/begin CHARACTERISTIC KF_TI_PHI_ENDE_OFFS "Offset Einspritzendewinkel | EN: End-of-injection angle offset" MAP 0x784E8 TKF_SW_SW_SW 100.0 FORMULA_0111 -720.0000 720.0000 /begin AXIS_DESCR STD_AXIS FORMULA_0023 7 -50.0000 170.0000 FORMAT "%4.1" /end AXIS_DESCR /begin AXIS_DESCR STD_AXIS dr_rel FORMULA_0115 7 0.0 199.9938 FORMAT "%5.2" /end AXIS_DESCR FORMAT "%4.1" /end CHARACTERISTIC
/begin CHARACTERISTIC KF_TI_PHI_ENDE_GRUND "Vorlagerungswinkel aus Grundkennfeld | EN: End-of-injection angle from base map" MAP 0x78568 TKF_SW_SW_SW 100.0 FORMULA_0111 0.0 1440.0000 /begin AXIS_DESCR STD_AXIS FORMULA_0006 10 0.0 10000.0000 /end AXIS_DESCR /begin AXIS_DESCR STD_AXIS dr_rel FORMULA_0115 8 0.0 199.9938 FORMAT "%5.2" /end AXIS_DESCR FORMAT "%4.1" /end CHARACTERISTIC
/begin CHARACTERISTIC KF_TI_TU_F "Tuning-Faktor f. TI | [Code V452 INJ 0x60654] Per-cylinder injection trim - the S85/MSS65 form of MSS60 GKF_TI_TU_F_ZYL[i] (PSB: 'S85 MS_S65: KF_TI_TU_F(n,ZYL), K_TI_GA'). Final step: ti_tpu_zyl[i] = max(ti_berech_zyl[i], KF_TI_SOLL_MIN) x KF_TI_TU_F(n, i) x K_TI_GA, then limited to ti_max. Y = cylinder 1..10 (index = bank x 5 + k: 1-5 bank 1, 6-10 bank 2; rows 11-12 unused). Exact per cylinder (no interpolation between rows), linear over n only - no load axis, and no transient weighting (MSS60 KL_TI_TU_F_WICHT does not exist in V452). Step 1/128 = 0.78 %. All 1.00 in this file. Lambda control/LAA removes any bank-average change; only the spread within a bank remains." MAP 0x7862E TKF_SW_SW_UW 100.0 FORMULA_0805 0.0 10.0000 /begin AXIS_DESCR STD_AXIS FORMULA_0006 6 0.0 10000.0000 /end AXIS_DESCR /begin AXIS_DESCR STD_AXIS Zylinder FORMULA_1187 12 1.0000 12.0000 /end AXIS_DESCR FORMAT "%5.2" /end CHARACTERISTIC
/begin CHARACTERISTIC KF_TI_LAA_OFFS_WICHT_F "Korrekturfaktor - Lambdaadaptionsoffset | EN: Correction factor - lambda adaptation offset" MAP 0x786E4 TKF_SW_SW_UW 100.0 FORMULA_0075 0.0 4.0000 /begin AXIS_DESCR STD_AXIS FORMULA_0006 4 0.0 10000.0000 /end AXIS_DESCR
 /begin AXIS_DESCR STD_AXIS ti_ml_mg_la_f FORMULA_1163 4 -1023.9687 1023.9687 FORMAT "%5.2" /end AXIS_DESCR
 FORMAT "%6.3" /end CHARACTERISTIC
/begin CHARACTERISTIC KF_TI_GRUND_F "Wichtungsfaktor auf ti.ml_mg_zyl | EN: Weighting factor on fuel mass per cylinder (main fuel trim map)" MAP 0x78716 TKF_SW_SW_UW 100.0 FORMULA_0075 0.0 4.0000 /begin AXIS_DESCR STD_AXIS FORMULA_0006 10 0.0 10000.0000 /end AXIS_DESCR /begin AXIS_DESCR STD_AXIS rf FORMULA_0007 10 0.0 2.0000 FORMAT "%6.3" /end AXIS_DESCR FORMAT "%6.3" /end CHARACTERISTIC
/begin CHARACTERISTIC KF_ZGLA_ZYL_NR_OFFS "OFFSET auf aktuellen Zylinder - Zylindergleichstellung" MAP 0x78808 TKF_SW_SW_UW 100.0 FORMULA_1188 0.0 5.0000 /begin AXIS_DESCR STD_AXIS FORMULA_0006 10 0.0 10000.0000 /end AXIS_DESCR /begin AXIS_DESCR STD_AXIS rf FORMULA_0007 10 0.0 2.0000 FORMAT "%6.3" /end AXIS_DESCR /end CHARACTERISTIC
/begin CHARACTERISTIC KF_TI_MKS_NS_GRUND "Grundeinspritzmasse Nachstart" MAP 0x788FA TKF_SW_SW_UW 100.0 FORMULA_0529 0.0 16383.7500
 /begin AXIS_DESCR STD_AXIS tsgrw FORMULA_0023 10 -50.0000 170.0000 FORMAT "%4.1" /end AXIS_DESCR
 /begin AXIS_DESCR STD_AXIS FORMULA_0077 5 400.0000 1200.0000 FORMAT "%4.1" /end AXIS_DESCR
 FORMAT "%5.2" /end CHARACTERISTIC
/begin CHARACTERISTIC KF_TI_NS_F "Nachstartfaktor auf Grundeinspritzmenge | EN: Post-start base factor" MAP 0x7897E TKF_SW_SW_UW 100.0 FORMULA_0075 0.0 4.0000
 /begin AXIS_DESCR STD_AXIS tsgrw FORMULA_0023 10 -50.0000 170.0000 FORMAT "%4.1" /end AXIS_DESCR
 /begin AXIS_DESCR STD_AXIS FORMULA_0010 10 0.0 32767.0000 /end AXIS_DESCR
 FORMAT "%6.3" /end CHARACTERISTIC
/begin CHARACTERISTIC KF_TI_SEG_TIME_F "Nachstart-Manipulationsfaktor" MAP 0x78A70 TKF_UW_UW_UW 100.0 FORMULA_0075 0.0 4.0000
 /begin AXIS_DESCR STD_AXIS ti_mks_ns_rel FORMULA_0075 10 0.0 4.0000 FORMAT "%6.3" /end AXIS_DESCR
 /begin AXIS_DESCR STD_AXIS FORMULA_0600 10 0.0 1092.2500 FORMAT "%5.2" /end AXIS_DESCR
 FORMAT "%6.3" /end CHARACTERISTIC
/begin CHARACTERISTIC KF_TI_WL_OFFS "TI-Warmlaufoffset | EN: Injection warm-up offset" MAP 0x78B62 TKF_SW_SW_SW 100.0 FORMULA_0075 -1.0000 1.0000 /begin AXIS_DESCR STD_AXIS FORMULA_0006 8 0.0 10000.0000 /end AXIS_DESCR /begin AXIS_DESCR STD_AXIS rf FORMULA_0007 8 0.0 2.0000 FORMAT "%6.3" /end AXIS_DESCR FORMAT "%6.3" /end CHARACTERISTIC
/begin CHARACTERISTIC KF_TI_WL_KORR_F "Korrektur - TI-Warmlauffaktor | EN: Correction - injection warm-up factor" MAP 0x78C04 TKF_SW_SW_UW 100.0 FORMULA_0075 0.0 4.0000 /begin AXIS_DESCR STD_AXIS FORMULA_0023 8 -50.0000 170.0000 FORMAT "%4.1" /end AXIS_DESCR /begin AXIS_DESCR STD_AXIS FORMULA_0021 8 0.0 327.0000 FORMAT "%5.2" /end AXIS_DESCR FORMAT "%6.3" /end CHARACTERISTIC
/begin CHARACTERISTIC KF_TI_MKS_START "START-MKS Grundkennfeld | EN: Start base map, injection with clutch closed" MAP 0x78CA6 TKF_SW_SW_UW 100.0 FORMULA_0752 0.0 1023.9843 /begin AXIS_DESCR STD_AXIS FORMULA_0023 8 -50.0000 170.0000 FORMAT "%4.1" /end AXIS_DESCR /begin AXIS_DESCR STD_AXIS FORMULA_0600 3 0.0 546.1166 FORMAT "%5.2" /end AXIS_DESCR FORMAT "%5.2" /end CHARACTERISTIC
/begin CHARACTERISTIC KF_TI_START_F "Abregelfaktor im START | EN: Start fade-out factor" MAP 0x78CEE TKF_SW_SW_UW 100.0 FORMULA_0075 0.0 4.0000 /begin AXIS_DESCR STD_AXIS FORMULA_0023 5 -50.0000 170.0000 FORMAT "%4.1" /end AXIS_DESCR /begin AXIS_DESCR STD_AXIS FORMULA_0010 10 0.0 32767.0000 /end AXIS_DESCR FORMAT "%6.3" /end CHARACTERISTIC
/begin CHARACTERISTIC KF_TI_WL_OFFS_KH "TI-Warmlaufoffset waehrend KH | EN: Injection warm-up offset during catalyst heating" MAP 0x78D72 TKF_SW_SW_SW 100.0 FORMULA_0075 -1.0000 1.0000 /begin AXIS_DESCR STD_AXIS FORMULA_0006 8 0.0 10000.0000 /end AXIS_DESCR
 /begin AXIS_DESCR STD_AXIS egas_aq_soll_roh FORMULA_0147 8 0.0 3276.7000 FORMAT "%4.1" /end AXIS_DESCR
 FORMAT "%6.3" /end CHARACTERISTIC
/begin CHARACTERISTIC KF_TI_WL_KORR_F_KH "TI-Warmlaufkorrekturfaktor waehrend KH | EN: Injection warm-up correction factor during catalyst heating" MAP 0x78E14 TKF_SW_SW_UW 100.0 FORMULA_0075 0.0 4.0000 /begin AXIS_DESCR STD_AXIS FORMULA_0023 8 -50.0000 170.0000 FORMAT "%4.1" /end AXIS_DESCR /begin AXIS_DESCR STD_AXIS FORMULA_0021 8 0.0 327.0000 FORMAT "%5.2" /end AXIS_DESCR FORMAT "%6.3" /end CHARACTERISTIC
/* ------------------ Abschnitt erzeugt aus vfz.dat ------------------ */
/begin CHARACTERISTIC K_V_RAD_TOL_CFG "Schalter RadToleranz" VALUE 0x79AE0 TKW_VV_VV_UB 100.0 FORMULA_1230 0.0 255.0 /end CHARACTERISTIC
/begin CHARACTERISTIC K_V_RAD_TOL_TAU "Filterkonstante RadToleranz | EN: Filterkonstante RadToleranz" VALUE 0x79AE1 TKW_VV_VV_UB 100.0 FORMULA_0651 0.0051 1.2800 /end CHARACTERISTIC
/begin CHARACTERISTIC K_V_MAX_FF_RESET "FF-Reset fuer meinen INCA-Spezl | EN: 0 Speichern 1 Reset ELSE undef FF-Reset fuer meinen INCA-Spezl" VALUE 0x79AE2 TKW_VV_VV_UB 100.0 FORMULA_1011 0.0 255.0 /end CHARACTERISTIC
/begin CHARACTERISTIC K_V_MAX_MAX "Stoll'sche v_max-Konstante | EN: Stoll'sche v_max-Konstante" VALUE 0x79AE4 TKW_VV_VV_SW 100.0 FORMULA_0078 -80.0000 360.0000 FORMAT "%4.1" /end CHARACTERISTIC
/begin CHARACTERISTIC K_V_MAX_ANH_KM_STAND "minimaler km-Stand fuer v_max-Anhebung | EN: minimaler km -Stand fuer v_max -Anhebung" VALUE 0x79AE6 TKW_VV_VV_UW 100.0 FORMULA_0616 0.0 65535.0000 /end CHARACTERISTIC
/begin CHARACTERISTIC K_V_MAX_ANH_MAX_CNT "Begrenzung v_max-Anhebungen per Tester | EN: Begrenzung v_max-Anhebungen per Tester" VALUE 0x79AE8 TKW_VV_VV_UB 100.0 FORMULA_0003 0.0 4.0000 /end CHARACTERISTIC
/begin CHARACTERISTIC KL_V_MAX_GANG_LIMOUSINE "Maximalgeschwindigkeit angehoben f. Limousine | EN: Maximum vehicle speed, raised, Saloon" CURVE 0x79AEA TKL_SW_VV_SW 100.0 FORMULA_0078 -80.0000 360.0000 /begin AXIS_DESCR STD_AXIS FORMULA_0666 8 -1.0000 10.0000 /end AXIS_DESCR FORMAT "%4.1" /end CHARACTERISTIC
/begin CHARACTERISTIC KL_V_MAX_GANG_TOURING "Maximalgeschwindigkeit angehoben f. Touring | EN: Maximum vehicle speed, raised, Touring" CURVE 0x79B0C TKL_SW_VV_SW 100.0 FORMULA_0078 -80.0000 360.0000 /begin AXIS_DESCR STD_AXIS FORMULA_0666 8 -1.0000 10.0000 /end AXIS_DESCR FORMAT "%4.1" /end CHARACTERISTIC
/begin CHARACTERISTIC KL_V_MAX_GANG_COUPE "Maximalgeschwindigkeit angehoben f. Coupe | EN: Maximum vehicle speed, raised, Coupe" CURVE 0x79B2E TKL_SW_VV_SW 100.0 FORMULA_0078 -80.0000 360.0000 /begin AXIS_DESCR STD_AXIS FORMULA_0666 8 -1.0000 10.0000 /end AXIS_DESCR FORMAT "%4.1" /end CHARACTERISTIC
/begin CHARACTERISTIC KL_V_MAX_GANG_CABRIO "Maximalgeschwindigkeit angehoben f. Cabrio | EN: Maximum vehicle speed, raised, Convertible" CURVE 0x79B50 TKL_SW_VV_SW 100.0 FORMULA_0078 -80.0000 360.0000 /begin AXIS_DESCR STD_AXIS FORMULA_0666 8 -1.0000 10.0000 /end AXIS_DESCR FORMAT "%4.1" /end CHARACTERISTIC
/begin CHARACTERISTIC KL_V_MAX_GANG_BEGRENZT "Maximalgeschwindigkeit | EN: Maximum vehicle speed (Vmax)" CURVE 0x79B72 TKL_SW_VV_SW 100.0 FORMULA_0078 -80.0000 360.0000 /begin AXIS_DESCR STD_AXIS FORMULA_0666 8 -1.0000 10.0000 /end AXIS_DESCR FORMAT "%4.1" /end CHARACTERISTIC
/begin CHARACTERISTIC KL_V_MAX_SK "Maximalgeschwindigkeit bei SK-Fehler | EN: Maximum vehicle speed with safety-concept fault" CURVE 0x79B94 TKL_UB_VV_SW 100.0 FORMULA_0078 -80.0000 360.0000 /begin AXIS_DESCR STD_AXIS Stufe FORMULA_0003 6 0.0 255.0000 /end AXIS_DESCR FORMAT "%4.1" /end CHARACTERISTIC
/begin FUNCTION Eigendiagnose ""
 /begin DEF_CHARACTERISTIC K_ED_VAN_VENT_A1.KLASSENINDEX K_ED_VAN_VENT_A1.OK_SCHWELLE K_ED_VAN_VENT_A1.P_CODE_OPENLOAD K_ED_VAN_VENT_A1.P_CODE_SH_TO_GND K_ED_VAN_VENT_A1.P_CODE_SH_TO_UB K_ED_VAN_VENT_A1.P_CODE_UNPLAUSIBEL K_ED_VAN_VENT_A2.DEC_NACH_EINTRAG K_ED_VAN_VENT_A2.DEC_VOR_EINTRAG K_ED_VAN_VENT_A2.FEHLERSCHWELLE K_ED_VAN_VENT_A2.INC_NACH_EINTRAG K_ED_VAN_VENT_A2.INC_VOR_EINTRAG K_ED_VAN_VENT_A2.KLASSENINDEX K_ED_VAN_VENT_A2.OK_SCHWELLE K_ED_VAN_VENT_A2.P_CODE_OPENLOAD K_ED_VAN_VENT_A2.P_CODE_SH_TO_GND K_ED_VAN_VENT_A2.P_CODE_SH_TO_UB K_ED_VAN_VENT_A2.P_CODE_UNPLAUSIBEL K_ED_VAN_VENT_E1.DEC_NACH_EINTRAG K_ED_VAN_VENT_E1.DEC_VOR_EINTRAG K_ED_VAN_VENT_E1.FEHLERSCHWELLE K_ED_VAN_VENT_E1.INC_NACH_EINTRAG K_ED_VAN_VENT_E1.INC_VOR_EINTRAG K_ED_VAN_VENT_E1.KLASSENINDEX K_ED_VAN_VENT_E1.OK_SCHWELLE K_ED_VAN_VENT_E1.P_CODE_OPENLOAD K_ED_VAN_VENT_E1.P_CODE_SH_TO_GND K_ED_VAN_VENT_E1.P_CODE_SH_TO_UB K_ED_VAN_VENT_E1.P_CODE_UNPLAUSIBEL K_ED_VAN_VENT_E2.DEC_NACH_EINTRAG K_ED_VAN_VENT_E2.DEC_VOR_EINTRAG K_ED_VAN_VENT_E2.FEHLERSCHWELLE K_ED_VAN_VENT_E2.INC_NACH_EINTRAG K_ED_VAN_VENT_E2.INC_VOR_EINTRAG K_ED_VAN_VENT_E2.KLASSENINDEX K_ED_VAN_VENT_E2.OK_SCHWELLE K_ED_VAN_VENT_E2.P_CODE_OPENLOAD K_ED_VAN_VENT_E2.P_CODE_SH_TO_GND K_ED_VAN_VENT_E2.P_CODE_SH_TO_UB K_ED_VAN_VENT_E2.P_CODE_UNPLAUSIBEL K_ED_WUC_DELTA_TMOT K_ED_WUC_TMOT_MIN /end DEF_CHARACTERISTIC
/end FUNCTION
/begin FUNCTION Einspritzung ""
 /begin DEF_CHARACTERISTIC KF_TI_GRUND_F KF_TI_LAA_OFFS_WICHT_F KF_TI_MKS_NS_GRUND KF_TI_MKS_START KF_TI_NS_F KF_TI_PHI_ENDE_GRUND KF_TI_PHI_ENDE_OFFS KF_TI_SEG_TIME_F KF_TI_SOLL_MIN KF_TI_SOLL_UB_OFFS KF_TI_START_F KF_TI_TU_F KF_TI_WL_KORR_F KF_TI_WL_KORR_F_KH KF_TI_WL_OFFS KF_TI_WL_OFFS_KH KF_ZGLA_ZYL_NR_OFFS KL_TI_NS_VERLUSTE KL_TI_PHI_ENDE_ES KL_TI_PHI_ENDE_GRAD KL_TI_PHI_ENDE_START KL_TI_PHI_EV_WURZEL KL_TI_SOLL_LIN_OFFS KL_TI_SOLL_QSTAT_F KL_TI_SOLL_RHO_F KL_TI_SOLL_UB_OFFS_T_KORR_F KL_TI_START_PUMG_F K_KVA_Q_MOT_TAU K_KVA_SPEC_WEIGHT K_TI_GA K_TI_GRUND_STOECH K_TI_MAX_OFFS K_TI_MAX_RESET K_TI_MIN_MAX_HYS K_TI_MIN_OFF_TIME K_TI_MKS_LWV_CFG K_TI_MKS_OELV_CFG K_TI_MKS_START_CFG K_TI_MKS_TE_CFG K_TI_NMIN_KL50OFF K_TI_NS_CFG K_TI_OFF_CFG K_TI_OFF_EXD_N_MAX K_TI_PHI_ENDE_A_SAUG K_TI_PHI_ENDE_A_ZYL K_TI_PHI_ENDE_ROH_KST K_TI_PHI_ENDE_S_ESV_EV K_TI_PHI_ENDE_S_HUB K_TI_RF_MAX_DLY K_TI_WL_CFG K_ZGLA_ADAPT_CFG K_ZGLA_FILT_T1 K_ZGLA_F_MAX K_ZGLA_F_MIN K_ZGLA_I K_ZGLA_INPUT_CFG K_ZGLA_LAM_IST_MAX K_ZGLA_LAM_IST_MIN K_ZGLA_N_MAX K_ZGLA_RESET_CFG K_ZGLA_RF_MAX K_ZGLA_RF_MIN K_ZGLA_TMOT_MIN /end DEF_CHARACTERISTIC
 /begin REF_CHARACTERISTIC /end REF_CHARACTERISTIC
 /begin IN_MEASUREMENT /end IN_MEASUREMENT
 /begin OUT_MEASUREMENT /end OUT_MEASUREMENT
/end FUNCTION
/begin FUNCTION Elektroluefter ""
 /begin DEF_CHARACTERISTIC KF_ELU_PWM_MS KL_ELU_KKOS KL_ELU_TAN KL_ELU_TKA KL_ELU_TKAT KL_ELU_V_KORR K_ELU_ED_BLOCKIERT_CNT K_ELU_ED_BLOCKIERT_MAX K_ELU_ED_BLOCKIERT_MIN K_ELU_ED_BLOCKIER_ZYKLUS_TIME K_ELU_ED_OPENLOAD_CNT K_ELU_ED_SH_TO_GND_CNT K_ELU_ED_SH_TO_UB_DELAY K_ELU_ED_SH_TO_UB_OFF_TIME K_ELU_HYS_SCHLEPP K_ELU_IDENT_CYCLE_CNT_BEGR K_ELU_IDENT_CYCLE_TIME_BEGR K_ELU_IDENT_RESP_600W_MAX K_ELU_IDENT_RESP_600W_MIN K_ELU_IDENT_RESP_850W_MAX K_ELU_IDENT_RESP_850W_MIN K_ELU_PWM_AUS K_ELU_PWM_GRAD_ZUL K_ELU_PWM_IDENT K_ELU_PWM_MAX_ML K_ELU_PWM_MAX_MS K_ELU_PWM_MIN_ML K_ELU_PWM_MIN_MS K_ELU_PWM_OFFS K_ELU_TAN_DREH_ERSATZ K_ELU_TCR2_TICS K_ELU_TCR2_TICS_NL K_ELU_TKA_TMOT_DIFF K_ELU_TYP_CFG K_ELU_T_ML_MIN K_ELU_T_MS_MAX /end DEF_CHARACTERISTIC
 /begin REF_CHARACTERISTIC /end REF_CHARACTERISTIC
 /begin IN_MEASUREMENT /end IN_MEASUREMENT
 /begin OUT_MEASUREMENT /end OUT_MEASUREMENT
/end FUNCTION
/begin FUNCTION Ercosek_SC "" /begin DEF_CHARACTERISTIC /end DEF_CHARACTERISTIC /begin REF_CHARACTERISTIC /end REF_CHARACTERISTIC /begin IN_MEASUREMENT /end IN_MEASUREMENT /begin OUT_MEASUREMENT /end OUT_MEASUREMENT /end FUNCTION
/begin FUNCTION Fahrzeuggeschwindigkeit ""
 /begin DEF_CHARACTERISTIC KL_V_MAX_GANG_BEGRENZT KL_V_MAX_GANG_CABRIO KL_V_MAX_GANG_COUPE KL_V_MAX_GANG_LIMOUSINE KL_V_MAX_GANG_TOURING KL_V_MAX_SK K_V_MAX_ANH_KM_STAND K_V_MAX_ANH_MAX_CNT K_V_MAX_FF_RESET K_V_MAX_MAX K_V_RAD_TOL_CFG K_V_RAD_TOL_TAU /end DEF_CHARACTERISTIC
 /begin REF_CHARACTERISTIC /end REF_CHARACTERISTIC
 /begin IN_MEASUREMENT /end IN_MEASUREMENT
 /begin OUT_MEASUREMENT /end OUT_MEASUREMENT
/end FUNCTION
/begin FUNCTION Flashservice "" /begin DEF_CHARACTERISTIC /end DEF_CHARACTERISTIC /begin REF_CHARACTERISTIC /end REF_CHARACTERISTIC /begin IN_MEASUREMENT /end IN_MEASUREMENT /begin OUT_MEASUREMENT /end OUT_MEASUREMENT /end FUNCTION
/begin FUNCTION Generator-Module ""
 /begin DEF_CHARACTERISTIC KL_GENLDST K_APPUPLLDST K_DFS_MAX K_DFS_MIN K_DFS_MITT K_GENLDDFMAX K_MSKGENDFP K_TNNSTART /end DEF_CHARACTERISTIC
 /begin REF_CHARACTERISTIC /end REF_CHARACTERISTIC
 /begin IN_MEASUREMENT /end IN_MEASUREMENT
 /begin OUT_MEASUREMENT /end OUT_MEASUREMENT
/end FUNCTION
/begin FUNCTION Getriebetemperatur ""
 /begin DEF_CHARACTERISTIC KL_TGETR_NTC K_TGETR_CC_HIGH K_TGETR_CC_HYST K_TGETR_DIAG_MAX K_TGETR_DIAG_MIN K_TGETR_DIAG_TUMG_MIN K_TGETR_TAU /end DEF_CHARACTERISTIC
 /begin REF_CHARACTERISTIC /end REF_CHARACTERISTIC
 /begin IN_MEASUREMENT /end IN_MEASUREMENT
 /begin OUT_MEASUREMENT /end OUT_MEASUREMENT
/end FUNCTION
/begin FUNCTION Global "" /begin DEF_CHARACTERISTIC /end DEF_CHARACTERISTIC /begin REF_CHARACTERISTIC /end REF_CHARACTERISTIC /begin IN_MEASUREMENT /end IN_MEASUREMENT /begin OUT_MEASUREMENT /end OUT_MEASUREMENT /end FUNCTION
/begin FUNCTION HFM ""
 /begin DEF_CHARACTERISTIC KF_HFM_KORR_ML_TAN KF_HFM_KORR_N_RF KF_HFM_TAU KL_HFM_ANZ_SEG_N KL_HFM_FAK_S65_B1 KL_HFM_FAK_S65_B2 KL_HFM_KORR_ML_FZG KL_HFM_KORR_ML_PST KL_RF_PUMG_KORR KL_RF_TANZYL_KORR KL_RF_TAN_KORR K_HFM_DIAG_ML_MAX K_HFM_DIAG_ML_MIN K_HFM_ERSATZ K_HFM_KL_CFG K_HFM_MVAC_CFG K_HFM_N_RF_KORR_CFG K_HFM_OBD_DYN_DELTA_RF K_HFM_OBD_DYN_RF_T /end DEF_CHARACTERISTIC
 /begin REF_CHARACTERISTIC /end REF_CHARACTERISTIC
 /begin IN_MEASUREMENT /end IN_MEASUREMENT
 /begin OUT_MEASUREMENT /end OUT_MEASUREMENT
/end FUNCTION
/begin FUNCTION INJ-TB "" /begin DEF_CHARACTERISTIC /end DEF_CHARACTERISTIC /begin REF_CHARACTERISTIC /end REF_CHARACTERISTIC /begin IN_MEASUREMENT /end IN_MEASUREMENT /begin OUT_MEASUREMENT /end OUT_MEASUREMENT /end FUNCTION
/begin FUNCTION Inter_Prozessor_Kommunikation "" /begin DEF_CHARACTERISTIC /end DEF_CHARACTERISTIC /begin REF_CHARACTERISTIC /end REF_CHARACTERISTIC /begin IN_MEASUREMENT /end IN_MEASUREMENT /begin OUT_MEASUREMENT /end OUT_MEASUREMENT /end FUNCTION
/begin FUNCTION KFIPOL "" /begin DEF_CHARACTERISTIC /end DEF_CHARACTERISTIC /begin REF_CHARACTERISTIC /end REF_CHARACTERISTIC /begin IN_MEASUREMENT /end IN_MEASUREMENT /begin OUT_MEASUREMENT /end OUT_MEASUREMENT /end FUNCTION
/begin FUNCTION KGE ""
 /begin DEF_CHARACTERISTIC KL_KGE_MIN_INTG_B1 KL_KGE_MIN_INTG_B2 KL_KGE_OZ_NIVR_KOR K_KGE_AX_BERG K_KGE_AY K_KGE_HFM_TAU K_KGE_LL_T_DELAY K_KGE_LL_T_DIAG K_KGE_OZ_NIVR_MAX K_KGE_OZ_NIVR_MIN K_KGE_PUMG_MAX K_KGE_RSTART_T K_KGE_SEG_IDX_INTG_1of2_ K_KGE_SEG_IDX_INTG_2of2_ K_KGE_TIME_ML K_KGE_TMOT K_KGE_TOEL /end DEF_CHARACTERISTIC
 /begin REF_CHARACTERISTIC /end REF_CHARACTERISTIC
 /begin IN_MEASUREMENT /end IN_MEASUREMENT
 /begin OUT_MEASUREMENT /end OUT_MEASUREMENT
/end FUNCTION
/begin FUNCTION KT_IBS "" /begin DEF_CHARACTERISTIC /end DEF_CHARACTERISTIC /begin REF_CHARACTERISTIC /end REF_CHARACTERISTIC /begin IN_MEASUREMENT /end IN_MEASUREMENT /begin OUT_MEASUREMENT /end OUT_MEASUREMENT /end FUNCTION
/begin FUNCTION KWP-Jobs "" /begin DEF_CHARACTERISTIC /end DEF_CHARACTERISTIC /begin REF_CHARACTERISTIC /end REF_CHARACTERISTIC /begin IN_MEASUREMENT /end IN_MEASUREMENT /begin OUT_MEASUREMENT /end OUT_MEASUREMENT /end FUNCTION
/begin FUNCTION KWP-Programmierung "" /begin DEF_CHARACTERISTIC /end DEF_CHARACTERISTIC /begin REF_CHARACTERISTIC /end REF_CHARACTERISTIC /begin IN_MEASUREMENT /end IN_MEASUREMENT /begin OUT_MEASUREMENT /end OUT_MEASUREMENT /end FUNCTION
/begin FUNCTION Katschutz ""
 /begin DEF_CHARACTERISTIC KL_KATS_LAM_I KL_KATS_MDL_LAM_OFFS KL_KATS_NKAT_LAM_OFFS KL_KATS_VKAT_LAM_OFFS K_KATS_CFG K_KATS_I_MAX K_KATS_I_MIN K_KATS_LAM_GRAD_NEG K_KATS_LAM_GRAD_POS K_KATS_LAM_MIN K_KATS_LAM_P_DELTA_MAX K_KATS_TKAT_MESS_MAX K_KATS_T_LAM_MIN K_KATS_T_MAX K_KATS_T_MAX_PST /end DEF_CHARACTERISTIC
 /begin REF_CHARACTERISTIC /end REF_CHARACTERISTIC
 /begin IN_MEASUREMENT /end IN_MEASUREMENT
 /begin OUT_MEASUREMENT /end OUT_MEASUREMENT
/end FUNCTION
/begin FUNCTION Kraftstoffdruckregelung ""
 /begin DEF_CHARACTERISTIC KF_PKSR_PSOLL_QSOLL_TV KF_PKSR_RF_N_PSOLL KL_PKSR_100P_DAUER_TMOT KL_PKSR_I_FAKTOR KL_PKSR_P_FAKTOR KL_PKSR_QSSP_PKS KL_PKSR_TKSM_PSOLL KL_PKSR_TV_HARDWARE K_PKSR_ADAP_DELTA_FAK K_PKSR_ADAP_DELTA_OFF K_PKSR_ADAP_DIAG_T K_PKSR_ADAP_FAK_MAX K_PKSR_ADAP_FAK_MIN K_PKSR_ADAP_FAK_ML_MIN K_PKSR_ADAP_FAK_N_MIN K_PKSR_ADAP_OFF_MAX K_PKSR_ADAP_OFF_MIN K_PKSR_ADAP_OFF_ML_MAX K_PKSR_ADAP_OFF_N_MAX K_PKSR_ADAP_OFF_N_NORM K_PKSR_ADAP_RESET K_PKSR_CFG K_PKSR_DIAG K_PKSR_EKP_100_PSOLL_RAMPE K_PKSR_EKP_VORL_RESET K_PKSR_EXD_DELTA_P_VL K_PKSR_EXD_DELTA_P_VL_FE K_PKSR_EXD_DELTA_TV K_PKSR_EXD_EKP1_TV_MAX K_PKSR_EXD_FSTLITH_MIN K_PKSR_EXD_NMAX K_PKSR_EXD_PDELTA_DR K_PKSR_EXD_PDIF_T_ADAP K_PKSR_EXD_P_GRAD_REL K_PKSR_EXD_TAU_PDIF_PL K_PKSR_EXD_TAU_PKS_PL K_PKSR_EXD_TV_65 K_PKSR_EXD_V_SSPLITH K_PKSR_I_ANTEIL_MAX K_PKSR_I_ANTEIL_MIN K_PKSR_MAX_TV_GEREGELT K_PKSR_MLSOLL_EKP2 K_PKSR_MLSOLL_HYS_EKP2 K_PKSR_N_EKP2 K_PKSR_N_HYS_EKP2 K_PKSR_PERIOD K_PKSR_PSOLL_MECH K_PKSR_P_SSP_SA K_PKSR_TMIN_EKP2 K_PKSR_TV_DIAG K_PKSR_T_ABST K_PKSR_T_VORLAUF K_PKS_OBD_SOLL_DYN_TAU /end DEF_CHARACTERISTIC
 /begin REF_CHARACTERISTIC /end REF_CHARACTERISTIC
 /begin IN_MEASUREMENT /end IN_MEASUREMENT
 /begin OUT_MEASUREMENT /end OUT_MEASUREMENT
/end FUNCTION
/begin FUNCTION Kurbelwelle ""
 /begin DEF_CHARACTERISTIC K_KW_ED_DELTA_N K_KW_ED_DELTA_N_RATE K_KW_ED_DELTA_U K_KW_ED_MAX_RATE K_KW_ED_N_DROP K_KW_ED_N_DROP_RATE K_KW_ED_SH_TO_GND_RATE K_KW_ED_SH_TO_UB_RATE /end DEF_CHARACTERISTIC
 /begin REF_CHARACTERISTIC /end REF_CHARACTERISTIC
 /begin IN_MEASUREMENT /end IN_MEASUREMENT
 /begin OUT_MEASUREMENT /end OUT_MEASUREMENT
/end FUNCTION
/begin FUNCTION LAVK-OBD ""
 /begin DEF_CHARACTERISTIC KL_KSD_OBD_OEL_DEC KL_KSD_OBD_OEL_INC K_KSD_OBD_CFG K_KSD_OBD_DIAG_T K_KSD_OBD_LL_LAM_MAX K_KSD_OBD_LL_LAM_MIN K_KSD_OBD_LL_MAX_T K_KSD_OBD_LL_MIN_T K_KSD_OBD_N_MAX K_KSD_OBD_N_MIN K_KSD_OBD_OEL_SPERR_MAX K_KSD_OBD_PUMG_MIN K_KSD_OBD_RF_MAX K_KSD_OBD_RF_MIN K_KSD_OBD_TAN K_KSD_OBD_TL_LAM_MAX K_KSD_OBD_TL_LAM_MIN K_KSD_OBD_TL_MAX_T K_KSD_OBD_TL_MIN_T K_KSD_OBD_TMOT_MIN K_KSD_OBD_T_ML K_KSD_OBD_V K_LAVK_OBD_ACT_CFG K_LAVK_OBD_ACT_EXD_N_SOLL K_LAVK_OBD_ACT_EXD_TIME K_LAVK_OBD_ACT_F_T K_LAVK_OBD_ACT_LAM_IST_F K_LAVK_OBD_ACT_LAM_IST_M K_LAVK_OBD_ACT_LAM_SOLL_F K_LAVK_OBD_ACT_LAM_SOLL_M K_LAVK_OBD_ACT_LANK_F K_LAVK_OBD_ACT_LANK_M K_LAVK_OBD_ACT_ML_SUM K_LAVK_OBD_ACT_M_T K_LAVK_OBD_ACT_NK_F_CNT K_LAVK_OBD_ACT_NK_M_CNT K_LAVK_OBD_ACT_N_MAX K_LAVK_OBD_ACT_N_MIN K_LAVK_OBD_ACT_RF_MAX K_LAVK_OBD_ACT_RF_MIN K_LAVK_OBD_ACT_TKAT K_LAVK_OBD_ACT_TRIM_F K_LAVK_OBD_ACT_TRIM_M K_LAVK_OBD_ACT_VK_F_CNT K_LAVK_OBD_ACT_VK_M_CNT K_LAVK_OBD_PLAU_CFG K_LAVK_OBD_PLAU_F_CNT K_LAVK_OBD_PLAU_IP_N_MAX K_LAVK_OBD_PLAU_IP_N_MIN K_LAVK_OBD_PLAU_IP_REG_MAX K_LAVK_OBD_PLAU_IP_REG_MIN K_LAVK_OBD_PLAU_IP_STABIL_T K_LAVK_OBD_PLAU_LAM_FETT K_LAVK_OBD_PLAU_LAM_MAGER K_LAVK_OBD_PLAU_LAM_MAX K_LAVK_OBD_PLAU_LAM_MIN K_LAVK_OBD_PLAU_LANK_MAX K_LAVK_OBD_PLAU_LANK_MIN K_LAVK_OBD_PLAU_ML_SUM K_LAVK_OBD_PLAU_M_CNT K_LAVK_OBD_PLAU_OL_CNT K_LAVK_OBD_PLAU_RF_MAX K_LAVK_OBD_PLAU_RF_MIN K_LAVK_OBD_PLAU_T K_LAVK_OBD_PLAU_TKAT_MAX K_LAVK_OBD_PLAU_TKAT_MIN K_LAVK_OBD_PLAU_UN_OSZI_OFF K_LAVK_OBD_PLAU_UN_SCHW K_LAVK_OBD_SA_CFG K_LAVK_OBD_SA_CNT K_LAVK_OBD_SA_DIAG_OL K_LAVK_OBD_SA_ML_SUM K_LAVK_OBD_SA_SCHW K_LAVK_OBD_SA_T K_LAVK_OBD_TL_CFG K_LAVK_OBD_TL_CNT K_LAVK_OBD_TL_ML_SUM K_LAVK_OBD_TL_SCHW_MAX K_LAVK_OBD_TL_SCHW_MIN K_LAVK_OBD_TL_T K_LAVK_OBD_TMOT K_LAVK_OBD_VK_TEMP K_LA_OBD_DYN_CNT_INC K_LA_OBD_DYN_DELTA_CNT K_LA_OBD_DYN_DELTA_PUMP_RF K_LA_OBD_DYN_DELTA_RF K_LA_OBD_DYN_RF_T /end DEF_CHARACTERISTIC
 /begin REF_CHARACTERISTIC /end REF_CHARACTERISTIC
 /begin IN_MEASUREMENT /end IN_MEASUREMENT
 /begin OUT_MEASUREMENT /end OUT_MEASUREMENT
/end FUNCTION
/begin FUNCTION LSHNK ""
 /begin DEF_CHARACTERISTIC KF_LSHVK_TEMP_SOLL KF_LSHVK_TV_KORR_MAX KF_LSHVK_TV_VORST KL_LSHNK_RF_AUS KL_LSHNK_SOND_TEMP KL_LSHNK_TA KL_LSHNK_T_EIN KL_LSHVK_DIAG_TIME_ML KL_LSHVK_R_MESS_F KL_LSHVK_R_MESS_OFFS KL_LSHVK_SOND_TEMP KL_LSHVK_TEMP_IST_HIGH KL_LSHVK_TEMP_IST_LOW KL_LSHVK_TEMP_SOLL_MS KL_LSHVK_UEFF_MAX KL_LSRVK_OBD_START_TML KL_LSRVK_OBD_TML K_LSHNK_AKTIV_T K_LSHNK_DIAG_CFG K_LSHNK_DIAG_RO K_LSHNK_DIAG_RU K_LSHNK_DIAG_R_TAU K_LSHNK_DIAG_TAUP_T K_LSHNK_RF_HYS K_LSHNK_TAUP K_LSHNK_TA_MAX K_LSHNK_TKAT_MAX K_LSHNK_UB_MAX K_LSHVK_AD_TEST K_LSHVK_CFG K_LSHVK_DIAG_ANZ_MESS K_LSHVK_DIAG_CFG K_LSHVK_DIAG_RO K_LSHVK_DIAG_RU K_LSHVK_DIAG_R_ADAPT K_LSHVK_DIAG_R_OFFSET K_LSHVK_DIAG_R_TAU K_LSHVK_DIAG_TEMP_IST_MAX K_LSHVK_DIAG_TEMP_IST_MIN K_LSHVK_REG_K K_LSHVK_REG_TN K_LSHVK_RI_RANGE_SCHW K_LSHVK_R_AD_GAIN_CNT K_LSHVK_R_AD_GAIN_CNT_MIN K_LSHVK_R_AD_GAIN_GRAD K_LSHVK_R_AD_GAIN_MAX K_LSHVK_R_AD_GAIN_MIN K_LSHVK_R_AD_GAIN_NV_MAX K_LSHVK_R_AD_GAIN_NV_MIN K_LSHVK_R_AD_GAIN_T K_LSHVK_R_AD_GAIN_T1 K_LSHVK_R_AD_OFFS_CNT K_LSHVK_R_AD_OFFS_CNT_MIN K_LSHVK_R_AD_OFFS_GRAD K_LSHVK_R_AD_OFFS_MAX K_LSHVK_R_AD_OFFS_MIN K_LSHVK_R_AD_OFFS_NV_MAX K_LSHVK_R_AD_OFFS_NV_MIN K_LSHVK_R_AD_OFFS_T K_LSHVK_R_AD_OFFS_T1 K_LSHVK_R_AD_RESET K_LSHVK_R_REF K_LSHVK_R_REF_OFFS K_LSHVK_TABG_HYS K_LSHVK_TEMP_DIF_ZUL K_LSHVK_TEMP_FILT_TAU K_LSHVK_TEMP_IST_ENABLE_IP_LOOP K_LSHVK_TEMP_IST_SCHW K_LSHVK_TEMP_MAX K_LSHVK_TEMP_MIN K_LSHVK_TEMP_REG_MIN K_LSHVK_TV_KORR_MIN K_LSHVK_T_KL15_MAX K_LSHVK_UB_MAX K_LSHVK_UB_NORM K_LSHVK_UEFF_GRAD K_LSHVK_WSS_CFG K_LSH_UB_TAU K_LSRVK_OBD_CFG K_LSRVK_OBD_ML_SUM K_LSRVK_OBD_REF_CNT K_LSRVK_OBD_REF_GAIN_MAX K_LSRVK_OBD_REF_GAIN_MIN K_LSRVK_OBD_REF_OFFS_CNT K_LSRVK_OBD_REF_OFFS_MAX K_LSRVK_OBD_REF_OFFS_MIN K_LSRVK_OBD_REG_T K_LSRVK_OBD_START_R K_LSRVK_OBD_TKAT_MAX K_LSRVK_OBD_TKAT_MIN /end DEF_CHARACTERISTIC
 /begin REF_CHARACTERISTIC /end REF_CHARACTERISTIC
 /begin IN_MEASUREMENT /end IN_MEASUREMENT
 /begin OUT_MEASUREMENT /end OUT_MEASUREMENT
/end FUNCTION
/begin RECORD_LAYOUT TKW_VV_VV_UB FNC_VALUES 1 UBYTE COLUMN_DIR DIRECT /end RECORD_LAYOUT
/begin RECORD_LAYOUT TKW_VV_VV_SB FNC_VALUES 1 SBYTE COLUMN_DIR DIRECT /end RECORD_LAYOUT
/begin RECORD_LAYOUT TKW_VV_VV_UW FNC_VALUES 1 UWORD COLUMN_DIR DIRECT /end RECORD_LAYOUT
/begin RECORD_LAYOUT TKW_VV_VV_SW FNC_VALUES 1 SWORD COLUMN_DIR DIRECT /end RECORD_LAYOUT
/begin RECORD_LAYOUT TKL_UB_VV_UB NO_AXIS_PTS_X 1 UBYTE RESERVED 2 BYTE AXIS_PTS_X 3 UBYTE INDEX_INCR DIRECT FNC_VALUES 4 UBYTE COLUMN_DIR DIRECT /end RECORD_LAYOUT
/begin RECORD_LAYOUT TKL_UB_VV_SW NO_AXIS_PTS_X 1 UBYTE RESERVED 2 BYTE AXIS_PTS_X 3 UBYTE INDEX_INCR DIRECT FNC_VALUES 4 SWORD COLUMN_DIR DIRECT /end RECORD_LAYOUT
/begin RECORD_LAYOUT TKL_UW_VV_UW NO_AXIS_PTS_X 1 UBYTE RESERVED 2 BYTE AXIS_PTS_X 3 UWORD INDEX_INCR DIRECT FNC_VALUES 4 UWORD COLUMN_DIR DIRECT /end RECORD_LAYOUT
/begin RECORD_LAYOUT TKL_UW_VV_SW NO_AXIS_PTS_X 1 UBYTE RESERVED 2 BYTE AXIS_PTS_X 3 UWORD INDEX_INCR DIRECT FNC_VALUES 4 SWORD COLUMN_DIR DIRECT /end RECORD_LAYOUT
/begin RECORD_LAYOUT TKL_SW_VV_UB NO_AXIS_PTS_X 1 UBYTE RESERVED 2 BYTE AXIS_PTS_X 3 SWORD INDEX_INCR DIRECT FNC_VALUES 4 UBYTE COLUMN_DIR DIRECT /end RECORD_LAYOUT
/begin RECORD_LAYOUT TKL_SW_VV_UW NO_AXIS_PTS_X 1 UBYTE RESERVED 2 BYTE AXIS_PTS_X 3 SWORD INDEX_INCR DIRECT FNC_VALUES 4 UWORD COLUMN_DIR DIRECT /end RECORD_LAYOUT
/begin RECORD_LAYOUT TKL_SW_VV_SW NO_AXIS_PTS_X 1 UBYTE RESERVED 2 BYTE AXIS_PTS_X 3 SWORD INDEX_INCR DIRECT FNC_VALUES 4 SWORD COLUMN_DIR DIRECT /end RECORD_LAYOUT
/begin RECORD_LAYOUT TKF_UW_UW_UW NO_AXIS_PTS_X 1 UBYTE NO_AXIS_PTS_Y 2 UBYTE AXIS_PTS_X 3 UWORD INDEX_INCR DIRECT AXIS_PTS_Y 4 UWORD INDEX_INCR DIRECT FNC_VALUES 5 UWORD COLUMN_DIR DIRECT /end RECORD_LAYOUT
/begin RECORD_LAYOUT TKF_SW_SW_UB NO_AXIS_PTS_X 1 UBYTE NO_AXIS_PTS_Y 2 UBYTE AXIS_PTS_X 3 SWORD INDEX_INCR DIRECT AXIS_PTS_Y 4 SWORD INDEX_INCR DIRECT FNC_VALUES 5 UBYTE COLUMN_DIR DIRECT /end RECORD_LAYOUT
/begin RECORD_LAYOUT TKF_SW_SW_UW NO_AXIS_PTS_X 1 UBYTE NO_AXIS_PTS_Y 2 UBYTE AXIS_PTS_X 3 SWORD INDEX_INCR DIRECT AXIS_PTS_Y 4 SWORD INDEX_INCR DIRECT FNC_VALUES 5 UWORD COLUMN_DIR DIRECT /end RECORD_LAYOUT
/begin RECORD_LAYOUT TKF_SW_SW_SW NO_AXIS_PTS_X 1 UBYTE NO_AXIS_PTS_Y 2 UBYTE AXIS_PTS_X 3 SWORD INDEX_INCR DIRECT AXIS_PTS_Y 4 SWORD INDEX_INCR DIRECT FNC_VALUES 5 SWORD COLUMN_DIR DIRECT /end RECORD_LAYOUT
/end MODULE
/end PROJECT
