/begin PROJECT MSS65-inj-V912 "MSS65 INJ - V912.00-B204.00, data set 0569Q60Z520E"
/begin HEADER "" VERSION "V912.00-B204.00" /end HEADER
/begin MODULE _MSS65-inj "MSS65 INJ - V912.00-B204.00, data 7842800"
/begin MOD_COMMON "" BYTE_ORDER MSB_FIRST /* Default byteorder (Motorola) */ /end MOD_COMMON
/begin COMPU_METHOD FORMULA_0001 "FORMULA_0001" RAT_FUNC "%6.1" "%" COEFFS 0 10 0 0 0 1 /end COMPU_METHOD
/begin COMPU_METHOD FORMULA_0003 "FORMULA_0003" RAT_FUNC "%3.0" "-" COEFFS 0 1 0 0 0 1 /end COMPU_METHOD
/begin COMPU_METHOD FORMULA_0006 "FORMULA_0006" RAT_FUNC "%5.0" "Upm" COEFFS 0 1 0 0 0 1 /end COMPU_METHOD
/begin COMPU_METHOD FORMULA_0007 "FORMULA_0007" RAT_FUNC "%8.3" "-" COEFFS 0 10000 0 0 0 1 /end COMPU_METHOD
/begin COMPU_METHOD FORMULA_0008 "FORMULA_0008" RAT_FUNC "%6.1" "V" COEFFS 0 10 0 0 0 1 /end COMPU_METHOD
/begin COMPU_METHOD FORMULA_0010 "FORMULA_0010" RAT_FUNC "%5.0" "-" COEFFS 0 1 0 0 0 1 /end COMPU_METHOD
/begin COMPU_METHOD FORMULA_0021 "FORMULA_0021" RAT_FUNC "%7.2" "s" COEFFS 0 100 0 0 0 1 /end COMPU_METHOD
/* ------------------ Abschnitt erzeugt aus adapt_glob.dat ------------------ */
/begin COMPU_METHOD FORMULA_0023 "FORMULA_0023" RAT_FUNC "%6.1" "�C" COEFFS 0 10 2732 0 0 1 /end COMPU_METHOD
/begin COMPU_METHOD FORMULA_0025 "FORMULA_0025" RAT_FUNC "%8.3" "-" COEFFS 0 16384 0 0 0 1 /end COMPU_METHOD
/begin COMPU_METHOD FORMULA_0032 "FORMULA_0032" RAT_FUNC "%3.0" "%" COEFFS 0 1 0 0 0 1 /end COMPU_METHOD
/begin COMPU_METHOD FORMULA_0033 "FORMULA_0033" RAT_FUNC "%5.2" "-" COEFFS 0 1 0 0 0 1 /end COMPU_METHOD
/begin COMPU_METHOD FORMULA_0062 "FORMULA_0062" RAT_FUNC "%5.0" "s" COEFFS 0 1 0 0 0 1 /end COMPU_METHOD
/begin COMPU_METHOD FORMULA_0073 "FORMULA_0073" RAT_FUNC "%6.1" "s" COEFFS 0 10 0 0 0 1 /end COMPU_METHOD
/begin COMPU_METHOD FORMULA_0075 "FORMULA_0075" RAT_FUNC "%8.3" "-" COEFFS 0 1024 0 0 0 1 /end COMPU_METHOD
/begin COMPU_METHOD FORMULA_0077 "FORMULA_0077" RAT_FUNC "%6.1" "mbar" COEFFS 0 16 0 0 0 1 /end COMPU_METHOD
/begin COMPU_METHOD FORMULA_0079 "FORMULA_0079" RAT_FUNC "%6.1" "l" COEFFS 0 2 0 0 0 1 /end COMPU_METHOD
/begin COMPU_METHOD FORMULA_0109 "FORMULA_0109" RAT_FUNC "%7.2" "-" COEFFS 0 10000 0 0 0 1 /end COMPU_METHOD
/begin COMPU_METHOD FORMULA_0111 "FORMULA_0111" RAT_FUNC "%6.1" "�KW" COEFFS 0 10 0 0 0 1 /end COMPU_METHOD
/begin COMPU_METHOD FORMULA_0112 "FORMULA_0112" RAT_FUNC "%6.1" "kg/h" COEFFS 0 10 0 0 0 1 /end COMPU_METHOD
/begin COMPU_METHOD FORMULA_0113 "FORMULA_0113" RAT_FUNC "%6.1" "mg/asp" COEFFS 0 10 0 0 0 1 /end COMPU_METHOD
/begin COMPU_METHOD FORMULA_0115 "FORMULA_0115" RAT_FUNC "%7.2" "%" COEFFS 0 16384 0 0 0 100 /end COMPU_METHOD
/begin COMPU_METHOD FORMULA_0118 "FORMULA_0118" RAT_FUNC "%8.3" "bar" COEFFS 0 1000 0 0 0 1 /end COMPU_METHOD
/begin COMPU_METHOD FORMULA_0123 "FORMULA_0123" RAT_FUNC "%5.0" "digit" COEFFS 0 1 0 0 0 1 /end COMPU_METHOD
/begin COMPU_METHOD FORMULA_0132 "FORMULA_0132" RAT_FUNC "%7.2" "m/(s*s)" COEFFS 0 40 0 0 0 1 /end COMPU_METHOD
/begin COMPU_METHOD FORMULA_0147 "FORMULA_0147" RAT_FUNC "%6.1" "qmm" COEFFS 0 10 0 0 0 1 /end COMPU_METHOD
/begin COMPU_METHOD FORMULA_0317 "FORMULA_0317" RAT_FUNC "%5.2" "s" COEFFS 0 100 0 0 0 1 /end COMPU_METHOD
/* ------------------ Abschnitt erzeugt aus pctrl.dat ------------------ */
/begin COMPU_METHOD FORMULA_0352 "FORMULA_0352" RAT_FUNC "%5.2" "s" COEFFS 0 200 0 0 0 1 /end COMPU_METHOD
/begin COMPU_METHOD FORMULA_0353 "FORMULA_0353" RAT_FUNC "%3.0" "ms" COEFFS 0 1 0 0 0 10 /end COMPU_METHOD
/begin COMPU_METHOD FORMULA_0356 "FORMULA_0356" RAT_FUNC "%3.0" "us" COEFFS 0 1 0 0 0 1 /end COMPU_METHOD
/begin COMPU_METHOD FORMULA_0357 "FORMULA_0357" TAB_VERB "%5.2" "-" COMPU_TAB_REF FORMULA_0357_VTAB /end COMPU_METHOD
/begin COMPU_VTAB FORMULA_0357_VTAB "FORMULA_0357_VTAB" TAB_VERB 2 0 "Aus" 1 "Ein" /end COMPU_VTAB
/begin COMPU_METHOD FORMULA_0363 "FORMULA_0363" TAB_VERB "%5.2" "-" COMPU_TAB_REF FORMULA_0363_VTAB /end COMPU_METHOD
/begin COMPU_VTAB FORMULA_0363_VTAB "FORMULA_0363_VTAB" TAB_VERB 2 0 "SK aus" 1 "SK aktiv" /end COMPU_VTAB
/begin COMPU_METHOD FORMULA_0364 "FORMULA_0364" TAB_VERB "%3.0" "-" COMPU_TAB_REF FORMULA_0364_VTAB /end COMPU_METHOD
/begin COMPU_VTAB FORMULA_0364_VTAB "FORMULA_0364_VTAB" TAB_VERB 5 0 "Aus" 1 "MVAC" 2 "ELUP" 3 "MVAC+ELUP" 6 "System" /end COMPU_VTAB
/begin COMPU_METHOD FORMULA_0365 "FORMULA_0365" TAB_VERB "%3.0" "-" COMPU_TAB_REF FORMULA_0365_VTAB /end COMPU_METHOD
/begin COMPU_VTAB FORMULA_0365_VTAB "FORMULA_0365_VTAB" TAB_VERB 8 0 "Inaktiv" 1 "D-CRC" 2 "P-CRC" 3 "PD-CRC" 4 "B-CRC" 5 "BD-CRC" 6 "BP-CRC" 7 "BPD-CRC" /end COMPU_VTAB
/begin COMPU_METHOD FORMULA_0366 "FORMULA_0366" TAB_VERB "%3.0" "-" COMPU_TAB_REF FORMULA_0366_VTAB /end COMPU_METHOD
/begin COMPU_VTAB FORMULA_0366_VTAB "FORMULA_0366_VTAB" TAB_VERB 8 0 "alle an" 3 "LA" 12 "LAA" 15 "LA+LAA" 48 "Mager" 51 "LA+Mager" 60 "LAA+Mager" 63 "LA+LAA+Mager" /end COMPU_VTAB
/begin COMPU_METHOD FORMULA_0367 "FORMULA_0367" TAB_VERB "%3.0" "-" COMPU_TAB_REF FORMULA_0367_VTAB /end COMPU_METHOD
/begin COMPU_VTAB FORMULA_0367_VTAB "FORMULA_0367_VTAB" TAB_VERB 8 0 "alle an" 1 "LA" 2 "LAA" 3 "LA+LAA" 4 "Mager" 5 "LA+Mager" 6 "LAA+Mager" 7 "LA+LAA+Mager" /end COMPU_VTAB
/begin COMPU_METHOD FORMULA_0368 "FORMULA_0368" TAB_VERB "%3.0" "-" COMPU_TAB_REF FORMULA_0368_VTAB /end COMPU_METHOD
/begin COMPU_VTAB FORMULA_0368_VTAB "FORMULA_0368_VTAB" TAB_VERB 2 0 "aktiv" 1 "gesperrt" /end COMPU_VTAB
/* ------------------ Abschnitt erzeugt aus sw_confg.dat ------------------ */
/begin COMPU_METHOD FORMULA_0371 "FORMULA_0371" TAB_VERB "%7.2" "-" COMPU_TAB_REF FORMULA_0371_VTAB /end COMPU_METHOD
/begin COMPU_VTAB FORMULA_0371_VTAB "FORMULA_0371_VTAB" TAB_VERB 5 8192 "S65" 8448 "S65FLACH" 8704 "S65V" 256 "S15" 16384 "S85" DEFAULT_VALUE "undefiniert" /end COMPU_VTAB
/begin COMPU_METHOD FORMULA_0372 "FORMULA_0372" TAB_VERB "%5.2" "-" COMPU_TAB_REF FORMULA_0372_VTAB /end COMPU_METHOD
/begin COMPU_VTAB FORMULA_0372_VTAB "FORMULA_0372_VTAB" TAB_VERB 7 16 "E60" 17 "E63" 18 "E64" 32 "E65" 64 "E85" 128 "E90" 129 "E91" DEFAULT_VALUE "undefiniert" /end COMPU_VTAB
/begin COMPU_METHOD FORMULA_0373 "FORMULA_0373" TAB_VERB "%5.2" "-" COMPU_TAB_REF FORMULA_0373_VTAB /end COMPU_METHOD
/begin COMPU_VTAB FORMULA_0373_VTAB "FORMULA_0373_VTAB" TAB_VERB 3 16 "HS" 64 "SMG" 128 "DKG" DEFAULT_VALUE "undefiniert" /end COMPU_VTAB
/begin COMPU_METHOD FORMULA_0374 "FORMULA_0374" TAB_VERB "%5.2" "-" COMPU_TAB_REF FORMULA_0374_VTAB /end COMPU_METHOD
/begin COMPU_VTAB FORMULA_0374_VTAB "FORMULA_0374_VTAB" TAB_VERB 5 1 "ECE" 2 "US" 4 "Golfstaaten" 8 "ZA" 16 "JAPAN" DEFAULT_VALUE "undefiniert" /end COMPU_VTAB
/begin COMPU_METHOD FORMULA_0375 "FORMULA_0375" TAB_VERB "%5.2" "-" COMPU_TAB_REF FORMULA_0375_VTAB /end COMPU_METHOD
/begin COMPU_VTAB FORMULA_0375_VTAB "FORMULA_0375_VTAB" TAB_VERB 6 16 "EU3" 17 "EU4" 1 "D4" 32 "LEV" 33 "LEV2" 34 "ULEV" DEFAULT_VALUE "undefiniert" /end COMPU_VTAB
/begin COMPU_METHOD FORMULA_0376 "FORMULA_0376" TAB_VERB "%5.2" "-" COMPU_TAB_REF FORMULA_0376_VTAB /end COMPU_METHOD
/begin COMPU_VTAB FORMULA_0376_VTAB "FORMULA_0376_VTAB" TAB_VERB 3 1 "MIL_OFF" 2 "MIL_FSP" 4 "MIL_ON" DEFAULT_VALUE "undefiniert" /end COMPU_VTAB
/begin COMPU_METHOD FORMULA_0377 "FORMULA_0377" TAB_VERB "%5.2" "-" COMPU_TAB_REF FORMULA_0377_VTAB /end COMPU_METHOD
/begin COMPU_VTAB FORMULA_0377_VTAB "FORMULA_0377_VTAB" TAB_VERB 2 128 "Serienstand" 1 "Entwicklung" DEFAULT_VALUE "undefiniert" /end COMPU_VTAB
/begin COMPU_METHOD FORMULA_0378 "FORMULA_0378" TAB_VERB "%5.2" "-" COMPU_TAB_REF FORMULA_0378_VTAB /end COMPU_METHOD
/begin COMPU_VTAB FORMULA_0378_VTAB "FORMULA_0378_VTAB" TAB_VERB 2 1 "CAN 11H" 2 "CAN 12H" DEFAULT_VALUE "undefiniert" /end COMPU_VTAB
/begin COMPU_METHOD FORMULA_0379 "FORMULA_0379" TAB_VERB "%5.2" "-" COMPU_TAB_REF FORMULA_0379_VTAB /end COMPU_METHOD
/begin COMPU_VTAB FORMULA_0379_VTAB "FORMULA_0379_VTAB" TAB_VERB 3 0 "Fz-Betrieb" 1 "Pruefstand" 2 "Rolle" /end COMPU_VTAB
/begin COMPU_METHOD FORMULA_0380 "FORMULA_0380" TAB_VERB "%5.2" "-" COMPU_TAB_REF FORMULA_0380_VTAB /end COMPU_METHOD
/begin COMPU_VTAB FORMULA_0380_VTAB "FORMULA_0380_VTAB" TAB_VERB 4 0 "auto Erkennung" 1 "ApplDFlash, rest auto" 2 "ETH aus, rest auto" 3 "ApplDFlash, ETH aus" DEFAULT_VALUE "ungueltig" /end COMPU_VTAB
/begin COMPU_METHOD FORMULA_0381 "FORMULA_0381" TAB_VERB "%5.2" "-" COMPU_TAB_REF FORMULA_0381_VTAB /end COMPU_METHOD
/begin COMPU_VTAB FORMULA_0381_VTAB "FORMULA_0381_VTAB" TAB_VERB 2 0 "Teves" 1 "Bosch" /end COMPU_VTAB
/begin COMPU_METHOD FORMULA_0382 "FORMULA_0382" TAB_VERB "%5.2" "-" COMPU_TAB_REF FORMULA_0382_VTAB /end COMPU_METHOD
/begin COMPU_VTAB FORMULA_0382_VTAB "FORMULA_0382_VTAB" TAB_VERB 3 0 "Aus" 1 "dSPACE" 2 "noLoop" /end COMPU_VTAB
/begin COMPU_METHOD FORMULA_0426 "FORMULA_0426" RAT_FUNC "%5.0" "�C" COEFFS 0 10 0 0 0 1 /end COMPU_METHOD
/begin COMPU_METHOD FORMULA_0427 "FORMULA_0427" RAT_FUNC "%6.1" "V" COEFFS 0 1 0 0 0 0.0942 /end COMPU_METHOD
/begin COMPU_METHOD FORMULA_0433 "FORMULA_0433" RAT_FUNC "%7.2" "%" COEFFS 0 65536 0 0 0 100 /end COMPU_METHOD
/begin COMPU_METHOD FORMULA_0434 "FORMULA_0434" RAT_FUNC "%5.2" "-" COEFFS 0 256 0 0 0 1 /end COMPU_METHOD
/begin COMPU_METHOD FORMULA_0447 "FORMULA_0447" RAT_FUNC "%5.2" "-" COEFFS 0 256 0 0 0 8 /end COMPU_METHOD
/begin COMPU_METHOD FORMULA_0455 "FORMULA_0455" RAT_FUNC "%5.2" "-" COEFFS 0 256 0 0 0 32 /end COMPU_METHOD
/* ------------------ Abschnitt erzeugt aus dgen.dat ------------------ */
/begin COMPU_METHOD FORMULA_0458 "FORMULA_0458" RAT_FUNC "%4.1" "s" COEFFS 0 10 0 0 0 1 /end COMPU_METHOD
/begin COMPU_METHOD FORMULA_0461 "FORMULA_0461" RAT_FUNC "%5.2" "-" COEFFS 0 256 0 0 0 4 /end COMPU_METHOD
/begin COMPU_METHOD FORMULA_0471 "FORMULA_0471" RAT_FUNC "%5.2" "%" COEFFS 0 256 0 0 0 100 /end COMPU_METHOD
/begin COMPU_METHOD FORMULA_0473 "FORMULA_0473" RAT_FUNC "%5.2" "-" COEFFS 0 256 0 0 0 2 /end COMPU_METHOD
/begin COMPU_METHOD FORMULA_0474 "FORMULA_0474" RAT_FUNC "%4.1" "-" COEFFS 0 1 0 0 0 1 /end COMPU_METHOD
/* ------------------ Abschnitt erzeugt aus loadresp.dat ------------------ */
/begin COMPU_METHOD FORMULA_0475 "FORMULA_0475" RAT_FUNC "%7.2" "-" COEFFS 0 32768 0 0 0 100 /end COMPU_METHOD
/* ------------------ Abschnitt erzeugt aus bgcreng.dat ------------------ */
/begin COMPU_METHOD FORMULA_0480 "FORMULA_0480" RAT_FUNC "%7.2" "%" COEFFS 0 65536 0 0 0 512 /end COMPU_METHOD
/* ------------------ Abschnitt erzeugt aus dibs.dat ------------------ */
/begin COMPU_METHOD FORMULA_0483 "FORMULA_0483" RAT_FUNC "%4.1" "-" COEFFS 0 1 0 0 0 1 /end COMPU_METHOD
/begin COMPU_METHOD FORMULA_0488 "FORMULA_0488" RAT_FUNC "%7.2" "s" COEFFS 0 1 0 0 0 56 /end COMPU_METHOD
/begin COMPU_METHOD FORMULA_0490 "FORMULA_0490" RAT_FUNC "%7.2" "s" COEFFS 0 1 0 0 0 14 /end COMPU_METHOD
/begin COMPU_METHOD FORMULA_0494 "FORMULA_0494" RAT_FUNC "%8.3" "Ah" COEFFS 0 989 0 0 0 18 /end COMPU_METHOD
/begin COMPU_METHOD FORMULA_0495 "FORMULA_0495" RAT_FUNC "%7.2" "-" COEFFS 0 32768 0 0 0 50 /end COMPU_METHOD
/begin COMPU_METHOD FORMULA_0497 "FORMULA_0497" RAT_FUNC "%8.3" "" COEFFS 0 -4000 24000 0 0 -1 /end COMPU_METHOD
/begin COMPU_METHOD FORMULA_0501 "FORMULA_0501" RAT_FUNC "%7.2" "" COEFFS 0 4 0 0 0 1 /end COMPU_METHOD
/begin COMPU_METHOD FORMULA_0503 "FORMULA_0503" RAT_FUNC "%8.3" "" COEFFS 0 4 0 0 0 1 /end COMPU_METHOD
/begin COMPU_METHOD FORMULA_0504 "FORMULA_0504" RAT_FUNC "%8.3" "" COEFFS 0 25 5000 0 0 2 /end COMPU_METHOD
/begin COMPU_METHOD FORMULA_0506 "FORMULA_0506" RAT_FUNC "%5.2" "%" COEFFS 0 2 0 0 0 1 /end COMPU_METHOD
/* ------------------ Abschnitt erzeugt aus pmsoccalc.dat ------------------ */
/begin COMPU_METHOD FORMULA_0507 "FORMULA_0507" RAT_FUNC "%8.3" "A" COEFFS 0 50 0 0 0 1 /end COMPU_METHOD
/* ------------------ Abschnitt erzeugt aus pmsocfit.dat ------------------ */
/begin COMPU_METHOD FORMULA_0509 "FORMULA_0509" RAT_FUNC "%6.3" "" COEFFS 0 1000 0 0 0 1 /end COMPU_METHOD
/begin COMPU_METHOD FORMULA_0512 "FORMULA_0512" RAT_FUNC "%6.3" "A" COEFFS 0 256 0 0 0 1000 /end COMPU_METHOD
/* ------------------ Abschnitt erzeugt aus adapt.dat ------------------ */
/begin COMPU_METHOD FORMULA_0513 "FORMULA_0513" TAB_VERB "%3.0" "-" COMPU_TAB_REF FORMULA_0513_VTAB /end COMPU_METHOD
/begin COMPU_VTAB FORMULA_0513_VTAB "FORMULA_0513_VTAB" TAB_VERB 2 0 "ausgeschaltet" 1 "Einschalten" DEFAULT_VALUE "undef" /end COMPU_VTAB
/begin COMPU_METHOD FORMULA_0514 "FORMULA_0514" TAB_VERB "%7.0" "-" COMPU_TAB_REF FORMULA_0514_VTAB /end COMPU_METHOD
/begin COMPU_VTAB FORMULA_0514_VTAB "FORMULA_0514_VTAB" TAB_VERB 2 0 "aus" 1 "ein" /end COMPU_VTAB
/begin COMPU_METHOD FORMULA_0515 "FORMULA_0515" TAB_VERB "%7.0" "-" COMPU_TAB_REF FORMULA_0515_VTAB /end COMPU_METHOD
/begin COMPU_VTAB FORMULA_0515_VTAB "FORMULA_0515_VTAB" TAB_VERB 2 0 "aus" 1 "ein" /end COMPU_VTAB
/begin COMPU_METHOD FORMULA_0516 "FORMULA_0516" TAB_VERB "%7.0" "-" COMPU_TAB_REF FORMULA_0516_VTAB /end COMPU_METHOD
/begin COMPU_VTAB FORMULA_0516_VTAB "FORMULA_0516_VTAB" TAB_VERB 2 0 "aus" 1 "ein" /end COMPU_VTAB
/begin COMPU_METHOD FORMULA_0517 "FORMULA_0517" TAB_VERB "%7.0" "-" COMPU_TAB_REF FORMULA_0517_VTAB /end COMPU_METHOD
/begin COMPU_VTAB FORMULA_0517_VTAB "FORMULA_0517_VTAB" TAB_VERB 2 0 "aus" 1 "ein" /end COMPU_VTAB
/begin COMPU_METHOD FORMULA_0518 "FORMULA_0518" TAB_VERB "%7.0" "-" COMPU_TAB_REF FORMULA_0518_VTAB /end COMPU_METHOD
/begin COMPU_VTAB FORMULA_0518_VTAB "FORMULA_0518_VTAB" TAB_VERB 2 0 "aus" 1 "ein" /end COMPU_VTAB
/begin COMPU_METHOD FORMULA_0519 "FORMULA_0519" TAB_VERB "%7.0" "-" COMPU_TAB_REF FORMULA_0519_VTAB /end COMPU_METHOD
/begin COMPU_VTAB FORMULA_0519_VTAB "FORMULA_0519_VTAB" TAB_VERB 2 0 "aus" 1 "ein" /end COMPU_VTAB
/begin COMPU_METHOD FORMULA_0520 "FORMULA_0520" TAB_VERB "%7.0" "-" COMPU_TAB_REF FORMULA_0520_VTAB /end COMPU_METHOD
/begin COMPU_VTAB FORMULA_0520_VTAB "FORMULA_0520_VTAB" TAB_VERB 2 0 "aus" 1 "ein" /end COMPU_VTAB
/begin COMPU_METHOD FORMULA_0521 "FORMULA_0521" TAB_VERB "%7.0" "-" COMPU_TAB_REF FORMULA_0521_VTAB /end COMPU_METHOD
/begin COMPU_VTAB FORMULA_0521_VTAB "FORMULA_0521_VTAB" TAB_VERB 2 0 "aus" 1 "ein" /end COMPU_VTAB
/begin COMPU_METHOD FORMULA_0522 "FORMULA_0522" TAB_VERB "%7.0" "-" COMPU_TAB_REF FORMULA_0522_VTAB /end COMPU_METHOD
/begin COMPU_VTAB FORMULA_0522_VTAB "FORMULA_0522_VTAB" TAB_VERB 2 0 "aus" 1 "ein" /end COMPU_VTAB
/begin COMPU_METHOD FORMULA_0523 "FORMULA_0523" TAB_VERB "%7.0" "-" COMPU_TAB_REF FORMULA_0523_VTAB /end COMPU_METHOD
/begin COMPU_VTAB FORMULA_0523_VTAB "FORMULA_0523_VTAB" TAB_VERB 2 0 "aus" 1 "ein" /end COMPU_VTAB
/begin COMPU_METHOD FORMULA_0524 "FORMULA_0524" TAB_VERB "%7.0" "-" COMPU_TAB_REF FORMULA_0524_VTAB /end COMPU_METHOD
/begin COMPU_VTAB FORMULA_0524_VTAB "FORMULA_0524_VTAB" TAB_VERB 2 0 "aus" 1 "ein" /end COMPU_VTAB
/begin COMPU_METHOD FORMULA_0525 "FORMULA_0525" TAB_VERB "%7.0" "-" COMPU_TAB_REF FORMULA_0525_VTAB /end COMPU_METHOD
/begin COMPU_VTAB FORMULA_0525_VTAB "FORMULA_0525_VTAB" TAB_VERB 2 0 "aus" 1 "ein" /end COMPU_VTAB
/begin COMPU_METHOD FORMULA_0526 "FORMULA_0526" TAB_VERB "%7.0" "-" COMPU_TAB_REF FORMULA_0526_VTAB /end COMPU_METHOD
/begin COMPU_VTAB FORMULA_0526_VTAB "FORMULA_0526_VTAB" TAB_VERB 2 0 "aus" 1 "ein" /end COMPU_VTAB
/begin COMPU_METHOD FORMULA_0527 "FORMULA_0527" TAB_VERB "%3.0" "-" COMPU_TAB_REF FORMULA_0527_VTAB /end COMPU_METHOD
/begin COMPU_VTAB FORMULA_0527_VTAB "FORMULA_0527_VTAB" TAB_VERB 2 0 "Langztwert nach CBS-RESET" 1 "noch kein Langztwert nach CBS-RESET" /end COMPU_VTAB
/begin COMPU_METHOD FORMULA_0528 "FORMULA_0528" TAB_VERB "%5.2" "-" COMPU_TAB_REF FORMULA_0528_VTAB /end COMPU_METHOD
/begin COMPU_VTAB FORMULA_0528_VTAB "FORMULA_0528_VTAB" TAB_VERB 4 0 "keine Messg. erwuenscht" 1 "Kurzzeitmessg. laeuft" 2 "Kurzzeitmessg. erfolgr." 3 "Kurzzeitmessg. abgebr." /end COMPU_VTAB
/begin COMPU_METHOD FORMULA_0533 "FORMULA_0533" TAB_VERB "%7.2" "-" COMPU_TAB_REF FORMULA_0533_VTAB /end COMPU_METHOD
/begin COMPU_VTAB FORMULA_0533_VTAB "FORMULA_0533_VTAB" TAB_VERB 1 0 "Messung gesperrt" DEFAULT_VALUE "Messung freigegeben" /end COMPU_VTAB
/begin COMPU_METHOD FORMULA_0534 "FORMULA_0534" TAB_VERB "%7.2" "-" COMPU_TAB_REF FORMULA_0534_VTAB /end COMPU_METHOD
/begin COMPU_VTAB FORMULA_0534_VTAB "FORMULA_0534_VTAB" TAB_VERB 1 0 "Diag. inaktiv" DEFAULT_VALUE "Diag. aktiv" /end COMPU_VTAB
/begin COMPU_METHOD FORMULA_0535 "FORMULA_0535" TAB_VERB "%7.2" "-" COMPU_TAB_REF FORMULA_0535_VTAB /end COMPU_METHOD
/begin COMPU_VTAB FORMULA_0535_VTAB "FORMULA_0535_VTAB" TAB_VERB 1 0 "INIT-Wert" DEFAULT_VALUE "gelernter Wert" /end COMPU_VTAB
/begin COMPU_METHOD FORMULA_0536 "FORMULA_0536" TAB_VERB "%7.2" "-" COMPU_TAB_REF FORMULA_0536_VTAB /end COMPU_METHOD
/begin COMPU_VTAB FORMULA_0536_VTAB "FORMULA_0536_VTAB" TAB_VERB 1 0 "i.O." DEFAULT_VALUE "SH_TO_X_SPERREN" /end COMPU_VTAB
/begin COMPU_METHOD FORMULA_0540 "FORMULA_0540" RAT_FUNC "%7.0" "s" COEFFS 0 1 0 0 0 1 /end COMPU_METHOD
/begin COMPU_METHOD FORMULA_0541 "FORMULA_0541" RAT_FUNC "%5.0" "%" COEFFS 0 1 0 0 0 1 /end COMPU_METHOD
/begin COMPU_METHOD FORMULA_0542 "FORMULA_0542" TAB_VERB "%5.2" "-" COMPU_TAB_REF FORMULA_0542_VTAB /end COMPU_METHOD
/begin COMPU_VTAB FORMULA_0542_VTAB "FORMULA_0542_VTAB" TAB_VERB 3 0 "Vorlauf gesperrt" 1 "mit Vorlauf" 2 "Vorl init" /end COMPU_VTAB
/begin COMPU_METHOD FORMULA_0544 "FORMULA_0544" RAT_FUNC "%5.0" "Diags" COEFFS 0 1 0 0 0 1 /end COMPU_METHOD
/begin COMPU_METHOD FORMULA_0545 "FORMULA_0545" TAB_VERB "%5.2" "-" COMPU_TAB_REF FORMULA_0545_VTAB /end COMPU_METHOD
/begin COMPU_VTAB FORMULA_0545_VTAB "FORMULA_0545_VTAB" TAB_VERB 2 0 "nein" 1 "ja" /end COMPU_VTAB
/begin COMPU_METHOD FORMULA_0546 "FORMULA_0546" TAB_VERB "%5.2" "-" COMPU_TAB_REF FORMULA_0546_VTAB /end COMPU_METHOD
/begin COMPU_VTAB FORMULA_0546_VTAB "FORMULA_0546_VTAB" TAB_VERB 2 0 "nein" 1 "ja" /end COMPU_VTAB
/begin COMPU_METHOD FORMULA_0547 "FORMULA_0547" TAB_VERB "%5.2" "-" COMPU_TAB_REF FORMULA_0547_VTAB /end COMPU_METHOD
/begin COMPU_VTAB FORMULA_0547_VTAB "FORMULA_0547_VTAB" TAB_VERB 2 0 "nein" 1 "ja" /end COMPU_VTAB
/begin COMPU_METHOD FORMULA_0548 "FORMULA_0548" TAB_VERB "%5.2" "-" COMPU_TAB_REF FORMULA_0548_VTAB /end COMPU_METHOD
/begin COMPU_VTAB FORMULA_0548_VTAB "FORMULA_0548_VTAB" TAB_VERB 2 0 "nein" 1 "ja" /end COMPU_VTAB
/begin COMPU_METHOD FORMULA_0549 "FORMULA_0549" TAB_VERB "%5.2" "-" COMPU_TAB_REF FORMULA_0549_VTAB /end COMPU_METHOD
/begin COMPU_VTAB FORMULA_0549_VTAB "FORMULA_0549_VTAB" TAB_VERB 2 0 "nein" 1 "ja" /end COMPU_VTAB
/begin COMPU_METHOD FORMULA_0550 "FORMULA_0550" TAB_VERB "%5.2" "-" COMPU_TAB_REF FORMULA_0550_VTAB /end COMPU_METHOD
/begin COMPU_VTAB FORMULA_0550_VTAB "FORMULA_0550_VTAB" TAB_VERB 2 0 "nein" 1 "ja" /end COMPU_VTAB
/begin COMPU_METHOD FORMULA_0552 "FORMULA_0552" RAT_FUNC "%7.2" "uA" COEFFS 0 65536 0 0 0 9 /end COMPU_METHOD
/begin COMPU_METHOD FORMULA_0554 "FORMULA_0554" TAB_VERB "%5.2" "-" COMPU_TAB_REF FORMULA_0554_VTAB /end COMPU_METHOD
/begin COMPU_VTAB FORMULA_0554_VTAB "FORMULA_0554_VTAB" TAB_VERB 51 0 "AUS" 1 "BEREIT" 2 "WAIT_KLA" 3 "WAIT_V" 4 "WAIT_N" 5 "WAIT_UB" 6 "WAIT_PMIN" 7 "WAIT_TEMP" 8 "WAIT_FST" 9 "WAIT_TEV" 10 "WAIT_EXD" 11 "WAIT_FEHLER_LOESCH" 12 "WAIT_VENTIL" 13 "WAIT_AY" 14 "WAIT_FEUCHT" 20 "START" 21 "REFDIA1" 22 "VENTIL_CHK" 23 "DECKELDIA" 24 "GROBLECKDIA" 25 "FEINLECKDIA" 26 "DECKEL_REFDIA2" 27 "GROB_REFDIA2" 28 "FEIN_REFDIA2" 29 "VENTIL_CHK2" 32 "DECKEL_DICHT" 33 "GROB_DICHT" 34 "FEIN_DICHT" 35 "DECKELLECK" 36 "GROBLECK" 37 "FEINLECK" 40 "ABBRUCH_UB_DIFF" 41 "ABBRUCH_I_REF_DIFF" 42 "ABBRUCH_TEV" 43 "ABBRUCH_KL15" 44 "ABBRUCH_N" 45 "ABBRUCH_V" 46 "ABBRUCH_KS" 47 "ABBRUCH_EXD" 48 "ABBRUCH_REF_ZU_GROSS" 49 "ABBRUCH_REF_ZU_KLEIN" 50 "ABBRUCH_VERSTOPFT" 51 "ABBRUCH_NACHTANK" 52 "ABBRUCH_TANKDECKEL" 53 "ABBRUCH_AIRBAG" 54 "ABBRUCH_I_REF_1/2" 55 "ABBRUCH_DI2" 56 "ABBRUCH_AY" 57 "ABBRUCH_I_REF2_DIFF" 58 "ABBRUCH_UB_MIN" 59 "ABBRUCH_POWER_DOWN" DEFAULT_VALUE "undef" /end COMPU_VTAB
/begin COMPU_METHOD FORMULA_0556 "FORMULA_0556" RAT_FUNC "%9.4" "-" COEFFS 0 10000 0 0 0 1 /end COMPU_METHOD
/begin COMPU_METHOD FORMULA_0558 "FORMULA_0558" RAT_FUNC "%6.3" "l" COEFFS 0 512 0 0 0 1 /end COMPU_METHOD
/begin COMPU_METHOD FORMULA_0559 "FORMULA_0559" RAT_FUNC "%8.3" "L" COEFFS 0 1 0 0 0 0.001024 /end COMPU_METHOD
/begin COMPU_METHOD FORMULA_0560 "FORMULA_0560" TAB_VERB "%5.2" "-" COMPU_TAB_REF FORMULA_0560_VTAB /end COMPU_METHOD
/begin COMPU_VTAB FORMULA_0560_VTAB "FORMULA_0560_VTAB" TAB_VERB 4 0 "kein ELU erkannt" 1 "600W" 2 "850W" 128 "TEMIC 850W invers" DEFAULT_VALUE "undefiniert" /end COMPU_VTAB
/begin COMPU_METHOD FORMULA_0561 "FORMULA_0561" RAT_FUNC "%8.3" "kg/h" COEFFS 0 1000 0 0 0 1 /end COMPU_METHOD
/begin COMPU_METHOD FORMULA_0563 "FORMULA_0563" TAB_VERB "%7.2" "-" COMPU_TAB_REF FORMULA_0563_VTAB /end COMPU_METHOD
/begin COMPU_VTAB FORMULA_0563_VTAB "FORMULA_0563_VTAB" TAB_VERB 1 0 "erfuellt" DEFAULT_VALUE "offen" /end COMPU_VTAB
/begin COMPU_METHOD FORMULA_0564 "FORMULA_0564" TAB_VERB "%7.2" "-" COMPU_TAB_REF FORMULA_0564_VTAB /end COMPU_METHOD
/begin COMPU_VTAB FORMULA_0564_VTAB "FORMULA_0564_VTAB" TAB_VERB 1 0 "erfuellt" DEFAULT_VALUE "offen" /end COMPU_VTAB
/begin COMPU_METHOD FORMULA_0565 "FORMULA_0565" TAB_VERB "%7.2" "-" COMPU_TAB_REF FORMULA_0565_VTAB /end COMPU_METHOD
/begin COMPU_VTAB FORMULA_0565_VTAB "FORMULA_0565_VTAB" TAB_VERB 1 0 "erfuellt" DEFAULT_VALUE "offen" /end COMPU_VTAB
/begin COMPU_METHOD FORMULA_0566 "FORMULA_0566" TAB_VERB "%7.2" "-" COMPU_TAB_REF FORMULA_0566_VTAB /end COMPU_METHOD
/begin COMPU_VTAB FORMULA_0566_VTAB "FORMULA_0566_VTAB" TAB_VERB 1 0 "erfuellt" DEFAULT_VALUE "offen" /end COMPU_VTAB
/begin COMPU_METHOD FORMULA_0567 "FORMULA_0567" TAB_VERB "%7.2" "-" COMPU_TAB_REF FORMULA_0567_VTAB /end COMPU_METHOD
/begin COMPU_VTAB FORMULA_0567_VTAB "FORMULA_0567_VTAB" TAB_VERB 1 0 "erfuellt" DEFAULT_VALUE "offen" /end COMPU_VTAB
/begin COMPU_METHOD FORMULA_0568 "FORMULA_0568" TAB_VERB "%7.2" "-" COMPU_TAB_REF FORMULA_0568_VTAB /end COMPU_METHOD
/begin COMPU_VTAB FORMULA_0568_VTAB "FORMULA_0568_VTAB" TAB_VERB 1 0 "erfuellt" DEFAULT_VALUE "offen" /end COMPU_VTAB
/begin COMPU_METHOD FORMULA_0569 "FORMULA_0569" TAB_VERB "%7.2" "-" COMPU_TAB_REF FORMULA_0569_VTAB /end COMPU_METHOD
/begin COMPU_VTAB FORMULA_0569_VTAB "FORMULA_0569_VTAB" TAB_VERB 1 0 "erfuellt" DEFAULT_VALUE "offen" /end COMPU_VTAB
/begin COMPU_METHOD FORMULA_0570 "FORMULA_0570" TAB_VERB "%7.2" "-" COMPU_TAB_REF FORMULA_0570_VTAB /end COMPU_METHOD
/begin COMPU_VTAB FORMULA_0570_VTAB "FORMULA_0570_VTAB" TAB_VERB 1 0 "erfuellt" DEFAULT_VALUE "offen" /end COMPU_VTAB
/begin COMPU_METHOD FORMULA_0571 "FORMULA_0571" TAB_VERB "%7.2" "-" COMPU_TAB_REF FORMULA_0571_VTAB /end COMPU_METHOD
/begin COMPU_VTAB FORMULA_0571_VTAB "FORMULA_0571_VTAB" TAB_VERB 1 0 "erfuellt" DEFAULT_VALUE "offen" /end COMPU_VTAB
/begin COMPU_METHOD FORMULA_0572 "FORMULA_0572" TAB_VERB "%5.2" "-" COMPU_TAB_REF FORMULA_0572_VTAB /end COMPU_METHOD
/begin COMPU_VTAB FORMULA_0572_VTAB "FORMULA_0572_VTAB" TAB_VERB 9 0 "Initialisierung" 1 "Rangecheck geheilt" 2 "n.i.O. Zyklusvergleich" 4 "i.O. Zyklusvergleich" 8 "i.O. Modellcheck" 16 "n.i.O. Rangecheck" 32 "n.i.O. Gradientenueberwachung" 64 "n.i.O. Modellcheck" 128 "Diagnose gesperrt" DEFAULT_VALUE "undef" /end COMPU_VTAB
/begin COMPU_METHOD FORMULA_0573 "FORMULA_0573" RAT_FUNC "%7.2" "-*s" COEFFS 0 16384 0 0 0 1 /end COMPU_METHOD
/begin COMPU_METHOD FORMULA_0574 "FORMULA_0574" TAB_VERB "%7.2" "-" COMPU_TAB_REF FORMULA_0574_VTAB /end COMPU_METHOD
/begin COMPU_VTAB FORMULA_0574_VTAB "FORMULA_0574_VTAB" TAB_VERB 1 317 "aktiv" DEFAULT_VALUE "nicht aktiv" /end COMPU_VTAB
/begin COMPU_METHOD FORMULA_0575 "FORMULA_0575" TAB_VERB "%5.2" "-" COMPU_TAB_REF FORMULA_0575_VTAB /end COMPU_METHOD
/begin COMPU_VTAB FORMULA_0575_VTAB "FORMULA_0575_VTAB" TAB_VERB 3 0 "inaktive" 1 "einfangen" 2 "eingeregelt" DEFAULT_VALUE "ungueltig" /end COMPU_VTAB
/* ------------------ Abschnitt erzeugt aus adapt_wichtig.dat ------------------ */
/begin COMPU_METHOD FORMULA_0576 "FORMULA_0576" RAT_FUNC "%7.0" "mal" COEFFS 0 1 0 0 0 1 /end COMPU_METHOD
/begin COMPU_METHOD FORMULA_0577 "FORMULA_0577" RAT_FUNC "%5.0" "bytes" COEFFS 0 1 0 0 0 4 /end COMPU_METHOD
/begin COMPU_METHOD FORMULA_0578 "FORMULA_0578" RAT_FUNC "%5.0" "VERS" COEFFS 0 1 0 0 0 1 /end COMPU_METHOD
/begin COMPU_METHOD FORMULA_0579 "FORMULA_0579" TAB_VERB "%3.0" "-" COMPU_TAB_REF FORMULA_0579_VTAB /end COMPU_METHOD
/begin COMPU_VTAB FORMULA_0579_VTAB "FORMULA_0579_VTAB" TAB_VERB 2 0 "Einfahrint. abgeschl." 1 "Einfahrint. aktiv" DEFAULT_VALUE "undef" /end COMPU_VTAB
/* ------------------ Abschnitt erzeugt aus ag_ti.dat ------------------ */
/begin COMPU_METHOD FORMULA_0580 "FORMULA_0580" TAB_VERB "%3.0" "-" COMPU_TAB_REF FORMULA_0580_VTAB /end COMPU_METHOD
/begin COMPU_VTAB FORMULA_0580_VTAB "FORMULA_0580_VTAB" TAB_VERB 5 0 "Inaktiv" 1 "Key" 5 "Aktiv" 8 "Fehler" 9 "Beendet" DEFAULT_VALUE "undefined" /end COMPU_VTAB
/begin COMPU_METHOD FORMULA_0581 "FORMULA_0581" TAB_VERB "%3.0" "-" COMPU_TAB_REF FORMULA_0581_VTAB /end COMPU_METHOD
/begin COMPU_VTAB FORMULA_0581_VTAB "FORMULA_0581_VTAB" TAB_VERB 4 0 "Aus" 1 "Statisch" 2 "Sequentiell" 3 "Sporadisch" DEFAULT_VALUE "undefined" /end COMPU_VTAB
/begin COMPU_METHOD FORMULA_0582 "FORMULA_0582" TAB_VERB "%5.0" "-" COMPU_TAB_REF FORMULA_0582_VTAB /end COMPU_METHOD
/begin COMPU_VTAB FORMULA_0582_VTAB "FORMULA_0582_VTAB" TAB_VERB 1 0 "keine Ausblendung." DEFAULT_VALUE "Ausblendungen aktiv." /end COMPU_VTAB
/begin COMPU_METHOD FORMULA_0583 "FORMULA_0583" TAB_VERB "%5.0" "-" COMPU_TAB_REF FORMULA_0583_VTAB /end COMPU_METHOD
/begin COMPU_VTAB FORMULA_0583_VTAB "FORMULA_0583_VTAB" TAB_VERB 1 0 "Zyl. 1 an." DEFAULT_VALUE "Zyl. 1 aus." /end COMPU_VTAB
/begin COMPU_METHOD FORMULA_0584 "FORMULA_0584" TAB_VERB "%5.0" "-" COMPU_TAB_REF FORMULA_0584_VTAB /end COMPU_METHOD
/begin COMPU_VTAB FORMULA_0584_VTAB "FORMULA_0584_VTAB" TAB_VERB 1 0 "Zyl. 2 an." DEFAULT_VALUE "Zyl. 2 aus." /end COMPU_VTAB
/begin COMPU_METHOD FORMULA_0585 "FORMULA_0585" TAB_VERB "%5.0" "-" COMPU_TAB_REF FORMULA_0585_VTAB /end COMPU_METHOD
/begin COMPU_VTAB FORMULA_0585_VTAB "FORMULA_0585_VTAB" TAB_VERB 1 0 "Zyl. 3 an." DEFAULT_VALUE "Zyl. 3 aus." /end COMPU_VTAB
/begin COMPU_METHOD FORMULA_0586 "FORMULA_0586" TAB_VERB "%5.0" "-" COMPU_TAB_REF FORMULA_0586_VTAB /end COMPU_METHOD
/begin COMPU_VTAB FORMULA_0586_VTAB "FORMULA_0586_VTAB" TAB_VERB 1 0 "Zyl. 4 an." DEFAULT_VALUE "Zyl. 4 aus." /end COMPU_VTAB
/begin COMPU_METHOD FORMULA_0587 "FORMULA_0587" TAB_VERB "%5.0" "-" COMPU_TAB_REF FORMULA_0587_VTAB /end COMPU_METHOD
/begin COMPU_VTAB FORMULA_0587_VTAB "FORMULA_0587_VTAB" TAB_VERB 1 0 "Zyl. 5 an." DEFAULT_VALUE "Zyl. 5 aus." /end COMPU_VTAB
/begin COMPU_METHOD FORMULA_0588 "FORMULA_0588" TAB_VERB "%5.0" "-" COMPU_TAB_REF FORMULA_0588_VTAB /end COMPU_METHOD
/begin COMPU_VTAB FORMULA_0588_VTAB "FORMULA_0588_VTAB" TAB_VERB 1 0 "Zyl. 6 an." DEFAULT_VALUE "Zyl. 6 aus." /end COMPU_VTAB
/begin COMPU_METHOD FORMULA_0589 "FORMULA_0589" TAB_VERB "%5.0" "-" COMPU_TAB_REF FORMULA_0589_VTAB /end COMPU_METHOD
/begin COMPU_VTAB FORMULA_0589_VTAB "FORMULA_0589_VTAB" TAB_VERB 1 0 "Zyl. 7 an." DEFAULT_VALUE "Zyl. 7 aus." /end COMPU_VTAB
/begin COMPU_METHOD FORMULA_0590 "FORMULA_0590" TAB_VERB "%5.0" "-" COMPU_TAB_REF FORMULA_0590_VTAB /end COMPU_METHOD
/begin COMPU_VTAB FORMULA_0590_VTAB "FORMULA_0590_VTAB" TAB_VERB 1 0 "Zyl. 8 an." DEFAULT_VALUE "Zyl. 8 aus." /end COMPU_VTAB
/begin COMPU_METHOD FORMULA_0591 "FORMULA_0591" TAB_VERB "%5.0" "-" COMPU_TAB_REF FORMULA_0591_VTAB /end COMPU_METHOD
/begin COMPU_VTAB FORMULA_0591_VTAB "FORMULA_0591_VTAB" TAB_VERB 1 0 "Zyl. 9 an." DEFAULT_VALUE "Zyl. 9 aus." /end COMPU_VTAB
/begin COMPU_METHOD FORMULA_0592 "FORMULA_0592" TAB_VERB "%5.0" "-" COMPU_TAB_REF FORMULA_0592_VTAB /end COMPU_METHOD
/begin COMPU_VTAB FORMULA_0592_VTAB "FORMULA_0592_VTAB" TAB_VERB 1 0 "Zyl. 10 an." DEFAULT_VALUE "Zyl. 10 aus." /end COMPU_VTAB
/* ------------------ Abschnitt erzeugt aus ascet_interf.dat ------------------ */
/begin COMPU_METHOD FORMULA_0593 "FORMULA_0593" RAT_FUNC "%3.0" "m/s*s" COEFFS 0 4 0 0 0 1 /end COMPU_METHOD
/begin COMPU_METHOD FORMULA_0594 "FORMULA_0594" TAB_VERB "%5.2" "-" COMPU_TAB_REF FORMULA_0594_VTAB /end COMPU_METHOD
/begin COMPU_VTAB FORMULA_0594_VTAB "FORMULA_0594_VTAB" TAB_VERB 2 0 "FALSE" 1 "TRUE" /end COMPU_VTAB
/begin COMPU_METHOD FORMULA_0596 "FORMULA_0596" TAB_VERB "%5.2" "%" COMPU_TAB_REF FORMULA_0596_VTAB /end COMPU_METHOD
/begin COMPU_VTAB FORMULA_0596_VTAB "FORMULA_0596_VTAB" TAB_VERB 4 0 "<50" 1 "50..<75" 2 "75..<100" 3 "100" /end COMPU_VTAB
/begin COMPU_METHOD FORMULA_0597 "FORMULA_0597" TAB_VERB "%5.2" "-" COMPU_TAB_REF FORMULA_0597_VTAB /end COMPU_METHOD
/begin COMPU_VTAB FORMULA_0597_VTAB "FORMULA_0597_VTAB" TAB_VERB 9 12 "zu wenig" 25 "Minimum" 38 "Min-OK" 53 "OK" 69 "OK-Max" 85 "Max" 95 "Ueberfuellt" 120 "-.-" 121 "Uhr" DEFAULT_VALUE "undef." /end COMPU_VTAB
/begin COMPU_METHOD FORMULA_0599 "FORMULA_0599" TAB_VERB "%5.2" "-" COMPU_TAB_REF FORMULA_0599_VTAB /end COMPU_METHOD
/begin COMPU_VTAB FORMULA_0599_VTAB "FORMULA_0599_VTAB" TAB_VERB 3 0 "BSD1_alt" 1 "BSD1_plus" 2 "BSD2" DEFAULT_VALUE "undef." /end COMPU_VTAB
/begin COMPU_METHOD FORMULA_0602 "FORMULA_0602" TAB_VERB "%7.2" "-" COMPU_TAB_REF FORMULA_0602_VTAB /end COMPU_METHOD
/begin COMPU_VTAB FORMULA_0602_VTAB "FORMULA_0602_VTAB" TAB_VERB 15 0 "keine Test-CC/CBS-Meldung raus" 1 "CC Motoroel nachfuellen" 2 "CC Motoroel unter min" 3 "CC Motoroelsensor gestoert" 4 "CC Motoroel ueberhitzt" 5 "CC Motoroeldruck zu niedrig" 6 "CC Batterie wird nicht geladen" 7 "CC Batterieentladung zu hoch" 8 "CC Batterie stark entladen" 9 "CC Batterieueberwachung ausgef." 10 "CC Batterie pruefen" 11 "CC Batteriekontakte pruefen" 12 "CC Batterie entl. Verbr.abschaltung" 13 "CBS Oel Verfbkt. und Restlauflstg." 14 "CBS Oel Prognoseinterv. u. Zieltermin" /end COMPU_VTAB
/* ------------------ Abschnitt erzeugt aus bsd.dat ------------------ */
/begin COMPU_METHOD FORMULA_0607 "FORMULA_0607" TAB_VERB "%3.0" "-" COMPU_TAB_REF FORMULA_0607_VTAB /end COMPU_METHOD
/begin COMPU_VTAB FORMULA_0607_VTAB "FORMULA_0607_VTAB" TAB_VERB 32 0 "none" 16 "ack" 32 "par" 48 "par+ack" 64 "read" 80 "read+ack" 96 "read+par" 112 "read+par+ack" 128 "send" 144 "send+ack" 160 "send+par" 176 "send+par+ack" 192 "send+read" 208 "send+read+ack" 224 "send+read+par" 240 "send+read+par+ack" 1 "glitch" 17 "ack+glitch" 33 "par+glitch" 49 "par+ack+glitch" 65 "read+glitch" 81 "read+ack+glitch" 97 "read+par+glitch" 113 "read+par+ack+glitch" 129 "send+glitch" 145 "send+ack+glitch" 161 "send+par+glitch" 177 "send+par+ack+glitch" 193 "send+read+glitch" 209 "send+read+ack+glitch" 225 "send+read+par+glitch" 241 "send+read+par+ack+glitch" DEFAULT_VALUE "undefined" /end COMPU_VTAB
/begin COMPU_METHOD FORMULA_0608 "FORMULA_0608" TAB_VERB "%3.0" "-" COMPU_TAB_REF FORMULA_0608_VTAB /end COMPU_METHOD
/begin COMPU_VTAB FORMULA_0608_VTAB "FORMULA_0608_VTAB" TAB_VERB 9 0 "BSD_IDLE" 1 "BSDHTOK" 2 "BSDWRITE" 4 "BSDDO" 8 "BSDBSY" 16 "BSDRXRDY" 32 "BSDTXOK" 64 "BSDDTRQ" 48 "BSDTXIND" /end COMPU_VTAB
/* ------------------ Abschnitt erzeugt aus cantel.dat ------------------ */
/begin COMPU_METHOD FORMULA_0609 "FORMULA_0609" RAT_FUNC "%7.2" "s" COEFFS 0 1000 0 0 0 5 /end COMPU_METHOD
/begin COMPU_METHOD FORMULA_0610 "FORMULA_0610" TAB_VERB "%5.2" "-" COMPU_TAB_REF FORMULA_0610_VTAB /end COMPU_METHOD
/begin COMPU_VTAB FORMULA_0610_VTAB "FORMULA_0610_VTAB" TAB_VERB 4 0 "Kl15 aus" 1 "Req Kl15" 2 "Kl15 ein" 3 "Ungueltig" /end COMPU_VTAB
/begin COMPU_METHOD FORMULA_0611 "FORMULA_0611" RAT_FUNC "%3.0" "Sufe" COEFFS 0 1 0 0 0 1 /end COMPU_METHOD
/begin COMPU_METHOD FORMULA_0612 "FORMULA_0612" TAB_VERB "%3.0" "-" COMPU_TAB_REF FORMULA_0612_VTAB /end COMPU_METHOD
/begin COMPU_VTAB FORMULA_0612_VTAB "FORMULA_0612_VTAB" TAB_VERB 7 0 "keine" 1 "ACC aktz." 2 "EMF aktz." 3 "HBA aktz." 4 "Verzoegerung" 14 "abgelehnt" 15 "ungueltig" DEFAULT_VALUE "undef" /end COMPU_VTAB
/begin COMPU_METHOD FORMULA_0613 "FORMULA_0613" RAT_FUNC "%4.1" "s" COEFFS 0 1 0 0 0 1 /end COMPU_METHOD
/begin COMPU_METHOD FORMULA_0614 "FORMULA_0614" TAB_VERB "%5.2" "-" COMPU_TAB_REF FORMULA_0614_VTAB /end COMPU_METHOD
/begin COMPU_VTAB FORMULA_0614_VTAB "FORMULA_0614_VTAB" TAB_VERB 2 0 "Aus" 1 "An" /end COMPU_VTAB
/begin COMPU_METHOD FORMULA_0615 "FORMULA_0615" TAB_VERB "%5.2" "-" COMPU_TAB_REF FORMULA_0615_VTAB /end COMPU_METHOD
/begin COMPU_VTAB FORMULA_0615_VTAB "FORMULA_0615_VTAB" TAB_VERB 2 0 "unlocked" 1 "locked" DEFAULT_VALUE "undef" /end COMPU_VTAB
/begin COMPU_METHOD FORMULA_0617 "FORMULA_0617" TAB_VERB "%5.2" "-" COMPU_TAB_REF FORMULA_0617_VTAB /end COMPU_METHOD
/begin COMPU_VTAB FORMULA_0617_VTAB "FORMULA_0617_VTAB" TAB_VERB 3 5 "EKP an" 10 "EKP aus" 15 "ungueltig" DEFAULT_VALUE "undef" /end COMPU_VTAB
/begin COMPU_METHOD FORMULA_0618 "FORMULA_0618" RAT_FUNC "%3.0" ".Klasse" COEFFS 0 1 0 0 0 1 /end COMPU_METHOD
/begin COMPU_METHOD FORMULA_0619 "FORMULA_0619" RAT_FUNC "%3.0" "mA" COEFFS 0 1 0 0 0 1 /end COMPU_METHOD
/begin COMPU_METHOD FORMULA_0620 "FORMULA_0620" RAT_FUNC "%3.0" "A" COEFFS 0 1 0 0 0 10 /end COMPU_METHOD
/begin COMPU_METHOD FORMULA_0621 "FORMULA_0621" TAB_VERB "%3.0" "-" COMPU_TAB_REF FORMULA_0621_VTAB /end COMPU_METHOD
/begin COMPU_VTAB FORMULA_0621_VTAB "FORMULA_0621_VTAB" TAB_VERB 5 0 "keine Angabe" 1 "Komfort" 2 "Sport" 5 "Komfort erw." 6 "Sport erw." DEFAULT_VALUE "undef" /end COMPU_VTAB
/begin COMPU_METHOD FORMULA_0622 "FORMULA_0622" TAB_VERB "%3.0" "-" COMPU_TAB_REF FORMULA_0622_VTAB /end COMPU_METHOD
/begin COMPU_VTAB FORMULA_0622_VTAB "FORMULA_0622_VTAB" TAB_VERB 2 0 "Ausschalten" 1 "Einschalten" DEFAULT_VALUE "undef" /end COMPU_VTAB
/begin COMPU_METHOD FORMULA_0623 "FORMULA_0623" RAT_FUNC "%6.1" "-" COEFFS 0 10 0 0 0 1 /end COMPU_METHOD
/begin COMPU_METHOD FORMULA_0624 "FORMULA_0624" TAB_VERB "%3.0" "-" COMPU_TAB_REF FORMULA_0624_VTAB /end COMPU_METHOD
/begin COMPU_VTAB FORMULA_0624_VTAB "FORMULA_0624_VTAB" TAB_VERB 4 0 "beide zu" 1 "FAT offen" 2 "BFAT offen" 3 "beide offen" DEFAULT_VALUE "undef" /end COMPU_VTAB
/begin COMPU_METHOD FORMULA_0625 "FORMULA_0625" TAB_VERB "%3.0" "-" COMPU_TAB_REF FORMULA_0625_VTAB /end COMPU_METHOD
/begin COMPU_VTAB FORMULA_0625_VTAB "FORMULA_0625_VTAB" TAB_VERB 2 0 "Aus" 1 "PTH/Mdrv" DEFAULT_VALUE "undef" /end COMPU_VTAB
/begin COMPU_METHOD FORMULA_0626 "FORMULA_0626" RAT_FUNC "%4.1" "%" COEFFS 0 10 0 0 0 1 /end COMPU_METHOD
/begin COMPU_METHOD FORMULA_0627 "FORMULA_0627" TAB_VERB "%5.2" "-" COMPU_TAB_REF FORMULA_0627_VTAB /end COMPU_METHOD
/begin COMPU_VTAB FORMULA_0627_VTAB "FORMULA_0627_VTAB" TAB_VERB 6 0 "Normal" 1 "MDrv aus" 2 "BAT-Komp aus" 4 "Obd ein" 8 "OelAG ein" 12 "Obd+OelAG" /end COMPU_VTAB
/begin COMPU_METHOD FORMULA_0628 "FORMULA_0628" TAB_VERB "%5.2" "-" COMPU_TAB_REF FORMULA_0628_VTAB /end COMPU_METHOD
/begin COMPU_VTAB FORMULA_0628_VTAB "FORMULA_0628_VTAB" TAB_VERB 2 0 "Aus" 1 "Ein" /end COMPU_VTAB
/begin COMPU_METHOD FORMULA_0629 "FORMULA_0629" TAB_VERB "%5.2" "-" COMPU_TAB_REF FORMULA_0629_VTAB /end COMPU_METHOD
/begin COMPU_VTAB FORMULA_0629_VTAB "FORMULA_0629_VTAB" TAB_VERB 2 0 "1=li" 1 "1=re" /end COMPU_VTAB
/begin COMPU_METHOD FORMULA_0630 "FORMULA_0630" TAB_VERB "%3.0" "-" COMPU_TAB_REF FORMULA_0630_VTAB /end COMPU_METHOD
/begin COMPU_VTAB FORMULA_0630_VTAB "FORMULA_0630_VTAB" TAB_VERB 3 5 "EKP an" 10 "EKP aus" 15 "ungueltig" /end COMPU_VTAB
/begin COMPU_METHOD FORMULA_0631 "FORMULA_0631" RAT_FUNC "%4.1" "�C" COEFFS 0 2 80 0 0 1 /end COMPU_METHOD
/* ------------------ Abschnitt erzeugt aus carbtlgr_inj.dat ------------------ */
/begin COMPU_METHOD FORMULA_0632 "FORMULA_0632" TAB_VERB "%3.0" "-" COMPU_TAB_REF FORMULA_0632_VTAB /end COMPU_METHOD
/begin COMPU_VTAB FORMULA_0632_VTAB "FORMULA_0632_VTAB" TAB_VERB 1 -1 "Kein AIF)" /end COMPU_VTAB
/begin COMPU_METHOD FORMULA_0633 "FORMULA_0633" TAB_VERB "%3.0" "-" COMPU_TAB_REF FORMULA_0633_VTAB /end COMPU_METHOD
/begin COMPU_VTAB FORMULA_0633_VTAB "FORMULA_0633_VTAB" TAB_VERB 2 0 "Kein SCAN-TOOL" 1 "SCAN-TOOL" /end COMPU_VTAB
/* ------------------ Abschnitt erzeugt aus diag_tr.dat ------------------ */
/begin COMPU_METHOD FORMULA_0634 "FORMULA_0634" TAB_VERB "%5.2" "-" COMPU_TAB_REF FORMULA_0634_VTAB /end COMPU_METHOD
/begin COMPU_VTAB FORMULA_0634_VTAB "FORMULA_0634_VTAB" TAB_VERB 4 0 "Aus" 1 "readDummy" 2 "An" 4 "Stop" DEFAULT_VALUE "undef" /end COMPU_VTAB
/* ------------------ Abschnitt erzeugt aus dmtl.dat ------------------ */
/begin COMPU_METHOD FORMULA_0635 "FORMULA_0635" TAB_VERB "%5.2" "-" COMPU_TAB_REF FORMULA_0635_VTAB /end COMPU_METHOD
/begin COMPU_VTAB FORMULA_0635_VTAB "FORMULA_0635_VTAB" TAB_VERB 1 0 "AUS" DEFAULT_VALUE "EIN" /end COMPU_VTAB
/begin COMPU_METHOD FORMULA_0636 "FORMULA_0636" TAB_VERB "%5.2" "-" COMPU_TAB_REF FORMULA_0636_VTAB /end COMPU_METHOD
/begin COMPU_VTAB FORMULA_0636_VTAB "FORMULA_0636_VTAB" TAB_VERB 2 0 "nein" 1 "ks_to_gnd" /end COMPU_VTAB
/begin COMPU_METHOD FORMULA_0637 "FORMULA_0637" TAB_VERB "%5.2" "-" COMPU_TAB_REF FORMULA_0637_VTAB /end COMPU_METHOD
/begin COMPU_VTAB FORMULA_0637_VTAB "FORMULA_0637_VTAB" TAB_VERB 2 0 "aus" 1 "ein" /end COMPU_VTAB
/begin COMPU_METHOD FORMULA_0638 "FORMULA_0638" TAB_VERB "%5.2" "-" COMPU_TAB_REF FORMULA_0638_VTAB /end COMPU_METHOD
/begin COMPU_VTAB FORMULA_0638_VTAB "FORMULA_0638_VTAB" TAB_VERB 2 0 "nein" 1 "angefordert" /end COMPU_VTAB
/begin COMPU_METHOD FORMULA_0639 "FORMULA_0639" TAB_VERB "%5.2" "-" COMPU_TAB_REF FORMULA_0639_VTAB /end COMPU_METHOD
/begin COMPU_VTAB FORMULA_0639_VTAB "FORMULA_0639_VTAB" TAB_VERB 2 0 "o.k" 1 "Kurzschluss" /end COMPU_VTAB
/begin COMPU_METHOD FORMULA_0640 "FORMULA_0640" TAB_VERB "%5.2" "-" COMPU_TAB_REF FORMULA_0640_VTAB /end COMPU_METHOD
/begin COMPU_VTAB FORMULA_0640_VTAB "FORMULA_0640_VTAB" TAB_VERB 2 0 "1.Stabil" 1 "2.Stabil laeuft" /end COMPU_VTAB
/begin COMPU_METHOD FORMULA_0641 "FORMULA_0641" TAB_VERB "%5.2" "-" COMPU_TAB_REF FORMULA_0641_VTAB /end COMPU_METHOD
/begin COMPU_VTAB FORMULA_0641_VTAB "FORMULA_0641_VTAB" TAB_VERB 2 0 "nein" 1 "erfuellt" /end COMPU_VTAB
/begin COMPU_METHOD FORMULA_0642 "FORMULA_0642" TAB_VERB "%5.2" "-" COMPU_TAB_REF FORMULA_0642_VTAB /end COMPU_METHOD
/begin COMPU_VTAB FORMULA_0642_VTAB "FORMULA_0642_VTAB" TAB_VERB 2 0 "aus" 1 "ein" /end COMPU_VTAB
/begin COMPU_METHOD FORMULA_0644 "FORMULA_0644" RAT_FUNC "%7.2" "uA" COEFFS 0 65536 0 0 0 2.25 /end COMPU_METHOD
/begin COMPU_METHOD FORMULA_0651 "FORMULA_0651" RAT_FUNC "%6.3" "s" COEFFS 0 0 1.28 0 1 0 /end COMPU_METHOD
/* ------------------ Abschnitt erzeugt aus dwf.dat ------------------ */
/begin COMPU_METHOD FORMULA_0659 "FORMULA_0659" TAB_VERB "%3.0" "-" COMPU_TAB_REF FORMULA_0659_VTAB /end COMPU_METHOD
/begin COMPU_VTAB FORMULA_0659_VTAB "FORMULA_0659_VTAB" TAB_VERB 1 0 "Aus" DEFAULT_VALUE "Ein" /end COMPU_VTAB
/begin COMPU_METHOD FORMULA_0660 "FORMULA_0660" TAB_VERB "%3.0" "-" COMPU_TAB_REF FORMULA_0660_VTAB /end COMPU_METHOD
/begin COMPU_VTAB FORMULA_0660_VTAB "FORMULA_0660_VTAB" TAB_VERB 1 0 "Aus" DEFAULT_VALUE "Ein" /end COMPU_VTAB
/begin COMPU_METHOD FORMULA_0661 "FORMULA_0661" TAB_VERB "%3.0" "-" COMPU_TAB_REF FORMULA_0661_VTAB /end COMPU_METHOD
/begin COMPU_VTAB FORMULA_0661_VTAB "FORMULA_0661_VTAB" TAB_VERB 1 0 "Aus" DEFAULT_VALUE "Blinken" /end COMPU_VTAB
/begin COMPU_METHOD FORMULA_0662 "FORMULA_0662" RAT_FUNC "%3.0" "Segmente" COEFFS 0 1 0 0 0 1 /end COMPU_METHOD
/begin COMPU_METHOD FORMULA_0664 "FORMULA_0664" RAT_FUNC "%5.2" "s" COEFFS 0 0 2.56 0 1 0 /end COMPU_METHOD
/* ------------------ Abschnitt erzeugt aus ebox_elu.dat ------------------ */
/begin COMPU_METHOD FORMULA_0667 "FORMULA_0667" TAB_VERB "%3.0" "-" COMPU_TAB_REF FORMULA_0667_VTAB /end COMPU_METHOD
/begin COMPU_VTAB FORMULA_0667_VTAB "FORMULA_0667_VTAB" TAB_VERB 3 0 "aus" 1 "an" 2 "Sperre SH_TO_UB" /end COMPU_VTAB
/* ------------------ Abschnitt erzeugt aus elu.dat ------------------ */
/begin COMPU_METHOD FORMULA_0670 "FORMULA_0670" TAB_VERB "%3.0" "-" COMPU_TAB_REF FORMULA_0670_VTAB /end COMPU_METHOD
/begin COMPU_VTAB FORMULA_0670_VTAB "FORMULA_0670_VTAB" TAB_VERB 3 0 "Ansteuerung inaktiv" 3 "Ansteuerung bei ML" 5 "Ansteuerung bei MS" DEFAULT_VALUE "undefiniert" /end COMPU_VTAB
/begin COMPU_METHOD FORMULA_0671 "FORMULA_0671" RAT_FUNC "%6.1" "%" COEFFS 0 512 0 0 0 1 /end COMPU_METHOD
/begin COMPU_METHOD FORMULA_0673 "FORMULA_0673" TAB_VERB "%3.0" "-" COMPU_TAB_REF FORMULA_0673_VTAB /end COMPU_METHOD
/begin COMPU_VTAB FORMULA_0673_VTAB "FORMULA_0673_VTAB" TAB_VERB 7 0 "Adaption fehlt" 1 "Typ-Identifikation" 2 "Funktionssperre" 4 "Weckfunktion" 8 "Luefterbetrieb" 16 "Nachlaufanforderung" 32 "aus" DEFAULT_VALUE "undefiniert" /end COMPU_VTAB
/begin COMPU_METHOD FORMULA_0674 "FORMULA_0674" TAB_VERB "%3.0" "-" COMPU_TAB_REF FORMULA_0674_VTAB /end COMPU_METHOD
/begin COMPU_VTAB FORMULA_0674_VTAB "FORMULA_0674_VTAB" TAB_VERB 5 0 "NO_FEHLER" 1 "SH_TO_UB" 2 "SH_TO_GND" 4 "OPENLOAD" 8 "UNPLAUSIBEL" DEFAULT_VALUE "undefiniert" /end COMPU_VTAB
/begin COMPU_METHOD FORMULA_0680 "FORMULA_0680" TAB_VERB "%5.2" "-" COMPU_TAB_REF FORMULA_0680_VTAB /end COMPU_METHOD
/begin COMPU_VTAB FORMULA_0680_VTAB "FORMULA_0680_VTAB" TAB_VERB 2 0 "nicht erfuellt" 1 "erfuellt" DEFAULT_VALUE "undef" /end COMPU_VTAB
/begin COMPU_METHOD FORMULA_0681 "FORMULA_0681" TAB_VERB "%3.0" "-" COMPU_TAB_REF FORMULA_0681_VTAB /end COMPU_METHOD
/begin COMPU_VTAB FORMULA_0681_VTAB "FORMULA_0681_VTAB" TAB_VERB 7 0 "inaktiv" 1 "Bedingungen nicht erfuellt" 5 "aktiv" 6 "beendet" 7 "Abbruch" 8 "beendet niO" 9 "beendet iO" DEFAULT_VALUE "undef" /end COMPU_VTAB
/begin COMPU_METHOD FORMULA_0683 "FORMULA_0683" RAT_FUNC "%5.2" "s" COEFFS 0 0 25.6 0 1 0 /end COMPU_METHOD
/* ------------------ Abschnitt erzeugt aus ews.dat ------------------ */
/begin COMPU_METHOD FORMULA_0684 "FORMULA_0684" TAB_VERB "%5.2" "-" COMPU_TAB_REF FORMULA_0684_VTAB /end COMPU_METHOD
/begin COMPU_VTAB FORMULA_0684_VTAB "FORMULA_0684_VTAB" TAB_VERB 21 0 "RESET" 1 "GET_WC_IGN" 2 "WAIT_TEL" 130 "WAIT_TEL_NACHLAUF" 131 "FREI" 132 "WEITERGESCHALTEN" 133 "GESPEICHERT" 134 "NACHLAUF" 6 "WAIT_RESTART" 7 "MANIPULATION" 8 "JUNGFRAU" 9 "WAIT_STARTWERT1" 10 "WAIT_STARTWERT2" 11 "WAIT_SYNC" 12 "SYNC_ENDE" 13 "SYNC_STW_FALSCH" 14 "SYNC_Z1_FEHLER" 15 "SYNC_KEIN_STW" 16 "SYNC_TIMEOUT" 17 "DEFEKT" 18 "WC_DEFEKT" DEFAULT_VALUE "undef" /end COMPU_VTAB
/begin COMPU_METHOD FORMULA_0685 "FORMULA_0685" TAB_VERB "%5.2" "-" COMPU_TAB_REF FORMULA_0685_VTAB /end COMPU_METHOD
/begin COMPU_VTAB FORMULA_0685_VTAB "FORMULA_0685_VTAB" TAB_VERB 3 0 "kein STW" 1 "STW defekt" 2 "STW o.k." /end COMPU_VTAB
/* ------------------ Abschnitt erzeugt aus fplau.dat ------------------ */
/begin COMPU_METHOD FORMULA_0686 "FORMULA_0686" TAB_VERB "%9.2" "-" COMPU_TAB_REF FORMULA_0686_VTAB /end COMPU_METHOD
/begin COMPU_VTAB FORMULA_0686_VTAB "FORMULA_0686_VTAB" TAB_VERB 1 0 "diag. laeuft" DEFAULT_VALUE "diag. inaktive" /end COMPU_VTAB
/begin COMPU_METHOD FORMULA_0687 "FORMULA_0687" TAB_VERB "%9.2" "-" COMPU_TAB_REF FORMULA_0687_VTAB /end COMPU_METHOD
/begin COMPU_VTAB FORMULA_0687_VTAB "FORMULA_0687_VTAB" TAB_VERB 1 0 "ok" DEFAULT_VALUE "nok" /end COMPU_VTAB
/begin COMPU_METHOD FORMULA_0688 "FORMULA_0688" TAB_VERB "%9.2" "-" COMPU_TAB_REF FORMULA_0688_VTAB /end COMPU_METHOD
/begin COMPU_VTAB FORMULA_0688_VTAB "FORMULA_0688_VTAB" TAB_VERB 1 0 "ok" DEFAULT_VALUE "nok" /end COMPU_VTAB
/begin COMPU_METHOD FORMULA_0689 "FORMULA_0689" TAB_VERB "%9.2" "-" COMPU_TAB_REF FORMULA_0689_VTAB /end COMPU_METHOD
/begin COMPU_VTAB FORMULA_0689_VTAB "FORMULA_0689_VTAB" TAB_VERB 1 0 "ok" DEFAULT_VALUE "nok" /end COMPU_VTAB
/begin COMPU_METHOD FORMULA_0690 "FORMULA_0690" TAB_VERB "%9.2" "-" COMPU_TAB_REF FORMULA_0690_VTAB /end COMPU_METHOD
/begin COMPU_VTAB FORMULA_0690_VTAB "FORMULA_0690_VTAB" TAB_VERB 1 0 "ok" DEFAULT_VALUE "nok" /end COMPU_VTAB
/begin COMPU_METHOD FORMULA_0691 "FORMULA_0691" TAB_VERB "%9.2" "-" COMPU_TAB_REF FORMULA_0691_VTAB /end COMPU_METHOD
/begin COMPU_VTAB FORMULA_0691_VTAB "FORMULA_0691_VTAB" TAB_VERB 1 0 "ok" DEFAULT_VALUE "nok" /end COMPU_VTAB
/begin COMPU_METHOD FORMULA_0692 "FORMULA_0692" TAB_VERB "%9.2" "-" COMPU_TAB_REF FORMULA_0692_VTAB /end COMPU_METHOD
/begin COMPU_VTAB FORMULA_0692_VTAB "FORMULA_0692_VTAB" TAB_VERB 1 0 "ok" DEFAULT_VALUE "nok" /end COMPU_VTAB
/begin COMPU_METHOD FORMULA_0693 "FORMULA_0693" TAB_VERB "%9.2" "-" COMPU_TAB_REF FORMULA_0693_VTAB /end COMPU_METHOD
/begin COMPU_VTAB FORMULA_0693_VTAB "FORMULA_0693_VTAB" TAB_VERB 1 0 "ok" DEFAULT_VALUE "nok" /end COMPU_VTAB
/begin COMPU_METHOD FORMULA_0694 "FORMULA_0694" TAB_VERB "%9.2" "-" COMPU_TAB_REF FORMULA_0694_VTAB /end COMPU_METHOD
/begin COMPU_VTAB FORMULA_0694_VTAB "FORMULA_0694_VTAB" TAB_VERB 1 0 "ok" DEFAULT_VALUE "nok" /end COMPU_VTAB
/begin COMPU_METHOD FORMULA_0695 "FORMULA_0695" TAB_VERB "%9.2" "-" COMPU_TAB_REF FORMULA_0695_VTAB /end COMPU_METHOD
/begin COMPU_VTAB FORMULA_0695_VTAB "FORMULA_0695_VTAB" TAB_VERB 1 0 "ok" DEFAULT_VALUE "nok" /end COMPU_VTAB
/begin COMPU_METHOD FORMULA_0696 "FORMULA_0696" TAB_VERB "%9.2" "-" COMPU_TAB_REF FORMULA_0696_VTAB /end COMPU_METHOD
/begin COMPU_VTAB FORMULA_0696_VTAB "FORMULA_0696_VTAB" TAB_VERB 1 0 "ok" DEFAULT_VALUE "nok" /end COMPU_VTAB
/begin COMPU_METHOD FORMULA_0697 "FORMULA_0697" TAB_VERB "%9.2" "-" COMPU_TAB_REF FORMULA_0697_VTAB /end COMPU_METHOD
/begin COMPU_VTAB FORMULA_0697_VTAB "FORMULA_0697_VTAB" TAB_VERB 1 0 "ok" DEFAULT_VALUE "nok" /end COMPU_VTAB
/begin COMPU_METHOD FORMULA_0698 "FORMULA_0698" TAB_VERB "%9.2" "-" COMPU_TAB_REF FORMULA_0698_VTAB /end COMPU_METHOD
/begin COMPU_VTAB FORMULA_0698_VTAB "FORMULA_0698_VTAB" TAB_VERB 1 0 "ok" DEFAULT_VALUE "nok" /end COMPU_VTAB
/begin COMPU_METHOD FORMULA_0699 "FORMULA_0699" TAB_VERB "%9.2" "-" COMPU_TAB_REF FORMULA_0699_VTAB /end COMPU_METHOD
/begin COMPU_VTAB FORMULA_0699_VTAB "FORMULA_0699_VTAB" TAB_VERB 1 0 "ok" DEFAULT_VALUE "nok" /end COMPU_VTAB
/begin COMPU_METHOD FORMULA_0700 "FORMULA_0700" TAB_VERB "%9.2" "-" COMPU_TAB_REF FORMULA_0700_VTAB /end COMPU_METHOD
/begin COMPU_VTAB FORMULA_0700_VTAB "FORMULA_0700_VTAB" TAB_VERB 1 0 "ok" DEFAULT_VALUE "nok" /end COMPU_VTAB
/begin COMPU_METHOD FORMULA_0701 "FORMULA_0701" TAB_VERB "%9.2" "-" COMPU_TAB_REF FORMULA_0701_VTAB /end COMPU_METHOD
/begin COMPU_VTAB FORMULA_0701_VTAB "FORMULA_0701_VTAB" TAB_VERB 1 0 "ok" DEFAULT_VALUE "nok" /end COMPU_VTAB
/begin COMPU_METHOD FORMULA_0702 "FORMULA_0702" TAB_VERB "%9.2" "-" COMPU_TAB_REF FORMULA_0702_VTAB /end COMPU_METHOD
/begin COMPU_VTAB FORMULA_0702_VTAB "FORMULA_0702_VTAB" TAB_VERB 1 0 "ok" DEFAULT_VALUE "nok" /end COMPU_VTAB
/begin COMPU_METHOD FORMULA_0703 "FORMULA_0703" TAB_VERB "%9.2" "-" COMPU_TAB_REF FORMULA_0703_VTAB /end COMPU_METHOD
/begin COMPU_VTAB FORMULA_0703_VTAB "FORMULA_0703_VTAB" TAB_VERB 1 0 "ok" DEFAULT_VALUE "nok" /end COMPU_VTAB
/begin COMPU_METHOD FORMULA_0704 "FORMULA_0704" TAB_VERB "%9.2" "-" COMPU_TAB_REF FORMULA_0704_VTAB /end COMPU_METHOD
/begin COMPU_VTAB FORMULA_0704_VTAB "FORMULA_0704_VTAB" TAB_VERB 1 0 "ok" DEFAULT_VALUE "nok" /end COMPU_VTAB
/begin COMPU_METHOD FORMULA_0705 "FORMULA_0705" TAB_VERB "%9.2" "-" COMPU_TAB_REF FORMULA_0705_VTAB /end COMPU_METHOD
/begin COMPU_VTAB FORMULA_0705_VTAB "FORMULA_0705_VTAB" TAB_VERB 1 0 "ok" DEFAULT_VALUE "nok" /end COMPU_VTAB
/begin COMPU_METHOD FORMULA_0706 "FORMULA_0706" TAB_VERB "%9.2" "-" COMPU_TAB_REF FORMULA_0706_VTAB /end COMPU_METHOD
/begin COMPU_VTAB FORMULA_0706_VTAB "FORMULA_0706_VTAB" TAB_VERB 1 0 "ok" DEFAULT_VALUE "nok" /end COMPU_VTAB
/begin COMPU_METHOD FORMULA_0707 "FORMULA_0707" TAB_VERB "%9.2" "-" COMPU_TAB_REF FORMULA_0707_VTAB /end COMPU_METHOD
/begin COMPU_VTAB FORMULA_0707_VTAB "FORMULA_0707_VTAB" TAB_VERB 1 0 "ok" DEFAULT_VALUE "nok" /end COMPU_VTAB
/* ------------------ Abschnitt erzeugt aus kva.dat ------------------ */
/begin COMPU_METHOD FORMULA_0746 "FORMULA_0746" RAT_FUNC "%6.1" "l/h" COEFFS 0 8 0 0 0 1 /end COMPU_METHOD
/begin COMPU_METHOD FORMULA_0840 "FORMULA_0840" RAT_FUNC "%6.1" "%" COEFFS 0 1024 0 0 0 100 /end COMPU_METHOD
/begin COMPU_METHOD FORMULA_0997 "FORMULA_0997" RAT_FUNC "%8.3" "qcm" COEFFS 0 1000 0 0 0 1 /end COMPU_METHOD
/begin COMPU_METHOD FORMULA_0998 "FORMULA_0998" RAT_FUNC "%7.2" "ms" COEFFS 0 100 0 0 0 1 /end COMPU_METHOD
/* ------------------ Abschnitt erzeugt aus pks.dat ------------------ */
/begin COMPU_METHOD FORMULA_1033 "FORMULA_1033" RAT_FUNC "%7.2" "s" COEFFS 0 10 0 0 0 1 /end COMPU_METHOD
/begin COMPU_METHOD FORMULA_1034 "FORMULA_1034" RAT_FUNC "%8.3" "-" COEFFS 0 1000 0 0 0 1 /end COMPU_METHOD
/begin COMPU_METHOD FORMULA_1037 "FORMULA_1037" TAB_VERB "%5.2" "-" COMPU_TAB_REF FORMULA_1037_VTAB /end COMPU_METHOD
/begin COMPU_VTAB FORMULA_1037_VTAB "FORMULA_1037_VTAB" TAB_VERB 2 0 "Disabled" 1 "Enabled" /end COMPU_VTAB
/begin COMPU_METHOD FORMULA_1038 "FORMULA_1038" RAT_FUNC "%8.3" "bar/V" COEFFS 0 5000 0 0 0 1 /end COMPU_METHOD
/begin COMPU_METHOD FORMULA_1039 "FORMULA_1039" RAT_FUNC "%8.3" "-/10ms" COEFFS 0 1000 0 0 0 1 /end COMPU_METHOD
/begin COMPU_METHOD FORMULA_1040 "FORMULA_1040" RAT_FUNC "%7.2" "s" COEFFS 0 0 655.35 0 1 0 /end COMPU_METHOD
/* ------------------ Abschnitt erzeugt aus psau.dat ------------------ */
/begin COMPU_METHOD FORMULA_1054 "FORMULA_1054" RAT_FUNC "%6.1" "mbar/V" COEFFS 0 80 0 0 0 1 /end COMPU_METHOD
/begin COMPU_METHOD FORMULA_1055 "FORMULA_1055" TAB_VERB "%5.2" "-" COMPU_TAB_REF FORMULA_1055_VTAB /end COMPU_METHOD
/begin COMPU_VTAB FORMULA_1055_VTAB "FORMULA_1055_VTAB" TAB_VERB 2 0 "absolut" 1 "differenz" DEFAULT_VALUE "ungueltig" /end COMPU_VTAB
/begin COMPU_METHOD FORMULA_1071 "FORMULA_1071" RAT_FUNC "%8.3" "dm**3" COEFFS 0 1000 0 0 0 1 /end COMPU_METHOD
/begin COMPU_METHOD FORMULA_1072 "FORMULA_1072" RAT_FUNC "%8.3" "Kg/m**3" COEFFS 0 1000 0 0 0 1 /end COMPU_METHOD
/begin COMPU_METHOD FORMULA_1073 "FORMULA_1073" RAT_FUNC "%3.0" "Segmente" COEFFS 0 2 0 0 0 1 /end COMPU_METHOD
/begin COMPU_METHOD FORMULA_1076 "FORMULA_1076" RAT_FUNC "%3.0" "seg" COEFFS 0 1 0 0 0 1 /end COMPU_METHOD
/begin COMPU_METHOD FORMULA_1077 "FORMULA_1077" RAT_FUNC "%6.1" "ccm" COEFFS 0 10 0 0 0 1 /end COMPU_METHOD
/begin COMPU_METHOD FORMULA_1078 "FORMULA_1078" RAT_FUNC "%7.2" "-" COEFFS 0 1000 0 0 0 1 /end COMPU_METHOD
/begin COMPU_METHOD FORMULA_1091 "FORMULA_1091" RAT_FUNC "%3.0" "digit" COEFFS 0 1 0 0 0 1 /end COMPU_METHOD
/begin COMPU_METHOD FORMULA_1097 "FORMULA_1097" RAT_FUNC "%6.1" "kg/h" COEFFS 0 125 0 0 0 1 /end COMPU_METHOD
/begin COMPU_METHOD FORMULA_1118 "FORMULA_1118" RAT_FUNC "%6.1" "kg/h/0.01s" COEFFS 0 10 0 0 0 1 /end COMPU_METHOD
/begin COMPU_METHOD FORMULA_1120 "FORMULA_1120" RAT_FUNC "%8.3" "kg*s/h" COEFFS 0 1000 0 0 0 1 /end COMPU_METHOD
/begin COMPU_METHOD FORMULA_1121 "FORMULA_1121" TAB_VERB "%5.2" "-" COMPU_TAB_REF FORMULA_1121_VTAB /end COMPU_METHOD
/begin COMPU_VTAB FORMULA_1121_VTAB "FORMULA_1121_VTAB" TAB_VERB 5 0 "AUS" 2 "AN-HFM" 4 "AN-LAM" 8 "Prueflauf" 10 "AN-HFM-PL" DEFAULT_VALUE "undefiniert" /end COMPU_VTAB
/begin COMPU_METHOD FORMULA_1122 "FORMULA_1122" TAB_VERB "%5.2" "-" COMPU_TAB_REF FORMULA_1122_VTAB /end COMPU_METHOD
/begin COMPU_VTAB FORMULA_1122_VTAB "FORMULA_1122_VTAB" TAB_VERB 2 0 "SL_ML_SOLL" 2 "Modell" DEFAULT_VALUE "undefiniert" /end COMPU_VTAB
/begin COMPU_METHOD FORMULA_1123 "FORMULA_1123" RAT_FUNC "%9.4" "J/(kg*K*m^4)" COEFFS 0 65535 0 0 0 1 /end COMPU_METHOD
/begin COMPU_METHOD FORMULA_1124 "FORMULA_1124" RAT_FUNC "%8.3" "kg/h" COEFFS 0 125 0 0 0 1 /end COMPU_METHOD
/begin COMPU_METHOD FORMULA_1128 "FORMULA_1128" TAB_VERB "%3.0" "-" COMPU_TAB_REF FORMULA_1128_VTAB /end COMPU_METHOD
/begin COMPU_VTAB FORMULA_1128_VTAB "FORMULA_1128_VTAB" TAB_VERB 3 0 "SSP-Funktion" 1 "Treiber an [SSP aus]" 2 "Treiber aus [SSP an]" /end COMPU_VTAB
/* ------------------ Abschnitt erzeugt aus os.dat ------------------ */ /* ------------------ Abschnitt erzeugt aus pctrl.dat ------------------ */
/begin CHARACTERISTIC K_PCTRL_TIMEOUT "Timeout der Prozessorueberwachung | EN: Timeout der Prozessorueberwachung" VALUE 0x75E38 TKW_VV_VV_UB 100.0 FORMULA_0353 0.0 2550.0000 /end CHARACTERISTIC
/begin CHARACTERISTIC K_PCTRL_TASK_ZYKL "Task-Ueberwachungszyklus | EN: Task-Ueberwachungszyklus" VALUE 0x75E39 TKW_VV_VV_UB 100.0 FORMULA_0352 0.0 1.2750 /end CHARACTERISTIC
/begin CHARACTERISTIC K_PCTRL_PROZ_ZYKL "Prozess-Ueberwachungszyklus | EN: Prozess-Ueberwachungszyklus" VALUE 0x75E3A TKW_VV_VV_UB 100.0 FORMULA_0352 0.0 1.2750 /end CHARACTERISTIC
/* ------------------ Abschnitt erzeugt aus qadc.dat ------------------ */ /* ------------------ Abschnitt erzeugt aus ram_chk.dat ------------------ */
/begin CHARACTERISTIC K_RAM_CHK_T "Zeit fuer den Ramcheck pro Aufruf" VALUE 0x770FE TKW_VV_VV_UB 100.0 FORMULA_0356 1.0000 255.0000 /end CHARACTERISTIC
/begin CHARACTERISTIC K_RAM_CHK_CFG "Ramcheck Config | EN: Ramcheck Config" VALUE 0x770FF TKW_VV_VV_UB 100.0 FORMULA_0357 0.0 255.0 /end CHARACTERISTIC
/* ------------------ Abschnitt erzeugt aus sc_glob.dat ------------------ */ /* ------------------ Abschnitt erzeugt aus sk.dat ------------------ */
/begin CHARACTERISTIC K_SK_CFG "SK-Cfg" VALUE 0x774DA TKW_VV_VV_UB 100.0 FORMULA_0363 0.0 255.0 /end CHARACTERISTIC
/begin CHARACTERISTIC K_SK_MAX_RESETS "max. Anzahl von Resets pro SG-Lauf | EN: Maximum number of resets per ECU run" VALUE 0x774DB TKW_VV_VV_UB 100.0 FORMULA_0003 0.0 255.0000 /end CHARACTERISTIC
/begin CHARACTERISTIC K_SK_FM_GEMISCH_TEST "SK Gemischtestmaske | EN: Safety-concept mixture test mask" VALUE 0x774DC TKW_VV_VV_UB 100.0 FORMULA_0003 0.0 255.0000 /end CHARACTERISTIC
/begin CHARACTERISTIC K_SK_FM_KR_TEST "SK KR-Testmaske" VALUE 0x774DD TKW_VV_VV_UB 100.0 FORMULA_0003 0.0 255.0000 /end CHARACTERISTIC
/begin CHARACTERISTIC K_SK_FM_EGAS_TEST "SK Egastestmaske | EN: Safety-concept E-gas test mask" VALUE 0x774DE TKW_VV_VV_UB 100.0 FORMULA_0003 0.0 255.0000 /end CHARACTERISTIC
/begin CHARACTERISTIC K_SK_ZYL_OFF_MAX "Anzahl der abg. Zyl. pro Bank | EN: Number of cylinders cut per bank" VALUE 0x774DF TKW_VV_VV_UB 100.0 FORMULA_0003 0.0 255.0000 /end CHARACTERISTIC
/begin CHARACTERISTIC K_SK_FM_FAIL_ZYL_TEST "SK TI-Testmaske (1=Aus) | EN: Safety-concept injection test mask (1=off)" VALUE 0x774E0 TKW_VV_VV_UW 100.0 FORMULA_0010 0.0 65535.0000 /end CHARACTERISTIC
/begin CHARACTERISTIC K_SK_FM_SMG_TEST "SK SMG-Testmaske | EN: Safety-concept SMG test mask" VALUE 0x774E2 TKW_VV_VV_UB 100.0 FORMULA_0003 0.0 255.0000 /end CHARACTERISTIC
/begin CHARACTERISTIC K_SK_FM_MD_TEST "SK Md-Testmaske | EN: Safety-concept torque test mask" VALUE 0x774E3 TKW_VV_VV_UB 100.0 FORMULA_0003 0.0 255.0000 /end CHARACTERISTIC
/begin CHARACTERISTIC K_SK_FM_LAM_TEST "SK LAM-Testmaske | EN: Safety-concept lambda test mask" VALUE 0x774E4 TKW_VV_VV_UB 100.0 FORMULA_0003 0.0 255.0000 /end CHARACTERISTIC
/begin CHARACTERISTIC K_SK_FM_MVAC_TEST "SK MVAC-Testmaske" VALUE 0x774E5 TKW_VV_VV_UB 100.0 FORMULA_0364 0.0 255.0 /end CHARACTERISTIC
/begin CHARACTERISTIC K_SK_MAX_OS_ERR "erlaubte OS-Fehler bis zum Reset | EN: Permitted operating-system faults before reset" VALUE 0x774E6 TKW_VV_VV_UB 100.0 FORMULA_0003 0.0 255.0000 /end CHARACTERISTIC
/begin CHARACTERISTIC K_SK_TASK_ERR "Maske Taskueberwachung | EN: Task monitoring mask" VALUE 0x774E7 TKW_VV_VV_UB 100.0 FORMULA_0003 0.0 255.0000 /end CHARACTERISTIC
/begin CHARACTERISTIC K_SK_CRC32 "CRC32-Aktivierung" VALUE 0x774E8 TKW_VV_VV_UB 100.0 FORMULA_0365 0.0 255.0 /end CHARACTERISTIC
/begin CHARACTERISTIC K_SK_PKS_NOTLAUF "PKS-Aktivierung | EN: Fuel-pressure-control activation" VALUE 0x774E9 TKW_VV_VV_UB 100.0 FORMULA_0003 0.0 255.0000 /end CHARACTERISTIC
/begin CHARACTERISTIC K_SK_LLRA_SPERRE "LLRA-Sperre | EN: Idle-controller adaptation lock" VALUE 0x774EA TKW_VV_VV_UB 100.0 FORMULA_0003 0.0 255.0000 /end CHARACTERISTIC
/begin CHARACTERISTIC K_SK_FRA_SPERRE "FRA-Sperre | EN: Charge-adaptation lock" VALUE 0x774EB TKW_VV_VV_UB 100.0 FORMULA_0003 0.0 255.0000 /end CHARACTERISTIC
/begin CHARACTERISTIC K_SK_KH_SPERRE "KH-Sperre | EN: Catalyst-heating lock" VALUE 0x774EC TKW_VV_VV_UB 100.0 FORMULA_0003 0.0 255.0000 /end CHARACTERISTIC
/begin CHARACTERISTIC K_SK_FGR_SPERRE "FGR-Sperre | EN: Cruise control lock" VALUE 0x774ED TKW_VV_VV_UB 100.0 FORMULA_0003 0.0 255.0000 /end CHARACTERISTIC
/begin CHARACTERISTIC K_SK_MD_TI_EINGR "Freigabe Teilfeuern | EN: Enable partial firing (cylinder cut-out)" VALUE 0x774EE TKW_VV_VV_UB 100.0 FORMULA_0003 0.0 255.0000 /end CHARACTERISTIC
/begin CHARACTERISTIC K_SK_MD_VL_SPERRE "VL-Sperre | EN: Full-load lock" VALUE 0x774EF TKW_VV_VV_UB 100.0 FORMULA_0003 0.0 255.0000 /end CHARACTERISTIC
/begin CHARACTERISTIC K_SK_MD_BEGR_DK_OFFEN "Begrenzung bei offenen Klappen | EN: Limitation with open flaps" VALUE 0x774F0 TKW_VV_VV_UB 100.0 FORMULA_0003 0.0 255.0000 /end CHARACTERISTIC
/begin CHARACTERISTIC K_SK_LAM_EINGR_TI "LA-Eingriff bei Teilfeuerung" VALUE 0x774F1 TKW_VV_VV_UB 100.0 FORMULA_0366 0.0 255.0 /end CHARACTERISTIC
/begin CHARACTERISTIC K_SK_T_RESET_DELAY_OS "Resetdelay fuer Betriebssystem Fehler | EN: Reset delay for operating-system fault [s]" VALUE 0x774F2 TKW_VV_VV_UB 100.0 FORMULA_0317 0.0 2.0000 /end CHARACTERISTIC
/begin CHARACTERISTIC K_SK_EGAS_OFF_TIME "Zeit bis Egasabschaltung | EN: Time until throttle (E-gas) shut-off [s]" VALUE 0x774F4 TKW_VV_VV_UW 100.0 FORMULA_0021 0.0 5.0000 FORMAT "%5.2" /end CHARACTERISTIC
/begin CHARACTERISTIC K_SK_PROZ_ERR "Maske Prozessueberwachung | EN: Process monitoring mask" VALUE 0x774F6 TKW_VV_VV_UW 100.0 FORMULA_0010 0.0 65535.0000 /end CHARACTERISTIC
/begin CHARACTERISTIC K_SK_MD_BEGR_MVAC_SYS "Begrenzung bei MVAC-Systemfehler | EN: Limitation with brake-booster vacuum system fault" VALUE 0x774F8 TKW_VV_VV_UB 100.0 FORMULA_0003 0.0 255.0000 /end CHARACTERISTIC
/begin CHARACTERISTIC K_SK_MD_BEGR_RESET "Begrenzung ab dem 1.Reset | EN: Limitation from the 1st reset" VALUE 0x774F9 TKW_VV_VV_UB 100.0 FORMULA_0003 0.0 255.0000 /end CHARACTERISTIC
/begin CHARACTERISTIC K_SK_EGAS_OFF_1of16_ "DK2 DK1 LLS2 LLS1 | EN: DK2 DK1 LLS2 LLS1" VALUE 0x774FA TKW_VV_VV_UB 100.0 FORMULA_0003 0.0 255.0000 /end CHARACTERISTIC
/begin CHARACTERISTIC K_SK_EGAS_OFF_2of16_ "DK2 DK1 LLS2 LLS1 | EN: DK2 DK1 LLS2 LLS1" VALUE 0x774FB TKW_VV_VV_UB 100.0 FORMULA_0003 0.0 255.0000 /end CHARACTERISTIC
/begin CHARACTERISTIC K_SK_EGAS_OFF_3of16_ "DK2 DK1 LLS2 LLS1 | EN: DK2 DK1 LLS2 LLS1" VALUE 0x774FC TKW_VV_VV_UB 100.0 FORMULA_0003 0.0 255.0000 /end CHARACTERISTIC
/begin CHARACTERISTIC K_SK_EGAS_OFF_4of16_ "DK2 DK1 LLS2 LLS1 | EN: DK2 DK1 LLS2 LLS1" VALUE 0x774FD TKW_VV_VV_UB 100.0 FORMULA_0003 0.0 255.0000 /end CHARACTERISTIC
/begin CHARACTERISTIC K_SK_EGAS_OFF_5of16_ "DK2 DK1 LLS2 LLS1 | EN: DK2 DK1 LLS2 LLS1" VALUE 0x774FE TKW_VV_VV_UB 100.0 FORMULA_0003 0.0 255.0000 /end CHARACTERISTIC
/begin CHARACTERISTIC K_SK_EGAS_OFF_6of16_ "DK2 DK1 LLS2 LLS1" VALUE 0x774FF TKW_VV_VV_UB 100.0 FORMULA_0003 0.0 255.0000 /end CHARACTERISTIC
/begin CHARACTERISTIC K_SK_EGAS_OFF_7of16_ "DK2 DK1 LLS2 LLS1 | EN: DK2 DK1 LLS2 LLS1" VALUE 0x77500 TKW_VV_VV_UB 100.0 FORMULA_0003 0.0 255.0000 /end CHARACTERISTIC
/begin CHARACTERISTIC K_SK_EGAS_OFF_8of16_ "DK2 DK1 LLS2 LLS1" VALUE 0x77501 TKW_VV_VV_UB 100.0 FORMULA_0003 0.0 255.0000 /end CHARACTERISTIC
/begin CHARACTERISTIC K_SK_EGAS_OFF_9of16_ "DK2 DK1 LLS2 LLS1" VALUE 0x77502 TKW_VV_VV_UB 100.0 FORMULA_0003 0.0 255.0000 /end CHARACTERISTIC
/begin CHARACTERISTIC K_SK_EGAS_OFF_10of16_ "DK2 DK1 LLS2 LLS1" VALUE 0x77503 TKW_VV_VV_UB 100.0 FORMULA_0003 0.0 255.0000 /end CHARACTERISTIC
/begin CHARACTERISTIC K_SK_EGAS_OFF_11of16_ "DK2 DK1 LLS2 LLS1" VALUE 0x77504 TKW_VV_VV_UB 100.0 FORMULA_0003 0.0 255.0000 /end CHARACTERISTIC
/begin CHARACTERISTIC K_SK_EGAS_OFF_12of16_ "DK2 DK1 LLS2 LLS1" VALUE 0x77505 TKW_VV_VV_UB 100.0 FORMULA_0003 0.0 255.0000 /end CHARACTERISTIC
/begin CHARACTERISTIC K_SK_EGAS_OFF_13of16_ "DK2 DK1 LLS2 LLS1" VALUE 0x77506 TKW_VV_VV_UB 100.0 FORMULA_0003 0.0 255.0000 /end CHARACTERISTIC
/begin CHARACTERISTIC K_SK_EGAS_OFF_14of16_ "DK2 DK1 LLS2 LLS1 | EN: DK2 DK1 LLS2 LLS1" VALUE 0x77507 TKW_VV_VV_UB 100.0 FORMULA_0003 0.0 255.0000 /end CHARACTERISTIC
/begin CHARACTERISTIC K_SK_EGAS_OFF_15of16_ "DK2 DK1 LLS2 LLS1 | EN: DK2 DK1 LLS2 LLS1" VALUE 0x77508 TKW_VV_VV_UB 100.0 FORMULA_0003 0.0 255.0000 /end CHARACTERISTIC
/begin CHARACTERISTIC K_SK_EGAS_OFF_16of16_ "DK2 DK1 LLS2 LLS1 | EN: DK2 DK1 LLS2 LLS1" VALUE 0x77509 TKW_VV_VV_UB 100.0 FORMULA_0003 0.0 255.0000 /end CHARACTERISTIC
/begin CHARACTERISTIC K_SK_MD_BEGR_EGAS_1of64_ "WDK2 WDK1 DK2 DK1 LLS2 LLS1 | EN: WDK2 WDK1 DK2 DK1 LLS2 LLS1" VALUE 0x7750A TKW_VV_VV_UB 100.0 FORMULA_0003 0.0 255.0000 /end CHARACTERISTIC
/begin CHARACTERISTIC K_SK_MD_BEGR_EGAS_2of64_ "WDK2 WDK1 DK2 DK1 LLS2 LLS1 | EN: WDK2 WDK1 DK2 DK1 LLS2 LLS1" VALUE 0x7750B TKW_VV_VV_UB 100.0 FORMULA_0003 0.0 255.0000 /end CHARACTERISTIC
/begin CHARACTERISTIC K_SK_MD_BEGR_EGAS_3of64_ "WDK2 WDK1 DK2 DK1 LLS2 LLS1 | EN: WDK2 WDK1 DK2 DK1 LLS2 LLS1" VALUE 0x7750C TKW_VV_VV_UB 100.0 FORMULA_0003 0.0 255.0000 /end CHARACTERISTIC
/begin CHARACTERISTIC K_SK_MD_BEGR_EGAS_4of64_ "WDK2 WDK1 DK2 DK1 LLS2 LLS1 | EN: WDK2 WDK1 DK2 DK1 LLS2 LLS1" VALUE 0x7750D TKW_VV_VV_UB 100.0 FORMULA_0003 0.0 255.0000 /end CHARACTERISTIC
/begin CHARACTERISTIC K_SK_MD_BEGR_EGAS_5of64_ "WDK2 WDK1 DK2 DK1 LLS2 LLS1 | EN: WDK2 WDK1 DK2 DK1 LLS2 LLS1" VALUE 0x7750E TKW_VV_VV_UB 100.0 FORMULA_0003 0.0 255.0000 /end CHARACTERISTIC
/begin CHARACTERISTIC K_SK_MD_BEGR_EGAS_6of64_ "WDK2 WDK1 DK2 DK1 LLS2 LLS1 | EN: WDK2 WDK1 DK2 DK1 LLS2 LLS1" VALUE 0x7750F TKW_VV_VV_UB 100.0 FORMULA_0003 0.0 255.0000 /end CHARACTERISTIC
/begin CHARACTERISTIC K_SK_MD_BEGR_EGAS_7of64_ "WDK2 WDK1 DK2 DK1 LLS2 LLS1 | EN: WDK2 WDK1 DK2 DK1 LLS2 LLS1" VALUE 0x77510 TKW_VV_VV_UB 100.0 FORMULA_0003 0.0 255.0000 /end CHARACTERISTIC
/begin CHARACTERISTIC K_SK_MD_BEGR_EGAS_8of64_ "WDK2 WDK1 DK2 DK1 LLS2 LLS1 | EN: WDK2 WDK1 DK2 DK1 LLS2 LLS1" VALUE 0x77511 TKW_VV_VV_UB 100.0 FORMULA_0003 0.0 255.0000 /end CHARACTERISTIC
/begin CHARACTERISTIC K_SK_MD_BEGR_EGAS_9of64_ "WDK2 WDK1 DK2 DK1 LLS2 LLS1 | EN: WDK2 WDK1 DK2 DK1 LLS2 LLS1" VALUE 0x77512 TKW_VV_VV_UB 100.0 FORMULA_0003 0.0 255.0000 /end CHARACTERISTIC
/begin CHARACTERISTIC K_SK_MD_BEGR_EGAS_10of64_ "WDK2 WDK1 DK2 DK1 LLS2 LLS1 | EN: WDK2 WDK1 DK2 DK1 LLS2 LLS1" VALUE 0x77513 TKW_VV_VV_UB 100.0 FORMULA_0003 0.0 255.0000 /end CHARACTERISTIC
/begin CHARACTERISTIC K_SK_MD_BEGR_EGAS_11of64_ "WDK2 WDK1 DK2 DK1 LLS2 LLS1 | EN: WDK2 WDK1 DK2 DK1 LLS2 LLS1" VALUE 0x77514 TKW_VV_VV_UB 100.0 FORMULA_0003 0.0 255.0000 /end CHARACTERISTIC
/begin CHARACTERISTIC K_SK_MD_BEGR_EGAS_12of64_ "WDK2 WDK1 DK2 DK1 LLS2 LLS1 | EN: WDK2 WDK1 DK2 DK1 LLS2 LLS1" VALUE 0x77515 TKW_VV_VV_UB 100.0 FORMULA_0003 0.0 255.0000 /end CHARACTERISTIC
/begin CHARACTERISTIC K_SK_MD_BEGR_EGAS_13of64_ "WDK2 WDK1 DK2 DK1 LLS2 LLS1 | EN: WDK2 WDK1 DK2 DK1 LLS2 LLS1" VALUE 0x77516 TKW_VV_VV_UB 100.0 FORMULA_0003 0.0 255.0000 /end CHARACTERISTIC
/begin CHARACTERISTIC K_SK_MD_BEGR_EGAS_14of64_ "WDK2 WDK1 DK2 DK1 LLS2 LLS1 | EN: WDK2 WDK1 DK2 DK1 LLS2 LLS1" VALUE 0x77517 TKW_VV_VV_UB 100.0 FORMULA_0003 0.0 255.0000 /end CHARACTERISTIC
/begin CHARACTERISTIC K_SK_MD_BEGR_EGAS_15of64_ "WDK2 WDK1 DK2 DK1 LLS2 LLS1 | EN: WDK2 WDK1 DK2 DK1 LLS2 LLS1" VALUE 0x77518 TKW_VV_VV_UB 100.0 FORMULA_0003 0.0 255.0000 /end CHARACTERISTIC
/begin CHARACTERISTIC K_SK_MD_BEGR_EGAS_16of64_ "WDK2 WDK1 DK2 DK1 LLS2 LLS1 | EN: WDK2 WDK1 DK2 DK1 LLS2 LLS1" VALUE 0x77519 TKW_VV_VV_UB 100.0 FORMULA_0003 0.0 255.0000 /end CHARACTERISTIC
/begin CHARACTERISTIC K_SK_MD_BEGR_EGAS_17of64_ "WDK2 WDK1 DK2 DK1 LLS2 LLS1" VALUE 0x7751A TKW_VV_VV_UB 100.0 FORMULA_0003 0.0 255.0000 /end CHARACTERISTIC
/begin CHARACTERISTIC K_SK_MD_BEGR_EGAS_18of64_ "WDK2 WDK1 DK2 DK1 LLS2 LLS1" VALUE 0x7751B TKW_VV_VV_UB 100.0 FORMULA_0003 0.0 255.0000 /end CHARACTERISTIC
/begin CHARACTERISTIC K_SK_MD_BEGR_EGAS_19of64_ "WDK2 WDK1 DK2 DK1 LLS2 LLS1" VALUE 0x7751C TKW_VV_VV_UB 100.0 FORMULA_0003 0.0 255.0000 /end CHARACTERISTIC
/begin CHARACTERISTIC K_SK_MD_BEGR_EGAS_20of64_ "WDK2 WDK1 DK2 DK1 LLS2 LLS1" VALUE 0x7751D TKW_VV_VV_UB 100.0 FORMULA_0003 0.0 255.0000 /end CHARACTERISTIC
/begin CHARACTERISTIC K_SK_MD_BEGR_EGAS_21of64_ "WDK2 WDK1 DK2 DK1 LLS2 LLS1" VALUE 0x7751E TKW_VV_VV_UB 100.0 FORMULA_0003 0.0 255.0000 /end CHARACTERISTIC
/begin CHARACTERISTIC K_SK_MD_BEGR_EGAS_22of64_ "WDK2 WDK1 DK2 DK1 LLS2 LLS1" VALUE 0x7751F TKW_VV_VV_UB 100.0 FORMULA_0003 0.0 255.0000 /end CHARACTERISTIC
/begin CHARACTERISTIC K_SK_MD_BEGR_EGAS_23of64_ "WDK2 WDK1 DK2 DK1 LLS2 LLS1" VALUE 0x77520 TKW_VV_VV_UB 100.0 FORMULA_0003 0.0 255.0000 /end CHARACTERISTIC
/begin CHARACTERISTIC K_SK_MD_BEGR_EGAS_24of64_ "WDK2 WDK1 DK2 DK1 LLS2 LLS1" VALUE 0x77521 TKW_VV_VV_UB 100.0 FORMULA_0003 0.0 255.0000 /end CHARACTERISTIC
/begin CHARACTERISTIC K_SK_MD_BEGR_EGAS_25of64_ "WDK2 WDK1 DK2 DK1 LLS2 LLS1 | EN: WDK2 WDK1 DK2 DK1 LLS2 LLS1" VALUE 0x77522 TKW_VV_VV_UB 100.0 FORMULA_0003 0.0 255.0000 /end CHARACTERISTIC
/begin CHARACTERISTIC K_SK_MD_BEGR_EGAS_26of64_ "WDK2 WDK1 DK2 DK1 LLS2 LLS1 | EN: WDK2 WDK1 DK2 DK1 LLS2 LLS1" VALUE 0x77523 TKW_VV_VV_UB 100.0 FORMULA_0003 0.0 255.0000 /end CHARACTERISTIC
/begin CHARACTERISTIC K_SK_MD_BEGR_EGAS_27of64_ "WDK2 WDK1 DK2 DK1 LLS2 LLS1 | EN: WDK2 WDK1 DK2 DK1 LLS2 LLS1" VALUE 0x77524 TKW_VV_VV_UB 100.0 FORMULA_0003 0.0 255.0000 /end CHARACTERISTIC
/begin CHARACTERISTIC K_SK_MD_BEGR_EGAS_28of64_ "WDK2 WDK1 DK2 DK1 LLS2 LLS1 | EN: WDK2 WDK1 DK2 DK1 LLS2 LLS1" VALUE 0x77525 TKW_VV_VV_UB 100.0 FORMULA_0003 0.0 255.0000 /end CHARACTERISTIC
/begin CHARACTERISTIC K_SK_MD_BEGR_EGAS_29of64_ "WDK2 WDK1 DK2 DK1 LLS2 LLS1" VALUE 0x77526 TKW_VV_VV_UB 100.0 FORMULA_0003 0.0 255.0000 /end CHARACTERISTIC
/begin CHARACTERISTIC K_SK_MD_BEGR_EGAS_30of64_ "WDK2 WDK1 DK2 DK1 LLS2 LLS1" VALUE 0x77527 TKW_VV_VV_UB 100.0 FORMULA_0003 0.0 255.0000 /end CHARACTERISTIC
/begin CHARACTERISTIC K_SK_MD_BEGR_EGAS_31of64_ "WDK2 WDK1 DK2 DK1 LLS2 LLS1" VALUE 0x77528 TKW_VV_VV_UB 100.0 FORMULA_0003 0.0 255.0000 /end CHARACTERISTIC
/begin CHARACTERISTIC K_SK_MD_BEGR_EGAS_32of64_ "WDK2 WDK1 DK2 DK1 LLS2 LLS1" VALUE 0x77529 TKW_VV_VV_UB 100.0 FORMULA_0003 0.0 255.0000 /end CHARACTERISTIC
/begin CHARACTERISTIC K_SK_MD_BEGR_EGAS_33of64_ "WDK2 WDK1 DK2 DK1 LLS2 LLS1" VALUE 0x7752A TKW_VV_VV_UB 100.0 FORMULA_0003 0.0 255.0000 /end CHARACTERISTIC
/begin CHARACTERISTIC K_SK_MD_BEGR_EGAS_34of64_ "WDK2 WDK1 DK2 DK1 LLS2 LLS1" VALUE 0x7752B TKW_VV_VV_UB 100.0 FORMULA_0003 0.0 255.0000 /end CHARACTERISTIC
/begin CHARACTERISTIC K_SK_MD_BEGR_EGAS_35of64_ "WDK2 WDK1 DK2 DK1 LLS2 LLS1" VALUE 0x7752C TKW_VV_VV_UB 100.0 FORMULA_0003 0.0 255.0000 /end CHARACTERISTIC
/begin CHARACTERISTIC K_SK_MD_BEGR_EGAS_36of64_ "WDK2 WDK1 DK2 DK1 LLS2 LLS1" VALUE 0x7752D TKW_VV_VV_UB 100.0 FORMULA_0003 0.0 255.0000 /end CHARACTERISTIC
/begin CHARACTERISTIC K_SK_MD_BEGR_EGAS_37of64_ "WDK2 WDK1 DK2 DK1 LLS2 LLS1" VALUE 0x7752E TKW_VV_VV_UB 100.0 FORMULA_0003 0.0 255.0000 /end CHARACTERISTIC
/begin CHARACTERISTIC K_SK_MD_BEGR_EGAS_38of64_ "WDK2 WDK1 DK2 DK1 LLS2 LLS1" VALUE 0x7752F TKW_VV_VV_UB 100.0 FORMULA_0003 0.0 255.0000 /end CHARACTERISTIC
/begin CHARACTERISTIC K_SK_MD_BEGR_EGAS_39of64_ "WDK2 WDK1 DK2 DK1 LLS2 LLS1" VALUE 0x77530 TKW_VV_VV_UB 100.0 FORMULA_0003 0.0 255.0000 /end CHARACTERISTIC
/begin CHARACTERISTIC K_SK_MD_BEGR_EGAS_40of64_ "WDK2 WDK1 DK2 DK1 LLS2 LLS1" VALUE 0x77531 TKW_VV_VV_UB 100.0 FORMULA_0003 0.0 255.0000 /end CHARACTERISTIC
/begin CHARACTERISTIC K_SK_MD_BEGR_EGAS_41of64_ "WDK2 WDK1 DK2 DK1 LLS2 LLS1 | EN: WDK2 WDK1 DK2 DK1 LLS2 LLS1" VALUE 0x77532 TKW_VV_VV_UB 100.0 FORMULA_0003 0.0 255.0000 /end CHARACTERISTIC
/begin CHARACTERISTIC K_SK_MD_BEGR_EGAS_42of64_ "WDK2 WDK1 DK2 DK1 LLS2 LLS1 | EN: WDK2 WDK1 DK2 DK1 LLS2 LLS1" VALUE 0x77533 TKW_VV_VV_UB 100.0 FORMULA_0003 0.0 255.0000 /end CHARACTERISTIC
/begin CHARACTERISTIC K_SK_MD_BEGR_EGAS_43of64_ "WDK2 WDK1 DK2 DK1 LLS2 LLS1 | EN: WDK2 WDK1 DK2 DK1 LLS2 LLS1" VALUE 0x77534 TKW_VV_VV_UB 100.0 FORMULA_0003 0.0 255.0000 /end CHARACTERISTIC
/begin CHARACTERISTIC K_SK_MD_BEGR_EGAS_44of64_ "WDK2 WDK1 DK2 DK1 LLS2 LLS1 | EN: WDK2 WDK1 DK2 DK1 LLS2 LLS1" VALUE 0x77535 TKW_VV_VV_UB 100.0 FORMULA_0003 0.0 255.0000 /end CHARACTERISTIC
/begin CHARACTERISTIC K_SK_MD_BEGR_EGAS_45of64_ "WDK2 WDK1 DK2 DK1 LLS2 LLS1" VALUE 0x77536 TKW_VV_VV_UB 100.0 FORMULA_0003 0.0 255.0000 /end CHARACTERISTIC
/begin CHARACTERISTIC K_SK_MD_BEGR_EGAS_46of64_ "WDK2 WDK1 DK2 DK1 LLS2 LLS1" VALUE 0x77537 TKW_VV_VV_UB 100.0 FORMULA_0003 0.0 255.0000 /end CHARACTERISTIC
/begin CHARACTERISTIC K_SK_MD_BEGR_EGAS_47of64_ "WDK2 WDK1 DK2 DK1 LLS2 LLS1" VALUE 0x77538 TKW_VV_VV_UB 100.0 FORMULA_0003 0.0 255.0000 /end CHARACTERISTIC
/begin CHARACTERISTIC K_SK_MD_BEGR_EGAS_48of64_ "WDK2 WDK1 DK2 DK1 LLS2 LLS1" VALUE 0x77539 TKW_VV_VV_UB 100.0 FORMULA_0003 0.0 255.0000 /end CHARACTERISTIC
/begin CHARACTERISTIC K_SK_MD_BEGR_EGAS_49of64_ "WDK2 WDK1 DK2 DK1 LLS2 LLS1" VALUE 0x7753A TKW_VV_VV_UB 100.0 FORMULA_0003 0.0 255.0000 /end CHARACTERISTIC
/begin CHARACTERISTIC K_SK_MD_BEGR_EGAS_50of64_ "WDK2 WDK1 DK2 DK1 LLS2 LLS1" VALUE 0x7753B TKW_VV_VV_UB 100.0 FORMULA_0003 0.0 255.0000 /end CHARACTERISTIC
/begin CHARACTERISTIC K_SK_MD_BEGR_EGAS_51of64_ "WDK2 WDK1 DK2 DK1 LLS2 LLS1" VALUE 0x7753C TKW_VV_VV_UB 100.0 FORMULA_0003 0.0 255.0000 /end CHARACTERISTIC
/begin CHARACTERISTIC K_SK_MD_BEGR_EGAS_52of64_ "WDK2 WDK1 DK2 DK1 LLS2 LLS1" VALUE 0x7753D TKW_VV_VV_UB 100.0 FORMULA_0003 0.0 255.0000 /end CHARACTERISTIC
/begin CHARACTERISTIC K_SK_MD_BEGR_EGAS_53of64_ "WDK2 WDK1 DK2 DK1 LLS2 LLS1" VALUE 0x7753E TKW_VV_VV_UB 100.0 FORMULA_0003 0.0 255.0000 /end CHARACTERISTIC
/begin CHARACTERISTIC K_SK_MD_BEGR_EGAS_54of64_ "WDK2 WDK1 DK2 DK1 LLS2 LLS1" VALUE 0x7753F TKW_VV_VV_UB 100.0 FORMULA_0003 0.0 255.0000 /end CHARACTERISTIC
/begin CHARACTERISTIC K_SK_MD_BEGR_EGAS_55of64_ "WDK2 WDK1 DK2 DK1 LLS2 LLS1" VALUE 0x77540 TKW_VV_VV_UB 100.0 FORMULA_0003 0.0 255.0000 /end CHARACTERISTIC
/begin CHARACTERISTIC K_SK_MD_BEGR_EGAS_56of64_ "WDK2 WDK1 DK2 DK1 LLS2 LLS1" VALUE 0x77541 TKW_VV_VV_UB 100.0 FORMULA_0003 0.0 255.0000 /end CHARACTERISTIC
/begin CHARACTERISTIC K_SK_MD_BEGR_EGAS_57of64_ "WDK2 WDK1 DK2 DK1 LLS2 LLS1" VALUE 0x77542 TKW_VV_VV_UB 100.0 FORMULA_0003 0.0 255.0000 /end CHARACTERISTIC
/begin CHARACTERISTIC K_SK_MD_BEGR_EGAS_58of64_ "WDK2 WDK1 DK2 DK1 LLS2 LLS1" VALUE 0x77543 TKW_VV_VV_UB 100.0 FORMULA_0003 0.0 255.0000 /end CHARACTERISTIC
/begin CHARACTERISTIC K_SK_MD_BEGR_EGAS_59of64_ "WDK2 WDK1 DK2 DK1 LLS2 LLS1" VALUE 0x77544 TKW_VV_VV_UB 100.0 FORMULA_0003 0.0 255.0000 /end CHARACTERISTIC
/begin CHARACTERISTIC K_SK_MD_BEGR_EGAS_60of64_ "WDK2 WDK1 DK2 DK1 LLS2 LLS1" VALUE 0x77545 TKW_VV_VV_UB 100.0 FORMULA_0003 0.0 255.0000 /end CHARACTERISTIC
/begin CHARACTERISTIC K_SK_MD_BEGR_EGAS_61of64_ "WDK2 WDK1 DK2 DK1 LLS2 LLS1" VALUE 0x77546 TKW_VV_VV_UB 100.0 FORMULA_0003 0.0 255.0000 /end CHARACTERISTIC
/begin CHARACTERISTIC K_SK_MD_BEGR_EGAS_62of64_ "WDK2 WDK1 DK2 DK1 LLS2 LLS1" VALUE 0x77547 TKW_VV_VV_UB 100.0 FORMULA_0003 0.0 255.0000 /end CHARACTERISTIC
/begin CHARACTERISTIC K_SK_MD_BEGR_EGAS_63of64_ "WDK2 WDK1 DK2 DK1 LLS2 LLS1" VALUE 0x77548 TKW_VV_VV_UB 100.0 FORMULA_0003 0.0 255.0000 /end CHARACTERISTIC
/begin CHARACTERISTIC K_SK_MD_BEGR_EGAS_64of64_ "WDK2 WDK1 DK2 DK1 LLS2 LLS1 | EN: WDK2 WDK1 DK2 DK1 LLS2 LLS1" VALUE 0x77549 TKW_VV_VV_UB 100.0 FORMULA_0003 0.0 255.0000 /end CHARACTERISTIC
/begin CHARACTERISTIC K_SK_MD_BEGR_TI_1of16_ "B2 B1 Z2 Z1" VALUE 0x7754A TKW_VV_VV_UB 100.0 FORMULA_0003 0.0 255.0000 /end CHARACTERISTIC
/begin CHARACTERISTIC K_SK_MD_BEGR_TI_2of16_ "B2 B1 Z2 Z1 | EN: B2 B1 Z2 Z1" VALUE 0x7754B TKW_VV_VV_UB 100.0 FORMULA_0003 0.0 255.0000 /end CHARACTERISTIC
/begin CHARACTERISTIC K_SK_MD_BEGR_TI_3of16_ "B2 B1 Z2 Z1 | EN: B2 B1 Z2 Z1" VALUE 0x7754C TKW_VV_VV_UB 100.0 FORMULA_0003 0.0 255.0000 /end CHARACTERISTIC
/begin CHARACTERISTIC K_SK_MD_BEGR_TI_4of16_ "B2 B1 Z2 Z1 | EN: B2 B1 Z2 Z1" VALUE 0x7754D TKW_VV_VV_UB 100.0 FORMULA_0003 0.0 255.0000 /end CHARACTERISTIC
/begin CHARACTERISTIC K_SK_MD_BEGR_TI_5of16_ "B2 B1 Z2 Z1 | EN: B2 B1 Z2 Z1" VALUE 0x7754E TKW_VV_VV_UB 100.0 FORMULA_0003 0.0 255.0000 /end CHARACTERISTIC
/begin CHARACTERISTIC K_SK_MD_BEGR_TI_6of16_ "B2 B1 Z2 Z1 | EN: B2 B1 Z2 Z1" VALUE 0x7754F TKW_VV_VV_UB 100.0 FORMULA_0003 0.0 255.0000 /end CHARACTERISTIC
/begin CHARACTERISTIC K_SK_MD_BEGR_TI_7of16_ "B2 B1 Z2 Z1 | EN: B2 B1 Z2 Z1" VALUE 0x77550 TKW_VV_VV_UB 100.0 FORMULA_0003 0.0 255.0000 /end CHARACTERISTIC
/begin CHARACTERISTIC K_SK_MD_BEGR_TI_8of16_ "B2 B1 Z2 Z1 | EN: B2 B1 Z2 Z1" VALUE 0x77551 TKW_VV_VV_UB 100.0 FORMULA_0003 0.0 255.0000 /end CHARACTERISTIC
/begin CHARACTERISTIC K_SK_MD_BEGR_TI_9of16_ "B2 B1 Z2 Z1 | EN: B2 B1 Z2 Z1" VALUE 0x77552 TKW_VV_VV_UB 100.0 FORMULA_0003 0.0 255.0000 /end CHARACTERISTIC
/begin CHARACTERISTIC K_SK_MD_BEGR_TI_10of16_ "B2 B1 Z2 Z1 | EN: B2 B1 Z2 Z1" VALUE 0x77553 TKW_VV_VV_UB 100.0 FORMULA_0003 0.0 255.0000 /end CHARACTERISTIC
/begin CHARACTERISTIC K_SK_MD_BEGR_TI_11of16_ "B2 B1 Z2 Z1 | EN: B2 B1 Z2 Z1" VALUE 0x77554 TKW_VV_VV_UB 100.0 FORMULA_0003 0.0 255.0000 /end CHARACTERISTIC
/begin CHARACTERISTIC K_SK_MD_BEGR_TI_12of16_ "B2 B1 Z2 Z1 | EN: B2 B1 Z2 Z1" VALUE 0x77555 TKW_VV_VV_UB 100.0 FORMULA_0003 0.0 255.0000 /end CHARACTERISTIC
/begin CHARACTERISTIC K_SK_MD_BEGR_TI_13of16_ "B2 B1 Z2 Z1 | EN: B2 B1 Z2 Z1" VALUE 0x77556 TKW_VV_VV_UB 100.0 FORMULA_0003 0.0 255.0000 /end CHARACTERISTIC
/begin CHARACTERISTIC K_SK_MD_BEGR_TI_14of16_ "B2 B1 Z2 Z1 | EN: B2 B1 Z2 Z1" VALUE 0x77557 TKW_VV_VV_UB 100.0 FORMULA_0003 0.0 255.0000 /end CHARACTERISTIC
/begin CHARACTERISTIC K_SK_MD_BEGR_TI_15of16_ "B2 B1 Z2 Z1 | EN: B2 B1 Z2 Z1" VALUE 0x77558 TKW_VV_VV_UB 100.0 FORMULA_0003 0.0 255.0000 /end CHARACTERISTIC
/begin CHARACTERISTIC K_SK_MD_BEGR_TI_16of16_ "B2 B1 Z2 Z1 | EN: B2 B1 Z2 Z1" VALUE 0x77559 TKW_VV_VV_UB 100.0 FORMULA_0003 0.0 255.0000 /end CHARACTERISTIC
/begin CHARACTERISTIC K_SK_TI_OFF_EGAS_1of64_ "TI2 TI1 DK2 DK1 LLS2 LLS1 | EN: TI2 TI1 DK2 DK1 LLS2 LLS1" VALUE 0x7755A TKW_VV_VV_UB 100.0 FORMULA_0003 0.0 255.0000 /end CHARACTERISTIC
/begin CHARACTERISTIC K_SK_TI_OFF_EGAS_2of64_ "TI2 TI1 DK2 DK1 LLS2 LLS1 | EN: TI2 TI1 DK2 DK1 LLS2 LLS1" VALUE 0x7755B TKW_VV_VV_UB 100.0 FORMULA_0003 0.0 255.0000 /end CHARACTERISTIC
/begin CHARACTERISTIC K_SK_TI_OFF_EGAS_3of64_ "TI2 TI1 DK2 DK1 LLS2 LLS1 | EN: TI2 TI1 DK2 DK1 LLS2 LLS1" VALUE 0x7755C TKW_VV_VV_UB 100.0 FORMULA_0003 0.0 255.0000 /end CHARACTERISTIC
/begin CHARACTERISTIC K_SK_TI_OFF_EGAS_4of64_ "TI2 TI1 DK2 DK1 LLS2 LLS1 | EN: TI2 TI1 DK2 DK1 LLS2 LLS1" VALUE 0x7755D TKW_VV_VV_UB 100.0 FORMULA_0003 0.0 255.0000 /end CHARACTERISTIC
/begin CHARACTERISTIC K_SK_TI_OFF_EGAS_5of64_ "TI2 TI1 DK2 DK1 LLS2 LLS1 | EN: TI2 TI1 DK2 DK1 LLS2 LLS1" VALUE 0x7755E TKW_VV_VV_UB 100.0 FORMULA_0003 0.0 255.0000 /end CHARACTERISTIC
/begin CHARACTERISTIC K_SK_TI_OFF_EGAS_6of64_ "TI2 TI1 DK2 DK1 LLS2 LLS1 | EN: TI2 TI1 DK2 DK1 LLS2 LLS1" VALUE 0x7755F TKW_VV_VV_UB 100.0 FORMULA_0003 0.0 255.0000 /end CHARACTERISTIC
/begin CHARACTERISTIC K_SK_TI_OFF_EGAS_7of64_ "TI2 TI1 DK2 DK1 LLS2 LLS1 | EN: TI2 TI1 DK2 DK1 LLS2 LLS1" VALUE 0x77560 TKW_VV_VV_UB 100.0 FORMULA_0003 0.0 255.0000 /end CHARACTERISTIC
/begin CHARACTERISTIC K_SK_TI_OFF_EGAS_8of64_ "TI2 TI1 DK2 DK1 LLS2 LLS1 | EN: TI2 TI1 DK2 DK1 LLS2 LLS1" VALUE 0x77561 TKW_VV_VV_UB 100.0 FORMULA_0003 0.0 255.0000 /end CHARACTERISTIC
/begin CHARACTERISTIC K_SK_TI_OFF_EGAS_9of64_ "TI2 TI1 DK2 DK1 LLS2 LLS1 | EN: TI2 TI1 DK2 DK1 LLS2 LLS1" VALUE 0x77562 TKW_VV_VV_UB 100.0 FORMULA_0003 0.0 255.0000 /end CHARACTERISTIC
/begin CHARACTERISTIC K_SK_TI_OFF_EGAS_10of64_ "TI2 TI1 DK2 DK1 LLS2 LLS1 | EN: TI2 TI1 DK2 DK1 LLS2 LLS1" VALUE 0x77563 TKW_VV_VV_UB 100.0 FORMULA_0003 0.0 255.0000 /end CHARACTERISTIC
/begin CHARACTERISTIC K_SK_TI_OFF_EGAS_11of64_ "TI2 TI1 DK2 DK1 LLS2 LLS1 | EN: TI2 TI1 DK2 DK1 LLS2 LLS1" VALUE 0x77564 TKW_VV_VV_UB 100.0 FORMULA_0003 0.0 255.0000 /end CHARACTERISTIC
/begin CHARACTERISTIC K_SK_TI_OFF_EGAS_12of64_ "TI2 TI1 DK2 DK1 LLS2 LLS1 | EN: TI2 TI1 DK2 DK1 LLS2 LLS1" VALUE 0x77565 TKW_VV_VV_UB 100.0 FORMULA_0003 0.0 255.0000 /end CHARACTERISTIC
/begin CHARACTERISTIC K_SK_TI_OFF_EGAS_13of64_ "TI2 TI1 DK2 DK1 LLS2 LLS1 | EN: TI2 TI1 DK2 DK1 LLS2 LLS1" VALUE 0x77566 TKW_VV_VV_UB 100.0 FORMULA_0003 0.0 255.0000 /end CHARACTERISTIC
/begin CHARACTERISTIC K_SK_TI_OFF_EGAS_14of64_ "TI2 TI1 DK2 DK1 LLS2 LLS1 | EN: TI2 TI1 DK2 DK1 LLS2 LLS1" VALUE 0x77567 TKW_VV_VV_UB 100.0 FORMULA_0003 0.0 255.0000 /end CHARACTERISTIC
/begin CHARACTERISTIC K_SK_TI_OFF_EGAS_15of64_ "TI2 TI1 DK2 DK1 LLS2 LLS1 | EN: TI2 TI1 DK2 DK1 LLS2 LLS1" VALUE 0x77568 TKW_VV_VV_UB 100.0 FORMULA_0003 0.0 255.0000 /end CHARACTERISTIC
/begin CHARACTERISTIC K_SK_TI_OFF_EGAS_16of64_ "TI2 TI1 DK2 DK1 LLS2 LLS1 | EN: TI2 TI1 DK2 DK1 LLS2 LLS1" VALUE 0x77569 TKW_VV_VV_UB 100.0 FORMULA_0003 0.0 255.0000 /end CHARACTERISTIC
/begin CHARACTERISTIC K_SK_TI_OFF_EGAS_17of64_ "TI2 TI1 DK2 DK1 LLS2 LLS1 | EN: TI2 TI1 DK2 DK1 LLS2 LLS1" VALUE 0x7756A TKW_VV_VV_UB 100.0 FORMULA_0003 0.0 255.0000 /end CHARACTERISTIC
/begin CHARACTERISTIC K_SK_TI_OFF_EGAS_18of64_ "TI2 TI1 DK2 DK1 LLS2 LLS1 | EN: TI2 TI1 DK2 DK1 LLS2 LLS1" VALUE 0x7756B TKW_VV_VV_UB 100.0 FORMULA_0003 0.0 255.0000 /end CHARACTERISTIC
/begin CHARACTERISTIC K_SK_TI_OFF_EGAS_19of64_ "TI2 TI1 DK2 DK1 LLS2 LLS1 | EN: TI2 TI1 DK2 DK1 LLS2 LLS1" VALUE 0x7756C TKW_VV_VV_UB 100.0 FORMULA_0003 0.0 255.0000 /end CHARACTERISTIC
/begin CHARACTERISTIC K_SK_TI_OFF_EGAS_20of64_ "TI2 TI1 DK2 DK1 LLS2 LLS1 | EN: TI2 TI1 DK2 DK1 LLS2 LLS1" VALUE 0x7756D TKW_VV_VV_UB 100.0 FORMULA_0003 0.0 255.0000 /end CHARACTERISTIC
/begin CHARACTERISTIC K_SK_TI_OFF_EGAS_21of64_ "TI2 TI1 DK2 DK1 LLS2 LLS1 | EN: TI2 TI1 DK2 DK1 LLS2 LLS1" VALUE 0x7756E TKW_VV_VV_UB 100.0 FORMULA_0003 0.0 255.0000 /end CHARACTERISTIC
/begin CHARACTERISTIC K_SK_TI_OFF_EGAS_22of64_ "TI2 TI1 DK2 DK1 LLS2 LLS1 | EN: TI2 TI1 DK2 DK1 LLS2 LLS1" VALUE 0x7756F TKW_VV_VV_UB 100.0 FORMULA_0003 0.0 255.0000 /end CHARACTERISTIC
/begin CHARACTERISTIC K_SK_TI_OFF_EGAS_23of64_ "TI2 TI1 DK2 DK1 LLS2 LLS1 | EN: TI2 TI1 DK2 DK1 LLS2 LLS1" VALUE 0x77570 TKW_VV_VV_UB 100.0 FORMULA_0003 0.0 255.0000 /end CHARACTERISTIC
/begin CHARACTERISTIC K_SK_TI_OFF_EGAS_24of64_ "TI2 TI1 DK2 DK1 LLS2 LLS1 | EN: TI2 TI1 DK2 DK1 LLS2 LLS1" VALUE 0x77571 TKW_VV_VV_UB 100.0 FORMULA_0003 0.0 255.0000 /end CHARACTERISTIC
/begin CHARACTERISTIC K_SK_TI_OFF_EGAS_25of64_ "TI2 TI1 DK2 DK1 LLS2 LLS1 | EN: TI2 TI1 DK2 DK1 LLS2 LLS1" VALUE 0x77572 TKW_VV_VV_UB 100.0 FORMULA_0003 0.0 255.0000 /end CHARACTERISTIC
/begin CHARACTERISTIC K_SK_TI_OFF_EGAS_26of64_ "TI2 TI1 DK2 DK1 LLS2 LLS1 | EN: TI2 TI1 DK2 DK1 LLS2 LLS1" VALUE 0x77573 TKW_VV_VV_UB 100.0 FORMULA_0003 0.0 255.0000 /end CHARACTERISTIC
/begin CHARACTERISTIC K_SK_TI_OFF_EGAS_27of64_ "TI2 TI1 DK2 DK1 LLS2 LLS1 | EN: TI2 TI1 DK2 DK1 LLS2 LLS1" VALUE 0x77574 TKW_VV_VV_UB 100.0 FORMULA_0003 0.0 255.0000 /end CHARACTERISTIC
/begin CHARACTERISTIC K_SK_TI_OFF_EGAS_28of64_ "TI2 TI1 DK2 DK1 LLS2 LLS1 | EN: TI2 TI1 DK2 DK1 LLS2 LLS1" VALUE 0x77575 TKW_VV_VV_UB 100.0 FORMULA_0003 0.0 255.0000 /end CHARACTERISTIC
/begin CHARACTERISTIC K_SK_TI_OFF_EGAS_29of64_ "TI2 TI1 DK2 DK1 LLS2 LLS1 | EN: TI2 TI1 DK2 DK1 LLS2 LLS1" VALUE 0x77576 TKW_VV_VV_UB 100.0 FORMULA_0003 0.0 255.0000 /end CHARACTERISTIC
/begin CHARACTERISTIC K_SK_TI_OFF_EGAS_30of64_ "TI2 TI1 DK2 DK1 LLS2 LLS1 | EN: TI2 TI1 DK2 DK1 LLS2 LLS1" VALUE 0x77577 TKW_VV_VV_UB 100.0 FORMULA_0003 0.0 255.0000 /end CHARACTERISTIC
/begin CHARACTERISTIC K_SK_TI_OFF_EGAS_31of64_ "TI2 TI1 DK2 DK1 LLS2 LLS1 | EN: TI2 TI1 DK2 DK1 LLS2 LLS1" VALUE 0x77578 TKW_VV_VV_UB 100.0 FORMULA_0003 0.0 255.0000 /end CHARACTERISTIC
/begin CHARACTERISTIC K_SK_TI_OFF_EGAS_32of64_ "TI2 TI1 DK2 DK1 LLS2 LLS1 | EN: TI2 TI1 DK2 DK1 LLS2 LLS1" VALUE 0x77579 TKW_VV_VV_UB 100.0 FORMULA_0003 0.0 255.0000 /end CHARACTERISTIC
/begin CHARACTERISTIC K_SK_TI_OFF_EGAS_33of64_ "TI2 TI1 DK2 DK1 LLS2 LLS1 | EN: TI2 TI1 DK2 DK1 LLS2 LLS1" VALUE 0x7757A TKW_VV_VV_UB 100.0 FORMULA_0003 0.0 255.0000 /end CHARACTERISTIC
/begin CHARACTERISTIC K_SK_TI_OFF_EGAS_34of64_ "TI2 TI1 DK2 DK1 LLS2 LLS1 | EN: TI2 TI1 DK2 DK1 LLS2 LLS1" VALUE 0x7757B TKW_VV_VV_UB 100.0 FORMULA_0003 0.0 255.0000 /end CHARACTERISTIC
/begin CHARACTERISTIC K_SK_TI_OFF_EGAS_35of64_ "TI2 TI1 DK2 DK1 LLS2 LLS1 | EN: TI2 TI1 DK2 DK1 LLS2 LLS1" VALUE 0x7757C TKW_VV_VV_UB 100.0 FORMULA_0003 0.0 255.0000 /end CHARACTERISTIC
/begin CHARACTERISTIC K_SK_TI_OFF_EGAS_36of64_ "TI2 TI1 DK2 DK1 LLS2 LLS1 | EN: TI2 TI1 DK2 DK1 LLS2 LLS1" VALUE 0x7757D TKW_VV_VV_UB 100.0 FORMULA_0003 0.0 255.0000 /end CHARACTERISTIC
/begin CHARACTERISTIC K_SK_TI_OFF_EGAS_37of64_ "TI2 TI1 DK2 DK1 LLS2 LLS1 | EN: TI2 TI1 DK2 DK1 LLS2 LLS1" VALUE 0x7757E TKW_VV_VV_UB 100.0 FORMULA_0003 0.0 255.0000 /end CHARACTERISTIC
/begin CHARACTERISTIC K_SK_TI_OFF_EGAS_38of64_ "TI2 TI1 DK2 DK1 LLS2 LLS1 | EN: TI2 TI1 DK2 DK1 LLS2 LLS1" VALUE 0x7757F TKW_VV_VV_UB 100.0 FORMULA_0003 0.0 255.0000 /end CHARACTERISTIC
/begin CHARACTERISTIC K_SK_TI_OFF_EGAS_39of64_ "TI2 TI1 DK2 DK1 LLS2 LLS1 | EN: TI2 TI1 DK2 DK1 LLS2 LLS1" VALUE 0x77580 TKW_VV_VV_UB 100.0 FORMULA_0003 0.0 255.0000 /end CHARACTERISTIC
/begin CHARACTERISTIC K_SK_TI_OFF_EGAS_40of64_ "TI2 TI1 DK2 DK1 LLS2 LLS1 | EN: TI2 TI1 DK2 DK1 LLS2 LLS1" VALUE 0x77581 TKW_VV_VV_UB 100.0 FORMULA_0003 0.0 255.0000 /end CHARACTERISTIC
/begin CHARACTERISTIC K_SK_TI_OFF_EGAS_41of64_ "TI2 TI1 DK2 DK1 LLS2 LLS1 | EN: TI2 TI1 DK2 DK1 LLS2 LLS1" VALUE 0x77582 TKW_VV_VV_UB 100.0 FORMULA_0003 0.0 255.0000 /end CHARACTERISTIC
/begin CHARACTERISTIC K_SK_TI_OFF_EGAS_42of64_ "TI2 TI1 DK2 DK1 LLS2 LLS1 | EN: TI2 TI1 DK2 DK1 LLS2 LLS1" VALUE 0x77583 TKW_VV_VV_UB 100.0 FORMULA_0003 0.0 255.0000 /end CHARACTERISTIC
/begin CHARACTERISTIC K_SK_TI_OFF_EGAS_43of64_ "TI2 TI1 DK2 DK1 LLS2 LLS1 | EN: TI2 TI1 DK2 DK1 LLS2 LLS1" VALUE 0x77584 TKW_VV_VV_UB 100.0 FORMULA_0003 0.0 255.0000 /end CHARACTERISTIC
/begin CHARACTERISTIC K_SK_TI_OFF_EGAS_44of64_ "TI2 TI1 DK2 DK1 LLS2 LLS1 | EN: TI2 TI1 DK2 DK1 LLS2 LLS1" VALUE 0x77585 TKW_VV_VV_UB 100.0 FORMULA_0003 0.0 255.0000 /end CHARACTERISTIC
/begin CHARACTERISTIC K_SK_TI_OFF_EGAS_45of64_ "TI2 TI1 DK2 DK1 LLS2 LLS1 | EN: TI2 TI1 DK2 DK1 LLS2 LLS1" VALUE 0x77586 TKW_VV_VV_UB 100.0 FORMULA_0003 0.0 255.0000 /end CHARACTERISTIC
/begin CHARACTERISTIC K_SK_TI_OFF_EGAS_46of64_ "TI2 TI1 DK2 DK1 LLS2 LLS1 | EN: TI2 TI1 DK2 DK1 LLS2 LLS1" VALUE 0x77587 TKW_VV_VV_UB 100.0 FORMULA_0003 0.0 255.0000 /end CHARACTERISTIC
/begin CHARACTERISTIC K_SK_TI_OFF_EGAS_47of64_ "TI2 TI1 DK2 DK1 LLS2 LLS1 | EN: TI2 TI1 DK2 DK1 LLS2 LLS1" VALUE 0x77588 TKW_VV_VV_UB 100.0 FORMULA_0003 0.0 255.0000 /end CHARACTERISTIC
/begin CHARACTERISTIC K_SK_TI_OFF_EGAS_48of64_ "TI2 TI1 DK2 DK1 LLS2 LLS1 | EN: TI2 TI1 DK2 DK1 LLS2 LLS1" VALUE 0x77589 TKW_VV_VV_UB 100.0 FORMULA_0003 0.0 255.0000 /end CHARACTERISTIC
/begin CHARACTERISTIC K_SK_TI_OFF_EGAS_49of64_ "TI2 TI1 DK2 DK1 LLS2 LLS1 | EN: TI2 TI1 DK2 DK1 LLS2 LLS1" VALUE 0x7758A TKW_VV_VV_UB 100.0 FORMULA_0003 0.0 255.0000 /end CHARACTERISTIC
/begin CHARACTERISTIC K_SK_TI_OFF_EGAS_50of64_ "TI2 TI1 DK2 DK1 LLS2 LLS1 | EN: TI2 TI1 DK2 DK1 LLS2 LLS1" VALUE 0x7758B TKW_VV_VV_UB 100.0 FORMULA_0003 0.0 255.0000 /end CHARACTERISTIC
/begin CHARACTERISTIC K_SK_TI_OFF_EGAS_51of64_ "TI2 TI1 DK2 DK1 LLS2 LLS1 | EN: TI2 TI1 DK2 DK1 LLS2 LLS1" VALUE 0x7758C TKW_VV_VV_UB 100.0 FORMULA_0003 0.0 255.0000 /end CHARACTERISTIC
/begin CHARACTERISTIC K_SK_TI_OFF_EGAS_52of64_ "TI2 TI1 DK2 DK1 LLS2 LLS1 | EN: TI2 TI1 DK2 DK1 LLS2 LLS1" VALUE 0x7758D TKW_VV_VV_UB 100.0 FORMULA_0003 0.0 255.0000 /end CHARACTERISTIC
/begin CHARACTERISTIC K_SK_TI_OFF_EGAS_53of64_ "TI2 TI1 DK2 DK1 LLS2 LLS1 | EN: TI2 TI1 DK2 DK1 LLS2 LLS1" VALUE 0x7758E TKW_VV_VV_UB 100.0 FORMULA_0003 0.0 255.0000 /end CHARACTERISTIC
/begin CHARACTERISTIC K_SK_TI_OFF_EGAS_54of64_ "TI2 TI1 DK2 DK1 LLS2 LLS1 | EN: TI2 TI1 DK2 DK1 LLS2 LLS1" VALUE 0x7758F TKW_VV_VV_UB 100.0 FORMULA_0003 0.0 255.0000 /end CHARACTERISTIC
/begin CHARACTERISTIC K_SK_TI_OFF_EGAS_55of64_ "TI2 TI1 DK2 DK1 LLS2 LLS1 | EN: TI2 TI1 DK2 DK1 LLS2 LLS1" VALUE 0x77590 TKW_VV_VV_UB 100.0 FORMULA_0003 0.0 255.0000 /end CHARACTERISTIC
/begin CHARACTERISTIC K_SK_TI_OFF_EGAS_56of64_ "TI2 TI1 DK2 DK1 LLS2 LLS1 | EN: TI2 TI1 DK2 DK1 LLS2 LLS1" VALUE 0x77591 TKW_VV_VV_UB 100.0 FORMULA_0003 0.0 255.0000 /end CHARACTERISTIC
/begin CHARACTERISTIC K_SK_TI_OFF_EGAS_57of64_ "TI2 TI1 DK2 DK1 LLS2 LLS1 | EN: TI2 TI1 DK2 DK1 LLS2 LLS1" VALUE 0x77592 TKW_VV_VV_UB 100.0 FORMULA_0003 0.0 255.0000 /end CHARACTERISTIC
/begin CHARACTERISTIC K_SK_TI_OFF_EGAS_58of64_ "TI2 TI1 DK2 DK1 LLS2 LLS1 | EN: TI2 TI1 DK2 DK1 LLS2 LLS1" VALUE 0x77593 TKW_VV_VV_UB 100.0 FORMULA_0003 0.0 255.0000 /end CHARACTERISTIC
/begin CHARACTERISTIC K_SK_TI_OFF_EGAS_59of64_ "TI2 TI1 DK2 DK1 LLS2 LLS1 | EN: TI2 TI1 DK2 DK1 LLS2 LLS1" VALUE 0x77594 TKW_VV_VV_UB 100.0 FORMULA_0003 0.0 255.0000 /end CHARACTERISTIC
/begin CHARACTERISTIC K_SK_TI_OFF_EGAS_60of64_ "TI2 TI1 DK2 DK1 LLS2 LLS1 | EN: TI2 TI1 DK2 DK1 LLS2 LLS1" VALUE 0x77595 TKW_VV_VV_UB 100.0 FORMULA_0003 0.0 255.0000 /end CHARACTERISTIC
/begin CHARACTERISTIC K_SK_TI_OFF_EGAS_61of64_ "TI2 TI1 DK2 DK1 LLS2 LLS1 | EN: TI2 TI1 DK2 DK1 LLS2 LLS1" VALUE 0x77596 TKW_VV_VV_UB 100.0 FORMULA_0003 0.0 255.0000 /end CHARACTERISTIC
/begin CHARACTERISTIC K_SK_TI_OFF_EGAS_62of64_ "TI2 TI1 DK2 DK1 LLS2 LLS1 | EN: TI2 TI1 DK2 DK1 LLS2 LLS1" VALUE 0x77597 TKW_VV_VV_UB 100.0 FORMULA_0003 0.0 255.0000 /end CHARACTERISTIC
/begin CHARACTERISTIC K_SK_TI_OFF_EGAS_63of64_ "TI2 TI1 DK2 DK1 LLS2 LLS1 | EN: TI2 TI1 DK2 DK1 LLS2 LLS1" VALUE 0x77598 TKW_VV_VV_UB 100.0 FORMULA_0003 0.0 255.0000 /end CHARACTERISTIC
/begin CHARACTERISTIC K_SK_TI_OFF_EGAS_64of64_ "TI2 TI1 DK2 DK1 LLS2 LLS1 | EN: TI2 TI1 DK2 DK1 LLS2 LLS1" VALUE 0x77599 TKW_VV_VV_UB 100.0 FORMULA_0003 0.0 255.0000 /end CHARACTERISTIC
/begin CHARACTERISTIC K_SK_MD_BEGR_SMG_1of16_ "CANErr CANSk STAT SABR | EN: CANErr CANSk STAT SABR" VALUE 0x7759A TKW_VV_VV_UB 100.0 FORMULA_0003 0.0 255.0000 /end CHARACTERISTIC
/begin CHARACTERISTIC K_SK_MD_BEGR_SMG_2of16_ "CANErr CANSk STAT SABR | EN: CANErr CANSk STAT SABR" VALUE 0x7759B TKW_VV_VV_UB 100.0 FORMULA_0003 0.0 255.0000 /end CHARACTERISTIC
/begin CHARACTERISTIC K_SK_MD_BEGR_SMG_3of16_ "CANErr CANSk STAT SABR | EN: CANErr CANSk STAT SABR" VALUE 0x7759C TKW_VV_VV_UB 100.0 FORMULA_0003 0.0 255.0000 /end CHARACTERISTIC
/begin CHARACTERISTIC K_SK_MD_BEGR_SMG_4of16_ "CANErr CANSk STAT SABR | EN: CANErr CANSk STAT SABR" VALUE 0x7759D TKW_VV_VV_UB 100.0 FORMULA_0003 0.0 255.0000 /end CHARACTERISTIC
/begin CHARACTERISTIC K_SK_MD_BEGR_SMG_5of16_ "CANErr CANSk STAT SABR | EN: CANErr CANSk STAT SABR" VALUE 0x7759E TKW_VV_VV_UB 100.0 FORMULA_0003 0.0 255.0000 /end CHARACTERISTIC
/begin CHARACTERISTIC K_SK_MD_BEGR_SMG_6of16_ "CANErr CANSk STAT SABR | EN: CANErr CANSk STAT SABR" VALUE 0x7759F TKW_VV_VV_UB 100.0 FORMULA_0003 0.0 255.0000 /end CHARACTERISTIC
/begin CHARACTERISTIC K_SK_MD_BEGR_SMG_7of16_ "CANErr CANSk STAT SABR | EN: CANErr CANSk STAT SABR" VALUE 0x775A0 TKW_VV_VV_UB 100.0 FORMULA_0003 0.0 255.0000 /end CHARACTERISTIC
/begin CHARACTERISTIC K_SK_MD_BEGR_SMG_8of16_ "CANErr CANSk STAT SABR | EN: CANErr CANSk STAT SABR" VALUE 0x775A1 TKW_VV_VV_UB 100.0 FORMULA_0003 0.0 255.0000 /end CHARACTERISTIC
/begin CHARACTERISTIC K_SK_MD_BEGR_SMG_9of16_ "CANErr CANSk STAT SABR | EN: CANErr CANSk STAT SABR" VALUE 0x775A2 TKW_VV_VV_UB 100.0 FORMULA_0003 0.0 255.0000 /end CHARACTERISTIC
/begin CHARACTERISTIC K_SK_MD_BEGR_SMG_10of16_ "CANErr CANSk STAT SABR | EN: CANErr CANSk STAT SABR" VALUE 0x775A3 TKW_VV_VV_UB 100.0 FORMULA_0003 0.0 255.0000 /end CHARACTERISTIC
/begin CHARACTERISTIC K_SK_MD_BEGR_SMG_11of16_ "CANErr CANSk STAT SABR | EN: CANErr CANSk STAT SABR" VALUE 0x775A4 TKW_VV_VV_UB 100.0 FORMULA_0003 0.0 255.0000 /end CHARACTERISTIC
/begin CHARACTERISTIC K_SK_MD_BEGR_SMG_12of16_ "CANErr CANSk STAT SABR | EN: CANErr CANSk STAT SABR" VALUE 0x775A5 TKW_VV_VV_UB 100.0 FORMULA_0003 0.0 255.0000 /end CHARACTERISTIC
/begin CHARACTERISTIC K_SK_MD_BEGR_SMG_13of16_ "CANErr CANSk STAT SABR | EN: CANErr CANSk STAT SABR" VALUE 0x775A6 TKW_VV_VV_UB 100.0 FORMULA_0003 0.0 255.0000 /end CHARACTERISTIC
/begin CHARACTERISTIC K_SK_MD_BEGR_SMG_14of16_ "CANErr CANSk STAT SABR | EN: CANErr CANSk STAT SABR" VALUE 0x775A7 TKW_VV_VV_UB 100.0 FORMULA_0003 0.0 255.0000 /end CHARACTERISTIC
/begin CHARACTERISTIC K_SK_MD_BEGR_SMG_15of16_ "CANErr CANSk STAT SABR | EN: CANErr CANSk STAT SABR" VALUE 0x775A8 TKW_VV_VV_UB 100.0 FORMULA_0003 0.0 255.0000 /end CHARACTERISTIC
/begin CHARACTERISTIC K_SK_MD_BEGR_SMG_16of16_ "CANErr CANSk STAT SABR | EN: CANErr CANSk STAT SABR" VALUE 0x775A9 TKW_VV_VV_UB 100.0 FORMULA_0003 0.0 255.0000 /end CHARACTERISTIC
/begin CHARACTERISTIC K_SK_MD_BEGR_MD_1of16_ "SollIst Mdmin EtaRf LLR | EN: SollIst Mdmin EtaRf LLR" VALUE 0x775AA TKW_VV_VV_UB 100.0 FORMULA_0003 0.0 255.0000 /end CHARACTERISTIC
/begin CHARACTERISTIC K_SK_MD_BEGR_MD_2of16_ "SollIst Mdmin EtaRf LLR" VALUE 0x775AB TKW_VV_VV_UB 100.0 FORMULA_0003 0.0 255.0000 /end CHARACTERISTIC
/begin CHARACTERISTIC K_SK_MD_BEGR_MD_3of16_ "SollIst Mdmin EtaRf LLR" VALUE 0x775AC TKW_VV_VV_UB 100.0 FORMULA_0003 0.0 255.0000 /end CHARACTERISTIC
/begin CHARACTERISTIC K_SK_MD_BEGR_MD_4of16_ "SollIst Mdmin EtaRf LLR | EN: SollIst Mdmin EtaRf LLR" VALUE 0x775AD TKW_VV_VV_UB 100.0 FORMULA_0003 0.0 255.0000 /end CHARACTERISTIC
/begin CHARACTERISTIC K_SK_MD_BEGR_MD_5of16_ "SollIst Mdmin EtaRf LLR | EN: SollIst Mdmin EtaRf LLR" VALUE 0x775AE TKW_VV_VV_UB 100.0 FORMULA_0003 0.0 255.0000 /end CHARACTERISTIC
/begin CHARACTERISTIC K_SK_MD_BEGR_MD_6of16_ "SollIst Mdmin EtaRf LLR | EN: SollIst Mdmin EtaRf LLR" VALUE 0x775AF TKW_VV_VV_UB 100.0 FORMULA_0003 0.0 255.0000 /end CHARACTERISTIC
/begin CHARACTERISTIC K_SK_MD_BEGR_MD_7of16_ "SollIst Mdmin EtaRf LLR | EN: SollIst Mdmin EtaRf LLR" VALUE 0x775B0 TKW_VV_VV_UB 100.0 FORMULA_0003 0.0 255.0000 /end CHARACTERISTIC
/begin CHARACTERISTIC K_SK_MD_BEGR_MD_8of16_ "SollIst Mdmin EtaRf LLR | EN: SollIst Mdmin EtaRf LLR" VALUE 0x775B1 TKW_VV_VV_UB 100.0 FORMULA_0003 0.0 255.0000 /end CHARACTERISTIC
/begin CHARACTERISTIC K_SK_MD_BEGR_MD_9of16_ "SollIst Mdmin EtaRf LLR | EN: SollIst Mdmin EtaRf LLR" VALUE 0x775B2 TKW_VV_VV_UB 100.0 FORMULA_0003 0.0 255.0000 /end CHARACTERISTIC
/begin CHARACTERISTIC K_SK_MD_BEGR_MD_10of16_ "SollIst Mdmin EtaRf LLR | EN: SollIst Mdmin EtaRf LLR" VALUE 0x775B3 TKW_VV_VV_UB 100.0 FORMULA_0003 0.0 255.0000 /end CHARACTERISTIC
/begin CHARACTERISTIC K_SK_MD_BEGR_MD_11of16_ "SollIst Mdmin EtaRf LLR | EN: SollIst Mdmin EtaRf LLR" VALUE 0x775B4 TKW_VV_VV_UB 100.0 FORMULA_0003 0.0 255.0000 /end CHARACTERISTIC
/begin CHARACTERISTIC K_SK_MD_BEGR_MD_12of16_ "SollIst Mdmin EtaRf LLR | EN: SollIst Mdmin EtaRf LLR" VALUE 0x775B5 TKW_VV_VV_UB 100.0 FORMULA_0003 0.0 255.0000 /end CHARACTERISTIC
/begin CHARACTERISTIC K_SK_MD_BEGR_MD_13of16_ "SollIst Mdmin EtaRf LLR | EN: SollIst Mdmin EtaRf LLR" VALUE 0x775B6 TKW_VV_VV_UB 100.0 FORMULA_0003 0.0 255.0000 /end CHARACTERISTIC
/begin CHARACTERISTIC K_SK_MD_BEGR_MD_14of16_ "SollIst Mdmin EtaRf LLR | EN: SollIst Mdmin EtaRf LLR" VALUE 0x775B7 TKW_VV_VV_UB 100.0 FORMULA_0003 0.0 255.0000 /end CHARACTERISTIC
/begin CHARACTERISTIC K_SK_MD_BEGR_MD_15of16_ "SollIst Mdmin EtaRf LLR | EN: SollIst Mdmin EtaRf LLR" VALUE 0x775B8 TKW_VV_VV_UB 100.0 FORMULA_0003 0.0 255.0000 /end CHARACTERISTIC
/begin CHARACTERISTIC K_SK_MD_BEGR_MD_16of16_ "SollIst Mdmin EtaRf LLR | EN: SollIst Mdmin EtaRf LLR" VALUE 0x775B9 TKW_VV_VV_UB 100.0 FORMULA_0003 0.0 255.0000 /end CHARACTERISTIC
/begin CHARACTERISTIC K_SK_MD_BEGR_GEMISCH_1of32_ "VAN KATS FPLAU LAVK PKS | EN: VAN KATS FPLAU LAVK PKS" VALUE 0x775BA TKW_VV_VV_UB 100.0 FORMULA_0003 0.0 255.0000 /end CHARACTERISTIC
/begin CHARACTERISTIC K_SK_MD_BEGR_GEMISCH_2of32_ "VAN KATS FPLAU LAVK PKS | EN: VAN KATS FPLAU LAVK PKS" VALUE 0x775BB TKW_VV_VV_UB 100.0 FORMULA_0003 0.0 255.0000 /end CHARACTERISTIC
/begin CHARACTERISTIC K_SK_MD_BEGR_GEMISCH_3of32_ "VAN KATS FPLAU LAVK PKS | EN: VAN KATS FPLAU LAVK PKS" VALUE 0x775BC TKW_VV_VV_UB 100.0 FORMULA_0003 0.0 255.0000 /end CHARACTERISTIC
/begin CHARACTERISTIC K_SK_MD_BEGR_GEMISCH_4of32_ "VAN KATS FPLAU LAVK PKS | EN: VAN KATS FPLAU LAVK PKS" VALUE 0x775BD TKW_VV_VV_UB 100.0 FORMULA_0003 0.0 255.0000 /end CHARACTERISTIC
/begin CHARACTERISTIC K_SK_MD_BEGR_GEMISCH_5of32_ "VAN KATS FPLAU LAVK PKS" VALUE 0x775BE TKW_VV_VV_UB 100.0 FORMULA_0003 0.0 255.0000 /end CHARACTERISTIC
/begin CHARACTERISTIC K_SK_MD_BEGR_GEMISCH_6of32_ "VAN KATS FPLAU LAVK PKS" VALUE 0x775BF TKW_VV_VV_UB 100.0 FORMULA_0003 0.0 255.0000 /end CHARACTERISTIC
/begin CHARACTERISTIC K_SK_MD_BEGR_GEMISCH_7of32_ "VAN KATS FPLAU LAVK PKS" VALUE 0x775C0 TKW_VV_VV_UB 100.0 FORMULA_0003 0.0 255.0000 /end CHARACTERISTIC
/begin CHARACTERISTIC K_SK_MD_BEGR_GEMISCH_8of32_ "VAN KATS FPLAU LAVK PKS" VALUE 0x775C1 TKW_VV_VV_UB 100.0 FORMULA_0003 0.0 255.0000 /end CHARACTERISTIC
/begin CHARACTERISTIC K_SK_MD_BEGR_GEMISCH_9of32_ "VAN KATS FPLAU LAVK PKS" VALUE 0x775C2 TKW_VV_VV_UB 100.0 FORMULA_0003 0.0 255.0000 /end CHARACTERISTIC
/begin CHARACTERISTIC K_SK_MD_BEGR_GEMISCH_10of32_ "VAN KATS FPLAU LAVK PKS" VALUE 0x775C3 TKW_VV_VV_UB 100.0 FORMULA_0003 0.0 255.0000 /end CHARACTERISTIC
/begin CHARACTERISTIC K_SK_MD_BEGR_GEMISCH_11of32_ "VAN KATS FPLAU LAVK PKS" VALUE 0x775C4 TKW_VV_VV_UB 100.0 FORMULA_0003 0.0 255.0000 /end CHARACTERISTIC
/begin CHARACTERISTIC K_SK_MD_BEGR_GEMISCH_12of32_ "VAN KATS FPLAU LAVK PKS" VALUE 0x775C5 TKW_VV_VV_UB 100.0 FORMULA_0003 0.0 255.0000 /end CHARACTERISTIC
/begin CHARACTERISTIC K_SK_MD_BEGR_GEMISCH_13of32_ "VAN KATS FPLAU LAVK PKS" VALUE 0x775C6 TKW_VV_VV_UB 100.0 FORMULA_0003 0.0 255.0000 /end CHARACTERISTIC
/begin CHARACTERISTIC K_SK_MD_BEGR_GEMISCH_14of32_ "VAN KATS FPLAU LAVK PKS" VALUE 0x775C7 TKW_VV_VV_UB 100.0 FORMULA_0003 0.0 255.0000 /end CHARACTERISTIC
/begin CHARACTERISTIC K_SK_MD_BEGR_GEMISCH_15of32_ "VAN KATS FPLAU LAVK PKS" VALUE 0x775C8 TKW_VV_VV_UB 100.0 FORMULA_0003 0.0 255.0000 /end CHARACTERISTIC
/begin CHARACTERISTIC K_SK_MD_BEGR_GEMISCH_16of32_ "VAN KATS FPLAU LAVK PKS" VALUE 0x775C9 TKW_VV_VV_UB 100.0 FORMULA_0003 0.0 255.0000 /end CHARACTERISTIC
/begin CHARACTERISTIC K_SK_MD_BEGR_GEMISCH_17of32_ "VAN KATS FPLAU LAVK PKS | EN: VAN KATS FPLAU LAVK PKS" VALUE 0x775CA TKW_VV_VV_UB 100.0 FORMULA_0003 0.0 255.0000 /end CHARACTERISTIC
/begin CHARACTERISTIC K_SK_MD_BEGR_GEMISCH_18of32_ "VAN KATS FPLAU LAVK PKS | EN: VAN KATS FPLAU LAVK PKS" VALUE 0x775CB TKW_VV_VV_UB 100.0 FORMULA_0003 0.0 255.0000 /end CHARACTERISTIC
/begin CHARACTERISTIC K_SK_MD_BEGR_GEMISCH_19of32_ "VAN KATS FPLAU LAVK PKS | EN: VAN KATS FPLAU LAVK PKS" VALUE 0x775CC TKW_VV_VV_UB 100.0 FORMULA_0003 0.0 255.0000 /end CHARACTERISTIC
/begin CHARACTERISTIC K_SK_MD_BEGR_GEMISCH_20of32_ "VAN KATS FPLAU LAVK PKS | EN: VAN KATS FPLAU LAVK PKS" VALUE 0x775CD TKW_VV_VV_UB 100.0 FORMULA_0003 0.0 255.0000 /end CHARACTERISTIC
/begin CHARACTERISTIC K_SK_MD_BEGR_GEMISCH_21of32_ "VAN KATS FPLAU LAVK PKS | EN: VAN KATS FPLAU LAVK PKS" VALUE 0x775CE TKW_VV_VV_UB 100.0 FORMULA_0003 0.0 255.0000 /end CHARACTERISTIC
/begin CHARACTERISTIC K_SK_MD_BEGR_GEMISCH_22of32_ "VAN KATS FPLAU LAVK PKS | EN: VAN KATS FPLAU LAVK PKS" VALUE 0x775CF TKW_VV_VV_UB 100.0 FORMULA_0003 0.0 255.0000 /end CHARACTERISTIC
/begin CHARACTERISTIC K_SK_MD_BEGR_GEMISCH_23of32_ "VAN KATS FPLAU LAVK PKS | EN: VAN KATS FPLAU LAVK PKS" VALUE 0x775D0 TKW_VV_VV_UB 100.0 FORMULA_0003 0.0 255.0000 /end CHARACTERISTIC
/begin CHARACTERISTIC K_SK_MD_BEGR_GEMISCH_24of32_ "VAN KATS FPLAU LAVK PKS | EN: VAN KATS FPLAU LAVK PKS" VALUE 0x775D1 TKW_VV_VV_UB 100.0 FORMULA_0003 0.0 255.0000 /end CHARACTERISTIC
/begin CHARACTERISTIC K_SK_MD_BEGR_GEMISCH_25of32_ "VAN KATS FPLAU LAVK PKS | EN: VAN KATS FPLAU LAVK PKS" VALUE 0x775D2 TKW_VV_VV_UB 100.0 FORMULA_0003 0.0 255.0000 /end CHARACTERISTIC
/begin CHARACTERISTIC K_SK_MD_BEGR_GEMISCH_26of32_ "VAN KATS FPLAU LAVK PKS | EN: VAN KATS FPLAU LAVK PKS" VALUE 0x775D3 TKW_VV_VV_UB 100.0 FORMULA_0003 0.0 255.0000 /end CHARACTERISTIC
/begin CHARACTERISTIC K_SK_MD_BEGR_GEMISCH_27of32_ "VAN KATS FPLAU LAVK PKS | EN: VAN KATS FPLAU LAVK PKS" VALUE 0x775D4 TKW_VV_VV_UB 100.0 FORMULA_0003 0.0 255.0000 /end CHARACTERISTIC
/begin CHARACTERISTIC K_SK_MD_BEGR_GEMISCH_28of32_ "VAN KATS FPLAU LAVK PKS | EN: VAN KATS FPLAU LAVK PKS" VALUE 0x775D5 TKW_VV_VV_UB 100.0 FORMULA_0003 0.0 255.0000 /end CHARACTERISTIC
/begin CHARACTERISTIC K_SK_MD_BEGR_GEMISCH_29of32_ "VAN KATS FPLAU LAVK PKS | EN: VAN KATS FPLAU LAVK PKS" VALUE 0x775D6 TKW_VV_VV_UB 100.0 FORMULA_0003 0.0 255.0000 /end CHARACTERISTIC
/begin CHARACTERISTIC K_SK_MD_BEGR_GEMISCH_30of32_ "VAN KATS FPLAU LAVK PKS | EN: VAN KATS FPLAU LAVK PKS" VALUE 0x775D7 TKW_VV_VV_UB 100.0 FORMULA_0003 0.0 255.0000 /end CHARACTERISTIC
/begin CHARACTERISTIC K_SK_MD_BEGR_GEMISCH_31of32_ "VAN KATS FPLAU LAVK PKS | EN: VAN KATS FPLAU LAVK PKS" VALUE 0x775D8 TKW_VV_VV_UB 100.0 FORMULA_0003 0.0 255.0000 /end CHARACTERISTIC
/begin CHARACTERISTIC K_SK_MD_BEGR_GEMISCH_32of32_ "VAN KATS FPLAU LAVK PKS | EN: VAN KATS FPLAU LAVK PKS" VALUE 0x775D9 TKW_VV_VV_UB 100.0 FORMULA_0003 0.0 255.0000 /end CHARACTERISTIC
/begin CHARACTERISTIC K_SK_MD_BEGR_KR_1of8_ "nc nc SpVe" VALUE 0x775DA TKW_VV_VV_UB 100.0 FORMULA_0003 0.0 255.0000 /end CHARACTERISTIC
/begin CHARACTERISTIC K_SK_MD_BEGR_KR_2of8_ "nc nc SpVe" VALUE 0x775DB TKW_VV_VV_UB 100.0 FORMULA_0003 0.0 255.0000 /end CHARACTERISTIC
/begin CHARACTERISTIC K_SK_MD_BEGR_KR_3of8_ "nc nc SpVe" VALUE 0x775DC TKW_VV_VV_UB 100.0 FORMULA_0003 0.0 255.0000 /end CHARACTERISTIC
/begin CHARACTERISTIC K_SK_MD_BEGR_KR_4of8_ "nc nc SpVe" VALUE 0x775DD TKW_VV_VV_UB 100.0 FORMULA_0003 0.0 255.0000 /end CHARACTERISTIC
/begin CHARACTERISTIC K_SK_MD_BEGR_KR_5of8_ "nc nc SpVe" VALUE 0x775DE TKW_VV_VV_UB 100.0 FORMULA_0003 0.0 255.0000 /end CHARACTERISTIC
/begin CHARACTERISTIC K_SK_MD_BEGR_KR_6of8_ "nc nc SpVe" VALUE 0x775DF TKW_VV_VV_UB 100.0 FORMULA_0003 0.0 255.0000 /end CHARACTERISTIC
/begin CHARACTERISTIC K_SK_MD_BEGR_KR_7of8_ "nc nc SpVe" VALUE 0x775E0 TKW_VV_VV_UB 100.0 FORMULA_0003 0.0 255.0000 /end CHARACTERISTIC
/begin CHARACTERISTIC K_SK_MD_BEGR_KR_8of8_ "nc nc SpVe" VALUE 0x775E1 TKW_VV_VV_UB 100.0 FORMULA_0003 0.0 255.0000 /end CHARACTERISTIC
/begin CHARACTERISTIC K_SK_LAM_EINGR_1of32_ "Gemisch Boff Zoff DK LLS | EN: Gemisch Boff Zoff DK LLS" VALUE 0x775E2 TKW_VV_VV_UB 100.0 FORMULA_0367 0.0 255.0 /end CHARACTERISTIC
/begin CHARACTERISTIC K_SK_LAM_EINGR_2of32_ "Gemisch Boff Zoff DK LLS | EN: Gemisch Boff Zoff DK LLS" VALUE 0x775E3 TKW_VV_VV_UB 100.0 FORMULA_0367 0.0 255.0 /end CHARACTERISTIC
/begin CHARACTERISTIC K_SK_LAM_EINGR_3of32_ "Gemisch Boff Zoff DK LLS | EN: Gemisch Boff Zoff DK LLS" VALUE 0x775E4 TKW_VV_VV_UB 100.0 FORMULA_0367 0.0 255.0 /end CHARACTERISTIC
/begin CHARACTERISTIC K_SK_LAM_EINGR_4of32_ "Gemisch Boff Zoff DK LLS | EN: Gemisch Boff Zoff DK LLS" VALUE 0x775E5 TKW_VV_VV_UB 100.0 FORMULA_0367 0.0 255.0 /end CHARACTERISTIC
/begin CHARACTERISTIC K_SK_LAM_EINGR_5of32_ "Gemisch Boff Zoff DK LLS | EN: Gemisch Boff Zoff DK LLS" VALUE 0x775E6 TKW_VV_VV_UB 100.0 FORMULA_0367 0.0 255.0 /end CHARACTERISTIC
/begin CHARACTERISTIC K_SK_LAM_EINGR_6of32_ "Gemisch Boff Zoff DK LLS | EN: Gemisch Boff Zoff DK LLS" VALUE 0x775E7 TKW_VV_VV_UB 100.0 FORMULA_0367 0.0 255.0 /end CHARACTERISTIC
/begin CHARACTERISTIC K_SK_LAM_EINGR_7of32_ "Gemisch Boff Zoff DK LLS | EN: Gemisch Boff Zoff DK LLS" VALUE 0x775E8 TKW_VV_VV_UB 100.0 FORMULA_0367 0.0 255.0 /end CHARACTERISTIC
/begin CHARACTERISTIC K_SK_LAM_EINGR_8of32_ "Gemisch Boff Zoff DK LLS | EN: Gemisch Boff Zoff DK LLS" VALUE 0x775E9 TKW_VV_VV_UB 100.0 FORMULA_0367 0.0 255.0 /end CHARACTERISTIC
/begin CHARACTERISTIC K_SK_LAM_EINGR_9of32_ "Gemisch Boff Zoff DK LLS | EN: Gemisch Boff Zoff DK LLS" VALUE 0x775EA TKW_VV_VV_UB 100.0 FORMULA_0367 0.0 255.0 /end CHARACTERISTIC
/begin CHARACTERISTIC K_SK_LAM_EINGR_10of32_ "Gemisch Boff Zoff DK LLS | EN: Gemisch Boff Zoff DK LLS" VALUE 0x775EB TKW_VV_VV_UB 100.0 FORMULA_0367 0.0 255.0 /end CHARACTERISTIC
/begin CHARACTERISTIC K_SK_LAM_EINGR_11of32_ "Gemisch Boff Zoff DK LLS | EN: Gemisch Boff Zoff DK LLS" VALUE 0x775EC TKW_VV_VV_UB 100.0 FORMULA_0367 0.0 255.0 /end CHARACTERISTIC
/begin CHARACTERISTIC K_SK_LAM_EINGR_12of32_ "Gemisch Boff Zoff DK LLS | EN: Gemisch Boff Zoff DK LLS" VALUE 0x775ED TKW_VV_VV_UB 100.0 FORMULA_0367 0.0 255.0 /end CHARACTERISTIC
/begin CHARACTERISTIC K_SK_LAM_EINGR_13of32_ "Gemisch Boff Zoff DK LLS | EN: Gemisch Boff Zoff DK LLS" VALUE 0x775EE TKW_VV_VV_UB 100.0 FORMULA_0367 0.0 255.0 /end CHARACTERISTIC
/begin CHARACTERISTIC K_SK_LAM_EINGR_14of32_ "Gemisch Boff Zoff DK LLS | EN: Gemisch Boff Zoff DK LLS" VALUE 0x775EF TKW_VV_VV_UB 100.0 FORMULA_0367 0.0 255.0 /end CHARACTERISTIC
/begin CHARACTERISTIC K_SK_LAM_EINGR_15of32_ "Gemisch Boff Zoff DK LLS | EN: Gemisch Boff Zoff DK LLS" VALUE 0x775F0 TKW_VV_VV_UB 100.0 FORMULA_0367 0.0 255.0 /end CHARACTERISTIC
/begin CHARACTERISTIC K_SK_LAM_EINGR_16of32_ "Gemisch Boff Zoff DK LLS | EN: Gemisch Boff Zoff DK LLS" VALUE 0x775F1 TKW_VV_VV_UB 100.0 FORMULA_0367 0.0 255.0 /end CHARACTERISTIC
/begin CHARACTERISTIC K_SK_LAM_EINGR_17of32_ "Gemisch Boff Zoff DK LLS | EN: Gemisch Boff Zoff DK LLS" VALUE 0x775F2 TKW_VV_VV_UB 100.0 FORMULA_0367 0.0 255.0 /end CHARACTERISTIC
/begin CHARACTERISTIC K_SK_LAM_EINGR_18of32_ "Gemisch Boff Zoff DK LLS | EN: Gemisch Boff Zoff DK LLS" VALUE 0x775F3 TKW_VV_VV_UB 100.0 FORMULA_0367 0.0 255.0 /end CHARACTERISTIC
/begin CHARACTERISTIC K_SK_LAM_EINGR_19of32_ "Gemisch Boff Zoff DK LLS | EN: Gemisch Boff Zoff DK LLS" VALUE 0x775F4 TKW_VV_VV_UB 100.0 FORMULA_0367 0.0 255.0 /end CHARACTERISTIC
/begin CHARACTERISTIC K_SK_LAM_EINGR_20of32_ "Gemisch Boff Zoff DK LLS | EN: Gemisch Boff Zoff DK LLS" VALUE 0x775F5 TKW_VV_VV_UB 100.0 FORMULA_0367 0.0 255.0 /end CHARACTERISTIC
/begin CHARACTERISTIC K_SK_LAM_EINGR_21of32_ "Gemisch Boff Zoff DK LLS | EN: Gemisch Boff Zoff DK LLS" VALUE 0x775F6 TKW_VV_VV_UB 100.0 FORMULA_0367 0.0 255.0 /end CHARACTERISTIC
/begin CHARACTERISTIC K_SK_LAM_EINGR_22of32_ "Gemisch Boff Zoff DK LLS | EN: Gemisch Boff Zoff DK LLS" VALUE 0x775F7 TKW_VV_VV_UB 100.0 FORMULA_0367 0.0 255.0 /end CHARACTERISTIC
/begin CHARACTERISTIC K_SK_LAM_EINGR_23of32_ "Gemisch Boff Zoff DK LLS | EN: Gemisch Boff Zoff DK LLS" VALUE 0x775F8 TKW_VV_VV_UB 100.0 FORMULA_0367 0.0 255.0 /end CHARACTERISTIC
/begin CHARACTERISTIC K_SK_LAM_EINGR_24of32_ "Gemisch Boff Zoff DK LLS | EN: Gemisch Boff Zoff DK LLS" VALUE 0x775F9 TKW_VV_VV_UB 100.0 FORMULA_0367 0.0 255.0 /end CHARACTERISTIC
/begin CHARACTERISTIC K_SK_LAM_EINGR_25of32_ "Gemisch Boff Zoff DK LLS | EN: Gemisch Boff Zoff DK LLS" VALUE 0x775FA TKW_VV_VV_UB 100.0 FORMULA_0367 0.0 255.0 /end CHARACTERISTIC
/begin CHARACTERISTIC K_SK_LAM_EINGR_26of32_ "Gemisch Boff Zoff DK LLS | EN: Gemisch Boff Zoff DK LLS" VALUE 0x775FB TKW_VV_VV_UB 100.0 FORMULA_0367 0.0 255.0 /end CHARACTERISTIC
/begin CHARACTERISTIC K_SK_LAM_EINGR_27of32_ "Gemisch Boff Zoff DK LLS | EN: Gemisch Boff Zoff DK LLS" VALUE 0x775FC TKW_VV_VV_UB 100.0 FORMULA_0367 0.0 255.0 /end CHARACTERISTIC
/begin CHARACTERISTIC K_SK_LAM_EINGR_28of32_ "Gemisch Boff Zoff DK LLS | EN: Gemisch Boff Zoff DK LLS" VALUE 0x775FD TKW_VV_VV_UB 100.0 FORMULA_0367 0.0 255.0 /end CHARACTERISTIC
/begin CHARACTERISTIC K_SK_LAM_EINGR_29of32_ "Gemisch Boff Zoff DK LLS | EN: Gemisch Boff Zoff DK LLS" VALUE 0x775FE TKW_VV_VV_UB 100.0 FORMULA_0367 0.0 255.0 /end CHARACTERISTIC
/begin CHARACTERISTIC K_SK_LAM_EINGR_30of32_ "Gemisch Boff Zoff DK LLS | EN: Gemisch Boff Zoff DK LLS" VALUE 0x775FF TKW_VV_VV_UB 100.0 FORMULA_0367 0.0 255.0 /end CHARACTERISTIC
/begin CHARACTERISTIC K_SK_LAM_EINGR_31of32_ "Gemisch Boff Zoff DK LLS | EN: Gemisch Boff Zoff DK LLS" VALUE 0x77600 TKW_VV_VV_UB 100.0 FORMULA_0367 0.0 255.0 /end CHARACTERISTIC
/begin CHARACTERISTIC K_SK_LAM_EINGR_32of32_ "Gemisch Boff Zoff DK LLS | EN: Gemisch Boff Zoff DK LLS" VALUE 0x77601 TKW_VV_VV_UB 100.0 FORMULA_0367 0.0 255.0 /end CHARACTERISTIC
/begin CHARACTERISTIC K_SK_MD_BEGR_PWG_1of6_ "pwg_mode | EN: pwg_mode" VALUE 0x77602 TKW_VV_VV_UB 100.0 FORMULA_0003 0.0 255.0000 /end CHARACTERISTIC
/begin CHARACTERISTIC K_SK_MD_BEGR_PWG_2of6_ "pwg_mode | EN: pwg_mode" VALUE 0x77603 TKW_VV_VV_UB 100.0 FORMULA_0003 0.0 255.0000 /end CHARACTERISTIC
/begin CHARACTERISTIC K_SK_MD_BEGR_PWG_3of6_ "pwg_mode | EN: pwg_mode" VALUE 0x77604 TKW_VV_VV_UB 100.0 FORMULA_0003 0.0 255.0000 /end CHARACTERISTIC
/begin CHARACTERISTIC K_SK_MD_BEGR_PWG_4of6_ "pwg_mode | EN: pwg_mode" VALUE 0x77605 TKW_VV_VV_UB 100.0 FORMULA_0003 0.0 255.0000 /end CHARACTERISTIC
/begin CHARACTERISTIC K_SK_MD_BEGR_PWG_5of6_ "pwg_mode | EN: pwg_mode" VALUE 0x77606 TKW_VV_VV_UB 100.0 FORMULA_0003 0.0 255.0000 /end CHARACTERISTIC
/begin CHARACTERISTIC K_SK_MD_BEGR_PWG_6of6_ "pwg_mode | EN: pwg_mode" VALUE 0x77607 TKW_VV_VV_UB 100.0 FORMULA_0003 0.0 255.0000 /end CHARACTERISTIC
/begin CHARACTERISTIC K_SK_MD_BEGR_MVAC_1of4_ "ELUP MVAC | EN: ELUP MVAC" VALUE 0x77608 TKW_VV_VV_UB 100.0 FORMULA_0003 0.0 255.0000 /end CHARACTERISTIC
/begin CHARACTERISTIC K_SK_MD_BEGR_MVAC_2of4_ "ELUP MVAC | EN: ELUP MVAC" VALUE 0x77609 TKW_VV_VV_UB 100.0 FORMULA_0003 0.0 255.0000 /end CHARACTERISTIC
/begin CHARACTERISTIC K_SK_MD_BEGR_MVAC_3of4_ "ELUP MVAC | EN: ELUP MVAC" VALUE 0x7760A TKW_VV_VV_UB 100.0 FORMULA_0003 0.0 255.0000 /end CHARACTERISTIC
/begin CHARACTERISTIC K_SK_MD_BEGR_MVAC_4of4_ "ELUP MVAC | EN: ELUP MVAC" VALUE 0x7760B TKW_VV_VV_UB 100.0 FORMULA_0003 0.0 255.0000 /end CHARACTERISTIC
/begin CHARACTERISTIC K_SK_MVAC_KH_1of4_ "ELUP MVAC | EN: ELUP MVAC" VALUE 0x7760C TKW_VV_VV_UB 100.0 FORMULA_0368 0.0 255.0 /end CHARACTERISTIC
/begin CHARACTERISTIC K_SK_MVAC_KH_2of4_ "ELUP MVAC | EN: ELUP MVAC" VALUE 0x7760D TKW_VV_VV_UB 100.0 FORMULA_0368 0.0 255.0 /end CHARACTERISTIC
/begin CHARACTERISTIC K_SK_MVAC_KH_3of4_ "ELUP MVAC | EN: ELUP MVAC" VALUE 0x7760E TKW_VV_VV_UB 100.0 FORMULA_0368 0.0 255.0 /end CHARACTERISTIC
/begin CHARACTERISTIC K_SK_MVAC_KH_4of4_ "ELUP MVAC | EN: ELUP MVAC" VALUE 0x7760F TKW_VV_VV_UB 100.0 FORMULA_0368 0.0 255.0 /end CHARACTERISTIC
/* ------------------ Abschnitt erzeugt aus sk_e2_glob.dat ------------------ */
/begin CHARACTERISTIC K_SK_E2_KOMP_ERR_MAX "max. Fehler fuer Komplementvergleich | EN: Maximum faults for complement comparison" VALUE 0x77610 TKW_VV_VV_UB 100.0 FORMULA_0003 0.0 255.0000 /end CHARACTERISTIC
/begin CHARACTERISTIC K_SK_MAX_RESETS_E2 "max. Anzahl von Resets pro SG-Lauf Ebene 2 | EN: Maximum number of resets per ECU run, level 2" VALUE 0x77611 TKW_VV_VV_UB 100.0 FORMULA_0003 0.0 255.0000 /end CHARACTERISTIC
/* ------------------ Abschnitt erzeugt aus spi.dat ------------------ */ /* ------------------ Abschnitt erzeugt aus sw_confg.dat ------------------ */
/begin CHARACTERISTIC cfg.motortyp "Konfigurationsparameter: Motortyp | EN: Konfigurationsparameter: Motortyp" VALUE 0x77B1C TKW_VV_VV_UW 100.0 FORMULA_0371 0.0 65535.0 FORMAT "%5.2" /end CHARACTERISTIC
/begin CHARACTERISTIC cfg.baureihe "Konfigurationsparameter: Fz Baureihe" VALUE 0x77B1E TKW_VV_VV_UB 100.0 FORMULA_0372 0.0 255.0 /end CHARACTERISTIC
/begin CHARACTERISTIC cfg.getriebetyp "Konfigurationsparameter: Getriebetyp | EN: Konfigurationsparameter: Getriebetyp" VALUE 0x77B1F TKW_VV_VV_UB 100.0 FORMULA_0373 0.0 255.0 /end CHARACTERISTIC
/begin CHARACTERISTIC cfg.la_variante "Konfigurationsparameter: LA-Variante | EN: Konfigurationsparameter: LA-Variante [V912: differs from V452 160E]" VALUE 0x77B20 TKW_VV_VV_UB 100.0 FORMULA_0374 0.0 255.0 /end CHARACTERISTIC
/begin CHARACTERISTIC cfg.abgas "Konfigurationsparameter: ABGAS-Variante [V912: differs from V452 160E]" VALUE 0x77B21 TKW_VV_VV_UB 100.0 FORMULA_0375 0.0 255.0 /end CHARACTERISTIC
/begin CHARACTERISTIC cfg.diagnose "Konfigurationsparameter: Diagnose | EN: Konfigurationsparameter: Diagnose" VALUE 0x77B22 TKW_VV_VV_UB 100.0 FORMULA_0376 0.0 255.0 /end CHARACTERISTIC
/begin CHARACTERISTIC cfg.status "Konfigurationsparameter: SG Status | EN: Konfigurationsparameter: SG Status" VALUE 0x77B23 TKW_VV_VV_UB 100.0 FORMULA_0377 0.0 255.0 /end CHARACTERISTIC
/begin CHARACTERISTIC cfg.canstand "Konfigurationsparameter: CAN Stand | EN: Konfigurationsparameter: CAN Stand" VALUE 0x77B24 TKW_VV_VV_UB 100.0 FORMULA_0378 0.0 255.0 /end CHARACTERISTIC
/begin CHARACTERISTIC cfg.betriebsmode "Konfigurationsparameter: SG Typ | EN: Konfigurationsparameter: SG Typ" VALUE 0x77B25 TKW_VV_VV_UB 100.0 FORMULA_0379 0.0 255.0 /end CHARACTERISTIC
/begin CHARACTERISTIC cfg.sg_mode "Steuergeraete Mode | EN: Steuergeraete Mode" VALUE 0x77B26 TKW_VV_VV_UB 100.0 FORMULA_0380 0.0 255.0 BIT_MASK 0xF /end CHARACTERISTIC
/begin CHARACTERISTIC cfg.peripherie "Konfigurationsparameter: Motorperipherie" VALUE 0x77B27 TKW_VV_VV_UB 100.0 FORMULA_0033 0.0 255.0000 /end CHARACTERISTIC
/begin CHARACTERISTIC cfg.dsc_typ "Konfigurationsparameter: DSC" VALUE 0x77B28 TKW_VV_VV_UB 100.0 FORMULA_0381 0.0 255.0 /end CHARACTERISTIC
/begin CHARACTERISTIC cfg.canmess "Konfigurationsparameter: CAN-Messtechnik | EN: Konfigurationsparameter: CAN-Messtechnik" VALUE 0x77B29 TKW_VV_VV_UB 100.0 FORMULA_0357 0.0 255.0 /end CHARACTERISTIC
/begin CHARACTERISTIC cfg.hil "Konfigurationsparameter: HIL-Betrieb | EN: Konfigurationsparameter: HIL-Betrieb" VALUE 0x77B2A TKW_VV_VV_UB 100.0 FORMULA_0382 0.0 255.0 /end CHARACTERISTIC
/begin CHARACTERISTIC cfg.ipm "Konfigurationsparameter: IPM | EN: Konfigurationsparameter: IPM" VALUE 0x77B2B TKW_VV_VV_UB 100.0 FORMULA_0357 0.0 255.0 /end CHARACTERISTIC
/* ------------------ Abschnitt erzeugt aus pmdiag.dat ------------------ */
/begin CHARACTERISTIC K_CCPRIOTIME "Zeitverschiebung bis ccmeldung gesetzt wird." VALUE 0x763EE TKW_VV_VV_UB 100.0 FORMULA_0458 0.0 25.5000 /end CHARACTERISTIC
/begin CHARACTERISTIC K_TCODIERPM "T1 Zyklus fuer Fehlerinfo | EN: T1 Zyklus fuer Fehlerinfo" VALUE 0x763F9 TKW_VV_VV_UB 100.0 FORMULA_0458 0.0 25.5000 /end CHARACTERISTIC
/begin CHARACTERISTIC S_PMSV_HEIZ "Standheizen wird f�r Nibble-historie ausgewertet" VALUE 0x76404 TKW_VV_VV_UB 100.0 FORMULA_0474 0.0 1.0000 /end CHARACTERISTIC
/begin CHARACTERISTIC KL_T4RELMXRG "Max Toleranzzeit von T4 Ringshift | EN: Maximum tolerance time of T4, ring shift" CURVE 0x76408 TKL_UW_VV_UW 100.0 FORMULA_0490 0.0 917490.0000 /begin AXIS_DESCR STD_AXIS FORMULA_0488 6 0.0 3669960.0000 FORMAT "%5.2" /end AXIS_DESCR FORMAT "%5.2" /end CHARACTERISTIC
/begin CHARACTERISTIC KL_CLASS2NENN "Batterieklasse -> Batteriegroesse [V912: differs from V452 160E]" CURVE 0x76422 TKL_UB_VV_UB 100.0 FORMULA_0483 0.0 255.0000 /begin AXIS_DESCR STD_AXIS FORMULA_0003 8 0.0 255.0000 /end AXIS_DESCR /end CHARACTERISTIC
/begin CHARACTERISTIC KL_T2RELMXRG "Max Toleranzzeit von T2 Ringshift | EN: Maximum tolerance time of T2, ring shift" CURVE 0x76434 TKL_UW_VV_UW 100.0 FORMULA_0490 0.0 917490.0000 /begin AXIS_DESCR STD_AXIS FORMULA_0488 6 0.0 3669960.0000 FORMAT "%5.2" /end AXIS_DESCR FORMAT "%5.2" /end CHARACTERISTIC
/begin CHARACTERISTIC KL_T2RELMAX "Max Toleranzzeit von T2 | EN: Maximum tolerance time of T2" CURVE 0x7644E TKL_UW_VV_UW 100.0 FORMULA_0490 0.0 917490.0000 /begin AXIS_DESCR STD_AXIS FORMULA_0488 6 0.0 3669960.0000 FORMAT "%5.2" /end AXIS_DESCR FORMAT "%5.2" /end CHARACTERISTIC
/begin CHARACTERISTIC KL_T3RELMAX "Max Toleranzzeit von T3 | EN: Maximum tolerance time of T3 [V912: differs from V452 160E]" CURVE 0x76468 TKL_UW_VV_UW 100.0 FORMULA_0490 0.0 917490.0000 /begin AXIS_DESCR STD_AXIS FORMULA_0488 6 0.0 3669960.0000 FORMAT "%5.2" /end AXIS_DESCR FORMAT "%5.2" /end CHARACTERISTIC
/begin CHARACTERISTIC KL_CLASS2IND "Batterieklasse -> Batterieindex [V912: differs from V452 160E]" CURVE 0x76482 TKL_UB_VV_UB 100.0 FORMULA_0003 0.0 255.0000 /begin AXIS_DESCR STD_AXIS FORMULA_0003 8 0.0 255.0000 /end AXIS_DESCR /end CHARACTERISTIC
/begin CHARACTERISTIC KL_T3RELMXRG "Max Toleranzzeit von T3 Ringshift | EN: Maximum tolerance time of T3, ring shift [V912: differs from V452 160E]" CURVE 0x76494 TKL_UW_VV_UW 100.0 FORMULA_0490 0.0 917490.0000 /begin AXIS_DESCR STD_AXIS FORMULA_0488 6 0.0 3669960.0000 FORMAT "%5.2" /end AXIS_DESCR FORMAT "%5.2" /end CHARACTERISTIC
/begin CHARACTERISTIC KL_T4RELMAX "Max Toleranzzeit von T4 | EN: Maximum tolerance time of T4" CURVE 0x764AE TKL_UW_VV_UW 100.0 FORMULA_0490 0.0 917490.0000 /begin AXIS_DESCR STD_AXIS FORMULA_0488 6 0.0 3669960.0000 FORMAT "%5.2" /end AXIS_DESCR FORMAT "%5.2" /end CHARACTERISTIC
/* ------------------ Abschnitt erzeugt aus pmprsvcalc.dat ------------------ */
/begin CHARACTERISTIC K_MX_PTCPI "Maximalwert des PI-Reglers PTC Ansteuerung | EN: Maximum value of PI controller, PTC control" VALUE 0x764DA TKW_VV_VV_UW 100.0 FORMULA_0480 0.0 511.9921 FORMAT "%5.2" /end CHARACTERISTIC
/begin CHARACTERISTIC K_PWRCOSHT "ctrpwrcos-Wert bei Generator Hochtemperatur | EN: Consumer power control value at high generator temperature" VALUE 0x764E0 TKW_VV_VV_UW 100.0 FORMULA_0010 0.0 65535.0000 /end CHARACTERISTIC
/begin CHARACTERISTIC K_LLPMFILTK "Filterkonstante : Tiefpassfilter DF-Signal | EN: Filterkonstante : Tiefpassfilter DF-Signal" VALUE 0x76505 TKW_VV_VV_UB 100.0 FORMULA_0434 0.0 0.9960 /end CHARACTERISTIC
/begin CHARACTERISTIC K_PRIOCF_R "Prio Comfort Bei Kl.R | EN: Prio Comfort Bei Kl.R" VALUE 0x7650A TKW_VV_VV_UB 100.0 FORMULA_0003 0.0 7.0000 /end CHARACTERISTIC
/begin CHARACTERISTIC K_SELSPCOSA "Spezialverbraucher | EN: Spezialverbraucher" VALUE 0x76513 TKW_VV_VV_UB 100.0 FORMULA_0003 0.0 15.0000 /end CHARACTERISTIC
/begin CHARACTERISTIC K_ULEVAPP "Spannungsebene Applikationsgroesse" VALUE 0x7651C TKW_VV_VV_UB 100.0 FORMULA_0003 0.0 15.0000 /end CHARACTERISTIC
/begin CHARACTERISTIC K_CTRPWRCF_2of7_ "" VALUE 0x76528 TKW_VV_VV_UW 100.0 FORMULA_0010 0.0 65535.0000 /end CHARACTERISTIC
/begin CHARACTERISTIC K_CTRPWRCF_3of7_ "" VALUE 0x7652A TKW_VV_VV_UW 100.0 FORMULA_0010 0.0 65535.0000 /end CHARACTERISTIC
/begin CHARACTERISTIC K_CTRPWRCF_4of7_ "" VALUE 0x7652C TKW_VV_VV_UW 100.0 FORMULA_0010 0.0 65535.0000 /end CHARACTERISTIC
/begin CHARACTERISTIC K_CTRPWRCF_5of7_ "" VALUE 0x7652E TKW_VV_VV_UW 100.0 FORMULA_0010 0.0 65535.0000 /end CHARACTERISTIC
/begin CHARACTERISTIC K_CTRPWRCF_6of7_ "" VALUE 0x76530 TKW_VV_VV_UW 100.0 FORMULA_0010 0.0 65535.0000 /end CHARACTERISTIC
/begin CHARACTERISTIC K_CTRPWRCF_7of7_ "" VALUE 0x76532 TKW_VV_VV_UW 100.0 FORMULA_0010 0.0 65535.0000 /end CHARACTERISTIC
/begin CHARACTERISTIC K_CTRPWRDF_2of14_ "" VALUE 0x76536 TKW_VV_VV_UW 100.0 FORMULA_0010 0.0 65535.0000 /end CHARACTERISTIC
/begin CHARACTERISTIC K_CTRPWRDF_3of14_ "" VALUE 0x76538 TKW_VV_VV_UW 100.0 FORMULA_0010 0.0 65535.0000 /end CHARACTERISTIC
/begin CHARACTERISTIC K_CTRPWRDF_4of14_ "" VALUE 0x7653A TKW_VV_VV_UW 100.0 FORMULA_0010 0.0 65535.0000 /end CHARACTERISTIC
/begin CHARACTERISTIC K_CTRPWRDF_5of14_ "" VALUE 0x7653C TKW_VV_VV_UW 100.0 FORMULA_0010 0.0 65535.0000 /end CHARACTERISTIC
/begin CHARACTERISTIC K_CTRPWRDF_6of14_ "" VALUE 0x7653E TKW_VV_VV_UW 100.0 FORMULA_0010 0.0 65535.0000 /end CHARACTERISTIC
/begin CHARACTERISTIC K_CTRPWRDF_7of14_ "" VALUE 0x76540 TKW_VV_VV_UW 100.0 FORMULA_0010 0.0 65535.0000 /end CHARACTERISTIC
/begin CHARACTERISTIC K_CTRPWRDF_8of14_ "" VALUE 0x76542 TKW_VV_VV_UW 100.0 FORMULA_0010 0.0 65535.0000 /end CHARACTERISTIC
/begin CHARACTERISTIC K_CTRPWRDF_10of14_ "" VALUE 0x76546 TKW_VV_VV_UW 100.0 FORMULA_0010 0.0 65535.0000 /end CHARACTERISTIC
/begin CHARACTERISTIC K_CTRPWRDF_11of14_ "" VALUE 0x76548 TKW_VV_VV_UW 100.0 FORMULA_0010 0.0 65535.0000 /end CHARACTERISTIC
/begin CHARACTERISTIC K_CTRPWRDF_12of14_ "" VALUE 0x7654A TKW_VV_VV_UW 100.0 FORMULA_0010 0.0 65535.0000 /end CHARACTERISTIC
/begin CHARACTERISTIC K_CTRPWRDF_13of14_ "" VALUE 0x7654C TKW_VV_VV_UW 100.0 FORMULA_0010 0.0 65535.0000 /end CHARACTERISTIC
/begin CHARACTERISTIC K_CTRPWRDF_14of14_ "" VALUE 0x7654E TKW_VV_VV_UW 100.0 FORMULA_0010 0.0 65535.0000 /end CHARACTERISTIC
/begin CHARACTERISTIC K_CTRPRIOCF_2of7_ "" VALUE 0x76551 TKW_VV_VV_UB 100.0 FORMULA_0003 0.0 255.0000 /end CHARACTERISTIC
/begin CHARACTERISTIC K_CTRPRIOCF_3of7_ "" VALUE 0x76552 TKW_VV_VV_UB 100.0 FORMULA_0003 0.0 255.0000 /end CHARACTERISTIC
/begin CHARACTERISTIC K_CTRPRIOCF_4of7_ "" VALUE 0x76553 TKW_VV_VV_UB 100.0 FORMULA_0003 0.0 255.0000 /end CHARACTERISTIC
/begin CHARACTERISTIC K_CTRPRIOCF_5of7_ "" VALUE 0x76554 TKW_VV_VV_UB 100.0 FORMULA_0003 0.0 255.0000 /end CHARACTERISTIC
/begin CHARACTERISTIC K_CTRPRIOCF_6of7_ "" VALUE 0x76555 TKW_VV_VV_UB 100.0 FORMULA_0003 0.0 255.0000 /end CHARACTERISTIC
/begin CHARACTERISTIC K_CTRPRIOCF_7of7_ "" VALUE 0x76556 TKW_VV_VV_UB 100.0 FORMULA_0003 0.0 255.0000 /end CHARACTERISTIC
/begin CHARACTERISTIC K_PRIODF_3of7_ "" VALUE 0x76559 TKW_VV_VV_UB 100.0 FORMULA_0003 0.0 255.0000 /end CHARACTERISTIC
/begin CHARACTERISTIC K_PRIODF_4of7_ "" VALUE 0x7655A TKW_VV_VV_UB 100.0 FORMULA_0003 0.0 255.0000 /end CHARACTERISTIC
/begin CHARACTERISTIC K_PRIODF_5of7_ "" VALUE 0x7655B TKW_VV_VV_UB 100.0 FORMULA_0003 0.0 255.0000 /end CHARACTERISTIC
/begin CHARACTERISTIC K_PRIODF_6of7_ "" VALUE 0x7655C TKW_VV_VV_UB 100.0 FORMULA_0003 0.0 255.0000 /end CHARACTERISTIC
/begin CHARACTERISTIC K_PRIODF_7of7_ "" VALUE 0x7655D TKW_VV_VV_UB 100.0 FORMULA_0003 0.0 255.0000 /end CHARACTERISTIC
/begin CHARACTERISTIC KL_PTC "PWM-�bersetzer f�r PTC-Ansteuerung | EN: PWM translator for PTC heater control" CURVE 0x7657C TKL_UW_VV_UB 100.0 FORMULA_0506 0.0 127.5000 /begin AXIS_DESCR STD_AXIS FORMULA_0503 5 0.0 16383.7500 FORMAT "%6.3" /end AXIS_DESCR /end CHARACTERISTIC
/begin CHARACTERISTIC KL_PRIOCF "" CURVE 0x7658E TKL_SW_VV_UB 100.0 FORMULA_0003 0.0 6.0000 /begin AXIS_DESCR STD_AXIS FORMULA_0501 7 -8192.0000 8191.7500 FORMAT "%5.2" /end AXIS_DESCR /end CHARACTERISTIC
/begin CHARACTERISTIC KL_PWRCF "" CURVE 0x765A6 TKL_SW_VV_UB 100.0 FORMULA_0003 0.0 6.0000 /begin AXIS_DESCR STD_AXIS FORMULA_0501 7 -8192.0000 8191.7500 FORMAT "%5.2" /end AXIS_DESCR /end CHARACTERISTIC
/begin CHARACTERISTIC KL_DFPTC "Gefiltertes dffgen -> Prio_Gewichtung -�bersetzer | EN: Filtered generator demand to priority weighting translator" CURVE 0x765BE TKL_UB_VV_SW 100.0 FORMULA_0501 -100.0000 100.0000 /begin AXIS_DESCR STD_AXIS FORMULA_0471 6 0.0 99.6093 FORMAT "%5.2" /end AXIS_DESCR FORMAT "%5.2" /end CHARACTERISTIC
/begin CHARACTERISTIC KL_PWRDF "" CURVE 0x765D2 TKL_UW_VV_UB 100.0 FORMULA_0003 0.0 13.0000 /begin AXIS_DESCR STD_AXIS FORMULA_0503 14 0.0 16383.7500 FORMAT "%6.3" /end AXIS_DESCR /end CHARACTERISTIC
/begin CHARACTERISTIC KL_PRIO2PTC "Gewichtung der Prios auf Gewichtung fuer PTC Ansteuerung | EN: Priority weighting for PTC heater control" CURVE 0x765FE TKL_UW_VV_SW 100.0 FORMULA_0501 -100.0000 100.0000 /begin AXIS_DESCR STD_AXIS FORMULA_0503 5 0.0 16383.7500 FORMAT "%6.3" /end AXIS_DESCR FORMAT "%5.2" /end CHARACTERISTIC
/begin CHARACTERISTIC KL_SOCPRIO "dsoc -> Prio �bersetzer | EN: State-of-charge delta to priority translator" CURVE 0x76614 TKL_SW_VV_SW 100.0 FORMULA_0501 -150.0000 150.0000 /begin AXIS_DESCR STD_AXIS FORMULA_0475 4 -100.0000 99.9969 FORMAT "%5.2" /end AXIS_DESCR FORMAT "%5.2" /end CHARACTERISTIC
/begin CHARACTERISTIC KL_DFPRIO "Dffgen Prio �bersetzer | EN: Generator priority translator" CURVE 0x76626 TKL_UB_VV_SW 100.0 FORMULA_0501 -100.0000 100.0000 /begin AXIS_DESCR STD_AXIS FORMULA_0471 6 0.0 99.6093 FORMAT "%5.2" /end AXIS_DESCR FORMAT "%5.2" /end CHARACTERISTIC
/begin CHARACTERISTIC KL_DSOCPRIO "" CURVE 0x7663A TKL_SW_VV_UW 100.0 FORMULA_0480 0.0 511.9921 /begin AXIS_DESCR STD_AXIS FORMULA_0475 5 -100.0000 99.9969 FORMAT "%5.2" /end AXIS_DESCR FORMAT "%5.2" /end CHARACTERISTIC
/begin CHARACTERISTIC KL_PRIODF "" CURVE 0x76650 TKL_UW_VV_UB 100.0 FORMULA_0003 0.0 6.0000 /begin AXIS_DESCR STD_AXIS FORMULA_0503 7 0.0 16383.7500 FORMAT "%6.3" /end AXIS_DESCR /end CHARACTERISTIC
/* ------------------ Abschnitt erzeugt aus pmsoccalc.dat ------------------ */
/begin CHARACTERISTIC K_Q_BILAPWF "Defaultwert f�r q_bila nach Powerfail | EN: Defaultwert für q_bila nach Powerfail" VALUE 0x76668 TKW_VV_VV_UW 100.0 FORMULA_0494 0.0 1192.7502 FORMAT "%6.3" /end CHARACTERISTIC
/begin CHARACTERISTIC K_SOC_QPWF "Ladezustandsqualit�t nach Powerfail | EN: Ladezustandsqualität nach Powerfail" VALUE 0x7666C TKW_VV_VV_UW 100.0 FORMULA_0494 0.0 1192.7502 FORMAT "%6.3" /end CHARACTERISTIC
/begin CHARACTERISTIC K_SOC_QUALIA "Applikationswert soc_quali | EN: Applikationswert soc_quali" VALUE 0x7666E TKW_VV_VV_UW 100.0 FORMULA_0494 0.0 1192.7502 FORMAT "%6.3" /end CHARACTERISTIC
/begin CHARACTERISTIC CBATT_DEF "Ersatzwert Batteriekapazit�t | EN: Ersatzwert Batteriekapazitï¿½t" VALUE 0x76670 TKW_VV_VV_UB 100.0 FORMULA_0483 1.0000 255.0000 /end CHARACTERISTIC
/begin CHARACTERISTIC K_IB_COMMVAL "Anzahl Taskaufrufe zwischen periodischer Abfrage qlad und qelad | EN: Anzahl Taskaufrufe zwischen periodischer A bfrage qlad und qelad" VALUE 0x76671 TKW_VV_VV_UB 100.0 FORMULA_0003 0.0 255.0000 /end CHARACTERISTIC
/begin CHARACTERISTIC K_PMQ_UX "Ruhespannung Extrapolationsteiler | EN: trapolationsteiler 7.96875p S_BSOCCALC - 0p 0 x Enable Rücksetzten Ruhespannungen IBS" VALUE 0x76672 TKW_VV_VV_UB 100.0 FORMULA_0447 0.0313 7.9687 /end CHARACTERISTIC
/begin CHARACTERISTIC S_BSOCCALC "Enable R�cksetzten Ruhespannungen IBS | EN: Enable Rï¿½cksetzten Ruhespannungen IBS" VALUE 0x76673 TKW_VV_VV_UB 100.0 FORMULA_0003 0.0 255.0000 /end CHARACTERISTIC
/begin CHARACTERISTIC KL_SOC0TEMP "Temperaturabh�ngige Stromkorrektur f�r Ruhespannungsmessung [V912: differs from V452 160E]" CURVE 0x76676 TKL_SW_VV_UB 100.0 FORMULA_0473 0.0 1.9921 /begin AXIS_DESCR STD_AXIS FORMULA_0426 5 -3276.8000 3276.7000 /end AXIS_DESCR /end CHARACTERISTIC
/begin CHARACTERISTIC KF_SOCLF "Ladefaktor in Abh�ngigkeit von Temperatur und Ladezustand | EN: Charge factor vs temperature and state of charge [V912: differs from V452 160E]" MAP 0x76688 TKF_UW_SW_UB 100.0 FORMULA_0461 0.0157 3.9843 /begin AXIS_DESCR STD_AXIS FORMULA_0426 3 -3276.8000 3276.7000 /end AXIS_DESCR /begin AXIS_DESCR STD_AXIS FORMULA_0494 3 0.0 1192.7502 FORMAT "%6.3" /end AXIS_DESCR /end CHARACTERISTIC
/begin CHARACTERISTIC KF_SOC0UBIB "" MAP 0x766A0 TKF_SW_UW_UW 100.0 FORMULA_0494 0.0 1192.7502 /begin AXIS_DESCR STD_AXIS FORMULA_0497 3 6.0000 22.3837 FORMAT "%6.3" /end AXIS_DESCR /begin AXIS_DESCR STD_AXIS FORMULA_0507 5 -655.3600 655.3400 FORMAT "%6.3" /end AXIS_DESCR FORMAT "%6.3" /end CHARACTERISTIC
/* ------------------ Abschnitt erzeugt aus pmsocfit.dat ------------------ */
/begin CHARACTERISTIC K_I_FITAUSW "Grenzwert Fitstrom | EN: Grenzwert Fitstrom [V912: differs from V452 160E]" VALUE 0x766D0 TKW_VV_VV_UW 100.0 FORMULA_0504 -200.0000 5042.8000 FORMAT "%6.3" /end CHARACTERISTIC
/begin CHARACTERISTIC KL_PMSOCVU "SoC-Wert aus der Fitberechnung | EN: State-of-charge value from fit calculation [V912: differs from V452 160E]" CURVE 0x766DC TKL_UW_VV_UW 100.0 FORMULA_0433 0.0 99.9984 /begin AXIS_DESCR STD_AXIS FORMULA_0497 3 6.0000 22.3837 FORMAT "%6.3" /end AXIS_DESCR FORMAT "%5.2" /end CHARACTERISTIC
/begin CHARACTERISTIC KF_PMRIBAT8 "Kennfeld Innenwiderstand Batterie8 | EN: Kennfeld Innenwiderstand Batterie8 [V912: differs from V452 160E]" MAP 0x766EA TKF_UW_SW_UB 100.0 FORMULA_0509 0.0 0.2550 /begin AXIS_DESCR STD_AXIS FORMULA_0426 4 -3276.8000 3276.7000 /end AXIS_DESCR /begin AXIS_DESCR STD_AXIS FORMULA_0504 6 -200.0000 5042.8000 FORMAT "%6.3" /end AXIS_DESCR /end CHARACTERISTIC
/begin CHARACTERISTIC KF_PMRIBAT6 "Kennfeld Innenwiderstand Batterie6 | EN: Kennfeld Innenwiderstand Batterie6 [V912: differs from V452 160E]" MAP 0x76718 TKF_UW_SW_UB 100.0 FORMULA_0509 0.0 0.2550 /begin AXIS_DESCR STD_AXIS FORMULA_0426 4 -3276.8000 3276.7000 /end AXIS_DESCR /begin AXIS_DESCR STD_AXIS FORMULA_0504 6 -200.0000 5042.8000 FORMAT "%6.3" /end AXIS_DESCR /end CHARACTERISTIC
/begin CHARACTERISTIC KF_PMRIBAT5 "Kennfeld Innenwiderstand Batterie5 | EN: Kennfeld Innenwiderstand Batterie5 [V912: differs from V452 160E]" MAP 0x76746 TKF_UW_SW_UB 100.0 FORMULA_0509 0.0 0.2550 /begin AXIS_DESCR STD_AXIS FORMULA_0426 4 -3276.8000 3276.7000 /end AXIS_DESCR /begin AXIS_DESCR STD_AXIS FORMULA_0504 6 -200.0000 5042.8000 FORMAT "%6.3" /end AXIS_DESCR /end CHARACTERISTIC
/begin CHARACTERISTIC KF_PMRIBAT3 "Kennfeld Innenwiderstand Batterie3 | EN: Kennfeld Innenwiderstand Batterie3 [V912: differs from V452 160E]" MAP 0x76774 TKF_UW_SW_UB 100.0 FORMULA_0509 0.0 0.2550 /begin AXIS_DESCR STD_AXIS FORMULA_0426 4 -3276.8000 3276.7000 /end AXIS_DESCR /begin AXIS_DESCR STD_AXIS FORMULA_0504 6 -200.0000 5042.8000 FORMAT "%6.3" /end AXIS_DESCR /end CHARACTERISTIC
/begin CHARACTERISTIC KF_PMRIBAT4 "Kennfeld Innenwiderstand Batterie4 | EN: Kennfeld Innenwiderstand Batterie4 [V912: differs from V452 160E]" MAP 0x767A2 TKF_UW_SW_UB 100.0 FORMULA_0509 0.0 0.2550 /begin AXIS_DESCR STD_AXIS FORMULA_0426 4 -3276.8000 3276.7000 /end AXIS_DESCR /begin AXIS_DESCR STD_AXIS FORMULA_0504 6 -200.0000 5042.8000 FORMAT "%6.3" /end AXIS_DESCR /end CHARACTERISTIC
/begin CHARACTERISTIC KF_PMRIBAT2 "Kennfeld Innenwiderstand Batterie2 | EN: Kennfeld Innenwiderstand Batterie2 [V912: differs from V452 160E]" MAP 0x767D0 TKF_UW_SW_UB 100.0 FORMULA_0509 0.0 0.2550 /begin AXIS_DESCR STD_AXIS FORMULA_0426 4 -3276.8000 3276.7000 /end AXIS_DESCR /begin AXIS_DESCR STD_AXIS FORMULA_0504 6 -200.0000 5042.8000 FORMAT "%6.3" /end AXIS_DESCR /end CHARACTERISTIC
/begin CHARACTERISTIC KF_PMRIBAT1 "Kennfeld Innenwiderstand Batterie [V912: differs from V452 160E]" MAP 0x767FE TKF_UW_SW_UB 100.0 FORMULA_0509 0.0 0.2550 /begin AXIS_DESCR STD_AXIS FORMULA_0426 4 -3276.8000 3276.7000 /end AXIS_DESCR /begin AXIS_DESCR STD_AXIS FORMULA_0504 6 -200.0000 5042.8000 FORMAT "%6.3" /end AXIS_DESCR /end CHARACTERISTIC
/begin CHARACTERISTIC KF_PMRIBAT7 "Kennfeld Innenwiderstand Batterie7 | EN: Kennfeld Innenwiderstand Batterie7 [V912: differs from V452 160E]" MAP 0x7682C TKF_UW_SW_UB 100.0 FORMULA_0509 0.0 0.2550 /begin AXIS_DESCR STD_AXIS FORMULA_0426 4 -3276.8000 3276.7000 /end AXIS_DESCR /begin AXIS_DESCR STD_AXIS FORMULA_0504 6 -200.0000 5042.8000 FORMAT "%6.3" /end AXIS_DESCR /end CHARACTERISTIC
/* ------------------ Abschnitt erzeugt aus pmsockor.dat ------------------ */
/begin CHARACTERISTIC K_ABSCHKORA "Applikationswert f�r Korrektur Abschaltung | EN: Calibration value for switch-off correction" VALUE 0x7685A TKW_VV_VV_SW 100.0 FORMULA_0495 -50.0000 49.9984 FORMAT "%5.2" /end CHARACTERISTIC
/begin CHARACTERISTIC K_DAB_KORR1 "Korrekturkonstante 1 f�r Abschaltung | EN: Correction constant 1 for switch-off" VALUE 0x7685C TKW_VV_VV_SW 100.0 FORMULA_0495 -50.0000 49.9984 FORMAT "%5.2" /end CHARACTERISTIC
/begin CHARACTERISTIC K_DAB_KORR2 "Korrekturkonstante 2 f�r Abschaltung | EN: Correction constant 2 for switch-off" VALUE 0x7685E TKW_VV_VV_SW 100.0 FORMULA_0495 -50.0000 49.9984 FORMAT "%5.2" /end CHARACTERISTIC
/begin CHARACTERISTIC K_DAB_KORR3 "Korrekturkonstante 3 f�r Abschaltung | EN: Correction constant 3 for switch-off" VALUE 0x76860 TKW_VV_VV_SW 100.0 FORMULA_0495 -50.0000 49.9984 FORMAT "%5.2" /end CHARACTERISTIC
/begin CHARACTERISTIC K_DSOCABSCH "Applikationsgr�sse f�r d_soc | EN: Calibration value for d_soc" VALUE 0x76864 TKW_VV_VV_SW 100.0 FORMULA_0475 -100.0000 99.9969 FORMAT "%5.2" /end CHARACTERISTIC
/begin CHARACTERISTIC K_TSAISPWF "Defaultwert Saison Temp bei DME Powerfail | EN: Default seasonal temperature on DME power fail [°C]" VALUE 0x76866 TKW_VV_VV_SW 100.0 FORMULA_0426 -3276.8000 3276.7000 /end CHARACTERISTIC
/begin CHARACTERISTIC K_BILA_OGRZ "Grenzwert oberhalb dessen eine Apassung durch soc_kor nicht zul�ssig ist" VALUE 0x76868 TKW_VV_VV_UW 100.0 FORMULA_0433 0.0 99.9984 FORMAT "%5.2" /end CHARACTERISTIC
/begin CHARACTERISTIC K_BILA_UGRZ "" VALUE 0x7686A TKW_VV_VV_UW 100.0 FORMULA_0433 0.0 99.9984 FORMAT "%5.2" /end CHARACTERISTIC
/begin CHARACTERISTIC K_QSTARTFGA "Applikationswert f�r q_startfgk | EN: Calibration value for q_startfgk [V912: differs from V452 160E]" VALUE 0x76876 TKW_VV_VV_UW 100.0 FORMULA_0494 0.0 1192.7502 FORMAT "%6.3" /end CHARACTERISTIC
/begin CHARACTERISTIC K_SOCFITGRZ "Grenzwert f�r soc_fit | EN: Limit value for soc_fit" VALUE 0x76878 TKW_VV_VV_UW 100.0 FORMULA_0433 0.0 99.9984 FORMAT "%5.2" /end CHARACTERISTIC
/begin CHARACTERISTIC K_SOCFITLIML "Applikationskonstante zur Abwertung SoC aus der Fitberechnung | EN: Calibration constant for devaluing state of charge from fit calculation" VALUE 0x7687C TKW_VV_VV_UW 100.0 FORMULA_0433 0.0 99.9984 FORMAT "%5.2" /end CHARACTERISTIC
/begin CHARACTERISTIC K_TSAISONFIL "Filterkonstante f�r t_saison | EN: Filter constant for seasonal temperature" VALUE 0x76880 TKW_VV_VV_UW 100.0 FORMULA_0010 1.0000 65535.0000 /end CHARACTERISTIC
/begin CHARACTERISTIC S_ABSCHK "Schalter f�r Applikationswert absch_korr | EN: Switch for calibration value absch_korr" VALUE 0x76882 TKW_VV_VV_UB 100.0 FORMULA_0003 0.0 255.0000 /end CHARACTERISTIC
/begin CHARACTERISTIC S_PMTABSMN "Schalter f�r Applikation der Abstellzeit tabsmn_w | EN: Switch for calibrating engine-off time tabsmn_w" VALUE 0x76884 TKW_VV_VV_UB 100.0 FORMULA_0003 0.0 255.0000 /end CHARACTERISTIC
/begin CHARACTERISTIC S_QSTARTFK "Schalter f�r Applikation q_startfgk | EN: Switch for calibrating q_startfgk" VALUE 0x76885 TKW_VV_VV_UB 100.0 FORMULA_0003 0.0 255.0000 /end CHARACTERISTIC
/begin CHARACTERISTIC KL_FITGRZ "Grenzwert f�r soc_fit | EN: Limit value for soc_fit" CURVE 0x76888 TKL_SW_VV_UW 100.0 FORMULA_0433 0.0 99.9984 /begin AXIS_DESCR STD_AXIS FORMULA_0426 4 -3276.8000 3276.7000 /end AXIS_DESCR FORMAT "%5.2" /end CHARACTERISTIC
/begin CHARACTERISTIC KL_SSOC "soc_s in Abh. von tsaison | EN: soc_s depending on seasonal temperature" CURVE 0x7689A TKL_SW_VV_UW 100.0 FORMULA_0433 0.0 99.9984 /begin AXIS_DESCR STD_AXIS FORMULA_0426 4 -3276.8000 3276.7000 /end AXIS_DESCR FORMAT "%5.2" /end CHARACTERISTIC
/* ------------------ Abschnitt erzeugt aus pmsocstart.dat ------------------ */
/begin CHARACTERISTIC K_TIME_START "Zeittriggerschwelle nach Motorstart [V912: differs from V452 160E]" VALUE 0x768AC TKW_VV_VV_UW 100.0 FORMULA_0021 0.0 655.3500 FORMAT "%5.2" /end CHARACTERISTIC
/begin CHARACTERISTIC K_UB_GRENZ "Grenzwert Gradient d. Bordnetzspannung [V912: differs from V452 160E]" VALUE 0x768AE TKW_VV_VV_UW 100.0 FORMULA_0427 0.0 6173.3970 FORMAT "%4.1" /end CHARACTERISTIC
/begin CHARACTERISTIC K_RIN_GRENZ7 "Grenzwert Innenwiderstand Batterie7 | EN: Battery internal resistance limit 7" VALUE 0x768B8 TKW_VV_VV_UB 100.0 FORMULA_0455 0.0 31.8750 /end CHARACTERISTIC
/begin CHARACTERISTIC K_RIN_GRENZ8 "Grenzwert Innenwiderstand Batterie8 | EN: Battery internal resistance limit 8" VALUE 0x768B9 TKW_VV_VV_UB 100.0 FORMULA_0455 0.0 31.8750 /end CHARACTERISTIC
/begin CHARACTERISTIC KL_UNSTART "Startspannung abh�ngig v.Motordrehzahl | EN: Start voltage depending on engine speed [V912: differs from V452 160E]" CURVE 0x768F2 TKL_SW_VV_UW 100.0 FORMULA_0497 6.0000 22.3837 /begin AXIS_DESCR STD_AXIS FORMULA_0006 2 -32768.0000 32767.0000 /end AXIS_DESCR FORMAT "%6.3" /end CHARACTERISTIC
/begin CHARACTERISTIC KL_ITNSTART "Startspannung abh. vom Itnstart | EN: Start voltage depending on start current [V912: differs from V452 160E]" CURVE 0x768FC TKL_UB_VV_UW 100.0 FORMULA_0497 6.0000 22.3837 /begin AXIS_DESCR STD_AXIS NO_INPUT_QUANTITY FORMULA_0512 4 0.0 996.0937 /end AXIS_DESCR FORMAT "%6.3" /end CHARACTERISTIC
/* ------------------ Abschnitt erzeugt aus pks.dat ------------------ */
/begin CHARACTERISTIC K_PKS_OBD_CFG "OBD Kraftstoffsystem Diagnose" VALUE 0x75F64 TKW_VV_VV_UB 100.0 FORMULA_1037 0.0 255.0 /end CHARACTERISTIC
/begin CHARACTERISTIC K_PKS_OBD_PUMG_MIN "Minimaler Umgebungsdruck fuer PKS-Diagnose | EN: Minimum ambient pressure for fuel-pressure diagnosis [mbar]" VALUE 0x75F66 TKW_VV_VV_SW 100.0 FORMULA_0077 400.0000 1200.0000 FORMAT "%4.1" /end CHARACTERISTIC
/begin CHARACTERISTIC K_PKS_OBD_UB_MIN "Minimaler Spannungswert U_KL87 fuer PKS-Diagnose | EN: Minimum terminal-87 voltage for fuel-pressure diagnosis [V]" VALUE 0x75F68 TKW_VV_VV_SW 100.0 FORMULA_0008 0.0 28.0000 FORMAT "%4.1" /end CHARACTERISTIC
/begin CHARACTERISTIC K_PKS_OBD_FST "Minimaler Fuellstand Tank | EN: Minimum tank fill level [l]" VALUE 0x75F6A TKW_VV_VV_UW 100.0 FORMULA_0079 0.0 32767.5000 FORMAT "%4.1" /end CHARACTERISTIC
/begin CHARACTERISTIC K_PKS_OBD_AY "Maximale Querbeschleunigung fuer PKS-Diagnose | EN: Maximum lateral acceleration for fuel-pressure diagnosis [m/(s*s)]" VALUE 0x75F6C TKW_VV_VV_SW 100.0 FORMULA_0132 -20.0000 20.0000 FORMAT "%5.2" /end CHARACTERISTIC
/begin CHARACTERISTIC K_PKS_OBD_PUMPE_VL "Vorlaufzeit Kraftstoffpumpe bis Diagnose | EN: Fuel-pump lead time before diagnosis [s]" VALUE 0x75F6E TKW_VV_VV_UW 100.0 FORMULA_1033 0.0 6553.5000 FORMAT "%5.2" /end CHARACTERISTIC
/begin CHARACTERISTIC K_PKS_OBD_VERZ "Vorzoegerung Kraftstoffpumpen-Diagnose nach Dynamik | EN: Fuel-pump diagnosis delay after dynamics [s]" VALUE 0x75F70 TKW_VV_VV_UW 100.0 FORMULA_1033 0.0 6553.5000 FORMAT "%5.2" /end CHARACTERISTIC
/begin CHARACTERISTIC K_PKS_OBD_VERZ_Q_MAX "Vorzoegerung Kraftstoffpumpen-Diagnose bei QMAX | EN: Fuel-pump diagnosis delay at maximum flow [s]" VALUE 0x75F72 TKW_VV_VV_UW 100.0 FORMULA_1033 0.0 6553.5000 FORMAT "%5.2" /end CHARACTERISTIC
/begin CHARACTERISTIC K_PKS_OBD_SOLL_DYN_MAX "Maximale Dynamik Kraftstoffpumpen-Solldruck | EN: Maximum dynamics of fuel-pump target pressure [bar]" VALUE 0x75F74 TKW_VV_VV_SW 100.0 FORMULA_0118 0.0 10.0000 FORMAT "%6.3" /end CHARACTERISTIC
/begin CHARACTERISTIC K_PKS_OBD_TMOT_MIN "Untergrenze Motortemperatur fuer Diagnose | EN: Lower engine-temperature limit for diagnosis [°C]" VALUE 0x75F76 TKW_VV_VV_SW 100.0 FORMULA_0023 -50.0000 170.0000 FORMAT "%4.1" /end CHARACTERISTIC
/begin CHARACTERISTIC K_PKS_OBD_LL_MAX "Kraftstoffdruck Abweichung LL Maximum | EN: Fuel pressure deviation at idle, maximum [%]" VALUE 0x75F78 TKW_VV_VV_SW 100.0 FORMULA_0541 -1000.0000 1000.0000 /end CHARACTERISTIC
/begin CHARACTERISTIC K_PKS_OBD_LL_MIN "Kraftstoffdruck Abweichung LL Minimum | EN: Fuel pressure deviation at idle, minimum [%]" VALUE 0x75F7A TKW_VV_VV_SW 100.0 FORMULA_0541 -1000.0000 1000.0000 /end CHARACTERISTIC
/begin CHARACTERISTIC K_PKS_OBD_TL_MAX "Kraftstoffdruck Abweichung TL Maximum | EN: Fuel pressure deviation at part load, maximum [%]" VALUE 0x75F7C TKW_VV_VV_SW 100.0 FORMULA_0541 -1000.0000 1000.0000 /end CHARACTERISTIC
/begin CHARACTERISTIC K_PKS_OBD_TL_MIN "Kraftstoffdruck Abweichung TL Minimum | EN: Fuel pressure deviation at part load, minimum [%]" VALUE 0x75F7E TKW_VV_VV_SW 100.0 FORMULA_0541 -1000.0000 1000.0000 /end CHARACTERISTIC
/begin CHARACTERISTIC K_PKS_OBD_Q_MAX "Kraftstoffdruck Abweichung Q Maximum | EN: Fuel pressure deviation at flow Q, maximum [%]" VALUE 0x75F80 TKW_VV_VV_SW 100.0 FORMULA_0541 -1000.0000 1000.0000 /end CHARACTERISTIC
/begin CHARACTERISTIC K_PKS_OBD_Q_MIN "Kraftstoffdruck Abweichung Q Minimum | EN: Fuel pressure deviation at flow Q, minimum [%]" VALUE 0x75F82 TKW_VV_VV_SW 100.0 FORMULA_0541 -1000.0000 1000.0000 /end CHARACTERISTIC
/begin CHARACTERISTIC K_PKS_OBD_Q_EKP_MAX "Volumenstrom EKP Maximum | EN: Fuel-pump volume flow, maximum [l/h]" VALUE 0x75F84 TKW_VV_VV_SW 100.0 FORMULA_0746 0.0 250.0000 FORMAT "%4.1" /end CHARACTERISTIC
/begin CHARACTERISTIC K_PKS_OBD_Q_EKP_MIN "Volumenstrom EKP Minimum | EN: Fuel-pump volume flow, minimum [l/h]" VALUE 0x75F86 TKW_VV_VV_SW 100.0 FORMULA_0746 0.0 250.0000 FORMAT "%4.1" /end CHARACTERISTIC
/begin CHARACTERISTIC K_PKS_STEIGUNG "Steigung Kraftstoffdrucksensor | EN: Fuel-pressure sensor slope [bar/V]" VALUE 0x75F88 TKW_VV_VV_SW 100.0 FORMULA_1038 0.0 5.0000 FORMAT "%6.3" /end CHARACTERISTIC
/begin CHARACTERISTIC K_PKS_OFFSET "Offset Kraftstoffdrucksensor | EN: Offset Kraftstoffdrucksensor" VALUE 0x75F8A TKW_VV_VV_SW 100.0 FORMULA_0118 -10.0000 10.0000 FORMAT "%6.3" /end CHARACTERISTIC
/begin CHARACTERISTIC K_PKS_TAU "Filterkonstante f. Kraftstoffdruck | EN: Filterkonstante f. Kraftstof f-druck" VALUE 0x75F8C TKW_VV_VV_UB 100.0 FORMULA_0651 0.0051 1.2800 /end CHARACTERISTIC
/begin CHARACTERISTIC K_PKS_TAU_EKP100 "Filterkonstante f. Kraftstoffdruck bei 100% | EN: Filterkonstante f. Kraftstof f-druck bei 100%" VALUE 0x75F8D TKW_VV_VV_UB 100.0 FORMULA_0651 0.0051 1.2800 /end CHARACTERISTIC
/begin CHARACTERISTIC K_PKS_OBD_ABW_TAU "Filterkonstante f. Abweichung Kraftstoffdruck | EN: Filterkonstante f. Abweichung Kraftstoffdruck" VALUE 0x75F8E TKW_VV_VV_UB 100.0 FORMULA_0683 0.1004 25.6000 /end CHARACTERISTIC
/begin CHARACTERISTIC K_PKS_OBD_ABW_TAU_QMAX "Filterkonstante bei hohen Volumenstrom | EN: Filterkonstante bei hohen Volumenstrom" VALUE 0x75F8F TKW_VV_VV_UB 100.0 FORMULA_0683 0.1004 25.6000 /end CHARACTERISTIC
/begin CHARACTERISTIC K_PKS_DIAG_MIN "untere Grenze Kraftstoffdruck | EN: untere Grenze Kraftstoffdruck" VALUE 0x75F90 TKW_VV_VV_SW 100.0 FORMULA_0118 0.0 10.0000 FORMAT "%6.3" /end CHARACTERISTIC
/begin CHARACTERISTIC K_PKS_DIAG_MAX "obere Grenze Kraftstoffdruck | EN: obere Grenze Kraftstoffdruck" VALUE 0x75F92 TKW_VV_VV_SW 100.0 FORMULA_0118 0.0 10.0000 FORMAT "%6.3" /end CHARACTERISTIC
/begin CHARACTERISTIC K_PKS_ERSATZ "Ersatzwert Kraftstoffdruck | EN: Ersatzwert Kraftstoffdruck" VALUE 0x75F94 TKW_VV_VV_SW 100.0 FORMULA_0118 0.0 10.0000 FORMAT "%6.3" /end CHARACTERISTIC
/begin CHARACTERISTIC K_PKS_OBD_ERSATZ "Ersatzwert Kraftstoffdruck bei OBD-Fehler | EN: Ersatzwert Kraftstoffdruck bei OBD-Fehler" VALUE 0x75F96 TKW_VV_VV_SW 100.0 FORMULA_0118 0.0 10.0000 FORMAT "%6.3" /end CHARACTERISTIC
/begin CHARACTERISTIC K_PKS_OBD_TIME_ML_MIN "Sperrzeit Diagnose nach Start | EN: Sperrzeit Diagnose nach Start" VALUE 0x75F98 TKW_VV_VV_UW 100.0 FORMULA_0021 0.0 655.0000 FORMAT "%5.2" /end CHARACTERISTIC
/begin CHARACTERISTIC K_PKS_PLAU_SCHWELLE "Fehlerschwelle fuer pks_plau_intg | EN: Fehlerschwelle fuer pks_plau_intg" VALUE 0x75F9A TKW_VV_VV_SW 100.0 FORMULA_1034 0.0 10.0000 FORMAT "%6.3" /end CHARACTERISTIC
/begin CHARACTERISTIC K_PKS_PLAU_INTG_MAX "Minbegrenzung fuer pks_plau_intg | EN: Minbegrenzung fuer pks_plau_intg" VALUE 0x75F9C TKW_VV_VV_UW 100.0 FORMULA_1034 0.0 65.5350 FORMAT "%6.3" /end CHARACTERISTIC
/begin CHARACTERISTIC K_PKS_PLAU_INTG_MIN "Minbegrenzung fuer pks_plau_intg | EN: Minbegrenzung fuer pks_plau_intg" VALUE 0x75F9E TKW_VV_VV_UW 100.0 FORMULA_1034 0.0 65.5350 FORMAT "%6.3" /end CHARACTERISTIC
/begin CHARACTERISTIC K_PKS_DIAG_AUFBAU_MIN "Min-Druck bei Druckaufbau Vorlauf/-Start | EN: Min-Druck bei Druckaufbau Vorlauf/-Start" VALUE 0x75FA0 TKW_VV_VV_SW 100.0 FORMULA_0118 0.0 10.0000 FORMAT "%6.3" /end CHARACTERISTIC
/begin CHARACTERISTIC K_PKS_DIAG_AUFBAU_TAU "TAU fuer Druckabweichungsintegral | EN: TAU fuer Druckabweichung s-integral" VALUE 0x75FA2 TKW_VV_VV_UB 100.0 FORMULA_0683 0.1004 25.6000 /end CHARACTERISTIC
/begin CHARACTERISTIC K_PKS_DIAG_FEHLER_SCHW "Fehlerschwelle fuer Druckabweichung | EN: Fehlerschwelle fuer Drucka b-weichung" VALUE 0x75FA4 TKW_VV_VV_SW 100.0 FORMULA_0118 0.0 10.0000 FORMAT "%6.3" /end CHARACTERISTIC
/begin CHARACTERISTIC K_PKS_PLAU_MAX_I "MAX I-Anteil bis zu der die Plausi durchgefuehrt wird | EN: MAX I -Anteil bis zu der die Plausi durchgefuehrt wird [V912: differs from V452 160E]" VALUE 0x75FA6 TKW_VV_VV_SW 100.0 FORMULA_0840 -3200.0000 3199.9023 FORMAT "%4.1" /end CHARACTERISTIC
/begin CHARACTERISTIC K_PKS_PLAU_MIN_T_REG "Zeit in Regeleung bis die Plausi durchgefuehrt wird | EN: Zeit in Regeleung bis die Plausi durchgefuehrt wird" VALUE 0x75FA8 TKW_VV_VV_UW 100.0 FORMULA_0021 0.0 655.0000 FORMAT "%5.2" /end CHARACTERISTIC
/begin CHARACTERISTIC K_PKS_DIAG_AUFBAU_DELAY "Verzoegerungszeit fuer Druckaufbaudiagnose | EN: Verzoegerungszeit fuer Druckaufbaudiagnose" VALUE 0x75FAA TKW_VV_VV_UW 100.0 FORMULA_0021 0.0 655.0000 FORMAT "%5.2" /end CHARACTERISTIC
/begin CHARACTERISTIC K_PKS_PLAU_QMIN_N "Sperrschwelle bei hoher Drezahl und geringem KVA | EN: Sperrschwelle bei hoher Drezahl und geringem KVA" VALUE 0x75FAC TKW_VV_VV_SW 100.0 FORMULA_0006 0.0 10000.0000 /end CHARACTERISTIC
/begin CHARACTERISTIC K_PKS_PLAU_QMIN_KVA "Sperrschwelle bei hoher Drezahl und geringem KVA | EN: Sperrschwelle bei hoher Drezahl und geringem KVA" VALUE 0x75FAE TKW_VV_VV_SW 100.0 FORMULA_0746 0.0 500.0000 FORMAT "%4.1" /end CHARACTERISTIC
/begin CHARACTERISTIC KL_PKS_PLAU_INC "Incrementwerte fuer Abweichungsintegral | EN: Increment values for deviation integrator (plausibility)" CURVE 0x75FB0 TKL_SW_VV_SW 100.0 FORMULA_1039 -10.0000 10.0000
 /begin AXIS_DESCR STD_AXIS delta FORMULA_0118 11 -10.0000 10.0000 FORMAT "%6.3" /end AXIS_DESCR
 FORMAT "%6.3" /end CHARACTERISTIC
/begin CHARACTERISTIC KL_PKS_TAU_MODELL "TAU fuer TV in Rueckwertsinterpol | EN: Time constant for duty cycle in reverse interpolation" CURVE 0x75FDE TKL_SW_VV_UW 100.0 FORMULA_1040 0.0100 655.3500 /begin AXIS_DESCR STD_AXIS FORMULA_0746 5 0.0 500.0000 FORMAT "%4.1" /end AXIS_DESCR FORMAT "%5.2" /end CHARACTERISTIC
/* ------------------ Abschnitt erzeugt aus psau.dat ------------------ */
/begin CHARACTERISTIC K_PSAU_STEIGUNG "Steigung des Drucksensors | EN: Steigung des Drucksensors" VALUE 0x76B06 TKW_VV_VV_UW 100.0 FORMULA_1054 0.0 819.0000 FORMAT "%4.1" /end CHARACTERISTIC
/begin CHARACTERISTIC K_PSAU_OFFSET "Offset des Drucksensors | EN: Offset des Drucksensors" VALUE 0x76B08 TKW_VV_VV_SW 100.0 FORMULA_0077 -1000.0000 2000.0000 FORMAT "%4.1" /end CHARACTERISTIC
/begin CHARACTERISTIC K_PSAU_DIAG_MAX "MAX PSAU fuer Diagnose  | EN: MAX PSAU fuer Diagnose" VALUE 0x76B0A TKW_VV_VV_SW 100.0 FORMULA_0077 0.0 1200.0000 FORMAT "%4.1" /end CHARACTERISTIC
/begin CHARACTERISTIC K_PSAU_DIAG_MIN "MIN Saugrohrdruch fuer Diagnose  | EN: MIN Saugrohrdruch fuer Dia g-nose" VALUE 0x76B0C TKW_VV_VV_SW 100.0 FORMULA_0077 -625.0000 2000.0000 FORMAT "%4.1" /end CHARACTERISTIC
/begin CHARACTERISTIC K_PSAU_ADAPT_MAX "Maximaler Adaptionswert fuer PSAUx | EN: Maximaler Adaptionswert fuer PSAUx" VALUE 0x76B0E TKW_VV_VV_SW 100.0 FORMULA_0077 0.0 200.0000 FORMAT "%4.1" /end CHARACTERISTIC
/begin CHARACTERISTIC K_PSAU_ADAPT_MIN "Minimaler Adaptionswert fuer PSAUx | EN: Minimaler Adaptionswert fuer PSAUx" VALUE 0x76B10 TKW_VV_VV_SW 100.0 FORMULA_0077 -200.0000 0.0 FORMAT "%4.1" /end CHARACTERISTIC
/begin CHARACTERISTIC K_PSAU_TAU "Filterkonstante PSAU nur im Zeitraster, nicht im Segment | EN: Filterkonstante PSAU nur im Zeitraster, nicht im Segment" VALUE 0x76B12 TKW_VV_VV_UB 100.0 FORMULA_0664 0.0101 2.5600 /end CHARACTERISTIC
/begin CHARACTERISTIC K_PSAU_SENSOR_CFG "Psau Ersatzwertaktivierung | EN: 0x0 absolut 0x1 differenz ELSE ungueltig Psau Ersatzwertaktivierung" VALUE 0x76B13 TKW_VV_VV_UB 100.0 FORMULA_1055 0.0 255.0 /end CHARACTERISTIC
/begin CHARACTERISTIC KL_PSAU_ERSATZ_RGX_DELTA_KORR "Korrektur PSAU Ersatzwert" CURVE 0x76B14 TKL_SW_VV_UW 100.0 FORMULA_0075 0.0 4.0000
 /begin AXIS_DESCR STD_AXIS rg_x_stat FORMULA_0109 6 -0.5000 0.5000 FORMAT "%5.2" /end AXIS_DESCR
 FORMAT "%6.3" /end CHARACTERISTIC
/begin CHARACTERISTIC KF_PSAU_ERSATZ_DR_REL_F "Lambdapulshub in Richtung FETT" MAP 0x76B2E TKF_SW_SW_UW 100.0 FORMULA_0075 0.0 4.0000 /begin AXIS_DESCR STD_AXIS FORMULA_0006 12 0.0 10000.0000 /end AXIS_DESCR /begin AXIS_DESCR STD_AXIS dr_rel FORMULA_0115 8 0.0 199.9938 FORMAT "%5.2" /end AXIS_DESCR FORMAT "%6.3" /end CHARACTERISTIC
/* ------------------ Abschnitt erzeugt aus qadc_conf.dat ------------------ */ /* ------------------ Abschnitt erzeugt aus rf.dat ------------------ */
/begin CHARACTERISTIC K_RF_HUBVOLUMEN "Hubvolumen  | EN: Hubvolumen" VALUE 0x77100 TKW_VV_VV_UW 100.0 FORMULA_1071 1.0000 9.0000 FORMAT "%6.3" /end CHARACTERISTIC
/begin CHARACTERISTIC K_RF_LUFTDICHTE "Luftdichte | EN: Luftdichte" VALUE 0x77102 TKW_VV_VV_UW 100.0 FORMULA_1072 0.1000 1.8000 FORMAT "%6.3" /end CHARACTERISTIC
/begin CHARACTERISTIC K_RF_ST_LL_RAMP "Dauer der RF Rampe von START nach LL | EN: Dauer der RF Rampe von START nach LL" VALUE 0x77104 TKW_VV_VV_UB 100.0 FORMULA_1073 0.0 100.0000 /end CHARACTERISTIC
/begin CHARACTERISTIC K_RF_DYN_TAU "Filterkonstante fuer rf_dyn | EN: Filterkonstante fuer rf_dyn" VALUE 0x77105 TKW_VV_VV_UB 100.0 FORMULA_0664 0.0101 2.5600 /end CHARACTERISTIC
/begin CHARACTERISTIC KL_RF_START "Start rf" CURVE 0x77106 TKL_SW_VV_SW 100.0 FORMULA_0007 0.0 2.0000 /begin AXIS_DESCR STD_AXIS FORMULA_0006 4 0.0 10000.0000 /end AXIS_DESCR FORMAT "%6.3" /end CHARACTERISTIC
/* ------------------ Abschnitt erzeugt aus rg.dat ------------------ */
/begin CHARACTERISTIC K_RG_M_MIN "MIN-Begrenzung RG-Masse" VALUE 0x77118 TKW_VV_VV_SW 100.0 FORMULA_0113 -500.0000 1500.0000 FORMAT "%4.1" /end CHARACTERISTIC
/begin CHARACTERISTIC K_RG_M_MAX "MAX-Begrenzung RG-Masse" VALUE 0x7711A TKW_VV_VV_SW 100.0 FORMULA_0113 -500.0000 1500.0000 FORMAT "%4.1" /end CHARACTERISTIC
/begin CHARACTERISTIC K_RG_X_START "RG-Gehalt Zustand Start" VALUE 0x7711C TKW_VV_VV_SW 100.0 FORMULA_0109 -0.5000 0.5000 FORMAT "%5.2" /end CHARACTERISTIC
/begin CHARACTERISTIC K_RG_TABG_FAKTOR "Verhaelt tzyl zu tabg LW" VALUE 0x7711E TKW_VV_VV_UW 100.0 FORMULA_0075 0.0 4.0000 FORMAT "%6.3" /end CHARACTERISTIC
/begin CHARACTERISTIC K_RG_V_TOTVOLUMEN "Masse RG im Totvolumen" VALUE 0x77120 TKW_VV_VV_SW 100.0 FORMULA_1077 0.0 3000.0000 FORMAT "%4.1" /end CHARACTERISTIC
/begin CHARACTERISTIC K_RG_T_UES_AV_MAX "Max. Ueberschneidungszeit" VALUE 0x77122 TKW_VV_VV_UW 100.0 FORMULA_0998 0.0 40.0000 FORMAT "%5.2" /end CHARACTERISTIC
/begin CHARACTERISTIC K_RG_WE_ANZ_SEGM "Anzahl der Segm. fuer Auf bzw. Abregeln" VALUE 0x77124 TKW_VV_VV_UB 100.0 FORMULA_1076 0.0 100.0000 /end CHARACTERISTIC
/begin CHARACTERISTIC KL_RG_UES_A_MEAN "AVquerschnitt nach LOT | EN: Valve cross-section after LOT" CURVE 0x77126 TKL_SW_VV_UW 100.0 FORMULA_0997 0.0 15.0000 /begin AXIS_DESCR STD_AXIS van_xd FORMULA_0111 12 0.0 160.0000 FORMAT "%4.1" /end AXIS_DESCR FORMAT "%6.3" /end CHARACTERISTIC
/begin CHARACTERISTIC KL_RG_UES_E_MEAN "EV-Querschnitt vor LOT" CURVE 0x77158 TKL_SW_VV_UW 100.0 FORMULA_0997 0.0 15.0000 /begin AXIS_DESCR STD_AXIS van_xd FORMULA_0111 12 0.0 160.0000 FORMAT "%4.1" /end AXIS_DESCR FORMAT "%6.3" /end CHARACTERISTIC
/begin CHARACTERISTIC KL_RG_PHI_MEAN "Durchflussbeiwert RG" CURVE 0x7718A TKL_SW_VV_SW 100.0 FORMULA_0556 -1.0000 1.0000
 /begin AXIS_DESCR STD_AXIS pzyl_pabg_Verhaeltniss FORMULA_1078 10 0.0 2.0000 FORMAT "%5.2" /end AXIS_DESCR
 FORMAT "%7.4" /end CHARACTERISTIC
/begin CHARACTERISTIC KL_RG_PRGVO_ASP_OFFSET "Druckoffset aus Ventilueberschneidung" CURVE 0x771B4 TKL_SW_VV_SW 100.0 FORMULA_0077 -2000.0000 2000.0000
 /begin AXIS_DESCR STD_AXIS van_vo_filt FORMULA_0111 9 -80.0000 80.0000 FORMAT "%4.1" /end AXIS_DESCR
 FORMAT "%4.1" /end CHARACTERISTIC
/begin CHARACTERISTIC KF_RG_STAT "RG-Gehalt stationaer" MAP 0x771DA TKF_SW_SW_SW 100.0 FORMULA_0109 -0.5000 0.5000 /begin AXIS_DESCR STD_AXIS FORMULA_0006 16 0.0 10000.0000 /end AXIS_DESCR /begin AXIS_DESCR STD_AXIS dr_rel FORMULA_0115 12 0.0 199.9938 FORMAT "%5.2" /end AXIS_DESCR FORMAT "%5.2" /end CHARACTERISTIC
/* ------------------ Abschnitt erzeugt aus sk_inj.dat ------------------ */
/begin CHARACTERISTIC K_SK_HW_AD_DELTA_MAX "Maximal zulaessige Differenz Master-Slave | EN: Maximum permitted master-slave difference [digit]" VALUE 0x7768C TKW_VV_VV_UB 100.0 FORMULA_1091 0.0 255.0000 /end CHARACTERISTIC
/begin CHARACTERISTIC K_SK_HW_AD_STAT "Maximaler Spannungshub fuer Stationaerbetrieb PWG1 | EN: Maximum voltage swing for steady state, pedal sensor 1 [digit]" VALUE 0x7768D TKW_VV_VV_UB 100.0 FORMULA_1091 0.0 255.0000 /end CHARACTERISTIC
/begin CHARACTERISTIC K_SK_HW_AD_STAT_ZAEHLER "Zaehler fuer Stationaerbetrieb PWG1 | EN: Counter for steady state, pedal sensor 1 [s]" VALUE 0x7768E TKW_VV_VV_UB 100.0 FORMULA_0352 0.0 1.2750 /end CHARACTERISTIC
/begin CHARACTERISTIC K_SK_HW_AD_ED_ZAEHLER "Filterzaehler bei fehlerhaftem AD-Wert | EN: Filter counter for faulty A/D value [s]" VALUE 0x7768F TKW_VV_VV_UB 100.0 FORMULA_0352 0.0 1.2750 /end CHARACTERISTIC
/* ------------------ Abschnitt erzeugt aus slp.dat ------------------ */
/begin CHARACTERISTIC K_SLP_TIME_AUS "Auszeit SLP nach Abschalten | EN: Auszeit SLP nach Abschalten" VALUE 0x77884 TKW_VV_VV_UW 100.0 FORMULA_0062 0.0 65535.0000 /end CHARACTERISTIC
/begin CHARACTERISTIC K_SLP_PABG_SCHWELLE "Abbruchschwelle durch Abgasgegendruck | EN: Abbruchschwelle durch Abgasgege n-druck" VALUE 0x77886 TKW_VV_VV_SW 100.0 FORMULA_0077 0.0 1000.0000 FORMAT "%4.1" /end CHARACTERISTIC
/begin CHARACTERISTIC K_SLP_PABG_TAU "Filterkonstante fuer den Abgasdruck | EN: Filterkonstante fuer den Abgasdruck" VALUE 0x77888 TKW_VV_VV_UB 100.0 FORMULA_0683 0.1004 25.6000 /end CHARACTERISTIC
/begin CHARACTERISTIC K_SLP_TIME_MAX "Maxlaufzeit der SLP | EN: Maxlaufzeit der SLP" VALUE 0x7788A TKW_VV_VV_UW 100.0 FORMULA_0073 0.0 6553.5000 FORMAT "%4.1" /end CHARACTERISTIC
/begin CHARACTERISTIC KL_SLP_DELAY_TMOT_START "SLP-Delay abhaengig von tmot_start" CURVE 0x7788C TKL_SW_VV_UW 100.0 FORMULA_0021 0.0 655.0000 /begin AXIS_DESCR STD_AXIS FORMULA_0023 6 -50.0000 170.0000 FORMAT "%4.1" /end AXIS_DESCR FORMAT "%5.2" /end CHARACTERISTIC
/begin CHARACTERISTIC KF_SLP_DAUER_TMOT_START "SLP Laufzeit [V912: differs from V452 160E]" MAP 0x778A6 TKF_SW_SW_SW 100.0 FORMULA_0073 0.0 3276.7000 /begin AXIS_DESCR STD_AXIS FORMULA_0023 8 -50.0000 170.0000 FORMAT "%4.1" /end AXIS_DESCR /begin AXIS_DESCR STD_AXIS FORMULA_0025 4 0.0 1.9990 FORMAT "%6.3" /end AXIS_DESCR FORMAT "%4.1" /end CHARACTERISTIC
/* ------------------ Abschnitt erzeugt aus sls_obd.dat ------------------ */
/begin CHARACTERISTIC K_SLS_OBDH_T_AUFHEIZ "Aufheizverzoegerung fuer Mini-HFM | EN: Aufheizverzoegerung fuer Mini-HFM" VALUE 0x77900 TKW_VV_VV_UB 100.0 FORMULA_0317 0.0 2.5000 /end CHARACTERISTIC
/begin CHARACTERISTIC K_SLS_OBDH_T_HFM_DIA "Diagnosezeit fuer Mini-HFM | EN: Diagnosezeit fuer Mini-HFM" VALUE 0x77902 TKW_VV_VV_UW 100.0 FORMULA_0021 0.0 100.0000 FORMAT "%5.2" /end CHARACTERISTIC
/begin CHARACTERISTIC K_SLS_OBDH_T_ML_PLAUSI "Max. Diagnosezeit fuer Luftmassenplausi | EN: Max. Diagnosezeit fuer Luftmassenplausi" VALUE 0x77904 TKW_VV_VV_UW 100.0 FORMULA_0021 0.0 100.0000 FORMAT "%5.2" /end CHARACTERISTIC
/begin CHARACTERISTIC K_SLS_OBDH_START_MIN "Mindestluftmassenintegral fuer plausibles SLS" VALUE 0x77906 TKW_VV_VV_SW 100.0 FORMULA_0561 -32.7670 32.7670 FORMAT "%6.3" /end CHARACTERISTIC
/begin CHARACTERISTIC K_SLS_OBDH_SLP_DEF "Luftmassenintegralgrenze fuer Erkennung SLP defekt" VALUE 0x77908 TKW_VV_VV_SW 100.0 FORMULA_1120 -32.7670 32.7670 FORMAT "%6.3" /end CHARACTERISTIC
/begin CHARACTERISTIC K_SLS_OBDH_EUV_MIN_DEF "Ml-Integralgrenze fuer Erkennung SLV klemmt geschl. Leitung undicht" VALUE 0x7790A TKW_VV_VV_SW 100.0 FORMULA_1120 -32.7670 32.7670 FORMAT "%6.3" /end CHARACTERISTIC
/begin CHARACTERISTIC K_SLS_OBDH_MDF_MAX_DEF "Max. Abw.Integralgrenze LTG-undicht [V912: differs from V452 160E]" VALUE 0x7790C TKW_VV_VV_SW 100.0 FORMULA_1120 -32.7670 32.7670 FORMAT "%6.3" /end CHARACTERISTIC
/begin CHARACTERISTIC K_SLS_OBDH_MDF_MIN_DEF "Max. Abw.Integralgrenze MDF zu gering" VALUE 0x7790E TKW_VV_VV_SW 100.0 FORMULA_1120 -32.7670 32.7670 FORMAT "%6.3" /end CHARACTERISTIC
/begin CHARACTERISTIC K_SLS_OBDH_ZWD_100_MIN "Min. ML-Grenze fuer ZWD 100 Proz. offen" VALUE 0x77910 TKW_VV_VV_SW 100.0 FORMULA_0112 0.0 40.0000 FORMAT "%4.1" /end CHARACTERISTIC
/begin CHARACTERISTIC K_SLS_OBDH_ZWD_0_MAX "Max. ML-Grenze fuer ZWD 0 Proz. offen" VALUE 0x77912 TKW_VV_VV_SW 100.0 FORMULA_0112 0.0 40.0000 FORMAT "%4.1" /end CHARACTERISTIC
/begin CHARACTERISTIC K_SLS_OBDH_ZWD_OFF_MAX "Max. ML-Grenze fuer ZWD stromlos" VALUE 0x77914 TKW_VV_VV_SW 100.0 FORMULA_0112 0.0 40.0000 FORMAT "%4.1" /end CHARACTERISTIC
/begin CHARACTERISTIC K_SLS_OBDH_ZWD_OFF_MIN "Min. ML-Grenze fuer ZWD stromlos" VALUE 0x77916 TKW_VV_VV_SW 100.0 FORMULA_0112 0.0 40.0000 FORMAT "%4.1" /end CHARACTERISTIC
/begin CHARACTERISTIC K_SLS_OBDH_SLV_MAX "Max. ML-Integralgrenze fuer SLV NIO" VALUE 0x77918 TKW_VV_VV_SW 100.0 FORMULA_1120 -32.7670 32.7670 FORMAT "%6.3" /end CHARACTERISTIC
/begin CHARACTERISTIC K_SLS_OBD_CFG "SLS-OBD Konfigbyte | EN: 0x0 AUS 0x2 AN-HFM 0x4 AN-LAM 0x8 Prueflauf 0xA AN -HFM- PL ELSE undef i- niert SLS-OBD Konfigbyte" VALUE 0x7791A TKW_VV_VV_UB 100.0 FORMULA_1121 0.0 255.0 /end CHARACTERISTIC
/begin CHARACTERISTIC K_SLS_OBDH_MDF_CFG "SLS-OBD MDF Konfigbyte" VALUE 0x7791B TKW_VV_VV_UB 100.0 FORMULA_1122 0.0 255.0 /end CHARACTERISTIC
/begin CHARACTERISTIC K_SLS_OBDH_MDF_1_MAG "Max. Abweichungsintg.-grenze MDF-Diag B1 magerer als B2" VALUE 0x7791C TKW_VV_VV_SW 100.0 FORMULA_0573 -1.9000 1.9000 FORMAT "%5.2" /end CHARACTERISTIC
/begin CHARACTERISTIC K_SLS_OBDH_MDF_2_MAG "Max. Abweichungsintg.-grenze MDF-Diag B1 magerer als B2" VALUE 0x7791E TKW_VV_VV_SW 100.0 FORMULA_0573 -1.9000 1.9000 FORMAT "%5.2" /end CHARACTERISTIC
/begin CHARACTERISTIC K_SLS_OBDH_MDL_K_EINBAUTEN "Max. Abweichungsintg.-grenze MDF-Diag B1 magerer als B2" VALUE 0x77920 TKW_VV_VV_UW 100.0 FORMULA_1123 0.0 1.0000 FORMAT "%7.4" /end CHARACTERISTIC
/begin CHARACTERISTIC K_SLS_OBDH_DYN_DELTA_RF "Dynamikschwelle RF | EN: Dynamikschwelle RF" VALUE 0x77922 TKW_VV_VV_SW 100.0 FORMULA_0007 0.0 2.0000 FORMAT "%6.3" /end CHARACTERISTIC
/begin CHARACTERISTIC K_SLS_OBDH_DYN_RF_T "Zeit nach Dyn.abbr. durch rf, bevor die Diag weiterlaeuft | EN: Zeit nach Dyn.abbr. durch rf, bevor die Diag weiterlaeuft" VALUE 0x77924 TKW_VV_VV_UW 100.0 FORMULA_0021 0.0 655.0000 FORMAT "%5.2" /end CHARACTERISTIC
/begin CHARACTERISTIC K_SLS_OBD_DYN_TAU "Filterkonstante fuer sls_obd_ml_dyn" VALUE 0x77926 TKW_VV_VV_UB 100.0 FORMULA_0664 0.0101 2.5600 /end CHARACTERISTIC
/begin CHARACTERISTIC K_SLS_OBD_ML_MDL_DIFF_MAX "Saturation Gradient Luftmasse Motor | EN: Saturation Gradient Luftmasse Motor" VALUE 0x77928 TKW_VV_VV_SW 100.0 FORMULA_1118 -100.0000 100.0000 FORMAT "%4.1" /end CHARACTERISTIC
/begin CHARACTERISTIC K_SLS_OBD_ML_MDL_WICHT "Wichtungsfaktor fuer Dynamik | EN: Wichtungsfaktor fuer Dynamik" VALUE 0x7792A TKW_VV_VV_UW 100.0 FORMULA_0075 0.0 4.0000 FORMAT "%6.3" /end CHARACTERISTIC
/begin CHARACTERISTIC K_SLS_OBDH_ASV_RE_OPE "Max. Abweichungsintg.-grenze ASV-Diag rechts haengt offen | EN: Max. Abweichungsintg. -grenze ASV-Diag rechts haengt offen" VALUE 0x7792C TKW_VV_VV_SW 100.0 FORMULA_0573 -1.9000 1.9000 FORMAT "%5.2" /end CHARACTERISTIC
/begin CHARACTERISTIC K_SLS_OBDH_ASV_PL_RE_OPE "Max. Abweichungsintg.-grenze ASV-Diag rechts haengt offen im PL | EN: Max. Abweichungsintg.-grenze ASV-Diag rechts haengt offen im PL" VALUE 0x7792E TKW_VV_VV_SW 100.0 FORMULA_0573 -1.9000 1.9000 FORMAT "%5.2" /end CHARACTERISTIC
/begin CHARACTERISTIC K_SLS_OBDH_UB_MIN "UB min. Schwelle fuer die SLS-Diagnose | EN: UB min. Schwelle fuer di e SLS -Diagnose" VALUE 0x77930 TKW_VV_VV_SW 100.0 FORMULA_0008 0.0 28.0000 FORMAT "%4.1" /end CHARACTERISTIC
/begin CHARACTERISTIC K_SLS_OBDH_ASV_LI_OPE "Max. Abweichungsintg.-grenze ASV-Diag links haengt offen | EN: Max. Abweichungsintg. -grenze ASV-Diag links haengt offen" VALUE 0x77932 TKW_VV_VV_SW 100.0 FORMULA_0573 -1.9000 1.9000 FORMAT "%5.2" /end CHARACTERISTIC
/begin CHARACTERISTIC K_SLS_OBDH_ASV_PL_LI_OPE "Max. Abweichungsintg.-grenze ASV-Diag links haengt offen im PL" VALUE 0x77934 TKW_VV_VV_SW 100.0 FORMULA_0573 -1.9000 1.9000 FORMAT "%5.2" /end CHARACTERISTIC
/begin CHARACTERISTIC K_SLS_OBDH_T_SLV_INT_START "Delay fuer start Diagnose SLV | EN: Delay fuer start Diagnose SLV" VALUE 0x77936 TKW_VV_VV_UW 100.0 FORMULA_0021 0.0 10.0000 FORMAT "%5.2" /end CHARACTERISTIC
/begin CHARACTERISTIC K_SLS_PL_T_MDF_STOP "MDF Diagnoseende fuer Prueflauf | EN: MDF Diagnoseende fuer Prueflauf" VALUE 0x77938 TKW_VV_VV_UW 100.0 FORMULA_0021 0.0 100.0000 FORMAT "%5.2" /end CHARACTERISTIC
/begin CHARACTERISTIC K_SLS_OBD_TMOT_MIN "Min. Temp. fuer die Diagnose | EN: Min. Temp. fuer die Diagnose" VALUE 0x7793A TKW_VV_VV_SW 100.0 FORMULA_0023 -50.0000 170.0000 FORMAT "%4.1" /end CHARACTERISTIC
/begin CHARACTERISTIC K_SLS_OBDH_N_MIN "Abbruchdrezahl n kleiner Schwelle | EN: Abbruchdrezahl n kleiner Schwelle" VALUE 0x7793C TKW_VV_VV_SW 100.0 FORMULA_0006 0.0 10000.0000 /end CHARACTERISTIC
/begin CHARACTERISTIC K_SLS_OBDH_N_MAX "Abbruchdrezahl n groesser Schwelle | EN: Abbruchdrezahl n groesser Schwelle" VALUE 0x7793E TKW_VV_VV_SW 100.0 FORMULA_0006 0.0 10000.0000 /end CHARACTERISTIC
/begin CHARACTERISTIC K_SLS_OBDH_RF_MIN "Abbruchlastschwelle bei rf unter Schelle | EN: Abbruchlastschwelle bei rf unter Schelle" VALUE 0x77940 TKW_VV_VV_SW 100.0 FORMULA_0007 0.0 2.0000 FORMAT "%6.3" /end CHARACTERISTIC
/begin CHARACTERISTIC K_SLS_OBDH_RF_MAX "Abbruchlastschwelle bei rf ueber Schelle" VALUE 0x77942 TKW_VV_VV_SW 100.0 FORMULA_0007 0.0 2.0000 FORMAT "%6.3" /end CHARACTERISTIC
/begin CHARACTERISTIC K_SLS_OBDH_ML_MIN "Abbruchlastschwelle bei ml_ges unter Schelle | EN: Abbruchlastschwelle bei ml_ges unter Schelle" VALUE 0x77944 TKW_VV_VV_SW 100.0 FORMULA_0112 -100.0000 1400.0000 FORMAT "%4.1" /end CHARACTERISTIC
/begin CHARACTERISTIC K_SLS_OBDH_ML_MAX "Abbruchlastschwelle bei ml_ges ueber Schelle | EN: Abbruchlastschwelle bei ml_ges ueber Schelle" VALUE 0x77946 TKW_VV_VV_SW 100.0 FORMULA_0112 -100.0000 1400.0000 FORMAT "%4.1" /end CHARACTERISTIC
/begin CHARACTERISTIC K_SLS_OBDH_MLVERH_MIN "Abbruchlastschwelle bei ml_verh unter Schelle | EN: Abbruchlastschwelle bei ml_verh unter Schelle" VALUE 0x77948 TKW_VV_VV_UB 100.0 FORMULA_0032 0.0 200.0000 /end CHARACTERISTIC
/begin CHARACTERISTIC K_SLS_OBDH_PUMG_MIN "Abbruchlastschwelle bei ml_verh unter Schelle | EN: Abbruchlastschwelle bei ml_verh unter Schelle" VALUE 0x7794A TKW_VV_VV_SW 100.0 FORMULA_0077 400.0000 1200.0000 FORMAT "%4.1" /end CHARACTERISTIC
/begin CHARACTERISTIC K_SLS_OBDH_T_SA "Diagnoseabbruch nach time_sa | EN: Diagnoseabbruch nach time_sa" VALUE 0x7794C TKW_VV_VV_UW 100.0 FORMULA_0021 0.0 655.0000 FORMAT "%5.2" /end CHARACTERISTIC
/begin CHARACTERISTIC K_SLS_OBDH_ASV_TAU "Filterkonstante fuer lam_ist und ml_ges der ASV Diag. | EN: Filterkonstante fuer lam_ist  und ml_ges der ASV Diag." VALUE 0x7794E TKW_VV_VV_UB 100.0 FORMULA_0683 0.1004 25.6000 /end CHARACTERISTIC
/begin CHARACTERISTIC K_SLS_OBDH_ML_TAU "Filterkonstante fuer lam_ist und ml_ges der ML Diag." VALUE 0x7794F TKW_VV_VV_UB 100.0 FORMULA_0683 0.1004 25.6000 /end CHARACTERISTIC
/begin CHARACTERISTIC K_SLS_OBDH_HFM_TAU "Tau fuer sl_ml_hfm_fil" VALUE 0x77950 TKW_VV_VV_UB 100.0 FORMULA_0664 0.0101 2.5600 /end CHARACTERISTIC
/begin CHARACTERISTIC K_SLS_OBDH_ML_TMOT "Schwelle ML-Plausi fuer ASV kleben zu | EN: Schwelle ML-Plausi fuer ASV kleben zu" VALUE 0x77952 TKW_VV_VV_SW 100.0 FORMULA_0023 -50.0000 170.0000 FORMAT "%4.1" /end CHARACTERISTIC
/begin CHARACTERISTIC K_SLS_OBDH_HYD_ABBRUCH_ML_MAX "ML-Schwelle fuer Feuchtigkeitserkennung Mini-HFM | EN: ML-Schwelle fuer Feuchtigkeitserkennung Mini-HFM" VALUE 0x77954 TKW_VV_VV_SW 100.0 FORMULA_1124 -260.0000 260.0000 FORMAT "%6.3" /end CHARACTERISTIC
/begin CHARACTERISTIC K_SLS_OBDH_HYD_ABBRUCH_AD_MAX "max-AD-Wert fuer Feuchtigkeitsabbruch | EN: max-AD-Wert fuer Feuchtigkeitsabbruch" VALUE 0x77956 TKW_VV_VV_SW 100.0 FORMULA_0123 0.0 1023.0000 /end CHARACTERISTIC
/begin CHARACTERISTIC K_SLS_OBDH_HFM_MAX "max. Luftmassenintegral fuer plausibles SLS | EN: max. Luftmassenintegral fuer plausibles SLS" VALUE 0x77958 TKW_VV_VV_SW 100.0 FORMULA_1097 -260.0000 260.0000 FORMAT "%4.1" /end CHARACTERISTIC
/begin CHARACTERISTIC KL_SLS_OBDH_ML_MDF_DIAG "Einschaltverzoegerung Mindestdurchflussdiagnose | EN: Switch-on delay of minimum-flow diagnosis" CURVE 0x7795A TKL_SW_VV_UW 100.0 FORMULA_0021 0.0 655.0000
 /begin AXIS_DESCR STD_AXIS tabg_vkat_1of2 FORMULA_0023 6 -50.0000 1000.0000 FORMAT "%4.1" /end AXIS_DESCR
 FORMAT "%5.2" /end CHARACTERISTIC
/begin CHARACTERISTIC KL_SLS_OBDH_ZWD_T_DIAG_OFF "Diag-Dauer ZWD stromlos" CURVE 0x77974 TKL_SW_VV_UW 100.0 FORMULA_0021 0.0 655.0000
 /begin AXIS_DESCR STD_AXIS tabg_vkat_1of2 FORMULA_0023 6 -50.0000 170.0000 FORMAT "%4.1" /end AXIS_DESCR
 FORMAT "%5.2" /end CHARACTERISTIC
/begin CHARACTERISTIC KL_SLS_OBDH_ZWD_T_DIAG_0 "Diag-Dauer ZWD  ZWD 0 Proz geoffnet" CURVE 0x7798E TKL_SW_VV_UW 100.0 FORMULA_0021 0.0 655.0000
 /begin AXIS_DESCR STD_AXIS tabg_vkat_1of2 FORMULA_0023 6 -50.0000 170.0000 FORMAT "%4.1" /end AXIS_DESCR
 FORMAT "%5.2" /end CHARACTERISTIC
/begin CHARACTERISTIC KL_SLS_OBDH_ZWD_T_DIAG_100 "Diag-Dauer ZWD 100 Proz geoffnet" CURVE 0x779A8 TKL_SW_VV_UW 100.0 FORMULA_0021 0.0 655.0000
 /begin AXIS_DESCR STD_AXIS tabg_vkat_1of2 FORMULA_0023 6 -50.0000 170.0000 FORMAT "%4.1" /end AXIS_DESCR
 FORMAT "%5.2" /end CHARACTERISTIC
/begin CHARACTERISTIC KL_SLS_OBDH_SLV_T_DIAG_OFF "Diag-Dauer SLV [V912: differs from V452 160E]" CURVE 0x779C2 TKL_SW_VV_UW 100.0 FORMULA_0021 0.0 655.0000
 /begin AXIS_DESCR STD_AXIS tabg_vkat_1of2 FORMULA_0023 6 -50.0000 170.0000 FORMAT "%4.1" /end AXIS_DESCR
 FORMAT "%5.2" /end CHARACTERISTIC
/begin CHARACTERISTIC KL_SLS_OBDH_ASV_DIA_T "Diag-Dauer ASV | EN: Diagnosis duration, secondary-air valve" CURVE 0x779DC TKL_SW_VV_UW 100.0 FORMULA_0021 0.0 655.0000
 /begin AXIS_DESCR STD_AXIS tabg_vkat_1of2 FORMULA_0023 6 -50.0000 170.0000 FORMAT "%4.1" /end AXIS_DESCR
 FORMAT "%5.2" /end CHARACTERISTIC
/begin CHARACTERISTIC KL_SLS_OBDH_ASV_LAM_LEAK_MAX "Schwelle fuer Erkennung auf Leckage | EN: Schwelle fuer Erkennung auf Leckage" CURVE 0x779F6 TKL_SW_VV_SW 100.0 FORMULA_0025 -0.5000 0.5000 /begin AXIS_DESCR STD_AXIS FORMULA_0112 4 -100.0000 1400.0000 FORMAT "%4.1" /end AXIS_DESCR FORMAT "%6.3" /end CHARACTERISTIC
/begin CHARACTERISTIC KL_SLS_OBDH_ML_LAM_DIF_MAX "Schwelle fuer Erkennung Durchfluss ML-Plausi" CURVE 0x77A08 TKL_SW_VV_SW 100.0 FORMULA_0025 -0.5000 0.5000 /begin AXIS_DESCR STD_AXIS FORMULA_0112 4 -100.0000 1400.0000 FORMAT "%4.1" /end AXIS_DESCR FORMAT "%6.3" /end CHARACTERISTIC
/begin CHARACTERISTIC KL_SLS_OBDH_PU_SAU_MIN "Schwelle fuer Diagnoseabbruch psau Underdruck" CURVE 0x77A1A TKL_SW_VV_SW 100.0 FORMULA_0077 0.0 2000.0000 /begin AXIS_DESCR STD_AXIS FORMULA_0023 4 -50.0000 170.0000 FORMAT "%4.1" /end AXIS_DESCR FORMAT "%4.1" /end CHARACTERISTIC
/begin CHARACTERISTIC KL_SLS_OBDH_HFM_DIAG_MIN "Min Luftmassendelta zur Erkennung HFM i.O. | EN: Minimum air-mass delta for detecting air-mass meter OK" CURVE 0x77A2C TKL_UW_VV_SW 100.0 FORMULA_0123 0.0 2000.0000 /begin AXIS_DESCR STD_AXIS FORMULA_0075 4 0.0 4.0000 FORMAT "%6.3" /end AXIS_DESCR /end CHARACTERISTIC
/begin CHARACTERISTIC KL_SLS_OBDH_ML_VOLA_INTG_MAX "Max. Wert fuer Erkennung SLP defekt" CURVE 0x77A3E TKL_UW_VV_UW 100.0 FORMULA_0112 0.0 6550.0000 /begin AXIS_DESCR STD_AXIS FORMULA_0075 4 0.0 4.0000 FORMAT "%6.3" /end AXIS_DESCR FORMAT "%4.1" /end CHARACTERISTIC
/* ------------------ Abschnitt erzeugt aus ssp.dat ------------------ */
/begin CHARACTERISTIC K_SSP_CFG "Schalter Funktion - Ausgang" VALUE 0x77A5A TKW_VV_VV_UB 100.0 FORMULA_1128 0.0 255.0 /end CHARACTERISTIC
/begin CHARACTERISTIC K_SSP_N "Treiber Ausschaltschwelle" VALUE 0x77A5C TKW_VV_VV_SW 100.0 FORMULA_0006 0.0 10000.0000 /end CHARACTERISTIC
/begin CHARACTERISTIC K_SSP_N_HYS "Hysterese Ausschaltschwelle" VALUE 0x77A5E TKW_VV_VV_SW 100.0 FORMULA_0006 0.0 10000.0000 /end CHARACTERISTIC
/begin CHARACTERISTIC K_SSP_DIAG_ML_MAX "maximal zulaessiger Luftmassenstrom aus HFM fuer SSP-Funktionscheck" VALUE 0x77A60 TKW_VV_VV_SW 100.0 FORMULA_0112 -100.0000 1400.0000 FORMAT "%4.1" /end CHARACTERISTIC
/begin CHARACTERISTIC K_SSP_DIAG_TMOT "minimal zulaessige tmot fuer SSP-Funktionscheck" VALUE 0x77A62 TKW_VV_VV_SW 100.0 FORMULA_0023 -50.0000 170.0000 FORMAT "%4.1" /end CHARACTERISTIC
/begin CHARACTERISTIC K_SSP_DIAG_T_START "minimal geforderte Motorlaufzeit time_ml fuer SSP-Funktionscheck" VALUE 0x77A64 TKW_VV_VV_UW 100.0 FORMULA_0021 0.0 655.0000 FORMAT "%5.2" /end CHARACTERISTIC
/begin CHARACTERISTIC K_SSP_DIAG_LLS_DIFF "zulaessige Abweichung lls[1] Ist- zu Mittelwert fuer SSP-Funktionscheck" VALUE 0x77A66 TKW_VV_VV_SW 100.0 FORMULA_0001 -10.0000 120.0000 FORMAT "%4.1" /end CHARACTERISTIC
/begin CHARACTERISTIC K_SSP_DIAG_TIME_WAIT "Wartezeit ohne SSP fuer SSP-Funktionscheck" VALUE 0x77A68 TKW_VV_VV_UW 100.0 FORMULA_0021 0.0 655.0000 FORMAT "%5.2" /end CHARACTERISTIC
/begin CHARACTERISTIC K_SSP_DIAG_TIME "Messzeit ohne SSP fuer SSP-Funktionscheck" VALUE 0x77A6A TKW_VV_VV_UW 100.0 FORMULA_0021 0.0 655.0000 FORMAT "%5.2" /end CHARACTERISTIC
/begin CHARACTERISTIC K_SSP_DIAG_TIME_WAIT_AN "Wartezeit mit SSP fuer SSP-Funktionscheck" VALUE 0x77A6C TKW_VV_VV_UW 100.0 FORMULA_0021 0.0 655.0000 FORMAT "%5.2" /end CHARACTERISTIC
/begin CHARACTERISTIC K_SSP_DIAG_TIME_AN "Messzeit mit SSP fuer SSP-Funktionscheck" VALUE 0x77A6E TKW_VV_VV_UW 100.0 FORMULA_0021 0.0 655.0000 FORMAT "%5.2" /end CHARACTERISTIC
/begin CHARACTERISTIC K_SSP_DIAG_SCHWELLE "zu ueberschreitende Schwelle von ml-Differenz" VALUE 0x77A70 TKW_VV_VV_SW 100.0 FORMULA_0112 -100.0000 1400.0000 FORMAT "%4.1" /end CHARACTERISTIC
/begin CHARACTERISTIC K_SSP_ED_OPENLOAD_CNT "Counter zur Entprellung der Treiberdiagnose bei OPENLOAD" VALUE 0x77A72 TKW_VV_VV_UB 100.0 FORMULA_0003 0.0 255.0000 /end CHARACTERISTIC
/begin CHARACTERISTIC K_SSP_DIAG_AQ_SOLL_SCHWELLE "zulaessige AQ-Soll-Abweichung fuer SSP-Diagnose" VALUE 0x77A74 TKW_VV_VV_UW 100.0 FORMULA_0147 0.0 6500.0000 FORMAT "%4.1" /end CHARACTERISTIC
/begin FUNCTION PCTRL "" /begin DEF_CHARACTERISTIC K_PCTRL_PROZ_ZYKL K_PCTRL_TASK_ZYKL K_PCTRL_TIMEOUT /end DEF_CHARACTERISTIC /begin REF_CHARACTERISTIC /end REF_CHARACTERISTIC /begin IN_MEASUREMENT /end IN_MEASUREMENT /begin OUT_MEASUREMENT /end OUT_MEASUREMENT /end FUNCTION
/begin FUNCTION PKS ""
 /begin DEF_CHARACTERISTIC KL_PKS_PLAU_INC KL_PKS_TAU_MODELL K_PKS_DIAG_AUFBAU_DELAY K_PKS_DIAG_AUFBAU_MIN K_PKS_DIAG_AUFBAU_TAU K_PKS_DIAG_FEHLER_SCHW K_PKS_DIAG_MAX K_PKS_DIAG_MIN K_PKS_ERSATZ K_PKS_OBD_ABW_TAU K_PKS_OBD_ABW_TAU_QMAX K_PKS_OBD_AY K_PKS_OBD_CFG K_PKS_OBD_ERSATZ K_PKS_OBD_FST K_PKS_OBD_LL_MAX K_PKS_OBD_LL_MIN K_PKS_OBD_PUMG_MIN K_PKS_OBD_PUMPE_VL K_PKS_OBD_Q_EKP_MAX K_PKS_OBD_Q_EKP_MIN K_PKS_OBD_Q_MAX K_PKS_OBD_Q_MIN K_PKS_OBD_SOLL_DYN_MAX K_PKS_OBD_TIME_ML_MIN K_PKS_OBD_TL_MAX K_PKS_OBD_TL_MIN K_PKS_OBD_TMOT_MIN K_PKS_OBD_UB_MIN K_PKS_OBD_VERZ K_PKS_OBD_VERZ_Q_MAX K_PKS_OFFSET K_PKS_PLAU_INTG_MAX K_PKS_PLAU_INTG_MIN K_PKS_PLAU_MAX_I K_PKS_PLAU_MIN_T_REG K_PKS_PLAU_QMIN_KVA K_PKS_PLAU_QMIN_N K_PKS_PLAU_SCHWELLE K_PKS_STEIGUNG K_PKS_TAU K_PKS_TAU_EKP100 /end DEF_CHARACTERISTIC
 /begin REF_CHARACTERISTIC /end REF_CHARACTERISTIC
 /begin IN_MEASUREMENT /end IN_MEASUREMENT
 /begin OUT_MEASUREMENT /end OUT_MEASUREMENT
/end FUNCTION
/begin FUNCTION PSAU ""
 /begin DEF_CHARACTERISTIC KF_PSAU_ERSATZ_DR_REL_F KL_PSAU_ERSATZ_RGX_DELTA_KORR K_PSAU_ADAPT_MAX K_PSAU_ADAPT_MIN K_PSAU_DIAG_MAX K_PSAU_DIAG_MIN K_PSAU_OFFSET K_PSAU_SENSOR_CFG K_PSAU_STEIGUNG K_PSAU_TAU /end DEF_CHARACTERISTIC
 /begin REF_CHARACTERISTIC /end REF_CHARACTERISTIC
 /begin IN_MEASUREMENT /end IN_MEASUREMENT
 /begin OUT_MEASUREMENT /end OUT_MEASUREMENT
/end FUNCTION
/begin FUNCTION PTCAN-Interface "" /begin DEF_CHARACTERISTIC /end DEF_CHARACTERISTIC /begin REF_CHARACTERISTIC /end REF_CHARACTERISTIC /begin IN_MEASUREMENT /end IN_MEASUREMENT /begin OUT_MEASUREMENT /end OUT_MEASUREMENT /end FUNCTION
/begin FUNCTION Powermanagement ""
 /begin DEF_CHARACTERISTIC CBATT_DEF KF_PMRIBAT1 KF_PMRIBAT2 KF_PMRIBAT3 KF_PMRIBAT4 KF_PMRIBAT5 KF_PMRIBAT6 KF_PMRIBAT7 KF_PMRIBAT8 KF_SOC0UBIB KF_SOCLF KL_CLASS2IND KL_CLASS2NENN KL_DFPRIO KL_DFPTC KL_DSOCPRIO KL_FITGRZ KL_ITNSTART KL_PMSOCVU KL_PRIO2PTC KL_PRIOCF KL_PRIODF KL_PTC KL_PWRCF KL_PWRDF KL_SOC0TEMP KL_SOCPRIO KL_SSOC KL_T2RELMAX KL_T2RELMXRG KL_T3RELMAX KL_T3RELMXRG KL_T4RELMAX KL_T4RELMXRG KL_UNSTART K_ABSCHKORA K_BILA_OGRZ K_BILA_UGRZ K_CCPRIOTIME K_CTRPRIOCF_2of7_ K_CTRPRIOCF_3of7_ K_CTRPRIOCF_4of7_ K_CTRPRIOCF_5of7_ K_CTRPRIOCF_6of7_ K_CTRPRIOCF_7of7_ K_CTRPWRCF_2of7_ K_CTRPWRCF_3of7_ K_CTRPWRCF_4of7_ K_CTRPWRCF_5of7_ K_CTRPWRCF_6of7_ K_CTRPWRCF_7of7_ K_CTRPWRDF_10of14_ K_CTRPWRDF_11of14_ K_CTRPWRDF_12of14_ K_CTRPWRDF_13of14_ K_CTRPWRDF_14of14_ K_CTRPWRDF_2of14_ K_CTRPWRDF_3of14_ K_CTRPWRDF_4of14_ K_CTRPWRDF_5of14_ K_CTRPWRDF_6of14_ K_CTRPWRDF_7of14_ K_CTRPWRDF_8of14_ K_DAB_KORR1 K_DAB_KORR2 K_DAB_KORR3 K_DSOCABSCH K_IB_COMMVAL K_I_FITAUSW K_LLPMFILTK K_MX_PTCPI K_PMQ_UX K_PRIOCF_R K_PRIODF_3of7_ K_PRIODF_4of7_ K_PRIODF_5of7_ K_PRIODF_6of7_ K_PRIODF_7of7_ K_PWRCOSHT K_QSTARTFGA K_Q_BILAPWF K_RIN_GRENZ7 K_RIN_GRENZ8 K_SELSPCOSA K_SOCFITGRZ K_SOCFITLIML K_SOC_QPWF K_SOC_QUALIA K_TCODIERPM K_TIME_START K_TSAISONFIL K_TSAISPWF K_UB_GRENZ K_ULEVAPP S_ABSCHK S_BSOCCALC S_PMSV_HEIZ S_PMTABSMN S_QSTARTFK /end DEF_CHARACTERISTIC
 /begin REF_CHARACTERISTIC /end REF_CHARACTERISTIC
 /begin IN_MEASUREMENT /end IN_MEASUREMENT
 /begin OUT_MEASUREMENT /end OUT_MEASUREMENT
/end FUNCTION
/begin FUNCTION RF ""
 /begin DEF_CHARACTERISTIC KL_RF_START K_RF_DYN_TAU K_RF_HUBVOLUMEN K_RF_LUFTDICHTE K_RF_ST_LL_RAMP /end DEF_CHARACTERISTIC
 /begin REF_CHARACTERISTIC /end REF_CHARACTERISTIC
 /begin IN_MEASUREMENT /end IN_MEASUREMENT
 /begin OUT_MEASUREMENT /end OUT_MEASUREMENT
/end FUNCTION
/begin FUNCTION RTA "" /begin DEF_CHARACTERISTIC /end DEF_CHARACTERISTIC /begin REF_CHARACTERISTIC /end REF_CHARACTERISTIC /begin IN_MEASUREMENT /end IN_MEASUREMENT /begin OUT_MEASUREMENT /end OUT_MEASUREMENT /end FUNCTION
/begin FUNCTION RamCheck "" /begin DEF_CHARACTERISTIC K_RAM_CHK_CFG K_RAM_CHK_T /end DEF_CHARACTERISTIC /begin REF_CHARACTERISTIC /end REF_CHARACTERISTIC /begin IN_MEASUREMENT /end IN_MEASUREMENT /begin OUT_MEASUREMENT /end OUT_MEASUREMENT /end FUNCTION
/begin FUNCTION Restgas ""
 /begin DEF_CHARACTERISTIC KF_RG_STAT KL_RG_PHI_MEAN KL_RG_PRGVO_ASP_OFFSET KL_RG_UES_A_MEAN KL_RG_UES_E_MEAN K_RG_M_MAX K_RG_M_MIN K_RG_TABG_FAKTOR K_RG_T_UES_AV_MAX K_RG_V_TOTVOLUMEN K_RG_WE_ANZ_SEGM K_RG_X_START /end DEF_CHARACTERISTIC
 /begin REF_CHARACTERISTIC /end REF_CHARACTERISTIC
 /begin IN_MEASUREMENT /end IN_MEASUREMENT
 /begin OUT_MEASUREMENT /end OUT_MEASUREMENT
/end FUNCTION
/begin FUNCTION SG-Konfiguration ""
 /begin DEF_CHARACTERISTIC cfg.abgas cfg.baureihe cfg.betriebsmode cfg.canmess cfg.canstand cfg.diagnose cfg.dsc_typ cfg.getriebetyp cfg.hil cfg.ipm cfg.la_variante cfg.motortyp cfg.peripherie cfg.sg_mode cfg.status /end DEF_CHARACTERISTIC
 /begin REF_CHARACTERISTIC /end REF_CHARACTERISTIC
 /begin IN_MEASUREMENT /end IN_MEASUREMENT
 /begin OUT_MEASUREMENT /end OUT_MEASUREMENT
/end FUNCTION
/begin FUNCTION SK-Ebene_2 "" /begin DEF_CHARACTERISTIC K_SK_E2_KOMP_ERR_MAX K_SK_MAX_RESETS_E2 /end DEF_CHARACTERISTIC /begin REF_CHARACTERISTIC /end REF_CHARACTERISTIC /begin IN_MEASUREMENT /end IN_MEASUREMENT /begin OUT_MEASUREMENT /end OUT_MEASUREMENT /end FUNCTION
/begin FUNCTION SK-Manager ""
 /begin DEF_CHARACTERISTIC K_SK_CFG K_SK_CRC32 K_SK_EGAS_OFF_10of16_ K_SK_EGAS_OFF_11of16_ K_SK_EGAS_OFF_12of16_ K_SK_EGAS_OFF_13of16_ K_SK_EGAS_OFF_14of16_ K_SK_EGAS_OFF_15of16_ K_SK_EGAS_OFF_16of16_ K_SK_EGAS_OFF_1of16_ K_SK_EGAS_OFF_2of16_ K_SK_EGAS_OFF_3of16_ K_SK_EGAS_OFF_4of16_ K_SK_EGAS_OFF_5of16_ K_SK_EGAS_OFF_6of16_ K_SK_EGAS_OFF_7of16_ K_SK_EGAS_OFF_8of16_ K_SK_EGAS_OFF_9of16_ K_SK_EGAS_OFF_TIME K_SK_FGR_SPERRE K_SK_FM_EGAS_TEST K_SK_FM_FAIL_ZYL_TEST K_SK_FM_GEMISCH_TEST K_SK_FM_KR_TEST K_SK_FM_LAM_TEST K_SK_FM_MD_TEST K_SK_FM_MVAC_TEST K_SK_FM_SMG_TEST K_SK_FRA_SPERRE K_SK_HW_AD_DELTA_MAX K_SK_HW_AD_ED_ZAEHLER K_SK_HW_AD_STAT K_SK_HW_AD_STAT_ZAEHLER K_SK_KH_SPERRE K_SK_LAM_EINGR_10of32_ K_SK_LAM_EINGR_11of32_ K_SK_LAM_EINGR_12of32_ K_SK_LAM_EINGR_13of32_ K_SK_LAM_EINGR_14of32_ K_SK_LAM_EINGR_15of32_ K_SK_LAM_EINGR_16of32_ K_SK_LAM_EINGR_17of32_ K_SK_LAM_EINGR_18of32_ K_SK_LAM_EINGR_19of32_ K_SK_LAM_EINGR_1of32_ K_SK_LAM_EINGR_20of32_ K_SK_LAM_EINGR_21of32_ K_SK_LAM_EINGR_22of32_ K_SK_LAM_EINGR_23of32_ K_SK_LAM_EINGR_24of32_ K_SK_LAM_EINGR_25of32_ K_SK_LAM_EINGR_26of32_ K_SK_LAM_EINGR_27of32_ K_SK_LAM_EINGR_28of32_ K_SK_LAM_EINGR_29of32_ K_SK_LAM_EINGR_2of32_ K_SK_LAM_EINGR_30of32_ K_SK_LAM_EINGR_31of32_ K_SK_LAM_EINGR_32of32_ K_SK_LAM_EINGR_3of32_ K_SK_LAM_EINGR_4of32_ K_SK_LAM_EINGR_5of32_ K_SK_LAM_EINGR_6of32_ K_SK_LAM_EINGR_7of32_ K_SK_LAM_EINGR_8of32_ K_SK_LAM_EINGR_9of32_ K_SK_LAM_EINGR_TI K_SK_LLRA_SPERRE K_SK_MAX_OS_ERR K_SK_MAX_RESETS K_SK_MD_BEGR_DK_OFFEN K_SK_MD_BEGR_EGAS_10of64_ K_SK_MD_BEGR_EGAS_11of64_ K_SK_MD_BEGR_EGAS_12of64_ K_SK_MD_BEGR_EGAS_13of64_ K_SK_MD_BEGR_EGAS_14of64_ K_SK_MD_BEGR_EGAS_15of64_ K_SK_MD_BEGR_EGAS_16of64_ K_SK_MD_BEGR_EGAS_17of64_ K_SK_MD_BEGR_EGAS_18of64_ K_SK_MD_BEGR_EGAS_19of64_ K_SK_MD_BEGR_EGAS_1of64_ K_SK_MD_BEGR_EGAS_20of64_ K_SK_MD_BEGR_EGAS_21of64_ K_SK_MD_BEGR_EGAS_22of64_ K_SK_MD_BEGR_EGAS_23of64_ K_SK_MD_BEGR_EGAS_24of64_ K_SK_MD_BEGR_EGAS_25of64_ K_SK_MD_BEGR_EGAS_26of64_ K_SK_MD_BEGR_EGAS_27of64_ K_SK_MD_BEGR_EGAS_28of64_ K_SK_MD_BEGR_EGAS_29of64_ K_SK_MD_BEGR_EGAS_2of64_ K_SK_MD_BEGR_EGAS_30of64_ K_SK_MD_BEGR_EGAS_31of64_ K_SK_MD_BEGR_EGAS_32of64_ K_SK_MD_BEGR_EGAS_33of64_ K_SK_MD_BEGR_EGAS_34of64_ K_SK_MD_BEGR_EGAS_35of64_ K_SK_MD_BEGR_EGAS_36of64_ K_SK_MD_BEGR_EGAS_37of64_ K_SK_MD_BEGR_EGAS_38of64_ K_SK_MD_BEGR_EGAS_39of64_ K_SK_MD_BEGR_EGAS_3of64_ K_SK_MD_BEGR_EGAS_40of64_ K_SK_MD_BEGR_EGAS_41of64_ K_SK_MD_BEGR_EGAS_42of64_ K_SK_MD_BEGR_EGAS_43of64_ K_SK_MD_BEGR_EGAS_44of64_ K_SK_MD_BEGR_EGAS_45of64_ K_SK_MD_BEGR_EGAS_46of64_ K_SK_MD_BEGR_EGAS_47of64_ K_SK_MD_BEGR_EGAS_48of64_ K_SK_MD_BEGR_EGAS_49of64_ K_SK_MD_BEGR_EGAS_4of64_ K_SK_MD_BEGR_EGAS_50of64_ K_SK_MD_BEGR_EGAS_51of64_ K_SK_MD_BEGR_EGAS_52of64_ K_SK_MD_BEGR_EGAS_53of64_ K_SK_MD_BEGR_EGAS_54of64_ K_SK_MD_BEGR_EGAS_55of64_ K_SK_MD_BEGR_EGAS_56of64_ K_SK_MD_BEGR_EGAS_57of64_ K_SK_MD_BEGR_EGAS_58of64_ K_SK_MD_BEGR_EGAS_59of64_ K_SK_MD_BEGR_EGAS_5of64_ K_SK_MD_BEGR_EGAS_60of64_ K_SK_MD_BEGR_EGAS_61of64_ K_SK_MD_BEGR_EGAS_62of64_ K_SK_MD_BEGR_EGAS_63of64_ K_SK_MD_BEGR_EGAS_64of64_ K_SK_MD_BEGR_EGAS_6of64_ K_SK_MD_BEGR_EGAS_7of64_ K_SK_MD_BEGR_EGAS_8of64_ K_SK_MD_BEGR_EGAS_9of64_ K_SK_MD_BEGR_GEMISCH_10of32_ K_SK_MD_BEGR_GEMISCH_11of32_ K_SK_MD_BEGR_GEMISCH_12of32_ K_SK_MD_BEGR_GEMISCH_13of32_ K_SK_MD_BEGR_GEMISCH_14of32_ K_SK_MD_BEGR_GEMISCH_15of32_ K_SK_MD_BEGR_GEMISCH_16of32_ K_SK_MD_BEGR_GEMISCH_17of32_ K_SK_MD_BEGR_GEMISCH_18of32_ K_SK_MD_BEGR_GEMISCH_19of32_ K_SK_MD_BEGR_GEMISCH_1of32_ K_SK_MD_BEGR_GEMISCH_20of32_ K_SK_MD_BEGR_GEMISCH_21of32_ K_SK_MD_BEGR_GEMISCH_22of32_ K_SK_MD_BEGR_GEMISCH_23of32_ K_SK_MD_BEGR_GEMISCH_24of32_ K_SK_MD_BEGR_GEMISCH_25of32_ K_SK_MD_BEGR_GEMISCH_26of32_ K_SK_MD_BEGR_GEMISCH_27of32_ K_SK_MD_BEGR_GEMISCH_28of32_ K_SK_MD_BEGR_GEMISCH_29of32_ K_SK_MD_BEGR_GEMISCH_2of32_ K_SK_MD_BEGR_GEMISCH_30of32_ K_SK_MD_BEGR_GEMISCH_31of32_ K_SK_MD_BEGR_GEMISCH_32of32_ K_SK_MD_BEGR_GEMISCH_3of32_ K_SK_MD_BEGR_GEMISCH_4of32_ K_SK_MD_BEGR_GEMISCH_5of32_ K_SK_MD_BEGR_GEMISCH_6of32_ K_SK_MD_BEGR_GEMISCH_7of32_ K_SK_MD_BEGR_GEMISCH_8of32_ K_SK_MD_BEGR_GEMISCH_9of32_ K_SK_MD_BEGR_KR_1of8_ K_SK_MD_BEGR_KR_2of8_ K_SK_MD_BEGR_KR_3of8_ K_SK_MD_BEGR_KR_4of8_ K_SK_MD_BEGR_KR_5of8_ K_SK_MD_BEGR_KR_6of8_ K_SK_MD_BEGR_KR_7of8_ K_SK_MD_BEGR_KR_8of8_ K_SK_MD_BEGR_MD_10of16_ K_SK_MD_BEGR_MD_11of16_ K_SK_MD_BEGR_MD_12of16_ K_SK_MD_BEGR_MD_13of16_ K_SK_MD_BEGR_MD_14of16_ K_SK_MD_BEGR_MD_15of16_ K_SK_MD_BEGR_MD_16of16_ K_SK_MD_BEGR_MD_1of16_ K_SK_MD_BEGR_MD_2of16_ K_SK_MD_BEGR_MD_3of16_ K_SK_MD_BEGR_MD_4of16_ K_SK_MD_BEGR_MD_5of16_ K_SK_MD_BEGR_MD_6of16_ K_SK_MD_BEGR_MD_7of16_ K_SK_MD_BEGR_MD_8of16_ K_SK_MD_BEGR_MD_9of16_ K_SK_MD_BEGR_MVAC_1of4_ K_SK_MD_BEGR_MVAC_2of4_ K_SK_MD_BEGR_MVAC_3of4_ K_SK_MD_BEGR_MVAC_4of4_ K_SK_MD_BEGR_MVAC_SYS K_SK_MD_BEGR_PWG_1of6_ K_SK_MD_BEGR_PWG_2of6_ K_SK_MD_BEGR_PWG_3of6_ K_SK_MD_BEGR_PWG_4of6_ K_SK_MD_BEGR_PWG_5of6_ K_SK_MD_BEGR_PWG_6of6_ K_SK_MD_BEGR_RESET K_SK_MD_BEGR_SMG_10of16_ K_SK_MD_BEGR_SMG_11of16_ K_SK_MD_BEGR_SMG_12of16_ K_SK_MD_BEGR_SMG_13of16_ K_SK_MD_BEGR_SMG_14of16_ K_SK_MD_BEGR_SMG_15of16_ K_SK_MD_BEGR_SMG_16of16_ K_SK_MD_BEGR_SMG_1of16_ K_SK_MD_BEGR_SMG_2of16_ K_SK_MD_BEGR_SMG_3of16_ K_SK_MD_BEGR_SMG_4of16_ K_SK_MD_BEGR_SMG_5of16_ K_SK_MD_BEGR_SMG_6of16_ K_SK_MD_BEGR_SMG_7of16_ K_SK_MD_BEGR_SMG_8of16_ K_SK_MD_BEGR_SMG_9of16_ K_SK_MD_BEGR_TI_10of16_ K_SK_MD_BEGR_TI_11of16_ K_SK_MD_BEGR_TI_12of16_ K_SK_MD_BEGR_TI_13of16_ K_SK_MD_BEGR_TI_14of16_ K_SK_MD_BEGR_TI_15of16_ K_SK_MD_BEGR_TI_16of16_ K_SK_MD_BEGR_TI_1of16_ K_SK_MD_BEGR_TI_2of16_ K_SK_MD_BEGR_TI_3of16_ K_SK_MD_BEGR_TI_4of16_ K_SK_MD_BEGR_TI_5of16_ K_SK_MD_BEGR_TI_6of16_ K_SK_MD_BEGR_TI_7of16_ K_SK_MD_BEGR_TI_8of16_ K_SK_MD_BEGR_TI_9of16_ K_SK_MD_TI_EINGR K_SK_MD_VL_SPERRE K_SK_MVAC_KH_1of4_ K_SK_MVAC_KH_2of4_ K_SK_MVAC_KH_3of4_ K_SK_MVAC_KH_4of4_ K_SK_PKS_NOTLAUF K_SK_PROZ_ERR K_SK_TASK_ERR K_SK_TI_OFF_EGAS_10of64_ K_SK_TI_OFF_EGAS_11of64_ K_SK_TI_OFF_EGAS_12of64_ K_SK_TI_OFF_EGAS_13of64_ K_SK_TI_OFF_EGAS_14of64_ K_SK_TI_OFF_EGAS_15of64_ K_SK_TI_OFF_EGAS_16of64_ K_SK_TI_OFF_EGAS_17of64_ K_SK_TI_OFF_EGAS_18of64_ K_SK_TI_OFF_EGAS_19of64_ K_SK_TI_OFF_EGAS_1of64_ K_SK_TI_OFF_EGAS_20of64_ K_SK_TI_OFF_EGAS_21of64_ K_SK_TI_OFF_EGAS_22of64_ K_SK_TI_OFF_EGAS_23of64_ K_SK_TI_OFF_EGAS_24of64_ K_SK_TI_OFF_EGAS_25of64_ K_SK_TI_OFF_EGAS_26of64_ K_SK_TI_OFF_EGAS_27of64_ K_SK_TI_OFF_EGAS_28of64_ K_SK_TI_OFF_EGAS_29of64_ K_SK_TI_OFF_EGAS_2of64_ K_SK_TI_OFF_EGAS_30of64_ K_SK_TI_OFF_EGAS_31of64_ K_SK_TI_OFF_EGAS_32of64_ K_SK_TI_OFF_EGAS_33of64_ K_SK_TI_OFF_EGAS_34of64_ K_SK_TI_OFF_EGAS_35of64_ K_SK_TI_OFF_EGAS_36of64_ K_SK_TI_OFF_EGAS_37of64_ K_SK_TI_OFF_EGAS_38of64_ K_SK_TI_OFF_EGAS_39of64_ K_SK_TI_OFF_EGAS_3of64_ K_SK_TI_OFF_EGAS_40of64_ K_SK_TI_OFF_EGAS_41of64_ K_SK_TI_OFF_EGAS_42of64_ K_SK_TI_OFF_EGAS_43of64_ K_SK_TI_OFF_EGAS_44of64_ K_SK_TI_OFF_EGAS_45of64_ K_SK_TI_OFF_EGAS_46of64_ K_SK_TI_OFF_EGAS_47of64_ K_SK_TI_OFF_EGAS_48of64_ K_SK_TI_OFF_EGAS_49of64_ K_SK_TI_OFF_EGAS_4of64_ K_SK_TI_OFF_EGAS_50of64_ K_SK_TI_OFF_EGAS_51of64_ K_SK_TI_OFF_EGAS_52of64_ K_SK_TI_OFF_EGAS_53of64_ K_SK_TI_OFF_EGAS_54of64_ K_SK_TI_OFF_EGAS_55of64_ K_SK_TI_OFF_EGAS_56of64_ K_SK_TI_OFF_EGAS_57of64_ K_SK_TI_OFF_EGAS_58of64_ K_SK_TI_OFF_EGAS_59of64_ K_SK_TI_OFF_EGAS_5of64_ K_SK_TI_OFF_EGAS_60of64_ K_SK_TI_OFF_EGAS_61of64_ K_SK_TI_OFF_EGAS_62of64_ K_SK_TI_OFF_EGAS_63of64_ K_SK_TI_OFF_EGAS_64of64_ K_SK_TI_OFF_EGAS_6of64_ K_SK_TI_OFF_EGAS_7of64_ K_SK_TI_OFF_EGAS_8of64_ K_SK_TI_OFF_EGAS_9of64_ K_SK_T_RESET_DELAY_OS K_SK_ZYL_OFF_MAX /end DEF_CHARACTERISTIC
 /begin REF_CHARACTERISTIC /end REF_CHARACTERISTIC
 /begin IN_MEASUREMENT /end IN_MEASUREMENT
 /begin OUT_MEASUREMENT /end OUT_MEASUREMENT
/end FUNCTION
/begin FUNCTION SLP ""
 /begin DEF_CHARACTERISTIC KF_SLP_DAUER_TMOT_START KL_SLP_DELAY_TMOT_START K_SLP_PABG_SCHWELLE K_SLP_PABG_TAU K_SLP_TIME_AUS K_SLP_TIME_MAX /end DEF_CHARACTERISTIC
 /begin REF_CHARACTERISTIC /end REF_CHARACTERISTIC
 /begin IN_MEASUREMENT /end IN_MEASUREMENT
 /begin OUT_MEASUREMENT /end OUT_MEASUREMENT
/end FUNCTION
/begin FUNCTION SLS_OBD ""
 /begin DEF_CHARACTERISTIC KL_SLS_OBDH_ASV_DIA_T KL_SLS_OBDH_ASV_LAM_LEAK_MAX KL_SLS_OBDH_HFM_DIAG_MIN KL_SLS_OBDH_ML_LAM_DIF_MAX KL_SLS_OBDH_ML_MDF_DIAG KL_SLS_OBDH_ML_VOLA_INTG_MAX KL_SLS_OBDH_PU_SAU_MIN KL_SLS_OBDH_SLV_T_DIAG_OFF KL_SLS_OBDH_ZWD_T_DIAG_0 KL_SLS_OBDH_ZWD_T_DIAG_100 KL_SLS_OBDH_ZWD_T_DIAG_OFF K_SLS_OBDH_ASV_LI_OPE K_SLS_OBDH_ASV_PL_LI_OPE K_SLS_OBDH_ASV_PL_RE_OPE K_SLS_OBDH_ASV_RE_OPE K_SLS_OBDH_ASV_TAU K_SLS_OBDH_DYN_DELTA_RF K_SLS_OBDH_DYN_RF_T K_SLS_OBDH_EUV_MIN_DEF K_SLS_OBDH_HFM_MAX K_SLS_OBDH_HFM_TAU K_SLS_OBDH_HYD_ABBRUCH_AD_MAX K_SLS_OBDH_HYD_ABBRUCH_ML_MAX K_SLS_OBDH_MDF_1_MAG K_SLS_OBDH_MDF_2_MAG K_SLS_OBDH_MDF_CFG K_SLS_OBDH_MDF_MAX_DEF K_SLS_OBDH_MDF_MIN_DEF K_SLS_OBDH_MDL_K_EINBAUTEN K_SLS_OBDH_MLVERH_MIN K_SLS_OBDH_ML_MAX K_SLS_OBDH_ML_MIN K_SLS_OBDH_ML_TAU K_SLS_OBDH_ML_TMOT K_SLS_OBDH_N_MAX K_SLS_OBDH_N_MIN K_SLS_OBDH_PUMG_MIN K_SLS_OBDH_RF_MAX K_SLS_OBDH_RF_MIN K_SLS_OBDH_SLP_DEF K_SLS_OBDH_SLV_MAX K_SLS_OBDH_START_MIN K_SLS_OBDH_T_AUFHEIZ K_SLS_OBDH_T_HFM_DIA K_SLS_OBDH_T_ML_PLAUSI K_SLS_OBDH_T_SA K_SLS_OBDH_T_SLV_INT_START K_SLS_OBDH_UB_MIN K_SLS_OBDH_ZWD_0_MAX K_SLS_OBDH_ZWD_100_MIN K_SLS_OBDH_ZWD_OFF_MAX K_SLS_OBDH_ZWD_OFF_MIN K_SLS_OBD_CFG K_SLS_OBD_DYN_TAU K_SLS_OBD_ML_MDL_DIFF_MAX K_SLS_OBD_ML_MDL_WICHT K_SLS_OBD_TMOT_MIN K_SLS_PL_T_MDF_STOP /end DEF_CHARACTERISTIC
 /begin REF_CHARACTERISTIC /end REF_CHARACTERISTIC
 /begin IN_MEASUREMENT /end IN_MEASUREMENT
 /begin OUT_MEASUREMENT /end OUT_MEASUREMENT
/end FUNCTION
/begin FUNCTION SLV "" /begin DEF_CHARACTERISTIC /end DEF_CHARACTERISTIC /begin REF_CHARACTERISTIC /end REF_CHARACTERISTIC /begin IN_MEASUREMENT /end IN_MEASUREMENT /begin OUT_MEASUREMENT /end OUT_MEASUREMENT /end FUNCTION
/begin FUNCTION SPI_INJ "" /begin DEF_CHARACTERISTIC /end DEF_CHARACTERISTIC /begin REF_CHARACTERISTIC /end REF_CHARACTERISTIC /begin IN_MEASUREMENT /end IN_MEASUREMENT /begin OUT_MEASUREMENT /end OUT_MEASUREMENT /end FUNCTION
/begin FUNCTION SSP ""
 /begin DEF_CHARACTERISTIC K_SSP_CFG K_SSP_DIAG_AQ_SOLL_SCHWELLE K_SSP_DIAG_LLS_DIFF K_SSP_DIAG_ML_MAX K_SSP_DIAG_SCHWELLE K_SSP_DIAG_TIME K_SSP_DIAG_TIME_AN K_SSP_DIAG_TIME_WAIT K_SSP_DIAG_TIME_WAIT_AN K_SSP_DIAG_TMOT K_SSP_DIAG_T_START K_SSP_ED_OPENLOAD_CNT K_SSP_N K_SSP_N_HYS /end DEF_CHARACTERISTIC
 /begin REF_CHARACTERISTIC /end REF_CHARACTERISTIC
 /begin IN_MEASUREMENT /end IN_MEASUREMENT
 /begin OUT_MEASUREMENT /end OUT_MEASUREMENT
/end FUNCTION
/begin RECORD_LAYOUT TKW_VV_VV_UB FNC_VALUES 1 UBYTE COLUMN_DIR DIRECT /end RECORD_LAYOUT
/begin RECORD_LAYOUT TKW_VV_VV_UW FNC_VALUES 1 UWORD COLUMN_DIR DIRECT /end RECORD_LAYOUT
/begin RECORD_LAYOUT TKW_VV_VV_SW FNC_VALUES 1 SWORD COLUMN_DIR DIRECT /end RECORD_LAYOUT
/begin RECORD_LAYOUT TKL_UB_VV_UB NO_AXIS_PTS_X 1 UBYTE RESERVED 2 BYTE AXIS_PTS_X 3 UBYTE INDEX_INCR DIRECT FNC_VALUES 4 UBYTE COLUMN_DIR DIRECT /end RECORD_LAYOUT
/begin RECORD_LAYOUT TKL_UB_VV_UW NO_AXIS_PTS_X 1 UBYTE RESERVED 2 BYTE AXIS_PTS_X 3 UBYTE INDEX_INCR DIRECT FNC_VALUES 4 UWORD COLUMN_DIR DIRECT /end RECORD_LAYOUT
/begin RECORD_LAYOUT TKL_UB_VV_SW NO_AXIS_PTS_X 1 UBYTE RESERVED 2 BYTE AXIS_PTS_X 3 UBYTE INDEX_INCR DIRECT FNC_VALUES 4 SWORD COLUMN_DIR DIRECT /end RECORD_LAYOUT
/begin RECORD_LAYOUT TKL_UW_VV_UB NO_AXIS_PTS_X 1 UBYTE RESERVED 2 BYTE AXIS_PTS_X 3 UWORD INDEX_INCR DIRECT FNC_VALUES 4 UBYTE COLUMN_DIR DIRECT /end RECORD_LAYOUT
/begin RECORD_LAYOUT TKL_UW_VV_UW NO_AXIS_PTS_X 1 UBYTE RESERVED 2 BYTE AXIS_PTS_X 3 UWORD INDEX_INCR DIRECT FNC_VALUES 4 UWORD COLUMN_DIR DIRECT /end RECORD_LAYOUT
/begin RECORD_LAYOUT TKL_UW_VV_SW NO_AXIS_PTS_X 1 UBYTE RESERVED 2 BYTE AXIS_PTS_X 3 UWORD INDEX_INCR DIRECT FNC_VALUES 4 SWORD COLUMN_DIR DIRECT /end RECORD_LAYOUT
/begin RECORD_LAYOUT TKL_SW_VV_UB NO_AXIS_PTS_X 1 UBYTE RESERVED 2 BYTE AXIS_PTS_X 3 SWORD INDEX_INCR DIRECT FNC_VALUES 4 UBYTE COLUMN_DIR DIRECT /end RECORD_LAYOUT
/begin RECORD_LAYOUT TKL_SW_VV_UW NO_AXIS_PTS_X 1 UBYTE RESERVED 2 BYTE AXIS_PTS_X 3 SWORD INDEX_INCR DIRECT FNC_VALUES 4 UWORD COLUMN_DIR DIRECT /end RECORD_LAYOUT
/begin RECORD_LAYOUT TKL_SW_VV_SW NO_AXIS_PTS_X 1 UBYTE RESERVED 2 BYTE AXIS_PTS_X 3 SWORD INDEX_INCR DIRECT FNC_VALUES 4 SWORD COLUMN_DIR DIRECT /end RECORD_LAYOUT
/begin RECORD_LAYOUT TKF_UW_SW_UB NO_AXIS_PTS_X 1 UBYTE NO_AXIS_PTS_Y 2 UBYTE AXIS_PTS_X 3 SWORD INDEX_INCR DIRECT AXIS_PTS_Y 4 UWORD INDEX_INCR DIRECT FNC_VALUES 5 UBYTE COLUMN_DIR DIRECT /end RECORD_LAYOUT
/begin RECORD_LAYOUT TKF_SW_UW_UW NO_AXIS_PTS_X 1 UBYTE NO_AXIS_PTS_Y 2 UBYTE AXIS_PTS_X 3 UWORD INDEX_INCR DIRECT AXIS_PTS_Y 4 SWORD INDEX_INCR DIRECT FNC_VALUES 5 UWORD COLUMN_DIR DIRECT /end RECORD_LAYOUT
/begin RECORD_LAYOUT TKF_SW_SW_UW NO_AXIS_PTS_X 1 UBYTE NO_AXIS_PTS_Y 2 UBYTE AXIS_PTS_X 3 SWORD INDEX_INCR DIRECT AXIS_PTS_Y 4 SWORD INDEX_INCR DIRECT FNC_VALUES 5 UWORD COLUMN_DIR DIRECT /end RECORD_LAYOUT
/begin RECORD_LAYOUT TKF_SW_SW_SW NO_AXIS_PTS_X 1 UBYTE NO_AXIS_PTS_Y 2 UBYTE AXIS_PTS_X 3 SWORD INDEX_INCR DIRECT AXIS_PTS_Y 4 SWORD INDEX_INCR DIRECT FNC_VALUES 5 SWORD COLUMN_DIR DIRECT /end RECORD_LAYOUT
/end MODULE
/end PROJECT
