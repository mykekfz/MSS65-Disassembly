/* ------------------------------------------------------------------
MSS65 INJ A2L - Data 7842800 / program 7842123 (V912.00-B204.00, data set 0569Q60Z520E)
Created by ZiMMie for the M5Board and Nam3Forum communities.
This project exists to make this information freely available to
everyone: to share the work, encourage collaboration, and let others
learn from it, use it and add their own knowledge.
The reference material is based on publicly available program data.
The V912 program was disassembled and analysed to place and verify the
definitions for this calibration.
This is a community effort, and every contribution matters.
Corrections, additional findings, technical knowledge and general
feedback are all very welcome. The more knowledge is shared and the
more people work together, the more can be achieved.
Completely free to use and share.
------------------------------------------------------------------ */
/* Technical notes - V912 definitions.
Calibration addresses aligned against the V912 image (0pa/0da) by table structure, code read-width
evidence and value comparison with V452 (05.11.2026). Injection calibration is reorganised in several blocks relative to V452.
Characteristics that could not be placed with confidence are left out, including most of the
generator / power-management / IBS block (rewritten in V912).
Descriptions ending in [V912: differs from V452 160E] hold a different value than the V452 160E data set.
RAM measurements are not included: the V912 RAM layout differs from V452 and has not been re-mapped. */
/begin PROJECT MSS65-inj-V912 "MSS65 INJ - V912.00-B204.00, data set 0569Q60Z520E"
/begin HEADER "" VERSION "V912.00-B204.00" /end HEADER
/begin MODULE _MSS65-inj "MSS65 INJ - V912.00-B204.00, data 7842800"
/begin MOD_COMMON "" BYTE_ORDER MSB_FIRST /* Default byteorder (Motorola) */ /end MOD_COMMON
/*--------------------------- QADC A + B ------------------------------------------------*/ /*--------------------------- CAN A + B ------------------------------------------------*/ /* TPU KW FORMELN ------------------------------------------------------------------------*/
/begin COMPU_METHOD FORMULA_KW1 "FORMULA_KW1" RAT_FUNC "%5.0" "-" COEFFS 0 256 128 0 0 1 /end COMPU_METHOD
/begin COMPU_METHOD FORMULA_KW2 "FORMULA_KW2" RAT_FUNC "%5.0" "-" COEFFS 0 64 0 0 0 1 /end COMPU_METHOD
/begin COMPU_METHOD FORMULA_KW3 "FORMULA_KW3" TAB_VERB "%5.0" "-" COMPU_TAB_REF FORMULA_KW3_VTAB /end COMPU_METHOD
/begin COMPU_VTAB FORMULA_KW3_VTAB "FORMULA_KW3_VTAB" TAB_VERB 13 0 "ini" 1 "1st edge" 2 "second edge" 3 "wait teeth" 4 "search gap" 5 "1st missing required" 6 "last tooth until gap" 7 "1st missing tooth" 8 "2nd missing tooth" 9 "1st tooth after gap" 10 "2nd tooth after gap" 11 "tooth 2..56, 62..116" 12 "gap required" DEFAULT_VALUE "1 undefined" /end COMPU_VTAB
/begin COMPU_METHOD FORMULA_KW4 "FORMULA_KW4" RAT_FUNC "%5.0" "-" COEFFS 0 1 0 0 0 1 /end COMPU_METHOD
/begin COMPU_METHOD FORMULA_KW5 "FORMULA_KW5" RAT_FUNC "%5.0" "Upm" COEFFS 0 0 27344 0 1 0 /end COMPU_METHOD
/begin COMPU_METHOD FORMULA_KW6 "FORMULA_KW6" RAT_FUNC "%6.4" "�" COEFFS 0 1 0 0 0 0.00004291534423828125 /end COMPU_METHOD
/begin COMPU_METHOD FORMULA_KW8 "FORMULA_KW8" RAT_FUNC "%9.2" "ms" COEFFS 0 7000 0 0 0 1 /end COMPU_METHOD
/begin COMPU_METHOD FORMULA_KW9 "FORMULA_KW9" RAT_FUNC "%7.2" "ms" COEFFS 0 1 0 0 0 2.34057 /end COMPU_METHOD
/begin COMPU_METHOD FORMULA_KW10 "FORMULA_KW10" RAT_FUNC "%7.2" "�" COEFFS 0 1 0 0 0 0.01098633 /end COMPU_METHOD
/begin COMPU_METHOD FORMULA_KW11 "FORMULA_KW11" RAT_FUNC "%7.2" "ms" COEFFS 0 7000 0 0 0 1 /end COMPU_METHOD
/begin COMPU_METHOD FORMULA_KW12 "FORMULA_KW12" RAT_FUNC "%9.2" "ms" COEFFS 0 7000 0 0 0 256 /end COMPU_METHOD
/begin COMPU_METHOD FORMULA_KW13 "FORMULA_KW13" RAT_FUNC "%12.2" "ms" COEFFS 0 840000 0 0 0 1 /end COMPU_METHOD
/* TPU KW A ------------------------------------------------------------------------------*/ /* TPU KW B ------------------------------------------------------------------------------*/ /* TPU PWM FORMELN -----------------------------------------------------------------------*/
/begin COMPU_METHOD FORMULA_PWM1 "FORMULA_PWM1" RAT_FUNC "%7.2" "ms" COEFFS 0 7000 0 0 0 1 /end COMPU_METHOD
/* TPU PWM -------------------------------------------------------------------------------*/ /* TPU DIO FORMELN -----------------------------------------------------------------------*/
/begin COMPU_METHOD FORMULA_DIO1 "FORMULA_DIO1" TAB_VERB "%5.0" "-" COMPU_TAB_REF FORMULA_DIO1_VTAB /end COMPU_METHOD
/begin COMPU_VTAB FORMULA_DIO1_VTAB "FORMULA_DIO1_VTAB" TAB_VERB 5 0x04 "in rising edge" 0x08 "in falling edge" 0x0C "in both edges" 0xE1 "out pin high" 0xE2 "out pin low" DEFAULT_VALUE "1 undefined" /end COMPU_VTAB
/begin COMPU_METHOD FORMULA_DIO2 "FORMULA_DIO2" RAT_FUNC "%5.0" "-" COEFFS 0 1 0 0 0 1 /end COMPU_METHOD
/begin COMPU_METHOD FORMULA_DIO3 "FORMULA_DIO3" RAT_FUNC "%7.2" "ms" COEFFS 0 7000 0 0 0 1 /end COMPU_METHOD
/* TPU DIO -------------------------------------------------------------------------------*/ /* TPU ATP FORMELN -----------------------------------------------------------------------*/
/begin COMPU_METHOD FORMULA_ATP1 "FORMULA_ATP1" RAT_FUNC "%7.2" "�" COEFFS 0 1 0 0 0 0.01098633 /end COMPU_METHOD
/begin COMPU_METHOD FORMULA_ATP2 "FORMULA_ATP2" RAT_FUNC "%7.2" "ms" COEFFS 0 7000 0 0 0 1 /end COMPU_METHOD
/begin COMPU_METHOD FORMULA_ATP3 "FORMULA_ATP3" RAT_FUNC "%5.0" "-" COEFFS 0 1 0 0 0 1 /end COMPU_METHOD
/* TPU ATP -------------------------------------------------------------------------------*/ /* TPU KW FORMELN ------------------------------------------------------------------------*/
/begin COMPU_METHOD FORMULA_NW1 "FORMULA_NW1" RAT_FUNC "%9.2" "ms" COEFFS 0 7000 0 0 0 1 /end COMPU_METHOD
/begin COMPU_METHOD FORMULA_NW2 "FORMULA_NW2" RAT_FUNC "%12.2" "ms" COEFFS 0 840000 0 0 0 1 /end COMPU_METHOD
/begin COMPU_METHOD FORMULA_NW3 "FORMULA_NW3" RAT_FUNC "%5.0" "-" COEFFS 0 256 128 0 0 1 /end COMPU_METHOD
/begin COMPU_METHOD FORMULA_NW4 "FORMULA_NW4" RAT_FUNC "%5.0" "-" COEFFS 0 32768 0 0 0 1 /end COMPU_METHOD
/* TPU NW --------------------------------------------------------------------------------*/ /* TPU INJ FORMELN -----------------------------------------------------------------------*/
/begin COMPU_METHOD FORMULA_INJ1 "FORMULA_INJ1" RAT_FUNC "%7.2" "�" COEFFS 0 1 0 0 0 0.01098633 /end COMPU_METHOD
/begin COMPU_METHOD FORMULA_INJ2 "FORMULA_INJ2" RAT_FUNC "%7.2" "ms" COEFFS 0 7000 0 0 0 1 /end COMPU_METHOD
/begin COMPU_METHOD FORMULA_INJ3 "FORMULA_INJ3" RAT_FUNC "%9.2" "ms" COEFFS 0 1750 0 0 0 1 /end COMPU_METHOD
/begin COMPU_METHOD FORMULA_INJ4 "FORMULA_INJ4" RAT_FUNC "%7.0" "-" COEFFS 0 1 0 0 0 1 /end COMPU_METHOD
/begin COMPU_METHOD FORMULA_INJ5 "FORMULA_INJ5" RAT_FUNC "%5.0" "-" COEFFS 0 32768 0 0 0 1 /end COMPU_METHOD
/begin COMPU_METHOD FORMULA_INJ6 "FORMULA_INJ6" RAT_FUNC "%5.0" "-" COEFFS 0 16384 0 0 0 1 /end COMPU_METHOD
/begin COMPU_METHOD FORMULA_INJ7 "FORMULA_INJ7" RAT_FUNC "%5.0" "-" COEFFS 0 128 0 0 0 1 /end COMPU_METHOD
/begin COMPU_METHOD FORMULA_INJ8 "FORMULA_INJ8" RAT_FUNC "%5.0" "-" COEFFS 0 64 0 0 0 1 /end COMPU_METHOD
/begin COMPU_METHOD FORMULA_INJ9 "FORMULA_INJ9" RAT_FUNC "%9.2" "ms" COEFFS 0 7000 0 0 0 256 /end COMPU_METHOD
/begin COMPU_METHOD FORMULA_INJ10 "FORMULA_INJ10" RAT_FUNC "%9.2" "ms" COEFFS 0 7000 0 0 0 1 /end COMPU_METHOD
/begin COMPU_METHOD FORMULA_INJ11 "FORMULA_INJ11" RAT_FUNC "%9.2" "ms" COEFFS 0 7000 0 0 0 256 /end COMPU_METHOD
/* TPU INJ Globale Parameter -------------------------------------------------------------*/ /* TPU INJ Parameter Zylinder 1 ----------------------------------------------------------*/ /* TPU INJ Parameter Zylinder 2 ----------------------------------------------------------*/ /* TPU INJ Parameter Zylinder 3 ----------------------------------------------------------*/ /* TPU INJ Parameter Zylinder 4 ----------------------------------------------------------*/ /* TPU INJ Parameter Zylinder 5 ----------------------------------------------------------*/ /* TPU INJ Parameter Zylinder 6 ----------------------------------------------------------*/ /* TPU INJ Parameter Zylinder 7 ----------------------------------------------------------*/ /* TPU INJ Parameter Zylinder 8 ----------------------------------------------------------*/ /* TPU INJ Parameter Zylinder 9 ----------------------------------------------------------*/ /* TPU INJ Parameter Zylinder 10 ---------------------------------------------------------*/
/begin MOD_PAR "" VERSION "ccp 2.1" ADDR_EPK 0x00070289 EPK "V912" SUPPLIER "" CUSTOMER "" CUSTOMER_NO "" USER "" ECU "MSS65-INJ" /* Description of memory-segments. There has to be a CODE and DATA-Segment to */ /* support the generation of valid flashable HEX-Files */
 /begin MEMORY_SEGMENT CODESEG1 "Program" CODE FLASH INTERN 0x10000 0x60000 -1 -1 -1 -1 -1 /end MEMORY_SEGMENT
 /begin MEMORY_SEGMENT CODESEG2 "Program" CODE FLASH EXTERN 0x450000 0x1B0000 -1 -1 -1 -1 -1 /end MEMORY_SEGMENT
 /begin MEMORY_SEGMENT DATASEG1 "Appl.-DATA" DATA FLASH /* Memorytype; RAM wird nicht unterst�tzt */ INTERN 0x70000 0x10000 -1 -1 -1 -1 -1 /end MEMORY_SEGMENT
 /begin MEMORY_SEGMENT /* The new keyword MEMORY_SEGMENT */ VARSEG "Variablen" VARIABLES RAM INTERN 0x3F8000 0x8000 -1 -1 -1 -1 -1 /end MEMORY_SEGMENT
 /begin CALIBRATION_METHOD "DSERAP" /* Name of Method */ 1 /* Version No. */
  /begin CALIBRATION_HANDLE 0x70000 /* Begin of Calibration-Data */ 0xFFFC /* Length of Calibration-Data */ /end CALIBRATION_HANDLE
 /end CALIBRATION_METHOD
/end MOD_PAR
/begin IF_DATA ASAP1B_CCP /* spezific definition for CCP */ /* schnelle zeitsynchrone DAQ-Liste */
 /begin SOURCE "5 ms" 3 /* Basic Scale Unit: 3 -> 1ms */ 5 /* Rate: 5 * 1ms = 5ms */
  /begin QP_BLOB /* The QP-BLOB specifies the behavior of*/ 0 LENGTH 20 CAN_ID_FIXED 0x510 RASTER 0 FIRST_PID 0 /end QP_BLOB
 /end SOURCE
 /* langsame zeitsynchrone DAQ-Liste */
 /begin SOURCE "100 ms" 5 /* Basic Scale Unit: 5 -> 100ms */ 1 /* Rate: 1 * 100ms = 100ms */
  /begin QP_BLOB /* The QP-BLOB specifies the behavior of*/ 1 LENGTH 10 CAN_ID_FIXED 0x511 RASTER 1 FIRST_PID 20 /end QP_BLOB
 /end SOURCE
 /* winkelsynchrone DAQ-Liste */
 /begin SOURCE "segment-synchron" 103 /* Basic Scale Unit: 103 -> Segment */ 1 /* Rate: 1 * Seg = Seg */
  /begin QP_BLOB /* The QP-BLOB specify the behavior of */ 2 LENGTH 10 CAN_ID_FIXED 0x512 RASTER 2 /* noch pruefen!!!! p_wax */ FIRST_PID 30 /end QP_BLOB
 /end SOURCE
 /begin RASTER "5ms-Task" "5ms" 0 3 /* Scaling Unit: 3 = 1 msec */ 5 /* Rate in Scaling Unit: 5 */ /end RASTER
 /begin RASTER "100ms-Task" "100ms" 1 5 /* Scaling Unit: 5 = 100 msec */ 1 /* Rate in Scaling Unit: 1 */ /end RASTER
 /begin RASTER "sync-Task" "sync" 2 103 /* Scaling Unit: 103 = cylinder segment */ 1 /* Rate in Scaling Unit: 1 */ /end RASTER
 /begin TP_BLOB /* This BLOB describes all parameters */ /* that are necessary for CAN-timing and*/ /* ECU-calibration-technics */ 0x0201 /* CCP-Version V2.1 => 0x0201 */ 0x0202 /* BLOB-Version V2.2 => 0x0202 */ 0x500 /* CAN-ID CCP -> ECU */ 0x501 /* CAN-ID ECU -> CCP */ 0x1234 /* ECU CCP-Address */ 1 /* Byte-order: 1 - High-Byte-First (MOT)*/ /* 2 - Low-Byte-First(INTEL)*/
  /begin CAN_PARAM /* Interface CAN-Conrtoller settings */ 0x01f4 /* CAN-Baudrate in kBd: 0x01F4 = 500 kBd*/ 0x41 /* Bittimingregister BTR0: 0x41 */ 0x25 /* Bittimingregister BTR1: 0x25 */ /end CAN_PARAM
  BAUDRATE 500000 /* Baud rate */ SAMPLE_POINT 66 /* Sampling Point of time in percent */ SAMPLE_RATE 1 /* number of samples per bit */ STORE_SUPPORTED /* ECU supports the Store function */ RESUME_SUPPORTED /* ECU supports the Resume function */
  /begin CHECKSUM_PARAM 0x8009 /* Auswahl Checksum-Funktionen */ 0xFFFC /* Max. Blocklaenge */ CHECKSUM_CALCULATION ACTIVE_PAGE /* akt. Seite berechnen */ /end CHECKSUM_PARAM
  /begin DEFINED_PAGES /* Description of the memory-page */ 1 /* Logical-page-number */ "Workingpage" /* Name of page */ 0x0000 /* Address-Extension */ /* (only low-byte sgnificant) */ 0xc70000 /* Address of Memorypage */ 0x10000 /* Memorysize */ RAM FLASH_BACK /* feature available to flash back the RAM memory page */ DEFAULT /* Page is standard (fallback mode) */ RAM_INIT_BY_ECU /* Initialisationmethode: die ECU initialisiert die WP eigenstaendig */ /* INCA vermeidet mit dieser Einstellung das Senden des MOVE-Commands */ /* beim CCP-Session-Login. */ /end DEFINED_PAGES
  /begin DEFINED_PAGES /* Description of the memory-page */ 2 /* Logical-page-number */ "Referenzpage" /* Name of page */ 0x0000 /* Address-Extension */ /* (only low-byte sgnificant) */ 0x70000 /* Address of Memorypage */ 0x10000 /* Memorysize */ FLASH RAM_INIT_BY_ECU /* Initialisationmethode: die ECU initialisiert die WP eigenstaendig */ /* INCA vermeidet mit dieser Einstellung das Senden des MOVE-Commands */ /* beim CCP-Session-Login. */ /end DEFINED_PAGES
  OPTIONAL_CMD 0x0C /* GetSessionStatus */ OPTIONAL_CMD 0x0D /* SetSessionStatus */ OPTIONAL_CMD 0x0E /* BuildChecksum */ OPTIONAL_CMD 0x09 /* GetCalPage */ OPTIONAL_CMD 0x10 /* Clear Memory */ OPTIONAL_CMD 0x11 /* SelectCalPage */ OPTIONAL_CMD 0x12 /* GetSeed */ OPTIONAL_CMD 0x13 /* Unlock */ OPTIONAL_CMD 0x18 /* Programm */ OPTIONAL_CMD 0x19 /* Move */ OPTIONAL_CMD 0x22 /* Programm6 */ OPTIONAL_CMD 0x23 /* Download6 */ /end TP_BLOB
/end IF_DATA
/begin IF_DATA ASAP1B_KWP2000
 /begin SOURCE "timeslot" 0 0 QP_BLOB 0 BLOCKMODE 0xf0 0 20 /end SOURCE
 /begin TP_BLOB 0x0100 /* blob Version */ 0x11 /* ECU address on k line */ 0xF1 /* required tester address */ WuP /* stimulation mode of ECU: WuP */ MSB_FIRST /* byte order in measurements and characteristics */ 1 /* 1: 1st startDiagnosticSession without baudrate switch */ 0x00000 /* Project base address (PBA) */ /*SERAM SERAM_A SERAM_U SERAM_O SERAM_E Flash addr RAM addr Data rd code ver Code read Load mode*/ SERAM 0x60100 0x60100 0x6FAFF 0x6FAFF 0 0 1 0 0 1
  /begin CHECKSUM 0x010201 /* check sum type qualifier (see table) */ 1 /* 1: check sum calculation only on active page */ 1 /* No of local routine for check sum */ RequestRoutineResults /* result of checksum routine delivered by */ RNC_RESULT 0x23 /* only at 'RequestRoutineResults': */ /* result codes, that sign 'calculation in progress' */ /end CHECKSUM
  /begin FLASH_COPY TOOLFLASHBACK /* ECU mode for copying RAM into Flash */ 3 /* No of local routine for copy Flash to RAM */ RequestRoutineResults /* result of copy routine delivered by */ RAM_InitByECU /* ECU mode for copying Flash into RAM */ 0x86 /* diagnostic mode for copy RAM to Flash */ COPY_FRAME 1 /* list of page frames to be copied */ RNC_RESULT 0x23 0xfb 0xfc /* only at 'RequestRoutineResults': */ /* result codes, that sign 'copy in progress' */ /* COPY_PARA */ /* list of add. parameters for local routine */ /end FLASH_COPY
  /*Baudrate switch: BaudRate DiagMode i,k for ECU baudrate*/ /* BAUD_DEF 250000 0x86 0xA7 */ /* BAUD_DEF 125000 0x86 0x87 */ /* BAUD_DEF 111111 0x86 0x84 */ /* BAUD_DEF 55555 0x86 0x64 */ /* BAUD_DEF 10400 0x86 0x14 */ /*Timing parameter: p1Max p2Min p2Max p3Min p3Max p4Min */ /*Timing parameter: p1Max p2Min p2Max p3Min p3Max p4Min */ /* TIME_DEF 1 0 50 0 500 0 */ /* TIME_DEF 2 0 50 0 500 0 */ /* TIME_DEF 5 1 100 1 500 0 */ /* TIME_DEF 10 1 500 2 1000 1 */ TIME_DEF 20 2 25 28 250 0 /end TP_BLOB
/end IF_DATA
/begin IF_DATA EDIC_ISO_DS2 "V1.0" 0x12 25 1 SUPP_SERVICE READMEM SUPP_SERVICE WRITEMEM SUPP_SERVICE ACK TELDATA 0x9E /end IF_DATA
/begin COMPU_METHOD DEFAULT_FORMULA "DEFAULT_FORMULA" RAT_FUNC "%7.0" "" COEFFS 0 1 0 0 0 1 /end COMPU_METHOD
/begin COMPU_METHOD FORMULA_0002 "FORMULA_0002" TAB_VERB "%3.0" "-" COMPU_TAB_REF FORMULA_0002_VTAB /end COMPU_METHOD
/begin COMPU_VTAB FORMULA_0002_VTAB "FORMULA_0002_VTAB" TAB_VERB 4 0 "in Ordnung" 128 "queue full" 64 "queue fehler" 32 "IRQ illegal" DEFAULT_VALUE "undefiniert" /end COMPU_VTAB
/begin COMPU_METHOD FORMULA_0003 "FORMULA_0003" RAT_FUNC "%3.0" "-" COEFFS 0 1 0 0 0 1 /end COMPU_METHOD
/begin COMPU_METHOD FORMULA_0004 "FORMULA_0004" TAB_VERB "%5.2" "-" COMPU_TAB_REF FORMULA_0004_VTAB /end COMPU_METHOD
/begin COMPU_VTAB FORMULA_0004_VTAB "FORMULA_0004_VTAB" TAB_VERB 9 0 "OK" 1 "NR CS0" 2 "NR CS1" 4 "NR CS2" 8 "NR CS3" 16 "CNT CS0" 17 "CNT CS1" 18 "CNT CS2" 20 "CNT CS3" /end COMPU_VTAB
/begin COMPU_METHOD FORMULA_0005 "FORMULA_0005" TAB_VERB "%5.2" "-" COMPU_TAB_REF FORMULA_0005_VTAB /end COMPU_METHOD
/begin COMPU_VTAB FORMULA_0005_VTAB "FORMULA_0005_VTAB" TAB_VERB 7 0 "OK" 1 "Seg-Kanal" 2 "5ms-Kanal" 4 "10ms-Kanal" 8 "100ms-Kanal" 16 "bgnd-Kanal" 32 "kwp-Kanal" DEFAULT_VALUE "ungueltig" /end COMPU_VTAB
/begin COMPU_METHOD FORMULA_0006 "FORMULA_0006" RAT_FUNC "%5.0" "Upm" COEFFS 0 1 0 0 0 1 /end COMPU_METHOD
/begin COMPU_METHOD FORMULA_0008 "FORMULA_0008" RAT_FUNC "%6.1" "V" COEFFS 0 10 0 0 0 1 /end COMPU_METHOD
/begin COMPU_METHOD FORMULA_0010 "FORMULA_0010" RAT_FUNC "%5.0" "-" COEFFS 0 1 0 0 0 1 /end COMPU_METHOD
/begin COMPU_METHOD FORMULA_0011 "FORMULA_0011" TAB_VERB "%5.0" "-" COMPU_TAB_REF FORMULA_0011_VTAB /end COMPU_METHOD
/begin COMPU_VTAB FORMULA_0011_VTAB "FORMULA_0011_VTAB" TAB_VERB 15 0 "kein Fehler" 1 "Egasueberwachung" 2 "Momentenueberwachung" 4 "Einspritzueberwachung" 8 "SMG-Ueberwachung" 16 "Systemfehler" 32 "Stackueberwachung" 64 "Resetanzahl" 128 "Gemischfehler" 256 "Klopfregelung" 512 "CRC-Check" 1024 "Taskueberwachung" 2048 "Prozessueberwachung" 4096 "Pedalwertgeber" 8192 "Mastervac" DEFAULT_VALUE "undef" /end COMPU_VTAB
/begin COMPU_METHOD FORMULA_0012 "FORMULA_0012" TAB_VERB "%3.0" "-" COMPU_TAB_REF FORMULA_0012_VTAB /end COMPU_METHOD
/begin COMPU_VTAB FORMULA_0012_VTAB "FORMULA_0012_VTAB" TAB_VERB 1 0 "iO" DEFAULT_VALUE "Fehler" /end COMPU_VTAB
/begin COMPU_METHOD FORMULA_0013 "FORMULA_0013" TAB_VERB "%3.0" "-" COMPU_TAB_REF FORMULA_0013_VTAB /end COMPU_METHOD
/begin COMPU_VTAB FORMULA_0013_VTAB "FORMULA_0013_VTAB" TAB_VERB 5 0 "CRC iO" 1 "D-Fehler" 2 "P-Fehler" 3 "PD-Fehler" 4 "B-Fehler" DEFAULT_VALUE "Mehrfachfehler" /end COMPU_VTAB
/begin COMPU_METHOD FORMULA_0014 "FORMULA_0014" TAB_VERB "%3.0" "-" COMPU_TAB_REF FORMULA_0014_VTAB /end COMPU_METHOD
/begin COMPU_VTAB FORMULA_0014_VTAB "FORMULA_0014_VTAB" TAB_VERB 5 0 "OK" 3 "ID" 4 "Limit" 11 "Overrun" 14 "Stack" /end COMPU_VTAB
/begin COMPU_METHOD FORMULA_0015 "FORMULA_0015" TAB_VERB "%5.0" "-" COMPU_TAB_REF FORMULA_0015_VTAB /end COMPU_METHOD
/begin COMPU_VTAB FORMULA_0015_VTAB "FORMULA_0015_VTAB" TAB_VERB 6 512 "MCI" 768 "DataAcc" 1024 "IntrAcc" 1536 "Align" 1792 "PrgExc" 8192 "NMI" /end COMPU_VTAB
/begin COMPU_METHOD FORMULA_0016 "FORMULA_0016" TAB_VERB "%3.0" "-" COMPU_TAB_REF FORMULA_0016_VTAB /end COMPU_METHOD
/begin COMPU_VTAB FORMULA_0016_VTAB "FORMULA_0016_VTAB" TAB_VERB 13 0 "ini" 1 "1st edge" 2 "second edge" 3 "wait teeth" 4 "search gap" 5 "1st missing required" 6 "last tooth until gap" 7 "1st missing tooth" 8 "2nd missing tooth" 9 "1st tooth after gap" 10 "2nd tooth after gap" 11 "tooth 2..56, 62..116" 12 "gap required" DEFAULT_VALUE "undefined" /end COMPU_VTAB
/begin COMPU_METHOD FORMULA_0017 "FORMULA_0017" RAT_FUNC "%9.2" "ms" COEFFS 0 7000 0 0 0 1 /end COMPU_METHOD
/begin COMPU_METHOD FORMULA_0018 "FORMULA_0018" RAT_FUNC "%5.0" "us" COEFFS 0 1 0 0 0 1 /end COMPU_METHOD
/begin COMPU_METHOD FORMULA_0019 "FORMULA_0019" TAB_VERB "%7.2" "-" COMPU_TAB_REF FORMULA_0019_VTAB /end COMPU_METHOD
/begin COMPU_VTAB FORMULA_0019_VTAB "FORMULA_0019_VTAB" TAB_VERB 13 1 "Motor steht" 2 "Motor presync" 4 "Start" 8 "LLOKS" 16 "LLMKS" 32 "TL" 64 "VL" 128 "SA" 256 "NL" 512 "Abgew." 1024 "Kl15 aus" 2048 "Wakeup" 4096 "Schub" DEFAULT_VALUE "undefiniert" /end COMPU_VTAB
/begin COMPU_METHOD FORMULA_0021 "FORMULA_0021" RAT_FUNC "%7.2" "s" COEFFS 0 100 0 0 0 1 /end COMPU_METHOD
/* ------------------ Abschnitt erzeugt aus adapt_glob.dat ------------------ */
/begin COMPU_METHOD FORMULA_0023 "FORMULA_0023" RAT_FUNC "%6.1" "�C" COEFFS 0 10 2732 0 0 1 /end COMPU_METHOD
/begin COMPU_METHOD FORMULA_0026 "FORMULA_0026" TAB_VERB "%3.0" "-" COMPU_TAB_REF FORMULA_0026_VTAB /end COMPU_METHOD
/begin COMPU_VTAB FORMULA_0026_VTAB "FORMULA_0026_VTAB" TAB_VERB 4 0 "off" 1 "Fertigungsmode" 2 "Transportmode" 4 "Werkstattmode" DEFAULT_VALUE "off" /end COMPU_VTAB
/begin COMPU_METHOD FORMULA_0027 "FORMULA_0027" RAT_FUNC "%7.0" "km" COEFFS 0 1 0 0 0 1 /end COMPU_METHOD
/begin COMPU_METHOD FORMULA_0028 "FORMULA_0028" TAB_VERB "%3.0" "-" COMPU_TAB_REF FORMULA_0028_VTAB /end COMPU_METHOD
/begin COMPU_VTAB FORMULA_0028_VTAB "FORMULA_0028_VTAB" TAB_VERB 7 0 "kein Land" 1 "ECE" 2 "US" 3 "D" 4 "GB" 5 "J" 255 "ungueltig" /end COMPU_VTAB
/begin COMPU_METHOD FORMULA_0029 "FORMULA_0029" TAB_VERB "%3.0" "-" COMPU_TAB_REF FORMULA_0029_VTAB /end COMPU_METHOD
/begin COMPU_VTAB FORMULA_0029_VTAB "FORMULA_0029_VTAB" TAB_VERB 9 0 "keine Angabe" 4 "E60" 5 "E61" 6 "E63" 7 "E64" 8 "E90" 13 "E91" 14 "E92" 15 "E93" DEFAULT_VALUE "ungueltig" /end COMPU_VTAB
/begin COMPU_METHOD FORMULA_0030 "FORMULA_0030" TAB_VERB "%3.0" "-" COMPU_TAB_REF FORMULA_0030_VTAB /end COMPU_METHOD
/begin COMPU_VTAB FORMULA_0030_VTAB "FORMULA_0030_VTAB" TAB_VERB 3 0 "v_max 250" 1 "reserviert" 2 "v_max angehoben" DEFAULT_VALUE "undef" /end COMPU_VTAB
/begin COMPU_METHOD FORMULA_0031 "FORMULA_0031" TAB_VERB "%3.0" "-" COMPU_TAB_REF FORMULA_0031_VTAB /end COMPU_METHOD
/begin COMPU_VTAB FORMULA_0031_VTAB "FORMULA_0031_VTAB" TAB_VERB 5 0 "HS" 1 "Automat" 2 "Steptronic" 3 "SMG" 15 "ungueltig" /end COMPU_VTAB
/begin COMPU_METHOD FORMULA_0034 "FORMULA_0034" TAB_VERB "%5.2" "-" COMPU_TAB_REF FORMULA_0034_VTAB /end COMPU_METHOD
/begin COMPU_VTAB FORMULA_0034_VTAB "FORMULA_0034_VTAB" TAB_VERB 1 0 "erfuellt" DEFAULT_VALUE "offen" /end COMPU_VTAB
/begin COMPU_METHOD FORMULA_0035 "FORMULA_0035" TAB_VERB "%5.2" "-" COMPU_TAB_REF FORMULA_0035_VTAB /end COMPU_METHOD
/begin COMPU_VTAB FORMULA_0035_VTAB "FORMULA_0035_VTAB" TAB_VERB 1 0 "erfuellt" DEFAULT_VALUE "offen" /end COMPU_VTAB
/begin COMPU_METHOD FORMULA_0036 "FORMULA_0036" TAB_VERB "%5.2" "-" COMPU_TAB_REF FORMULA_0036_VTAB /end COMPU_METHOD
/begin COMPU_VTAB FORMULA_0036_VTAB "FORMULA_0036_VTAB" TAB_VERB 1 0 "erfuellt" DEFAULT_VALUE "offen" /end COMPU_VTAB
/begin COMPU_METHOD FORMULA_0037 "FORMULA_0037" TAB_VERB "%5.2" "-" COMPU_TAB_REF FORMULA_0037_VTAB /end COMPU_METHOD
/begin COMPU_VTAB FORMULA_0037_VTAB "FORMULA_0037_VTAB" TAB_VERB 1 0 "erfuellt" DEFAULT_VALUE "offen" /end COMPU_VTAB
/begin COMPU_METHOD FORMULA_0038 "FORMULA_0038" TAB_VERB "%5.2" "-" COMPU_TAB_REF FORMULA_0038_VTAB /end COMPU_METHOD
/begin COMPU_VTAB FORMULA_0038_VTAB "FORMULA_0038_VTAB" TAB_VERB 1 0 "erfuellt" DEFAULT_VALUE "offen" /end COMPU_VTAB
/* ------------------ Abschnitt erzeugt aus crc32.dat ------------------ */
/begin COMPU_METHOD FORMULA_0039 "FORMULA_0039" TAB_VERB "%3.0" "-" COMPU_TAB_REF FORMULA_0039_VTAB /end COMPU_METHOD
/begin COMPU_VTAB FORMULA_0039_VTAB "FORMULA_0039_VTAB" TAB_VERB 4 0 "CRC iO" 1 "Daten falsch" 2 "Prog falsch" 4 "Booter falsch" DEFAULT_VALUE "Mehrfachfehler" /end COMPU_VTAB
/begin COMPU_METHOD FORMULA_0040 "FORMULA_0040" TAB_VERB "%3.0" "-" COMPU_TAB_REF FORMULA_0040_VTAB /end COMPU_METHOD
/begin COMPU_VTAB FORMULA_0040_VTAB "FORMULA_0040_VTAB" TAB_VERB 4 0 "Inaktiv" 1 "Start" 2 "Aktiv" 3 "Ende" DEFAULT_VALUE "undef" /end COMPU_VTAB
/* ------------------ Abschnitt erzeugt aus debug.dat ------------------ */
/begin COMPU_METHOD FORMULA_0041 "FORMULA_0041" RAT_FUNC "%9.2" "-" COEFFS 0 1 0 0 0 1 /end COMPU_METHOD
/* ------------------ Abschnitt erzeugt aus ed_glob.dat ------------------ */
/begin COMPU_METHOD FORMULA_0042 "FORMULA_0042" TAB_VERB "%5.2" "-" COMPU_TAB_REF FORMULA_0042_VTAB /end COMPU_METHOD
/begin COMPU_VTAB FORMULA_0042_VTAB "FORMULA_0042_VTAB" TAB_VERB 1 0 "kein WUC" DEFAULT_VALUE "Warmcycle" /end COMPU_VTAB
/begin COMPU_METHOD FORMULA_0043 "FORMULA_0043" TAB_VERB "%5.2" "-" COMPU_TAB_REF FORMULA_0043_VTAB /end COMPU_METHOD
/begin COMPU_VTAB FORMULA_0043_VTAB "FORMULA_0043_VTAB" TAB_VERB 1 0 "Kein Cycle" DEFAULT_VALUE "Rate-Based-DCY" /end COMPU_VTAB
/begin COMPU_METHOD FORMULA_0044 "FORMULA_0044" TAB_VERB "%5.2" "-" COMPU_TAB_REF FORMULA_0044_VTAB /end COMPU_METHOD
/begin COMPU_VTAB FORMULA_0044_VTAB "FORMULA_0044_VTAB" TAB_VERB 1 0 "Kein RBM-EVAP" DEFAULT_VALUE "RBM-EVAP" /end COMPU_VTAB
/begin COMPU_METHOD FORMULA_0045 "FORMULA_0045" TAB_VERB "%5.2" "-" COMPU_TAB_REF FORMULA_0045_VTAB /end COMPU_METHOD
/begin COMPU_VTAB FORMULA_0045_VTAB "FORMULA_0045_VTAB" TAB_VERB 1 0 "Kein RBM-SLP" DEFAULT_VALUE "RBM-SLP" /end COMPU_VTAB
/begin COMPU_METHOD FORMULA_0046 "FORMULA_0046" TAB_VERB "%5.2" "-" COMPU_TAB_REF FORMULA_0046_VTAB /end COMPU_METHOD
/begin COMPU_VTAB FORMULA_0046_VTAB "FORMULA_0046_VTAB" TAB_VERB 1 0 "Kein Abbruch" DEFAULT_VALUE "Abbruch" /end COMPU_VTAB
/begin COMPU_METHOD FORMULA_0047 "FORMULA_0047" TAB_VERB "%5.2" "-" COMPU_TAB_REF FORMULA_0047_VTAB /end COMPU_METHOD
/begin COMPU_VTAB FORMULA_0047_VTAB "FORMULA_0047_VTAB" TAB_VERB 1 0 "Kein CSS-DEN" DEFAULT_VALUE "CSS-DEN" /end COMPU_VTAB
/begin COMPU_METHOD FORMULA_0048 "FORMULA_0048" TAB_VERB "%5.2" "-" COMPU_TAB_REF FORMULA_0048_VTAB /end COMPU_METHOD
/begin COMPU_VTAB FORMULA_0048_VTAB "FORMULA_0048_VTAB" TAB_VERB 1 0 "Kein CSS-NUM" DEFAULT_VALUE "CSS-NUM" /end COMPU_VTAB
/begin COMPU_METHOD FORMULA_0049 "FORMULA_0049" TAB_VERB "%7.2" "-" COMPU_TAB_REF FORMULA_0049_VTAB /end COMPU_METHOD
/begin COMPU_VTAB FORMULA_0049_VTAB "FORMULA_0049_VTAB" TAB_VERB 44 0 "O.K." 1 "SH_TO_UB" 2 "SH_TO_GND" 4 "OPENLOAD" 8 "UNPLAUSI" 256 "O.K./ZYKLUS" 512 "FILTER" 513 "FIL/SH_TO_UB" 514 "FIL/SH_TO_GND" 516 "FIL/OPENLOAD" 520 "FIL/UNPLAUSI" 576 "VORHANDEN" 577 "VORH/SH_TO_UB" 578 "VORH/SH_TO_GND" 580 "VORH/OPENLOAD" 584 "VORH/UNPLAUSI" 768 "FILTER/ZYKLUS" 769 "FIL/ZYK/SH_TO_UB" 770 "FIL/ZYK/SH_TO_GND" 772 "FIL/ZYK/OPENLOAD" 776 "FIL/ZYK/UNPLAUSI" 832 "VORHANDEN/ZYKLUS" 833 "VORH/ZYK/SH_TO_UB" 834 "VORH/ZYK/SH_TO_GND" 836 "VORH/ZYK/OPENLOAD" 840 "VORH/ZYK/UNPLAUSI" 2048 "O.K./SCDN" 2304 "O.K./S/ZYKLUS" 2561 "FIL/S/SH_TO_UB" 2562 "FIL/S/SH_TO_GND" 2564 "FIL/S/OPENLOAD" 2568 "FIL/S/UNPLAUSI" 2625 "VORH/S/SH_TO_UB" 2626 "VORH/S/SH_TO_GND" 2628 "VORH/S/OPENLOAD" 2632 "VORH/S/UNPLAUSI" 2817 "FIL/ZYK/S/SH_TO_UB" 2818 "FIL/ZYK/S/SH_TO_GND" 2820 "FIL/ZYK/S/OPENLOAD" 2824 "FIL/ZYK/S/UNPLAUSI" 2881 "VORH/ZYK/S/SH_TO_UB" 2882 "VORH/ZYK/S/SH_TO_GND" 2884 "VORH/ZYK/S/OPENLOAD" 2888 "VORH/ZYK/S/UNPLAUSI" /end COMPU_VTAB
/begin COMPU_METHOD FORMULA_0050 "FORMULA_0050" TAB_VERB "%5.0" "-" COMPU_TAB_REF FORMULA_0050_VTAB /end COMPU_METHOD
/begin COMPU_VTAB FORMULA_0050_VTAB "FORMULA_0050_VTAB" TAB_VERB 352 10000 "SK_INJ_TESTFEHLER" 10001 "PUMG_FEHLER" 10002 "HFM1_FEHLER" 10003 "HFM2_FEHLER" 10004 "PSAU1_FEHLER" 10005 "PSAU2_FEHLER" 10006 "VAN_HALL_E1_FEHLER" 10007 "VAN_HALL_A1_FEHLER" 10008 "VAN_HALL_E2_FEHLER" 10009 "VAN_HALL_A2_FEHLER" 10010 "VAN_REGL_E1_FEHLER" 10011 "VAN_REGL_A1_FEHLER" 10012 "VAN_REGL_E2_FEHLER" 10013 "VAN_REGL_A2_FEHLER" 10014 "NW1_SYNC_FEHLER" 10015 "NW2_SYNC_FEHLER" 10016 "PCTRL_IGN_FEHLER" 10017 "PT_TORQDKG_FEHLER" 10018 "PKS_FEHLER" 10019 "PT_STATUSR_FEHLER" 10020 "LAVK1_FEHLER" 10021 "LAVK2_FEHLER" 10022 "LAVK1_OBD_PLAU_FEHLER" 10023 "LAVK2_OBD_PLAU_FEHLER" 10024 "LAVK1_OBD_SA_FEHLER" 10025 "LAVK2_OBD_SA_FEHLER" 10026 "LANK1_FEHLER" 10027 "LANK2_FEHLER" 10028 "LSHNK1_FEHLER" 10029 "LSHNK2_FEHLER" 52615 "PT_BUSOFF" 52632 "PT_TORQDSC_FEHLER" 52645 "PT_STDSC_FEHLER" 52667 "PT_VRAD_FEHLER" 52636 "PT_VFZG_FEHLER" 52628 "PT_ATEMP_FEHLER" 52640 "PT_KLST_FEHLER" 52649 "PT_KKOS_FEHLER" 52641 "PT_LRW_FEHLER" 10039 "FPLAU1_FEHLER" 10040 "FPLAU2_FEHLER" 10041 "SL_ML_HFM_FEHLER" 10042 "LANK1_OBD_S_FEHLER" 10043 "LANK2_OBD_S_FEHLER" 10044 "LAVK1_OBD_TL_FEHLER" 10045 "LAVK2_OBD_TL_FEHLER" 10046 "LSHVK1_FEHLER" 10047 "LSHVK2_FEHLER" 10048 "LSRVK1_OBD_REG_FEHLER" 10049 "LSRVK2_OBD_REG_FEHLER" 10050 "LSHVK1_R_FEHLER" 10051 "LSHVK2_R_FEHLER" 10052 "LSRVK1_OBD_START_FEHLER" 10053 "LSRVK2_OBD_START_FEHLER" 10054 "LSRVK1_OBD_REF_FEHLER" 10055 "LSRVK2_OBD_REF_FEHLER" 10056 "LAVK1_DIAG_FEHLER" 10057 "LAVK2_DIAG_FEHLER" 10058 "LAVK1_IA_OPENLOAD_FEHLER" 10059 "LAVK2_IA_OPENLOAD_FEHLER" 10060 "PT_GRB_FEHLER" 10061 "PT_GRB2_FEHLER" 10062 "LAVK1_UN_OPENLOAD_FEHLER" 10063 "LAVK2_UN_OPENLOAD_FEHLER" 10064 "LAVK1_IP_OPENLOAD_FEHLER" 10065 "LAVK2_IP_OPENLOAD_FEHLER" 10066 "APPL_DATA_INJ" 10067 "TZ1_FEHLER" 10068 "TZ2_FEHLER" 10069 "TZ3_FEHLER" 10070 "TZ4_FEHLER" 10071 "TZ5_FEHLER" 10072 "TZ6_FEHLER" 10073 "TZ7_FEHLER" 10074 "TZ8_FEHLER" 10075 "TZ9_FEHLER" 10076 "TZ10_FEHLER" 10077 "LAM1_REG_FEHLER" 10078 "LAM2_REG_FEHLER" 10079 "VAN_ANSCHL_E1_FEHLER" 10080 "VAN_ANSCHL_A1_FEHLER" 10081 "VAN_ANSCHL_E2_FEHLER" 10082 "VAN_ANSCHL_A2_FEHLER" 10083 "VAN_VENT_E1_FEHLER" 10084 "VAN_VENT_A1_FEHLER" 10085 "VAN_VENT_E2_FEHLER" 10086 "VAN_VENT_A2_FEHLER" 10087 "EV1_FEHLER" 10088 "EV2_FEHLER" 10089 "EV3_FEHLER" 10090 "EV4_FEHLER" 10091 "EV5_FEHLER" 10092 "EV6_FEHLER" 10093 "EV7_FEHLER" 10094 "EV8_FEHLER" 10095 "EV9_FEHLER" 10096 "EV10_FEHLER" 10097 "LAVK1_OBD_DYN_FEHLER" 10098 "LAVK2_OBD_DYN_FEHLER" 52650 "PT_CRASH_FEHLER" 52635 "PT_VEHMOD_FEHLER" 52629 "PT_BEDFGR_FEHLER" 10102 "DMTL_P_FEHLER" 10103 "DMTL_V_FEHLER" 10104 "DMTL_H_FEHLER" 10105 "DMTL_GROBLECK_FEHLER" 10106 "DMTL_FEUCHT_FEHLER" 10107 "DMTL_DECKEL_MELDUNG" 10108 "LA1_TRIM_FEHLER" 10109 "LA2_TRIM_FEHLER" 10110 "RLU87_FEHLER" 10111 "EKP_PWM_FEHLER" 10112 "SSP_FEHLER" 10113 "TD_FEHLER" 10114 "RLSLP_FEHLER" 10115 "SLV_FEHLER" 52639 "PT_KMST_FEHLER" 52648 "PT_STATKOM_FEHLER" 10118 "PKS_LL_FEHLER" 10119 "PKS_TL_FEHLER" 10120 "PKS_Q_FEHLER" 10121 "KAT_OBD1_FEHLER" 10122 "KAT_OBD2_FEHLER" 10123 "VAN_DSV_FEHLER" 10124 "FI_GEN" 10125 "FI_BSD" 10126 "FI_QLT" 10127 "FI_IBS1" 10128 "FI_IBS2" 10129 "FI_IBS3" 10130 "FI_PMBN" 10131 "FI_PMBATT" 10132 "MVAC_DRUCKSENSOR" 52668 "PT_BEDAT_FEHLER" 10134 "SK_MANAGER_INJ" 10135 "SSP_DIAG_FEHLER" 10136 "EWS_SCI_FEHLER" 10137 "EWS_MAN_FEHLER" 10138 "FI_BSD_0" 10139 "FI_BSD_6" 10140 "FI_BSDGLOB" 10141 "FI_PMRUHVERL" 10142 "FI_TOENS" 10143 "EBOX_ELU_FEHLER" 10144 "SG_INJ_FEHLER" 10145 "EGAS_ENLTG1_DIAG" 10146 "EGAS_ENLTG2_DIAG" 10147 "S_POEL_FEHLER" 10148 "TEV1_OBD_FEHLER" 10149 "TEV2_OBD_FEHLER" 10150 "TEV1_FEHLER" 10151 "TEV2_FEHLER" 10152 "EBENE2_INJ_FEHLER" 10153 "KW_FEHLER" 10154 "LA1_ADAPT_FEHLER" 10155 "LA2_ADAPT_FEHLER" 10156 "KGE1_FEHLER" 10157 "KGE2_FEHLER" 10158 "FST_FEHLER" 10159 "SLP_FEHLER" 10160 "SL_DURCHS_B1" 10161 "SL_DURCHS_B2" 10162 "SL_DURCHS_HSTRANG" 10163 "FETRAWE_FEHLER" 10164 "S_GETR_HS_FEHLER" 10165 "S_KUPP_HS_FEHLER" 10166 "VAN_DRUCK_FEHLER" 10167 "ELUP_FEHLER" 10168 "ELU_FEHLER" 52655 "PT_STATANH_FEHLER" 10170 "KSD1_FEHLER" 10171 "KSD2_FEHLER" 10172 "KATS1_FEHLER" 10173 "KATS2_FEHLER" 10174 "PT_STATGRB_FEHLER" 10175 "PT_ANFRADMOM_FEHLER" 10176 "FST_GEBER_FEHLER" 10177 "TANK_LEER_INFO" 10178 "PT_TOMA_FEHLER" 10179 "DMTL_FEINLECK_FEHLER" 10180 "PUMG_OBD_FEHLER" 10181 "SL_ML_HFM_OBD_FEHLER" 10182 "LA1_TRIM_AD_FEHLER" 10183 "LA2_TRIM_AD_FEHLER" 10184 "LANK1_OPENLOAD_FEHLER" 10185 "LANK2_OPENLOAD_FEHLER" 10186 "LANK1_OBD_WE_FEHLER" 10187 "LANK2_OBD_WE_FEHLER" 10188 "LSHNK1_R_FEHLER" 10189 "LSHNK2_R_FEHLER" 10190 "PKS_MODELL_FEHLER" 10191 "PKS_PAUFBAU_FEHLER" 10192 "PKSR_ADAPT_ANSCHL_FEHLER" 10193 "TGETR_FEHLER" 10194 "LAVK_ATIC42_FEHLER" 10195 "PT_ALAENGS_FEHLER" 10196 "PT_OBD_ED_FEHLER" 10197 "FST_GEBER_LI_FEHLER" 10198 "FST_GEBER_RE_FEHLER" 10199 "LANK1_OBD_SLOPE_FEHLER" 10200 "LANK2_OBD_SLOPE_FEHLER" 10201 "MVAC_OBD_FEHLER" 10202 "ELUP_OBD_FEHLER" 10203 "LAVK2_ATIC42_FEHLER" 10204 "INDEX_204_INJ" 10205 "INDEX_205_INJ" 10206 "INDEX_206_INJ" 10207 "INDEX_207_INJ" 10208 "INDEX_208_INJ" 10209 "INDEX_209_INJ" 10210 "INDEX_210_INJ" 10211 "INDEX_211_INJ" 10212 "INDEX_212_INJ" 10213 "INDEX_213_INJ" 10214 "INDEX_214_INJ" 10215 "INDEX_215_INJ" 10216 "INDEX_216_INJ" 10217 "INDEX_217_INJ" 10218 "INDEX_218_INJ" 10219 "INDEX_219_INJ" 10220 "INDEX_220_INJ" 10221 "INDEX_221_INJ" 10222 "INDEX_222_INJ" 10223 "INDEX_223_INJ" 11000 "SK_IGN_TESTFEHLER" 11001 "TMOT_FEHLER" 11002 "TMOT_OBD_FEHLER" 11003 "TAN1_FEHLER" 11004 "TAN2_FEHLER" 11005 "TIME_REL_OBD_FEHLER" 11006 "UB_FEHLER" 11007 "TKA_FEHLER" 11008 "TDME_FEHLER" 11009 "UEXT_111_219_514_FEHLER" 11010 "UEXT_124_512_FEHLER" 11011 "APPL_DATA_IGN" 11012 "TKA_OBD_FEHLER" 11013 "PWG1_FEHLER" 11014 "PWG2_FEHLER" 11015 "PWG_VGL_FEHLER" 11016 "PCTRL_INJ_FEHLER" 52669 "EC_LLS1_FEHLER" 52670 "EC_LLS2_FEHLER" 52671 "EC_DK1_FEHLER" 52672 "EC_DK2_FEHLER" 11021 "LLS1_SK_FEHLER" 11022 "LLS2_SK_FEHLER" 11023 "SMG_SCHALTABLAUF" 11024 "SMG_SK_FEHLER" 11025 "SMG_SK_N_UEBERWACHUNG" 11026 "TUMG_OBD_FEHLER" 11027 "V_FEHLER" 11028 "DK_INIT_FEHLER" 11029 "DK1_REG_FEHLER" 11030 "DK2_REG_FEHLER" 11031 "DK1_ADAPT_FEHLER" 11032 "DK2_ADAPT_FEHLER" 11033 "IONVERST_B1" 11034 "IONSPG_B1" 11035 "IONVERST_B2" 11036 "IONSPG_B2" 11037 "TABG1_FEHLER" 11038 "TABG2_FEHLER" 11039 "DK1_WDK_FEHLER" 11040 "DK2_WDK_FEHLER" 11041 "DK1_PDR_FEHLER" 11042 "DK2_PDR_FEHLER" 11043 "LLS1_REG_FEHLER" 11044 "LLS2_REG_FEHLER" 11045 "DK1_SK_FEHLER" 11046 "DK2_SK_FEHLER" 11047 "DK1_FT_FEHLER" 11048 "DK2_FT_FEHLER" 11049 "MD_SK_ERR" 11050 "LLS_INIT_FEHLER" 11051 "DSC_EINGR_FEHLER" 11052 "DK1_CMD_FEHLER" 11053 "DK2_CMD_FEHLER" 11054 "LLS1_CMD_FEHLER" 11055 "LLS2_CMD_FEHLER" 52673 "SC_SMG1_FEHLER" 52674 "SC_SMG2_FEHLER" 52675 "SC_SMG3_FEHLER" 52619 "SC_BUSOFF_FEHLER" 52627 "EC_BUSOFF_FEHLER" 11061 "AUSS_KAT_Z1_FEHLER" 11062 "AUSS_KAT_Z2_FEHLER" 11063 "AUSS_KAT_Z3_FEHLER" 11064 "AUSS_KAT_Z4_FEHLER" 11065 "AUSS_KAT_Z5_FEHLER" 11066 "AUSS_KAT_Z6_FEHLER" 11067 "AUSS_KAT_Z7_FEHLER" 11068 "AUSS_KAT_Z8_FEHLER" 11069 "AUSS_KAT_Z9_FEHLER" 11070 "AUSS_KAT_Z10_FEHLER" 11071 "ION_SIG_BANK_1" 11072 "ION_SIG_BANK_2" 11073 "AUSS_KAT_MULT_FEHLER" 11074 "AUSS_ABG_Z1_FEHLER" 11075 "AUSS_ABG_Z2_FEHLER" 11076 "AUSS_ABG_Z3_FEHLER" 11077 "AUSS_ABG_Z4_FEHLER" 11078 "AUSS_ABG_Z5_FEHLER" 11079 "AUSS_ABG_Z6_FEHLER" 11080 "AUSS_ABG_Z7_FEHLER" 11081 "AUSS_ABG_Z8_FEHLER" 11082 "AUSS_ABG_Z9_FEHLER" 11083 "AUSS_ABG_Z10_FEHLER" 11084 "ION_SAT_BANK_1" 11085 "ION_SAT_BANK_2" 11086 "AUSS_ABG_MULT_FEHLER" 11087 "TAN_OBD_B1_FEHLER" 11088 "DKG_EINGR_FEHLER" 11089 "SC_PKS_FEHLER" 11090 "ZOELP1_FEHLER" 11091 "ZOELP2_FEHLER" 11092 "SG_IGN_FEHLER" 11093 "EBENE2_IGN_FEHLER" 11094 "BLS_PLAU_FEHLER" 11095 "SK_MANAGER_IGN" 11096 "LLR_DIAGNOSE" 11097 "THERMOSTAT_FEHLER" 11098 "TAN_OBD_B2_FEHLER" 11099 "DK1_ZUSTAND" 11100 "DK2_ZUSTAND" 11101 "FGR_ABWURF" 11102 "PWG_BLS_FEHLER" 11103 "START_RL_FEHLER" 11104 "AFZ_FEHLER" 11105 "N_GETR_EIN_HS_FEHLER" 11106 "TUMG_FEHLER" 11107 "LLR_DIAGNOSE_CSS" 11108 "TMOT_HIGH_FEHLER" 11109 "AFZ_NA_FEHLER" 11110 "INDEX_110_IGN" 11111 "INDEX_111_IGN" 11112 "INDEX_112_IGN" 11113 "INDEX_113_IGN" 11114 "INDEX_114_IGN" 11115 "INDEX_115_IGN" 11116 "INDEX_116_IGN" 11117 "INDEX_117_IGN" 11118 "INDEX_118_IGN" 11119 "INDEX_119_IGN" 11120 "INDEX_120_IGN" 11121 "INDEX_121_IGN" 11122 "INDEX_122_IGN" 11123 "INDEX_123_IGN" 11124 "INDEX_124_IGN" 11125 "INDEX_125_IGN" 11126 "INDEX_126_IGN" 11127 "INDEX_127_IGN" /end COMPU_VTAB
/begin COMPU_METHOD FORMULA_0051 "FORMULA_0051" RAT_FUNC "%5.0" "km" COEFFS 0 1 0 0 0 8 /end COMPU_METHOD
/begin COMPU_METHOD FORMULA_0052 "FORMULA_0052" RAT_FUNC "%5.0" "-" COEFFS 0 4 0 0 0 1 /end COMPU_METHOD
/begin COMPU_METHOD FORMULA_0053 "FORMULA_0053" RAT_FUNC "%7.2" "g/s" COEFFS 0 100 0 0 0 1 /end COMPU_METHOD
/begin COMPU_METHOD FORMULA_0054 "FORMULA_0054" TAB_VERB "%3.0" "-" COMPU_TAB_REF FORMULA_0054_VTAB /end COMPU_METHOD
/begin COMPU_VTAB FORMULA_0054_VTAB "FORMULA_0054_VTAB" TAB_VERB 4 1 "Regler noch aus" 2 "Regler aktiv" 4 "Schubabschalten" 8 "Sonde defekt" /end COMPU_VTAB
/begin COMPU_METHOD FORMULA_0055 "FORMULA_0055" RAT_FUNC "%7.4" "-" COEFFS 0 128 0 0 0 1 /end COMPU_METHOD
/begin COMPU_METHOD FORMULA_0056 "FORMULA_0056" RAT_FUNC "%7.4" "%" COEFFS 0 255 0 0 0 100 /end COMPU_METHOD
/begin COMPU_METHOD FORMULA_0057 "FORMULA_0057" RAT_FUNC "%3.0" "�C" COEFFS 0 1 40 0 0 1 /end COMPU_METHOD
/begin COMPU_METHOD FORMULA_0058 "FORMULA_0058" RAT_FUNC "%3.0" "kPa" COEFFS 0 1 0 0 0 3 /end COMPU_METHOD
/begin COMPU_METHOD FORMULA_0059 "FORMULA_0059" RAT_FUNC "%3.0" "km/h" COEFFS 0 1 0 0 0 1 /end COMPU_METHOD
/begin COMPU_METHOD FORMULA_0060 "FORMULA_0060" RAT_FUNC "%4.1" "�KW" COEFFS 0 2 128 0 0 1 /end COMPU_METHOD
/begin COMPU_METHOD FORMULA_0061 "FORMULA_0061" TAB_VERB "%3.0" "-" COMPU_TAB_REF FORMULA_0061_VTAB /end COMPU_METHOD
/begin COMPU_VTAB FORMULA_0061_VTAB "FORMULA_0061_VTAB" TAB_VERB 2 1 "Einblasung" 4 "Keine Einblasung" /end COMPU_VTAB
/begin COMPU_METHOD FORMULA_0062 "FORMULA_0062" RAT_FUNC "%5.0" "s" COEFFS 0 1 0 0 0 1 /end COMPU_METHOD
/begin COMPU_METHOD FORMULA_0063 "FORMULA_0063" RAT_FUNC "%8.3" "V" COEFFS 0 1000 0 0 0 1 /end COMPU_METHOD
/begin COMPU_METHOD FORMULA_0064 "FORMULA_0064" RAT_FUNC "%9.4" "%" COEFFS 0 255 0 0 0 1 /end COMPU_METHOD
/begin COMPU_METHOD FORMULA_0065 "FORMULA_0065" RAT_FUNC "%5.2" "%" COEFFS 0 255 0 0 0 100 /end COMPU_METHOD
/begin COMPU_METHOD FORMULA_0066 "FORMULA_0066" RAT_FUNC "%3.0" "kPa" COEFFS 0 1 0 0 0 1 /end COMPU_METHOD
/begin COMPU_METHOD FORMULA_0067 "FORMULA_0067" TAB_VERB "%5.2" "-" COMPU_TAB_REF FORMULA_0067_VTAB /end COMPU_METHOD
/begin COMPU_VTAB FORMULA_0067_VTAB "FORMULA_0067_VTAB" TAB_VERB 1 0 "MIL aus" DEFAULT_VALUE "MIL an" /end COMPU_VTAB
/begin COMPU_METHOD FORMULA_0068 "FORMULA_0068" TAB_VERB "%5.2" "-" COMPU_TAB_REF FORMULA_0068_VTAB /end COMPU_METHOD
/begin COMPU_VTAB FORMULA_0068_VTAB "FORMULA_0068_VTAB" TAB_VERB 1 0 "PRE-MIL aus" DEFAULT_VALUE "PRE-MIL an" /end COMPU_VTAB
/begin COMPU_METHOD FORMULA_0069 "FORMULA_0069" TAB_VERB "%5.2" "-" COMPU_TAB_REF FORMULA_0069_VTAB /end COMPU_METHOD
/begin COMPU_VTAB FORMULA_0069_VTAB "FORMULA_0069_VTAB" TAB_VERB 1 0 "DME-MIL aus" DEFAULT_VALUE "DME-MIL an" /end COMPU_VTAB
/begin COMPU_METHOD FORMULA_0070 "FORMULA_0070" TAB_VERB "%5.2" "-" COMPU_TAB_REF FORMULA_0070_VTAB /end COMPU_METHOD
/begin COMPU_VTAB FORMULA_0070_VTAB "FORMULA_0070_VTAB" TAB_VERB 1 0 "ZYL_OFF-MIL aus" DEFAULT_VALUE "ZYL_OFF-MIL an" /end COMPU_VTAB
/begin COMPU_METHOD FORMULA_0071 "FORMULA_0071" TAB_VERB "%5.2" "-" COMPU_TAB_REF FORMULA_0071_VTAB /end COMPU_METHOD
/begin COMPU_VTAB FORMULA_0071_VTAB "FORMULA_0071_VTAB" TAB_VERB 1 0 "SMG-MIL aus" DEFAULT_VALUE "SMG-MIL an" /end COMPU_VTAB
/begin COMPU_METHOD FORMULA_0072 "FORMULA_0072" TAB_VERB "%3.0" "-" COMPU_TAB_REF FORMULA_0072_VTAB /end COMPU_METHOD
/begin COMPU_VTAB FORMULA_0072_VTAB "FORMULA_0072_VTAB" TAB_VERB 1 165 "fsp_loeschen" DEFAULT_VALUE "fsp_sichern" /end COMPU_VTAB
/begin COMPU_METHOD FORMULA_0073 "FORMULA_0073" RAT_FUNC "%6.1" "s" COEFFS 0 10 0 0 0 1 /end COMPU_METHOD
/begin COMPU_METHOD FORMULA_0074 "FORMULA_0074" RAT_FUNC "%7.0" "us" COEFFS 0 1 0 0 0 1 /end COMPU_METHOD
/begin COMPU_METHOD FORMULA_0076 "FORMULA_0076" RAT_FUNC "%6.1" "Kelvin" COEFFS 0 10 0 0 0 1 /end COMPU_METHOD
/begin COMPU_METHOD FORMULA_0077 "FORMULA_0077" RAT_FUNC "%6.1" "mbar" COEFFS 0 16 0 0 0 1 /end COMPU_METHOD
/begin COMPU_METHOD FORMULA_0078 "FORMULA_0078" RAT_FUNC "%6.1" "km/h" COEFFS 0 16 0 0 0 1 /end COMPU_METHOD
/* ------------------ Abschnitt erzeugt aus eeprom.dat ------------------ */
/begin COMPU_METHOD FORMULA_0080 "FORMULA_0080" TAB_VERB "%3.0" "Seite" COMPU_TAB_REF FORMULA_0080_VTAB /end COMPU_METHOD
/begin COMPU_VTAB FORMULA_0080_VTAB "FORMULA_0080_VTAB" TAB_VERB 1 128 "Keine Daten)" /end COMPU_VTAB
/begin COMPU_METHOD FORMULA_0081 "FORMULA_0081" TAB_VERB "%3.0" "Seite" COMPU_TAB_REF FORMULA_0081_VTAB /end COMPU_METHOD
/begin COMPU_VTAB FORMULA_0081_VTAB "FORMULA_0081_VTAB" TAB_VERB 2 64 "Sektoren voll->A" 72 "Sektoren voll->B" /end COMPU_VTAB
/begin COMPU_METHOD FORMULA_0082 "FORMULA_0082" TAB_VERB "%3.0" "-" COMPU_TAB_REF FORMULA_0082_VTAB /end COMPU_METHOD
/begin COMPU_VTAB FORMULA_0082_VTAB "FORMULA_0082_VTAB" TAB_VERB 9 0 "Daten o.k." 1 "CRC Stand falsch" 2 "Andere Erstellung" 4 "Andere Version" 8 "Wichtig groesser" 16 "Wichtig kleiner" 32 "Wichtig CRC falsch" 64 "Wichtig Laenge nio" 128 "keine Daten" /end COMPU_VTAB
/begin COMPU_METHOD FORMULA_0084 "FORMULA_0084" TAB_VERB "%7.2" "-" COMPU_TAB_REF FORMULA_0084_VTAB /end COMPU_METHOD
/begin COMPU_VTAB FORMULA_0084_VTAB "FORMULA_0084_VTAB" TAB_VERB 3 1 "Regler-RESET" 2 "Regler aktiv" 4 "Regler inaktiv" /end COMPU_VTAB
/begin COMPU_METHOD FORMULA_0085 "FORMULA_0085" TAB_VERB "%7.2" "-" COMPU_TAB_REF FORMULA_0085_VTAB /end COMPU_METHOD
/begin COMPU_VTAB FORMULA_0085_VTAB "FORMULA_0085_VTAB" TAB_VERB 2 0 "nicht einger." 1 "einger." /end COMPU_VTAB
/begin COMPU_METHOD FORMULA_0086 "FORMULA_0086" TAB_VERB "%7.2" "-" COMPU_TAB_REF FORMULA_0086_VTAB /end COMPU_METHOD
/begin COMPU_VTAB FORMULA_0086_VTAB "FORMULA_0086_VTAB" TAB_VERB 2 0 "inaktiv" 1 "aktiv" /end COMPU_VTAB
/begin COMPU_METHOD FORMULA_0087 "FORMULA_0087" TAB_VERB "%7.2" "-" COMPU_TAB_REF FORMULA_0087_VTAB /end COMPU_METHOD
/begin COMPU_VTAB FORMULA_0087_VTAB "FORMULA_0087_VTAB" TAB_VERB 2 0 "i.O." 1 "ti_min" /end COMPU_VTAB
/begin COMPU_METHOD FORMULA_0088 "FORMULA_0088" TAB_VERB "%7.2" "-" COMPU_TAB_REF FORMULA_0088_VTAB /end COMPU_METHOD
/begin COMPU_VTAB FORMULA_0088_VTAB "FORMULA_0088_VTAB" TAB_VERB 2 0 "i.O." 1 "MIN" /end COMPU_VTAB
/begin COMPU_METHOD FORMULA_0089 "FORMULA_0089" TAB_VERB "%7.2" "-" COMPU_TAB_REF FORMULA_0089_VTAB /end COMPU_METHOD
/begin COMPU_VTAB FORMULA_0089_VTAB "FORMULA_0089_VTAB" TAB_VERB 2 0 "i.O." 1 "MAX" /end COMPU_VTAB
/begin COMPU_METHOD FORMULA_0090 "FORMULA_0090" TAB_VERB "%7.2" "-" COMPU_TAB_REF FORMULA_0090_VTAB /end COMPU_METHOD
/begin COMPU_VTAB FORMULA_0090_VTAB "FORMULA_0090_VTAB" TAB_VERB 2 0 "-" 1 "SA-Verz." /end COMPU_VTAB
/begin COMPU_METHOD FORMULA_0091 "FORMULA_0091" TAB_VERB "%7.2" "-" COMPU_TAB_REF FORMULA_0091_VTAB /end COMPU_METHOD
/begin COMPU_VTAB FORMULA_0091_VTAB "FORMULA_0091_VTAB" TAB_VERB 2 0 "-" 1 "SLP-Verz." /end COMPU_VTAB
/begin COMPU_METHOD FORMULA_0092 "FORMULA_0092" TAB_VERB "%7.2" "-" COMPU_TAB_REF FORMULA_0092_VTAB /end COMPU_METHOD
/begin COMPU_VTAB FORMULA_0092_VTAB "FORMULA_0092_VTAB" TAB_VERB 2 0 "nicht einger." 1 "einger." /end COMPU_VTAB
/begin COMPU_METHOD FORMULA_0094 "FORMULA_0094" TAB_VERB "%7.2" "-" COMPU_TAB_REF FORMULA_0094_VTAB /end COMPU_METHOD
/begin COMPU_VTAB FORMULA_0094_VTAB "FORMULA_0094_VTAB" TAB_VERB 2 0 "inaktiv" 1 "aktiv" /end COMPU_VTAB
/begin COMPU_METHOD FORMULA_0095 "FORMULA_0095" TAB_VERB "%7.2" "-" COMPU_TAB_REF FORMULA_0095_VTAB /end COMPU_METHOD
/begin COMPU_VTAB FORMULA_0095_VTAB "FORMULA_0095_VTAB" TAB_VERB 2 0 "inaktiv" 1 "aktiv" /end COMPU_VTAB
/begin COMPU_METHOD FORMULA_0096 "FORMULA_0096" TAB_VERB "%7.2" "-" COMPU_TAB_REF FORMULA_0096_VTAB /end COMPU_METHOD
/begin COMPU_VTAB FORMULA_0096_VTAB "FORMULA_0096_VTAB" TAB_VERB 2 0 "inaktiv" 1 "aktiv" /end COMPU_VTAB
/begin COMPU_METHOD FORMULA_0097 "FORMULA_0097" TAB_VERB "%7.2" "-" COMPU_TAB_REF FORMULA_0097_VTAB /end COMPU_METHOD
/begin COMPU_VTAB FORMULA_0097_VTAB "FORMULA_0097_VTAB" TAB_VERB 2 0 "inaktiv" 1 "aktiv" /end COMPU_VTAB
/begin COMPU_METHOD FORMULA_0098 "FORMULA_0098" TAB_VERB "%7.2" "-" COMPU_TAB_REF FORMULA_0098_VTAB /end COMPU_METHOD
/begin COMPU_VTAB FORMULA_0098_VTAB "FORMULA_0098_VTAB" TAB_VERB 2 0 "nein" 1 "ja" /end COMPU_VTAB
/begin COMPU_METHOD FORMULA_0099 "FORMULA_0099" TAB_VERB "%7.2" "-" COMPU_TAB_REF FORMULA_0099_VTAB /end COMPU_METHOD
/begin COMPU_VTAB FORMULA_0099_VTAB "FORMULA_0099_VTAB" TAB_VERB 2 0 "inaktiv" 1 "aktiv" /end COMPU_VTAB
/begin COMPU_METHOD FORMULA_0100 "FORMULA_0100" TAB_VERB "%7.2" "-" COMPU_TAB_REF FORMULA_0100_VTAB /end COMPU_METHOD
/begin COMPU_VTAB FORMULA_0100_VTAB "FORMULA_0100_VTAB" TAB_VERB 2 0 "inaktiv" 1 "aktiv" /end COMPU_VTAB
/begin COMPU_METHOD FORMULA_0101 "FORMULA_0101" TAB_VERB "%7.2" "-" COMPU_TAB_REF FORMULA_0101_VTAB /end COMPU_METHOD
/begin COMPU_VTAB FORMULA_0101_VTAB "FORMULA_0101_VTAB" TAB_VERB 2 0 "inaktiv" 1 "aktiv" /end COMPU_VTAB
/begin COMPU_METHOD FORMULA_0102 "FORMULA_0102" TAB_VERB "%7.2" "-" COMPU_TAB_REF FORMULA_0102_VTAB /end COMPU_METHOD
/begin COMPU_VTAB FORMULA_0102_VTAB "FORMULA_0102_VTAB" TAB_VERB 2 0 "no" 1 "yes" /end COMPU_VTAB
/begin COMPU_METHOD FORMULA_0103 "FORMULA_0103" TAB_VERB "%7.2" "-" COMPU_TAB_REF FORMULA_0103_VTAB /end COMPU_METHOD
/begin COMPU_VTAB FORMULA_0103_VTAB "FORMULA_0103_VTAB" TAB_VERB 5 1 "PASSIV" 2 "WARTEN" 4 "AMPLITUDE" 8 "NORMIERUNG" 16 "ENDE" DEFAULT_VALUE "undef." /end COMPU_VTAB
/begin COMPU_METHOD FORMULA_0104 "FORMULA_0104" TAB_VERB "%7.2" "-" COMPU_TAB_REF FORMULA_0104_VTAB /end COMPU_METHOD
/begin COMPU_VTAB FORMULA_0104_VTAB "FORMULA_0104_VTAB" TAB_VERB 1 0 "-" DEFAULT_VALUE "MAX-Ermittlung" /end COMPU_VTAB
/begin COMPU_METHOD FORMULA_0105 "FORMULA_0105" TAB_VERB "%7.2" "-" COMPU_TAB_REF FORMULA_0105_VTAB /end COMPU_METHOD
/begin COMPU_VTAB FORMULA_0105_VTAB "FORMULA_0105_VTAB" TAB_VERB 1 0 "-" DEFAULT_VALUE "MIN-Ermittlung" /end COMPU_VTAB
/begin COMPU_METHOD FORMULA_0106 "FORMULA_0106" TAB_VERB "%7.2" "-" COMPU_TAB_REF FORMULA_0106_VTAB /end COMPU_METHOD
/begin COMPU_VTAB FORMULA_0106_VTAB "FORMULA_0106_VTAB" TAB_VERB 1 0 "-" DEFAULT_VALUE "aktiv" /end COMPU_VTAB
/begin COMPU_METHOD FORMULA_0107 "FORMULA_0107" TAB_VERB "%7.2" "-" COMPU_TAB_REF FORMULA_0107_VTAB /end COMPU_METHOD
/begin COMPU_VTAB FORMULA_0107_VTAB "FORMULA_0107_VTAB" TAB_VERB 1 0 "inaktiv" DEFAULT_VALUE "aktiv" /end COMPU_VTAB
/begin COMPU_METHOD FORMULA_0108 "FORMULA_0108" TAB_VERB "%7.2" "-" COMPU_TAB_REF FORMULA_0108_VTAB /end COMPU_METHOD
/begin COMPU_VTAB FORMULA_0108_VTAB "FORMULA_0108_VTAB" TAB_VERB 1 0 "inaktiv" DEFAULT_VALUE "aktiv" /end COMPU_VTAB
/begin COMPU_METHOD FORMULA_0110 "FORMULA_0110" TAB_VERB "%3.0" "-" COMPU_TAB_REF FORMULA_0110_VTAB /end COMPU_METHOD
/begin COMPU_VTAB FORMULA_0110_VTAB "FORMULA_0110_VTAB" TAB_VERB 5 1 "warte Sync." 2 "Sync. laeuft" 4 "synchronisiert" 8 "nicht sync." 20 "Sync. vio Ionenstrom" DEFAULT_VALUE "gibts nicht" /end COMPU_VTAB
/begin COMPU_METHOD FORMULA_0116 "FORMULA_0116" TAB_VERB "%5.2" "-" COMPU_TAB_REF FORMULA_0116_VTAB /end COMPU_METHOD
/begin COMPU_VTAB FORMULA_0116_VTAB "FORMULA_0116_VTAB" TAB_VERB 7 0 "Inaktiv" 1 "Trigger" 2 "Bereit" 3 "Tr+Be" 4 "Aktiv" 7 "Tr+Be+Aktiv" 8 "WE" DEFAULT_VALUE "undef" /end COMPU_VTAB
/begin COMPU_METHOD FORMULA_0117 "FORMULA_0117" RAT_FUNC "%7.2" "s" COEFFS 0 200 0 0 0 1 /end COMPU_METHOD
/begin COMPU_METHOD FORMULA_0119 "FORMULA_0119" RAT_FUNC "%5.2" "bar" COEFFS 0 100 0 0 0 3 /end COMPU_METHOD
/begin COMPU_METHOD FORMULA_0120 "FORMULA_0120" TAB_VERB "%5.2" "-" COMPU_TAB_REF FORMULA_0120_VTAB /end COMPU_METHOD
/begin COMPU_VTAB FORMULA_0120_VTAB "FORMULA_0120_VTAB" TAB_VERB 2 0 "QLT-Temp.fehler" 1 "QLT-Temp.OK" DEFAULT_VALUE "undef." /end COMPU_VTAB
/begin COMPU_METHOD FORMULA_0122 "FORMULA_0122" TAB_VERB "%5.2" "-" COMPU_TAB_REF FORMULA_0122_VTAB /end COMPU_METHOD
/begin COMPU_VTAB FORMULA_0122_VTAB "FORMULA_0122_VTAB" TAB_VERB 2 0 "Inaktiv" 1 "Aktiv" /end COMPU_VTAB
/begin COMPU_METHOD FORMULA_0124 "FORMULA_0124" TAB_VERB "%3.0" "-" COMPU_TAB_REF FORMULA_0124_VTAB /end COMPU_METHOD
/begin COMPU_VTAB FORMULA_0124_VTAB "FORMULA_0124_VTAB" TAB_VERB 2 0 "CBS-RESET nicht ausgef." 1 "CBS-RESET ausgefuehrt" /end COMPU_VTAB
/begin COMPU_METHOD FORMULA_0125 "FORMULA_0125" TAB_VERB "%5.0" "-" COMPU_TAB_REF FORMULA_0125_VTAB /end COMPU_METHOD
/begin COMPU_VTAB FORMULA_0125_VTAB "FORMULA_0125_VTAB" TAB_VERB 8 0 "O.K." 1 "BusOff" 2 "DPR" 4 "Timeout" 5 "BusOff+Timeout" 8 "Overflow" 16 "Chksum" 32 "Alive" DEFAULT_VALUE "Mehrfachfehler" /end COMPU_VTAB
/begin COMPU_METHOD FORMULA_0126 "FORMULA_0126" TAB_VERB "%3.0" "-" COMPU_TAB_REF FORMULA_0126_VTAB /end COMPU_METHOD
/begin COMPU_VTAB FORMULA_0126_VTAB "FORMULA_0126_VTAB" TAB_VERB 8 0 "O.K." 1 "BusOff" 2 "DPR" 4 "Timeout" 5 "BusOff+Timeout" 8 "Overflow" 16 "Chksum" 32 "Alive" DEFAULT_VALUE "Mehrfachfehler" /end COMPU_VTAB
/begin COMPU_METHOD FORMULA_0127 "FORMULA_0127" TAB_VERB "%3.0" "-" COMPU_TAB_REF FORMULA_0127_VTAB /end COMPU_METHOD
/begin COMPU_VTAB FORMULA_0127_VTAB "FORMULA_0127_VTAB" TAB_VERB 4 0 "aus" 1 "ein" 2 "Stufe 1" 4 "Stufe 2" DEFAULT_VALUE "ungueltig" /end COMPU_VTAB
/begin COMPU_METHOD FORMULA_0128 "FORMULA_0128" TAB_VERB "%3.0" "-" COMPU_TAB_REF FORMULA_0128_VTAB /end COMPU_METHOD
/begin COMPU_VTAB FORMULA_0128_VTAB "FORMULA_0128_VTAB" TAB_VERB 3 0 "aus" 1 "ZH" 2 "NTKW" DEFAULT_VALUE "ungueltig" /end COMPU_VTAB
/begin COMPU_METHOD FORMULA_0130 "FORMULA_0130" TAB_VERB "%7.2" "-" COMPU_TAB_REF FORMULA_0130_VTAB /end COMPU_METHOD
/begin COMPU_VTAB FORMULA_0130_VTAB "FORMULA_0130_VTAB" TAB_VERB 7 0 "iO" 1 "VL defekt" 2 "VR defekt" 4 "HL defekt" 8 "HR defekt" 16 "vVorne" 20 "vTacho" DEFAULT_VALUE "Mehrfach" /end COMPU_VTAB
/begin COMPU_METHOD FORMULA_0131 "FORMULA_0131" TAB_VERB "%5.2" "-" COMPU_TAB_REF FORMULA_0131_VTAB /end COMPU_METHOD
/begin COMPU_VTAB FORMULA_0131_VTAB "FORMULA_0131_VTAB" TAB_VERB 4 0 "steht" 1 "vorwaerts" 2 "rueckwaerts" 3 "faehrt" DEFAULT_VALUE "ungueltig" /end COMPU_VTAB
/begin COMPU_METHOD FORMULA_0132 "FORMULA_0132" RAT_FUNC "%7.2" "m/(s*s)" COEFFS 0 40 0 0 0 1 /end COMPU_METHOD
/begin COMPU_METHOD FORMULA_0133 "FORMULA_0133" TAB_VERB "%5.2" "-" COMPU_TAB_REF FORMULA_0133_VTAB /end COMPU_METHOD
/begin COMPU_VTAB FORMULA_0133_VTAB "FORMULA_0133_VTAB" TAB_VERB 4 0 "iO" 1 "ax-Err" 2 "ay-Err" 3 "ax-ay-Err" DEFAULT_VALUE "ungueltig" /end COMPU_VTAB
/begin COMPU_METHOD FORMULA_0134 "FORMULA_0134" TAB_VERB "%5.2" "-" COMPU_TAB_REF FORMULA_0134_VTAB /end COMPU_METHOD
/begin COMPU_VTAB FORMULA_0134_VTAB "FORMULA_0134_VTAB" TAB_VERB 3 0 "Inaktiv" 1 "MSR" 2 "ASC" DEFAULT_VALUE "ungueltig" /end COMPU_VTAB
/begin COMPU_METHOD FORMULA_0135 "FORMULA_0135" TAB_VERB "%3.0" "-" COMPU_TAB_REF FORMULA_0135_VTAB /end COMPU_METHOD
/begin COMPU_VTAB FORMULA_0135_VTAB "FORMULA_0135_VTAB" TAB_VERB 8 0 "iO" 1 "passiv" 2 "defekt" 3 "reserviert" 4 "MDM" 5 "reserviert" 6 "Unterspannung" 7 "ungueltig" /end COMPU_VTAB
/begin COMPU_METHOD FORMULA_0136 "FORMULA_0136" TAB_VERB "%3.0" "-" COMPU_TAB_REF FORMULA_0136_VTAB /end COMPU_METHOD
/begin COMPU_VTAB FORMULA_0136_VTAB "FORMULA_0136_VTAB" TAB_VERB 11 0 "keine" 1 "ABS" 2 "ASC" 3 "ABS/ASC" 4 "DSC" 5 "ABS/DSC" 8 "HBA" 16 "MSR" 17 "ABS/MSR" 32 "EBV" 255 "ungueltig" DEFAULT_VALUE "selbstrechnen" /end COMPU_VTAB
/begin COMPU_METHOD FORMULA_0137 "FORMULA_0137" TAB_VERB "%3.0" "-" COMPU_TAB_REF FORMULA_0137_VTAB /end COMPU_METHOD
/begin COMPU_VTAB FORMULA_0137_VTAB "FORMULA_0137_VTAB" TAB_VERB 4 0 "keiner" 1 "vorhanden" 2 "???" 3 "ungueltig" /end COMPU_VTAB
/begin COMPU_METHOD FORMULA_0138 "FORMULA_0138" RAT_FUNC "%3.0" "bar" COEFFS 0 1 0 0 0 1 /end COMPU_METHOD
/begin COMPU_METHOD FORMULA_0139 "FORMULA_0139" TAB_VERB "%5.2" "-" COMPU_TAB_REF FORMULA_0139_VTAB /end COMPU_METHOD
/begin COMPU_VTAB FORMULA_0139_VTAB "FORMULA_0139_VTAB" TAB_VERB 4 0 "iO" 1 "Verifikation" 2 "Fehler" 3 "ungueltig" /end COMPU_VTAB
/begin COMPU_METHOD FORMULA_0142 "FORMULA_0142" RAT_FUNC "%7.2" "Grad/s" COEFFS 0 1 0 0 0 0.04395 /end COMPU_METHOD
/begin COMPU_METHOD FORMULA_0143 "FORMULA_0143" TAB_VERB "%3.0" "-" COMPU_TAB_REF FORMULA_0143_VTAB /end COMPU_METHOD
/begin COMPU_VTAB FORMULA_0143_VTAB "FORMULA_0143_VTAB" TAB_VERB 8 0 "alle aus" 1 "Kl R" 2 "Kl 15" 3 "Kl R+15" 4 "Kl 50" 5 "Kl R+50" 6 "Kl 15+50" 7 "Kl R+15+50" /end COMPU_VTAB
/begin COMPU_METHOD FORMULA_0144 "FORMULA_0144" TAB_VERB "%3.0" "-" COMPU_TAB_REF FORMULA_0144_VTAB /end COMPU_METHOD
/begin COMPU_VTAB FORMULA_0144_VTAB "FORMULA_0144_VTAB" TAB_VERB 8 0 "keine" 1 "T vo" 2 "UeT vo" 4 "T hi" 8 "UeT hi" 16 "T ob/un" 64 "T ax" 255 "ungueltig" /end COMPU_VTAB
/begin COMPU_METHOD FORMULA_0145 "FORMULA_0145" TAB_VERB "%5.2" "-" COMPU_TAB_REF FORMULA_0145_VTAB /end COMPU_METHOD
/begin COMPU_VTAB FORMULA_0145_VTAB "FORMULA_0145_VTAB" TAB_VERB 4 0 "aus" 1 "an" 2 "Anf aus" 4 "Anf aus rec" DEFAULT_VALUE "ungueltig" /end COMPU_VTAB
/begin COMPU_METHOD FORMULA_0148 "FORMULA_0148" RAT_FUNC "%8.3" "ml" COEFFS 0 1000 0 0 0 1 /end COMPU_METHOD
/begin COMPU_METHOD FORMULA_0149 "FORMULA_0149" RAT_FUNC "%9.2" "min" COEFFS 0 60 0 0 0 1 /end COMPU_METHOD
/begin COMPU_METHOD FORMULA_0150 "FORMULA_0150" TAB_VERB "%5.2" "-" COMPU_TAB_REF FORMULA_0150_VTAB /end COMPU_METHOD
/begin COMPU_VTAB FORMULA_0150_VTAB "FORMULA_0150_VTAB" TAB_VERB 2 0 "Ok" 1 "Fehler" /end COMPU_VTAB
/begin COMPU_METHOD FORMULA_0151 "FORMULA_0151" TAB_VERB "%7.2" "-" COMPU_TAB_REF FORMULA_0151_VTAB /end COMPU_METHOD
/begin COMPU_VTAB FORMULA_0151_VTAB "FORMULA_0151_VTAB" TAB_VERB 5 1 "PASSIV" 2 "WARTEN" 4 "ZYK MAGER" 8 "ZYK FETT" 16 "ENDE" DEFAULT_VALUE "undef." /end COMPU_VTAB
/begin COMPU_METHOD FORMULA_0153 "FORMULA_0153" TAB_VERB "%5.2" "-" COMPU_TAB_REF FORMULA_0153_VTAB /end COMPU_METHOD
/begin COMPU_VTAB FORMULA_0153_VTAB "FORMULA_0153_VTAB" TAB_VERB 4 0 "inaktiv" 1 "Momenteneingriff" 2 "Einspritzausblendung" 3 "Md + TT-Eingriff" /end COMPU_VTAB
/begin COMPU_METHOD FORMULA_0154 "FORMULA_0154" TAB_VERB "%5.2" "-" COMPU_TAB_REF FORMULA_0154_VTAB /end COMPU_METHOD
/begin COMPU_VTAB FORMULA_0154_VTAB "FORMULA_0154_VTAB" TAB_VERB 2 0 "inaktiv" 1 "N-Dynamik aktiv" /end COMPU_VTAB
/begin COMPU_METHOD FORMULA_0155 "FORMULA_0155" TAB_VERB "%7.2" "-" COMPU_TAB_REF FORMULA_0155_VTAB /end COMPU_METHOD
/begin COMPU_VTAB FORMULA_0155_VTAB "FORMULA_0155_VTAB" TAB_VERB 2 0 "BLS aus" 1 "BLS ein" /end COMPU_VTAB
/begin COMPU_METHOD FORMULA_0156 "FORMULA_0156" TAB_VERB "%7.2" "-" COMPU_TAB_REF FORMULA_0156_VTAB /end COMPU_METHOD
/begin COMPU_VTAB FORMULA_0156_VTAB "FORMULA_0156_VTAB" TAB_VERB 2 0 "offen" 1 "geschlossen" /end COMPU_VTAB
/begin COMPU_METHOD FORMULA_0157 "FORMULA_0157" TAB_VERB "%7.2" "-" COMPU_TAB_REF FORMULA_0157_VTAB /end COMPU_METHOD
/begin COMPU_VTAB FORMULA_0157_VTAB "FORMULA_0157_VTAB" TAB_VERB 4 0 "Leergasse" 1 "Gerader Gang" 8 "Leergasse" 9 "Ungerader Gang" /end COMPU_VTAB
/begin COMPU_METHOD FORMULA_0158 "FORMULA_0158" TAB_VERB "%7.2" "-" COMPU_TAB_REF FORMULA_0158_VTAB /end COMPU_METHOD
/begin COMPU_VTAB FORMULA_0158_VTAB "FORMULA_0158_VTAB" TAB_VERB 2 0 "Sleep" 1 "Wakeup" /end COMPU_VTAB
/begin COMPU_METHOD FORMULA_0159 "FORMULA_0159" TAB_VERB "%7.2" "-" COMPU_TAB_REF FORMULA_0159_VTAB /end COMPU_METHOD
/begin COMPU_VTAB FORMULA_0159_VTAB "FORMULA_0159_VTAB" TAB_VERB 2 0 "aus" 1 "ein" /end COMPU_VTAB
/begin COMPU_METHOD FORMULA_0160 "FORMULA_0160" TAB_VERB "%7.2" "-" COMPU_TAB_REF FORMULA_0160_VTAB /end COMPU_METHOD
/begin COMPU_VTAB FORMULA_0160_VTAB "FORMULA_0160_VTAB" TAB_VERB 2 0 "keine Schaltung" 1 "Schaltung" /end COMPU_VTAB
/begin COMPU_METHOD FORMULA_0317 "FORMULA_0317" RAT_FUNC "%5.2" "s" COEFFS 0 100 0 0 0 1 /end COMPU_METHOD
/begin COMPU_METHOD FORMULA_0426 "FORMULA_0426" RAT_FUNC "%5.0" "�C" COEFFS 0 10 0 0 0 1 /end COMPU_METHOD
/begin COMPU_METHOD FORMULA_0431 "FORMULA_0431" RAT_FUNC "%5.2" "mm" COEFFS 0 256 0 0 0 75 /end COMPU_METHOD
/* ------------------ Abschnitt erzeugt aus oznivdl.dat ------------------ */
/begin COMPU_METHOD FORMULA_0436 "FORMULA_0436" RAT_FUNC "%5.2" "Liter" COEFFS 0 10 0 0 0 1 /end COMPU_METHOD
/begin COMPU_METHOD FORMULA_0438 "FORMULA_0438" RAT_FUNC "%7.2" "min" COEFFS 0 1 0 0 0 1 /end COMPU_METHOD
/begin COMPU_METHOD FORMULA_0446 "FORMULA_0446" RAT_FUNC "%4.1" "-" COEFFS 0 4 0 0 0 1 /end COMPU_METHOD
/begin COMPU_METHOD FORMULA_0449 "FORMULA_0449" RAT_FUNC "%7.2" "mm" COEFFS 0 256 0 0 0 75 /end COMPU_METHOD
/begin COMPU_METHOD FORMULA_0453 "FORMULA_0453" RAT_FUNC "%9.4" "-" COEFFS 0 1024 0 0 0 1 /end COMPU_METHOD
/* ------------------ Abschnitt erzeugt aus dgen.dat ------------------ */
/begin COMPU_METHOD FORMULA_0458 "FORMULA_0458" RAT_FUNC "%4.1" "s" COEFFS 0 10 0 0 0 1 /end COMPU_METHOD
/begin COMPU_METHOD FORMULA_0472 "FORMULA_0472" RAT_FUNC "%5.2" "min" COEFFS 0 1 0 0 0 1 /end COMPU_METHOD
/* ------------------ Abschnitt erzeugt aus dibs.dat ------------------ */
/begin COMPU_METHOD FORMULA_0483 "FORMULA_0483" RAT_FUNC "%4.1" "-" COEFFS 0 1 0 0 0 1 /end COMPU_METHOD
/begin COMPU_METHOD FORMULA_0498 "FORMULA_0498" RAT_FUNC "%5.2" "" COEFFS 0 25 0 0 0 128 /end COMPU_METHOD
/begin COMPU_METHOD FORMULA_0557 "FORMULA_0557" RAT_FUNC "%4.1" "l" COEFFS 0 2 0 0 0 1 /end COMPU_METHOD
/begin COMPU_METHOD FORMULA_0598 "FORMULA_0598" RAT_FUNC "%5.2" "Liter" COEFFS 0 10 100 0 0 1 /end COMPU_METHOD
/begin COMPU_METHOD FORMULA_0601 "FORMULA_0601" RAT_FUNC "%7.2" "Liter" COEFFS 0 1000 0 0 0 1 /end COMPU_METHOD
/begin COMPU_METHOD FORMULA_0603 "FORMULA_0603" RAT_FUNC "%5.2" "-" COEFFS 0 10 0 0 0 1 /end COMPU_METHOD
/begin COMPU_METHOD FORMULA_0604 "FORMULA_0604" RAT_FUNC "%5.2" "%" COEFFS 0 10 0 0 0 125 /end COMPU_METHOD
/begin COMPU_METHOD FORMULA_0605 "FORMULA_0605" RAT_FUNC "%7.2" "Kelvin" COEFFS 0 1 0 0 0 1 /end COMPU_METHOD
/begin COMPU_METHOD FORMULA_0606 "FORMULA_0606" RAT_FUNC "%7.2" "mm" COEFFS 0 337 0 0 0 100 /end COMPU_METHOD
/begin COMPU_METHOD FORMULA_0616 "FORMULA_0616" RAT_FUNC "%5.0" "km" COEFFS 0 1 0 0 0 1 /end COMPU_METHOD
/begin COMPU_METHOD FORMULA_0663 "FORMULA_0663" RAT_FUNC "%5.2" "Upm" COEFFS 0 1 0 0 0 50 /end COMPU_METHOD
/begin COMPU_METHOD FORMULA_0664 "FORMULA_0664" RAT_FUNC "%5.2" "s" COEFFS 0 0 2.56 0 1 0 /end COMPU_METHOD
/begin COMPU_METHOD FORMULA_0665 "FORMULA_0665" RAT_FUNC "%6.3" "-" COEFFS 0 256 0 0 0 1 /end COMPU_METHOD
/begin COMPU_METHOD FORMULA_0666 "FORMULA_0666" RAT_FUNC "%5.0" ".Gang" COEFFS 0 1 0 0 0 1 /end COMPU_METHOD
/* ------------------ Abschnitt erzeugt aus egas_diag.dat ------------------ */
/begin COMPU_METHOD FORMULA_0669 "FORMULA_0669" TAB_VERB "%5.2" "-" COMPU_TAB_REF FORMULA_0669_VTAB /end COMPU_METHOD
/begin COMPU_VTAB FORMULA_0669_VTAB "FORMULA_0669_VTAB" TAB_VERB 3 0 "Aus" 1 "Ein" 2 "ohne Abriss" /end COMPU_VTAB
/* ------------------ Abschnitt erzeugt aus elup.dat ------------------ */
/begin COMPU_METHOD FORMULA_0678 "FORMULA_0678" RAT_FUNC "%6.1" "mbar/s" COEFFS 0 16 0 0 0 1 /end COMPU_METHOD
/begin COMPU_METHOD FORMULA_0679 "FORMULA_0679" RAT_FUNC "%5.0" "bar/s" COEFFS 0 16 0 0 0 50 /end COMPU_METHOD
/begin COMPU_METHOD FORMULA_0682 "FORMULA_0682" TAB_VERB "%5.2" "-" COMPU_TAB_REF FORMULA_0682_VTAB /end COMPU_METHOD
/begin COMPU_VTAB FORMULA_0682_VTAB "FORMULA_0682_VTAB" TAB_VERB 2 0 "Funktion AUS" 1 "Funktion AN" DEFAULT_VALUE "undef" /end COMPU_VTAB
/begin COMPU_METHOD FORMULA_0683 "FORMULA_0683" RAT_FUNC "%5.2" "s" COEFFS 0 0 25.6 0 1 0 /end COMPU_METHOD
/begin COMPU_METHOD FORMULA_0718 "FORMULA_0718" RAT_FUNC "%5.2" "s" COEFFS 0 0 256 0 1 0 /end COMPU_METHOD
/begin COMPU_METHOD FORMULA_0733 "FORMULA_0733" RAT_FUNC "%5.2" "A" COEFFS 0 50 0 0 0 1 /end COMPU_METHOD
/begin COMPU_METHOD FORMULA_0734 "FORMULA_0734" RAT_FUNC "%5.2" "V" COEFFS 0 -125 750 0 0 -8 /end COMPU_METHOD
/begin COMPU_METHOD FORMULA_0735 "FORMULA_0735" RAT_FUNC "%5.2" "s" COEFFS 0 1 0 0 0 256 /end COMPU_METHOD
/begin COMPU_METHOD FORMULA_0736 "FORMULA_0736" RAT_FUNC "%5.2" "s" COEFFS 0 80 0 0 0 1 /end COMPU_METHOD
/begin COMPU_METHOD FORMULA_0737 "FORMULA_0737" RAT_FUNC "%5.2" "s" COEFFS 0 -1 0.01 0 0 -0.002 /end COMPU_METHOD
/begin COMPU_METHOD FORMULA_0739 "FORMULA_0739" RAT_FUNC "%5.2" "A" COEFFS 0 25 0 0 0 1 /end COMPU_METHOD
/begin COMPU_METHOD FORMULA_0740 "FORMULA_0740" RAT_FUNC "%5.2" "A" COEFFS 0 25 0 0 0 2 /end COMPU_METHOD
/begin COMPU_METHOD FORMULA_0741 "FORMULA_0741" RAT_FUNC "%5.2" "s" COEFFS 0 20 0 0 0 1 /end COMPU_METHOD
/begin COMPU_METHOD FORMULA_0742 "FORMULA_0742" RAT_FUNC "%5.2" "s" COEFFS 0 160 0 0 0 1 /end COMPU_METHOD
/begin COMPU_METHOD FORMULA_0743 "FORMULA_0743" RAT_FUNC "%5.2" "V" COEFFS 0 1 0 0 0 0.0196 /end COMPU_METHOD
/begin COMPU_METHOD FORMULA_0744 "FORMULA_0744" RAT_FUNC "%7.2" "s" COEFFS 0 20 0 0 0 1 /end COMPU_METHOD
/begin COMPU_METHOD FORMULA_1011 "FORMULA_1011" TAB_VERB "%3.0" "-" COMPU_TAB_REF FORMULA_1011_VTAB /end COMPU_METHOD
/begin COMPU_VTAB FORMULA_1011_VTAB "FORMULA_1011_VTAB" TAB_VERB 2 0 "Speichern" 1 "Reset" DEFAULT_VALUE "undef" /end COMPU_VTAB
/begin COMPU_METHOD FORMULA_1012 "FORMULA_1012" RAT_FUNC "%3.0" "Upm/s" COEFFS 0 1 0 0 0 100 /end COMPU_METHOD
/begin COMPU_METHOD FORMULA_1013 "FORMULA_1013" RAT_FUNC "%7.2" "Upm/s" COEFFS 0 1 0 0 0 10 /end COMPU_METHOD
/* ------------------ Abschnitt erzeugt aus eeprom.dat ------------------ */ /* ------------------ Abschnitt erzeugt aus glob.dat ------------------ */ /* ------------------ Abschnitt erzeugt aus ipk.dat ------------------ */ /* ------------------ Abschnitt erzeugt aus n.dat ------------------ */
/begin CHARACTERISTIC K_N_ZEIT_STOERUNG "Einfrierzeit Drehzahlerfassung nach TPU Stoerung | EN: Freeze time of speed sensing after TPU fault [s]" VALUE 0x75566 TKW_VV_VV_SB 100.0 FORMULA_0317 0.0 1.2700 /end CHARACTERISTIC
/begin CHARACTERISTIC K_N_OBERGRENZE "Plausibilitaetsgrenze fuer die n-Erfassung | EN: Plausibility limit for engine-speed sensing [Upm]" VALUE 0x75568 TKW_VV_VV_SW 100.0 FORMULA_0006 0.0 20000.0000 /end CHARACTERISTIC
/begin CHARACTERISTIC K_N_MIN_FREEZE "Minimale Eintrittsdrehzahl fuer Drehzahl-Freeze | EN: Minimum entry speed for engine-speed freeze [Upm]" VALUE 0x7556A TKW_VV_VV_SW 100.0 FORMULA_0006 0.0 10000.0000 /end CHARACTERISTIC
/* ------------------ Abschnitt erzeugt aus pmugencalc.dat ------------------ */ /* ------------------ Abschnitt erzeugt aus adapt.dat ------------------ */ /* ------------------ Abschnitt erzeugt aus adapt_wichtig.dat ------------------ */ /* ------------------ Abschnitt erzeugt aus ag_ti.dat ------------------ */ /* ------------------ Abschnitt erzeugt aus ascet_interf.dat ------------------ */
/begin CHARACTERISTIC K_OZLBESCHS "Laengsbeschleunigung Ausblendung-Schwelle im Stand | EN: Laengsbeschleunigung Aus-blendung-Schwelle im Stand" VALUE 0x702B7 TKW_VV_VV_SB 100.0 FORMULA_0446 -32.0000 31.7500 /end CHARACTERISTIC
/begin CHARACTERISTIC K_OZ_N_OELMAXKORR_U "unt. Drehz.grenze Wichtung Langzeitmw. | EN: unt. Drehz.grenze Wichtung Langzeitmw." VALUE 0x702BC TKW_VV_VV_SW 100.0 FORMULA_0006 -32768.0000 32767.0000 /end CHARACTERISTIC
/begin CHARACTERISTIC K_OZ_N_OELMAXKORR_O "ob. Drehz.grenze Wichtung Langzeitmw. | EN: ob. Drehz.grenze Wichtung Langzeitmw." VALUE 0x702BE TKW_VV_VV_SW 100.0 FORMULA_0006 -32768.0000 32767.0000 /end CHARACTERISTIC
/begin CHARACTERISTIC K_OZ_KRZ_MESSUNG_LL "Oelstanderfassung nach x sec. im Leerlauf | EN: Oelstanderfassung nach x sec. im Leerlauf" VALUE 0x702C0 TKW_VV_VV_UW 100.0 FORMULA_0021 0.0 655.0000 FORMAT "%5.2" /end CHARACTERISTIC
/begin CHARACTERISTIC K_OZ_ALT_NACHF "Nachfuellerkennung Motoroel | EN: Nachfuellerkennung Motoroel" VALUE 0x702C2 TKW_VV_VV_UB 100.0 FORMULA_0436 0.0 25.5000 /end CHARACTERISTIC
/begin CHARACTERISTIC K_OZ_KRZ_HYST_CBS "Mindestschwankung (CBS frisch) | EN: Mindestschwankung (CBS frisch)" VALUE 0x702C3 TKW_VV_VV_UB 100.0 FORMULA_0436 0.0 25.5000 /end CHARACTERISTIC
/begin CHARACTERISTIC K_OZ_ALT_HYST_U "Mind.schwankung (nach unten) Erstuebernahme Lzw. | EN: Mind.schwankung (nach unten) Erstuebernahme Lzw." VALUE 0x702C4 TKW_VV_VV_UB 100.0 FORMULA_0436 0.0 25.5000 /end CHARACTERISTIC
/begin CHARACTERISTIC K_OZ_ALT_HYST_F "Mindestschwankung Langzeitmsg. | EN: Mindestschwankung Langzeitmsg." VALUE 0x702C5 TKW_VV_VV_UB 100.0 FORMULA_0436 0.0 25.5000 /end CHARACTERISTIC
/begin CHARACTERISTIC K_OZ_KRZ_HYST "Mindestschwankung Kurzzeitmsg. | EN: Mindestschwankung Kurzzeitmsg." VALUE 0x702C6 TKW_VV_VV_UB 100.0 FORMULA_0436 0.0 25.5000 /end CHARACTERISTIC
/begin CHARACTERISTIC K_OZ_LZW_AEND_BEGR "neg. Inkrement Langzeitmsg. | EN: neg. Inkrement Langzeitmsg." VALUE 0x702C7 TKW_VV_VV_UB 100.0 FORMULA_0436 0.0 25.5000 /end CHARACTERISTIC
/begin CHARACTERISTIC K_OZ_1L_BEGR_U "untere 1L-Schwelle abzgl. Kraftst. | EN: untere 1L-Schwelle abzgl. Kraftst." VALUE 0x702C8 TKW_VV_VV_UB 100.0 FORMULA_0598 -10.0000 15.3999 /end CHARACTERISTIC
/begin CHARACTERISTIC K_OZ_CC_OELVERBRAUCH "Schwelle Motoroel bei Minimum" VALUE 0x702C9 TKW_VV_VV_UB 100.0 FORMULA_0598 -10.0000 15.3999 /end CHARACTERISTIC
/begin CHARACTERISTIC K_OZ_CC_OELVERLUST "Schwelle Motoroel unter Minimum bzw. Oelverlust | EN: Schwelle Motoroel unter Mini-mum bzw. Oelverlust" VALUE 0x702CA TKW_VV_VV_UB 100.0 FORMULA_0598 -10.0000 15.3999 /end CHARACTERISTIC
/begin CHARACTERISTIC K_OZ_OELVERLUST_FSP "Schwelle Motoroel unter Minimum mit FSP-Eintrag | EN: Schwelle Motoroel unter Mini-mum mit FSP-Eintrag" VALUE 0x702CB TKW_VV_VV_UB 100.0 FORMULA_0598 -10.0000 15.3999 /end CHARACTERISTIC
/begin CHARACTERISTIC K_OZ_1L_BEGR_O "obere 1L-Schwelle abzgl. Kraftst. | EN: obere 1L-Schwelle abzgl. Kraftst." VALUE 0x702CC TKW_VV_VV_UB 100.0 FORMULA_0598 -10.0000 15.3999 /end CHARACTERISTIC
/begin CHARACTERISTIC K_OZ_1_5_L_BEGR "1,5L-Anzeigeschwelle | EN: 1,5L-Anzeigeschwelle" VALUE 0x702CD TKW_VV_VV_UB 100.0 FORMULA_0598 -10.0000 15.3999 /end CHARACTERISTIC
/begin CHARACTERISTIC K_OZ_AG_MESSSTAB_MIN_OK "Schwelle Motoroel Min-OK" VALUE 0x702CE TKW_VV_VV_UB 100.0 FORMULA_0598 -10.0000 15.3999 /end CHARACTERISTIC
/begin CHARACTERISTIC K_OZ_AG_MESSSTAB_OK "Schwelle Motoroel OK | EN: Schwelle Motoroel OK" VALUE 0x702CF TKW_VV_VV_UB 100.0 FORMULA_0598 -10.0000 15.3999 /end CHARACTERISTIC
/begin CHARACTERISTIC K_OZ_AG_MESSSTAB_OK_MAX "Schwelle Motoroel OK-Max" VALUE 0x702D0 TKW_VV_VV_UB 100.0 FORMULA_0598 -10.0000 15.3999 /end CHARACTERISTIC
/begin CHARACTERISTIC K_OZ_MIN_LEVEL_VOL "Gesamtoelmenge Min-Stand | EN: Gesamtoelmenge Min-Stand" VALUE 0x702D2 TKW_VV_VV_UW 100.0 FORMULA_0601 0.0 20.0000 FORMAT "%5.2" /end CHARACTERISTIC
/begin CHARACTERISTIC K_OZ_NIV_KM_MAX "max. Km nach letzter Oelnivmessg. | EN: max. Km nach letzter Oelnivmessg." VALUE 0x702D4 TKW_VV_VV_UL 100.0 FORMULA_0027 0.0 16777214.0000 /end CHARACTERISTIC
/begin CHARACTERISTIC K_OZ_TEMPBW_KOPF "Mindesttemp. am Oelfilterkopf | EN: Mindesttemp. am Oelfilterkopf" VALUE 0x702DA TKW_VV_VV_SW 100.0 FORMULA_0023 -50.0000 170.0000 FORMAT "%4.1" /end CHARACTERISTIC
/begin CHARACTERISTIC K_OZ_TEMPBW_SUMPF "Mindesttemp. Oelwanne | EN: °C -3276.8p 2 0.75*x Mindesttemp. Oelwanne" VALUE 0x702DC TKW_VV_VV_SW 100.0 FORMULA_0426 -3276.8000 3276.7000 /end CHARACTERISTIC
/begin CHARACTERISTIC K_OZ_TEMP_KOR "Korrekturfaktor Volumenausdehnung | EN: Korrekturfaktor Volumenaus-dehnung" VALUE 0x702DE TKW_VV_VV_UB 100.0 FORMULA_0603 0.5000 1.5000 /end CHARACTERISTIC
/begin CHARACTERISTIC K_OZ_TEMP_75 "Mindesttemp. Oelwanne | EN: °C -3276.8p 2 0.75*x Mindesttemp. Oelwanne" VALUE 0x702E0 TKW_VV_VV_SW 100.0 FORMULA_0426 -3276.8000 3276.7000 /end CHARACTERISTIC
/begin CHARACTERISTIC K_SCHNELLMSG_ANZAHL_WERTE "Anzahl Oelsensor-Rohwerte" VALUE 0x702E2 TKW_VV_VV_UB 100.0 FORMULA_0483 7.0000 20.0000 /end CHARACTERISTIC
/begin CHARACTERISTIC K_SCHNELLMSG_KL15_MAX "CC-Mld-Schnellmessung-Aktivzeit" VALUE 0x702E4 TKW_VV_VV_UW 100.0 FORMULA_0021 0.0 655.0000 FORMAT "%5.2" /end CHARACTERISTIC
/begin CHARACTERISTIC K_SCHNELLMSG_KL15_AUSBLEND "Ausblendungszeit Bedingung Schnellmsg." VALUE 0x702E6 TKW_VV_VV_UW 100.0 FORMULA_0021 0.0 655.0000 FORMAT "%5.2" /end CHARACTERISTIC
/begin CHARACTERISTIC K_SCHNELLMSG_OZLBESCHS "Laengsbeschl. Ausblendung-Schwelle Schnellmessung" VALUE 0x702E8 TKW_VV_VV_SB 100.0 FORMULA_0446 -32.0000 31.7500 /end CHARACTERISTIC
/begin CHARACTERISTIC K_SCHNELLMSG_OZQBESCHS "Querbeschl. Ausblendung-Schwelle Schnellmessung" VALUE 0x702E9 TKW_VV_VV_SB 100.0 FORMULA_0446 -32.0000 31.7500 /end CHARACTERISTIC
/begin CHARACTERISTIC K_SCHNELLMSG_T_MS "Motor steht-Schwelle | EN: Motor steht-Schwelle" VALUE 0x702EA TKW_VV_VV_UW 100.0 FORMULA_0438 1.0000 65535.0000 FORMAT "%5.2" /end CHARACTERISTIC
/begin CHARACTERISTIC K_SCHNELLMSG_TOEL_MIN "Mindestoeltemp. fuer Schnellmessung" VALUE 0x702EC TKW_VV_VV_SW 100.0 FORMULA_0023 -50.0000 170.0000 FORMAT "%4.1" /end CHARACTERISTIC
/begin CHARACTERISTIC K_SCHNELLMSG_N_MAX "Maximaldrehzahl fuer Schnellmessung | EN: Maximaldrehzahl fuer Schnell-messung" VALUE 0x702EE TKW_VV_VV_SW 100.0 FORMULA_0006 0.0 10000.0000 /end CHARACTERISTIC
/begin CHARACTERISTIC K_SCHNELLMSG_V_MAX "Max.geschwindigkeit Schnellmessung | EN: Max.geschwindigkeit Schnell-messung" VALUE 0x702F0 TKW_VV_VV_SW 100.0 FORMULA_0078 -80.0000 360.0000 FORMAT "%4.1" /end CHARACTERISTIC
/begin CHARACTERISTIC KL_GEN_AUSL_BEGR "Generator Auslastungsbegrenzung | EN: Generator load limit" CURVE 0x702F8 TKL_SW_VV_UB 100.0 FORMULA_0604 0.0 87.5000 /begin AXIS_DESCR STD_AXIS FORMULA_0006 5 -32768.0000 32767.0000 /end AXIS_DESCR /end CHARACTERISTIC
/begin CHARACTERISTIC KL_OELLEVEL_KOMBI "Linearisierungskennlinie Kombianzeige | EN: Linearisierungskennlinie Kombianzeige" CURVE 0x7030A TKL_UB_VV_UB 100.0 FORMULA_0598 -10.0000 15.3999 /begin AXIS_DESCR STD_AXIS FORMULA_0431 20 0.0 74.7070 FORMAT "%5.2" /end AXIS_DESCR /end CHARACTERISTIC
/begin CHARACTERISTIC KL_OZ_LGMW_OFFSET "Linearisierungskennlinie Kombianzeige | EN: Linearisation curve, instrument cluster display" CURVE 0x70334 TKL_UB_VV_UB 100.0 FORMULA_0431 0.0 74.4140 /begin AXIS_DESCR STD_AXIS FORMULA_0431 8 0.0 74.7070 FORMAT "%5.2" /end AXIS_DESCR /end CHARACTERISTIC
/begin CHARACTERISTIC KL_OZ_LL_L_OFFSET "Laengs-Beschl. Korr. Niveau | EN: Laengs-Beschl. Korr. Niveau" CURVE 0x70346 TKL_SW_VV_SB 100.0 FORMULA_0431 -21.9726 21.9726 /begin AXIS_DESCR STD_AXIS FORMULA_0132 5 -20.0000 20.0000 FORMAT "%5.2" /end AXIS_DESCR /end CHARACTERISTIC
/begin CHARACTERISTIC KL_OZ_LL_Q_OFFSET "Quer-Beschl. Korr. Niveau | EN: Quer-Beschl. Korr. Niveau" CURVE 0x70358 TKL_SW_VV_SB 100.0 FORMULA_0431 -21.9726 21.9726 /begin AXIS_DESCR STD_AXIS FORMULA_0132 5 -20.0000 20.0000 FORMAT "%5.2" /end AXIS_DESCR /end CHARACTERISTIC
/begin CHARACTERISTIC KF_OZ_TEMP_KOR "Temperaturkorrektur Kurzzeitmessung | EN: Temperature correction, short-term measurement" MAP 0x7036A TKF_SW_SW_UW 100.0 FORMULA_0453 0.0 63.9990 /begin AXIS_DESCR STD_AXIS FORMULA_0449 6 0.0 74.7070 FORMAT "%5.2" /end AXIS_DESCR
 /begin AXIS_DESCR STD_AXIS toel_delta FORMULA_0605 6 0.0 32767.0000 FORMAT "%5.2" /end AXIS_DESCR
 FORMAT "%7.4" /end CHARACTERISTIC
/begin CHARACTERISTIC KF_SCHNELLMSG_OZNIVR_MIN "Mindestniveau kurz nach KL15ein | EN: Minimum level shortly after terminal 15 on" MAP 0x703CC TKF_SW_SW_SW 100.0 FORMULA_0606 0.0 75.3709 /begin AXIS_DESCR STD_AXIS FORMULA_0006 6 0.0 10000.0000 /end AXIS_DESCR /begin AXIS_DESCR STD_AXIS FORMULA_0023 6 -50.0000 170.0000 FORMAT "%4.1" /end AXIS_DESCR FORMAT "%5.2" /end CHARACTERISTIC
/* ------------------ Abschnitt erzeugt aus dwf.dat ------------------ */
/begin CHARACTERISTIC K_DWF_CFG "Konfiguration DWF-Anzeige | EN: Konfiguration DWF-Anzeige" VALUE 0x705AA TKW_VV_VV_UW 100.0 FORMULA_0010 0.0 65535.0000 /end CHARACTERISTIC
/begin CHARACTERISTIC K_DWF_ORANGE_OFF "Offset auf roten Bereich | EN: Offset auf roten Bereich" VALUE 0x705AC TKW_VV_VV_SB 100.0 FORMULA_0663 -6400.0000 6350.0000 /end CHARACTERISTIC
/begin CHARACTERISTIC K_DWF_SHLI_TAU_DN "dn-Filter Shiflights" VALUE 0x705AD TKW_VV_VV_UB 100.0 FORMULA_0664 0.0101 2.5600 /end CHARACTERISTIC
/begin CHARACTERISTIC K_DWF_SHLI_TAU_N "n-Filter Shiflights [V912: differs from V452 160E]" VALUE 0x705AE TKW_VV_VV_UB 100.0 FORMULA_0664 0.0101 2.5600 /end CHARACTERISTIC
/begin CHARACTERISTIC K_DWF_SHLI_T_TOT "Fahrertotzeit" VALUE 0x705AF TKW_VV_VV_UB 100.0 FORMULA_0317 0.0 2.5500 /end CHARACTERISTIC
/begin CHARACTERISTIC K_DWF_SHLI_TAB_FAK "Einfluss Abregelzeit" VALUE 0x705B0 TKW_VV_VV_UB 100.0 FORMULA_0665 0.0 0.9960 /end CHARACTERISTIC
/begin CHARACTERISTIC K_DWF_SHLI_T_FLS "Flash Segmentzeit" VALUE 0x705B1 TKW_VV_VV_UB 100.0 FORMULA_0317 0.0 2.5500 /end CHARACTERISTIC
/begin CHARACTERISTIC K_DWF_SHLI_T_AKTIV "Aktivierungsschwelle | EN: Aktivierungsschwelle" VALUE 0x705B2 TKW_VV_VV_UW 100.0 FORMULA_0021 0.0 655.0000 FORMAT "%5.2" /end CHARACTERISTIC
/begin CHARACTERISTIC K_DWF_SHLI_T_INAKTIV "Deaktivierungsschwelle | EN: Deaktivierungsschwelle" VALUE 0x705B4 TKW_VV_VV_UW 100.0 FORMULA_0021 0.0 655.0000 FORMAT "%5.2" /end CHARACTERISTIC
/begin CHARACTERISTIC K_DWF_SHLI_T_BL "Aktivierungsschwelle Blinken | EN: Aktivierungsschwelle Blinken" VALUE 0x705B6 TKW_VV_VV_UW 100.0 FORMULA_0117 0.0 325.0000 FORMAT "%5.2" /end CHARACTERISTIC
/begin CHARACTERISTIC K_DWF_SHLI_AX_AKTIV "Aktivierungsschwelle | EN: Aktivierungsschwelle" VALUE 0x705B8 TKW_VV_VV_SW 100.0 FORMULA_0132 -20.0000 20.0000 FORMAT "%5.2" /end CHARACTERISTIC
/begin CHARACTERISTIC KL_DWF_SHLI_V_DIFF "max. Radschlupf | EN: Maximum wheel slip" CURVE 0x705BA TKL_SW_VV_SW 100.0 FORMULA_0078 -80.0000 360.0000 /begin AXIS_DESCR STD_AXIS FORMULA_0666 6 -1.0000 10.0000 /end AXIS_DESCR FORMAT "%4.1" /end CHARACTERISTIC
/begin CHARACTERISTIC KL_DWF_SHLI_SEG "Rest-Segmente | EN: Remaining segments" CURVE 0x705D4 TKL_SW_VV_UB 100.0 FORMULA_0003 0.0 10.0000 /begin AXIS_DESCR STD_AXIS FORMULA_0006 4 0.0 10000.0000 /end AXIS_DESCR /end CHARACTERISTIC
/* ------------------ Abschnitt erzeugt aus ebox_elu.dat ------------------ */
/begin CHARACTERISTIC K_EBOX_ELU_EIN "Eischaltschwelle | EN: Eischaltschwelle" VALUE 0x705E2 TKW_VV_VV_SW 100.0 FORMULA_0023 -50.0000 170.0000 FORMAT "%4.1" /end CHARACTERISTIC
/begin CHARACTERISTIC K_EBOX_ELU_HYS "Ausschalt-Hysterese | EN: Ausschalt-Hysterese" VALUE 0x705E4 TKW_VV_VV_SW 100.0 FORMULA_0076 0.0 1000.0000 FORMAT "%4.1" /end CHARACTERISTIC
/begin CHARACTERISTIC K_EBOX_ELU_LOSBRECHEN "Eischaltdauer zum Losbrechen | EN: Eischaltdauer zum Losbrechen" VALUE 0x705E6 TKW_VV_VV_UW 100.0 FORMULA_0021 0.0 655.0000 FORMAT "%5.2" /end CHARACTERISTIC
/begin CHARACTERISTIC K_ED_APPL_DATA_INJ.P_CODE_SH_TO_UB "P-Code fuer die Art SH_TO_UB | EN: Fault code APPL_DATA_INJ - OBD P-code reported for short to battery voltage" VALUE 0x70C9E TKW_VV_VV_UW 100.0 FORMULA_0010 0.0 65535.0000 /end CHARACTERISTIC
/begin CHARACTERISTIC K_ED_EV1.P_CODE_SH_TO_UB "P-Code fuer die Art SH_TO_UB | EN: Fault code EV1 - OBD P-code reported for short to battery voltage" VALUE 0x70EC0 TKW_VV_VV_UW 100.0 FORMULA_0010 0.0 65535.0000 /end CHARACTERISTIC
/begin CHARACTERISTIC K_ED_EV2.P_CODE_SH_TO_UB "P-Code fuer die Art SH_TO_UB | EN: Fault code EV2 - OBD P-code reported for short to battery voltage" VALUE 0x70EDA TKW_VV_VV_UW 100.0 FORMULA_0010 0.0 65535.0000 /end CHARACTERISTIC
/begin CHARACTERISTIC K_ED_EV3.P_CODE_SH_TO_UB "P-Code fuer die Art SH_TO_UB | EN: Fault code EV3 - OBD P-code reported for short to battery voltage" VALUE 0x70EF4 TKW_VV_VV_UW 100.0 FORMULA_0010 0.0 65535.0000 /end CHARACTERISTIC
/begin CHARACTERISTIC K_ED_EV4.P_CODE_SH_TO_UB "P-Code fuer die Art SH_TO_UB | EN: Fault code EV4 - OBD P-code reported for short to battery voltage" VALUE 0x70F0E TKW_VV_VV_UW 100.0 FORMULA_0010 0.0 65535.0000 /end CHARACTERISTIC
/begin CHARACTERISTIC K_ED_EV5.P_CODE_SH_TO_UB "P-Code fuer die Art SH_TO_UB | EN: Fault code EV5 - OBD P-code reported for short to battery voltage" VALUE 0x70F28 TKW_VV_VV_UW 100.0 FORMULA_0010 0.0 65535.0000 /end CHARACTERISTIC
/begin CHARACTERISTIC K_ED_EV6.P_CODE_SH_TO_UB "P-Code fuer die Art SH_TO_UB | EN: Fault code EV6 - OBD P-code reported for short to battery voltage" VALUE 0x70F42 TKW_VV_VV_UW 100.0 FORMULA_0010 0.0 65535.0000 /end CHARACTERISTIC
/begin CHARACTERISTIC K_ED_EV7.P_CODE_SH_TO_UB "P-Code fuer die Art SH_TO_UB | EN: Fault code EV7 - OBD P-code reported for short to battery voltage" VALUE 0x70F5C TKW_VV_VV_UW 100.0 FORMULA_0010 0.0 65535.0000 /end CHARACTERISTIC
/begin CHARACTERISTIC K_ED_EV8.P_CODE_SH_TO_UB "P-Code fuer die Art SH_TO_UB | EN: Fault code EV8 - OBD P-code reported for short to battery voltage" VALUE 0x70F76 TKW_VV_VV_UW 100.0 FORMULA_0010 0.0 65535.0000 /end CHARACTERISTIC
/begin CHARACTERISTIC K_ED_EV9.P_CODE_SH_TO_UB "P-Code fuer die Art SH_TO_UB | EN: Fault code EV9 - OBD P-code reported for short to battery voltage" VALUE 0x70F90 TKW_VV_VV_UW 100.0 FORMULA_0010 0.0 65535.0000 /end CHARACTERISTIC
/begin CHARACTERISTIC K_ED_EV10.P_CODE_SH_TO_UB "P-Code fuer die Art SH_TO_UB | EN: Fault code EV10 - OBD P-code reported for short to battery voltage" VALUE 0x70FAA TKW_VV_VV_UW 100.0 FORMULA_0010 0.0 65535.0000 /end CHARACTERISTIC
/begin CHARACTERISTIC K_ED_DMTL_P.P_CODE_SH_TO_UB "P-Code fuer die Art SH_TO_UB | EN: Fault code DMTL_P - OBD P-code reported for short to battery voltage" VALUE 0x71046 TKW_VV_VV_UW 100.0 FORMULA_0010 0.0 65535.0000 /end CHARACTERISTIC
/begin CHARACTERISTIC K_ED_DMTL_V.P_CODE_SH_TO_UB "P-Code fuer die Art SH_TO_UB | EN: Fault code DMTL_V - OBD P-code reported for short to battery voltage" VALUE 0x71060 TKW_VV_VV_UW 100.0 FORMULA_0010 0.0 65535.0000 /end CHARACTERISTIC
/begin CHARACTERISTIC K_ED_DMTL_H.P_CODE_SH_TO_UB "P-Code fuer die Art SH_TO_UB | EN: Fault code DMTL_H - OBD P-code reported for short to battery voltage" VALUE 0x7107A TKW_VV_VV_UW 100.0 FORMULA_0010 0.0 65535.0000 /end CHARACTERISTIC
/begin CHARACTERISTIC K_ED_DMTL_GROBLECK.P_CODE_SH_TO_UB "P-Code fuer die Art SH_TO_UB | EN: Fault code DMTL_GROBLECK - OBD P-code reported for short to battery voltage" VALUE 0x71094 TKW_VV_VV_UW 100.0 FORMULA_0010 0.0 65535.0000 /end CHARACTERISTIC
/begin CHARACTERISTIC K_ED_DMTL_FEUCHT.P_CODE_SH_TO_UB "P-Code fuer die Art SH_TO_UB | EN: Fault code DMTL_FEUCHT - OBD P-code reported for short to battery voltage" VALUE 0x710AE TKW_VV_VV_UW 100.0 FORMULA_0010 0.0 65535.0000 /end CHARACTERISTIC
/begin CHARACTERISTIC K_ED_DMTL_DECKEL.P_CODE_SH_TO_UB "P-Code fuer die Art SH_TO_UB | EN: Fault code DMTL_DECKEL - OBD P-code reported for short to battery voltage" VALUE 0x710C8 TKW_VV_VV_UW 100.0 FORMULA_0010 0.0 65535.0000 /end CHARACTERISTIC
/begin CHARACTERISTIC K_ED_EKP_PWM.P_CODE_SH_TO_UB "P-Code fuer die Art SH_TO_UB | EN: Fault code EKP_PWM - OBD P-code reported for short to battery voltage" VALUE 0x71130 TKW_VV_VV_UW 100.0 FORMULA_0010 0.0 65535.0000 /end CHARACTERISTIC
/begin CHARACTERISTIC K_ED_EWS_SCI.P_CODE_SH_TO_UB "P-Code fuer die Art SH_TO_UB | EN: Fault code EWS_SCI - OBD P-code reported for short to battery voltage" VALUE 0x713BA TKW_VV_VV_UW 100.0 FORMULA_0010 0.0 65535.0000 /end CHARACTERISTIC
/begin CHARACTERISTIC K_ED_EWS_MAN.P_CODE_SH_TO_UB "P-Code fuer die Art SH_TO_UB | EN: Fault code EWS_MAN - OBD P-code reported for short to battery voltage" VALUE 0x713D4 TKW_VV_VV_UW 100.0 FORMULA_0010 0.0 65535.0000 /end CHARACTERISTIC
/begin CHARACTERISTIC K_ED_EBOX_ELU.P_CODE_SH_TO_UB "P-Code fuer die Art SH_TO_UB | EN: Fault code EBOX_ELU - OBD P-code reported for short to battery voltage" VALUE 0x71470 TKW_VV_VV_UW 100.0 FORMULA_0010 0.0 65535.0000 /end CHARACTERISTIC
/begin CHARACTERISTIC K_ED_DK1_ENLTG.P_CODE_SH_TO_UB "P-Code fuer die Art SH_TO_UB | EN: Fault code DK1_ENLTG - OBD P-code reported for short to battery voltage" VALUE 0x714A4 TKW_VV_VV_UW 100.0 FORMULA_0010 0.0 65535.0000 /end CHARACTERISTIC
/begin CHARACTERISTIC K_ED_DK2_ENLTG.P_CODE_SH_TO_UB "P-Code fuer die Art SH_TO_UB | EN: Fault code DK2_ENLTG - OBD P-code reported for short to battery voltage" VALUE 0x714BE TKW_VV_VV_UW 100.0 FORMULA_0010 0.0 65535.0000 /end CHARACTERISTIC
/begin CHARACTERISTIC K_ED_E2_INJ.P_CODE_SH_TO_UB "P-Code fuer die Art SH_TO_UB | EN: Fault code E2_INJ - OBD P-code reported for short to battery voltage" VALUE 0x7155A TKW_VV_VV_UW 100.0 FORMULA_0010 0.0 65535.0000 /end CHARACTERISTIC
/begin CHARACTERISTIC K_ED_FETRAWE.P_CODE_SH_TO_UB "P-Code fuer die Art SH_TO_UB | EN: Fault code FETRAWE - OBD P-code reported for short to battery voltage" VALUE 0x71678 TKW_VV_VV_UW 100.0 FORMULA_0010 0.0 65535.0000 /end CHARACTERISTIC
/begin CHARACTERISTIC K_ED_ELUP.P_CODE_SH_TO_UB "P-Code fuer die Art SH_TO_UB | EN: Fault code ELUP - OBD P-code reported for short to battery voltage" VALUE 0x716E0 TKW_VV_VV_UW 100.0 FORMULA_0010 0.0 65535.0000 /end CHARACTERISTIC
/begin CHARACTERISTIC K_ED_ELU.P_CODE_SH_TO_UB "P-Code fuer die Art SH_TO_UB | EN: Fault code ELU - OBD P-code reported for short to battery voltage" VALUE 0x716FA TKW_VV_VV_UW 100.0 FORMULA_0010 0.0 65535.0000 /end CHARACTERISTIC
/begin CHARACTERISTIC K_ED_DMTL_FEINLECK.P_CODE_SH_TO_UB "P-Code fuer die Art SH_TO_UB | EN: Fault code DMTL_FEINLECK - OBD P-code reported for short to battery voltage" VALUE 0x71818 TKW_VV_VV_UW 100.0 FORMULA_0010 0.0 65535.0000 /end CHARACTERISTIC
/begin CHARACTERISTIC K_ED_ELUP_OBD.P_CODE_SH_TO_UB "P-Code fuer die Art SH_TO_UB" VALUE 0x71A6E TKW_VV_VV_UW 100.0 FORMULA_0010 0.0 65535.0000 /end CHARACTERISTIC
/begin CHARACTERISTIC K_ED_APPL_DATA_INJ.P_CODE_SH_TO_GND "P-Code fuer die Art SH_TO_GND | EN: Fault code APPL_DATA_INJ - OBD P-code reported for short to ground" VALUE 0x70CA0 TKW_VV_VV_UW 100.0 FORMULA_0010 0.0 65535.0000 /end CHARACTERISTIC
/begin CHARACTERISTIC K_ED_EV1.P_CODE_SH_TO_GND "P-Code fuer die Art SH_TO_GND | EN: Fault code EV1 - OBD P-code reported for short to ground" VALUE 0x70EC2 TKW_VV_VV_UW 100.0 FORMULA_0010 0.0 65535.0000 /end CHARACTERISTIC
/begin CHARACTERISTIC K_ED_EV2.P_CODE_SH_TO_GND "P-Code fuer die Art SH_TO_GND | EN: Fault code EV2 - OBD P-code reported for short to ground" VALUE 0x70EDC TKW_VV_VV_UW 100.0 FORMULA_0010 0.0 65535.0000 /end CHARACTERISTIC
/begin CHARACTERISTIC K_ED_EV3.P_CODE_SH_TO_GND "P-Code fuer die Art SH_TO_GND | EN: Fault code EV3 - OBD P-code reported for short to ground" VALUE 0x70EF6 TKW_VV_VV_UW 100.0 FORMULA_0010 0.0 65535.0000 /end CHARACTERISTIC
/begin CHARACTERISTIC K_ED_EV4.P_CODE_SH_TO_GND "P-Code fuer die Art SH_TO_GND | EN: Fault code EV4 - OBD P-code reported for short to ground" VALUE 0x70F10 TKW_VV_VV_UW 100.0 FORMULA_0010 0.0 65535.0000 /end CHARACTERISTIC
/begin CHARACTERISTIC K_ED_EV5.P_CODE_SH_TO_GND "P-Code fuer die Art SH_TO_GND | EN: Fault code EV5 - OBD P-code reported for short to ground" VALUE 0x70F2A TKW_VV_VV_UW 100.0 FORMULA_0010 0.0 65535.0000 /end CHARACTERISTIC
/begin CHARACTERISTIC K_ED_EV6.P_CODE_SH_TO_GND "P-Code fuer die Art SH_TO_GND | EN: Fault code EV6 - OBD P-code reported for short to ground" VALUE 0x70F44 TKW_VV_VV_UW 100.0 FORMULA_0010 0.0 65535.0000 /end CHARACTERISTIC
/begin CHARACTERISTIC K_ED_EV7.P_CODE_SH_TO_GND "P-Code fuer die Art SH_TO_GND | EN: Fault code EV7 - OBD P-code reported for short to ground" VALUE 0x70F5E TKW_VV_VV_UW 100.0 FORMULA_0010 0.0 65535.0000 /end CHARACTERISTIC
/begin CHARACTERISTIC K_ED_EV8.P_CODE_SH_TO_GND "P-Code fuer die Art SH_TO_GND | EN: Fault code EV8 - OBD P-code reported for short to ground" VALUE 0x70F78 TKW_VV_VV_UW 100.0 FORMULA_0010 0.0 65535.0000 /end CHARACTERISTIC
/begin CHARACTERISTIC K_ED_EV9.P_CODE_SH_TO_GND "P-Code fuer die Art SH_TO_GND | EN: Fault code EV9 - OBD P-code reported for short to ground" VALUE 0x70F92 TKW_VV_VV_UW 100.0 FORMULA_0010 0.0 65535.0000 /end CHARACTERISTIC
/begin CHARACTERISTIC K_ED_EV10.P_CODE_SH_TO_GND "P-Code fuer die Art SH_TO_GND | EN: Fault code EV10 - OBD P-code reported for short to ground" VALUE 0x70FAC TKW_VV_VV_UW 100.0 FORMULA_0010 0.0 65535.0000 /end CHARACTERISTIC
/begin CHARACTERISTIC K_ED_DMTL_P.P_CODE_SH_TO_GND "P-Code fuer die Art SH_TO_GND | EN: Fault code DMTL_P - OBD P-code reported for short to ground" VALUE 0x71048 TKW_VV_VV_UW 100.0 FORMULA_0010 0.0 65535.0000 /end CHARACTERISTIC
/begin CHARACTERISTIC K_ED_DMTL_V.P_CODE_SH_TO_GND "P-Code fuer die Art SH_TO_GND | EN: Fault code DMTL_V - OBD P-code reported for short to ground" VALUE 0x71062 TKW_VV_VV_UW 100.0 FORMULA_0010 0.0 65535.0000 /end CHARACTERISTIC
/begin CHARACTERISTIC K_ED_DMTL_H.P_CODE_SH_TO_GND "P-Code fuer die Art SH_TO_GND | EN: Fault code DMTL_H - OBD P-code reported for short to ground" VALUE 0x7107C TKW_VV_VV_UW 100.0 FORMULA_0010 0.0 65535.0000 /end CHARACTERISTIC
/begin CHARACTERISTIC K_ED_DMTL_GROBLECK.P_CODE_SH_TO_GND "P-Code fuer die Art SH_TO_GND | EN: Fault code DMTL_GROBLECK - OBD P-code reported for short to ground" VALUE 0x71096 TKW_VV_VV_UW 100.0 FORMULA_0010 0.0 65535.0000 /end CHARACTERISTIC
/begin CHARACTERISTIC K_ED_DMTL_FEUCHT.P_CODE_SH_TO_GND "P-Code fuer die Art SH_TO_GND | EN: Fault code DMTL_FEUCHT - OBD P-code reported for short to ground" VALUE 0x710B0 TKW_VV_VV_UW 100.0 FORMULA_0010 0.0 65535.0000 /end CHARACTERISTIC
/begin CHARACTERISTIC K_ED_DMTL_DECKEL.P_CODE_SH_TO_GND "P-Code fuer die Art SH_TO_GND | EN: Fault code DMTL_DECKEL - OBD P-code reported for short to ground" VALUE 0x710CA TKW_VV_VV_UW 100.0 FORMULA_0010 0.0 65535.0000 /end CHARACTERISTIC
/begin CHARACTERISTIC K_ED_EKP_PWM.P_CODE_SH_TO_GND "P-Code fuer die Art SH_TO_GND | EN: Fault code EKP_PWM - OBD P-code reported for short to ground" VALUE 0x71132 TKW_VV_VV_UW 100.0 FORMULA_0010 0.0 65535.0000 /end CHARACTERISTIC
/begin CHARACTERISTIC K_ED_EWS_SCI.P_CODE_SH_TO_GND "P-Code fuer die Art SH_TO_GND | EN: Fault code EWS_SCI - OBD P-code reported for short to ground" VALUE 0x713BC TKW_VV_VV_UW 100.0 FORMULA_0010 0.0 65535.0000 /end CHARACTERISTIC
/begin CHARACTERISTIC K_ED_EWS_MAN.P_CODE_SH_TO_GND "P-Code fuer die Art SH_TO_GND | EN: Fault code EWS_MAN - OBD P-code reported for short to ground" VALUE 0x713D6 TKW_VV_VV_UW 100.0 FORMULA_0010 0.0 65535.0000 /end CHARACTERISTIC
/begin CHARACTERISTIC K_ED_EBOX_ELU.P_CODE_SH_TO_GND "P-Code fuer die Art SH_TO_GND | EN: Fault code EBOX_ELU - OBD P-code reported for short to ground" VALUE 0x71472 TKW_VV_VV_UW 100.0 FORMULA_0010 0.0 65535.0000 /end CHARACTERISTIC
/begin CHARACTERISTIC K_ED_DK1_ENLTG.P_CODE_SH_TO_GND "P-Code fuer die Art SH_TO_GND | EN: Fault code DK1_ENLTG - OBD P-code reported for short to ground" VALUE 0x714A6 TKW_VV_VV_UW 100.0 FORMULA_0010 0.0 65535.0000 /end CHARACTERISTIC
/begin CHARACTERISTIC K_ED_DK2_ENLTG.P_CODE_SH_TO_GND "P-Code fuer die Art SH_TO_GND | EN: Fault code DK2_ENLTG - OBD P-code reported for short to ground" VALUE 0x714C0 TKW_VV_VV_UW 100.0 FORMULA_0010 0.0 65535.0000 /end CHARACTERISTIC
/begin CHARACTERISTIC K_ED_E2_INJ.P_CODE_SH_TO_GND "P-Code fuer die Art SH_TO_GND | EN: Fault code E2_INJ - OBD P-code reported for short to ground" VALUE 0x7155C TKW_VV_VV_UW 100.0 FORMULA_0010 0.0 65535.0000 /end CHARACTERISTIC
/begin CHARACTERISTIC K_ED_FETRAWE.P_CODE_SH_TO_GND "P-Code fuer die Art SH_TO_GND | EN: Fault code FETRAWE - OBD P-code reported for short to ground" VALUE 0x7167A TKW_VV_VV_UW 100.0 FORMULA_0010 0.0 65535.0000 /end CHARACTERISTIC
/begin CHARACTERISTIC K_ED_ELUP.P_CODE_SH_TO_GND "P-Code fuer die Art SH_TO_GND | EN: Fault code ELUP - OBD P-code reported for short to ground" VALUE 0x716E2 TKW_VV_VV_UW 100.0 FORMULA_0010 0.0 65535.0000 /end CHARACTERISTIC
/begin CHARACTERISTIC K_ED_ELU.P_CODE_SH_TO_GND "P-Code fuer die Art SH_TO_GND | EN: Fault code ELU - OBD P-code reported for short to ground" VALUE 0x716FC TKW_VV_VV_UW 100.0 FORMULA_0010 0.0 65535.0000 /end CHARACTERISTIC
/begin CHARACTERISTIC K_ED_DMTL_FEINLECK.P_CODE_SH_TO_GND "P-Code fuer die Art SH_TO_GND | EN: Fault code DMTL_FEINLECK - OBD P-code reported for short to ground" VALUE 0x7181A TKW_VV_VV_UW 100.0 FORMULA_0010 0.0 65535.0000 /end CHARACTERISTIC
/begin CHARACTERISTIC K_ED_ELUP_OBD.P_CODE_SH_TO_GND "P-Code fuer die Art SH_TO_GND" VALUE 0x71A70 TKW_VV_VV_UW 100.0 FORMULA_0010 0.0 65535.0000 /end CHARACTERISTIC
/begin CHARACTERISTIC K_ED_APPL_DATA_INJ.P_CODE_OPENLOAD "P-Code fuer die Art OPENLOAD | EN: Fault code APPL_DATA_INJ - OBD P-code reported for open circuit" VALUE 0x70CA2 TKW_VV_VV_UW 100.0 FORMULA_0010 0.0 65535.0000 /end CHARACTERISTIC
/begin CHARACTERISTIC K_ED_EV1.P_CODE_OPENLOAD "P-Code fuer die Art OPENLOAD | EN: Fault code EV1 - OBD P-code reported for open circuit" VALUE 0x70EC4 TKW_VV_VV_UW 100.0 FORMULA_0010 0.0 65535.0000 /end CHARACTERISTIC
/begin CHARACTERISTIC K_ED_EV2.P_CODE_OPENLOAD "P-Code fuer die Art OPENLOAD | EN: Fault code EV2 - OBD P-code reported for open circuit" VALUE 0x70EDE TKW_VV_VV_UW 100.0 FORMULA_0010 0.0 65535.0000 /end CHARACTERISTIC
/begin CHARACTERISTIC K_ED_EV3.P_CODE_OPENLOAD "P-Code fuer die Art OPENLOAD | EN: Fault code EV3 - OBD P-code reported for open circuit" VALUE 0x70EF8 TKW_VV_VV_UW 100.0 FORMULA_0010 0.0 65535.0000 /end CHARACTERISTIC
/begin CHARACTERISTIC K_ED_EV4.P_CODE_OPENLOAD "P-Code fuer die Art OPENLOAD | EN: Fault code EV4 - OBD P-code reported for open circuit" VALUE 0x70F12 TKW_VV_VV_UW 100.0 FORMULA_0010 0.0 65535.0000 /end CHARACTERISTIC
/begin CHARACTERISTIC K_ED_EV5.P_CODE_OPENLOAD "P-Code fuer die Art OPENLOAD | EN: Fault code EV5 - OBD P-code reported for open circuit" VALUE 0x70F2C TKW_VV_VV_UW 100.0 FORMULA_0010 0.0 65535.0000 /end CHARACTERISTIC
/begin CHARACTERISTIC K_ED_EV6.P_CODE_OPENLOAD "P-Code fuer die Art OPENLOAD | EN: Fault code EV6 - OBD P-code reported for open circuit" VALUE 0x70F46 TKW_VV_VV_UW 100.0 FORMULA_0010 0.0 65535.0000 /end CHARACTERISTIC
/begin CHARACTERISTIC K_ED_EV7.P_CODE_OPENLOAD "P-Code fuer die Art OPENLOAD | EN: Fault code EV7 - OBD P-code reported for open circuit" VALUE 0x70F60 TKW_VV_VV_UW 100.0 FORMULA_0010 0.0 65535.0000 /end CHARACTERISTIC
/begin CHARACTERISTIC K_ED_EV8.P_CODE_OPENLOAD "P-Code fuer die Art OPENLOAD | EN: Fault code EV8 - OBD P-code reported for open circuit" VALUE 0x70F7A TKW_VV_VV_UW 100.0 FORMULA_0010 0.0 65535.0000 /end CHARACTERISTIC
/begin CHARACTERISTIC K_ED_EV9.P_CODE_OPENLOAD "P-Code fuer die Art OPENLOAD | EN: Fault code EV9 - OBD P-code reported for open circuit" VALUE 0x70F94 TKW_VV_VV_UW 100.0 FORMULA_0010 0.0 65535.0000 /end CHARACTERISTIC
/begin CHARACTERISTIC K_ED_EV10.P_CODE_OPENLOAD "P-Code fuer die Art OPENLOAD | EN: Fault code EV10 - OBD P-code reported for open circuit" VALUE 0x70FAE TKW_VV_VV_UW 100.0 FORMULA_0010 0.0 65535.0000 /end CHARACTERISTIC
/begin CHARACTERISTIC K_ED_DMTL_P.P_CODE_OPENLOAD "P-Code fuer die Art OPENLOAD | EN: Fault code DMTL_P - OBD P-code reported for open circuit" VALUE 0x7104A TKW_VV_VV_UW 100.0 FORMULA_0010 0.0 65535.0000 /end CHARACTERISTIC
/begin CHARACTERISTIC K_ED_DMTL_V.P_CODE_OPENLOAD "P-Code fuer die Art OPENLOAD | EN: Fault code DMTL_V - OBD P-code reported for open circuit" VALUE 0x71064 TKW_VV_VV_UW 100.0 FORMULA_0010 0.0 65535.0000 /end CHARACTERISTIC
/begin CHARACTERISTIC K_ED_DMTL_H.P_CODE_OPENLOAD "P-Code fuer die Art OPENLOAD | EN: Fault code DMTL_H - OBD P-code reported for open circuit" VALUE 0x7107E TKW_VV_VV_UW 100.0 FORMULA_0010 0.0 65535.0000 /end CHARACTERISTIC
/begin CHARACTERISTIC K_ED_DMTL_GROBLECK.P_CODE_OPENLOAD "P-Code fuer die Art OPENLOAD | EN: Fault code DMTL_GROBLECK - OBD P-code reported for open circuit" VALUE 0x71098 TKW_VV_VV_UW 100.0 FORMULA_0010 0.0 65535.0000 /end CHARACTERISTIC
/begin CHARACTERISTIC K_ED_DMTL_FEUCHT.P_CODE_OPENLOAD "P-Code fuer die Art OPENLOAD | EN: Fault code DMTL_FEUCHT - OBD P-code reported for open circuit" VALUE 0x710B2 TKW_VV_VV_UW 100.0 FORMULA_0010 0.0 65535.0000 /end CHARACTERISTIC
/begin CHARACTERISTIC K_ED_DMTL_DECKEL.P_CODE_OPENLOAD "P-Code fuer die Art OPENLOAD | EN: Fault code DMTL_DECKEL - OBD P-code reported for open circuit" VALUE 0x710CC TKW_VV_VV_UW 100.0 FORMULA_0010 0.0 65535.0000 /end CHARACTERISTIC
/begin CHARACTERISTIC K_ED_EKP_PWM.P_CODE_OPENLOAD "P-Code fuer die Art OPENLOAD | EN: Fault code EKP_PWM - OBD P-code reported for open circuit" VALUE 0x71134 TKW_VV_VV_UW 100.0 FORMULA_0010 0.0 65535.0000 /end CHARACTERISTIC
/begin CHARACTERISTIC K_ED_EWS_SCI.P_CODE_OPENLOAD "P-Code fuer die Art OPENLOAD | EN: Fault code EWS_SCI - OBD P-code reported for open circuit" VALUE 0x713BE TKW_VV_VV_UW 100.0 FORMULA_0010 0.0 65535.0000 /end CHARACTERISTIC
/begin CHARACTERISTIC K_ED_EWS_MAN.P_CODE_OPENLOAD "P-Code fuer die Art OPENLOAD | EN: Fault code EWS_MAN - OBD P-code reported for open circuit" VALUE 0x713D8 TKW_VV_VV_UW 100.0 FORMULA_0010 0.0 65535.0000 /end CHARACTERISTIC
/begin CHARACTERISTIC K_ED_EBOX_ELU.P_CODE_OPENLOAD "P-Code fuer die Art OPENLOAD | EN: Fault code EBOX_ELU - OBD P-code reported for open circuit" VALUE 0x71474 TKW_VV_VV_UW 100.0 FORMULA_0010 0.0 65535.0000 /end CHARACTERISTIC
/begin CHARACTERISTIC K_ED_DK1_ENLTG.P_CODE_OPENLOAD "P-Code fuer die Art OPENLOAD | EN: Fault code DK1_ENLTG - OBD P-code reported for open circuit" VALUE 0x714A8 TKW_VV_VV_UW 100.0 FORMULA_0010 0.0 65535.0000 /end CHARACTERISTIC
/begin CHARACTERISTIC K_ED_DK2_ENLTG.P_CODE_OPENLOAD "P-Code fuer die Art OPENLOAD | EN: Fault code DK2_ENLTG - OBD P-code reported for open circuit" VALUE 0x714C2 TKW_VV_VV_UW 100.0 FORMULA_0010 0.0 65535.0000 /end CHARACTERISTIC
/begin CHARACTERISTIC K_ED_E2_INJ.P_CODE_OPENLOAD "P-Code fuer die Art OPENLOAD | EN: Fault code E2_INJ - OBD P-code reported for open circuit" VALUE 0x7155E TKW_VV_VV_UW 100.0 FORMULA_0010 0.0 65535.0000 /end CHARACTERISTIC
/begin CHARACTERISTIC K_ED_FETRAWE.P_CODE_OPENLOAD "P-Code fuer die Art OPENLOAD | EN: Fault code FETRAWE - OBD P-code reported for open circuit" VALUE 0x7167C TKW_VV_VV_UW 100.0 FORMULA_0010 0.0 65535.0000 /end CHARACTERISTIC
/begin CHARACTERISTIC K_ED_ELUP.P_CODE_OPENLOAD "P-Code fuer die Art OPENLOAD | EN: Fault code ELUP - OBD P-code reported for open circuit" VALUE 0x716E4 TKW_VV_VV_UW 100.0 FORMULA_0010 0.0 65535.0000 /end CHARACTERISTIC
/begin CHARACTERISTIC K_ED_ELU.P_CODE_OPENLOAD "P-Code fuer die Art OPENLOAD | EN: Fault code ELU - OBD P-code reported for open circuit" VALUE 0x716FE TKW_VV_VV_UW 100.0 FORMULA_0010 0.0 65535.0000 /end CHARACTERISTIC
/begin CHARACTERISTIC K_ED_DMTL_FEINLECK.P_CODE_OPENLOAD "P-Code fuer die Art OPENLOAD | EN: Fault code DMTL_FEINLECK - OBD P-code reported for open circuit" VALUE 0x7181C TKW_VV_VV_UW 100.0 FORMULA_0010 0.0 65535.0000 /end CHARACTERISTIC
/begin CHARACTERISTIC K_ED_ELUP_OBD.P_CODE_OPENLOAD "P-Code fuer die Art OPENLOAD" VALUE 0x71A72 TKW_VV_VV_UW 100.0 FORMULA_0010 0.0 65535.0000 /end CHARACTERISTIC
/begin CHARACTERISTIC K_ED_APPL_DATA_INJ.P_CODE_UNPLAUSIBEL "P-Code fuer die Art UNPLAUSIBEL | EN: Fault code APPL_DATA_INJ - OBD P-code reported for implausible signal" VALUE 0x70CA4 TKW_VV_VV_UW 100.0 FORMULA_0010 0.0 65535.0000 /end CHARACTERISTIC
/begin CHARACTERISTIC K_ED_EV1.P_CODE_UNPLAUSIBEL "P-Code fuer die Art UNPLAUSIBEL | EN: Fault code EV1 - OBD P-code reported for implausible signal" VALUE 0x70EC6 TKW_VV_VV_UW 100.0 FORMULA_0010 0.0 65535.0000 /end CHARACTERISTIC
/begin CHARACTERISTIC K_ED_EV2.P_CODE_UNPLAUSIBEL "P-Code fuer die Art UNPLAUSIBEL | EN: Fault code EV2 - OBD P-code reported for implausible signal" VALUE 0x70EE0 TKW_VV_VV_UW 100.0 FORMULA_0010 0.0 65535.0000 /end CHARACTERISTIC
/begin CHARACTERISTIC K_ED_EV3.P_CODE_UNPLAUSIBEL "P-Code fuer die Art UNPLAUSIBEL | EN: Fault code EV3 - OBD P-code reported for implausible signal" VALUE 0x70EFA TKW_VV_VV_UW 100.0 FORMULA_0010 0.0 65535.0000 /end CHARACTERISTIC
/begin CHARACTERISTIC K_ED_EV4.P_CODE_UNPLAUSIBEL "P-Code fuer die Art UNPLAUSIBEL | EN: Fault code EV4 - OBD P-code reported for implausible signal" VALUE 0x70F14 TKW_VV_VV_UW 100.0 FORMULA_0010 0.0 65535.0000 /end CHARACTERISTIC
/begin CHARACTERISTIC K_ED_EV5.P_CODE_UNPLAUSIBEL "P-Code fuer die Art UNPLAUSIBEL | EN: Fault code EV5 - OBD P-code reported for implausible signal" VALUE 0x70F2E TKW_VV_VV_UW 100.0 FORMULA_0010 0.0 65535.0000 /end CHARACTERISTIC
/begin CHARACTERISTIC K_ED_EV6.P_CODE_UNPLAUSIBEL "P-Code fuer die Art UNPLAUSIBEL | EN: Fault code EV6 - OBD P-code reported for implausible signal" VALUE 0x70F48 TKW_VV_VV_UW 100.0 FORMULA_0010 0.0 65535.0000 /end CHARACTERISTIC
/begin CHARACTERISTIC K_ED_EV7.P_CODE_UNPLAUSIBEL "P-Code fuer die Art UNPLAUSIBEL | EN: Fault code EV7 - OBD P-code reported for implausible signal" VALUE 0x70F62 TKW_VV_VV_UW 100.0 FORMULA_0010 0.0 65535.0000 /end CHARACTERISTIC
/begin CHARACTERISTIC K_ED_EV8.P_CODE_UNPLAUSIBEL "P-Code fuer die Art UNPLAUSIBEL | EN: Fault code EV8 - OBD P-code reported for implausible signal" VALUE 0x70F7C TKW_VV_VV_UW 100.0 FORMULA_0010 0.0 65535.0000 /end CHARACTERISTIC
/begin CHARACTERISTIC K_ED_EV9.P_CODE_UNPLAUSIBEL "P-Code fuer die Art UNPLAUSIBEL | EN: Fault code EV9 - OBD P-code reported for implausible signal" VALUE 0x70F96 TKW_VV_VV_UW 100.0 FORMULA_0010 0.0 65535.0000 /end CHARACTERISTIC
/begin CHARACTERISTIC K_ED_EV10.P_CODE_UNPLAUSIBEL "P-Code fuer die Art UNPLAUSIBEL | EN: Fault code EV10 - OBD P-code reported for implausible signal" VALUE 0x70FB0 TKW_VV_VV_UW 100.0 FORMULA_0010 0.0 65535.0000 /end CHARACTERISTIC
/begin CHARACTERISTIC K_ED_DMTL_P.P_CODE_UNPLAUSIBEL "P-Code fuer die Art UNPLAUSIBEL | EN: Fault code DMTL_P - OBD P-code reported for implausible signal" VALUE 0x7104C TKW_VV_VV_UW 100.0 FORMULA_0010 0.0 65535.0000 /end CHARACTERISTIC
/begin CHARACTERISTIC K_ED_DMTL_V.P_CODE_UNPLAUSIBEL "P-Code fuer die Art UNPLAUSIBEL | EN: Fault code DMTL_V - OBD P-code reported for implausible signal" VALUE 0x71066 TKW_VV_VV_UW 100.0 FORMULA_0010 0.0 65535.0000 /end CHARACTERISTIC
/begin CHARACTERISTIC K_ED_DMTL_H.P_CODE_UNPLAUSIBEL "P-Code fuer die Art UNPLAUSIBEL | EN: Fault code DMTL_H - OBD P-code reported for implausible signal" VALUE 0x71080 TKW_VV_VV_UW 100.0 FORMULA_0010 0.0 65535.0000 /end CHARACTERISTIC
/begin CHARACTERISTIC K_ED_DMTL_GROBLECK.P_CODE_UNPLAUSIBEL "P-Code fuer die Art UNPLAUSIBEL | EN: Fault code DMTL_GROBLECK - OBD P-code reported for implausible signal" VALUE 0x7109A TKW_VV_VV_UW 100.0 FORMULA_0010 0.0 65535.0000 /end CHARACTERISTIC
/begin CHARACTERISTIC K_ED_DMTL_FEUCHT.P_CODE_UNPLAUSIBEL "P-Code fuer die Art UNPLAUSIBEL | EN: Fault code DMTL_FEUCHT - OBD P-code reported for implausible signal" VALUE 0x710B4 TKW_VV_VV_UW 100.0 FORMULA_0010 0.0 65535.0000 /end CHARACTERISTIC
/begin CHARACTERISTIC K_ED_DMTL_DECKEL.P_CODE_UNPLAUSIBEL "P-Code fuer die Art UNPLAUSIBEL | EN: Fault code DMTL_DECKEL - OBD P-code reported for implausible signal" VALUE 0x710CE TKW_VV_VV_UW 100.0 FORMULA_0010 0.0 65535.0000 /end CHARACTERISTIC
/begin CHARACTERISTIC K_ED_EKP_PWM.P_CODE_UNPLAUSIBEL "P-Code fuer die Art UNPLAUSIBEL | EN: Fault code EKP_PWM - OBD P-code reported for implausible signal" VALUE 0x71136 TKW_VV_VV_UW 100.0 FORMULA_0010 0.0 65535.0000 /end CHARACTERISTIC
/begin CHARACTERISTIC K_ED_EWS_SCI.P_CODE_UNPLAUSIBEL "P-Code fuer die Art UNPLAUSIBEL | EN: Fault code EWS_SCI - OBD P-code reported for implausible signal" VALUE 0x713C0 TKW_VV_VV_UW 100.0 FORMULA_0010 0.0 65535.0000 /end CHARACTERISTIC
/begin CHARACTERISTIC K_ED_EWS_MAN.P_CODE_UNPLAUSIBEL "P-Code fuer die Art UNPLAUSIBEL | EN: Fault code EWS_MAN - OBD P-code reported for implausible signal" VALUE 0x713DA TKW_VV_VV_UW 100.0 FORMULA_0010 0.0 65535.0000 /end CHARACTERISTIC
/begin CHARACTERISTIC K_ED_EBOX_ELU.P_CODE_UNPLAUSIBEL "P-Code fuer die Art UNPLAUSIBEL | EN: Fault code EBOX_ELU - OBD P-code reported for implausible signal" VALUE 0x71476 TKW_VV_VV_UW 100.0 FORMULA_0010 0.0 65535.0000 /end CHARACTERISTIC
/begin CHARACTERISTIC K_ED_DK1_ENLTG.P_CODE_UNPLAUSIBEL "P-Code fuer die Art UNPLAUSIBEL | EN: Fault code DK1_ENLTG - OBD P-code reported for implausible signal" VALUE 0x714AA TKW_VV_VV_UW 100.0 FORMULA_0010 0.0 65535.0000 /end CHARACTERISTIC
/begin CHARACTERISTIC K_ED_DK2_ENLTG.P_CODE_UNPLAUSIBEL "P-Code fuer die Art UNPLAUSIBEL | EN: Fault code DK2_ENLTG - OBD P-code reported for implausible signal" VALUE 0x714C4 TKW_VV_VV_UW 100.0 FORMULA_0010 0.0 65535.0000 /end CHARACTERISTIC
/begin CHARACTERISTIC K_ED_E2_INJ.P_CODE_UNPLAUSIBEL "P-Code fuer die Art UNPLAUSIBEL | EN: Fault code E2_INJ - OBD P-code reported for implausible signal" VALUE 0x71560 TKW_VV_VV_UW 100.0 FORMULA_0010 0.0 65535.0000 /end CHARACTERISTIC
/begin CHARACTERISTIC K_ED_FETRAWE.P_CODE_UNPLAUSIBEL "P-Code fuer die Art UNPLAUSIBEL | EN: Fault code FETRAWE - OBD P-code reported for implausible signal" VALUE 0x7167E TKW_VV_VV_UW 100.0 FORMULA_0010 0.0 65535.0000 /end CHARACTERISTIC
/begin CHARACTERISTIC K_ED_ELUP.P_CODE_UNPLAUSIBEL "P-Code fuer die Art UNPLAUSIBEL | EN: Fault code ELUP - OBD P-code reported for implausible signal" VALUE 0x716E6 TKW_VV_VV_UW 100.0 FORMULA_0010 0.0 65535.0000 /end CHARACTERISTIC
/begin CHARACTERISTIC K_ED_ELU.P_CODE_UNPLAUSIBEL "P-Code fuer die Art UNPLAUSIBEL | EN: Fault code ELU - OBD P-code reported for implausible signal" VALUE 0x71700 TKW_VV_VV_UW 100.0 FORMULA_0010 0.0 65535.0000 /end CHARACTERISTIC
/begin CHARACTERISTIC K_ED_DMTL_FEINLECK.P_CODE_UNPLAUSIBEL "P-Code fuer die Art UNPLAUSIBEL | EN: Fault code DMTL_FEINLECK - OBD P-code reported for implausible signal" VALUE 0x7181E TKW_VV_VV_UW 100.0 FORMULA_0010 0.0 65535.0000 /end CHARACTERISTIC
/begin CHARACTERISTIC K_ED_ELUP_OBD.P_CODE_UNPLAUSIBEL "P-Code fuer die Art UNPLAUSIBEL" VALUE 0x71A74 TKW_VV_VV_UW 100.0 FORMULA_0010 0.0 65535.0000 /end CHARACTERISTIC
/begin CHARACTERISTIC K_ED_APPL_DATA_INJ.FEHLERSCHWELLE "Filterschwelle fuer Fehlereintrag | EN: Fault code APPL_DATA_INJ - debounce filter threshold for setting the fault" VALUE 0x70CA6 TKW_VV_VV_UB 100.0 FORMULA_0003 0.0 255.0000 /end CHARACTERISTIC
/begin CHARACTERISTIC K_ED_EV1.FEHLERSCHWELLE "Filterschwelle fuer Fehlereintrag | EN: Fault code EV1 - debounce filter threshold for setting the fault" VALUE 0x70EC8 TKW_VV_VV_UB 100.0 FORMULA_0003 0.0 255.0000 /end CHARACTERISTIC
/begin CHARACTERISTIC K_ED_EV2.FEHLERSCHWELLE "Filterschwelle fuer Fehlereintrag | EN: Fault code EV2 - debounce filter threshold for setting the fault" VALUE 0x70EE2 TKW_VV_VV_UB 100.0 FORMULA_0003 0.0 255.0000 /end CHARACTERISTIC
/begin CHARACTERISTIC K_ED_EV3.FEHLERSCHWELLE "Filterschwelle fuer Fehlereintrag | EN: Fault code EV3 - debounce filter threshold for setting the fault" VALUE 0x70EFC TKW_VV_VV_UB 100.0 FORMULA_0003 0.0 255.0000 /end CHARACTERISTIC
/begin CHARACTERISTIC K_ED_EV4.FEHLERSCHWELLE "Filterschwelle fuer Fehlereintrag | EN: Fault code EV4 - debounce filter threshold for setting the fault" VALUE 0x70F16 TKW_VV_VV_UB 100.0 FORMULA_0003 0.0 255.0000 /end CHARACTERISTIC
/begin CHARACTERISTIC K_ED_EV5.FEHLERSCHWELLE "Filterschwelle fuer Fehlereintrag | EN: Fault code EV5 - debounce filter threshold for setting the fault" VALUE 0x70F30 TKW_VV_VV_UB 100.0 FORMULA_0003 0.0 255.0000 /end CHARACTERISTIC
/begin CHARACTERISTIC K_ED_EV6.FEHLERSCHWELLE "Filterschwelle fuer Fehlereintrag | EN: Fault code EV6 - debounce filter threshold for setting the fault" VALUE 0x70F4A TKW_VV_VV_UB 100.0 FORMULA_0003 0.0 255.0000 /end CHARACTERISTIC
/begin CHARACTERISTIC K_ED_EV7.FEHLERSCHWELLE "Filterschwelle fuer Fehlereintrag | EN: Fault code EV7 - debounce filter threshold for setting the fault" VALUE 0x70F64 TKW_VV_VV_UB 100.0 FORMULA_0003 0.0 255.0000 /end CHARACTERISTIC
/begin CHARACTERISTIC K_ED_EV8.FEHLERSCHWELLE "Filterschwelle fuer Fehlereintrag | EN: Fault code EV8 - debounce filter threshold for setting the fault" VALUE 0x70F7E TKW_VV_VV_UB 100.0 FORMULA_0003 0.0 255.0000 /end CHARACTERISTIC
/begin CHARACTERISTIC K_ED_EV9.FEHLERSCHWELLE "Filterschwelle fuer Fehlereintrag | EN: Fault code EV9 - debounce filter threshold for setting the fault" VALUE 0x70F98 TKW_VV_VV_UB 100.0 FORMULA_0003 0.0 255.0000 /end CHARACTERISTIC
/begin CHARACTERISTIC K_ED_EV10.FEHLERSCHWELLE "Filterschwelle fuer Fehlereintrag | EN: Fault code EV10 - debounce filter threshold for setting the fault" VALUE 0x70FB2 TKW_VV_VV_UB 100.0 FORMULA_0003 0.0 255.0000 /end CHARACTERISTIC
/begin CHARACTERISTIC K_ED_DMTL_P.FEHLERSCHWELLE "Filterschwelle fuer Fehlereintrag | EN: Fault code DMTL_P - debounce filter threshold for setting the fault" VALUE 0x7104E TKW_VV_VV_UB 100.0 FORMULA_0003 0.0 255.0000 /end CHARACTERISTIC
/begin CHARACTERISTIC K_ED_DMTL_V.FEHLERSCHWELLE "Filterschwelle fuer Fehlereintrag | EN: Fault code DMTL_V - debounce filter threshold for setting the fault" VALUE 0x71068 TKW_VV_VV_UB 100.0 FORMULA_0003 0.0 255.0000 /end CHARACTERISTIC
/begin CHARACTERISTIC K_ED_DMTL_H.FEHLERSCHWELLE "Filterschwelle fuer Fehlereintrag | EN: Fault code DMTL_H - debounce filter threshold for setting the fault" VALUE 0x71082 TKW_VV_VV_UB 100.0 FORMULA_0003 0.0 255.0000 /end CHARACTERISTIC
/begin CHARACTERISTIC K_ED_DMTL_GROBLECK.FEHLERSCHWELLE "Filterschwelle fuer Fehlereintrag | EN: Fault code DMTL_GROBLECK - debounce filter threshold for setting the fault" VALUE 0x7109C TKW_VV_VV_UB 100.0 FORMULA_0003 0.0 255.0000 /end CHARACTERISTIC
/begin CHARACTERISTIC K_ED_DMTL_FEUCHT.FEHLERSCHWELLE "Filterschwelle fuer Fehlereintrag | EN: Fault code DMTL_FEUCHT - debounce filter threshold for setting the fault" VALUE 0x710B6 TKW_VV_VV_UB 100.0 FORMULA_0003 0.0 255.0000 /end CHARACTERISTIC
/begin CHARACTERISTIC K_ED_DMTL_DECKEL.FEHLERSCHWELLE "Filterschwelle fuer Fehlereintrag | EN: Fault code DMTL_DECKEL - debounce filter threshold for setting the fault" VALUE 0x710D0 TKW_VV_VV_UB 100.0 FORMULA_0003 0.0 255.0000 /end CHARACTERISTIC
/begin CHARACTERISTIC K_ED_EKP_PWM.FEHLERSCHWELLE "Filterschwelle fuer Fehlereintrag | EN: Fault code EKP_PWM - debounce filter threshold for setting the fault" VALUE 0x71138 TKW_VV_VV_UB 100.0 FORMULA_0003 0.0 255.0000 /end CHARACTERISTIC
/begin CHARACTERISTIC K_ED_EWS_SCI.FEHLERSCHWELLE "Filterschwelle fuer Fehlereintrag | EN: Fault code EWS_SCI - debounce filter threshold for setting the fault" VALUE 0x713C2 TKW_VV_VV_UB 100.0 FORMULA_0003 0.0 255.0000 /end CHARACTERISTIC
/begin CHARACTERISTIC K_ED_EWS_MAN.FEHLERSCHWELLE "Filterschwelle fuer Fehlereintrag | EN: Fault code EWS_MAN - debounce filter threshold for setting the fault" VALUE 0x713DC TKW_VV_VV_UB 100.0 FORMULA_0003 0.0 255.0000 /end CHARACTERISTIC
/begin CHARACTERISTIC K_ED_EBOX_ELU.FEHLERSCHWELLE "Filterschwelle fuer Fehlereintrag | EN: Fault code EBOX_ELU - debounce filter threshold for setting the fault" VALUE 0x71478 TKW_VV_VV_UB 100.0 FORMULA_0003 0.0 255.0000 /end CHARACTERISTIC
/begin CHARACTERISTIC K_ED_DK1_ENLTG.FEHLERSCHWELLE "Filterschwelle fuer Fehlereintrag | EN: Fault code DK1_ENLTG - debounce filter threshold for setting the fault" VALUE 0x714AC TKW_VV_VV_UB 100.0 FORMULA_0003 0.0 255.0000 /end CHARACTERISTIC
/begin CHARACTERISTIC K_ED_DK2_ENLTG.FEHLERSCHWELLE "Filterschwelle fuer Fehlereintrag | EN: Fault code DK2_ENLTG - debounce filter threshold for setting the fault" VALUE 0x714C6 TKW_VV_VV_UB 100.0 FORMULA_0003 0.0 255.0000 /end CHARACTERISTIC
/begin CHARACTERISTIC K_ED_E2_INJ.FEHLERSCHWELLE "Filterschwelle fuer Fehlereintrag | EN: Fault code E2_INJ - debounce filter threshold for setting the fault" VALUE 0x71562 TKW_VV_VV_UB 100.0 FORMULA_0003 0.0 255.0000 /end CHARACTERISTIC
/begin CHARACTERISTIC K_ED_FETRAWE.FEHLERSCHWELLE "Filterschwelle fuer Fehlereintrag | EN: Fault code FETRAWE - debounce filter threshold for setting the fault" VALUE 0x71680 TKW_VV_VV_UB 100.0 FORMULA_0003 0.0 255.0000 /end CHARACTERISTIC
/begin CHARACTERISTIC K_ED_ELUP.FEHLERSCHWELLE "Filterschwelle fuer Fehlereintrag | EN: Fault code ELUP - debounce filter threshold for setting the fault" VALUE 0x716E8 TKW_VV_VV_UB 100.0 FORMULA_0003 0.0 255.0000 /end CHARACTERISTIC
/begin CHARACTERISTIC K_ED_ELU.FEHLERSCHWELLE "Filterschwelle fuer Fehlereintrag | EN: Fault code ELU - debounce filter threshold for setting the fault" VALUE 0x71702 TKW_VV_VV_UB 100.0 FORMULA_0003 0.0 255.0000 /end CHARACTERISTIC
/begin CHARACTERISTIC K_ED_DMTL_FEINLECK.FEHLERSCHWELLE "Filterschwelle fuer Fehlereintrag | EN: Fault code DMTL_FEINLECK - debounce filter threshold for setting the fault" VALUE 0x71820 TKW_VV_VV_UB 100.0 FORMULA_0003 0.0 255.0000 /end CHARACTERISTIC
/begin CHARACTERISTIC K_ED_ELUP_OBD.FEHLERSCHWELLE "Filterschwelle fuer Fehlereintrag" VALUE 0x71A76 TKW_VV_VV_UB 100.0 FORMULA_0003 0.0 255.0000 /end CHARACTERISTIC
/begin CHARACTERISTIC K_ED_APPL_DATA_INJ.OK_SCHWELLE "Filterschwelle fuer Fehleraustrag | EN: Fault code APPL_DATA_INJ - debounce filter threshold for clearing (healing) the fault" VALUE 0x70CA7 TKW_VV_VV_UB 100.0 FORMULA_0003 0.0 255.0000 /end CHARACTERISTIC
/begin CHARACTERISTIC K_ED_EV1.OK_SCHWELLE "Filterschwelle fuer Fehleraustrag | EN: Fault code EV1 - debounce filter threshold for clearing (healing) the fault" VALUE 0x70EC9 TKW_VV_VV_UB 100.0 FORMULA_0003 0.0 255.0000 /end CHARACTERISTIC
/begin CHARACTERISTIC K_ED_EV2.OK_SCHWELLE "Filterschwelle fuer Fehleraustrag | EN: Fault code EV2 - debounce filter threshold for clearing (healing) the fault" VALUE 0x70EE3 TKW_VV_VV_UB 100.0 FORMULA_0003 0.0 255.0000 /end CHARACTERISTIC
/begin CHARACTERISTIC K_ED_EV3.OK_SCHWELLE "Filterschwelle fuer Fehleraustrag | EN: Fault code EV3 - debounce filter threshold for clearing (healing) the fault" VALUE 0x70EFD TKW_VV_VV_UB 100.0 FORMULA_0003 0.0 255.0000 /end CHARACTERISTIC
/begin CHARACTERISTIC K_ED_EV4.OK_SCHWELLE "Filterschwelle fuer Fehleraustrag | EN: Fault code EV4 - debounce filter threshold for clearing (healing) the fault" VALUE 0x70F17 TKW_VV_VV_UB 100.0 FORMULA_0003 0.0 255.0000 /end CHARACTERISTIC
/begin CHARACTERISTIC K_ED_EV5.OK_SCHWELLE "Filterschwelle fuer Fehleraustrag | EN: Fault code EV5 - debounce filter threshold for clearing (healing) the fault" VALUE 0x70F31 TKW_VV_VV_UB 100.0 FORMULA_0003 0.0 255.0000 /end CHARACTERISTIC
/begin CHARACTERISTIC K_ED_EV6.OK_SCHWELLE "Filterschwelle fuer Fehleraustrag | EN: Fault code EV6 - debounce filter threshold for clearing (healing) the fault" VALUE 0x70F4B TKW_VV_VV_UB 100.0 FORMULA_0003 0.0 255.0000 /end CHARACTERISTIC
/begin CHARACTERISTIC K_ED_EV7.OK_SCHWELLE "Filterschwelle fuer Fehleraustrag | EN: Fault code EV7 - debounce filter threshold for clearing (healing) the fault" VALUE 0x70F65 TKW_VV_VV_UB 100.0 FORMULA_0003 0.0 255.0000 /end CHARACTERISTIC
/begin CHARACTERISTIC K_ED_EV8.OK_SCHWELLE "Filterschwelle fuer Fehleraustrag | EN: Fault code EV8 - debounce filter threshold for clearing (healing) the fault" VALUE 0x70F7F TKW_VV_VV_UB 100.0 FORMULA_0003 0.0 255.0000 /end CHARACTERISTIC
/begin CHARACTERISTIC K_ED_EV9.OK_SCHWELLE "Filterschwelle fuer Fehleraustrag | EN: Fault code EV9 - debounce filter threshold for clearing (healing) the fault" VALUE 0x70F99 TKW_VV_VV_UB 100.0 FORMULA_0003 0.0 255.0000 /end CHARACTERISTIC
/begin CHARACTERISTIC K_ED_EV10.OK_SCHWELLE "Filterschwelle fuer Fehleraustrag | EN: Fault code EV10 - debounce filter threshold for clearing (healing) the fault" VALUE 0x70FB3 TKW_VV_VV_UB 100.0 FORMULA_0003 0.0 255.0000 /end CHARACTERISTIC
/begin CHARACTERISTIC K_ED_DMTL_P.OK_SCHWELLE "Filterschwelle fuer Fehleraustrag | EN: Fault code DMTL_P - debounce filter threshold for clearing (healing) the fault" VALUE 0x7104F TKW_VV_VV_UB 100.0 FORMULA_0003 0.0 255.0000 /end CHARACTERISTIC
/begin CHARACTERISTIC K_ED_DMTL_V.OK_SCHWELLE "Filterschwelle fuer Fehleraustrag | EN: Fault code DMTL_V - debounce filter threshold for clearing (healing) the fault" VALUE 0x71069 TKW_VV_VV_UB 100.0 FORMULA_0003 0.0 255.0000 /end CHARACTERISTIC
/begin CHARACTERISTIC K_ED_DMTL_H.OK_SCHWELLE "Filterschwelle fuer Fehleraustrag | EN: Fault code DMTL_H - debounce filter threshold for clearing (healing) the fault" VALUE 0x71083 TKW_VV_VV_UB 100.0 FORMULA_0003 0.0 255.0000 /end CHARACTERISTIC
/begin CHARACTERISTIC K_ED_DMTL_GROBLECK.OK_SCHWELLE "Filterschwelle fuer Fehleraustrag | EN: Fault code DMTL_GROBLECK - debounce filter threshold for clearing (healing) the fault" VALUE 0x7109D TKW_VV_VV_UB 100.0 FORMULA_0003 0.0 255.0000 /end CHARACTERISTIC
/begin CHARACTERISTIC K_ED_DMTL_FEUCHT.OK_SCHWELLE "Filterschwelle fuer Fehleraustrag | EN: Fault code DMTL_FEUCHT - debounce filter threshold for clearing (healing) the fault" VALUE 0x710B7 TKW_VV_VV_UB 100.0 FORMULA_0003 0.0 255.0000 /end CHARACTERISTIC
/begin CHARACTERISTIC K_ED_DMTL_DECKEL.OK_SCHWELLE "Filterschwelle fuer Fehleraustrag | EN: Fault code DMTL_DECKEL - debounce filter threshold for clearing (healing) the fault" VALUE 0x710D1 TKW_VV_VV_UB 100.0 FORMULA_0003 0.0 255.0000 /end CHARACTERISTIC
/begin CHARACTERISTIC K_ED_EKP_PWM.OK_SCHWELLE "Filterschwelle fuer Fehleraustrag | EN: Fault code EKP_PWM - debounce filter threshold for clearing (healing) the fault" VALUE 0x71139 TKW_VV_VV_UB 100.0 FORMULA_0003 0.0 255.0000 /end CHARACTERISTIC
/begin CHARACTERISTIC K_ED_EWS_SCI.OK_SCHWELLE "Filterschwelle fuer Fehleraustrag | EN: Fault code EWS_SCI - debounce filter threshold for clearing (healing) the fault" VALUE 0x713C3 TKW_VV_VV_UB 100.0 FORMULA_0003 0.0 255.0000 /end CHARACTERISTIC
/begin CHARACTERISTIC K_ED_EWS_MAN.OK_SCHWELLE "Filterschwelle fuer Fehleraustrag | EN: Fault code EWS_MAN - debounce filter threshold for clearing (healing) the fault" VALUE 0x713DD TKW_VV_VV_UB 100.0 FORMULA_0003 0.0 255.0000 /end CHARACTERISTIC
/begin CHARACTERISTIC K_ED_EBOX_ELU.OK_SCHWELLE "Filterschwelle fuer Fehleraustrag | EN: Fault code EBOX_ELU - debounce filter threshold for clearing (healing) the fault" VALUE 0x71479 TKW_VV_VV_UB 100.0 FORMULA_0003 0.0 255.0000 /end CHARACTERISTIC
/begin CHARACTERISTIC K_ED_DK1_ENLTG.OK_SCHWELLE "Filterschwelle fuer Fehleraustrag | EN: Fault code DK1_ENLTG - debounce filter threshold for clearing (healing) the fault" VALUE 0x714AD TKW_VV_VV_UB 100.0 FORMULA_0003 0.0 255.0000 /end CHARACTERISTIC
/begin CHARACTERISTIC K_ED_DK2_ENLTG.OK_SCHWELLE "Filterschwelle fuer Fehleraustrag | EN: Fault code DK2_ENLTG - debounce filter threshold for clearing (healing) the fault" VALUE 0x714C7 TKW_VV_VV_UB 100.0 FORMULA_0003 0.0 255.0000 /end CHARACTERISTIC
/begin CHARACTERISTIC K_ED_E2_INJ.OK_SCHWELLE "Filterschwelle fuer Fehleraustrag | EN: Fault code E2_INJ - debounce filter threshold for clearing (healing) the fault" VALUE 0x71563 TKW_VV_VV_UB 100.0 FORMULA_0003 0.0 255.0000 /end CHARACTERISTIC
/begin CHARACTERISTIC K_ED_FETRAWE.OK_SCHWELLE "Filterschwelle fuer Fehleraustrag | EN: Fault code FETRAWE - debounce filter threshold for clearing (healing) the fault" VALUE 0x71681 TKW_VV_VV_UB 100.0 FORMULA_0003 0.0 255.0000 /end CHARACTERISTIC
/begin CHARACTERISTIC K_ED_ELUP.OK_SCHWELLE "Filterschwelle fuer Fehleraustrag | EN: Fault code ELUP - debounce filter threshold for clearing (healing) the fault" VALUE 0x716E9 TKW_VV_VV_UB 100.0 FORMULA_0003 0.0 255.0000 /end CHARACTERISTIC
/begin CHARACTERISTIC K_ED_ELU.OK_SCHWELLE "Filterschwelle fuer Fehleraustrag | EN: Fault code ELU - debounce filter threshold for clearing (healing) the fault" VALUE 0x71703 TKW_VV_VV_UB 100.0 FORMULA_0003 0.0 255.0000 /end CHARACTERISTIC
/begin CHARACTERISTIC K_ED_DMTL_FEINLECK.OK_SCHWELLE "Filterschwelle fuer Fehleraustrag | EN: Fault code DMTL_FEINLECK - debounce filter threshold for clearing (healing) the fault" VALUE 0x71821 TKW_VV_VV_UB 100.0 FORMULA_0003 0.0 255.0000 /end CHARACTERISTIC
/begin CHARACTERISTIC K_ED_ELUP_OBD.OK_SCHWELLE "Filterschwelle fuer Fehleraustrag" VALUE 0x71A77 TKW_VV_VV_UB 100.0 FORMULA_0003 0.0 255.0000 /end CHARACTERISTIC
/begin CHARACTERISTIC K_ED_APPL_DATA_INJ.INC_VOR_EINTRAG "Filtererhoehung vorm Fehlerspeichereintrag | EN: Fault code APPL_DATA_INJ - debounce filter increment before fault-memory entry" VALUE 0x70CA8 TKW_VV_VV_UB 100.0 FORMULA_0003 0.0 255.0000 /end CHARACTERISTIC
/begin CHARACTERISTIC K_ED_EV1.INC_VOR_EINTRAG "Filtererhoehung vorm Fehlerspeichereintrag | EN: Fault code EV1 - debounce filter increment before fault-memory entry" VALUE 0x70ECA TKW_VV_VV_UB 100.0 FORMULA_0003 0.0 255.0000 /end CHARACTERISTIC
/begin CHARACTERISTIC K_ED_EV2.INC_VOR_EINTRAG "Filtererhoehung vorm Fehlerspeichereintrag | EN: Fault code EV2 - debounce filter increment before fault-memory entry" VALUE 0x70EE4 TKW_VV_VV_UB 100.0 FORMULA_0003 0.0 255.0000 /end CHARACTERISTIC
/begin CHARACTERISTIC K_ED_EV3.INC_VOR_EINTRAG "Filtererhoehung vorm Fehlerspeichereintrag | EN: Fault code EV3 - debounce filter increment before fault-memory entry" VALUE 0x70EFE TKW_VV_VV_UB 100.0 FORMULA_0003 0.0 255.0000 /end CHARACTERISTIC
/begin CHARACTERISTIC K_ED_EV4.INC_VOR_EINTRAG "Filtererhoehung vorm Fehlerspeichereintrag | EN: Fault code EV4 - debounce filter increment before fault-memory entry" VALUE 0x70F18 TKW_VV_VV_UB 100.0 FORMULA_0003 0.0 255.0000 /end CHARACTERISTIC
/begin CHARACTERISTIC K_ED_EV5.INC_VOR_EINTRAG "Filtererhoehung vorm Fehlerspeichereintrag | EN: Fault code EV5 - debounce filter increment before fault-memory entry" VALUE 0x70F32 TKW_VV_VV_UB 100.0 FORMULA_0003 0.0 255.0000 /end CHARACTERISTIC
/begin CHARACTERISTIC K_ED_EV6.INC_VOR_EINTRAG "Filtererhoehung vorm Fehlerspeichereintrag | EN: Fault code EV6 - debounce filter increment before fault-memory entry" VALUE 0x70F4C TKW_VV_VV_UB 100.0 FORMULA_0003 0.0 255.0000 /end CHARACTERISTIC
/begin CHARACTERISTIC K_ED_EV7.INC_VOR_EINTRAG "Filtererhoehung vorm Fehlerspeichereintrag | EN: Fault code EV7 - debounce filter increment before fault-memory entry" VALUE 0x70F66 TKW_VV_VV_UB 100.0 FORMULA_0003 0.0 255.0000 /end CHARACTERISTIC
/begin CHARACTERISTIC K_ED_EV8.INC_VOR_EINTRAG "Filtererhoehung vorm Fehlerspeichereintrag | EN: Fault code EV8 - debounce filter increment before fault-memory entry" VALUE 0x70F80 TKW_VV_VV_UB 100.0 FORMULA_0003 0.0 255.0000 /end CHARACTERISTIC
/begin CHARACTERISTIC K_ED_EV9.INC_VOR_EINTRAG "Filtererhoehung vorm Fehlerspeichereintrag | EN: Fault code EV9 - debounce filter increment before fault-memory entry" VALUE 0x70F9A TKW_VV_VV_UB 100.0 FORMULA_0003 0.0 255.0000 /end CHARACTERISTIC
/begin CHARACTERISTIC K_ED_EV10.INC_VOR_EINTRAG "Filtererhoehung vorm Fehlerspeichereintrag | EN: Fault code EV10 - debounce filter increment before fault-memory entry" VALUE 0x70FB4 TKW_VV_VV_UB 100.0 FORMULA_0003 0.0 255.0000 /end CHARACTERISTIC
/begin CHARACTERISTIC K_ED_DMTL_P.INC_VOR_EINTRAG "Filtererhoehung vorm Fehlerspeichereintrag | EN: Fault code DMTL_P - debounce filter increment before fault-memory entry" VALUE 0x71050 TKW_VV_VV_UB 100.0 FORMULA_0003 0.0 255.0000 /end CHARACTERISTIC
/begin CHARACTERISTIC K_ED_DMTL_V.INC_VOR_EINTRAG "Filtererhoehung vorm Fehlerspeichereintrag | EN: Fault code DMTL_V - debounce filter increment before fault-memory entry" VALUE 0x7106A TKW_VV_VV_UB 100.0 FORMULA_0003 0.0 255.0000 /end CHARACTERISTIC
/begin CHARACTERISTIC K_ED_DMTL_H.INC_VOR_EINTRAG "Filtererhoehung vorm Fehlerspeichereintrag | EN: Fault code DMTL_H - debounce filter increment before fault-memory entry" VALUE 0x71084 TKW_VV_VV_UB 100.0 FORMULA_0003 0.0 255.0000 /end CHARACTERISTIC
/begin CHARACTERISTIC K_ED_DMTL_GROBLECK.INC_VOR_EINTRAG "Filtererhoehung vorm Fehlerspeichereintrag | EN: Fault code DMTL_GROBLECK - debounce filter increment before fault-memory entry" VALUE 0x7109E TKW_VV_VV_UB 100.0 FORMULA_0003 0.0 255.0000 /end CHARACTERISTIC
/begin CHARACTERISTIC K_ED_DMTL_FEUCHT.INC_VOR_EINTRAG "Filtererhoehung vorm Fehlerspeichereintrag | EN: Fault code DMTL_FEUCHT - debounce filter increment before fault-memory entry" VALUE 0x710B8 TKW_VV_VV_UB 100.0 FORMULA_0003 0.0 255.0000 /end CHARACTERISTIC
/begin CHARACTERISTIC K_ED_DMTL_DECKEL.INC_VOR_EINTRAG "Filtererhoehung vorm Fehlerspeichereintrag | EN: Fault code DMTL_DECKEL - debounce filter increment before fault-memory entry" VALUE 0x710D2 TKW_VV_VV_UB 100.0 FORMULA_0003 0.0 255.0000 /end CHARACTERISTIC
/begin CHARACTERISTIC K_ED_EKP_PWM.INC_VOR_EINTRAG "Filtererhoehung vorm Fehlerspeichereintrag | EN: Fault code EKP_PWM - debounce filter increment before fault-memory entry" VALUE 0x7113A TKW_VV_VV_UB 100.0 FORMULA_0003 0.0 255.0000 /end CHARACTERISTIC
/begin CHARACTERISTIC K_ED_EWS_SCI.INC_VOR_EINTRAG "Filtererhoehung vorm Fehlerspeichereintrag | EN: Fault code EWS_SCI - debounce filter increment before fault-memory entry" VALUE 0x713C4 TKW_VV_VV_UB 100.0 FORMULA_0003 0.0 255.0000 /end CHARACTERISTIC
/begin CHARACTERISTIC K_ED_EWS_MAN.INC_VOR_EINTRAG "Filtererhoehung vorm Fehlerspeichereintrag | EN: Fault code EWS_MAN - debounce filter increment before fault-memory entry" VALUE 0x713DE TKW_VV_VV_UB 100.0 FORMULA_0003 0.0 255.0000 /end CHARACTERISTIC
/begin CHARACTERISTIC K_ED_EBOX_ELU.INC_VOR_EINTRAG "Filtererhoehung vorm Fehlerspeichereintrag | EN: Fault code EBOX_ELU - debounce filter increment before fault-memory entry" VALUE 0x7147A TKW_VV_VV_UB 100.0 FORMULA_0003 0.0 255.0000 /end CHARACTERISTIC
/begin CHARACTERISTIC K_ED_DK1_ENLTG.INC_VOR_EINTRAG "Filtererhoehung vorm Fehlerspeichereintrag | EN: Fault code DK1_ENLTG - debounce filter increment before fault-memory entry" VALUE 0x714AE TKW_VV_VV_UB 100.0 FORMULA_0003 0.0 255.0000 /end CHARACTERISTIC
/begin CHARACTERISTIC K_ED_DK2_ENLTG.INC_VOR_EINTRAG "Filtererhoehung vorm Fehlerspeichereintrag | EN: Fault code DK2_ENLTG - debounce filter increment before fault-memory entry" VALUE 0x714C8 TKW_VV_VV_UB 100.0 FORMULA_0003 0.0 255.0000 /end CHARACTERISTIC
/begin CHARACTERISTIC K_ED_E2_INJ.INC_VOR_EINTRAG "Filtererhoehung vorm Fehlerspeichereintrag | EN: Fault code E2_INJ - debounce filter increment before fault-memory entry" VALUE 0x71564 TKW_VV_VV_UB 100.0 FORMULA_0003 0.0 255.0000 /end CHARACTERISTIC
/begin CHARACTERISTIC K_ED_FETRAWE.INC_VOR_EINTRAG "Filtererhoehung vorm Fehlerspeichereintrag | EN: Fault code FETRAWE - debounce filter increment before fault-memory entry" VALUE 0x71682 TKW_VV_VV_UB 100.0 FORMULA_0003 0.0 255.0000 /end CHARACTERISTIC
/begin CHARACTERISTIC K_ED_ELUP.INC_VOR_EINTRAG "Filtererhoehung vorm Fehlerspeichereintrag | EN: Fault code ELUP - debounce filter increment before fault-memory entry" VALUE 0x716EA TKW_VV_VV_UB 100.0 FORMULA_0003 0.0 255.0000 /end CHARACTERISTIC
/begin CHARACTERISTIC K_ED_ELU.INC_VOR_EINTRAG "Filtererhoehung vorm Fehlerspeichereintrag | EN: Fault code ELU - debounce filter increment before fault-memory entry" VALUE 0x71704 TKW_VV_VV_UB 100.0 FORMULA_0003 0.0 255.0000 /end CHARACTERISTIC
/begin CHARACTERISTIC K_ED_DMTL_FEINLECK.INC_VOR_EINTRAG "Filtererhoehung vorm Fehlerspeichereintrag | EN: Fault code DMTL_FEINLECK - debounce filter increment before fault-memory entry" VALUE 0x71822 TKW_VV_VV_UB 100.0 FORMULA_0003 0.0 255.0000 /end CHARACTERISTIC
/begin CHARACTERISTIC K_ED_ELUP_OBD.INC_VOR_EINTRAG "Filtererhoehung vorm Fehlerspeichereintrag" VALUE 0x71A78 TKW_VV_VV_UB 100.0 FORMULA_0003 0.0 255.0000 /end CHARACTERISTIC
/begin CHARACTERISTIC K_ED_APPL_DATA_INJ.DEC_VOR_EINTRAG "Filterverringerung vorm Fehlerspeichereintrag | EN: Fault code APPL_DATA_INJ - debounce filter decrement before fault-memory entry" VALUE 0x70CA9 TKW_VV_VV_UB 100.0 FORMULA_0003 0.0 255.0000 /end CHARACTERISTIC
/begin CHARACTERISTIC K_ED_EV1.DEC_VOR_EINTRAG "Filterverringerung vorm Fehlerspeichereintrag | EN: Fault code EV1 - debounce filter decrement before fault-memory entry" VALUE 0x70ECB TKW_VV_VV_UB 100.0 FORMULA_0003 0.0 255.0000 /end CHARACTERISTIC
/begin CHARACTERISTIC K_ED_EV2.DEC_VOR_EINTRAG "Filterverringerung vorm Fehlerspeichereintrag | EN: Fault code EV2 - debounce filter decrement before fault-memory entry" VALUE 0x70EE5 TKW_VV_VV_UB 100.0 FORMULA_0003 0.0 255.0000 /end CHARACTERISTIC
/begin CHARACTERISTIC K_ED_EV3.DEC_VOR_EINTRAG "Filterverringerung vorm Fehlerspeichereintrag | EN: Fault code EV3 - debounce filter decrement before fault-memory entry" VALUE 0x70EFF TKW_VV_VV_UB 100.0 FORMULA_0003 0.0 255.0000 /end CHARACTERISTIC
/begin CHARACTERISTIC K_ED_EV4.DEC_VOR_EINTRAG "Filterverringerung vorm Fehlerspeichereintrag | EN: Fault code EV4 - debounce filter decrement before fault-memory entry" VALUE 0x70F19 TKW_VV_VV_UB 100.0 FORMULA_0003 0.0 255.0000 /end CHARACTERISTIC
/begin CHARACTERISTIC K_ED_EV5.DEC_VOR_EINTRAG "Filterverringerung vorm Fehlerspeichereintrag | EN: Fault code EV5 - debounce filter decrement before fault-memory entry" VALUE 0x70F33 TKW_VV_VV_UB 100.0 FORMULA_0003 0.0 255.0000 /end CHARACTERISTIC
/begin CHARACTERISTIC K_ED_EV6.DEC_VOR_EINTRAG "Filterverringerung vorm Fehlerspeichereintrag | EN: Fault code EV6 - debounce filter decrement before fault-memory entry" VALUE 0x70F4D TKW_VV_VV_UB 100.0 FORMULA_0003 0.0 255.0000 /end CHARACTERISTIC
/begin CHARACTERISTIC K_ED_EV7.DEC_VOR_EINTRAG "Filterverringerung vorm Fehlerspeichereintrag | EN: Fault code EV7 - debounce filter decrement before fault-memory entry" VALUE 0x70F67 TKW_VV_VV_UB 100.0 FORMULA_0003 0.0 255.0000 /end CHARACTERISTIC
/begin CHARACTERISTIC K_ED_EV8.DEC_VOR_EINTRAG "Filterverringerung vorm Fehlerspeichereintrag | EN: Fault code EV8 - debounce filter decrement before fault-memory entry" VALUE 0x70F81 TKW_VV_VV_UB 100.0 FORMULA_0003 0.0 255.0000 /end CHARACTERISTIC
/begin CHARACTERISTIC K_ED_EV9.DEC_VOR_EINTRAG "Filterverringerung vorm Fehlerspeichereintrag | EN: Fault code EV9 - debounce filter decrement before fault-memory entry" VALUE 0x70F9B TKW_VV_VV_UB 100.0 FORMULA_0003 0.0 255.0000 /end CHARACTERISTIC
/begin CHARACTERISTIC K_ED_EV10.DEC_VOR_EINTRAG "Filterverringerung vorm Fehlerspeichereintrag | EN: Fault code EV10 - debounce filter decrement before fault-memory entry" VALUE 0x70FB5 TKW_VV_VV_UB 100.0 FORMULA_0003 0.0 255.0000 /end CHARACTERISTIC
/begin CHARACTERISTIC K_ED_DMTL_P.DEC_VOR_EINTRAG "Filterverringerung vorm Fehlerspeichereintrag | EN: Fault code DMTL_P - debounce filter decrement before fault-memory entry" VALUE 0x71051 TKW_VV_VV_UB 100.0 FORMULA_0003 0.0 255.0000 /end CHARACTERISTIC
/begin CHARACTERISTIC K_ED_DMTL_V.DEC_VOR_EINTRAG "Filterverringerung vorm Fehlerspeichereintrag | EN: Fault code DMTL_V - debounce filter decrement before fault-memory entry" VALUE 0x7106B TKW_VV_VV_UB 100.0 FORMULA_0003 0.0 255.0000 /end CHARACTERISTIC
/begin CHARACTERISTIC K_ED_DMTL_H.DEC_VOR_EINTRAG "Filterverringerung vorm Fehlerspeichereintrag | EN: Fault code DMTL_H - debounce filter decrement before fault-memory entry" VALUE 0x71085 TKW_VV_VV_UB 100.0 FORMULA_0003 0.0 255.0000 /end CHARACTERISTIC
/begin CHARACTERISTIC K_ED_DMTL_GROBLECK.DEC_VOR_EINTRAG "Filterverringerung vorm Fehlerspeichereintrag | EN: Fault code DMTL_GROBLECK - debounce filter decrement before fault-memory entry" VALUE 0x7109F TKW_VV_VV_UB 100.0 FORMULA_0003 0.0 255.0000 /end CHARACTERISTIC
/begin CHARACTERISTIC K_ED_DMTL_FEUCHT.DEC_VOR_EINTRAG "Filterverringerung vorm Fehlerspeichereintrag | EN: Fault code DMTL_FEUCHT - debounce filter decrement before fault-memory entry" VALUE 0x710B9 TKW_VV_VV_UB 100.0 FORMULA_0003 0.0 255.0000 /end CHARACTERISTIC
/begin CHARACTERISTIC K_ED_DMTL_DECKEL.DEC_VOR_EINTRAG "Filterverringerung vorm Fehlerspeichereintrag | EN: Fault code DMTL_DECKEL - debounce filter decrement before fault-memory entry" VALUE 0x710D3 TKW_VV_VV_UB 100.0 FORMULA_0003 0.0 255.0000 /end CHARACTERISTIC
/begin CHARACTERISTIC K_ED_EKP_PWM.DEC_VOR_EINTRAG "Filterverringerung vorm Fehlerspeichereintrag | EN: Fault code EKP_PWM - debounce filter decrement before fault-memory entry" VALUE 0x7113B TKW_VV_VV_UB 100.0 FORMULA_0003 0.0 255.0000 /end CHARACTERISTIC
/begin CHARACTERISTIC K_ED_EWS_SCI.DEC_VOR_EINTRAG "Filterverringerung vorm Fehlerspeichereintrag | EN: Fault code EWS_SCI - debounce filter decrement before fault-memory entry" VALUE 0x713C5 TKW_VV_VV_UB 100.0 FORMULA_0003 0.0 255.0000 /end CHARACTERISTIC
/begin CHARACTERISTIC K_ED_EWS_MAN.DEC_VOR_EINTRAG "Filterverringerung vorm Fehlerspeichereintrag | EN: Fault code EWS_MAN - debounce filter decrement before fault-memory entry" VALUE 0x713DF TKW_VV_VV_UB 100.0 FORMULA_0003 0.0 255.0000 /end CHARACTERISTIC
/begin CHARACTERISTIC K_ED_EBOX_ELU.DEC_VOR_EINTRAG "Filterverringerung vorm Fehlerspeichereintrag | EN: Fault code EBOX_ELU - debounce filter decrement before fault-memory entry" VALUE 0x7147B TKW_VV_VV_UB 100.0 FORMULA_0003 0.0 255.0000 /end CHARACTERISTIC
/begin CHARACTERISTIC K_ED_DK1_ENLTG.DEC_VOR_EINTRAG "Filterverringerung vorm Fehlerspeichereintrag | EN: Fault code DK1_ENLTG - debounce filter decrement before fault-memory entry" VALUE 0x714AF TKW_VV_VV_UB 100.0 FORMULA_0003 0.0 255.0000 /end CHARACTERISTIC
/begin CHARACTERISTIC K_ED_DK2_ENLTG.DEC_VOR_EINTRAG "Filterverringerung vorm Fehlerspeichereintrag | EN: Fault code DK2_ENLTG - debounce filter decrement before fault-memory entry" VALUE 0x714C9 TKW_VV_VV_UB 100.0 FORMULA_0003 0.0 255.0000 /end CHARACTERISTIC
/begin CHARACTERISTIC K_ED_E2_INJ.DEC_VOR_EINTRAG "Filterverringerung vorm Fehlerspeichereintrag | EN: Fault code E2_INJ - debounce filter decrement before fault-memory entry" VALUE 0x71565 TKW_VV_VV_UB 100.0 FORMULA_0003 0.0 255.0000 /end CHARACTERISTIC
/begin CHARACTERISTIC K_ED_FETRAWE.DEC_VOR_EINTRAG "Filterverringerung vorm Fehlerspeichereintrag | EN: Fault code FETRAWE - debounce filter decrement before fault-memory entry" VALUE 0x71683 TKW_VV_VV_UB 100.0 FORMULA_0003 0.0 255.0000 /end CHARACTERISTIC
/begin CHARACTERISTIC K_ED_ELUP.DEC_VOR_EINTRAG "Filterverringerung vorm Fehlerspeichereintrag | EN: Fault code ELUP - debounce filter decrement before fault-memory entry" VALUE 0x716EB TKW_VV_VV_UB 100.0 FORMULA_0003 0.0 255.0000 /end CHARACTERISTIC
/begin CHARACTERISTIC K_ED_ELU.DEC_VOR_EINTRAG "Filterverringerung vorm Fehlerspeichereintrag | EN: Fault code ELU - debounce filter decrement before fault-memory entry" VALUE 0x71705 TKW_VV_VV_UB 100.0 FORMULA_0003 0.0 255.0000 /end CHARACTERISTIC
/begin CHARACTERISTIC K_ED_DMTL_FEINLECK.DEC_VOR_EINTRAG "Filterverringerung vorm Fehlerspeichereintrag | EN: Fault code DMTL_FEINLECK - debounce filter decrement before fault-memory entry" VALUE 0x71823 TKW_VV_VV_UB 100.0 FORMULA_0003 0.0 255.0000 /end CHARACTERISTIC
/begin CHARACTERISTIC K_ED_ELUP_OBD.DEC_VOR_EINTRAG "Filterverringerung vorm Fehlerspeichereintrag" VALUE 0x71A79 TKW_VV_VV_UB 100.0 FORMULA_0003 0.0 255.0000 /end CHARACTERISTIC
/begin CHARACTERISTIC K_ED_APPL_DATA_INJ.INC_NACH_EINTRAG "Filtererhoehung nach Fehlerspeichereintrag | EN: Fault code APPL_DATA_INJ - debounce filter increment after fault-memory entry" VALUE 0x70CAA TKW_VV_VV_UB 100.0 FORMULA_0003 0.0 255.0000 /end CHARACTERISTIC
/begin CHARACTERISTIC K_ED_EV1.INC_NACH_EINTRAG "Filtererhoehung nach Fehlerspeichereintrag | EN: Fault code EV1 - debounce filter increment after fault-memory entry" VALUE 0x70ECC TKW_VV_VV_UB 100.0 FORMULA_0003 0.0 255.0000 /end CHARACTERISTIC
/begin CHARACTERISTIC K_ED_EV2.INC_NACH_EINTRAG "Filtererhoehung nach Fehlerspeichereintrag | EN: Fault code EV2 - debounce filter increment after fault-memory entry" VALUE 0x70EE6 TKW_VV_VV_UB 100.0 FORMULA_0003 0.0 255.0000 /end CHARACTERISTIC
/begin CHARACTERISTIC K_ED_EV3.INC_NACH_EINTRAG "Filtererhoehung nach Fehlerspeichereintrag | EN: Fault code EV3 - debounce filter increment after fault-memory entry" VALUE 0x70F00 TKW_VV_VV_UB 100.0 FORMULA_0003 0.0 255.0000 /end CHARACTERISTIC
/begin CHARACTERISTIC K_ED_EV4.INC_NACH_EINTRAG "Filtererhoehung nach Fehlerspeichereintrag | EN: Fault code EV4 - debounce filter increment after fault-memory entry" VALUE 0x70F1A TKW_VV_VV_UB 100.0 FORMULA_0003 0.0 255.0000 /end CHARACTERISTIC
/begin CHARACTERISTIC K_ED_EV5.INC_NACH_EINTRAG "Filtererhoehung nach Fehlerspeichereintrag | EN: Fault code EV5 - debounce filter increment after fault-memory entry" VALUE 0x70F34 TKW_VV_VV_UB 100.0 FORMULA_0003 0.0 255.0000 /end CHARACTERISTIC
/begin CHARACTERISTIC K_ED_EV6.INC_NACH_EINTRAG "Filtererhoehung nach Fehlerspeichereintrag | EN: Fault code EV6 - debounce filter increment after fault-memory entry" VALUE 0x70F4E TKW_VV_VV_UB 100.0 FORMULA_0003 0.0 255.0000 /end CHARACTERISTIC
/begin CHARACTERISTIC K_ED_EV7.INC_NACH_EINTRAG "Filtererhoehung nach Fehlerspeichereintrag | EN: Fault code EV7 - debounce filter increment after fault-memory entry" VALUE 0x70F68 TKW_VV_VV_UB 100.0 FORMULA_0003 0.0 255.0000 /end CHARACTERISTIC
/begin CHARACTERISTIC K_ED_EV8.INC_NACH_EINTRAG "Filtererhoehung nach Fehlerspeichereintrag | EN: Fault code EV8 - debounce filter increment after fault-memory entry" VALUE 0x70F82 TKW_VV_VV_UB 100.0 FORMULA_0003 0.0 255.0000 /end CHARACTERISTIC
/begin CHARACTERISTIC K_ED_EV9.INC_NACH_EINTRAG "Filtererhoehung nach Fehlerspeichereintrag | EN: Fault code EV9 - debounce filter increment after fault-memory entry" VALUE 0x70F9C TKW_VV_VV_UB 100.0 FORMULA_0003 0.0 255.0000 /end CHARACTERISTIC
/begin CHARACTERISTIC K_ED_EV10.INC_NACH_EINTRAG "Filtererhoehung nach Fehlerspeichereintrag | EN: Fault code EV10 - debounce filter increment after fault-memory entry" VALUE 0x70FB6 TKW_VV_VV_UB 100.0 FORMULA_0003 0.0 255.0000 /end CHARACTERISTIC
/begin CHARACTERISTIC K_ED_DMTL_P.INC_NACH_EINTRAG "Filtererhoehung nach Fehlerspeichereintrag | EN: Fault code DMTL_P - debounce filter increment after fault-memory entry" VALUE 0x71052 TKW_VV_VV_UB 100.0 FORMULA_0003 0.0 255.0000 /end CHARACTERISTIC
/begin CHARACTERISTIC K_ED_DMTL_V.INC_NACH_EINTRAG "Filtererhoehung nach Fehlerspeichereintrag | EN: Fault code DMTL_V - debounce filter increment after fault-memory entry" VALUE 0x7106C TKW_VV_VV_UB 100.0 FORMULA_0003 0.0 255.0000 /end CHARACTERISTIC
/begin CHARACTERISTIC K_ED_DMTL_H.INC_NACH_EINTRAG "Filtererhoehung nach Fehlerspeichereintrag | EN: Fault code DMTL_H - debounce filter increment after fault-memory entry" VALUE 0x71086 TKW_VV_VV_UB 100.0 FORMULA_0003 0.0 255.0000 /end CHARACTERISTIC
/begin CHARACTERISTIC K_ED_DMTL_GROBLECK.INC_NACH_EINTRAG "Filtererhoehung nach Fehlerspeichereintrag | EN: Fault code DMTL_GROBLECK - debounce filter increment after fault-memory entry" VALUE 0x710A0 TKW_VV_VV_UB 100.0 FORMULA_0003 0.0 255.0000 /end CHARACTERISTIC
/begin CHARACTERISTIC K_ED_DMTL_FEUCHT.INC_NACH_EINTRAG "Filtererhoehung nach Fehlerspeichereintrag | EN: Fault code DMTL_FEUCHT - debounce filter increment after fault-memory entry" VALUE 0x710BA TKW_VV_VV_UB 100.0 FORMULA_0003 0.0 255.0000 /end CHARACTERISTIC
/begin CHARACTERISTIC K_ED_DMTL_DECKEL.INC_NACH_EINTRAG "Filtererhoehung nach Fehlerspeichereintrag | EN: Fault code DMTL_DECKEL - debounce filter increment after fault-memory entry" VALUE 0x710D4 TKW_VV_VV_UB 100.0 FORMULA_0003 0.0 255.0000 /end CHARACTERISTIC
/begin CHARACTERISTIC K_ED_EKP_PWM.INC_NACH_EINTRAG "Filtererhoehung nach Fehlerspeichereintrag | EN: Fault code EKP_PWM - debounce filter increment after fault-memory entry" VALUE 0x7113C TKW_VV_VV_UB 100.0 FORMULA_0003 0.0 255.0000 /end CHARACTERISTIC
/begin CHARACTERISTIC K_ED_EWS_SCI.INC_NACH_EINTRAG "Filtererhoehung nach Fehlerspeichereintrag | EN: Fault code EWS_SCI - debounce filter increment after fault-memory entry" VALUE 0x713C6 TKW_VV_VV_UB 100.0 FORMULA_0003 0.0 255.0000 /end CHARACTERISTIC
/begin CHARACTERISTIC K_ED_EWS_MAN.INC_NACH_EINTRAG "Filtererhoehung nach Fehlerspeichereintrag | EN: Fault code EWS_MAN - debounce filter increment after fault-memory entry" VALUE 0x713E0 TKW_VV_VV_UB 100.0 FORMULA_0003 0.0 255.0000 /end CHARACTERISTIC
/begin CHARACTERISTIC K_ED_EBOX_ELU.INC_NACH_EINTRAG "Filtererhoehung nach Fehlerspeichereintrag | EN: Fault code EBOX_ELU - debounce filter increment after fault-memory entry" VALUE 0x7147C TKW_VV_VV_UB 100.0 FORMULA_0003 0.0 255.0000 /end CHARACTERISTIC
/begin CHARACTERISTIC K_ED_DK1_ENLTG.INC_NACH_EINTRAG "Filtererhoehung nach Fehlerspeichereintrag | EN: Fault code DK1_ENLTG - debounce filter increment after fault-memory entry" VALUE 0x714B0 TKW_VV_VV_UB 100.0 FORMULA_0003 0.0 255.0000 /end CHARACTERISTIC
/begin CHARACTERISTIC K_ED_DK2_ENLTG.INC_NACH_EINTRAG "Filtererhoehung nach Fehlerspeichereintrag | EN: Fault code DK2_ENLTG - debounce filter increment after fault-memory entry" VALUE 0x714CA TKW_VV_VV_UB 100.0 FORMULA_0003 0.0 255.0000 /end CHARACTERISTIC
/begin CHARACTERISTIC K_ED_E2_INJ.INC_NACH_EINTRAG "Filtererhoehung nach Fehlerspeichereintrag | EN: Fault code E2_INJ - debounce filter increment after fault-memory entry" VALUE 0x71566 TKW_VV_VV_UB 100.0 FORMULA_0003 0.0 255.0000 /end CHARACTERISTIC
/begin CHARACTERISTIC K_ED_FETRAWE.INC_NACH_EINTRAG "Filtererhoehung nach Fehlerspeichereintrag | EN: Fault code FETRAWE - debounce filter increment after fault-memory entry" VALUE 0x71684 TKW_VV_VV_UB 100.0 FORMULA_0003 0.0 255.0000 /end CHARACTERISTIC
/begin CHARACTERISTIC K_ED_ELUP.INC_NACH_EINTRAG "Filtererhoehung nach Fehlerspeichereintrag | EN: Fault code ELUP - debounce filter increment after fault-memory entry" VALUE 0x716EC TKW_VV_VV_UB 100.0 FORMULA_0003 0.0 255.0000 /end CHARACTERISTIC
/begin CHARACTERISTIC K_ED_ELU.INC_NACH_EINTRAG "Filtererhoehung nach Fehlerspeichereintrag | EN: Fault code ELU - debounce filter increment after fault-memory entry" VALUE 0x71706 TKW_VV_VV_UB 100.0 FORMULA_0003 0.0 255.0000 /end CHARACTERISTIC
/begin CHARACTERISTIC K_ED_DMTL_FEINLECK.INC_NACH_EINTRAG "Filtererhoehung nach Fehlerspeichereintrag | EN: Fault code DMTL_FEINLECK - debounce filter increment after fault-memory entry" VALUE 0x71824 TKW_VV_VV_UB 100.0 FORMULA_0003 0.0 255.0000 /end CHARACTERISTIC
/begin CHARACTERISTIC K_ED_ELUP_OBD.INC_NACH_EINTRAG "Filtererhoehung nach Fehlerspeichereintrag" VALUE 0x71A7A TKW_VV_VV_UB 100.0 FORMULA_0003 0.0 255.0000 /end CHARACTERISTIC
/begin CHARACTERISTIC K_ED_APPL_DATA_INJ.DEC_NACH_EINTRAG "Filterverringerung nach Fehlerspeichereintrag | EN: Fault code APPL_DATA_INJ - debounce filter decrement after fault-memory entry" VALUE 0x70CAB TKW_VV_VV_UB 100.0 FORMULA_0003 0.0 255.0000 /end CHARACTERISTIC
/begin CHARACTERISTIC K_ED_EV1.DEC_NACH_EINTRAG "Filterverringerung nach Fehlerspeichereintrag | EN: Fault code EV1 - debounce filter decrement after fault-memory entry" VALUE 0x70ECD TKW_VV_VV_UB 100.0 FORMULA_0003 0.0 255.0000 /end CHARACTERISTIC
/begin CHARACTERISTIC K_ED_EV2.DEC_NACH_EINTRAG "Filterverringerung nach Fehlerspeichereintrag | EN: Fault code EV2 - debounce filter decrement after fault-memory entry" VALUE 0x70EE7 TKW_VV_VV_UB 100.0 FORMULA_0003 0.0 255.0000 /end CHARACTERISTIC
/begin CHARACTERISTIC K_ED_EV3.DEC_NACH_EINTRAG "Filterverringerung nach Fehlerspeichereintrag | EN: Fault code EV3 - debounce filter decrement after fault-memory entry" VALUE 0x70F01 TKW_VV_VV_UB 100.0 FORMULA_0003 0.0 255.0000 /end CHARACTERISTIC
/begin CHARACTERISTIC K_ED_EV4.DEC_NACH_EINTRAG "Filterverringerung nach Fehlerspeichereintrag | EN: Fault code EV4 - debounce filter decrement after fault-memory entry" VALUE 0x70F1B TKW_VV_VV_UB 100.0 FORMULA_0003 0.0 255.0000 /end CHARACTERISTIC
/begin CHARACTERISTIC K_ED_EV5.DEC_NACH_EINTRAG "Filterverringerung nach Fehlerspeichereintrag | EN: Fault code EV5 - debounce filter decrement after fault-memory entry" VALUE 0x70F35 TKW_VV_VV_UB 100.0 FORMULA_0003 0.0 255.0000 /end CHARACTERISTIC
/begin CHARACTERISTIC K_ED_EV6.DEC_NACH_EINTRAG "Filterverringerung nach Fehlerspeichereintrag | EN: Fault code EV6 - debounce filter decrement after fault-memory entry" VALUE 0x70F4F TKW_VV_VV_UB 100.0 FORMULA_0003 0.0 255.0000 /end CHARACTERISTIC
/begin CHARACTERISTIC K_ED_EV7.DEC_NACH_EINTRAG "Filterverringerung nach Fehlerspeichereintrag | EN: Fault code EV7 - debounce filter decrement after fault-memory entry" VALUE 0x70F69 TKW_VV_VV_UB 100.0 FORMULA_0003 0.0 255.0000 /end CHARACTERISTIC
/begin CHARACTERISTIC K_ED_EV8.DEC_NACH_EINTRAG "Filterverringerung nach Fehlerspeichereintrag | EN: Fault code EV8 - debounce filter decrement after fault-memory entry" VALUE 0x70F83 TKW_VV_VV_UB 100.0 FORMULA_0003 0.0 255.0000 /end CHARACTERISTIC
/begin CHARACTERISTIC K_ED_EV9.DEC_NACH_EINTRAG "Filterverringerung nach Fehlerspeichereintrag | EN: Fault code EV9 - debounce filter decrement after fault-memory entry" VALUE 0x70F9D TKW_VV_VV_UB 100.0 FORMULA_0003 0.0 255.0000 /end CHARACTERISTIC
/begin CHARACTERISTIC K_ED_EV10.DEC_NACH_EINTRAG "Filterverringerung nach Fehlerspeichereintrag | EN: Fault code EV10 - debounce filter decrement after fault-memory entry" VALUE 0x70FB7 TKW_VV_VV_UB 100.0 FORMULA_0003 0.0 255.0000 /end CHARACTERISTIC
/begin CHARACTERISTIC K_ED_DMTL_P.DEC_NACH_EINTRAG "Filterverringerung nach Fehlerspeichereintrag | EN: Fault code DMTL_P - debounce filter decrement after fault-memory entry" VALUE 0x71053 TKW_VV_VV_UB 100.0 FORMULA_0003 0.0 255.0000 /end CHARACTERISTIC
/begin CHARACTERISTIC K_ED_DMTL_V.DEC_NACH_EINTRAG "Filterverringerung nach Fehlerspeichereintrag | EN: Fault code DMTL_V - debounce filter decrement after fault-memory entry" VALUE 0x7106D TKW_VV_VV_UB 100.0 FORMULA_0003 0.0 255.0000 /end CHARACTERISTIC
/begin CHARACTERISTIC K_ED_DMTL_H.DEC_NACH_EINTRAG "Filterverringerung nach Fehlerspeichereintrag | EN: Fault code DMTL_H - debounce filter decrement after fault-memory entry" VALUE 0x71087 TKW_VV_VV_UB 100.0 FORMULA_0003 0.0 255.0000 /end CHARACTERISTIC
/begin CHARACTERISTIC K_ED_DMTL_GROBLECK.DEC_NACH_EINTRAG "Filterverringerung nach Fehlerspeichereintrag | EN: Fault code DMTL_GROBLECK - debounce filter decrement after fault-memory entry" VALUE 0x710A1 TKW_VV_VV_UB 100.0 FORMULA_0003 0.0 255.0000 /end CHARACTERISTIC
/begin CHARACTERISTIC K_ED_DMTL_FEUCHT.DEC_NACH_EINTRAG "Filterverringerung nach Fehlerspeichereintrag | EN: Fault code DMTL_FEUCHT - debounce filter decrement after fault-memory entry" VALUE 0x710BB TKW_VV_VV_UB 100.0 FORMULA_0003 0.0 255.0000 /end CHARACTERISTIC
/begin CHARACTERISTIC K_ED_DMTL_DECKEL.DEC_NACH_EINTRAG "Filterverringerung nach Fehlerspeichereintrag | EN: Fault code DMTL_DECKEL - debounce filter decrement after fault-memory entry" VALUE 0x710D5 TKW_VV_VV_UB 100.0 FORMULA_0003 0.0 255.0000 /end CHARACTERISTIC
/begin CHARACTERISTIC K_ED_EKP_PWM.DEC_NACH_EINTRAG "Filterverringerung nach Fehlerspeichereintrag | EN: Fault code EKP_PWM - debounce filter decrement after fault-memory entry" VALUE 0x7113D TKW_VV_VV_UB 100.0 FORMULA_0003 0.0 255.0000 /end CHARACTERISTIC
/begin CHARACTERISTIC K_ED_EWS_SCI.DEC_NACH_EINTRAG "Filterverringerung nach Fehlerspeichereintrag | EN: Fault code EWS_SCI - debounce filter decrement after fault-memory entry" VALUE 0x713C7 TKW_VV_VV_UB 100.0 FORMULA_0003 0.0 255.0000 /end CHARACTERISTIC
/begin CHARACTERISTIC K_ED_EWS_MAN.DEC_NACH_EINTRAG "Filterverringerung nach Fehlerspeichereintrag | EN: Fault code EWS_MAN - debounce filter decrement after fault-memory entry" VALUE 0x713E1 TKW_VV_VV_UB 100.0 FORMULA_0003 0.0 255.0000 /end CHARACTERISTIC
/begin CHARACTERISTIC K_ED_EBOX_ELU.DEC_NACH_EINTRAG "Filterverringerung nach Fehlerspeichereintrag | EN: Fault code EBOX_ELU - debounce filter decrement after fault-memory entry" VALUE 0x7147D TKW_VV_VV_UB 100.0 FORMULA_0003 0.0 255.0000 /end CHARACTERISTIC
/begin CHARACTERISTIC K_ED_DK1_ENLTG.DEC_NACH_EINTRAG "Filterverringerung nach Fehlerspeichereintrag | EN: Fault code DK1_ENLTG - debounce filter decrement after fault-memory entry" VALUE 0x714B1 TKW_VV_VV_UB 100.0 FORMULA_0003 0.0 255.0000 /end CHARACTERISTIC
/begin CHARACTERISTIC K_ED_DK2_ENLTG.DEC_NACH_EINTRAG "Filterverringerung nach Fehlerspeichereintrag | EN: Fault code DK2_ENLTG - debounce filter decrement after fault-memory entry" VALUE 0x714CB TKW_VV_VV_UB 100.0 FORMULA_0003 0.0 255.0000 /end CHARACTERISTIC
/begin CHARACTERISTIC K_ED_E2_INJ.DEC_NACH_EINTRAG "Filterverringerung nach Fehlerspeichereintrag | EN: Fault code E2_INJ - debounce filter decrement after fault-memory entry" VALUE 0x71567 TKW_VV_VV_UB 100.0 FORMULA_0003 0.0 255.0000 /end CHARACTERISTIC
/begin CHARACTERISTIC K_ED_FETRAWE.DEC_NACH_EINTRAG "Filterverringerung nach Fehlerspeichereintrag | EN: Fault code FETRAWE - debounce filter decrement after fault-memory entry" VALUE 0x71685 TKW_VV_VV_UB 100.0 FORMULA_0003 0.0 255.0000 /end CHARACTERISTIC
/begin CHARACTERISTIC K_ED_ELUP.DEC_NACH_EINTRAG "Filterverringerung nach Fehlerspeichereintrag | EN: Fault code ELUP - debounce filter decrement after fault-memory entry" VALUE 0x716ED TKW_VV_VV_UB 100.0 FORMULA_0003 0.0 255.0000 /end CHARACTERISTIC
/begin CHARACTERISTIC K_ED_ELU.DEC_NACH_EINTRAG "Filterverringerung nach Fehlerspeichereintrag | EN: Fault code ELU - debounce filter decrement after fault-memory entry" VALUE 0x71707 TKW_VV_VV_UB 100.0 FORMULA_0003 0.0 255.0000 /end CHARACTERISTIC
/begin CHARACTERISTIC K_ED_DMTL_FEINLECK.DEC_NACH_EINTRAG "Filterverringerung nach Fehlerspeichereintrag | EN: Fault code DMTL_FEINLECK - debounce filter decrement after fault-memory entry" VALUE 0x71825 TKW_VV_VV_UB 100.0 FORMULA_0003 0.0 255.0000 /end CHARACTERISTIC
/begin CHARACTERISTIC K_ED_ELUP_OBD.DEC_NACH_EINTRAG "Filterverringerung nach Fehlerspeichereintrag" VALUE 0x71A7B TKW_VV_VV_UB 100.0 FORMULA_0003 0.0 255.0000 /end CHARACTERISTIC
/begin CHARACTERISTIC K_ED_APPL_DATA_INJ.KLASSENINDEX "Auswahl der Fehlerklasse | EN: Fault code APPL_DATA_INJ - fault class selection (lamp / warning behaviour)" VALUE 0x70CAC TKW_VV_VV_UB 100.0 FORMULA_0003 0.0 8.0000 /end CHARACTERISTIC
/begin CHARACTERISTIC K_ED_EV1.KLASSENINDEX "Auswahl der Fehlerklasse | EN: Fault code EV1 - fault class selection (lamp / warning behaviour)" VALUE 0x70ECE TKW_VV_VV_UB 100.0 FORMULA_0003 0.0 8.0000 /end CHARACTERISTIC
/begin CHARACTERISTIC K_ED_EV2.KLASSENINDEX "Auswahl der Fehlerklasse | EN: Fault code EV2 - fault class selection (lamp / warning behaviour)" VALUE 0x70EE8 TKW_VV_VV_UB 100.0 FORMULA_0003 0.0 8.0000 /end CHARACTERISTIC
/begin CHARACTERISTIC K_ED_EV3.KLASSENINDEX "Auswahl der Fehlerklasse | EN: Fault code EV3 - fault class selection (lamp / warning behaviour)" VALUE 0x70F02 TKW_VV_VV_UB 100.0 FORMULA_0003 0.0 8.0000 /end CHARACTERISTIC
/begin CHARACTERISTIC K_ED_EV4.KLASSENINDEX "Auswahl der Fehlerklasse | EN: Fault code EV4 - fault class selection (lamp / warning behaviour)" VALUE 0x70F1C TKW_VV_VV_UB 100.0 FORMULA_0003 0.0 8.0000 /end CHARACTERISTIC
/begin CHARACTERISTIC K_ED_EV5.KLASSENINDEX "Auswahl der Fehlerklasse | EN: Fault code EV5 - fault class selection (lamp / warning behaviour)" VALUE 0x70F36 TKW_VV_VV_UB 100.0 FORMULA_0003 0.0 8.0000 /end CHARACTERISTIC
/begin CHARACTERISTIC K_ED_EV6.KLASSENINDEX "Auswahl der Fehlerklasse | EN: Fault code EV6 - fault class selection (lamp / warning behaviour)" VALUE 0x70F50 TKW_VV_VV_UB 100.0 FORMULA_0003 0.0 8.0000 /end CHARACTERISTIC
/begin CHARACTERISTIC K_ED_EV7.KLASSENINDEX "Auswahl der Fehlerklasse | EN: Fault code EV7 - fault class selection (lamp / warning behaviour)" VALUE 0x70F6A TKW_VV_VV_UB 100.0 FORMULA_0003 0.0 8.0000 /end CHARACTERISTIC
/begin CHARACTERISTIC K_ED_EV8.KLASSENINDEX "Auswahl der Fehlerklasse | EN: Fault code EV8 - fault class selection (lamp / warning behaviour)" VALUE 0x70F84 TKW_VV_VV_UB 100.0 FORMULA_0003 0.0 8.0000 /end CHARACTERISTIC
/begin CHARACTERISTIC K_ED_EV9.KLASSENINDEX "Auswahl der Fehlerklasse | EN: Fault code EV9 - fault class selection (lamp / warning behaviour)" VALUE 0x70F9E TKW_VV_VV_UB 100.0 FORMULA_0003 0.0 8.0000 /end CHARACTERISTIC
/begin CHARACTERISTIC K_ED_EV10.KLASSENINDEX "Auswahl der Fehlerklasse | EN: Fault code EV10 - fault class selection (lamp / warning behaviour)" VALUE 0x70FB8 TKW_VV_VV_UB 100.0 FORMULA_0003 0.0 8.0000 /end CHARACTERISTIC
/begin CHARACTERISTIC K_ED_DMTL_P.KLASSENINDEX "Auswahl der Fehlerklasse | EN: Fault code DMTL_P - fault class selection (lamp / warning behaviour)" VALUE 0x71054 TKW_VV_VV_UB 100.0 FORMULA_0003 0.0 8.0000 /end CHARACTERISTIC
/begin CHARACTERISTIC K_ED_DMTL_V.KLASSENINDEX "Auswahl der Fehlerklasse | EN: Fault code DMTL_V - fault class selection (lamp / warning behaviour)" VALUE 0x7106E TKW_VV_VV_UB 100.0 FORMULA_0003 0.0 8.0000 /end CHARACTERISTIC
/begin CHARACTERISTIC K_ED_DMTL_H.KLASSENINDEX "Auswahl der Fehlerklasse | EN: Fault code DMTL_H - fault class selection (lamp / warning behaviour)" VALUE 0x71088 TKW_VV_VV_UB 100.0 FORMULA_0003 0.0 8.0000 /end CHARACTERISTIC
/begin CHARACTERISTIC K_ED_DMTL_GROBLECK.KLASSENINDEX "Auswahl der Fehlerklasse | EN: Fault code DMTL_GROBLECK - fault class selection (lamp / warning behaviour)" VALUE 0x710A2 TKW_VV_VV_UB 100.0 FORMULA_0003 0.0 8.0000 /end CHARACTERISTIC
/begin CHARACTERISTIC K_ED_DMTL_FEUCHT.KLASSENINDEX "Auswahl der Fehlerklasse | EN: Fault code DMTL_FEUCHT - fault class selection (lamp / warning behaviour)" VALUE 0x710BC TKW_VV_VV_UB 100.0 FORMULA_0003 0.0 8.0000 /end CHARACTERISTIC
/begin CHARACTERISTIC K_ED_DMTL_DECKEL.KLASSENINDEX "Auswahl der Fehlerklasse | EN: Fault code DMTL_DECKEL - fault class selection (lamp / warning behaviour)" VALUE 0x710D6 TKW_VV_VV_UB 100.0 FORMULA_0003 0.0 8.0000 /end CHARACTERISTIC
/begin CHARACTERISTIC K_ED_EKP_PWM.KLASSENINDEX "Auswahl der Fehlerklasse | EN: Fault code EKP_PWM - fault class selection (lamp / warning behaviour)" VALUE 0x7113E TKW_VV_VV_UB 100.0 FORMULA_0003 0.0 8.0000 /end CHARACTERISTIC
/begin CHARACTERISTIC K_ED_EWS_SCI.KLASSENINDEX "Auswahl der Fehlerklasse | EN: Fault code EWS_SCI - fault class selection (lamp / warning behaviour)" VALUE 0x713C8 TKW_VV_VV_UB 100.0 FORMULA_0003 0.0 8.0000 /end CHARACTERISTIC
/begin CHARACTERISTIC K_ED_EWS_MAN.KLASSENINDEX "Auswahl der Fehlerklasse | EN: Fault code EWS_MAN - fault class selection (lamp / warning behaviour)" VALUE 0x713E2 TKW_VV_VV_UB 100.0 FORMULA_0003 0.0 8.0000 /end CHARACTERISTIC
/begin CHARACTERISTIC K_ED_EBOX_ELU.KLASSENINDEX "Auswahl der Fehlerklasse | EN: Fault code EBOX_ELU - fault class selection (lamp / warning behaviour)" VALUE 0x7147E TKW_VV_VV_UB 100.0 FORMULA_0003 0.0 8.0000 /end CHARACTERISTIC
/begin CHARACTERISTIC K_ED_DK1_ENLTG.KLASSENINDEX "Auswahl der Fehlerklasse | EN: Fault code DK1_ENLTG - fault class selection (lamp / warning behaviour)" VALUE 0x714B2 TKW_VV_VV_UB 100.0 FORMULA_0003 0.0 8.0000 /end CHARACTERISTIC
/begin CHARACTERISTIC K_ED_DK2_ENLTG.KLASSENINDEX "Auswahl der Fehlerklasse | EN: Fault code DK2_ENLTG - fault class selection (lamp / warning behaviour)" VALUE 0x714CC TKW_VV_VV_UB 100.0 FORMULA_0003 0.0 8.0000 /end CHARACTERISTIC
/begin CHARACTERISTIC K_ED_E2_INJ.KLASSENINDEX "Auswahl der Fehlerklasse | EN: Fault code E2_INJ - fault class selection (lamp / warning behaviour)" VALUE 0x71568 TKW_VV_VV_UB 100.0 FORMULA_0003 0.0 8.0000 /end CHARACTERISTIC
/begin CHARACTERISTIC K_ED_FETRAWE.KLASSENINDEX "Auswahl der Fehlerklasse | EN: Fault code FETRAWE - fault class selection (lamp / warning behaviour)" VALUE 0x71686 TKW_VV_VV_UB 100.0 FORMULA_0003 0.0 8.0000 /end CHARACTERISTIC
/begin CHARACTERISTIC K_ED_ELUP.KLASSENINDEX "Auswahl der Fehlerklasse | EN: Fault code ELUP - fault class selection (lamp / warning behaviour) [V912: differs from V452 160E]" VALUE 0x716EE TKW_VV_VV_UB 100.0 FORMULA_0003 0.0 8.0000 /end CHARACTERISTIC
/begin CHARACTERISTIC K_ED_ELU.KLASSENINDEX "Auswahl der Fehlerklasse | EN: Fault code ELU - fault class selection (lamp / warning behaviour)" VALUE 0x71708 TKW_VV_VV_UB 100.0 FORMULA_0003 0.0 8.0000 /end CHARACTERISTIC
/begin CHARACTERISTIC K_ED_DMTL_FEINLECK.KLASSENINDEX "Auswahl der Fehlerklasse | EN: Fault code DMTL_FEINLECK - fault class selection (lamp / warning behaviour)" VALUE 0x71826 TKW_VV_VV_UB 100.0 FORMULA_0003 0.0 8.0000 /end CHARACTERISTIC
/begin CHARACTERISTIC K_ED_ELUP_OBD.KLASSENINDEX "Auswahl der Fehlerklasse [V912: differs from V452 160E]" VALUE 0x71A7C TKW_VV_VV_UB 100.0 FORMULA_0003 0.0 8.0000 /end CHARACTERISTIC
/begin CHARACTERISTIC K_ED_CSS_TIME "Zeit fuer CSS-Denominator | EN: Zeit fuer CSS-Denominator" VALUE 0x71CAC TKW_VV_VV_UW 100.0 FORMULA_0073 0.0 6553.5000 FORMAT "%4.1" /end CHARACTERISTIC
/* ------------------ Abschnitt erzeugt aus egas_diag.dat ------------------ */
/begin CHARACTERISTIC K_EGAS_CFG_DIAG "DK-Konfiguration elektr. Diagnose | EN: Throttle configuration, electrical diagnosis" VALUE 0x71D02 TKW_VV_VV_UB 100.0 FORMULA_0669 0.0 255.0 /end CHARACTERISTIC
/* ------------------ Abschnitt erzeugt aus elup.dat ------------------ */
/begin CHARACTERISTIC K_ELUP_CFG "Software-Schalter ELUP" VALUE 0x71DDC TKW_VV_VV_UB 100.0 FORMULA_0682 0.0 255.0 /end CHARACTERISTIC
/begin CHARACTERISTIC K_ELUP_UB_MIN "Mindestspannung an KL87 fuer ELUP-Ansteuerung | EN: Mindestspannung an KL87 fuer ELUP-Ansteuerung" VALUE 0x71DDE TKW_VV_VV_SW 100.0 FORMULA_0008 0.0 28.0000 FORMAT "%4.1" /end CHARACTERISTIC
/begin CHARACTERISTIC K_ELUP_ON_TIME_MIN "mindest ELUP-Ansteuerzeit | EN: mindest ELUP-Ansteuerzeit" VALUE 0x71DE0 TKW_VV_VV_UW 100.0 FORMULA_0021 0.0 655.0000 FORMAT "%5.2" /end CHARACTERISTIC
/begin CHARACTERISTIC K_ELUP_ON_TIME_MAX "maximale ELUP-Ansteuerzeit | EN: maximale ELUP-Ansteuerzeit" VALUE 0x71DE2 TKW_VV_VV_UW 100.0 FORMULA_0021 0.0 655.0000 FORMAT "%5.2" /end CHARACTERISTIC
/begin CHARACTERISTIC K_ELUP_OFF_TIME_MIN "mindest ELUP-Verriegelungszeit | EN: mindest ELUP -Verriegelungszeit" VALUE 0x71DE4 TKW_VV_VV_UW 100.0 FORMULA_0021 0.0 655.0000 FORMAT "%5.2" /end CHARACTERISTIC
/begin CHARACTERISTIC K_ELUP_OBD_MVACP_GRAD_T "Filterkonstante fuer elup_obd_mvacp_grad | EN: Filter constant for elup_ed_mvacp_grad" VALUE 0x71DE6 TKW_VV_VV_UB 100.0 FORMULA_0683 0.1004 25.6000 /end CHARACTERISTIC
/begin CHARACTERISTIC K_ELUP_OBD_BRPGRAD_T "Filterkonstante fuer elup_obd_brp_grad | EN: Filter constant for elup_ed_brp_grad" VALUE 0x71DE7 TKW_VV_VV_UB 100.0 FORMULA_0664 0.0101 2.5600 /end CHARACTERISTIC
/begin CHARACTERISTIC K_ELUP_OBD_PSAU_SW "Diag-Schwelle durch Saugrohrdruck zu pumg | EN: Diagnosis threshold from intake pressure vs ambient pressure" VALUE 0x71DE8 TKW_VV_VV_SW 100.0 FORMULA_0077 0.0 2000.0000 FORMAT "%4.1" /end CHARACTERISTIC
/begin CHARACTERISTIC K_ELUP_OBD_MVACP_GRAD_SW "Diag-Schwelle durch Differenzdruckgradient | EN: Diagnosis threshold from differential-pressure gradient" VALUE 0x71DEA TKW_VV_VV_SW 100.0 FORMULA_0678 -312.5000 312.5000 FORMAT "%4.1" /end CHARACTERISTIC
/begin CHARACTERISTIC K_ELUP_OBD_BRPGRAD_SW "Diag-Schwelle durch Bremsdruckgradient | EN: Diagnosis threshold from brake-pressure gradient" VALUE 0x71DEC TKW_VV_VV_SW 100.0 FORMULA_0679 -5000.0000 5000.0000 /end CHARACTERISTIC
/begin CHARACTERISTIC K_ELUP_OBD_DEL "Verzoegerung ELUP_OBD UNPLAUSIBEL durch Druckgradient | EN: Verzoegerung ELUP_OBD UNPLAUSIBEL durch Druckgradient" VALUE 0x71DEE TKW_VV_VV_UB 100.0 FORMULA_0458 0.0 25.5000 /end CHARACTERISTIC
/begin CHARACTERISTIC K_ELUP_OBD_ABS_DEL "Verzoegerung ELUP_OBD UNPLAUSIBEL durch Einschaltschwelle | EN: Verzoegerung ELUP_OBD UNPLAUSIBEL durch Einschaltschwelle" VALUE 0x71DEF TKW_VV_VV_UB 100.0 FORMULA_0458 0.0 25.5000 /end CHARACTERISTIC
/begin CHARACTERISTIC K_ELUP_PL_AN_SW "ELUP-Ansteuerschwelle fuer Prueflauf | EN: Vacuum-pump activation threshold for test run [mbar]" VALUE 0x71DF0 TKW_VV_VV_SW 100.0 FORMULA_0077 -1100.0000 200.0000 FORMAT "%4.1" /end CHARACTERISTIC
/begin CHARACTERISTIC K_ELUP_PL_IO_SW "ELUP-iO-Schwelle bei Prueflauf | EN: Vacuum-pump OK threshold during test run [mbar]" VALUE 0x71DF2 TKW_VV_VV_SW 100.0 FORMULA_0077 -1100.0000 200.0000 FORMAT "%4.1" /end CHARACTERISTIC
/begin CHARACTERISTIC K_ELUP_PL_ON_TIME "ELUP-Ansteuerzeit fuer Prueflauf | EN: Vacuum-pump activation time for test run [s]" VALUE 0x71DF4 TKW_VV_VV_UW 100.0 FORMULA_0021 0.0 655.0000 FORMAT "%5.2" /end CHARACTERISTIC
/begin CHARACTERISTIC KL_ELUP_EIN "Kennlinie Einschaltschwelle ELUP | EN: Curve: electric vacuum pump switch-on threshold" CURVE 0x71DF6 TKL_SW_VV_SW 100.0 FORMULA_0077 -1100.0000 200.0000 /begin AXIS_DESCR STD_AXIS FORMULA_0077 8 400.0000 1200.0000 FORMAT "%4.1" /end AXIS_DESCR FORMAT "%4.1" /end CHARACTERISTIC
/begin CHARACTERISTIC KL_ELUP_AUS "Kennlinie Ausschaltschwelle ELUP | EN: Curve: electric vacuum pump switch-off threshold" CURVE 0x71E18 TKL_SW_VV_SW 100.0 FORMULA_0077 -1100.0000 200.0000 /begin AXIS_DESCR STD_AXIS FORMULA_0077 8 400.0000 1200.0000 FORMAT "%4.1" /end AXIS_DESCR FORMAT "%4.1" /end CHARACTERISTIC
/begin CHARACTERISTIC KL_ELUP_V_OFFS "Kennlinie v-Offset auf ELUP-Schaltschwelle | EN: Curve: speed offset on vacuum-pump switching threshold" CURVE 0x71E3A TKL_SW_VV_SW 100.0 FORMULA_0077 -200.0000 200.0000 /begin AXIS_DESCR STD_AXIS FORMULA_0078 6 -80.0000 360.0000 FORMAT "%4.1" /end AXIS_DESCR FORMAT "%4.1" /end CHARACTERISTIC
/begin CHARACTERISTIC KL_ELUP_EIN_V_DEL "Kennlinie Einschlatverzoegerung druch v_vorne" CURVE 0x71E54 TKL_SW_VV_UW 100.0 FORMULA_0021 0.0 655.0000 /begin AXIS_DESCR STD_AXIS FORMULA_0078 6 -80.0000 360.0000 FORMAT "%4.1" /end AXIS_DESCR FORMAT "%5.2" /end CHARACTERISTIC
/* ------------------ Abschnitt erzeugt aus ews.dat ------------------ */
/begin CHARACTERISTIC K_EWS_FETRAWE_WEG "zul. Kilometerstand zum automatischen aktivieren des Fertigungsmodes beim EWS-DME-Abgl. | EN: Permitted mileage for auto-activating production mode on EWS-DME alignment [km]" VALUE 0x71E70 TKW_VV_VV_UW 100.0 FORMULA_0616 0.0 65535.0000 /end CHARACTERISTIC
/* ------------------ Abschnitt erzeugt aus fst.dat ------------------ */
/begin CHARACTERISTIC K_FST_ABWEICHUNG "Zulaessige Abweichung Verbrauch/Fuellstand | EN: Zulaessige Abweichung Ve r-brauch/Fuellstand" VALUE 0x72020 TKW_VV_VV_UB 100.0 FORMULA_0557 0.0 127.5000 /end CHARACTERISTIC
/begin CHARACTERISTIC K_FST_CAN_FEHLER "min. Dauer CAN-Fehler (65535s = aus) | EN: min. Dauer CAN -Fehler (65535s = aus)" VALUE 0x72022 TKW_VV_VV_UW 100.0 FORMULA_0062 0.0 65535.0000 /end CHARACTERISTIC
/begin CHARACTERISTIC K_FST_NACHTANK "Delta fuer Nachtankerkennung | EN: Delta fuer Nachtankerkennung" VALUE 0x72024 TKW_VV_VV_UB 100.0 FORMULA_0557 0.0 127.5000 /end CHARACTERISTIC
/begin CHARACTERISTIC K_FST_FILT "Filter Geberwert Li/Re | EN: Filter Geberwert Li/Re" VALUE 0x72025 TKW_VV_VV_UB 100.0 FORMULA_0718 1.0040 256.0000 /end CHARACTERISTIC
/begin CHARACTERISTIC K_FST_TANK_LEER_SUM "Summenfuellstand Tank Leer Info | EN: Summenfuellstand Tank Leer Info" VALUE 0x72026 TKW_VV_VV_UB 100.0 FORMULA_0557 0.0 127.5000 /end CHARACTERISTIC
/begin CHARACTERISTIC K_FST_TANK_LEER_RECHTS "Fuellstand rechts Tank Leer Info | EN: Fuellstand rechts Tank Leer Info" VALUE 0x72027 TKW_VV_VV_UB 100.0 FORMULA_0557 0.0 127.5000 /end CHARACTERISTIC
/begin CHARACTERISTIC K_FST_VOLL "Maximaler Fuellstand fuer Volldiagnose | EN: Maximaler Fuellstand fuer Volld i-agnose" VALUE 0x72028 TKW_VV_VV_UB 100.0 FORMULA_0557 0.0 127.5000 /end CHARACTERISTIC
/begin CHARACTERISTIC K_FST_V_BETANK_END "Geschw. fuer Tanken beendet | EN: Geschw. fuer Tanken beendet" VALUE 0x7202A TKW_VV_VV_SW 100.0 FORMULA_0078 -80.0000 360.0000 FORMAT "%4.1" /end CHARACTERISTIC
/begin CHARACTERISTIC K_FST_VERBRAUCH "FST-Plausi, wenn soviel verbraucht | EN: FST-Plausi, wenn soviel ve r-braucht" VALUE 0x7202C TKW_VV_VV_UB 100.0 FORMULA_0557 0.0 127.5000 /end CHARACTERISTIC
/begin CHARACTERISTIC K_FST_VERBRAUCH_VOLL "Unplausibl. Verbrauch bei FST voll | EN: Unplausibl. Verbrauch bei FST voll" VALUE 0x7202D TKW_VV_VV_UB 100.0 FORMULA_0557 0.0 127.5000 /end CHARACTERISTIC
/* ------------------ Abschnitt erzeugt aus kt_gen.dat ------------------ */ /* ------------------ Abschnitt erzeugt aus kt_ibs.dat ------------------ */
/begin CHARACTERISTIC K_ENISOC0 "" VALUE 0x737F4 TKW_VV_VV_UB 100.0 FORMULA_0733 0.0 5.1000 /end CHARACTERISTIC
/begin CHARACTERISTIC K_ENUSOC0 "" VALUE 0x737F5 TKW_VV_VV_UB 100.0 FORMULA_0734 6.0000 22.3200 /end CHARACTERISTIC
/begin CHARACTERISTIC K_T1SOC0 "" VALUE 0x737F6 TKW_VV_VV_UB 100.0 FORMULA_0735 0.0 65280.0000 /end CHARACTERISTIC
/begin CHARACTERISTIC K_T2SOC0 "" VALUE 0x737F7 TKW_VV_VV_UB 100.0 FORMULA_0735 0.0 65280.0000 /end CHARACTERISTIC
/begin CHARACTERISTIC K_T3SOC0 "" VALUE 0x737F8 TKW_VV_VV_UB 100.0 FORMULA_0735 0.0 65280.0000 /end CHARACTERISTIC
/begin CHARACTERISTIC K_ISTARTTRIG "" VALUE 0x737F9 TKW_VV_VV_UB 100.0 FORMULA_0498 0.0 1305.6000 /end CHARACTERISTIC
/begin CHARACTERISTIC K_TNUSTART "" VALUE 0x737FA TKW_VV_VV_UB 100.0 FORMULA_0736 0.0 3.1875 /end CHARACTERISTIC
/begin CHARACTERISTIC K_TNUSTARTFL "" VALUE 0x737FB TKW_VV_VV_UB 100.0 FORMULA_0737 0.0100 0.5200 /end CHARACTERISTIC
/begin CHARACTERISTIC K_UTIEFAPP "" VALUE 0x737FC TKW_VV_VV_UB 100.0 FORMULA_0734 6.0000 22.3200 /end CHARACTERISTIC
/begin CHARACTERISTIC K_T_UTIEFSET "" VALUE 0x737FD TKW_VV_VV_UB 100.0 FORMULA_0472 0.0 255.0000 /end CHARACTERISTIC
/begin CHARACTERISTIC K_T1SCHWELLE "" VALUE 0x737FF TKW_VV_VV_UB 100.0 FORMULA_0739 0.0 10.2000 /end CHARACTERISTIC
/begin CHARACTERISTIC K_T2SCHWELLE "" VALUE 0x73800 TKW_VV_VV_UB 100.0 FORMULA_0739 0.0 10.2000 /end CHARACTERISTIC
/begin CHARACTERISTIC K_T3SCHWELLE "" VALUE 0x73801 TKW_VV_VV_UB 100.0 FORMULA_0739 0.0 10.2000 /end CHARACTERISTIC
/begin CHARACTERISTIC K_ISLEEPGRZ "" VALUE 0x73802 TKW_VV_VV_UB 100.0 FORMULA_0733 0.0 5.1000 /end CHARACTERISTIC
/begin CHARACTERISTIC K_DI1000TGRZ "" VALUE 0x73803 TKW_VV_VV_UB 100.0 FORMULA_0472 0.0 255.0000 /end CHARACTERISTIC
/begin CHARACTERISTIC K_DUIGRZ "" VALUE 0x73804 TKW_VV_VV_UB 100.0 FORMULA_0733 0.0 5.1000 /end CHARACTERISTIC
/begin CHARACTERISTIC K_DIHIGHGRZ "" VALUE 0x73807 TKW_VV_VV_UB 100.0 FORMULA_0740 0.0 20.4000 /end CHARACTERISTIC
/begin CHARACTERISTIC K_DUMINTGRZ "" VALUE 0x73808 TKW_VV_VV_UB 100.0 FORMULA_0741 0.0 12.7500 /end CHARACTERISTIC
/begin CHARACTERISTIC K_DKL15FIL "" VALUE 0x73809 TKW_VV_VV_UB 100.0 FORMULA_0742 0.0 1.5937 /end CHARACTERISTIC
/begin CHARACTERISTIC K_DUREFMAX "" VALUE 0x7380A TKW_VV_VV_UB 100.0 FORMULA_0743 0.0 4.9980 /end CHARACTERISTIC
/begin CHARACTERISTIC K_DI200DT "" VALUE 0x73825 TKW_VV_VV_UB 100.0 FORMULA_0741 0.0 12.7500 /end CHARACTERISTIC
/begin CHARACTERISTIC K_DI1000DT " [V912: differs from V452 160E]" VALUE 0x73826 TKW_VV_VV_UB 100.0 FORMULA_0741 0.0 12.7500 /end CHARACTERISTIC
/begin CHARACTERISTIC K_ERREPEAT "EBSD Fehler repeat | EN: EBSD Fehler repeat [V912: differs from V452 160E]" VALUE 0x73841 TKW_VV_VV_UB 100.0 FORMULA_0003 0.0 255.0000 /end CHARACTERISTIC
/begin CHARACTERISTIC K_IBUNPLADEL "EBSD Fehler repeat | EN: EBSD Fehler repeat [V912: differs from V452 160E]" VALUE 0x73842 TKW_VV_VV_UB 100.0 FORMULA_0003 0.0 255.0000 /end CHARACTERISTIC
/begin CHARACTERISTIC K_TPT1TICO "" VALUE 0x73848 TKW_VV_VV_UW 100.0 FORMULA_0744 0.0 3276.7500 FORMAT "%5.2" /end CHARACTERISTIC
/* ------------------ Abschnitt erzeugt aus nwm.dat ------------------ */ /* ------------------ Abschnitt erzeugt aus n_dyn.dat ------------------ */
/begin CHARACTERISTIC K_N_OBD_DYN_TAU "Zeitkonstante f�r n-Filter Dynamikerkennung | EN: Time constant for speed filter, dynamics detection" VALUE 0x7556C TKW_VV_VV_UB 100.0 FORMULA_0664 0.0101 2.5600 /end CHARACTERISTIC
/begin CHARACTERISTIC K_N_OBD_DYN_DELTA "Differenzdrehzahl fuer Dynamikerkennung | EN: Speed difference for dynamics detection" VALUE 0x7556E TKW_VV_VV_SW 100.0 FORMULA_0006 0.0 10000.0000 /end CHARACTERISTIC
/begin CHARACTERISTIC K_N_OBD_DYN_T "Sperrzeit fuer Ruecknahme N-Dynamik | EN: Lock-out time for withdrawing speed dynamics" VALUE 0x75570 TKW_VV_VV_UW 100.0 FORMULA_0021 0.0 655.0000 FORMAT "%5.2" /end CHARACTERISTIC
/* ------------------ Abschnitt erzeugt aus n_grad.dat ------------------ */ /* ------------------ Abschnitt erzeugt aus n_max.dat ------------------ */
/begin CHARACTERISTIC K_N_BEGR_TI_OFF_RSS "N-Offset bei Rennstartschaltung | EN: N-Offset bei Rennstartschaltung" VALUE 0x75572 TKW_VV_VV_SW 100.0 FORMULA_0006 0.0 5000.0000 /end CHARACTERISTIC
/begin CHARACTERISTIC K_N_BEGR_EGAS_HYS "Hysterese fuer N-Begrenzung ueber Egas | EN: Hysterese fuer N -Begrenzung ueber Egas" VALUE 0x75574 TKW_VV_VV_SW 100.0 FORMULA_0006 0.0 500.0000 /end CHARACTERISTIC
/begin CHARACTERISTIC K_N_BEGR_TI_HYS "Hysterese fuer N-Begrenzung ueber TI | EN: Hysterese fuer N -Begrenzung ueber TI" VALUE 0x75576 TKW_VV_VV_SW 100.0 FORMULA_0006 0.0 500.0000 /end CHARACTERISTIC
/begin CHARACTERISTIC K_N_MAX_FF_RESET "FF-Reset fuer meinen INCA-Spezl" VALUE 0x75578 TKW_VV_VV_UB 100.0 FORMULA_1011 0.0 255.0 /end CHARACTERISTIC
/begin CHARACTERISTIC K_N_BEGR_SK_RAMPE "Rampe fuer SK-Begrenzung | EN: Ramp for safety-concept limit [Upm/s]" VALUE 0x75579 TKW_VV_VV_UB 100.0 FORMULA_1012 0.0 25500.0000 /end CHARACTERISTIC
/begin CHARACTERISTIC K_N_BEGR_FERTIGUNG "N-Max-Begrenzung fuer Fertigung | EN: Rev limit for production/factory [Upm]" VALUE 0x7557A TKW_VV_VV_SW 100.0 FORMULA_0006 0.0 10000.0000 /end CHARACTERISTIC
/begin CHARACTERISTIC K_N_BEGR_TRANSPORT "N-Max-Begrenzung fuer Fertigung | EN: Rev limit for production/factory [Upm]" VALUE 0x7557C TKW_VV_VV_SW 100.0 FORMULA_0006 0.0 10000.0000 /end CHARACTERISTIC
/begin CHARACTERISTIC K_N_BEGR_WERKSTATT "N-Max-Begrenzung fuer Fertigung | EN: Rev limit for production/factory [Upm]" VALUE 0x7557E TKW_VV_VV_SW 100.0 FORMULA_0006 0.0 10000.0000 /end CHARACTERISTIC
/begin CHARACTERISTIC K_N_BEGR_FETRAWE_WEG "zul. Kilometerstand fuer N-Max-Begrenzung im Fertigungs- bzw. Transportmode | EN: Permitted mileage for rev limit in production or transport mode [km]" VALUE 0x75580 TKW_VV_VV_UW 100.0 FORMULA_0616 0.0 65535.0000 /end CHARACTERISTIC
/begin CHARACTERISTIC K_N_BEGR_V_FEHLER "N-Max-Begrenzung fuer Fertigung | EN: Rev limit for production/factory [Upm]" VALUE 0x75582 TKW_VV_VV_SW 100.0 FORMULA_0006 0.0 10000.0000 /end CHARACTERISTIC
/begin CHARACTERISTIC K_N_BEGR_FZG_STEHT "N-Max-Begrenzung fuer Fertigung | EN: N-Max-Begrenzung fuer Fertigung" VALUE 0x75584 TKW_VV_VV_SW 100.0 FORMULA_0006 0.0 10000.0000 /end CHARACTERISTIC
/begin CHARACTERISTIC K_N_BEGR_CFG "Konfiguration Begrenzer | EN: Konfiguration Begrenzer" VALUE 0x75586 TKW_VV_VV_UW 100.0 FORMULA_0010 0.0 65535.0000 /end CHARACTERISTIC
/begin CHARACTERISTIC K_N_BEGR_TGETR_AEBGR_UP "�nderungsbegrenzung Drehzahlbegr. nach oben, Tgetr | EN: Änderungsbegrenzung Drehzahlbegr. nach o ben, Tgetr" VALUE 0x75588 TKW_VV_VV_UW 100.0 FORMULA_1013 0.0 20000.0000 FORMAT "%5.2" /end CHARACTERISTIC
/begin CHARACTERISTIC K_N_BEGR_TGETR_AEBGR_DOWN "�nderungsbegrenzung Drehzahlbegr. nach unten, Tgetr | EN: Änderungsbegrenzung Drehzahlbegr. nach un ten, Tgetr" VALUE 0x7558A TKW_VV_VV_UW 100.0 FORMULA_1013 0.0 20000.0000 FORMAT "%5.2" /end CHARACTERISTIC
/begin CHARACTERISTIC KL_N_BEGR_GANG "gangabhaengige Drehzahlbegrenzung | EN: Gear-dependent rev limit" CURVE 0x7558C TKL_SW_VV_SW 100.0 FORMULA_0006 0.0 10000.0000 /begin AXIS_DESCR STD_AXIS FORMULA_0666 8 -1.0000 10.0000 /end AXIS_DESCR /end CHARACTERISTIC
/begin CHARACTERISTIC KL_N_BEGR_SK "Maximaldrehzahl bei SK-Fehler | EN: Maximum engine speed with safety-concept fault" CURVE 0x755AE TKL_UB_VV_SW 100.0 FORMULA_0006 0.0 10000.0000 /begin AXIS_DESCR STD_AXIS Stufe FORMULA_0003 6 0.0 255.0000 /end AXIS_DESCR /end CHARACTERISTIC
/begin CHARACTERISTIC KL_N_BEGR_TOEL_KALT "Begrenzung bei kaltem Oel | EN: Rev limit with cold oil" CURVE 0x755C2 TKL_SW_VV_SW 100.0 FORMULA_0006 0.0 10000.0000 /begin AXIS_DESCR STD_AXIS FORMULA_0023 6 -50.0000 170.0000 FORMAT "%4.1" /end AXIS_DESCR /end CHARACTERISTIC
/begin CHARACTERISTIC KL_N_BEGR_TOEL_HEISS "Begrenzung bei heissem Oel | EN: Rev limit with hot oil" CURVE 0x755DC TKL_SW_VV_SW 100.0 FORMULA_0006 0.0 10000.0000 /begin AXIS_DESCR STD_AXIS FORMULA_0023 6 -50.0000 170.0000 FORMAT "%4.1" /end AXIS_DESCR /end CHARACTERISTIC
/begin CHARACTERISTIC KL_N_BEGR_TMOT_HEISS "Begrenzung bei heissem Tmot | EN: Rev limit with hot coolant" CURVE 0x755F6 TKL_SW_VV_SW 100.0 FORMULA_0006 0.0 10000.0000 /begin AXIS_DESCR STD_AXIS FORMULA_0023 6 -50.0000 170.0000 FORMAT "%4.1" /end AXIS_DESCR /end CHARACTERISTIC
/begin CHARACTERISTIC KL_N_BEGR_TGETR_HEISS "Begrenzung bei heissem Getriebeoel | EN: Rev limit with hot gearbox oil" CURVE 0x75610 TKL_SW_VV_SW 100.0 FORMULA_0006 0.0 10000.0000 /begin AXIS_DESCR STD_AXIS FORMULA_0023 8 -50.0000 190.0000 FORMAT "%4.1" /end AXIS_DESCR /end CHARACTERISTIC
/begin CHARACTERISTIC KL_N_BEGR_TI_OFFSET "N-Offset auf Momenteneingriff | EN: N-Offset auf Momenteneingriff" CURVE 0x75632 TKL_SW_VV_SW 100.0 FORMULA_0006 0.0 10000.0000 /begin AXIS_DESCR STD_AXIS FORMULA_0006 4 0.0 10000.0000 /end AXIS_DESCR /end CHARACTERISTIC
/begin CHARACTERISTIC K_N_BEGR_ERR_E2 "max. Fehler nmax Ebene 2" VALUE 0x7A2CC TKW_VV_VV_UB 100.0 FORMULA_0003 0.0 255.0000 /end CHARACTERISTIC
/begin CHARACTERISTIC K_N_BEGR_TI_MAX_E2 "max. nBegr-TI Ebene 2 | EN: Maximum rev-limit injection, level 2 [Upm]" VALUE 0x7A2CE TKW_VV_VV_SW 100.0 FORMULA_0006 0.0 10000.0000 /end CHARACTERISTIC
/begin CHARACTERISTIC K_N_BEGR_OFF_E2 "Offset fuer Fehlererkennung Ebene 2" VALUE 0x7A2D0 TKW_VV_VV_SW 100.0 FORMULA_0006 0.0 10000.0000 /end CHARACTERISTIC
/* ------------------ Abschnitt erzeugt aus zwktibs.dat ------------------ */
/begin FUNCTION AdaptCommon "" /begin DEF_CHARACTERISTIC /end DEF_CHARACTERISTIC /begin REF_CHARACTERISTIC /end REF_CHARACTERISTIC /begin IN_MEASUREMENT /end IN_MEASUREMENT /begin OUT_MEASUREMENT /end OUT_MEASUREMENT /end FUNCTION
/begin FUNCTION Adaptiondaten_glob "" /begin DEF_CHARACTERISTIC /end DEF_CHARACTERISTIC /begin REF_CHARACTERISTIC /end REF_CHARACTERISTIC /begin IN_MEASUREMENT /end IN_MEASUREMENT /begin OUT_MEASUREMENT /end OUT_MEASUREMENT /end FUNCTION
/begin FUNCTION Adaptionswerte "" /begin DEF_CHARACTERISTIC /end DEF_CHARACTERISTIC /begin REF_CHARACTERISTIC /end REF_CHARACTERISTIC /begin IN_MEASUREMENT /end IN_MEASUREMENT /begin OUT_MEASUREMENT /end OUT_MEASUREMENT /end FUNCTION
/begin FUNCTION Ascet_interf ""
 /begin DEF_CHARACTERISTIC KF_OZ_TEMP_KOR KF_SCHNELLMSG_OZNIVR_MIN KL_GEN_AUSL_BEGR KL_OELLEVEL_KOMBI KL_OZ_LGMW_OFFSET KL_OZ_LL_L_OFFSET KL_OZ_LL_Q_OFFSET K_OZLBESCHS K_OZ_1L_BEGR_O K_OZ_1L_BEGR_U K_OZ_1_5_L_BEGR K_OZ_AG_MESSSTAB_MIN_OK K_OZ_AG_MESSSTAB_OK K_OZ_AG_MESSSTAB_OK_MAX K_OZ_ALT_HYST_F K_OZ_ALT_HYST_U K_OZ_ALT_NACHF K_OZ_CC_OELVERBRAUCH K_OZ_CC_OELVERLUST K_OZ_KRZ_HYST K_OZ_KRZ_HYST_CBS K_OZ_KRZ_MESSUNG_LL K_OZ_LZW_AEND_BEGR K_OZ_MIN_LEVEL_VOL K_OZ_NIV_KM_MAX K_OZ_N_OELMAXKORR_O K_OZ_N_OELMAXKORR_U K_OZ_OELVERLUST_FSP K_OZ_TEMPBW_KOPF K_OZ_TEMPBW_SUMPF K_OZ_TEMP_75 K_OZ_TEMP_KOR K_SCHNELLMSG_ANZAHL_WERTE K_SCHNELLMSG_KL15_AUSBLEND K_SCHNELLMSG_KL15_MAX K_SCHNELLMSG_N_MAX K_SCHNELLMSG_OZLBESCHS K_SCHNELLMSG_OZQBESCHS K_SCHNELLMSG_TOEL_MIN K_SCHNELLMSG_T_MS K_SCHNELLMSG_V_MAX /end DEF_CHARACTERISTIC
 /begin REF_CHARACTERISTIC /end REF_CHARACTERISTIC
 /begin IN_MEASUREMENT /end IN_MEASUREMENT
 /begin OUT_MEASUREMENT /end OUT_MEASUREMENT
/end FUNCTION
/begin FUNCTION Aussetzererkennung "" /begin DEF_CHARACTERISTIC /end DEF_CHARACTERISTIC /begin REF_CHARACTERISTIC /end REF_CHARACTERISTIC /begin IN_MEASUREMENT /end IN_MEASUREMENT /begin OUT_MEASUREMENT /end OUT_MEASUREMENT /end FUNCTION
/begin FUNCTION BSD_KOMPONENTENTREIBER ""
 /begin DEF_CHARACTERISTIC K_DI1000DT K_DI1000TGRZ K_DI200DT K_DIHIGHGRZ K_DKL15FIL K_DUIGRZ K_DUMINTGRZ K_DUREFMAX K_ENISOC0 K_ENUSOC0 K_ERREPEAT K_IBUNPLADEL K_ISLEEPGRZ K_ISTARTTRIG K_T1SCHWELLE K_T1SOC0 K_T2SCHWELLE K_T2SOC0 K_T3SCHWELLE K_T3SOC0 K_TNUSTART K_TNUSTARTFL K_TPT1TICO K_T_UTIEFSET K_UTIEFAPP /end DEF_CHARACTERISTIC
 /begin REF_CHARACTERISTIC /end REF_CHARACTERISTIC
 /begin IN_MEASUREMENT /end IN_MEASUREMENT
 /begin OUT_MEASUREMENT /end OUT_MEASUREMENT
/end FUNCTION
/begin FUNCTION Betriebssystem "" /begin DEF_CHARACTERISTIC /end DEF_CHARACTERISTIC /begin REF_CHARACTERISTIC /end REF_CHARACTERISTIC /begin IN_MEASUREMENT /end IN_MEASUREMENT /begin OUT_MEASUREMENT /end OUT_MEASUREMENT /end FUNCTION
/begin FUNCTION Carbtelegramm "" /begin DEF_CHARACTERISTIC /end DEF_CHARACTERISTIC /begin REF_CHARACTERISTIC /end REF_CHARACTERISTIC /begin IN_MEASUREMENT /end IN_MEASUREMENT /begin OUT_MEASUREMENT /end OUT_MEASUREMENT /end FUNCTION
/begin FUNCTION Checksumme "" /begin DEF_CHARACTERISTIC /end DEF_CHARACTERISTIC /begin REF_CHARACTERISTIC /end REF_CHARACTERISTIC /begin IN_MEASUREMENT /end IN_MEASUREMENT /begin OUT_MEASUREMENT /end OUT_MEASUREMENT /end FUNCTION
/begin FUNCTION DMTL ""
 /begin DEF_CHARACTERISTIC K_FST_ABWEICHUNG K_FST_CAN_FEHLER K_FST_FILT K_FST_NACHTANK K_FST_TANK_LEER_RECHTS K_FST_TANK_LEER_SUM K_FST_VERBRAUCH K_FST_VERBRAUCH_VOLL K_FST_VOLL K_FST_V_BETANK_END /end DEF_CHARACTERISTIC
 /begin REF_CHARACTERISTIC /end REF_CHARACTERISTIC
 /begin IN_MEASUREMENT /end IN_MEASUREMENT
 /begin OUT_MEASUREMENT /end OUT_MEASUREMENT
/end FUNCTION
/begin FUNCTION Debugging "" /begin DEF_CHARACTERISTIC /end DEF_CHARACTERISTIC /begin REF_CHARACTERISTIC /end REF_CHARACTERISTIC /begin IN_MEASUREMENT /end IN_MEASUREMENT /begin OUT_MEASUREMENT /end OUT_MEASUREMENT /end FUNCTION
/begin FUNCTION Diag_tr "" /begin DEF_CHARACTERISTIC /end DEF_CHARACTERISTIC /begin REF_CHARACTERISTIC /end REF_CHARACTERISTIC /begin IN_MEASUREMENT /end IN_MEASUREMENT /begin OUT_MEASUREMENT /end OUT_MEASUREMENT /end FUNCTION
/begin FUNCTION Drehtzahlwarnfeld ""
 /begin DEF_CHARACTERISTIC KL_DWF_SHLI_SEG KL_DWF_SHLI_V_DIFF K_DWF_CFG K_DWF_ORANGE_OFF K_DWF_SHLI_AX_AKTIV K_DWF_SHLI_TAB_FAK K_DWF_SHLI_TAU_DN K_DWF_SHLI_TAU_N K_DWF_SHLI_T_AKTIV K_DWF_SHLI_T_BL K_DWF_SHLI_T_FLS K_DWF_SHLI_T_INAKTIV K_DWF_SHLI_T_TOT /end DEF_CHARACTERISTIC
 /begin REF_CHARACTERISTIC /end REF_CHARACTERISTIC
 /begin IN_MEASUREMENT /end IN_MEASUREMENT
 /begin OUT_MEASUREMENT /end OUT_MEASUREMENT
/end FUNCTION
/begin FUNCTION Drehzahlerfassung ""
 /begin DEF_CHARACTERISTIC KL_N_BEGR_GANG KL_N_BEGR_SK KL_N_BEGR_TGETR_HEISS KL_N_BEGR_TI_OFFSET KL_N_BEGR_TMOT_HEISS KL_N_BEGR_TOEL_HEISS KL_N_BEGR_TOEL_KALT K_N_BEGR_CFG K_N_BEGR_EGAS_HYS K_N_BEGR_ERR_E2 K_N_BEGR_FERTIGUNG K_N_BEGR_FETRAWE_WEG K_N_BEGR_FZG_STEHT K_N_BEGR_OFF_E2 K_N_BEGR_SK_RAMPE K_N_BEGR_TGETR_AEBGR_DOWN K_N_BEGR_TGETR_AEBGR_UP K_N_BEGR_TI_HYS K_N_BEGR_TI_MAX_E2 K_N_BEGR_TI_OFF_RSS K_N_BEGR_TRANSPORT K_N_BEGR_V_FEHLER K_N_BEGR_WERKSTATT K_N_MAX_FF_RESET K_N_MIN_FREEZE K_N_OBD_DYN_DELTA K_N_OBD_DYN_T K_N_OBD_DYN_TAU K_N_OBERGRENZE K_N_ZEIT_STOERUNG /end DEF_CHARACTERISTIC
 /begin REF_CHARACTERISTIC /end REF_CHARACTERISTIC
 /begin IN_MEASUREMENT /end IN_MEASUREMENT
 /begin OUT_MEASUREMENT /end OUT_MEASUREMENT
/end FUNCTION
/begin FUNCTION E-Boxluefter "" /begin DEF_CHARACTERISTIC K_EBOX_ELU_EIN K_EBOX_ELU_HYS K_EBOX_ELU_LOSBRECHEN /end DEF_CHARACTERISTIC /begin REF_CHARACTERISTIC /end REF_CHARACTERISTIC /begin IN_MEASUREMENT /end IN_MEASUREMENT /begin OUT_MEASUREMENT /end OUT_MEASUREMENT /end FUNCTION
/begin FUNCTION EEPROM "" /begin DEF_CHARACTERISTIC /end DEF_CHARACTERISTIC /begin REF_CHARACTERISTIC /end REF_CHARACTERISTIC /begin IN_MEASUREMENT /end IN_MEASUREMENT /begin OUT_MEASUREMENT /end OUT_MEASUREMENT /end FUNCTION
/begin FUNCTION ELUP ""
 /begin DEF_CHARACTERISTIC KL_ELUP_AUS KL_ELUP_EIN KL_ELUP_EIN_V_DEL KL_ELUP_V_OFFS K_ELUP_CFG K_ELUP_OBD_ABS_DEL K_ELUP_OBD_BRPGRAD_SW K_ELUP_OBD_BRPGRAD_T K_ELUP_OBD_DEL K_ELUP_OBD_MVACP_GRAD_SW K_ELUP_OBD_MVACP_GRAD_T K_ELUP_OBD_PSAU_SW K_ELUP_OFF_TIME_MIN K_ELUP_ON_TIME_MAX K_ELUP_ON_TIME_MIN K_ELUP_PL_AN_SW K_ELUP_PL_IO_SW K_ELUP_PL_ON_TIME K_ELUP_UB_MIN /end DEF_CHARACTERISTIC
 /begin REF_CHARACTERISTIC /end REF_CHARACTERISTIC
 /begin IN_MEASUREMENT /end IN_MEASUREMENT
 /begin OUT_MEASUREMENT /end OUT_MEASUREMENT
/end FUNCTION
/begin FUNCTION EWS "" /begin DEF_CHARACTERISTIC K_EWS_FETRAWE_WEG /end DEF_CHARACTERISTIC /begin REF_CHARACTERISTIC /end REF_CHARACTERISTIC /begin IN_MEASUREMENT /end IN_MEASUREMENT /begin OUT_MEASUREMENT /end OUT_MEASUREMENT /end FUNCTION
/begin FUNCTION Egas "" /begin DEF_CHARACTERISTIC K_EGAS_CFG_DIAG /end DEF_CHARACTERISTIC /begin REF_CHARACTERISTIC /end REF_CHARACTERISTIC /begin IN_MEASUREMENT /end IN_MEASUREMENT /begin OUT_MEASUREMENT /end OUT_MEASUREMENT /end FUNCTION
/begin FUNCTION Eigendiagnose ""
 /begin DEF_CHARACTERISTIC K_ED_APPL_DATA_INJ.DEC_NACH_EINTRAG K_ED_APPL_DATA_INJ.DEC_VOR_EINTRAG K_ED_APPL_DATA_INJ.FEHLERSCHWELLE K_ED_APPL_DATA_INJ.INC_NACH_EINTRAG K_ED_APPL_DATA_INJ.INC_VOR_EINTRAG K_ED_APPL_DATA_INJ.KLASSENINDEX K_ED_APPL_DATA_INJ.OK_SCHWELLE K_ED_APPL_DATA_INJ.P_CODE_OPENLOAD K_ED_APPL_DATA_INJ.P_CODE_SH_TO_GND K_ED_APPL_DATA_INJ.P_CODE_SH_TO_UB K_ED_APPL_DATA_INJ.P_CODE_UNPLAUSIBEL K_ED_CSS_TIME K_ED_DK1_ENLTG.DEC_NACH_EINTRAG K_ED_DK1_ENLTG.DEC_VOR_EINTRAG K_ED_DK1_ENLTG.FEHLERSCHWELLE K_ED_DK1_ENLTG.INC_NACH_EINTRAG K_ED_DK1_ENLTG.INC_VOR_EINTRAG K_ED_DK1_ENLTG.KLASSENINDEX K_ED_DK1_ENLTG.OK_SCHWELLE K_ED_DK1_ENLTG.P_CODE_OPENLOAD K_ED_DK1_ENLTG.P_CODE_SH_TO_GND K_ED_DK1_ENLTG.P_CODE_SH_TO_UB K_ED_DK1_ENLTG.P_CODE_UNPLAUSIBEL K_ED_DK2_ENLTG.DEC_NACH_EINTRAG K_ED_DK2_ENLTG.DEC_VOR_EINTRAG K_ED_DK2_ENLTG.FEHLERSCHWELLE K_ED_DK2_ENLTG.INC_NACH_EINTRAG K_ED_DK2_ENLTG.INC_VOR_EINTRAG K_ED_DK2_ENLTG.KLASSENINDEX K_ED_DK2_ENLTG.OK_SCHWELLE K_ED_DK2_ENLTG.P_CODE_OPENLOAD K_ED_DK2_ENLTG.P_CODE_SH_TO_GND K_ED_DK2_ENLTG.P_CODE_SH_TO_UB K_ED_DK2_ENLTG.P_CODE_UNPLAUSIBEL K_ED_DMTL_DECKEL.DEC_NACH_EINTRAG K_ED_DMTL_DECKEL.DEC_VOR_EINTRAG K_ED_DMTL_DECKEL.FEHLERSCHWELLE K_ED_DMTL_DECKEL.INC_NACH_EINTRAG K_ED_DMTL_DECKEL.INC_VOR_EINTRAG K_ED_DMTL_DECKEL.KLASSENINDEX K_ED_DMTL_DECKEL.OK_SCHWELLE K_ED_DMTL_DECKEL.P_CODE_OPENLOAD K_ED_DMTL_DECKEL.P_CODE_SH_TO_GND K_ED_DMTL_DECKEL.P_CODE_SH_TO_UB K_ED_DMTL_DECKEL.P_CODE_UNPLAUSIBEL K_ED_DMTL_FEINLECK.DEC_NACH_EINTRAG K_ED_DMTL_FEINLECK.DEC_VOR_EINTRAG K_ED_DMTL_FEINLECK.FEHLERSCHWELLE K_ED_DMTL_FEINLECK.INC_NACH_EINTRAG K_ED_DMTL_FEINLECK.INC_VOR_EINTRAG K_ED_DMTL_FEINLECK.KLASSENINDEX K_ED_DMTL_FEINLECK.OK_SCHWELLE K_ED_DMTL_FEINLECK.P_CODE_OPENLOAD K_ED_DMTL_FEINLECK.P_CODE_SH_TO_GND K_ED_DMTL_FEINLECK.P_CODE_SH_TO_UB K_ED_DMTL_FEINLECK.P_CODE_UNPLAUSIBEL K_ED_DMTL_FEUCHT.DEC_NACH_EINTRAG K_ED_DMTL_FEUCHT.DEC_VOR_EINTRAG K_ED_DMTL_FEUCHT.FEHLERSCHWELLE K_ED_DMTL_FEUCHT.INC_NACH_EINTRAG K_ED_DMTL_FEUCHT.INC_VOR_EINTRAG K_ED_DMTL_FEUCHT.KLASSENINDEX K_ED_DMTL_FEUCHT.OK_SCHWELLE K_ED_DMTL_FEUCHT.P_CODE_OPENLOAD K_ED_DMTL_FEUCHT.P_CODE_SH_TO_GND K_ED_DMTL_FEUCHT.P_CODE_SH_TO_UB K_ED_DMTL_FEUCHT.P_CODE_UNPLAUSIBEL K_ED_DMTL_GROBLECK.DEC_NACH_EINTRAG K_ED_DMTL_GROBLECK.DEC_VOR_EINTRAG K_ED_DMTL_GROBLECK.FEHLERSCHWELLE K_ED_DMTL_GROBLECK.INC_NACH_EINTRAG K_ED_DMTL_GROBLECK.INC_VOR_EINTRAG K_ED_DMTL_GROBLECK.KLASSENINDEX K_ED_DMTL_GROBLECK.OK_SCHWELLE K_ED_DMTL_GROBLECK.P_CODE_OPENLOAD K_ED_DMTL_GROBLECK.P_CODE_SH_TO_GND K_ED_DMTL_GROBLECK.P_CODE_SH_TO_UB K_ED_DMTL_GROBLECK.P_CODE_UNPLAUSIBEL K_ED_DMTL_H.DEC_NACH_EINTRAG K_ED_DMTL_H.DEC_VOR_EINTRAG K_ED_DMTL_H.FEHLERSCHWELLE K_ED_DMTL_H.INC_NACH_EINTRAG K_ED_DMTL_H.INC_VOR_EINTRAG K_ED_DMTL_H.KLASSENINDEX K_ED_DMTL_H.OK_SCHWELLE K_ED_DMTL_H.P_CODE_OPENLOAD K_ED_DMTL_H.P_CODE_SH_TO_GND K_ED_DMTL_H.P_CODE_SH_TO_UB K_ED_DMTL_H.P_CODE_UNPLAUSIBEL K_ED_DMTL_P.DEC_NACH_EINTRAG K_ED_DMTL_P.DEC_VOR_EINTRAG K_ED_DMTL_P.FEHLERSCHWELLE K_ED_DMTL_P.INC_NACH_EINTRAG K_ED_DMTL_P.INC_VOR_EINTRAG K_ED_DMTL_P.KLASSENINDEX K_ED_DMTL_P.OK_SCHWELLE K_ED_DMTL_P.P_CODE_OPENLOAD K_ED_DMTL_P.P_CODE_SH_TO_GND K_ED_DMTL_P.P_CODE_SH_TO_UB K_ED_DMTL_P.P_CODE_UNPLAUSIBEL K_ED_DMTL_V.DEC_NACH_EINTRAG K_ED_DMTL_V.DEC_VOR_EINTRAG K_ED_DMTL_V.FEHLERSCHWELLE K_ED_DMTL_V.INC_NACH_EINTRAG K_ED_DMTL_V.INC_VOR_EINTRAG K_ED_DMTL_V.KLASSENINDEX K_ED_DMTL_V.OK_SCHWELLE K_ED_DMTL_V.P_CODE_OPENLOAD K_ED_DMTL_V.P_CODE_SH_TO_GND K_ED_DMTL_V.P_CODE_SH_TO_UB K_ED_DMTL_V.P_CODE_UNPLAUSIBEL K_ED_E2_INJ.DEC_NACH_EINTRAG K_ED_E2_INJ.DEC_VOR_EINTRAG K_ED_E2_INJ.FEHLERSCHWELLE K_ED_E2_INJ.INC_NACH_EINTRAG K_ED_E2_INJ.INC_VOR_EINTRAG K_ED_E2_INJ.KLASSENINDEX K_ED_E2_INJ.OK_SCHWELLE K_ED_E2_INJ.P_CODE_OPENLOAD K_ED_E2_INJ.P_CODE_SH_TO_GND K_ED_E2_INJ.P_CODE_SH_TO_UB K_ED_E2_INJ.P_CODE_UNPLAUSIBEL K_ED_EBOX_ELU.DEC_NACH_EINTRAG K_ED_EBOX_ELU.DEC_VOR_EINTRAG K_ED_EBOX_ELU.FEHLERSCHWELLE K_ED_EBOX_ELU.INC_NACH_EINTRAG K_ED_EBOX_ELU.INC_VOR_EINTRAG K_ED_EBOX_ELU.KLASSENINDEX K_ED_EBOX_ELU.OK_SCHWELLE K_ED_EBOX_ELU.P_CODE_OPENLOAD K_ED_EBOX_ELU.P_CODE_SH_TO_GND K_ED_EBOX_ELU.P_CODE_SH_TO_UB K_ED_EBOX_ELU.P_CODE_UNPLAUSIBEL K_ED_EKP_PWM.DEC_NACH_EINTRAG K_ED_EKP_PWM.DEC_VOR_EINTRAG K_ED_EKP_PWM.FEHLERSCHWELLE K_ED_EKP_PWM.INC_NACH_EINTRAG K_ED_EKP_PWM.INC_VOR_EINTRAG K_ED_EKP_PWM.KLASSENINDEX K_ED_EKP_PWM.OK_SCHWELLE K_ED_EKP_PWM.P_CODE_OPENLOAD K_ED_EKP_PWM.P_CODE_SH_TO_GND K_ED_EKP_PWM.P_CODE_SH_TO_UB K_ED_EKP_PWM.P_CODE_UNPLAUSIBEL K_ED_ELU.DEC_NACH_EINTRAG K_ED_ELU.DEC_VOR_EINTRAG K_ED_ELU.FEHLERSCHWELLE K_ED_ELU.INC_NACH_EINTRAG K_ED_ELU.INC_VOR_EINTRAG K_ED_ELU.KLASSENINDEX K_ED_ELU.OK_SCHWELLE K_ED_ELU.P_CODE_OPENLOAD K_ED_ELU.P_CODE_SH_TO_GND K_ED_ELU.P_CODE_SH_TO_UB K_ED_ELU.P_CODE_UNPLAUSIBEL K_ED_ELUP.DEC_NACH_EINTRAG K_ED_ELUP.DEC_VOR_EINTRAG K_ED_ELUP.FEHLERSCHWELLE K_ED_ELUP.INC_NACH_EINTRAG K_ED_ELUP.INC_VOR_EINTRAG K_ED_ELUP.KLASSENINDEX K_ED_ELUP.OK_SCHWELLE K_ED_ELUP.P_CODE_OPENLOAD K_ED_ELUP.P_CODE_SH_TO_GND K_ED_ELUP.P_CODE_SH_TO_UB K_ED_ELUP.P_CODE_UNPLAUSIBEL K_ED_ELUP_OBD.DEC_NACH_EINTRAG K_ED_ELUP_OBD.DEC_VOR_EINTRAG K_ED_ELUP_OBD.FEHLERSCHWELLE K_ED_ELUP_OBD.INC_NACH_EINTRAG K_ED_ELUP_OBD.INC_VOR_EINTRAG K_ED_ELUP_OBD.KLASSENINDEX K_ED_ELUP_OBD.OK_SCHWELLE K_ED_ELUP_OBD.P_CODE_OPENLOAD K_ED_ELUP_OBD.P_CODE_SH_TO_GND K_ED_ELUP_OBD.P_CODE_SH_TO_UB K_ED_ELUP_OBD.P_CODE_UNPLAUSIBEL K_ED_EV1.DEC_NACH_EINTRAG K_ED_EV1.DEC_VOR_EINTRAG K_ED_EV1.FEHLERSCHWELLE K_ED_EV1.INC_NACH_EINTRAG K_ED_EV1.INC_VOR_EINTRAG K_ED_EV1.KLASSENINDEX K_ED_EV1.OK_SCHWELLE K_ED_EV1.P_CODE_OPENLOAD K_ED_EV1.P_CODE_SH_TO_GND K_ED_EV1.P_CODE_SH_TO_UB K_ED_EV1.P_CODE_UNPLAUSIBEL K_ED_EV10.DEC_NACH_EINTRAG K_ED_EV10.DEC_VOR_EINTRAG K_ED_EV10.FEHLERSCHWELLE K_ED_EV10.INC_NACH_EINTRAG K_ED_EV10.INC_VOR_EINTRAG K_ED_EV10.KLASSENINDEX K_ED_EV10.OK_SCHWELLE K_ED_EV10.P_CODE_OPENLOAD K_ED_EV10.P_CODE_SH_TO_GND K_ED_EV10.P_CODE_SH_TO_UB K_ED_EV10.P_CODE_UNPLAUSIBEL K_ED_EV2.DEC_NACH_EINTRAG K_ED_EV2.DEC_VOR_EINTRAG K_ED_EV2.FEHLERSCHWELLE K_ED_EV2.INC_NACH_EINTRAG K_ED_EV2.INC_VOR_EINTRAG K_ED_EV2.KLASSENINDEX K_ED_EV2.OK_SCHWELLE K_ED_EV2.P_CODE_OPENLOAD K_ED_EV2.P_CODE_SH_TO_GND K_ED_EV2.P_CODE_SH_TO_UB K_ED_EV2.P_CODE_UNPLAUSIBEL K_ED_EV3.DEC_NACH_EINTRAG K_ED_EV3.DEC_VOR_EINTRAG K_ED_EV3.FEHLERSCHWELLE K_ED_EV3.INC_NACH_EINTRAG K_ED_EV3.INC_VOR_EINTRAG K_ED_EV3.KLASSENINDEX K_ED_EV3.OK_SCHWELLE K_ED_EV3.P_CODE_OPENLOAD K_ED_EV3.P_CODE_SH_TO_GND K_ED_EV3.P_CODE_SH_TO_UB K_ED_EV3.P_CODE_UNPLAUSIBEL K_ED_EV4.DEC_NACH_EINTRAG K_ED_EV4.DEC_VOR_EINTRAG K_ED_EV4.FEHLERSCHWELLE K_ED_EV4.INC_NACH_EINTRAG K_ED_EV4.INC_VOR_EINTRAG K_ED_EV4.KLASSENINDEX K_ED_EV4.OK_SCHWELLE K_ED_EV4.P_CODE_OPENLOAD K_ED_EV4.P_CODE_SH_TO_GND K_ED_EV4.P_CODE_SH_TO_UB K_ED_EV4.P_CODE_UNPLAUSIBEL K_ED_EV5.DEC_NACH_EINTRAG K_ED_EV5.DEC_VOR_EINTRAG K_ED_EV5.FEHLERSCHWELLE K_ED_EV5.INC_NACH_EINTRAG K_ED_EV5.INC_VOR_EINTRAG K_ED_EV5.KLASSENINDEX K_ED_EV5.OK_SCHWELLE K_ED_EV5.P_CODE_OPENLOAD K_ED_EV5.P_CODE_SH_TO_GND K_ED_EV5.P_CODE_SH_TO_UB K_ED_EV5.P_CODE_UNPLAUSIBEL K_ED_EV6.DEC_NACH_EINTRAG K_ED_EV6.DEC_VOR_EINTRAG K_ED_EV6.FEHLERSCHWELLE K_ED_EV6.INC_NACH_EINTRAG K_ED_EV6.INC_VOR_EINTRAG K_ED_EV6.KLASSENINDEX K_ED_EV6.OK_SCHWELLE K_ED_EV6.P_CODE_OPENLOAD K_ED_EV6.P_CODE_SH_TO_GND K_ED_EV6.P_CODE_SH_TO_UB K_ED_EV6.P_CODE_UNPLAUSIBEL K_ED_EV7.DEC_NACH_EINTRAG K_ED_EV7.DEC_VOR_EINTRAG K_ED_EV7.FEHLERSCHWELLE K_ED_EV7.INC_NACH_EINTRAG K_ED_EV7.INC_VOR_EINTRAG K_ED_EV7.KLASSENINDEX K_ED_EV7.OK_SCHWELLE K_ED_EV7.P_CODE_OPENLOAD K_ED_EV7.P_CODE_SH_TO_GND K_ED_EV7.P_CODE_SH_TO_UB K_ED_EV7.P_CODE_UNPLAUSIBEL K_ED_EV8.DEC_NACH_EINTRAG K_ED_EV8.DEC_VOR_EINTRAG K_ED_EV8.FEHLERSCHWELLE K_ED_EV8.INC_NACH_EINTRAG K_ED_EV8.INC_VOR_EINTRAG K_ED_EV8.KLASSENINDEX K_ED_EV8.OK_SCHWELLE K_ED_EV8.P_CODE_OPENLOAD K_ED_EV8.P_CODE_SH_TO_GND K_ED_EV8.P_CODE_SH_TO_UB K_ED_EV8.P_CODE_UNPLAUSIBEL K_ED_EV9.DEC_NACH_EINTRAG K_ED_EV9.DEC_VOR_EINTRAG K_ED_EV9.FEHLERSCHWELLE K_ED_EV9.INC_NACH_EINTRAG K_ED_EV9.INC_VOR_EINTRAG K_ED_EV9.KLASSENINDEX K_ED_EV9.OK_SCHWELLE K_ED_EV9.P_CODE_OPENLOAD K_ED_EV9.P_CODE_SH_TO_GND K_ED_EV9.P_CODE_SH_TO_UB K_ED_EV9.P_CODE_UNPLAUSIBEL K_ED_EWS_MAN.DEC_NACH_EINTRAG K_ED_EWS_MAN.DEC_VOR_EINTRAG K_ED_EWS_MAN.FEHLERSCHWELLE K_ED_EWS_MAN.INC_NACH_EINTRAG K_ED_EWS_MAN.INC_VOR_EINTRAG K_ED_EWS_MAN.KLASSENINDEX K_ED_EWS_MAN.OK_SCHWELLE K_ED_EWS_MAN.P_CODE_OPENLOAD K_ED_EWS_MAN.P_CODE_SH_TO_GND K_ED_EWS_MAN.P_CODE_SH_TO_UB K_ED_EWS_MAN.P_CODE_UNPLAUSIBEL K_ED_EWS_SCI.DEC_NACH_EINTRAG K_ED_EWS_SCI.DEC_VOR_EINTRAG K_ED_EWS_SCI.FEHLERSCHWELLE K_ED_EWS_SCI.INC_NACH_EINTRAG K_ED_EWS_SCI.INC_VOR_EINTRAG K_ED_EWS_SCI.KLASSENINDEX K_ED_EWS_SCI.OK_SCHWELLE K_ED_EWS_SCI.P_CODE_OPENLOAD K_ED_EWS_SCI.P_CODE_SH_TO_GND K_ED_EWS_SCI.P_CODE_SH_TO_UB K_ED_EWS_SCI.P_CODE_UNPLAUSIBEL K_ED_FETRAWE.DEC_NACH_EINTRAG K_ED_FETRAWE.DEC_VOR_EINTRAG K_ED_FETRAWE.FEHLERSCHWELLE K_ED_FETRAWE.INC_NACH_EINTRAG K_ED_FETRAWE.INC_VOR_EINTRAG K_ED_FETRAWE.KLASSENINDEX K_ED_FETRAWE.OK_SCHWELLE K_ED_FETRAWE.P_CODE_OPENLOAD K_ED_FETRAWE.P_CODE_SH_TO_GND K_ED_FETRAWE.P_CODE_SH_TO_UB K_ED_FETRAWE.P_CODE_UNPLAUSIBEL /end DEF_CHARACTERISTIC
 /begin REF_CHARACTERISTIC /end REF_CHARACTERISTIC
 /begin IN_MEASUREMENT /end IN_MEASUREMENT
 /begin OUT_MEASUREMENT /end OUT_MEASUREMENT
/end FUNCTION
/begin RECORD_LAYOUT TKW_VV_VV_UB FNC_VALUES 1 UBYTE COLUMN_DIR DIRECT /end RECORD_LAYOUT
/begin RECORD_LAYOUT TKW_VV_VV_SB FNC_VALUES 1 SBYTE COLUMN_DIR DIRECT /end RECORD_LAYOUT
/begin RECORD_LAYOUT TKW_VV_VV_UW FNC_VALUES 1 UWORD COLUMN_DIR DIRECT /end RECORD_LAYOUT
/begin RECORD_LAYOUT TKW_VV_VV_SW FNC_VALUES 1 SWORD COLUMN_DIR DIRECT /end RECORD_LAYOUT
/begin RECORD_LAYOUT TKW_VV_VV_UL FNC_VALUES 1 ULONG COLUMN_DIR DIRECT /end RECORD_LAYOUT
/begin RECORD_LAYOUT TKL_UB_VV_UB NO_AXIS_PTS_X 1 UBYTE RESERVED 2 BYTE AXIS_PTS_X 3 UBYTE INDEX_INCR DIRECT FNC_VALUES 4 UBYTE COLUMN_DIR DIRECT /end RECORD_LAYOUT
/begin RECORD_LAYOUT TKL_UB_VV_SW NO_AXIS_PTS_X 1 UBYTE RESERVED 2 BYTE AXIS_PTS_X 3 UBYTE INDEX_INCR DIRECT FNC_VALUES 4 SWORD COLUMN_DIR DIRECT /end RECORD_LAYOUT
/begin RECORD_LAYOUT TKL_SW_VV_UB NO_AXIS_PTS_X 1 UBYTE RESERVED 2 BYTE AXIS_PTS_X 3 SWORD INDEX_INCR DIRECT FNC_VALUES 4 UBYTE COLUMN_DIR DIRECT /end RECORD_LAYOUT
/begin RECORD_LAYOUT TKL_SW_VV_SB NO_AXIS_PTS_X 1 UBYTE RESERVED 2 BYTE AXIS_PTS_X 3 SWORD INDEX_INCR DIRECT FNC_VALUES 4 SBYTE COLUMN_DIR DIRECT /end RECORD_LAYOUT
/begin RECORD_LAYOUT TKL_SW_VV_UW NO_AXIS_PTS_X 1 UBYTE RESERVED 2 BYTE AXIS_PTS_X 3 SWORD INDEX_INCR DIRECT FNC_VALUES 4 UWORD COLUMN_DIR DIRECT /end RECORD_LAYOUT
/begin RECORD_LAYOUT TKL_SW_VV_SW NO_AXIS_PTS_X 1 UBYTE RESERVED 2 BYTE AXIS_PTS_X 3 SWORD INDEX_INCR DIRECT FNC_VALUES 4 SWORD COLUMN_DIR DIRECT /end RECORD_LAYOUT
/begin RECORD_LAYOUT TKF_SW_SW_UW NO_AXIS_PTS_X 1 UBYTE NO_AXIS_PTS_Y 2 UBYTE AXIS_PTS_X 3 SWORD INDEX_INCR DIRECT AXIS_PTS_Y 4 SWORD INDEX_INCR DIRECT FNC_VALUES 5 UWORD COLUMN_DIR DIRECT /end RECORD_LAYOUT
/begin RECORD_LAYOUT TKF_SW_SW_SW NO_AXIS_PTS_X 1 UBYTE NO_AXIS_PTS_Y 2 UBYTE AXIS_PTS_X 3 SWORD INDEX_INCR DIRECT AXIS_PTS_Y 4 SWORD INDEX_INCR DIRECT FNC_VALUES 5 SWORD COLUMN_DIR DIRECT /end RECORD_LAYOUT
/end MODULE
/end PROJECT
