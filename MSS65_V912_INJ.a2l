/begin PROJECT MSS65-inj-V912 "MSS65 INJ - V912.00-B204.00, data set 0569Q60Z520E"
/begin HEADER "" VERSION "V912.00-B204.00" /end HEADER
/begin MODULE _MSS65-inj "MSS65 INJ - V912.00-B204.00, data 7842800"
/begin MOD_COMMON "" BYTE_ORDER MSB_FIRST /* Default byteorder (Motorola) */ /end MOD_COMMON
/begin COMPU_METHOD FORMULA_0003 "FORMULA_0003" RAT_FUNC "%3.0" "-" COEFFS 0 1 0 0 0 1 /end COMPU_METHOD
/begin COMPU_METHOD FORMULA_0008 "FORMULA_0008" RAT_FUNC "%6.1" "V" COEFFS 0 10 0 0 0 1 /end COMPU_METHOD
/begin COMPU_METHOD FORMULA_0010 "FORMULA_0010" RAT_FUNC "%5.0" "-" COEFFS 0 1 0 0 0 1 /end COMPU_METHOD
/* ------------------ Abschnitt erzeugt aus adapt_glob.dat ------------------ */
/begin COMPU_METHOD FORMULA_0023 "FORMULA_0023" RAT_FUNC "%6.1" "�C" COEFFS 0 10 2732 0 0 1 /end COMPU_METHOD
/begin COMPU_METHOD FORMULA_0073 "FORMULA_0073" RAT_FUNC "%6.1" "s" COEFFS 0 10 0 0 0 1 /end COMPU_METHOD
/begin COMPU_METHOD FORMULA_0075 "FORMULA_0075" RAT_FUNC "%8.3" "-" COEFFS 0 1024 0 0 0 1 /end COMPU_METHOD
/begin COMPU_METHOD FORMULA_0076 "FORMULA_0076" RAT_FUNC "%6.1" "Kelvin" COEFFS 0 10 0 0 0 1 /end COMPU_METHOD
/begin COMPU_METHOD FORMULA_0077 "FORMULA_0077" RAT_FUNC "%6.1" "mbar" COEFFS 0 16 0 0 0 1 /end COMPU_METHOD
/begin COMPU_METHOD FORMULA_0078 "FORMULA_0078" RAT_FUNC "%6.1" "km/h" COEFFS 0 16 0 0 0 1 /end COMPU_METHOD
/* ------------------ Abschnitt erzeugt aus adapt_common.dat ------------------ */ /* ------------------ Abschnitt erzeugt aus adapt_glob.dat ------------------ */ /* ------------------ Abschnitt erzeugt aus crc32.dat ------------------ */ /* ------------------ Abschnitt erzeugt aus debug.dat ------------------ */ /* ------------------ Abschnitt erzeugt aus diag_tr_ed.dat ------------------ */ /* ------------------ Abschnitt erzeugt aus ed_glob.dat ------------------ */
/begin CHARACTERISTIC K_ED_SCDN_ABDECKUNG_EINTRAG "Similar Abdeckung fuer Fehlerspeichereintrag  | EN: Similar Abdeckung fuer Fehlerspeichereintrag" VALUE 0x71CAE TKW_VV_VV_UW 100.0 FORMULA_0075 0.0 4.0000 FORMAT "%6.3" /end CHARACTERISTIC
/begin CHARACTERISTIC K_ED_SCDN_ABDECKUNG_AUSTRAG "Similar Abdeckung fuer Fehlerspeicheraustrag  | EN: Similar Abdeckung fuer Fehlerspeicheraustrag" VALUE 0x71CB0 TKW_VV_VV_UW 100.0 FORMULA_0075 0.0 4.0000 FORMAT "%6.3" /end CHARACTERISTIC
/begin CHARACTERISTIC K_ED_RBM_PUMG_MIN "Mindestluftdruck fuer Rate-Based | EN: Minimum air pressure for rate-based OBD monitoring" VALUE 0x71CB6 TKW_VV_VV_SW 100.0 FORMULA_0077 400.0000 1200.0000 FORMAT "%4.1" /end CHARACTERISTIC
/begin CHARACTERISTIC K_ED_RBM_TUMG_MIN "Mindesttemperatur | EN: Minimum ambient temperature (rate-based monitoring)" VALUE 0x71CB8 TKW_VV_VV_SW 100.0 FORMULA_0023 -50.0000 170.0000 FORMAT "%4.1" /end CHARACTERISTIC
/begin CHARACTERISTIC K_ED_RBM_TIME "Gesamtzeit fuer Fahrzyklus | EN: Total time for drive cycle (rate-based monitoring)" VALUE 0x71CBA TKW_VV_VV_UW 100.0 FORMULA_0073 0.0 6553.5000 FORMAT "%4.1" /end CHARACTERISTIC
/begin CHARACTERISTIC K_ED_RBM_TIME_V "Geschwindigkeitszeit Fahrzyklus | EN: Time at speed in drive cycle (rate-based monitoring)" VALUE 0x71CBC TKW_VV_VV_UW 100.0 FORMULA_0073 0.0 6553.5000 FORMAT "%4.1" /end CHARACTERISTIC
/begin CHARACTERISTIC K_ED_RBM_TIME_LL "Mindestleerlauf Fahrzyklus | EN: Minimum idle time in drive cycle (rate-based monitoring)" VALUE 0x71CBE TKW_VV_VV_UW 100.0 FORMULA_0073 0.0 6553.5000 FORMAT "%4.1" /end CHARACTERISTIC
/begin CHARACTERISTIC K_ED_RBM_V_MIN "Mindestgeschwindigkeit Fahrzyklus | EN: Minimum vehicle speed in drive cycle (rate-based monitoring)" VALUE 0x71CC0 TKW_VV_VV_SW 100.0 FORMULA_0078 -80.0000 360.0000 FORMAT "%4.1" /end CHARACTERISTIC
/begin CHARACTERISTIC K_ED_RBM_EVAP_MIN "Mindesttemperatur EVAP | EN: Mindesttemperatur EVAP" VALUE 0x71CC2 TKW_VV_VV_SW 100.0 FORMULA_0023 -50.0000 170.0000 FORMAT "%4.1" /end CHARACTERISTIC
/begin CHARACTERISTIC K_ED_RBM_EVAP_MAX "Maximaltemperatur EVAP | EN: Maximaltemperatur EVAP" VALUE 0x71CC4 TKW_VV_VV_SW 100.0 FORMULA_0023 -50.0000 170.0000 FORMAT "%4.1" /end CHARACTERISTIC
/begin CHARACTERISTIC K_ED_RBM_EVAP_TEMP_DELTA "Max. Differenz zwischen tmot und tumg fuer EVAP | EN: Max. Differenz zwischen tmot und tumg fuer EVAP" VALUE 0x71CC6 TKW_VV_VV_SW 100.0 FORMULA_0076 -1000.0000 1000.0000 FORMAT "%4.1" /end CHARACTERISTIC
/begin CHARACTERISTIC K_ED_UBMIN "untere UB-Schwelle fuer elektr. Diagnosen | EN: Lower battery-voltage threshold for electrical diagnoses" VALUE 0x71CCA TKW_VV_VV_SW 100.0 FORMULA_0008 0.0 28.0000 FORMAT "%4.1" /end CHARACTERISTIC
/* ------------------ Abschnitt erzeugt aus ed.dat ------------------ */
/begin CHARACTERISTIC K_ED_SK_TR_INJ.P_CODE_SH_TO_UB "P-Code fuer die Art SH_TO_UB | EN: P-Code fuer die Art SH_TO_UB" VALUE 0x705EA TKW_VV_VV_UW 100.0 FORMULA_0010 0.0 65535.0000 /end CHARACTERISTIC
/begin CHARACTERISTIC K_ED_PUMG.P_CODE_SH_TO_UB "P-Code fuer die Art SH_TO_UB | EN: Fault code PUMG - OBD P-code reported for short to battery voltage" VALUE 0x70604 TKW_VV_VV_UW 100.0 FORMULA_0010 0.0 65535.0000 /end CHARACTERISTIC
/begin CHARACTERISTIC K_ED_VAN_HALL_E1.P_CODE_SH_TO_UB "P-Code fuer die Art SH_TO_UB | EN: Fault code VAN_HALL_E1 - OBD P-code reported for short to battery voltage" VALUE 0x70686 TKW_VV_VV_UW 100.0 FORMULA_0010 0.0 65535.0000 /end CHARACTERISTIC
/begin CHARACTERISTIC K_ED_VAN_HALL_A1.P_CODE_SH_TO_UB "P-Code fuer die Art SH_TO_UB | EN: Fault code VAN_HALL_A1 - OBD P-code reported for short to battery voltage" VALUE 0x706A0 TKW_VV_VV_UW 100.0 FORMULA_0010 0.0 65535.0000 /end CHARACTERISTIC
/begin CHARACTERISTIC K_ED_VAN_HALL_E2.P_CODE_SH_TO_UB "P-Code fuer die Art SH_TO_UB | EN: Fault code VAN_HALL_E2 - OBD P-code reported for short to battery voltage" VALUE 0x706BA TKW_VV_VV_UW 100.0 FORMULA_0010 0.0 65535.0000 /end CHARACTERISTIC
/begin CHARACTERISTIC K_ED_VAN_HALL_A2.P_CODE_SH_TO_UB "P-Code fuer die Art SH_TO_UB | EN: Fault code VAN_HALL_A2 - OBD P-code reported for short to battery voltage" VALUE 0x706D4 TKW_VV_VV_UW 100.0 FORMULA_0010 0.0 65535.0000 /end CHARACTERISTIC
/begin CHARACTERISTIC K_ED_VAN_REGL_E1.P_CODE_SH_TO_UB "P-Code fuer die Art SH_TO_UB | EN: Fault code VAN_REGL_E1 - OBD P-code reported for short to battery voltage" VALUE 0x706EE TKW_VV_VV_UW 100.0 FORMULA_0010 0.0 65535.0000 /end CHARACTERISTIC
/begin CHARACTERISTIC K_ED_VAN_REGL_A1.P_CODE_SH_TO_UB "P-Code fuer die Art SH_TO_UB | EN: Fault code VAN_REGL_A1 - OBD P-code reported for short to battery voltage" VALUE 0x70708 TKW_VV_VV_UW 100.0 FORMULA_0010 0.0 65535.0000 /end CHARACTERISTIC
/begin CHARACTERISTIC K_ED_VAN_REGL_E2.P_CODE_SH_TO_UB "P-Code fuer die Art SH_TO_UB | EN: Fault code VAN_REGL_E2 - OBD P-code reported for short to battery voltage" VALUE 0x70722 TKW_VV_VV_UW 100.0 FORMULA_0010 0.0 65535.0000 /end CHARACTERISTIC
/begin CHARACTERISTIC K_ED_VAN_REGL_A2.P_CODE_SH_TO_UB "P-Code fuer die Art SH_TO_UB | EN: Fault code VAN_REGL_A2 - OBD P-code reported for short to battery voltage" VALUE 0x7073C TKW_VV_VV_UW 100.0 FORMULA_0010 0.0 65535.0000 /end CHARACTERISTIC
/begin CHARACTERISTIC K_ED_PT_STATDKG.P_CODE_SH_TO_UB "P-Code fuer die Art SH_TO_UB | EN: Fault code PT_STATDKG - OBD P-code reported for short to battery voltage" VALUE 0x707A4 TKW_VV_VV_UW 100.0 FORMULA_0010 0.0 65535.0000 /end CHARACTERISTIC
/begin CHARACTERISTIC K_ED_PT_STATR.P_CODE_SH_TO_UB "P-Code fuer die Art SH_TO_UB | EN: Fault code PT_STATR - OBD P-code reported for short to battery voltage" VALUE 0x707D8 TKW_VV_VV_UW 100.0 FORMULA_0010 0.0 65535.0000 /end CHARACTERISTIC
/begin CHARACTERISTIC K_ED_PT_TORQDSC.P_CODE_SH_TO_UB "P-Code fuer die Art SH_TO_UB | EN: Fault code PT_TORQDSC - OBD P-code reported for short to battery voltage" VALUE 0x70910 TKW_VV_VV_UW 100.0 FORMULA_0010 0.0 65535.0000 /end CHARACTERISTIC
/begin CHARACTERISTIC K_ED_PT_STDSC.P_CODE_SH_TO_UB "P-Code fuer die Art SH_TO_UB | EN: Fault code PT_STDSC - OBD P-code reported for short to battery voltage" VALUE 0x7092A TKW_VV_VV_UW 100.0 FORMULA_0010 0.0 65535.0000 /end CHARACTERISTIC
/begin CHARACTERISTIC K_ED_PT_VRAD.P_CODE_SH_TO_UB "P-Code fuer die Art SH_TO_UB | EN: Fault code PT_VRAD - OBD P-code reported for short to battery voltage" VALUE 0x70944 TKW_VV_VV_UW 100.0 FORMULA_0010 0.0 65535.0000 /end CHARACTERISTIC
/begin CHARACTERISTIC K_ED_PT_VFZG.P_CODE_SH_TO_UB "P-Code fuer die Art SH_TO_UB | EN: Fault code PT_VFZG - OBD P-code reported for short to battery voltage" VALUE 0x7095E TKW_VV_VV_UW 100.0 FORMULA_0010 0.0 65535.0000 /end CHARACTERISTIC
/begin CHARACTERISTIC K_ED_PT_LRW.P_CODE_SH_TO_UB "P-Code fuer die Art SH_TO_UB | EN: Fault code PT_LRW - OBD P-code reported for short to battery voltage" VALUE 0x709C6 TKW_VV_VV_UW 100.0 FORMULA_0010 0.0 65535.0000 /end CHARACTERISTIC
/begin CHARACTERISTIC K_ED_SL_ML_HFM.P_CODE_SH_TO_UB "P-Code fuer die Art SH_TO_UB | EN: Fault code SL_ML_HFM - OBD P-code reported for short to battery voltage" VALUE 0x70A14 TKW_VV_VV_UW 100.0 FORMULA_0010 0.0 65535.0000 /end CHARACTERISTIC
/begin CHARACTERISTIC K_ED_TZ1.P_CODE_SH_TO_UB "P-Code fuer die Art SH_TO_UB | EN: Fault code TZ1 - OBD P-code reported for short to battery voltage" VALUE 0x70CB8 TKW_VV_VV_UW 100.0 FORMULA_0010 0.0 65535.0000 /end CHARACTERISTIC
/begin CHARACTERISTIC K_ED_TZ2.P_CODE_SH_TO_UB "P-Code fuer die Art SH_TO_UB | EN: Fault code TZ2 - OBD P-code reported for short to battery voltage" VALUE 0x70CD2 TKW_VV_VV_UW 100.0 FORMULA_0010 0.0 65535.0000 /end CHARACTERISTIC
/begin CHARACTERISTIC K_ED_TZ3.P_CODE_SH_TO_UB "P-Code fuer die Art SH_TO_UB | EN: Fault code TZ3 - OBD P-code reported for short to battery voltage" VALUE 0x70CEC TKW_VV_VV_UW 100.0 FORMULA_0010 0.0 65535.0000 /end CHARACTERISTIC
/begin CHARACTERISTIC K_ED_TZ4.P_CODE_SH_TO_UB "P-Code fuer die Art SH_TO_UB | EN: Fault code TZ4 - OBD P-code reported for short to battery voltage" VALUE 0x70D06 TKW_VV_VV_UW 100.0 FORMULA_0010 0.0 65535.0000 /end CHARACTERISTIC
/begin CHARACTERISTIC K_ED_TZ5.P_CODE_SH_TO_UB "P-Code fuer die Art SH_TO_UB | EN: Fault code TZ5 - OBD P-code reported for short to battery voltage" VALUE 0x70D20 TKW_VV_VV_UW 100.0 FORMULA_0010 0.0 65535.0000 /end CHARACTERISTIC
/begin CHARACTERISTIC K_ED_TZ6.P_CODE_SH_TO_UB "P-Code fuer die Art SH_TO_UB | EN: Fault code TZ6 - OBD P-code reported for short to battery voltage" VALUE 0x70D3A TKW_VV_VV_UW 100.0 FORMULA_0010 0.0 65535.0000 /end CHARACTERISTIC
/begin CHARACTERISTIC K_ED_TZ7.P_CODE_SH_TO_UB "P-Code fuer die Art SH_TO_UB | EN: Fault code TZ7 - OBD P-code reported for short to battery voltage" VALUE 0x70D54 TKW_VV_VV_UW 100.0 FORMULA_0010 0.0 65535.0000 /end CHARACTERISTIC
/begin CHARACTERISTIC K_ED_TZ8.P_CODE_SH_TO_UB "P-Code fuer die Art SH_TO_UB | EN: Fault code TZ8 - OBD P-code reported for short to battery voltage" VALUE 0x70D6E TKW_VV_VV_UW 100.0 FORMULA_0010 0.0 65535.0000 /end CHARACTERISTIC
/begin CHARACTERISTIC K_ED_TZ9.P_CODE_SH_TO_UB "P-Code fuer die Art SH_TO_UB | EN: Fault code TZ9 - OBD P-code reported for short to battery voltage" VALUE 0x70D88 TKW_VV_VV_UW 100.0 FORMULA_0010 0.0 65535.0000 /end CHARACTERISTIC
/begin CHARACTERISTIC K_ED_TZ10.P_CODE_SH_TO_UB "P-Code fuer die Art SH_TO_UB | EN: Fault code TZ10 - OBD P-code reported for short to battery voltage" VALUE 0x70DA2 TKW_VV_VV_UW 100.0 FORMULA_0010 0.0 65535.0000 /end CHARACTERISTIC
/begin CHARACTERISTIC K_ED_VAN_ANSCHL_E1.P_CODE_SH_TO_UB "P-Code fuer die Art SH_TO_UB | EN: Fault code VAN_ANSCHL_E1 - OBD P-code reported for short to battery voltage" VALUE 0x70DF0 TKW_VV_VV_UW 100.0 FORMULA_0010 0.0 65535.0000 /end CHARACTERISTIC
/begin CHARACTERISTIC K_ED_VAN_ANSCHL_A1.P_CODE_SH_TO_UB "P-Code fuer die Art SH_TO_UB | EN: Fault code VAN_ANSCHL_A1 - OBD P-code reported for short to battery voltage" VALUE 0x70E0A TKW_VV_VV_UW 100.0 FORMULA_0010 0.0 65535.0000 /end CHARACTERISTIC
/begin CHARACTERISTIC K_ED_VAN_ANSCHL_E2.P_CODE_SH_TO_UB "P-Code fuer die Art SH_TO_UB | EN: Fault code VAN_ANSCHL_E2 - OBD P-code reported for short to battery voltage" VALUE 0x70E24 TKW_VV_VV_UW 100.0 FORMULA_0010 0.0 65535.0000 /end CHARACTERISTIC
/begin CHARACTERISTIC K_ED_VAN_ANSCHL_A2.P_CODE_SH_TO_UB "P-Code fuer die Art SH_TO_UB | EN: Fault code VAN_ANSCHL_A2 - OBD P-code reported for short to battery voltage" VALUE 0x70E3E TKW_VV_VV_UW 100.0 FORMULA_0010 0.0 65535.0000 /end CHARACTERISTIC
/begin CHARACTERISTIC K_ED_PT_VEHMOD.P_CODE_SH_TO_UB "P-Code fuer die Art SH_TO_UB | EN: Fault code PT_VEHMOD - OBD P-code reported for short to battery voltage" VALUE 0x71012 TKW_VV_VV_UW 100.0 FORMULA_0010 0.0 65535.0000 /end CHARACTERISTIC
/begin CHARACTERISTIC K_ED_RLU87.P_CODE_SH_TO_UB "P-Code fuer die Art SH_TO_UB | EN: Fault code RLU87 - OBD P-code reported for short to battery voltage" VALUE 0x71116 TKW_VV_VV_UW 100.0 FORMULA_0010 0.0 65535.0000 /end CHARACTERISTIC
/begin CHARACTERISTIC K_ED_SSP.P_CODE_SH_TO_UB "P-Code fuer die Art SH_TO_UB" VALUE 0x7114A TKW_VV_VV_UW 100.0 FORMULA_0010 0.0 65535.0000 /end CHARACTERISTIC
/begin CHARACTERISTIC K_ED_TD.P_CODE_SH_TO_UB "P-Code fuer die Art SH_TO_UB | EN: Fault code TD - OBD P-code reported for short to battery voltage" VALUE 0x71164 TKW_VV_VV_UW 100.0 FORMULA_0010 0.0 65535.0000 /end CHARACTERISTIC
/begin CHARACTERISTIC K_ED_RLSLP.P_CODE_SH_TO_UB "P-Code fuer die Art SH_TO_UB | EN: Fault code RLSLP - OBD P-code reported for short to battery voltage" VALUE 0x7117E TKW_VV_VV_UW 100.0 FORMULA_0010 0.0 65535.0000 /end CHARACTERISTIC
/begin CHARACTERISTIC K_ED_SLV.P_CODE_SH_TO_UB "P-Code fuer die Art SH_TO_UB | EN: Fault code SLV - OBD P-code reported for short to battery voltage" VALUE 0x71198 TKW_VV_VV_UW 100.0 FORMULA_0010 0.0 65535.0000 /end CHARACTERISTIC
/begin CHARACTERISTIC K_ED_VAN_DSV.P_CODE_SH_TO_UB "P-Code fuer die Art SH_TO_UB | EN: Fault code VAN_DSV - OBD P-code reported for short to battery voltage" VALUE 0x71268 TKW_VV_VV_UW 100.0 FORMULA_0010 0.0 65535.0000 /end CHARACTERISTIC
/begin CHARACTERISTIC K_ED_SK_MANAGER_INJ.P_CODE_SH_TO_UB "P-Code fuer die Art SH_TO_UB | EN: Fault code SK_MANAGER_INJ - OBD P-code reported for short to battery voltage" VALUE 0x71386 TKW_VV_VV_UW 100.0 FORMULA_0010 0.0 65535.0000 /end CHARACTERISTIC
/begin CHARACTERISTIC K_ED_SSP_DIAG.P_CODE_SH_TO_UB "P-Code fuer die Art SH_TO_UB" VALUE 0x713A0 TKW_VV_VV_UW 100.0 FORMULA_0010 0.0 65535.0000 /end CHARACTERISTIC
/begin CHARACTERISTIC K_ED_SG_INJ.P_CODE_SH_TO_UB "P-Code fuer die Art SH_TO_UB | EN: Fault code SG_INJ - OBD P-code reported for short to battery voltage" VALUE 0x7148A TKW_VV_VV_UW 100.0 FORMULA_0010 0.0 65535.0000 /end CHARACTERISTIC
/begin CHARACTERISTIC K_ED_S_POEL_DIAG.P_CODE_SH_TO_UB "P-Code fuer die Art SH_TO_UB | EN: Fault code S_POEL_DIAG - OBD P-code reported for short to battery voltage" VALUE 0x714D8 TKW_VV_VV_UW 100.0 FORMULA_0010 0.0 65535.0000 /end CHARACTERISTIC
/begin CHARACTERISTIC K_ED_TE_OBD_1.P_CODE_SH_TO_UB "P-Code fuer die Art SH_TO_UB | EN: Fault code TE_OBD_1 - OBD P-code reported for short to battery voltage" VALUE 0x714F2 TKW_VV_VV_UW 100.0 FORMULA_0010 0.0 65535.0000 /end CHARACTERISTIC
/begin CHARACTERISTIC K_ED_TE_OBD_2.P_CODE_SH_TO_UB "P-Code fuer die Art SH_TO_UB | EN: Fault code TE_OBD_2 - OBD P-code reported for short to battery voltage" VALUE 0x7150C TKW_VV_VV_UW 100.0 FORMULA_0010 0.0 65535.0000 /end CHARACTERISTIC
/begin CHARACTERISTIC K_ED_TEV1.P_CODE_SH_TO_UB "P-Code fuer die Art SH_TO_UB | EN: Fault code TEV1 - OBD P-code reported for short to battery voltage" VALUE 0x71526 TKW_VV_VV_UW 100.0 FORMULA_0010 0.0 65535.0000 /end CHARACTERISTIC
/begin CHARACTERISTIC K_ED_TEV2.P_CODE_SH_TO_UB "P-Code fuer die Art SH_TO_UB | EN: Fault code TEV2 - OBD P-code reported for short to battery voltage" VALUE 0x71540 TKW_VV_VV_UW 100.0 FORMULA_0010 0.0 65535.0000 /end CHARACTERISTIC
/begin CHARACTERISTIC K_ED_SLP.P_CODE_SH_TO_UB "P-Code fuer die Art SH_TO_UB | EN: Fault code SLP - OBD P-code reported for short to battery voltage" VALUE 0x71610 TKW_VV_VV_UW 100.0 FORMULA_0010 0.0 65535.0000 /end CHARACTERISTIC
/begin CHARACTERISTIC K_ED_SL_DURCHS_B1.P_CODE_SH_TO_UB "P-Code fuer die Art SH_TO_UB | EN: Fault code SL_DURCHS_B1 - OBD P-code reported for short to battery voltage" VALUE 0x7162A TKW_VV_VV_UW 100.0 FORMULA_0010 0.0 65535.0000 /end CHARACTERISTIC
/begin CHARACTERISTIC K_ED_SL_DURCHS_B2.P_CODE_SH_TO_UB "P-Code fuer die Art SH_TO_UB | EN: Fault code SL_DURCHS_B2 - OBD P-code reported for short to battery voltage" VALUE 0x71644 TKW_VV_VV_UW 100.0 FORMULA_0010 0.0 65535.0000 /end CHARACTERISTIC
/begin CHARACTERISTIC K_ED_SL_DURCHS_HSTRANG.P_CODE_SH_TO_UB "P-Code fuer die Art SH_TO_UB | EN: Fault code SL_DURCHS_HSTRANG - OBD P-code reported for short to battery voltage" VALUE 0x7165E TKW_VV_VV_UW 100.0 FORMULA_0010 0.0 65535.0000 /end CHARACTERISTIC
/begin CHARACTERISTIC K_ED_S_GETR_HS.P_CODE_SH_TO_UB "P-Code fuer die Art SH_TO_UB | EN: Fault code S_GETR_HS - OBD P-code reported for short to battery voltage" VALUE 0x71692 TKW_VV_VV_UW 100.0 FORMULA_0010 0.0 65535.0000 /end CHARACTERISTIC
/begin CHARACTERISTIC K_ED_S_KUPP_HS.P_CODE_SH_TO_UB "P-Code fuer die Art SH_TO_UB | EN: Fault code S_KUPP_HS - OBD P-code reported for short to battery voltage" VALUE 0x716AC TKW_VV_VV_UW 100.0 FORMULA_0010 0.0 65535.0000 /end CHARACTERISTIC
/begin CHARACTERISTIC K_ED_VAN_DRUCK.P_CODE_SH_TO_UB "P-Code fuer die Art SH_TO_UB | EN: Fault code VAN_DRUCK - OBD P-code reported for short to battery voltage" VALUE 0x716C6 TKW_VV_VV_UW 100.0 FORMULA_0010 0.0 65535.0000 /end CHARACTERISTIC
/begin CHARACTERISTIC K_ED_PT_STATANH.P_CODE_SH_TO_UB "P-Code fuer die Art SH_TO_UB | EN: Fault code PT_STATANH - OBD P-code reported for short to battery voltage" VALUE 0x71714 TKW_VV_VV_UW 100.0 FORMULA_0010 0.0 65535.0000 /end CHARACTERISTIC
/begin CHARACTERISTIC K_ED_PT_STATGRB.P_CODE_SH_TO_UB "P-Code fuer die Art SH_TO_UB" VALUE 0x71796 TKW_VV_VV_UW 100.0 FORMULA_0010 0.0 65535.0000 /end CHARACTERISTIC
/begin CHARACTERISTIC K_ED_TANK_LEER.P_CODE_SH_TO_UB "P-Code fuer die Art SH_TO_UB | EN: Fault code TANK_LEER - OBD P-code reported for short to battery voltage" VALUE 0x717E4 TKW_VV_VV_UW 100.0 FORMULA_0010 0.0 65535.0000 /end CHARACTERISTIC
/begin CHARACTERISTIC K_ED_PT_TOMA.P_CODE_SH_TO_UB "P-Code fuer die Art SH_TO_UB | EN: Fault code PT_TOMA - OBD P-code reported for short to battery voltage" VALUE 0x717FE TKW_VV_VV_UW 100.0 FORMULA_0010 0.0 65535.0000 /end CHARACTERISTIC
/begin CHARACTERISTIC K_ED_PUMG_OBD.P_CODE_SH_TO_UB "P-Code fuer die Art SH_TO_UB | EN: Fault code PUMG_OBD - OBD P-code reported for short to battery voltage" VALUE 0x71832 TKW_VV_VV_UW 100.0 FORMULA_0010 0.0 65535.0000 /end CHARACTERISTIC
/begin CHARACTERISTIC K_ED_SL_ML_HFM_OBD.P_CODE_SH_TO_UB "P-Code fuer die Art SH_TO_UB | EN: Fault code SL_ML_HFM_OBD - OBD P-code reported for short to battery voltage" VALUE 0x7184C TKW_VV_VV_UW 100.0 FORMULA_0010 0.0 65535.0000 /end CHARACTERISTIC
/begin CHARACTERISTIC K_ED_TGETR_HS.P_CODE_SH_TO_UB "P-Code fuer die Art SH_TO_UB | EN: Fault code TGETR_HS - OBD P-code reported for short to battery voltage" VALUE 0x71984 TKW_VV_VV_UW 100.0 FORMULA_0010 0.0 65535.0000 /end CHARACTERISTIC
/begin CHARACTERISTIC K_ED_PT_OBD_ED.P_CODE_SH_TO_UB "P-Code fuer die Art SH_TO_UB" VALUE 0x719D2 TKW_VV_VV_UW 100.0 FORMULA_0010 0.0 65535.0000 /end CHARACTERISTIC
/begin CHARACTERISTIC K_ED_SK_TR_INJ.P_CODE_SH_TO_GND "P-Code fuer die Art SH_TO_GND | EN: P-Code fuer die Art SH_TO_GND" VALUE 0x705EC TKW_VV_VV_UW 100.0 FORMULA_0010 0.0 65535.0000 /end CHARACTERISTIC
/begin CHARACTERISTIC K_ED_PUMG.P_CODE_SH_TO_GND "P-Code fuer die Art SH_TO_GND | EN: Fault code PUMG - OBD P-code reported for short to ground" VALUE 0x70606 TKW_VV_VV_UW 100.0 FORMULA_0010 0.0 65535.0000 /end CHARACTERISTIC
/begin CHARACTERISTIC K_ED_VAN_HALL_E1.P_CODE_SH_TO_GND "P-Code fuer die Art SH_TO_GND | EN: Fault code VAN_HALL_E1 - OBD P-code reported for short to ground" VALUE 0x70688 TKW_VV_VV_UW 100.0 FORMULA_0010 0.0 65535.0000 /end CHARACTERISTIC
/begin CHARACTERISTIC K_ED_VAN_HALL_A1.P_CODE_SH_TO_GND "P-Code fuer die Art SH_TO_GND | EN: Fault code VAN_HALL_A1 - OBD P-code reported for short to ground" VALUE 0x706A2 TKW_VV_VV_UW 100.0 FORMULA_0010 0.0 65535.0000 /end CHARACTERISTIC
/begin CHARACTERISTIC K_ED_VAN_HALL_E2.P_CODE_SH_TO_GND "P-Code fuer die Art SH_TO_GND | EN: Fault code VAN_HALL_E2 - OBD P-code reported for short to ground" VALUE 0x706BC TKW_VV_VV_UW 100.0 FORMULA_0010 0.0 65535.0000 /end CHARACTERISTIC
/begin CHARACTERISTIC K_ED_VAN_HALL_A2.P_CODE_SH_TO_GND "P-Code fuer die Art SH_TO_GND | EN: Fault code VAN_HALL_A2 - OBD P-code reported for short to ground" VALUE 0x706D6 TKW_VV_VV_UW 100.0 FORMULA_0010 0.0 65535.0000 /end CHARACTERISTIC
/begin CHARACTERISTIC K_ED_VAN_REGL_E1.P_CODE_SH_TO_GND "P-Code fuer die Art SH_TO_GND | EN: Fault code VAN_REGL_E1 - OBD P-code reported for short to ground" VALUE 0x706F0 TKW_VV_VV_UW 100.0 FORMULA_0010 0.0 65535.0000 /end CHARACTERISTIC
/begin CHARACTERISTIC K_ED_VAN_REGL_A1.P_CODE_SH_TO_GND "P-Code fuer die Art SH_TO_GND | EN: Fault code VAN_REGL_A1 - OBD P-code reported for short to ground" VALUE 0x7070A TKW_VV_VV_UW 100.0 FORMULA_0010 0.0 65535.0000 /end CHARACTERISTIC
/begin CHARACTERISTIC K_ED_VAN_REGL_E2.P_CODE_SH_TO_GND "P-Code fuer die Art SH_TO_GND | EN: Fault code VAN_REGL_E2 - OBD P-code reported for short to ground" VALUE 0x70724 TKW_VV_VV_UW 100.0 FORMULA_0010 0.0 65535.0000 /end CHARACTERISTIC
/begin CHARACTERISTIC K_ED_VAN_REGL_A2.P_CODE_SH_TO_GND "P-Code fuer die Art SH_TO_GND | EN: Fault code VAN_REGL_A2 - OBD P-code reported for short to ground" VALUE 0x7073E TKW_VV_VV_UW 100.0 FORMULA_0010 0.0 65535.0000 /end CHARACTERISTIC
/begin CHARACTERISTIC K_ED_PT_STATDKG.P_CODE_SH_TO_GND "P-Code fuer die Art SH_TO_GND | EN: Fault code PT_STATDKG - OBD P-code reported for short to ground" VALUE 0x707A6 TKW_VV_VV_UW 100.0 FORMULA_0010 0.0 65535.0000 /end CHARACTERISTIC
/begin CHARACTERISTIC K_ED_PT_STATR.P_CODE_SH_TO_GND "P-Code fuer die Art SH_TO_GND | EN: Fault code PT_STATR - OBD P-code reported for short to ground" VALUE 0x707DA TKW_VV_VV_UW 100.0 FORMULA_0010 0.0 65535.0000 /end CHARACTERISTIC
/begin CHARACTERISTIC K_ED_PT_TORQDSC.P_CODE_SH_TO_GND "P-Code fuer die Art SH_TO_GND | EN: Fault code PT_TORQDSC - OBD P-code reported for short to ground" VALUE 0x70912 TKW_VV_VV_UW 100.0 FORMULA_0010 0.0 65535.0000 /end CHARACTERISTIC
/begin CHARACTERISTIC K_ED_PT_STDSC.P_CODE_SH_TO_GND "P-Code fuer die Art SH_TO_GND | EN: Fault code PT_STDSC - OBD P-code reported for short to ground" VALUE 0x7092C TKW_VV_VV_UW 100.0 FORMULA_0010 0.0 65535.0000 /end CHARACTERISTIC
/begin CHARACTERISTIC K_ED_PT_VRAD.P_CODE_SH_TO_GND "P-Code fuer die Art SH_TO_GND | EN: Fault code PT_VRAD - OBD P-code reported for short to ground" VALUE 0x70946 TKW_VV_VV_UW 100.0 FORMULA_0010 0.0 65535.0000 /end CHARACTERISTIC
/begin CHARACTERISTIC K_ED_PT_VFZG.P_CODE_SH_TO_GND "P-Code fuer die Art SH_TO_GND | EN: Fault code PT_VFZG - OBD P-code reported for short to ground" VALUE 0x70960 TKW_VV_VV_UW 100.0 FORMULA_0010 0.0 65535.0000 /end CHARACTERISTIC
/begin CHARACTERISTIC K_ED_PT_LRW.P_CODE_SH_TO_GND "P-Code fuer die Art SH_TO_GND | EN: Fault code PT_LRW - OBD P-code reported for short to ground" VALUE 0x709C8 TKW_VV_VV_UW 100.0 FORMULA_0010 0.0 65535.0000 /end CHARACTERISTIC
/begin CHARACTERISTIC K_ED_SL_ML_HFM.P_CODE_SH_TO_GND "P-Code fuer die Art SH_TO_GND | EN: Fault code SL_ML_HFM - OBD P-code reported for short to ground" VALUE 0x70A16 TKW_VV_VV_UW 100.0 FORMULA_0010 0.0 65535.0000 /end CHARACTERISTIC
/begin CHARACTERISTIC K_ED_TZ1.P_CODE_SH_TO_GND "P-Code fuer die Art SH_TO_GND | EN: Fault code TZ1 - OBD P-code reported for short to ground" VALUE 0x70CBA TKW_VV_VV_UW 100.0 FORMULA_0010 0.0 65535.0000 /end CHARACTERISTIC
/begin CHARACTERISTIC K_ED_TZ2.P_CODE_SH_TO_GND "P-Code fuer die Art SH_TO_GND | EN: Fault code TZ2 - OBD P-code reported for short to ground" VALUE 0x70CD4 TKW_VV_VV_UW 100.0 FORMULA_0010 0.0 65535.0000 /end CHARACTERISTIC
/begin CHARACTERISTIC K_ED_TZ3.P_CODE_SH_TO_GND "P-Code fuer die Art SH_TO_GND | EN: Fault code TZ3 - OBD P-code reported for short to ground" VALUE 0x70CEE TKW_VV_VV_UW 100.0 FORMULA_0010 0.0 65535.0000 /end CHARACTERISTIC
/begin CHARACTERISTIC K_ED_TZ4.P_CODE_SH_TO_GND "P-Code fuer die Art SH_TO_GND | EN: Fault code TZ4 - OBD P-code reported for short to ground" VALUE 0x70D08 TKW_VV_VV_UW 100.0 FORMULA_0010 0.0 65535.0000 /end CHARACTERISTIC
/begin CHARACTERISTIC K_ED_TZ5.P_CODE_SH_TO_GND "P-Code fuer die Art SH_TO_GND | EN: Fault code TZ5 - OBD P-code reported for short to ground" VALUE 0x70D22 TKW_VV_VV_UW 100.0 FORMULA_0010 0.0 65535.0000 /end CHARACTERISTIC
/begin CHARACTERISTIC K_ED_TZ6.P_CODE_SH_TO_GND "P-Code fuer die Art SH_TO_GND | EN: Fault code TZ6 - OBD P-code reported for short to ground" VALUE 0x70D3C TKW_VV_VV_UW 100.0 FORMULA_0010 0.0 65535.0000 /end CHARACTERISTIC
/begin CHARACTERISTIC K_ED_TZ7.P_CODE_SH_TO_GND "P-Code fuer die Art SH_TO_GND | EN: Fault code TZ7 - OBD P-code reported for short to ground" VALUE 0x70D56 TKW_VV_VV_UW 100.0 FORMULA_0010 0.0 65535.0000 /end CHARACTERISTIC
/begin CHARACTERISTIC K_ED_TZ8.P_CODE_SH_TO_GND "P-Code fuer die Art SH_TO_GND | EN: Fault code TZ8 - OBD P-code reported for short to ground" VALUE 0x70D70 TKW_VV_VV_UW 100.0 FORMULA_0010 0.0 65535.0000 /end CHARACTERISTIC
/begin CHARACTERISTIC K_ED_TZ9.P_CODE_SH_TO_GND "P-Code fuer die Art SH_TO_GND | EN: Fault code TZ9 - OBD P-code reported for short to ground" VALUE 0x70D8A TKW_VV_VV_UW 100.0 FORMULA_0010 0.0 65535.0000 /end CHARACTERISTIC
/begin CHARACTERISTIC K_ED_TZ10.P_CODE_SH_TO_GND "P-Code fuer die Art SH_TO_GND | EN: Fault code TZ10 - OBD P-code reported for short to ground" VALUE 0x70DA4 TKW_VV_VV_UW 100.0 FORMULA_0010 0.0 65535.0000 /end CHARACTERISTIC
/begin CHARACTERISTIC K_ED_VAN_ANSCHL_E1.P_CODE_SH_TO_GND "P-Code fuer die Art SH_TO_GND | EN: Fault code VAN_ANSCHL_E1 - OBD P-code reported for short to ground" VALUE 0x70DF2 TKW_VV_VV_UW 100.0 FORMULA_0010 0.0 65535.0000 /end CHARACTERISTIC
/begin CHARACTERISTIC K_ED_VAN_ANSCHL_A1.P_CODE_SH_TO_GND "P-Code fuer die Art SH_TO_GND | EN: Fault code VAN_ANSCHL_A1 - OBD P-code reported for short to ground" VALUE 0x70E0C TKW_VV_VV_UW 100.0 FORMULA_0010 0.0 65535.0000 /end CHARACTERISTIC
/begin CHARACTERISTIC K_ED_VAN_ANSCHL_E2.P_CODE_SH_TO_GND "P-Code fuer die Art SH_TO_GND | EN: Fault code VAN_ANSCHL_E2 - OBD P-code reported for short to ground" VALUE 0x70E26 TKW_VV_VV_UW 100.0 FORMULA_0010 0.0 65535.0000 /end CHARACTERISTIC
/begin CHARACTERISTIC K_ED_VAN_ANSCHL_A2.P_CODE_SH_TO_GND "P-Code fuer die Art SH_TO_GND | EN: Fault code VAN_ANSCHL_A2 - OBD P-code reported for short to ground" VALUE 0x70E40 TKW_VV_VV_UW 100.0 FORMULA_0010 0.0 65535.0000 /end CHARACTERISTIC
/begin CHARACTERISTIC K_ED_PT_VEHMOD.P_CODE_SH_TO_GND "P-Code fuer die Art SH_TO_GND | EN: Fault code PT_VEHMOD - OBD P-code reported for short to ground" VALUE 0x71014 TKW_VV_VV_UW 100.0 FORMULA_0010 0.0 65535.0000 /end CHARACTERISTIC
/begin CHARACTERISTIC K_ED_RLU87.P_CODE_SH_TO_GND "P-Code fuer die Art SH_TO_GND | EN: Fault code RLU87 - OBD P-code reported for short to ground" VALUE 0x71118 TKW_VV_VV_UW 100.0 FORMULA_0010 0.0 65535.0000 /end CHARACTERISTIC
/begin CHARACTERISTIC K_ED_SSP.P_CODE_SH_TO_GND "P-Code fuer die Art SH_TO_GND" VALUE 0x7114C TKW_VV_VV_UW 100.0 FORMULA_0010 0.0 65535.0000 /end CHARACTERISTIC
/begin CHARACTERISTIC K_ED_TD.P_CODE_SH_TO_GND "P-Code fuer die Art SH_TO_GND | EN: Fault code TD - OBD P-code reported for short to ground" VALUE 0x71166 TKW_VV_VV_UW 100.0 FORMULA_0010 0.0 65535.0000 /end CHARACTERISTIC
/begin CHARACTERISTIC K_ED_RLSLP.P_CODE_SH_TO_GND "P-Code fuer die Art SH_TO_GND | EN: Fault code RLSLP - OBD P-code reported for short to ground" VALUE 0x71180 TKW_VV_VV_UW 100.0 FORMULA_0010 0.0 65535.0000 /end CHARACTERISTIC
/begin CHARACTERISTIC K_ED_SLV.P_CODE_SH_TO_GND "P-Code fuer die Art SH_TO_GND | EN: Fault code SLV - OBD P-code reported for short to ground" VALUE 0x7119A TKW_VV_VV_UW 100.0 FORMULA_0010 0.0 65535.0000 /end CHARACTERISTIC
/begin CHARACTERISTIC K_ED_VAN_DSV.P_CODE_SH_TO_GND "P-Code fuer die Art SH_TO_GND | EN: Fault code VAN_DSV - OBD P-code reported for short to ground" VALUE 0x7126A TKW_VV_VV_UW 100.0 FORMULA_0010 0.0 65535.0000 /end CHARACTERISTIC
/begin CHARACTERISTIC K_ED_SK_MANAGER_INJ.P_CODE_SH_TO_GND "P-Code fuer die Art SH_TO_GND | EN: Fault code SK_MANAGER_INJ - OBD P-code reported for short to ground" VALUE 0x71388 TKW_VV_VV_UW 100.0 FORMULA_0010 0.0 65535.0000 /end CHARACTERISTIC
/begin CHARACTERISTIC K_ED_SSP_DIAG.P_CODE_SH_TO_GND "P-Code fuer die Art SH_TO_GND" VALUE 0x713A2 TKW_VV_VV_UW 100.0 FORMULA_0010 0.0 65535.0000 /end CHARACTERISTIC
/begin CHARACTERISTIC K_ED_SG_INJ.P_CODE_SH_TO_GND "P-Code fuer die Art SH_TO_GND | EN: Fault code SG_INJ - OBD P-code reported for short to ground" VALUE 0x7148C TKW_VV_VV_UW 100.0 FORMULA_0010 0.0 65535.0000 /end CHARACTERISTIC
/begin CHARACTERISTIC K_ED_S_POEL_DIAG.P_CODE_SH_TO_GND "P-Code fuer die Art SH_TO_GND | EN: Fault code S_POEL_DIAG - OBD P-code reported for short to ground" VALUE 0x714DA TKW_VV_VV_UW 100.0 FORMULA_0010 0.0 65535.0000 /end CHARACTERISTIC
/begin CHARACTERISTIC K_ED_TE_OBD_1.P_CODE_SH_TO_GND "P-Code fuer die Art SH_TO_GND | EN: Fault code TE_OBD_1 - OBD P-code reported for short to ground" VALUE 0x714F4 TKW_VV_VV_UW 100.0 FORMULA_0010 0.0 65535.0000 /end CHARACTERISTIC
/begin CHARACTERISTIC K_ED_TE_OBD_2.P_CODE_SH_TO_GND "P-Code fuer die Art SH_TO_GND | EN: Fault code TE_OBD_2 - OBD P-code reported for short to ground" VALUE 0x7150E TKW_VV_VV_UW 100.0 FORMULA_0010 0.0 65535.0000 /end CHARACTERISTIC
/begin CHARACTERISTIC K_ED_TEV1.P_CODE_SH_TO_GND "P-Code fuer die Art SH_TO_GND | EN: Fault code TEV1 - OBD P-code reported for short to ground" VALUE 0x71528 TKW_VV_VV_UW 100.0 FORMULA_0010 0.0 65535.0000 /end CHARACTERISTIC
/begin CHARACTERISTIC K_ED_TEV2.P_CODE_SH_TO_GND "P-Code fuer die Art SH_TO_GND | EN: Fault code TEV2 - OBD P-code reported for short to ground" VALUE 0x71542 TKW_VV_VV_UW 100.0 FORMULA_0010 0.0 65535.0000 /end CHARACTERISTIC
/begin CHARACTERISTIC K_ED_SLP.P_CODE_SH_TO_GND "P-Code fuer die Art SH_TO_GND | EN: Fault code SLP - OBD P-code reported for short to ground" VALUE 0x71612 TKW_VV_VV_UW 100.0 FORMULA_0010 0.0 65535.0000 /end CHARACTERISTIC
/begin CHARACTERISTIC K_ED_SL_DURCHS_B1.P_CODE_SH_TO_GND "P-Code fuer die Art SH_TO_GND | EN: Fault code SL_DURCHS_B1 - OBD P-code reported for short to ground" VALUE 0x7162C TKW_VV_VV_UW 100.0 FORMULA_0010 0.0 65535.0000 /end CHARACTERISTIC
/begin CHARACTERISTIC K_ED_SL_DURCHS_B2.P_CODE_SH_TO_GND "P-Code fuer die Art SH_TO_GND | EN: Fault code SL_DURCHS_B2 - OBD P-code reported for short to ground" VALUE 0x71646 TKW_VV_VV_UW 100.0 FORMULA_0010 0.0 65535.0000 /end CHARACTERISTIC
/begin CHARACTERISTIC K_ED_SL_DURCHS_HSTRANG.P_CODE_SH_TO_GND "P-Code fuer die Art SH_TO_GND | EN: Fault code SL_DURCHS_HSTRANG - OBD P-code reported for short to ground" VALUE 0x71660 TKW_VV_VV_UW 100.0 FORMULA_0010 0.0 65535.0000 /end CHARACTERISTIC
/begin CHARACTERISTIC K_ED_S_GETR_HS.P_CODE_SH_TO_GND "P-Code fuer die Art SH_TO_GND | EN: Fault code S_GETR_HS - OBD P-code reported for short to ground" VALUE 0x71694 TKW_VV_VV_UW 100.0 FORMULA_0010 0.0 65535.0000 /end CHARACTERISTIC
/begin CHARACTERISTIC K_ED_S_KUPP_HS.P_CODE_SH_TO_GND "P-Code fuer die Art SH_TO_GND | EN: Fault code S_KUPP_HS - OBD P-code reported for short to ground" VALUE 0x716AE TKW_VV_VV_UW 100.0 FORMULA_0010 0.0 65535.0000 /end CHARACTERISTIC
/begin CHARACTERISTIC K_ED_VAN_DRUCK.P_CODE_SH_TO_GND "P-Code fuer die Art SH_TO_GND | EN: Fault code VAN_DRUCK - OBD P-code reported for short to ground" VALUE 0x716C8 TKW_VV_VV_UW 100.0 FORMULA_0010 0.0 65535.0000 /end CHARACTERISTIC
/begin CHARACTERISTIC K_ED_PT_STATANH.P_CODE_SH_TO_GND "P-Code fuer die Art SH_TO_GND | EN: Fault code PT_STATANH - OBD P-code reported for short to ground" VALUE 0x71716 TKW_VV_VV_UW 100.0 FORMULA_0010 0.0 65535.0000 /end CHARACTERISTIC
/begin CHARACTERISTIC K_ED_PT_STATGRB.P_CODE_SH_TO_GND "P-Code fuer die Art SH_TO_GND" VALUE 0x71798 TKW_VV_VV_UW 100.0 FORMULA_0010 0.0 65535.0000 /end CHARACTERISTIC
/begin CHARACTERISTIC K_ED_TANK_LEER.P_CODE_SH_TO_GND "P-Code fuer die Art SH_TO_GND | EN: Fault code TANK_LEER - OBD P-code reported for short to ground" VALUE 0x717E6 TKW_VV_VV_UW 100.0 FORMULA_0010 0.0 65535.0000 /end CHARACTERISTIC
/begin CHARACTERISTIC K_ED_PT_TOMA.P_CODE_SH_TO_GND "P-Code fuer die Art SH_TO_GND | EN: Fault code PT_TOMA - OBD P-code reported for short to ground" VALUE 0x71800 TKW_VV_VV_UW 100.0 FORMULA_0010 0.0 65535.0000 /end CHARACTERISTIC
/begin CHARACTERISTIC K_ED_PUMG_OBD.P_CODE_SH_TO_GND "P-Code fuer die Art SH_TO_GND | EN: Fault code PUMG_OBD - OBD P-code reported for short to ground" VALUE 0x71834 TKW_VV_VV_UW 100.0 FORMULA_0010 0.0 65535.0000 /end CHARACTERISTIC
/begin CHARACTERISTIC K_ED_SL_ML_HFM_OBD.P_CODE_SH_TO_GND "P-Code fuer die Art SH_TO_GND | EN: Fault code SL_ML_HFM_OBD - OBD P-code reported for short to ground" VALUE 0x7184E TKW_VV_VV_UW 100.0 FORMULA_0010 0.0 65535.0000 /end CHARACTERISTIC
/begin CHARACTERISTIC K_ED_TGETR_HS.P_CODE_SH_TO_GND "P-Code fuer die Art SH_TO_GND | EN: Fault code TGETR_HS - OBD P-code reported for short to ground" VALUE 0x71986 TKW_VV_VV_UW 100.0 FORMULA_0010 0.0 65535.0000 /end CHARACTERISTIC
/begin CHARACTERISTIC K_ED_PT_OBD_ED.P_CODE_SH_TO_GND "P-Code fuer die Art SH_TO_GND" VALUE 0x719D4 TKW_VV_VV_UW 100.0 FORMULA_0010 0.0 65535.0000 /end CHARACTERISTIC
/begin CHARACTERISTIC K_ED_SK_TR_INJ.P_CODE_OPENLOAD "P-Code fuer die Art OPENLOAD | EN: P-Code fuer die Art OPENLOAD" VALUE 0x705EE TKW_VV_VV_UW 100.0 FORMULA_0010 0.0 65535.0000 /end CHARACTERISTIC
/begin CHARACTERISTIC K_ED_VAN_HALL_E1.P_CODE_OPENLOAD "P-Code fuer die Art OPENLOAD | EN: Fault code VAN_HALL_E1 - OBD P-code reported for open circuit" VALUE 0x7068A TKW_VV_VV_UW 100.0 FORMULA_0010 0.0 65535.0000 /end CHARACTERISTIC
/begin CHARACTERISTIC K_ED_VAN_HALL_A1.P_CODE_OPENLOAD "P-Code fuer die Art OPENLOAD | EN: Fault code VAN_HALL_A1 - OBD P-code reported for open circuit" VALUE 0x706A4 TKW_VV_VV_UW 100.0 FORMULA_0010 0.0 65535.0000 /end CHARACTERISTIC
/begin CHARACTERISTIC K_ED_VAN_HALL_E2.P_CODE_OPENLOAD "P-Code fuer die Art OPENLOAD | EN: Fault code VAN_HALL_E2 - OBD P-code reported for open circuit" VALUE 0x706BE TKW_VV_VV_UW 100.0 FORMULA_0010 0.0 65535.0000 /end CHARACTERISTIC
/begin CHARACTERISTIC K_ED_VAN_HALL_A2.P_CODE_OPENLOAD "P-Code fuer die Art OPENLOAD | EN: Fault code VAN_HALL_A2 - OBD P-code reported for open circuit" VALUE 0x706D8 TKW_VV_VV_UW 100.0 FORMULA_0010 0.0 65535.0000 /end CHARACTERISTIC
/begin CHARACTERISTIC K_ED_PT_STATDKG.P_CODE_OPENLOAD "P-Code fuer die Art OPENLOAD | EN: Fault code PT_STATDKG - OBD P-code reported for open circuit" VALUE 0x707A8 TKW_VV_VV_UW 100.0 FORMULA_0010 0.0 65535.0000 /end CHARACTERISTIC
/begin CHARACTERISTIC K_ED_PT_STATR.P_CODE_OPENLOAD "P-Code fuer die Art OPENLOAD | EN: Fault code PT_STATR - OBD P-code reported for open circuit" VALUE 0x707DC TKW_VV_VV_UW 100.0 FORMULA_0010 0.0 65535.0000 /end CHARACTERISTIC
/begin CHARACTERISTIC K_ED_PT_TORQDSC.P_CODE_OPENLOAD "P-Code fuer die Art OPENLOAD | EN: Fault code PT_TORQDSC - OBD P-code reported for open circuit" VALUE 0x70914 TKW_VV_VV_UW 100.0 FORMULA_0010 0.0 65535.0000 /end CHARACTERISTIC
/begin CHARACTERISTIC K_ED_PT_STDSC.P_CODE_OPENLOAD "P-Code fuer die Art OPENLOAD | EN: Fault code PT_STDSC - OBD P-code reported for open circuit" VALUE 0x7092E TKW_VV_VV_UW 100.0 FORMULA_0010 0.0 65535.0000 /end CHARACTERISTIC
/begin CHARACTERISTIC K_ED_PT_VRAD.P_CODE_OPENLOAD "P-Code fuer die Art OPENLOAD | EN: Fault code PT_VRAD - OBD P-code reported for open circuit" VALUE 0x70948 TKW_VV_VV_UW 100.0 FORMULA_0010 0.0 65535.0000 /end CHARACTERISTIC
/begin CHARACTERISTIC K_ED_PT_VFZG.P_CODE_OPENLOAD "P-Code fuer die Art OPENLOAD | EN: Fault code PT_VFZG - OBD P-code reported for open circuit" VALUE 0x70962 TKW_VV_VV_UW 100.0 FORMULA_0010 0.0 65535.0000 /end CHARACTERISTIC
/begin CHARACTERISTIC K_ED_PT_LRW.P_CODE_OPENLOAD "P-Code fuer die Art OPENLOAD | EN: Fault code PT_LRW - OBD P-code reported for open circuit" VALUE 0x709CA TKW_VV_VV_UW 100.0 FORMULA_0010 0.0 65535.0000 /end CHARACTERISTIC
/begin CHARACTERISTIC K_ED_SL_ML_HFM.P_CODE_OPENLOAD "P-Code fuer die Art OPENLOAD | EN: Fault code SL_ML_HFM - OBD P-code reported for open circuit" VALUE 0x70A18 TKW_VV_VV_UW 100.0 FORMULA_0010 0.0 65535.0000 /end CHARACTERISTIC
/begin CHARACTERISTIC K_ED_TZ1.P_CODE_OPENLOAD "P-Code fuer die Art OPENLOAD | EN: Fault code TZ1 - OBD P-code reported for open circuit" VALUE 0x70CBC TKW_VV_VV_UW 100.0 FORMULA_0010 0.0 65535.0000 /end CHARACTERISTIC
/begin CHARACTERISTIC K_ED_TZ2.P_CODE_OPENLOAD "P-Code fuer die Art OPENLOAD | EN: Fault code TZ2 - OBD P-code reported for open circuit" VALUE 0x70CD6 TKW_VV_VV_UW 100.0 FORMULA_0010 0.0 65535.0000 /end CHARACTERISTIC
/begin CHARACTERISTIC K_ED_TZ3.P_CODE_OPENLOAD "P-Code fuer die Art OPENLOAD | EN: Fault code TZ3 - OBD P-code reported for open circuit" VALUE 0x70CF0 TKW_VV_VV_UW 100.0 FORMULA_0010 0.0 65535.0000 /end CHARACTERISTIC
/begin CHARACTERISTIC K_ED_TZ4.P_CODE_OPENLOAD "P-Code fuer die Art OPENLOAD | EN: Fault code TZ4 - OBD P-code reported for open circuit" VALUE 0x70D0A TKW_VV_VV_UW 100.0 FORMULA_0010 0.0 65535.0000 /end CHARACTERISTIC
/begin CHARACTERISTIC K_ED_TZ5.P_CODE_OPENLOAD "P-Code fuer die Art OPENLOAD | EN: Fault code TZ5 - OBD P-code reported for open circuit" VALUE 0x70D24 TKW_VV_VV_UW 100.0 FORMULA_0010 0.0 65535.0000 /end CHARACTERISTIC
/begin CHARACTERISTIC K_ED_TZ6.P_CODE_OPENLOAD "P-Code fuer die Art OPENLOAD | EN: Fault code TZ6 - OBD P-code reported for open circuit" VALUE 0x70D3E TKW_VV_VV_UW 100.0 FORMULA_0010 0.0 65535.0000 /end CHARACTERISTIC
/begin CHARACTERISTIC K_ED_TZ7.P_CODE_OPENLOAD "P-Code fuer die Art OPENLOAD | EN: Fault code TZ7 - OBD P-code reported for open circuit" VALUE 0x70D58 TKW_VV_VV_UW 100.0 FORMULA_0010 0.0 65535.0000 /end CHARACTERISTIC
/begin CHARACTERISTIC K_ED_TZ8.P_CODE_OPENLOAD "P-Code fuer die Art OPENLOAD | EN: Fault code TZ8 - OBD P-code reported for open circuit" VALUE 0x70D72 TKW_VV_VV_UW 100.0 FORMULA_0010 0.0 65535.0000 /end CHARACTERISTIC
/begin CHARACTERISTIC K_ED_TZ9.P_CODE_OPENLOAD "P-Code fuer die Art OPENLOAD | EN: Fault code TZ9 - OBD P-code reported for open circuit" VALUE 0x70D8C TKW_VV_VV_UW 100.0 FORMULA_0010 0.0 65535.0000 /end CHARACTERISTIC
/begin CHARACTERISTIC K_ED_TZ10.P_CODE_OPENLOAD "P-Code fuer die Art OPENLOAD | EN: Fault code TZ10 - OBD P-code reported for open circuit" VALUE 0x70DA6 TKW_VV_VV_UW 100.0 FORMULA_0010 0.0 65535.0000 /end CHARACTERISTIC
/begin CHARACTERISTIC K_ED_VAN_ANSCHL_E1.P_CODE_OPENLOAD "P-Code fuer die Art OPENLOAD | EN: Fault code VAN_ANSCHL_E1 - OBD P-code reported for open circuit" VALUE 0x70DF4 TKW_VV_VV_UW 100.0 FORMULA_0010 0.0 65535.0000 /end CHARACTERISTIC
/begin CHARACTERISTIC K_ED_VAN_ANSCHL_A1.P_CODE_OPENLOAD "P-Code fuer die Art OPENLOAD | EN: Fault code VAN_ANSCHL_A1 - OBD P-code reported for open circuit" VALUE 0x70E0E TKW_VV_VV_UW 100.0 FORMULA_0010 0.0 65535.0000 /end CHARACTERISTIC
/begin CHARACTERISTIC K_ED_VAN_ANSCHL_E2.P_CODE_OPENLOAD "P-Code fuer die Art OPENLOAD | EN: Fault code VAN_ANSCHL_E2 - OBD P-code reported for open circuit" VALUE 0x70E28 TKW_VV_VV_UW 100.0 FORMULA_0010 0.0 65535.0000 /end CHARACTERISTIC
/begin CHARACTERISTIC K_ED_VAN_ANSCHL_A2.P_CODE_OPENLOAD "P-Code fuer die Art OPENLOAD | EN: Fault code VAN_ANSCHL_A2 - OBD P-code reported for open circuit" VALUE 0x70E42 TKW_VV_VV_UW 100.0 FORMULA_0010 0.0 65535.0000 /end CHARACTERISTIC
/begin CHARACTERISTIC K_ED_PT_VEHMOD.P_CODE_OPENLOAD "P-Code fuer die Art OPENLOAD | EN: Fault code PT_VEHMOD - OBD P-code reported for open circuit" VALUE 0x71016 TKW_VV_VV_UW 100.0 FORMULA_0010 0.0 65535.0000 /end CHARACTERISTIC
/begin CHARACTERISTIC K_ED_RLU87.P_CODE_OPENLOAD "P-Code fuer die Art OPENLOAD | EN: Fault code RLU87 - OBD P-code reported for open circuit" VALUE 0x7111A TKW_VV_VV_UW 100.0 FORMULA_0010 0.0 65535.0000 /end CHARACTERISTIC
/begin CHARACTERISTIC K_ED_SSP.P_CODE_OPENLOAD "P-Code fuer die Art OPENLOAD" VALUE 0x7114E TKW_VV_VV_UW 100.0 FORMULA_0010 0.0 65535.0000 /end CHARACTERISTIC
/begin CHARACTERISTIC K_ED_TD.P_CODE_OPENLOAD "P-Code fuer die Art OPENLOAD | EN: Fault code TD - OBD P-code reported for open circuit" VALUE 0x71168 TKW_VV_VV_UW 100.0 FORMULA_0010 0.0 65535.0000 /end CHARACTERISTIC
/begin CHARACTERISTIC K_ED_RLSLP.P_CODE_OPENLOAD "P-Code fuer die Art OPENLOAD | EN: Fault code RLSLP - OBD P-code reported for open circuit" VALUE 0x71182 TKW_VV_VV_UW 100.0 FORMULA_0010 0.0 65535.0000 /end CHARACTERISTIC
/begin CHARACTERISTIC K_ED_SLV.P_CODE_OPENLOAD "P-Code fuer die Art OPENLOAD | EN: Fault code SLV - OBD P-code reported for open circuit" VALUE 0x7119C TKW_VV_VV_UW 100.0 FORMULA_0010 0.0 65535.0000 /end CHARACTERISTIC
/begin CHARACTERISTIC K_ED_VAN_DSV.P_CODE_OPENLOAD "P-Code fuer die Art OPENLOAD | EN: Fault code VAN_DSV - OBD P-code reported for open circuit" VALUE 0x7126C TKW_VV_VV_UW 100.0 FORMULA_0010 0.0 65535.0000 /end CHARACTERISTIC
/begin CHARACTERISTIC K_ED_SK_MANAGER_INJ.P_CODE_OPENLOAD "P-Code fuer die Art OPENLOAD | EN: Fault code SK_MANAGER_INJ - OBD P-code reported for open circuit" VALUE 0x7138A TKW_VV_VV_UW 100.0 FORMULA_0010 0.0 65535.0000 /end CHARACTERISTIC
/begin CHARACTERISTIC K_ED_SSP_DIAG.P_CODE_OPENLOAD "P-Code fuer die Art OPENLOAD" VALUE 0x713A4 TKW_VV_VV_UW 100.0 FORMULA_0010 0.0 65535.0000 /end CHARACTERISTIC
/begin CHARACTERISTIC K_ED_SG_INJ.P_CODE_OPENLOAD "P-Code fuer die Art OPENLOAD | EN: Fault code SG_INJ - OBD P-code reported for open circuit" VALUE 0x7148E TKW_VV_VV_UW 100.0 FORMULA_0010 0.0 65535.0000 /end CHARACTERISTIC
/begin CHARACTERISTIC K_ED_S_POEL_DIAG.P_CODE_OPENLOAD "P-Code fuer die Art OPENLOAD | EN: Fault code S_POEL_DIAG - OBD P-code reported for open circuit" VALUE 0x714DC TKW_VV_VV_UW 100.0 FORMULA_0010 0.0 65535.0000 /end CHARACTERISTIC
/begin CHARACTERISTIC K_ED_TE_OBD_1.P_CODE_OPENLOAD "P-Code fuer die Art OPENLOAD | EN: Fault code TE_OBD_1 - OBD P-code reported for open circuit" VALUE 0x714F6 TKW_VV_VV_UW 100.0 FORMULA_0010 0.0 65535.0000 /end CHARACTERISTIC
/begin CHARACTERISTIC K_ED_TE_OBD_2.P_CODE_OPENLOAD "P-Code fuer die Art OPENLOAD | EN: Fault code TE_OBD_2 - OBD P-code reported for open circuit" VALUE 0x71510 TKW_VV_VV_UW 100.0 FORMULA_0010 0.0 65535.0000 /end CHARACTERISTIC
/begin CHARACTERISTIC K_ED_TEV1.P_CODE_OPENLOAD "P-Code fuer die Art OPENLOAD | EN: Fault code TEV1 - OBD P-code reported for open circuit" VALUE 0x7152A TKW_VV_VV_UW 100.0 FORMULA_0010 0.0 65535.0000 /end CHARACTERISTIC
/begin CHARACTERISTIC K_ED_TEV2.P_CODE_OPENLOAD "P-Code fuer die Art OPENLOAD | EN: Fault code TEV2 - OBD P-code reported for open circuit" VALUE 0x71544 TKW_VV_VV_UW 100.0 FORMULA_0010 0.0 65535.0000 /end CHARACTERISTIC
/begin CHARACTERISTIC K_ED_SLP.P_CODE_OPENLOAD "P-Code fuer die Art OPENLOAD | EN: Fault code SLP - OBD P-code reported for open circuit" VALUE 0x71614 TKW_VV_VV_UW 100.0 FORMULA_0010 0.0 65535.0000 /end CHARACTERISTIC
/begin CHARACTERISTIC K_ED_SL_DURCHS_B1.P_CODE_OPENLOAD "P-Code fuer die Art OPENLOAD | EN: Fault code SL_DURCHS_B1 - OBD P-code reported for open circuit" VALUE 0x7162E TKW_VV_VV_UW 100.0 FORMULA_0010 0.0 65535.0000 /end CHARACTERISTIC
/begin CHARACTERISTIC K_ED_SL_DURCHS_B2.P_CODE_OPENLOAD "P-Code fuer die Art OPENLOAD | EN: Fault code SL_DURCHS_B2 - OBD P-code reported for open circuit" VALUE 0x71648 TKW_VV_VV_UW 100.0 FORMULA_0010 0.0 65535.0000 /end CHARACTERISTIC
/begin CHARACTERISTIC K_ED_SL_DURCHS_HSTRANG.P_CODE_OPENLOAD "P-Code fuer die Art OPENLOAD | EN: Fault code SL_DURCHS_HSTRANG - OBD P-code reported for open circuit" VALUE 0x71662 TKW_VV_VV_UW 100.0 FORMULA_0010 0.0 65535.0000 /end CHARACTERISTIC
/begin CHARACTERISTIC K_ED_S_GETR_HS.P_CODE_OPENLOAD "P-Code fuer die Art OPENLOAD | EN: Fault code S_GETR_HS - OBD P-code reported for open circuit" VALUE 0x71696 TKW_VV_VV_UW 100.0 FORMULA_0010 0.0 65535.0000 /end CHARACTERISTIC
/begin CHARACTERISTIC K_ED_S_KUPP_HS.P_CODE_OPENLOAD "P-Code fuer die Art OPENLOAD | EN: Fault code S_KUPP_HS - OBD P-code reported for open circuit" VALUE 0x716B0 TKW_VV_VV_UW 100.0 FORMULA_0010 0.0 65535.0000 /end CHARACTERISTIC
/begin CHARACTERISTIC K_ED_VAN_DRUCK.P_CODE_OPENLOAD "P-Code fuer die Art OPENLOAD | EN: Fault code VAN_DRUCK - OBD P-code reported for open circuit" VALUE 0x716CA TKW_VV_VV_UW 100.0 FORMULA_0010 0.0 65535.0000 /end CHARACTERISTIC
/begin CHARACTERISTIC K_ED_PT_STATANH.P_CODE_OPENLOAD "P-Code fuer die Art OPENLOAD | EN: Fault code PT_STATANH - OBD P-code reported for open circuit" VALUE 0x71718 TKW_VV_VV_UW 100.0 FORMULA_0010 0.0 65535.0000 /end CHARACTERISTIC
/begin CHARACTERISTIC K_ED_PT_STATGRB.P_CODE_OPENLOAD "P-Code fuer die Art OPENLOAD" VALUE 0x7179A TKW_VV_VV_UW 100.0 FORMULA_0010 0.0 65535.0000 /end CHARACTERISTIC
/begin CHARACTERISTIC K_ED_TANK_LEER.P_CODE_OPENLOAD "P-Code fuer die Art OPENLOAD | EN: Fault code TANK_LEER - OBD P-code reported for open circuit" VALUE 0x717E8 TKW_VV_VV_UW 100.0 FORMULA_0010 0.0 65535.0000 /end CHARACTERISTIC
/begin CHARACTERISTIC K_ED_PT_TOMA.P_CODE_OPENLOAD "P-Code fuer die Art OPENLOAD | EN: Fault code PT_TOMA - OBD P-code reported for open circuit" VALUE 0x71802 TKW_VV_VV_UW 100.0 FORMULA_0010 0.0 65535.0000 /end CHARACTERISTIC
/begin CHARACTERISTIC K_ED_PUMG_OBD.P_CODE_OPENLOAD "P-Code fuer die Art OPENLOAD | EN: Fault code PUMG_OBD - OBD P-code reported for open circuit" VALUE 0x71836 TKW_VV_VV_UW 100.0 FORMULA_0010 0.0 65535.0000 /end CHARACTERISTIC
/begin CHARACTERISTIC K_ED_SL_ML_HFM_OBD.P_CODE_OPENLOAD "P-Code fuer die Art OPENLOAD | EN: Fault code SL_ML_HFM_OBD - OBD P-code reported for open circuit" VALUE 0x71850 TKW_VV_VV_UW 100.0 FORMULA_0010 0.0 65535.0000 /end CHARACTERISTIC
/begin CHARACTERISTIC K_ED_TGETR_HS.P_CODE_OPENLOAD "P-Code fuer die Art OPENLOAD | EN: Fault code TGETR_HS - OBD P-code reported for open circuit" VALUE 0x71988 TKW_VV_VV_UW 100.0 FORMULA_0010 0.0 65535.0000 /end CHARACTERISTIC
/begin CHARACTERISTIC K_ED_PT_OBD_ED.P_CODE_OPENLOAD "P-Code fuer die Art OPENLOAD" VALUE 0x719D6 TKW_VV_VV_UW 100.0 FORMULA_0010 0.0 65535.0000 /end CHARACTERISTIC
/begin CHARACTERISTIC K_ED_SK_TR_INJ.P_CODE_UNPLAUSIBEL "P-Code fuer die Art UNPLAUSIBEL | EN: P-Code fuer die Art UNPLAUSIBEL" VALUE 0x705F0 TKW_VV_VV_UW 100.0 FORMULA_0010 0.0 65535.0000 /end CHARACTERISTIC
/begin CHARACTERISTIC K_ED_VAN_HALL_A1.P_CODE_UNPLAUSIBEL "P-Code fuer die Art UNPLAUSIBEL | EN: Fault code VAN_HALL_A1 - OBD P-code reported for implausible signal" VALUE 0x706A6 TKW_VV_VV_UW 100.0 FORMULA_0010 0.0 65535.0000 /end CHARACTERISTIC
/begin CHARACTERISTIC K_ED_VAN_HALL_A2.P_CODE_UNPLAUSIBEL "P-Code fuer die Art UNPLAUSIBEL | EN: Fault code VAN_HALL_A2 - OBD P-code reported for implausible signal" VALUE 0x706DA TKW_VV_VV_UW 100.0 FORMULA_0010 0.0 65535.0000 /end CHARACTERISTIC
/begin CHARACTERISTIC K_ED_VAN_REGL_E1.P_CODE_UNPLAUSIBEL "P-Code fuer die Art UNPLAUSIBEL | EN: Fault code VAN_REGL_E1 - OBD P-code reported for implausible signal" VALUE 0x706F4 TKW_VV_VV_UW 100.0 FORMULA_0010 0.0 65535.0000 /end CHARACTERISTIC
/begin CHARACTERISTIC K_ED_VAN_REGL_A1.P_CODE_UNPLAUSIBEL "P-Code fuer die Art UNPLAUSIBEL | EN: Fault code VAN_REGL_A1 - OBD P-code reported for implausible signal" VALUE 0x7070E TKW_VV_VV_UW 100.0 FORMULA_0010 0.0 65535.0000 /end CHARACTERISTIC
/begin CHARACTERISTIC K_ED_VAN_REGL_E2.P_CODE_UNPLAUSIBEL "P-Code fuer die Art UNPLAUSIBEL | EN: Fault code VAN_REGL_E2 - OBD P-code reported for implausible signal" VALUE 0x70728 TKW_VV_VV_UW 100.0 FORMULA_0010 0.0 65535.0000 /end CHARACTERISTIC
/begin CHARACTERISTIC K_ED_VAN_REGL_A2.P_CODE_UNPLAUSIBEL "P-Code fuer die Art UNPLAUSIBEL | EN: Fault code VAN_REGL_A2 - OBD P-code reported for implausible signal" VALUE 0x70742 TKW_VV_VV_UW 100.0 FORMULA_0010 0.0 65535.0000 /end CHARACTERISTIC
/begin CHARACTERISTIC K_ED_PT_STATDKG.P_CODE_UNPLAUSIBEL "P-Code fuer die Art UNPLAUSIBEL | EN: Fault code PT_STATDKG - OBD P-code reported for implausible signal" VALUE 0x707AA TKW_VV_VV_UW 100.0 FORMULA_0010 0.0 65535.0000 /end CHARACTERISTIC
/begin CHARACTERISTIC K_ED_PT_STATR.P_CODE_UNPLAUSIBEL "P-Code fuer die Art UNPLAUSIBEL | EN: Fault code PT_STATR - OBD P-code reported for implausible signal" VALUE 0x707DE TKW_VV_VV_UW 100.0 FORMULA_0010 0.0 65535.0000 /end CHARACTERISTIC
/begin CHARACTERISTIC K_ED_PT_TORQDSC.P_CODE_UNPLAUSIBEL "P-Code fuer die Art UNPLAUSIBEL | EN: Fault code PT_TORQDSC - OBD P-code reported for implausible signal" VALUE 0x70916 TKW_VV_VV_UW 100.0 FORMULA_0010 0.0 65535.0000 /end CHARACTERISTIC
/begin CHARACTERISTIC K_ED_PT_STDSC.P_CODE_UNPLAUSIBEL "P-Code fuer die Art UNPLAUSIBEL | EN: Fault code PT_STDSC - OBD P-code reported for implausible signal" VALUE 0x70930 TKW_VV_VV_UW 100.0 FORMULA_0010 0.0 65535.0000 /end CHARACTERISTIC
/begin CHARACTERISTIC K_ED_PT_VRAD.P_CODE_UNPLAUSIBEL "P-Code fuer die Art UNPLAUSIBEL | EN: Fault code PT_VRAD - OBD P-code reported for implausible signal" VALUE 0x7094A TKW_VV_VV_UW 100.0 FORMULA_0010 0.0 65535.0000 /end CHARACTERISTIC
/begin CHARACTERISTIC K_ED_PT_VFZG.P_CODE_UNPLAUSIBEL "P-Code fuer die Art UNPLAUSIBEL | EN: Fault code PT_VFZG - OBD P-code reported for implausible signal" VALUE 0x70964 TKW_VV_VV_UW 100.0 FORMULA_0010 0.0 65535.0000 /end CHARACTERISTIC
/begin CHARACTERISTIC K_ED_PT_LRW.P_CODE_UNPLAUSIBEL "P-Code fuer die Art UNPLAUSIBEL | EN: Fault code PT_LRW - OBD P-code reported for implausible signal" VALUE 0x709CC TKW_VV_VV_UW 100.0 FORMULA_0010 0.0 65535.0000 /end CHARACTERISTIC
/begin CHARACTERISTIC K_ED_SL_ML_HFM.P_CODE_UNPLAUSIBEL "P-Code fuer die Art UNPLAUSIBEL | EN: Fault code SL_ML_HFM - OBD P-code reported for implausible signal" VALUE 0x70A1A TKW_VV_VV_UW 100.0 FORMULA_0010 0.0 65535.0000 /end CHARACTERISTIC
/begin CHARACTERISTIC K_ED_TZ1.P_CODE_UNPLAUSIBEL "P-Code fuer die Art UNPLAUSIBEL | EN: Fault code TZ1 - OBD P-code reported for implausible signal" VALUE 0x70CBE TKW_VV_VV_UW 100.0 FORMULA_0010 0.0 65535.0000 /end CHARACTERISTIC
/begin CHARACTERISTIC K_ED_TZ2.P_CODE_UNPLAUSIBEL "P-Code fuer die Art UNPLAUSIBEL | EN: Fault code TZ2 - OBD P-code reported for implausible signal" VALUE 0x70CD8 TKW_VV_VV_UW 100.0 FORMULA_0010 0.0 65535.0000 /end CHARACTERISTIC
/begin CHARACTERISTIC K_ED_TZ3.P_CODE_UNPLAUSIBEL "P-Code fuer die Art UNPLAUSIBEL | EN: Fault code TZ3 - OBD P-code reported for implausible signal" VALUE 0x70CF2 TKW_VV_VV_UW 100.0 FORMULA_0010 0.0 65535.0000 /end CHARACTERISTIC
/begin CHARACTERISTIC K_ED_TZ4.P_CODE_UNPLAUSIBEL "P-Code fuer die Art UNPLAUSIBEL | EN: Fault code TZ4 - OBD P-code reported for implausible signal" VALUE 0x70D0C TKW_VV_VV_UW 100.0 FORMULA_0010 0.0 65535.0000 /end CHARACTERISTIC
/begin CHARACTERISTIC K_ED_TZ5.P_CODE_UNPLAUSIBEL "P-Code fuer die Art UNPLAUSIBEL | EN: Fault code TZ5 - OBD P-code reported for implausible signal" VALUE 0x70D26 TKW_VV_VV_UW 100.0 FORMULA_0010 0.0 65535.0000 /end CHARACTERISTIC
/begin CHARACTERISTIC K_ED_TZ6.P_CODE_UNPLAUSIBEL "P-Code fuer die Art UNPLAUSIBEL | EN: Fault code TZ6 - OBD P-code reported for implausible signal" VALUE 0x70D40 TKW_VV_VV_UW 100.0 FORMULA_0010 0.0 65535.0000 /end CHARACTERISTIC
/begin CHARACTERISTIC K_ED_TZ7.P_CODE_UNPLAUSIBEL "P-Code fuer die Art UNPLAUSIBEL | EN: Fault code TZ7 - OBD P-code reported for implausible signal" VALUE 0x70D5A TKW_VV_VV_UW 100.0 FORMULA_0010 0.0 65535.0000 /end CHARACTERISTIC
/begin CHARACTERISTIC K_ED_TZ8.P_CODE_UNPLAUSIBEL "P-Code fuer die Art UNPLAUSIBEL | EN: Fault code TZ8 - OBD P-code reported for implausible signal" VALUE 0x70D74 TKW_VV_VV_UW 100.0 FORMULA_0010 0.0 65535.0000 /end CHARACTERISTIC
/begin CHARACTERISTIC K_ED_TZ9.P_CODE_UNPLAUSIBEL "P-Code fuer die Art UNPLAUSIBEL | EN: Fault code TZ9 - OBD P-code reported for implausible signal" VALUE 0x70D8E TKW_VV_VV_UW 100.0 FORMULA_0010 0.0 65535.0000 /end CHARACTERISTIC
/begin CHARACTERISTIC K_ED_TZ10.P_CODE_UNPLAUSIBEL "P-Code fuer die Art UNPLAUSIBEL | EN: Fault code TZ10 - OBD P-code reported for implausible signal" VALUE 0x70DA8 TKW_VV_VV_UW 100.0 FORMULA_0010 0.0 65535.0000 /end CHARACTERISTIC
/begin CHARACTERISTIC K_ED_VAN_ANSCHL_E1.P_CODE_UNPLAUSIBEL "P-Code fuer die Art UNPLAUSIBEL | EN: Fault code VAN_ANSCHL_E1 - OBD P-code reported for implausible signal" VALUE 0x70DF6 TKW_VV_VV_UW 100.0 FORMULA_0010 0.0 65535.0000 /end CHARACTERISTIC
/begin CHARACTERISTIC K_ED_VAN_ANSCHL_A1.P_CODE_UNPLAUSIBEL "P-Code fuer die Art UNPLAUSIBEL | EN: Fault code VAN_ANSCHL_A1 - OBD P-code reported for implausible signal" VALUE 0x70E10 TKW_VV_VV_UW 100.0 FORMULA_0010 0.0 65535.0000 /end CHARACTERISTIC
/begin CHARACTERISTIC K_ED_VAN_ANSCHL_E2.P_CODE_UNPLAUSIBEL "P-Code fuer die Art UNPLAUSIBEL | EN: Fault code VAN_ANSCHL_E2 - OBD P-code reported for implausible signal" VALUE 0x70E2A TKW_VV_VV_UW 100.0 FORMULA_0010 0.0 65535.0000 /end CHARACTERISTIC
/begin CHARACTERISTIC K_ED_VAN_ANSCHL_A2.P_CODE_UNPLAUSIBEL "P-Code fuer die Art UNPLAUSIBEL | EN: Fault code VAN_ANSCHL_A2 - OBD P-code reported for implausible signal" VALUE 0x70E44 TKW_VV_VV_UW 100.0 FORMULA_0010 0.0 65535.0000 /end CHARACTERISTIC
/begin CHARACTERISTIC K_ED_PT_VEHMOD.P_CODE_UNPLAUSIBEL "P-Code fuer die Art UNPLAUSIBEL | EN: Fault code PT_VEHMOD - OBD P-code reported for implausible signal" VALUE 0x71018 TKW_VV_VV_UW 100.0 FORMULA_0010 0.0 65535.0000 /end CHARACTERISTIC
/begin CHARACTERISTIC K_ED_RLU87.P_CODE_UNPLAUSIBEL "P-Code fuer die Art UNPLAUSIBEL | EN: Fault code RLU87 - OBD P-code reported for implausible signal" VALUE 0x7111C TKW_VV_VV_UW 100.0 FORMULA_0010 0.0 65535.0000 /end CHARACTERISTIC
/begin CHARACTERISTIC K_ED_SSP.P_CODE_UNPLAUSIBEL "P-Code fuer die Art UNPLAUSIBEL" VALUE 0x71150 TKW_VV_VV_UW 100.0 FORMULA_0010 0.0 65535.0000 /end CHARACTERISTIC
/begin CHARACTERISTIC K_ED_TD.P_CODE_UNPLAUSIBEL "P-Code fuer die Art UNPLAUSIBEL | EN: Fault code TD - OBD P-code reported for implausible signal" VALUE 0x7116A TKW_VV_VV_UW 100.0 FORMULA_0010 0.0 65535.0000 /end CHARACTERISTIC
/begin CHARACTERISTIC K_ED_RLSLP.P_CODE_UNPLAUSIBEL "P-Code fuer die Art UNPLAUSIBEL | EN: Fault code RLSLP - OBD P-code reported for implausible signal" VALUE 0x71184 TKW_VV_VV_UW 100.0 FORMULA_0010 0.0 65535.0000 /end CHARACTERISTIC
/begin CHARACTERISTIC K_ED_SLV.P_CODE_UNPLAUSIBEL "P-Code fuer die Art UNPLAUSIBEL | EN: Fault code SLV - OBD P-code reported for implausible signal" VALUE 0x7119E TKW_VV_VV_UW 100.0 FORMULA_0010 0.0 65535.0000 /end CHARACTERISTIC
/begin CHARACTERISTIC K_ED_VAN_DSV.P_CODE_UNPLAUSIBEL "P-Code fuer die Art UNPLAUSIBEL | EN: Fault code VAN_DSV - OBD P-code reported for implausible signal" VALUE 0x7126E TKW_VV_VV_UW 100.0 FORMULA_0010 0.0 65535.0000 /end CHARACTERISTIC
/begin CHARACTERISTIC K_ED_SK_MANAGER_INJ.P_CODE_UNPLAUSIBEL "P-Code fuer die Art UNPLAUSIBEL | EN: Fault code SK_MANAGER_INJ - OBD P-code reported for implausible signal" VALUE 0x7138C TKW_VV_VV_UW 100.0 FORMULA_0010 0.0 65535.0000 /end CHARACTERISTIC
/begin CHARACTERISTIC K_ED_SSP_DIAG.P_CODE_UNPLAUSIBEL "P-Code fuer die Art UNPLAUSIBEL" VALUE 0x713A6 TKW_VV_VV_UW 100.0 FORMULA_0010 0.0 65535.0000 /end CHARACTERISTIC
/begin CHARACTERISTIC K_ED_SG_INJ.P_CODE_UNPLAUSIBEL "P-Code fuer die Art UNPLAUSIBEL | EN: Fault code SG_INJ - OBD P-code reported for implausible signal" VALUE 0x71490 TKW_VV_VV_UW 100.0 FORMULA_0010 0.0 65535.0000 /end CHARACTERISTIC
/begin CHARACTERISTIC K_ED_S_POEL_DIAG.P_CODE_UNPLAUSIBEL "P-Code fuer die Art UNPLAUSIBEL | EN: Fault code S_POEL_DIAG - OBD P-code reported for implausible signal" VALUE 0x714DE TKW_VV_VV_UW 100.0 FORMULA_0010 0.0 65535.0000 /end CHARACTERISTIC
/begin CHARACTERISTIC K_ED_TE_OBD_1.P_CODE_UNPLAUSIBEL "P-Code fuer die Art UNPLAUSIBEL | EN: Fault code TE_OBD_1 - OBD P-code reported for implausible signal" VALUE 0x714F8 TKW_VV_VV_UW 100.0 FORMULA_0010 0.0 65535.0000 /end CHARACTERISTIC
/begin CHARACTERISTIC K_ED_TE_OBD_2.P_CODE_UNPLAUSIBEL "P-Code fuer die Art UNPLAUSIBEL | EN: Fault code TE_OBD_2 - OBD P-code reported for implausible signal" VALUE 0x71512 TKW_VV_VV_UW 100.0 FORMULA_0010 0.0 65535.0000 /end CHARACTERISTIC
/begin CHARACTERISTIC K_ED_TEV1.P_CODE_UNPLAUSIBEL "P-Code fuer die Art UNPLAUSIBEL | EN: Fault code TEV1 - OBD P-code reported for implausible signal" VALUE 0x7152C TKW_VV_VV_UW 100.0 FORMULA_0010 0.0 65535.0000 /end CHARACTERISTIC
/begin CHARACTERISTIC K_ED_TEV2.P_CODE_UNPLAUSIBEL "P-Code fuer die Art UNPLAUSIBEL | EN: Fault code TEV2 - OBD P-code reported for implausible signal" VALUE 0x71546 TKW_VV_VV_UW 100.0 FORMULA_0010 0.0 65535.0000 /end CHARACTERISTIC
/begin CHARACTERISTIC K_ED_SLP.P_CODE_UNPLAUSIBEL "P-Code fuer die Art UNPLAUSIBEL | EN: Fault code SLP - OBD P-code reported for implausible signal" VALUE 0x71616 TKW_VV_VV_UW 100.0 FORMULA_0010 0.0 65535.0000 /end CHARACTERISTIC
/begin CHARACTERISTIC K_ED_SL_DURCHS_B1.P_CODE_UNPLAUSIBEL "P-Code fuer die Art UNPLAUSIBEL | EN: Fault code SL_DURCHS_B1 - OBD P-code reported for implausible signal" VALUE 0x71630 TKW_VV_VV_UW 100.0 FORMULA_0010 0.0 65535.0000 /end CHARACTERISTIC
/begin CHARACTERISTIC K_ED_SL_DURCHS_B2.P_CODE_UNPLAUSIBEL "P-Code fuer die Art UNPLAUSIBEL | EN: Fault code SL_DURCHS_B2 - OBD P-code reported for implausible signal" VALUE 0x7164A TKW_VV_VV_UW 100.0 FORMULA_0010 0.0 65535.0000 /end CHARACTERISTIC
/begin CHARACTERISTIC K_ED_SL_DURCHS_HSTRANG.P_CODE_UNPLAUSIBEL "P-Code fuer die Art UNPLAUSIBEL | EN: Fault code SL_DURCHS_HSTRANG - OBD P-code reported for implausible signal" VALUE 0x71664 TKW_VV_VV_UW 100.0 FORMULA_0010 0.0 65535.0000 /end CHARACTERISTIC
/begin CHARACTERISTIC K_ED_S_GETR_HS.P_CODE_UNPLAUSIBEL "P-Code fuer die Art UNPLAUSIBEL | EN: Fault code S_GETR_HS - OBD P-code reported for implausible signal" VALUE 0x71698 TKW_VV_VV_UW 100.0 FORMULA_0010 0.0 65535.0000 /end CHARACTERISTIC
/begin CHARACTERISTIC K_ED_S_KUPP_HS.P_CODE_UNPLAUSIBEL "P-Code fuer die Art UNPLAUSIBEL | EN: Fault code S_KUPP_HS - OBD P-code reported for implausible signal" VALUE 0x716B2 TKW_VV_VV_UW 100.0 FORMULA_0010 0.0 65535.0000 /end CHARACTERISTIC
/begin CHARACTERISTIC K_ED_VAN_DRUCK.P_CODE_UNPLAUSIBEL "P-Code fuer die Art UNPLAUSIBEL | EN: Fault code VAN_DRUCK - OBD P-code reported for implausible signal" VALUE 0x716CC TKW_VV_VV_UW 100.0 FORMULA_0010 0.0 65535.0000 /end CHARACTERISTIC
/begin CHARACTERISTIC K_ED_PT_STATANH.P_CODE_UNPLAUSIBEL "P-Code fuer die Art UNPLAUSIBEL | EN: Fault code PT_STATANH - OBD P-code reported for implausible signal" VALUE 0x7171A TKW_VV_VV_UW 100.0 FORMULA_0010 0.0 65535.0000 /end CHARACTERISTIC
/begin CHARACTERISTIC K_ED_PT_STATGRB.P_CODE_UNPLAUSIBEL "P-Code fuer die Art UNPLAUSIBEL" VALUE 0x7179C TKW_VV_VV_UW 100.0 FORMULA_0010 0.0 65535.0000 /end CHARACTERISTIC
/begin CHARACTERISTIC K_ED_TANK_LEER.P_CODE_UNPLAUSIBEL "P-Code fuer die Art UNPLAUSIBEL | EN: Fault code TANK_LEER - OBD P-code reported for implausible signal" VALUE 0x717EA TKW_VV_VV_UW 100.0 FORMULA_0010 0.0 65535.0000 /end CHARACTERISTIC
/begin CHARACTERISTIC K_ED_PT_TOMA.P_CODE_UNPLAUSIBEL "P-Code fuer die Art UNPLAUSIBEL | EN: Fault code PT_TOMA - OBD P-code reported for implausible signal" VALUE 0x71804 TKW_VV_VV_UW 100.0 FORMULA_0010 0.0 65535.0000 /end CHARACTERISTIC
/begin CHARACTERISTIC K_ED_PUMG_OBD.P_CODE_UNPLAUSIBEL "P-Code fuer die Art UNPLAUSIBEL | EN: Fault code PUMG_OBD - OBD P-code reported for implausible signal" VALUE 0x71838 TKW_VV_VV_UW 100.0 FORMULA_0010 0.0 65535.0000 /end CHARACTERISTIC
/begin CHARACTERISTIC K_ED_SL_ML_HFM_OBD.P_CODE_UNPLAUSIBEL "P-Code fuer die Art UNPLAUSIBEL | EN: Fault code SL_ML_HFM_OBD - OBD P-code reported for implausible signal" VALUE 0x71852 TKW_VV_VV_UW 100.0 FORMULA_0010 0.0 65535.0000 /end CHARACTERISTIC
/begin CHARACTERISTIC K_ED_TGETR_HS.P_CODE_UNPLAUSIBEL "P-Code fuer die Art UNPLAUSIBEL | EN: Fault code TGETR_HS - OBD P-code reported for implausible signal" VALUE 0x7198A TKW_VV_VV_UW 100.0 FORMULA_0010 0.0 65535.0000 /end CHARACTERISTIC
/begin CHARACTERISTIC K_ED_PT_OBD_ED.P_CODE_UNPLAUSIBEL "P-Code fuer die Art UNPLAUSIBEL" VALUE 0x719D8 TKW_VV_VV_UW 100.0 FORMULA_0010 0.0 65535.0000 /end CHARACTERISTIC
/begin CHARACTERISTIC K_ED_SK_TR_INJ.FEHLERSCHWELLE "Filterschwelle fuer Fehlereintrag | EN: Filterschwelle fuer Fehlereintrag" VALUE 0x705F2 TKW_VV_VV_UB 100.0 FORMULA_0003 0.0 255.0000 /end CHARACTERISTIC
/begin CHARACTERISTIC K_ED_PUMG.FEHLERSCHWELLE "Filterschwelle fuer Fehlereintrag | EN: Fault code PUMG - debounce filter threshold for setting the fault" VALUE 0x7060C TKW_VV_VV_UB 100.0 FORMULA_0003 0.0 255.0000 /end CHARACTERISTIC
/begin CHARACTERISTIC K_ED_VAN_HALL_E1.FEHLERSCHWELLE "Filterschwelle fuer Fehlereintrag | EN: Fault code VAN_HALL_E1 - debounce filter threshold for setting the fault" VALUE 0x7068E TKW_VV_VV_UB 100.0 FORMULA_0003 0.0 255.0000 /end CHARACTERISTIC
/begin CHARACTERISTIC K_ED_VAN_HALL_A1.FEHLERSCHWELLE "Filterschwelle fuer Fehlereintrag | EN: Fault code VAN_HALL_A1 - debounce filter threshold for setting the fault" VALUE 0x706A8 TKW_VV_VV_UB 100.0 FORMULA_0003 0.0 255.0000 /end CHARACTERISTIC
/begin CHARACTERISTIC K_ED_VAN_HALL_E2.FEHLERSCHWELLE "Filterschwelle fuer Fehlereintrag | EN: Fault code VAN_HALL_E2 - debounce filter threshold for setting the fault" VALUE 0x706C2 TKW_VV_VV_UB 100.0 FORMULA_0003 0.0 255.0000 /end CHARACTERISTIC
/begin CHARACTERISTIC K_ED_VAN_HALL_A2.FEHLERSCHWELLE "Filterschwelle fuer Fehlereintrag | EN: Fault code VAN_HALL_A2 - debounce filter threshold for setting the fault" VALUE 0x706DC TKW_VV_VV_UB 100.0 FORMULA_0003 0.0 255.0000 /end CHARACTERISTIC
/begin CHARACTERISTIC K_ED_VAN_REGL_E1.FEHLERSCHWELLE "Filterschwelle fuer Fehlereintrag | EN: Fault code VAN_REGL_E1 - debounce filter threshold for setting the fault" VALUE 0x706F6 TKW_VV_VV_UB 100.0 FORMULA_0003 0.0 255.0000 /end CHARACTERISTIC
/begin CHARACTERISTIC K_ED_VAN_REGL_A1.FEHLERSCHWELLE "Filterschwelle fuer Fehlereintrag | EN: Fault code VAN_REGL_A1 - debounce filter threshold for setting the fault" VALUE 0x70710 TKW_VV_VV_UB 100.0 FORMULA_0003 0.0 255.0000 /end CHARACTERISTIC
/begin CHARACTERISTIC K_ED_VAN_REGL_E2.FEHLERSCHWELLE "Filterschwelle fuer Fehlereintrag | EN: Fault code VAN_REGL_E2 - debounce filter threshold for setting the fault" VALUE 0x7072A TKW_VV_VV_UB 100.0 FORMULA_0003 0.0 255.0000 /end CHARACTERISTIC
/begin CHARACTERISTIC K_ED_VAN_REGL_A2.FEHLERSCHWELLE "Filterschwelle fuer Fehlereintrag | EN: Fault code VAN_REGL_A2 - debounce filter threshold for setting the fault" VALUE 0x70744 TKW_VV_VV_UB 100.0 FORMULA_0003 0.0 255.0000 /end CHARACTERISTIC
/begin CHARACTERISTIC K_ED_PT_STATDKG.FEHLERSCHWELLE "Filterschwelle fuer Fehlereintrag | EN: Fault code PT_STATDKG - debounce filter threshold for setting the fault" VALUE 0x707AC TKW_VV_VV_UB 100.0 FORMULA_0003 0.0 255.0000 /end CHARACTERISTIC
/begin CHARACTERISTIC K_ED_PT_STATR.FEHLERSCHWELLE "Filterschwelle fuer Fehlereintrag | EN: Fault code PT_STATR - debounce filter threshold for setting the fault" VALUE 0x707E0 TKW_VV_VV_UB 100.0 FORMULA_0003 0.0 255.0000 /end CHARACTERISTIC
/begin CHARACTERISTIC K_ED_PT_TORQDSC.FEHLERSCHWELLE "Filterschwelle fuer Fehlereintrag | EN: Fault code PT_TORQDSC - debounce filter threshold for setting the fault" VALUE 0x70918 TKW_VV_VV_UB 100.0 FORMULA_0003 0.0 255.0000 /end CHARACTERISTIC
/begin CHARACTERISTIC K_ED_PT_STDSC.FEHLERSCHWELLE "Filterschwelle fuer Fehlereintrag | EN: Fault code PT_STDSC - debounce filter threshold for setting the fault" VALUE 0x70932 TKW_VV_VV_UB 100.0 FORMULA_0003 0.0 255.0000 /end CHARACTERISTIC
/begin CHARACTERISTIC K_ED_PT_VRAD.FEHLERSCHWELLE "Filterschwelle fuer Fehlereintrag | EN: Fault code PT_VRAD - debounce filter threshold for setting the fault" VALUE 0x7094C TKW_VV_VV_UB 100.0 FORMULA_0003 0.0 255.0000 /end CHARACTERISTIC
/begin CHARACTERISTIC K_ED_PT_VFZG.FEHLERSCHWELLE "Filterschwelle fuer Fehlereintrag | EN: Fault code PT_VFZG - debounce filter threshold for setting the fault" VALUE 0x70966 TKW_VV_VV_UB 100.0 FORMULA_0003 0.0 255.0000 /end CHARACTERISTIC
/begin CHARACTERISTIC K_ED_SL_ML_HFM.FEHLERSCHWELLE "Filterschwelle fuer Fehlereintrag | EN: Fault code SL_ML_HFM - debounce filter threshold for setting the fault" VALUE 0x70A1C TKW_VV_VV_UB 100.0 FORMULA_0003 0.0 255.0000 /end CHARACTERISTIC
/begin CHARACTERISTIC K_ED_TZ1.FEHLERSCHWELLE "Filterschwelle fuer Fehlereintrag | EN: Fault code TZ1 - debounce filter threshold for setting the fault" VALUE 0x70CC0 TKW_VV_VV_UB 100.0 FORMULA_0003 0.0 255.0000 /end CHARACTERISTIC
/begin CHARACTERISTIC K_ED_TZ2.FEHLERSCHWELLE "Filterschwelle fuer Fehlereintrag | EN: Fault code TZ2 - debounce filter threshold for setting the fault" VALUE 0x70CDA TKW_VV_VV_UB 100.0 FORMULA_0003 0.0 255.0000 /end CHARACTERISTIC
/begin CHARACTERISTIC K_ED_TZ3.FEHLERSCHWELLE "Filterschwelle fuer Fehlereintrag | EN: Fault code TZ3 - debounce filter threshold for setting the fault" VALUE 0x70CF4 TKW_VV_VV_UB 100.0 FORMULA_0003 0.0 255.0000 /end CHARACTERISTIC
/begin CHARACTERISTIC K_ED_TZ4.FEHLERSCHWELLE "Filterschwelle fuer Fehlereintrag | EN: Fault code TZ4 - debounce filter threshold for setting the fault" VALUE 0x70D0E TKW_VV_VV_UB 100.0 FORMULA_0003 0.0 255.0000 /end CHARACTERISTIC
/begin CHARACTERISTIC K_ED_TZ5.FEHLERSCHWELLE "Filterschwelle fuer Fehlereintrag | EN: Fault code TZ5 - debounce filter threshold for setting the fault" VALUE 0x70D28 TKW_VV_VV_UB 100.0 FORMULA_0003 0.0 255.0000 /end CHARACTERISTIC
/begin CHARACTERISTIC K_ED_TZ6.FEHLERSCHWELLE "Filterschwelle fuer Fehlereintrag | EN: Fault code TZ6 - debounce filter threshold for setting the fault" VALUE 0x70D42 TKW_VV_VV_UB 100.0 FORMULA_0003 0.0 255.0000 /end CHARACTERISTIC
/begin CHARACTERISTIC K_ED_TZ7.FEHLERSCHWELLE "Filterschwelle fuer Fehlereintrag | EN: Fault code TZ7 - debounce filter threshold for setting the fault" VALUE 0x70D5C TKW_VV_VV_UB 100.0 FORMULA_0003 0.0 255.0000 /end CHARACTERISTIC
/begin CHARACTERISTIC K_ED_TZ8.FEHLERSCHWELLE "Filterschwelle fuer Fehlereintrag | EN: Fault code TZ8 - debounce filter threshold for setting the fault" VALUE 0x70D76 TKW_VV_VV_UB 100.0 FORMULA_0003 0.0 255.0000 /end CHARACTERISTIC
/begin CHARACTERISTIC K_ED_TZ9.FEHLERSCHWELLE "Filterschwelle fuer Fehlereintrag | EN: Fault code TZ9 - debounce filter threshold for setting the fault" VALUE 0x70D90 TKW_VV_VV_UB 100.0 FORMULA_0003 0.0 255.0000 /end CHARACTERISTIC
/begin CHARACTERISTIC K_ED_TZ10.FEHLERSCHWELLE "Filterschwelle fuer Fehlereintrag | EN: Fault code TZ10 - debounce filter threshold for setting the fault" VALUE 0x70DAA TKW_VV_VV_UB 100.0 FORMULA_0003 0.0 255.0000 /end CHARACTERISTIC
/begin CHARACTERISTIC K_ED_VAN_ANSCHL_E1.FEHLERSCHWELLE "Filterschwelle fuer Fehlereintrag | EN: Fault code VAN_ANSCHL_E1 - debounce filter threshold for setting the fault" VALUE 0x70DF8 TKW_VV_VV_UB 100.0 FORMULA_0003 0.0 255.0000 /end CHARACTERISTIC
/begin CHARACTERISTIC K_ED_VAN_ANSCHL_A1.FEHLERSCHWELLE "Filterschwelle fuer Fehlereintrag | EN: Fault code VAN_ANSCHL_A1 - debounce filter threshold for setting the fault" VALUE 0x70E12 TKW_VV_VV_UB 100.0 FORMULA_0003 0.0 255.0000 /end CHARACTERISTIC
/begin CHARACTERISTIC K_ED_VAN_ANSCHL_E2.FEHLERSCHWELLE "Filterschwelle fuer Fehlereintrag | EN: Fault code VAN_ANSCHL_E2 - debounce filter threshold for setting the fault" VALUE 0x70E2C TKW_VV_VV_UB 100.0 FORMULA_0003 0.0 255.0000 /end CHARACTERISTIC
/begin CHARACTERISTIC K_ED_VAN_ANSCHL_A2.FEHLERSCHWELLE "Filterschwelle fuer Fehlereintrag | EN: Fault code VAN_ANSCHL_A2 - debounce filter threshold for setting the fault" VALUE 0x70E46 TKW_VV_VV_UB 100.0 FORMULA_0003 0.0 255.0000 /end CHARACTERISTIC
/begin CHARACTERISTIC K_ED_VAN_VENT_A1.FEHLERSCHWELLE "Filterschwelle fuer Fehlereintrag | EN: Fault code VAN_VENT_A1 - debounce filter threshold for setting the fault" VALUE 0x70E7A TKW_VV_VV_UB 100.0 FORMULA_0003 0.0 255.0000 /end CHARACTERISTIC
/begin CHARACTERISTIC K_ED_PT_VEHMOD.FEHLERSCHWELLE "Filterschwelle fuer Fehlereintrag | EN: Fault code PT_VEHMOD - debounce filter threshold for setting the fault" VALUE 0x7101A TKW_VV_VV_UB 100.0 FORMULA_0003 0.0 255.0000 /end CHARACTERISTIC
/begin CHARACTERISTIC K_ED_RLU87.FEHLERSCHWELLE "Filterschwelle fuer Fehlereintrag | EN: Fault code RLU87 - debounce filter threshold for setting the fault" VALUE 0x7111E TKW_VV_VV_UB 100.0 FORMULA_0003 0.0 255.0000 /end CHARACTERISTIC
/begin CHARACTERISTIC K_ED_SSP.FEHLERSCHWELLE "Filterschwelle fuer Fehlereintrag" VALUE 0x71152 TKW_VV_VV_UB 100.0 FORMULA_0003 0.0 255.0000 /end CHARACTERISTIC
/begin CHARACTERISTIC K_ED_TD.FEHLERSCHWELLE "Filterschwelle fuer Fehlereintrag | EN: Fault code TD - debounce filter threshold for setting the fault" VALUE 0x7116C TKW_VV_VV_UB 100.0 FORMULA_0003 0.0 255.0000 /end CHARACTERISTIC
/begin CHARACTERISTIC K_ED_RLSLP.FEHLERSCHWELLE "Filterschwelle fuer Fehlereintrag | EN: Fault code RLSLP - debounce filter threshold for setting the fault" VALUE 0x71186 TKW_VV_VV_UB 100.0 FORMULA_0003 0.0 255.0000 /end CHARACTERISTIC
/begin CHARACTERISTIC K_ED_SLV.FEHLERSCHWELLE "Filterschwelle fuer Fehlereintrag | EN: Fault code SLV - debounce filter threshold for setting the fault" VALUE 0x711A0 TKW_VV_VV_UB 100.0 FORMULA_0003 0.0 255.0000 /end CHARACTERISTIC
/begin CHARACTERISTIC K_ED_VAN_DSV.FEHLERSCHWELLE "Filterschwelle fuer Fehlereintrag | EN: Fault code VAN_DSV - debounce filter threshold for setting the fault" VALUE 0x71270 TKW_VV_VV_UB 100.0 FORMULA_0003 0.0 255.0000 /end CHARACTERISTIC
/begin CHARACTERISTIC K_ED_SK_MANAGER_INJ.FEHLERSCHWELLE "Filterschwelle fuer Fehlereintrag | EN: Fault code SK_MANAGER_INJ - debounce filter threshold for setting the fault" VALUE 0x7138E TKW_VV_VV_UB 100.0 FORMULA_0003 0.0 255.0000 /end CHARACTERISTIC
/begin CHARACTERISTIC K_ED_SSP_DIAG.FEHLERSCHWELLE "Filterschwelle fuer Fehlereintrag" VALUE 0x713A8 TKW_VV_VV_UB 100.0 FORMULA_0003 0.0 255.0000 /end CHARACTERISTIC
/begin CHARACTERISTIC K_ED_SG_INJ.FEHLERSCHWELLE "Filterschwelle fuer Fehlereintrag | EN: Fault code SG_INJ - debounce filter threshold for setting the fault" VALUE 0x71492 TKW_VV_VV_UB 100.0 FORMULA_0003 0.0 255.0000 /end CHARACTERISTIC
/begin CHARACTERISTIC K_ED_S_POEL_DIAG.FEHLERSCHWELLE "Filterschwelle fuer Fehlereintrag | EN: Fault code S_POEL_DIAG - debounce filter threshold for setting the fault" VALUE 0x714E0 TKW_VV_VV_UB 100.0 FORMULA_0003 0.0 255.0000 /end CHARACTERISTIC
/begin CHARACTERISTIC K_ED_TE_OBD_1.FEHLERSCHWELLE "Filterschwelle fuer Fehlereintrag | EN: Fault code TE_OBD_1 - debounce filter threshold for setting the fault" VALUE 0x714FA TKW_VV_VV_UB 100.0 FORMULA_0003 0.0 255.0000 /end CHARACTERISTIC
/begin CHARACTERISTIC K_ED_TE_OBD_2.FEHLERSCHWELLE "Filterschwelle fuer Fehlereintrag | EN: Fault code TE_OBD_2 - debounce filter threshold for setting the fault" VALUE 0x71514 TKW_VV_VV_UB 100.0 FORMULA_0003 0.0 255.0000 /end CHARACTERISTIC
/begin CHARACTERISTIC K_ED_TEV1.FEHLERSCHWELLE "Filterschwelle fuer Fehlereintrag | EN: Fault code TEV1 - debounce filter threshold for setting the fault" VALUE 0x7152E TKW_VV_VV_UB 100.0 FORMULA_0003 0.0 255.0000 /end CHARACTERISTIC
/begin CHARACTERISTIC K_ED_TEV2.FEHLERSCHWELLE "Filterschwelle fuer Fehlereintrag | EN: Fault code TEV2 - debounce filter threshold for setting the fault" VALUE 0x71548 TKW_VV_VV_UB 100.0 FORMULA_0003 0.0 255.0000 /end CHARACTERISTIC
/begin CHARACTERISTIC K_ED_SLP.FEHLERSCHWELLE "Filterschwelle fuer Fehlereintrag | EN: Fault code SLP - debounce filter threshold for setting the fault" VALUE 0x71618 TKW_VV_VV_UB 100.0 FORMULA_0003 0.0 255.0000 /end CHARACTERISTIC
/begin CHARACTERISTIC K_ED_SL_DURCHS_B1.FEHLERSCHWELLE "Filterschwelle fuer Fehlereintrag | EN: Fault code SL_DURCHS_B1 - debounce filter threshold for setting the fault" VALUE 0x71632 TKW_VV_VV_UB 100.0 FORMULA_0003 0.0 255.0000 /end CHARACTERISTIC
/begin CHARACTERISTIC K_ED_SL_DURCHS_B2.FEHLERSCHWELLE "Filterschwelle fuer Fehlereintrag | EN: Fault code SL_DURCHS_B2 - debounce filter threshold for setting the fault" VALUE 0x7164C TKW_VV_VV_UB 100.0 FORMULA_0003 0.0 255.0000 /end CHARACTERISTIC
/begin CHARACTERISTIC K_ED_SL_DURCHS_HSTRANG.FEHLERSCHWELLE "Filterschwelle fuer Fehlereintrag | EN: Fault code SL_DURCHS_HSTRANG - debounce filter threshold for setting the fault" VALUE 0x71666 TKW_VV_VV_UB 100.0 FORMULA_0003 0.0 255.0000 /end CHARACTERISTIC
/begin CHARACTERISTIC K_ED_S_GETR_HS.FEHLERSCHWELLE "Filterschwelle fuer Fehlereintrag | EN: Fault code S_GETR_HS - debounce filter threshold for setting the fault" VALUE 0x7169A TKW_VV_VV_UB 100.0 FORMULA_0003 0.0 255.0000 /end CHARACTERISTIC
/begin CHARACTERISTIC K_ED_S_KUPP_HS.FEHLERSCHWELLE "Filterschwelle fuer Fehlereintrag | EN: Fault code S_KUPP_HS - debounce filter threshold for setting the fault" VALUE 0x716B4 TKW_VV_VV_UB 100.0 FORMULA_0003 0.0 255.0000 /end CHARACTERISTIC
/begin CHARACTERISTIC K_ED_VAN_DRUCK.FEHLERSCHWELLE "Filterschwelle fuer Fehlereintrag | EN: Fault code VAN_DRUCK - debounce filter threshold for setting the fault" VALUE 0x716CE TKW_VV_VV_UB 100.0 FORMULA_0003 0.0 255.0000 /end CHARACTERISTIC
/begin CHARACTERISTIC K_ED_PT_STATANH.FEHLERSCHWELLE "Filterschwelle fuer Fehlereintrag | EN: Fault code PT_STATANH - debounce filter threshold for setting the fault" VALUE 0x7171C TKW_VV_VV_UB 100.0 FORMULA_0003 0.0 255.0000 /end CHARACTERISTIC
/begin CHARACTERISTIC K_ED_PT_STATGRB.FEHLERSCHWELLE "Filterschwelle fuer Fehlereintrag" VALUE 0x7179E TKW_VV_VV_UB 100.0 FORMULA_0003 0.0 255.0000 /end CHARACTERISTIC
/begin CHARACTERISTIC K_ED_TANK_LEER.FEHLERSCHWELLE "Filterschwelle fuer Fehlereintrag | EN: Fault code TANK_LEER - debounce filter threshold for setting the fault" VALUE 0x717EC TKW_VV_VV_UB 100.0 FORMULA_0003 0.0 255.0000 /end CHARACTERISTIC
/begin CHARACTERISTIC K_ED_PT_TOMA.FEHLERSCHWELLE "Filterschwelle fuer Fehlereintrag | EN: Fault code PT_TOMA - debounce filter threshold for setting the fault" VALUE 0x71806 TKW_VV_VV_UB 100.0 FORMULA_0003 0.0 255.0000 /end CHARACTERISTIC
/begin CHARACTERISTIC K_ED_PUMG_OBD.FEHLERSCHWELLE "Filterschwelle fuer Fehlereintrag | EN: Fault code PUMG_OBD - debounce filter threshold for setting the fault" VALUE 0x7183A TKW_VV_VV_UB 100.0 FORMULA_0003 0.0 255.0000 /end CHARACTERISTIC
/begin CHARACTERISTIC K_ED_SL_ML_HFM_OBD.FEHLERSCHWELLE "Filterschwelle fuer Fehlereintrag | EN: Fault code SL_ML_HFM_OBD - debounce filter threshold for setting the fault" VALUE 0x71854 TKW_VV_VV_UB 100.0 FORMULA_0003 0.0 255.0000 /end CHARACTERISTIC
/begin CHARACTERISTIC K_ED_TGETR_HS.FEHLERSCHWELLE "Filterschwelle fuer Fehlereintrag | EN: Fault code TGETR_HS - debounce filter threshold for setting the fault" VALUE 0x7198C TKW_VV_VV_UB 100.0 FORMULA_0003 0.0 255.0000 /end CHARACTERISTIC
/begin CHARACTERISTIC K_ED_PT_OBD_ED.FEHLERSCHWELLE "Filterschwelle fuer Fehlereintrag" VALUE 0x719DA TKW_VV_VV_UB 100.0 FORMULA_0003 0.0 255.0000 /end CHARACTERISTIC
/begin CHARACTERISTIC K_ED_SK_TR_INJ.OK_SCHWELLE "Filterschwelle fuer Fehleraustrag | EN: Filterschwelle fuer Fehleraustrag" VALUE 0x705F3 TKW_VV_VV_UB 100.0 FORMULA_0003 0.0 255.0000 /end CHARACTERISTIC
/begin CHARACTERISTIC K_ED_PUMG.OK_SCHWELLE "Filterschwelle fuer Fehleraustrag | EN: Fault code PUMG - debounce filter threshold for clearing (healing) the fault" VALUE 0x7060D TKW_VV_VV_UB 100.0 FORMULA_0003 0.0 255.0000 /end CHARACTERISTIC
/begin CHARACTERISTIC K_ED_VAN_HALL_E1.OK_SCHWELLE "Filterschwelle fuer Fehleraustrag | EN: Fault code VAN_HALL_E1 - debounce filter threshold for clearing (healing) the fault" VALUE 0x7068F TKW_VV_VV_UB 100.0 FORMULA_0003 0.0 255.0000 /end CHARACTERISTIC
/begin CHARACTERISTIC K_ED_VAN_HALL_A1.OK_SCHWELLE "Filterschwelle fuer Fehleraustrag | EN: Fault code VAN_HALL_A1 - debounce filter threshold for clearing (healing) the fault" VALUE 0x706A9 TKW_VV_VV_UB 100.0 FORMULA_0003 0.0 255.0000 /end CHARACTERISTIC
/begin CHARACTERISTIC K_ED_VAN_HALL_E2.OK_SCHWELLE "Filterschwelle fuer Fehleraustrag | EN: Fault code VAN_HALL_E2 - debounce filter threshold for clearing (healing) the fault" VALUE 0x706C3 TKW_VV_VV_UB 100.0 FORMULA_0003 0.0 255.0000 /end CHARACTERISTIC
/begin CHARACTERISTIC K_ED_VAN_HALL_A2.OK_SCHWELLE "Filterschwelle fuer Fehleraustrag | EN: Fault code VAN_HALL_A2 - debounce filter threshold for clearing (healing) the fault" VALUE 0x706DD TKW_VV_VV_UB 100.0 FORMULA_0003 0.0 255.0000 /end CHARACTERISTIC
/begin CHARACTERISTIC K_ED_PT_STATDKG.OK_SCHWELLE "Filterschwelle fuer Fehleraustrag | EN: Fault code PT_STATDKG - debounce filter threshold for clearing (healing) the fault" VALUE 0x707AD TKW_VV_VV_UB 100.0 FORMULA_0003 0.0 255.0000 /end CHARACTERISTIC
/begin CHARACTERISTIC K_ED_PT_STATR.OK_SCHWELLE "Filterschwelle fuer Fehleraustrag | EN: Fault code PT_STATR - debounce filter threshold for clearing (healing) the fault" VALUE 0x707E1 TKW_VV_VV_UB 100.0 FORMULA_0003 0.0 255.0000 /end CHARACTERISTIC
/begin CHARACTERISTIC K_ED_PT_TORQDSC.OK_SCHWELLE "Filterschwelle fuer Fehleraustrag | EN: Fault code PT_TORQDSC - debounce filter threshold for clearing (healing) the fault" VALUE 0x70919 TKW_VV_VV_UB 100.0 FORMULA_0003 0.0 255.0000 /end CHARACTERISTIC
/begin CHARACTERISTIC K_ED_PT_STDSC.OK_SCHWELLE "Filterschwelle fuer Fehleraustrag | EN: Fault code PT_STDSC - debounce filter threshold for clearing (healing) the fault" VALUE 0x70933 TKW_VV_VV_UB 100.0 FORMULA_0003 0.0 255.0000 /end CHARACTERISTIC
/begin CHARACTERISTIC K_ED_PT_VRAD.OK_SCHWELLE "Filterschwelle fuer Fehleraustrag | EN: Fault code PT_VRAD - debounce filter threshold for clearing (healing) the fault" VALUE 0x7094D TKW_VV_VV_UB 100.0 FORMULA_0003 0.0 255.0000 /end CHARACTERISTIC
/begin CHARACTERISTIC K_ED_PT_VFZG.OK_SCHWELLE "Filterschwelle fuer Fehleraustrag | EN: Fault code PT_VFZG - debounce filter threshold for clearing (healing) the fault" VALUE 0x70967 TKW_VV_VV_UB 100.0 FORMULA_0003 0.0 255.0000 /end CHARACTERISTIC
/begin CHARACTERISTIC K_ED_PT_LRW.OK_SCHWELLE "Filterschwelle fuer Fehleraustrag | EN: Fault code PT_LRW - debounce filter threshold for clearing (healing) the fault" VALUE 0x709CF TKW_VV_VV_UB 100.0 FORMULA_0003 0.0 255.0000 /end CHARACTERISTIC
/begin CHARACTERISTIC K_ED_SL_ML_HFM.OK_SCHWELLE "Filterschwelle fuer Fehleraustrag | EN: Fault code SL_ML_HFM - debounce filter threshold for clearing (healing) the fault" VALUE 0x70A1D TKW_VV_VV_UB 100.0 FORMULA_0003 0.0 255.0000 /end CHARACTERISTIC
/begin CHARACTERISTIC K_ED_TZ1.OK_SCHWELLE "Filterschwelle fuer Fehleraustrag | EN: Fault code TZ1 - debounce filter threshold for clearing (healing) the fault" VALUE 0x70CC1 TKW_VV_VV_UB 100.0 FORMULA_0003 0.0 255.0000 /end CHARACTERISTIC
/begin CHARACTERISTIC K_ED_TZ2.OK_SCHWELLE "Filterschwelle fuer Fehleraustrag | EN: Fault code TZ2 - debounce filter threshold for clearing (healing) the fault" VALUE 0x70CDB TKW_VV_VV_UB 100.0 FORMULA_0003 0.0 255.0000 /end CHARACTERISTIC
/begin CHARACTERISTIC K_ED_TZ3.OK_SCHWELLE "Filterschwelle fuer Fehleraustrag | EN: Fault code TZ3 - debounce filter threshold for clearing (healing) the fault" VALUE 0x70CF5 TKW_VV_VV_UB 100.0 FORMULA_0003 0.0 255.0000 /end CHARACTERISTIC
/begin CHARACTERISTIC K_ED_TZ4.OK_SCHWELLE "Filterschwelle fuer Fehleraustrag | EN: Fault code TZ4 - debounce filter threshold for clearing (healing) the fault" VALUE 0x70D0F TKW_VV_VV_UB 100.0 FORMULA_0003 0.0 255.0000 /end CHARACTERISTIC
/begin CHARACTERISTIC K_ED_TZ5.OK_SCHWELLE "Filterschwelle fuer Fehleraustrag | EN: Fault code TZ5 - debounce filter threshold for clearing (healing) the fault" VALUE 0x70D29 TKW_VV_VV_UB 100.0 FORMULA_0003 0.0 255.0000 /end CHARACTERISTIC
/begin CHARACTERISTIC K_ED_TZ6.OK_SCHWELLE "Filterschwelle fuer Fehleraustrag | EN: Fault code TZ6 - debounce filter threshold for clearing (healing) the fault" VALUE 0x70D43 TKW_VV_VV_UB 100.0 FORMULA_0003 0.0 255.0000 /end CHARACTERISTIC
/begin CHARACTERISTIC K_ED_TZ7.OK_SCHWELLE "Filterschwelle fuer Fehleraustrag | EN: Fault code TZ7 - debounce filter threshold for clearing (healing) the fault" VALUE 0x70D5D TKW_VV_VV_UB 100.0 FORMULA_0003 0.0 255.0000 /end CHARACTERISTIC
/begin CHARACTERISTIC K_ED_TZ8.OK_SCHWELLE "Filterschwelle fuer Fehleraustrag | EN: Fault code TZ8 - debounce filter threshold for clearing (healing) the fault" VALUE 0x70D77 TKW_VV_VV_UB 100.0 FORMULA_0003 0.0 255.0000 /end CHARACTERISTIC
/begin CHARACTERISTIC K_ED_TZ9.OK_SCHWELLE "Filterschwelle fuer Fehleraustrag | EN: Fault code TZ9 - debounce filter threshold for clearing (healing) the fault" VALUE 0x70D91 TKW_VV_VV_UB 100.0 FORMULA_0003 0.0 255.0000 /end CHARACTERISTIC
/begin CHARACTERISTIC K_ED_TZ10.OK_SCHWELLE "Filterschwelle fuer Fehleraustrag | EN: Fault code TZ10 - debounce filter threshold for clearing (healing) the fault" VALUE 0x70DAB TKW_VV_VV_UB 100.0 FORMULA_0003 0.0 255.0000 /end CHARACTERISTIC
/begin CHARACTERISTIC K_ED_VAN_ANSCHL_E1.OK_SCHWELLE "Filterschwelle fuer Fehleraustrag | EN: Fault code VAN_ANSCHL_E1 - debounce filter threshold for clearing (healing) the fault" VALUE 0x70DF9 TKW_VV_VV_UB 100.0 FORMULA_0003 0.0 255.0000 /end CHARACTERISTIC
/begin CHARACTERISTIC K_ED_VAN_ANSCHL_A1.OK_SCHWELLE "Filterschwelle fuer Fehleraustrag | EN: Fault code VAN_ANSCHL_A1 - debounce filter threshold for clearing (healing) the fault" VALUE 0x70E13 TKW_VV_VV_UB 100.0 FORMULA_0003 0.0 255.0000 /end CHARACTERISTIC
/begin CHARACTERISTIC K_ED_VAN_ANSCHL_E2.OK_SCHWELLE "Filterschwelle fuer Fehleraustrag | EN: Fault code VAN_ANSCHL_E2 - debounce filter threshold for clearing (healing) the fault" VALUE 0x70E2D TKW_VV_VV_UB 100.0 FORMULA_0003 0.0 255.0000 /end CHARACTERISTIC
/begin CHARACTERISTIC K_ED_VAN_ANSCHL_A2.OK_SCHWELLE "Filterschwelle fuer Fehleraustrag | EN: Fault code VAN_ANSCHL_A2 - debounce filter threshold for clearing (healing) the fault" VALUE 0x70E47 TKW_VV_VV_UB 100.0 FORMULA_0003 0.0 255.0000 /end CHARACTERISTIC
/begin CHARACTERISTIC K_ED_PT_VEHMOD.OK_SCHWELLE "Filterschwelle fuer Fehleraustrag | EN: Fault code PT_VEHMOD - debounce filter threshold for clearing (healing) the fault" VALUE 0x7101B TKW_VV_VV_UB 100.0 FORMULA_0003 0.0 255.0000 /end CHARACTERISTIC
/begin CHARACTERISTIC K_ED_RLU87.OK_SCHWELLE "Filterschwelle fuer Fehleraustrag | EN: Fault code RLU87 - debounce filter threshold for clearing (healing) the fault" VALUE 0x7111F TKW_VV_VV_UB 100.0 FORMULA_0003 0.0 255.0000 /end CHARACTERISTIC
/begin CHARACTERISTIC K_ED_SSP.OK_SCHWELLE "Filterschwelle fuer Fehleraustrag" VALUE 0x71153 TKW_VV_VV_UB 100.0 FORMULA_0003 0.0 255.0000 /end CHARACTERISTIC
/begin CHARACTERISTIC K_ED_TD.OK_SCHWELLE "Filterschwelle fuer Fehleraustrag | EN: Fault code TD - debounce filter threshold for clearing (healing) the fault" VALUE 0x7116D TKW_VV_VV_UB 100.0 FORMULA_0003 0.0 255.0000 /end CHARACTERISTIC
/begin CHARACTERISTIC K_ED_RLSLP.OK_SCHWELLE "Filterschwelle fuer Fehleraustrag | EN: Fault code RLSLP - debounce filter threshold for clearing (healing) the fault" VALUE 0x71187 TKW_VV_VV_UB 100.0 FORMULA_0003 0.0 255.0000 /end CHARACTERISTIC
/begin CHARACTERISTIC K_ED_SLV.OK_SCHWELLE "Filterschwelle fuer Fehleraustrag | EN: Fault code SLV - debounce filter threshold for clearing (healing) the fault" VALUE 0x711A1 TKW_VV_VV_UB 100.0 FORMULA_0003 0.0 255.0000 /end CHARACTERISTIC
/begin CHARACTERISTIC K_ED_VAN_DSV.OK_SCHWELLE "Filterschwelle fuer Fehleraustrag | EN: Fault code VAN_DSV - debounce filter threshold for clearing (healing) the fault" VALUE 0x71271 TKW_VV_VV_UB 100.0 FORMULA_0003 0.0 255.0000 /end CHARACTERISTIC
/begin CHARACTERISTIC K_ED_SK_MANAGER_INJ.OK_SCHWELLE "Filterschwelle fuer Fehleraustrag | EN: Fault code SK_MANAGER_INJ - debounce filter threshold for clearing (healing) the fault" VALUE 0x7138F TKW_VV_VV_UB 100.0 FORMULA_0003 0.0 255.0000 /end CHARACTERISTIC
/begin CHARACTERISTIC K_ED_SSP_DIAG.OK_SCHWELLE "Filterschwelle fuer Fehleraustrag" VALUE 0x713A9 TKW_VV_VV_UB 100.0 FORMULA_0003 0.0 255.0000 /end CHARACTERISTIC
/begin CHARACTERISTIC K_ED_SG_INJ.OK_SCHWELLE "Filterschwelle fuer Fehleraustrag | EN: Fault code SG_INJ - debounce filter threshold for clearing (healing) the fault" VALUE 0x71493 TKW_VV_VV_UB 100.0 FORMULA_0003 0.0 255.0000 /end CHARACTERISTIC
/begin CHARACTERISTIC K_ED_S_POEL_DIAG.OK_SCHWELLE "Filterschwelle fuer Fehleraustrag | EN: Fault code S_POEL_DIAG - debounce filter threshold for clearing (healing) the fault" VALUE 0x714E1 TKW_VV_VV_UB 100.0 FORMULA_0003 0.0 255.0000 /end CHARACTERISTIC
/begin CHARACTERISTIC K_ED_TE_OBD_1.OK_SCHWELLE "Filterschwelle fuer Fehleraustrag | EN: Fault code TE_OBD_1 - debounce filter threshold for clearing (healing) the fault" VALUE 0x714FB TKW_VV_VV_UB 100.0 FORMULA_0003 0.0 255.0000 /end CHARACTERISTIC
/begin CHARACTERISTIC K_ED_TE_OBD_2.OK_SCHWELLE "Filterschwelle fuer Fehleraustrag | EN: Fault code TE_OBD_2 - debounce filter threshold for clearing (healing) the fault" VALUE 0x71515 TKW_VV_VV_UB 100.0 FORMULA_0003 0.0 255.0000 /end CHARACTERISTIC
/begin CHARACTERISTIC K_ED_TEV1.OK_SCHWELLE "Filterschwelle fuer Fehleraustrag | EN: Fault code TEV1 - debounce filter threshold for clearing (healing) the fault" VALUE 0x7152F TKW_VV_VV_UB 100.0 FORMULA_0003 0.0 255.0000 /end CHARACTERISTIC
/begin CHARACTERISTIC K_ED_TEV2.OK_SCHWELLE "Filterschwelle fuer Fehleraustrag | EN: Fault code TEV2 - debounce filter threshold for clearing (healing) the fault" VALUE 0x71549 TKW_VV_VV_UB 100.0 FORMULA_0003 0.0 255.0000 /end CHARACTERISTIC
/begin CHARACTERISTIC K_ED_SLP.OK_SCHWELLE "Filterschwelle fuer Fehleraustrag | EN: Fault code SLP - debounce filter threshold for clearing (healing) the fault" VALUE 0x71619 TKW_VV_VV_UB 100.0 FORMULA_0003 0.0 255.0000 /end CHARACTERISTIC
/begin CHARACTERISTIC K_ED_SL_DURCHS_B1.OK_SCHWELLE "Filterschwelle fuer Fehleraustrag | EN: Fault code SL_DURCHS_B1 - debounce filter threshold for clearing (healing) the fault" VALUE 0x71633 TKW_VV_VV_UB 100.0 FORMULA_0003 0.0 255.0000 /end CHARACTERISTIC
/begin CHARACTERISTIC K_ED_SL_DURCHS_B2.OK_SCHWELLE "Filterschwelle fuer Fehleraustrag | EN: Fault code SL_DURCHS_B2 - debounce filter threshold for clearing (healing) the fault" VALUE 0x7164D TKW_VV_VV_UB 100.0 FORMULA_0003 0.0 255.0000 /end CHARACTERISTIC
/begin CHARACTERISTIC K_ED_SL_DURCHS_HSTRANG.OK_SCHWELLE "Filterschwelle fuer Fehleraustrag | EN: Fault code SL_DURCHS_HSTRANG - debounce filter threshold for clearing (healing) the fault" VALUE 0x71667 TKW_VV_VV_UB 100.0 FORMULA_0003 0.0 255.0000 /end CHARACTERISTIC
/begin CHARACTERISTIC K_ED_S_GETR_HS.OK_SCHWELLE "Filterschwelle fuer Fehleraustrag | EN: Fault code S_GETR_HS - debounce filter threshold for clearing (healing) the fault" VALUE 0x7169B TKW_VV_VV_UB 100.0 FORMULA_0003 0.0 255.0000 /end CHARACTERISTIC
/begin CHARACTERISTIC K_ED_S_KUPP_HS.OK_SCHWELLE "Filterschwelle fuer Fehleraustrag | EN: Fault code S_KUPP_HS - debounce filter threshold for clearing (healing) the fault" VALUE 0x716B5 TKW_VV_VV_UB 100.0 FORMULA_0003 0.0 255.0000 /end CHARACTERISTIC
/begin CHARACTERISTIC K_ED_VAN_DRUCK.OK_SCHWELLE "Filterschwelle fuer Fehleraustrag | EN: Fault code VAN_DRUCK - debounce filter threshold for clearing (healing) the fault" VALUE 0x716CF TKW_VV_VV_UB 100.0 FORMULA_0003 0.0 255.0000 /end CHARACTERISTIC
/begin CHARACTERISTIC K_ED_PT_STATANH.OK_SCHWELLE "Filterschwelle fuer Fehleraustrag | EN: Fault code PT_STATANH - debounce filter threshold for clearing (healing) the fault" VALUE 0x7171D TKW_VV_VV_UB 100.0 FORMULA_0003 0.0 255.0000 /end CHARACTERISTIC
/begin CHARACTERISTIC K_ED_PT_STATGRB.OK_SCHWELLE "Filterschwelle fuer Fehleraustrag" VALUE 0x7179F TKW_VV_VV_UB 100.0 FORMULA_0003 0.0 255.0000 /end CHARACTERISTIC
/begin CHARACTERISTIC K_ED_TANK_LEER.OK_SCHWELLE "Filterschwelle fuer Fehleraustrag | EN: Fault code TANK_LEER - debounce filter threshold for clearing (healing) the fault" VALUE 0x717ED TKW_VV_VV_UB 100.0 FORMULA_0003 0.0 255.0000 /end CHARACTERISTIC
/begin CHARACTERISTIC K_ED_PT_TOMA.OK_SCHWELLE "Filterschwelle fuer Fehleraustrag | EN: Fault code PT_TOMA - debounce filter threshold for clearing (healing) the fault" VALUE 0x71807 TKW_VV_VV_UB 100.0 FORMULA_0003 0.0 255.0000 /end CHARACTERISTIC
/begin CHARACTERISTIC K_ED_PUMG_OBD.OK_SCHWELLE "Filterschwelle fuer Fehleraustrag | EN: Fault code PUMG_OBD - debounce filter threshold for clearing (healing) the fault" VALUE 0x7183B TKW_VV_VV_UB 100.0 FORMULA_0003 0.0 255.0000 /end CHARACTERISTIC
/begin CHARACTERISTIC K_ED_SL_ML_HFM_OBD.OK_SCHWELLE "Filterschwelle fuer Fehleraustrag | EN: Fault code SL_ML_HFM_OBD - debounce filter threshold for clearing (healing) the fault" VALUE 0x71855 TKW_VV_VV_UB 100.0 FORMULA_0003 0.0 255.0000 /end CHARACTERISTIC
/begin CHARACTERISTIC K_ED_TGETR_HS.OK_SCHWELLE "Filterschwelle fuer Fehleraustrag | EN: Fault code TGETR_HS - debounce filter threshold for clearing (healing) the fault" VALUE 0x7198D TKW_VV_VV_UB 100.0 FORMULA_0003 0.0 255.0000 /end CHARACTERISTIC
/begin CHARACTERISTIC K_ED_PT_OBD_ED.OK_SCHWELLE "Filterschwelle fuer Fehleraustrag" VALUE 0x719DB TKW_VV_VV_UB 100.0 FORMULA_0003 0.0 255.0000 /end CHARACTERISTIC
/begin CHARACTERISTIC K_ED_SK_TR_INJ.INC_VOR_EINTRAG "Filtererhoehung vorm Fehlerspeichereintrag | EN: Filtererhoehung vorm Fehlerspeichereintrag" VALUE 0x705F4 TKW_VV_VV_UB 100.0 FORMULA_0003 0.0 255.0000 /end CHARACTERISTIC
/begin CHARACTERISTIC K_ED_PUMG.INC_VOR_EINTRAG "Filtererhoehung vorm Fehlerspeichereintrag | EN: Fault code PUMG - debounce filter increment before fault-memory entry" VALUE 0x7060E TKW_VV_VV_UB 100.0 FORMULA_0003 0.0 255.0000 /end CHARACTERISTIC
/begin CHARACTERISTIC K_ED_VAN_HALL_E1.INC_VOR_EINTRAG "Filtererhoehung vorm Fehlerspeichereintrag | EN: Fault code VAN_HALL_E1 - debounce filter increment before fault-memory entry" VALUE 0x70690 TKW_VV_VV_UB 100.0 FORMULA_0003 0.0 255.0000 /end CHARACTERISTIC
/begin CHARACTERISTIC K_ED_VAN_HALL_A1.INC_VOR_EINTRAG "Filtererhoehung vorm Fehlerspeichereintrag | EN: Fault code VAN_HALL_A1 - debounce filter increment before fault-memory entry" VALUE 0x706AA TKW_VV_VV_UB 100.0 FORMULA_0003 0.0 255.0000 /end CHARACTERISTIC
/begin CHARACTERISTIC K_ED_VAN_HALL_E2.INC_VOR_EINTRAG "Filtererhoehung vorm Fehlerspeichereintrag | EN: Fault code VAN_HALL_E2 - debounce filter increment before fault-memory entry" VALUE 0x706C4 TKW_VV_VV_UB 100.0 FORMULA_0003 0.0 255.0000 /end CHARACTERISTIC
/begin CHARACTERISTIC K_ED_VAN_HALL_A2.INC_VOR_EINTRAG "Filtererhoehung vorm Fehlerspeichereintrag | EN: Fault code VAN_HALL_A2 - debounce filter increment before fault-memory entry" VALUE 0x706DE TKW_VV_VV_UB 100.0 FORMULA_0003 0.0 255.0000 /end CHARACTERISTIC
/begin CHARACTERISTIC K_ED_VAN_REGL_E1.INC_VOR_EINTRAG "Filtererhoehung vorm Fehlerspeichereintrag | EN: Fault code VAN_REGL_E1 - debounce filter increment before fault-memory entry" VALUE 0x706F8 TKW_VV_VV_UB 100.0 FORMULA_0003 0.0 255.0000 /end CHARACTERISTIC
/begin CHARACTERISTIC K_ED_VAN_REGL_A1.INC_VOR_EINTRAG "Filtererhoehung vorm Fehlerspeichereintrag | EN: Fault code VAN_REGL_A1 - debounce filter increment before fault-memory entry" VALUE 0x70712 TKW_VV_VV_UB 100.0 FORMULA_0003 0.0 255.0000 /end CHARACTERISTIC
/begin CHARACTERISTIC K_ED_VAN_REGL_E2.INC_VOR_EINTRAG "Filtererhoehung vorm Fehlerspeichereintrag | EN: Fault code VAN_REGL_E2 - debounce filter increment before fault-memory entry" VALUE 0x7072C TKW_VV_VV_UB 100.0 FORMULA_0003 0.0 255.0000 /end CHARACTERISTIC
/begin CHARACTERISTIC K_ED_VAN_REGL_A2.INC_VOR_EINTRAG "Filtererhoehung vorm Fehlerspeichereintrag | EN: Fault code VAN_REGL_A2 - debounce filter increment before fault-memory entry" VALUE 0x70746 TKW_VV_VV_UB 100.0 FORMULA_0003 0.0 255.0000 /end CHARACTERISTIC
/begin CHARACTERISTIC K_ED_PT_STATDKG.INC_VOR_EINTRAG "Filtererhoehung vorm Fehlerspeichereintrag | EN: Fault code PT_STATDKG - debounce filter increment before fault-memory entry" VALUE 0x707AE TKW_VV_VV_UB 100.0 FORMULA_0003 0.0 255.0000 /end CHARACTERISTIC
/begin CHARACTERISTIC K_ED_PT_STATR.INC_VOR_EINTRAG "Filtererhoehung vorm Fehlerspeichereintrag | EN: Fault code PT_STATR - debounce filter increment before fault-memory entry" VALUE 0x707E2 TKW_VV_VV_UB 100.0 FORMULA_0003 0.0 255.0000 /end CHARACTERISTIC
/begin CHARACTERISTIC K_ED_PT_TORQDSC.INC_VOR_EINTRAG "Filtererhoehung vorm Fehlerspeichereintrag | EN: Fault code PT_TORQDSC - debounce filter increment before fault-memory entry" VALUE 0x7091A TKW_VV_VV_UB 100.0 FORMULA_0003 0.0 255.0000 /end CHARACTERISTIC
/begin CHARACTERISTIC K_ED_PT_STDSC.INC_VOR_EINTRAG "Filtererhoehung vorm Fehlerspeichereintrag | EN: Fault code PT_STDSC - debounce filter increment before fault-memory entry" VALUE 0x70934 TKW_VV_VV_UB 100.0 FORMULA_0003 0.0 255.0000 /end CHARACTERISTIC
/begin CHARACTERISTIC K_ED_PT_VRAD.INC_VOR_EINTRAG "Filtererhoehung vorm Fehlerspeichereintrag | EN: Fault code PT_VRAD - debounce filter increment before fault-memory entry" VALUE 0x7094E TKW_VV_VV_UB 100.0 FORMULA_0003 0.0 255.0000 /end CHARACTERISTIC
/begin CHARACTERISTIC K_ED_PT_VFZG.INC_VOR_EINTRAG "Filtererhoehung vorm Fehlerspeichereintrag | EN: Fault code PT_VFZG - debounce filter increment before fault-memory entry" VALUE 0x70968 TKW_VV_VV_UB 100.0 FORMULA_0003 0.0 255.0000 /end CHARACTERISTIC
/begin CHARACTERISTIC K_ED_SL_ML_HFM.INC_VOR_EINTRAG "Filtererhoehung vorm Fehlerspeichereintrag | EN: Fault code SL_ML_HFM - debounce filter increment before fault-memory entry" VALUE 0x70A1E TKW_VV_VV_UB 100.0 FORMULA_0003 0.0 255.0000 /end CHARACTERISTIC
/begin CHARACTERISTIC K_ED_TZ1.INC_VOR_EINTRAG "Filtererhoehung vorm Fehlerspeichereintrag | EN: Fault code TZ1 - debounce filter increment before fault-memory entry" VALUE 0x70CC2 TKW_VV_VV_UB 100.0 FORMULA_0003 0.0 255.0000 /end CHARACTERISTIC
/begin CHARACTERISTIC K_ED_TZ2.INC_VOR_EINTRAG "Filtererhoehung vorm Fehlerspeichereintrag | EN: Fault code TZ2 - debounce filter increment before fault-memory entry" VALUE 0x70CDC TKW_VV_VV_UB 100.0 FORMULA_0003 0.0 255.0000 /end CHARACTERISTIC
/begin CHARACTERISTIC K_ED_TZ3.INC_VOR_EINTRAG "Filtererhoehung vorm Fehlerspeichereintrag | EN: Fault code TZ3 - debounce filter increment before fault-memory entry" VALUE 0x70CF6 TKW_VV_VV_UB 100.0 FORMULA_0003 0.0 255.0000 /end CHARACTERISTIC
/begin CHARACTERISTIC K_ED_TZ4.INC_VOR_EINTRAG "Filtererhoehung vorm Fehlerspeichereintrag | EN: Fault code TZ4 - debounce filter increment before fault-memory entry" VALUE 0x70D10 TKW_VV_VV_UB 100.0 FORMULA_0003 0.0 255.0000 /end CHARACTERISTIC
/begin CHARACTERISTIC K_ED_TZ5.INC_VOR_EINTRAG "Filtererhoehung vorm Fehlerspeichereintrag | EN: Fault code TZ5 - debounce filter increment before fault-memory entry" VALUE 0x70D2A TKW_VV_VV_UB 100.0 FORMULA_0003 0.0 255.0000 /end CHARACTERISTIC
/begin CHARACTERISTIC K_ED_TZ6.INC_VOR_EINTRAG "Filtererhoehung vorm Fehlerspeichereintrag | EN: Fault code TZ6 - debounce filter increment before fault-memory entry" VALUE 0x70D44 TKW_VV_VV_UB 100.0 FORMULA_0003 0.0 255.0000 /end CHARACTERISTIC
/begin CHARACTERISTIC K_ED_TZ7.INC_VOR_EINTRAG "Filtererhoehung vorm Fehlerspeichereintrag | EN: Fault code TZ7 - debounce filter increment before fault-memory entry" VALUE 0x70D5E TKW_VV_VV_UB 100.0 FORMULA_0003 0.0 255.0000 /end CHARACTERISTIC
/begin CHARACTERISTIC K_ED_TZ8.INC_VOR_EINTRAG "Filtererhoehung vorm Fehlerspeichereintrag | EN: Fault code TZ8 - debounce filter increment before fault-memory entry" VALUE 0x70D78 TKW_VV_VV_UB 100.0 FORMULA_0003 0.0 255.0000 /end CHARACTERISTIC
/begin CHARACTERISTIC K_ED_TZ9.INC_VOR_EINTRAG "Filtererhoehung vorm Fehlerspeichereintrag | EN: Fault code TZ9 - debounce filter increment before fault-memory entry" VALUE 0x70D92 TKW_VV_VV_UB 100.0 FORMULA_0003 0.0 255.0000 /end CHARACTERISTIC
/begin CHARACTERISTIC K_ED_TZ10.INC_VOR_EINTRAG "Filtererhoehung vorm Fehlerspeichereintrag | EN: Fault code TZ10 - debounce filter increment before fault-memory entry" VALUE 0x70DAC TKW_VV_VV_UB 100.0 FORMULA_0003 0.0 255.0000 /end CHARACTERISTIC
/begin CHARACTERISTIC K_ED_VAN_ANSCHL_E1.INC_VOR_EINTRAG "Filtererhoehung vorm Fehlerspeichereintrag | EN: Fault code VAN_ANSCHL_E1 - debounce filter increment before fault-memory entry" VALUE 0x70DFA TKW_VV_VV_UB 100.0 FORMULA_0003 0.0 255.0000 /end CHARACTERISTIC
/begin CHARACTERISTIC K_ED_VAN_ANSCHL_A1.INC_VOR_EINTRAG "Filtererhoehung vorm Fehlerspeichereintrag | EN: Fault code VAN_ANSCHL_A1 - debounce filter increment before fault-memory entry" VALUE 0x70E14 TKW_VV_VV_UB 100.0 FORMULA_0003 0.0 255.0000 /end CHARACTERISTIC
/begin CHARACTERISTIC K_ED_VAN_ANSCHL_E2.INC_VOR_EINTRAG "Filtererhoehung vorm Fehlerspeichereintrag | EN: Fault code VAN_ANSCHL_E2 - debounce filter increment before fault-memory entry" VALUE 0x70E2E TKW_VV_VV_UB 100.0 FORMULA_0003 0.0 255.0000 /end CHARACTERISTIC
/begin CHARACTERISTIC K_ED_VAN_ANSCHL_A2.INC_VOR_EINTRAG "Filtererhoehung vorm Fehlerspeichereintrag | EN: Fault code VAN_ANSCHL_A2 - debounce filter increment before fault-memory entry" VALUE 0x70E48 TKW_VV_VV_UB 100.0 FORMULA_0003 0.0 255.0000 /end CHARACTERISTIC
/begin CHARACTERISTIC K_ED_VAN_VENT_A1.INC_VOR_EINTRAG "Filtererhoehung vorm Fehlerspeichereintrag | EN: Fault code VAN_VENT_A1 - debounce filter increment before fault-memory entry" VALUE 0x70E7C TKW_VV_VV_UB 100.0 FORMULA_0003 0.0 255.0000 /end CHARACTERISTIC
/begin CHARACTERISTIC K_ED_PT_VEHMOD.INC_VOR_EINTRAG "Filtererhoehung vorm Fehlerspeichereintrag | EN: Fault code PT_VEHMOD - debounce filter increment before fault-memory entry" VALUE 0x7101C TKW_VV_VV_UB 100.0 FORMULA_0003 0.0 255.0000 /end CHARACTERISTIC
/begin CHARACTERISTIC K_ED_RLU87.INC_VOR_EINTRAG "Filtererhoehung vorm Fehlerspeichereintrag | EN: Fault code RLU87 - debounce filter increment before fault-memory entry" VALUE 0x71120 TKW_VV_VV_UB 100.0 FORMULA_0003 0.0 255.0000 /end CHARACTERISTIC
/begin CHARACTERISTIC K_ED_SSP.INC_VOR_EINTRAG "Filtererhoehung vorm Fehlerspeichereintrag" VALUE 0x71154 TKW_VV_VV_UB 100.0 FORMULA_0003 0.0 255.0000 /end CHARACTERISTIC
/begin CHARACTERISTIC K_ED_TD.INC_VOR_EINTRAG "Filtererhoehung vorm Fehlerspeichereintrag | EN: Fault code TD - debounce filter increment before fault-memory entry" VALUE 0x7116E TKW_VV_VV_UB 100.0 FORMULA_0003 0.0 255.0000 /end CHARACTERISTIC
/begin CHARACTERISTIC K_ED_RLSLP.INC_VOR_EINTRAG "Filtererhoehung vorm Fehlerspeichereintrag | EN: Fault code RLSLP - debounce filter increment before fault-memory entry" VALUE 0x71188 TKW_VV_VV_UB 100.0 FORMULA_0003 0.0 255.0000 /end CHARACTERISTIC
/begin CHARACTERISTIC K_ED_SLV.INC_VOR_EINTRAG "Filtererhoehung vorm Fehlerspeichereintrag | EN: Fault code SLV - debounce filter increment before fault-memory entry" VALUE 0x711A2 TKW_VV_VV_UB 100.0 FORMULA_0003 0.0 255.0000 /end CHARACTERISTIC
/begin CHARACTERISTIC K_ED_VAN_DSV.INC_VOR_EINTRAG "Filtererhoehung vorm Fehlerspeichereintrag | EN: Fault code VAN_DSV - debounce filter increment before fault-memory entry" VALUE 0x71272 TKW_VV_VV_UB 100.0 FORMULA_0003 0.0 255.0000 /end CHARACTERISTIC
/begin CHARACTERISTIC K_ED_SK_MANAGER_INJ.INC_VOR_EINTRAG "Filtererhoehung vorm Fehlerspeichereintrag | EN: Fault code SK_MANAGER_INJ - debounce filter increment before fault-memory entry" VALUE 0x71390 TKW_VV_VV_UB 100.0 FORMULA_0003 0.0 255.0000 /end CHARACTERISTIC
/begin CHARACTERISTIC K_ED_SSP_DIAG.INC_VOR_EINTRAG "Filtererhoehung vorm Fehlerspeichereintrag" VALUE 0x713AA TKW_VV_VV_UB 100.0 FORMULA_0003 0.0 255.0000 /end CHARACTERISTIC
/begin CHARACTERISTIC K_ED_SG_INJ.INC_VOR_EINTRAG "Filtererhoehung vorm Fehlerspeichereintrag | EN: Fault code SG_INJ - debounce filter increment before fault-memory entry" VALUE 0x71494 TKW_VV_VV_UB 100.0 FORMULA_0003 0.0 255.0000 /end CHARACTERISTIC
/begin CHARACTERISTIC K_ED_S_POEL_DIAG.INC_VOR_EINTRAG "Filtererhoehung vorm Fehlerspeichereintrag | EN: Fault code S_POEL_DIAG - debounce filter increment before fault-memory entry" VALUE 0x714E2 TKW_VV_VV_UB 100.0 FORMULA_0003 0.0 255.0000 /end CHARACTERISTIC
/begin CHARACTERISTIC K_ED_TE_OBD_1.INC_VOR_EINTRAG "Filtererhoehung vorm Fehlerspeichereintrag | EN: Fault code TE_OBD_1 - debounce filter increment before fault-memory entry" VALUE 0x714FC TKW_VV_VV_UB 100.0 FORMULA_0003 0.0 255.0000 /end CHARACTERISTIC
/begin CHARACTERISTIC K_ED_TE_OBD_2.INC_VOR_EINTRAG "Filtererhoehung vorm Fehlerspeichereintrag | EN: Fault code TE_OBD_2 - debounce filter increment before fault-memory entry" VALUE 0x71516 TKW_VV_VV_UB 100.0 FORMULA_0003 0.0 255.0000 /end CHARACTERISTIC
/begin CHARACTERISTIC K_ED_TEV1.INC_VOR_EINTRAG "Filtererhoehung vorm Fehlerspeichereintrag | EN: Fault code TEV1 - debounce filter increment before fault-memory entry" VALUE 0x71530 TKW_VV_VV_UB 100.0 FORMULA_0003 0.0 255.0000 /end CHARACTERISTIC
/begin CHARACTERISTIC K_ED_TEV2.INC_VOR_EINTRAG "Filtererhoehung vorm Fehlerspeichereintrag | EN: Fault code TEV2 - debounce filter increment before fault-memory entry" VALUE 0x7154A TKW_VV_VV_UB 100.0 FORMULA_0003 0.0 255.0000 /end CHARACTERISTIC
/begin CHARACTERISTIC K_ED_SLP.INC_VOR_EINTRAG "Filtererhoehung vorm Fehlerspeichereintrag | EN: Fault code SLP - debounce filter increment before fault-memory entry" VALUE 0x7161A TKW_VV_VV_UB 100.0 FORMULA_0003 0.0 255.0000 /end CHARACTERISTIC
/begin CHARACTERISTIC K_ED_SL_DURCHS_B1.INC_VOR_EINTRAG "Filtererhoehung vorm Fehlerspeichereintrag | EN: Fault code SL_DURCHS_B1 - debounce filter increment before fault-memory entry" VALUE 0x71634 TKW_VV_VV_UB 100.0 FORMULA_0003 0.0 255.0000 /end CHARACTERISTIC
/begin CHARACTERISTIC K_ED_SL_DURCHS_B2.INC_VOR_EINTRAG "Filtererhoehung vorm Fehlerspeichereintrag | EN: Fault code SL_DURCHS_B2 - debounce filter increment before fault-memory entry" VALUE 0x7164E TKW_VV_VV_UB 100.0 FORMULA_0003 0.0 255.0000 /end CHARACTERISTIC
/begin CHARACTERISTIC K_ED_SL_DURCHS_HSTRANG.INC_VOR_EINTRAG "Filtererhoehung vorm Fehlerspeichereintrag | EN: Fault code SL_DURCHS_HSTRANG - debounce filter increment before fault-memory entry" VALUE 0x71668 TKW_VV_VV_UB 100.0 FORMULA_0003 0.0 255.0000 /end CHARACTERISTIC
/begin CHARACTERISTIC K_ED_S_GETR_HS.INC_VOR_EINTRAG "Filtererhoehung vorm Fehlerspeichereintrag | EN: Fault code S_GETR_HS - debounce filter increment before fault-memory entry" VALUE 0x7169C TKW_VV_VV_UB 100.0 FORMULA_0003 0.0 255.0000 /end CHARACTERISTIC
/begin CHARACTERISTIC K_ED_S_KUPP_HS.INC_VOR_EINTRAG "Filtererhoehung vorm Fehlerspeichereintrag | EN: Fault code S_KUPP_HS - debounce filter increment before fault-memory entry" VALUE 0x716B6 TKW_VV_VV_UB 100.0 FORMULA_0003 0.0 255.0000 /end CHARACTERISTIC
/begin CHARACTERISTIC K_ED_VAN_DRUCK.INC_VOR_EINTRAG "Filtererhoehung vorm Fehlerspeichereintrag | EN: Fault code VAN_DRUCK - debounce filter increment before fault-memory entry" VALUE 0x716D0 TKW_VV_VV_UB 100.0 FORMULA_0003 0.0 255.0000 /end CHARACTERISTIC
/begin CHARACTERISTIC K_ED_PT_STATANH.INC_VOR_EINTRAG "Filtererhoehung vorm Fehlerspeichereintrag | EN: Fault code PT_STATANH - debounce filter increment before fault-memory entry" VALUE 0x7171E TKW_VV_VV_UB 100.0 FORMULA_0003 0.0 255.0000 /end CHARACTERISTIC
/begin CHARACTERISTIC K_ED_PT_STATGRB.INC_VOR_EINTRAG "Filtererhoehung vorm Fehlerspeichereintrag" VALUE 0x717A0 TKW_VV_VV_UB 100.0 FORMULA_0003 0.0 255.0000 /end CHARACTERISTIC
/begin CHARACTERISTIC K_ED_TANK_LEER.INC_VOR_EINTRAG "Filtererhoehung vorm Fehlerspeichereintrag | EN: Fault code TANK_LEER - debounce filter increment before fault-memory entry" VALUE 0x717EE TKW_VV_VV_UB 100.0 FORMULA_0003 0.0 255.0000 /end CHARACTERISTIC
/begin CHARACTERISTIC K_ED_PT_TOMA.INC_VOR_EINTRAG "Filtererhoehung vorm Fehlerspeichereintrag | EN: Fault code PT_TOMA - debounce filter increment before fault-memory entry" VALUE 0x71808 TKW_VV_VV_UB 100.0 FORMULA_0003 0.0 255.0000 /end CHARACTERISTIC
/begin CHARACTERISTIC K_ED_PUMG_OBD.INC_VOR_EINTRAG "Filtererhoehung vorm Fehlerspeichereintrag | EN: Fault code PUMG_OBD - debounce filter increment before fault-memory entry" VALUE 0x7183C TKW_VV_VV_UB 100.0 FORMULA_0003 0.0 255.0000 /end CHARACTERISTIC
/begin CHARACTERISTIC K_ED_SL_ML_HFM_OBD.INC_VOR_EINTRAG "Filtererhoehung vorm Fehlerspeichereintrag | EN: Fault code SL_ML_HFM_OBD - debounce filter increment before fault-memory entry" VALUE 0x71856 TKW_VV_VV_UB 100.0 FORMULA_0003 0.0 255.0000 /end CHARACTERISTIC
/begin CHARACTERISTIC K_ED_TGETR_HS.INC_VOR_EINTRAG "Filtererhoehung vorm Fehlerspeichereintrag | EN: Fault code TGETR_HS - debounce filter increment before fault-memory entry" VALUE 0x7198E TKW_VV_VV_UB 100.0 FORMULA_0003 0.0 255.0000 /end CHARACTERISTIC
/begin CHARACTERISTIC K_ED_PT_OBD_ED.INC_VOR_EINTRAG "Filtererhoehung vorm Fehlerspeichereintrag" VALUE 0x719DC TKW_VV_VV_UB 100.0 FORMULA_0003 0.0 255.0000 /end CHARACTERISTIC
/begin CHARACTERISTIC K_ED_SK_TR_INJ.DEC_VOR_EINTRAG "Filterverringerung vorm Fehlerspeichereintrag | EN: Filterverringerung vorm Fehlerspeichereintrag" VALUE 0x705F5 TKW_VV_VV_UB 100.0 FORMULA_0003 0.0 255.0000 /end CHARACTERISTIC
/begin CHARACTERISTIC K_ED_PUMG.DEC_VOR_EINTRAG "Filterverringerung vorm Fehlerspeichereintrag | EN: Fault code PUMG - debounce filter decrement before fault-memory entry" VALUE 0x7060F TKW_VV_VV_UB 100.0 FORMULA_0003 0.0 255.0000 /end CHARACTERISTIC
/begin CHARACTERISTIC K_ED_VAN_HALL_E1.DEC_VOR_EINTRAG "Filterverringerung vorm Fehlerspeichereintrag | EN: Fault code VAN_HALL_E1 - debounce filter decrement before fault-memory entry" VALUE 0x70691 TKW_VV_VV_UB 100.0 FORMULA_0003 0.0 255.0000 /end CHARACTERISTIC
/begin CHARACTERISTIC K_ED_VAN_HALL_A1.DEC_VOR_EINTRAG "Filterverringerung vorm Fehlerspeichereintrag | EN: Fault code VAN_HALL_A1 - debounce filter decrement before fault-memory entry" VALUE 0x706AB TKW_VV_VV_UB 100.0 FORMULA_0003 0.0 255.0000 /end CHARACTERISTIC
/begin CHARACTERISTIC K_ED_VAN_HALL_E2.DEC_VOR_EINTRAG "Filterverringerung vorm Fehlerspeichereintrag | EN: Fault code VAN_HALL_E2 - debounce filter decrement before fault-memory entry" VALUE 0x706C5 TKW_VV_VV_UB 100.0 FORMULA_0003 0.0 255.0000 /end CHARACTERISTIC
/begin CHARACTERISTIC K_ED_VAN_HALL_A2.DEC_VOR_EINTRAG "Filterverringerung vorm Fehlerspeichereintrag | EN: Fault code VAN_HALL_A2 - debounce filter decrement before fault-memory entry" VALUE 0x706DF TKW_VV_VV_UB 100.0 FORMULA_0003 0.0 255.0000 /end CHARACTERISTIC
/begin CHARACTERISTIC K_ED_VAN_REGL_E1.DEC_VOR_EINTRAG "Filterverringerung vorm Fehlerspeichereintrag | EN: Fault code VAN_REGL_E1 - debounce filter decrement before fault-memory entry" VALUE 0x706F9 TKW_VV_VV_UB 100.0 FORMULA_0003 0.0 255.0000 /end CHARACTERISTIC
/begin CHARACTERISTIC K_ED_VAN_REGL_A1.DEC_VOR_EINTRAG "Filterverringerung vorm Fehlerspeichereintrag | EN: Fault code VAN_REGL_A1 - debounce filter decrement before fault-memory entry" VALUE 0x70713 TKW_VV_VV_UB 100.0 FORMULA_0003 0.0 255.0000 /end CHARACTERISTIC
/begin CHARACTERISTIC K_ED_VAN_REGL_E2.DEC_VOR_EINTRAG "Filterverringerung vorm Fehlerspeichereintrag | EN: Fault code VAN_REGL_E2 - debounce filter decrement before fault-memory entry" VALUE 0x7072D TKW_VV_VV_UB 100.0 FORMULA_0003 0.0 255.0000 /end CHARACTERISTIC
/begin CHARACTERISTIC K_ED_VAN_REGL_A2.DEC_VOR_EINTRAG "Filterverringerung vorm Fehlerspeichereintrag | EN: Fault code VAN_REGL_A2 - debounce filter decrement before fault-memory entry" VALUE 0x70747 TKW_VV_VV_UB 100.0 FORMULA_0003 0.0 255.0000 /end CHARACTERISTIC
/begin CHARACTERISTIC K_ED_PT_STATDKG.DEC_VOR_EINTRAG "Filterverringerung vorm Fehlerspeichereintrag | EN: Fault code PT_STATDKG - debounce filter decrement before fault-memory entry" VALUE 0x707AF TKW_VV_VV_UB 100.0 FORMULA_0003 0.0 255.0000 /end CHARACTERISTIC
/begin CHARACTERISTIC K_ED_PT_STATR.DEC_VOR_EINTRAG "Filterverringerung vorm Fehlerspeichereintrag | EN: Fault code PT_STATR - debounce filter decrement before fault-memory entry" VALUE 0x707E3 TKW_VV_VV_UB 100.0 FORMULA_0003 0.0 255.0000 /end CHARACTERISTIC
/begin CHARACTERISTIC K_ED_PT_TORQDSC.DEC_VOR_EINTRAG "Filterverringerung vorm Fehlerspeichereintrag | EN: Fault code PT_TORQDSC - debounce filter decrement before fault-memory entry" VALUE 0x7091B TKW_VV_VV_UB 100.0 FORMULA_0003 0.0 255.0000 /end CHARACTERISTIC
/begin CHARACTERISTIC K_ED_PT_STDSC.DEC_VOR_EINTRAG "Filterverringerung vorm Fehlerspeichereintrag | EN: Fault code PT_STDSC - debounce filter decrement before fault-memory entry" VALUE 0x70935 TKW_VV_VV_UB 100.0 FORMULA_0003 0.0 255.0000 /end CHARACTERISTIC
/begin CHARACTERISTIC K_ED_PT_VRAD.DEC_VOR_EINTRAG "Filterverringerung vorm Fehlerspeichereintrag | EN: Fault code PT_VRAD - debounce filter decrement before fault-memory entry" VALUE 0x7094F TKW_VV_VV_UB 100.0 FORMULA_0003 0.0 255.0000 /end CHARACTERISTIC
/begin CHARACTERISTIC K_ED_PT_VFZG.DEC_VOR_EINTRAG "Filterverringerung vorm Fehlerspeichereintrag | EN: Fault code PT_VFZG - debounce filter decrement before fault-memory entry" VALUE 0x70969 TKW_VV_VV_UB 100.0 FORMULA_0003 0.0 255.0000 /end CHARACTERISTIC
/begin CHARACTERISTIC K_ED_SL_ML_HFM.DEC_VOR_EINTRAG "Filterverringerung vorm Fehlerspeichereintrag | EN: Fault code SL_ML_HFM - debounce filter decrement before fault-memory entry" VALUE 0x70A1F TKW_VV_VV_UB 100.0 FORMULA_0003 0.0 255.0000 /end CHARACTERISTIC
/begin CHARACTERISTIC K_ED_TZ1.DEC_VOR_EINTRAG "Filterverringerung vorm Fehlerspeichereintrag | EN: Fault code TZ1 - debounce filter decrement before fault-memory entry" VALUE 0x70CC3 TKW_VV_VV_UB 100.0 FORMULA_0003 0.0 255.0000 /end CHARACTERISTIC
/begin CHARACTERISTIC K_ED_TZ2.DEC_VOR_EINTRAG "Filterverringerung vorm Fehlerspeichereintrag | EN: Fault code TZ2 - debounce filter decrement before fault-memory entry" VALUE 0x70CDD TKW_VV_VV_UB 100.0 FORMULA_0003 0.0 255.0000 /end CHARACTERISTIC
/begin CHARACTERISTIC K_ED_TZ3.DEC_VOR_EINTRAG "Filterverringerung vorm Fehlerspeichereintrag | EN: Fault code TZ3 - debounce filter decrement before fault-memory entry" VALUE 0x70CF7 TKW_VV_VV_UB 100.0 FORMULA_0003 0.0 255.0000 /end CHARACTERISTIC
/begin CHARACTERISTIC K_ED_TZ4.DEC_VOR_EINTRAG "Filterverringerung vorm Fehlerspeichereintrag | EN: Fault code TZ4 - debounce filter decrement before fault-memory entry" VALUE 0x70D11 TKW_VV_VV_UB 100.0 FORMULA_0003 0.0 255.0000 /end CHARACTERISTIC
/begin CHARACTERISTIC K_ED_TZ5.DEC_VOR_EINTRAG "Filterverringerung vorm Fehlerspeichereintrag | EN: Fault code TZ5 - debounce filter decrement before fault-memory entry" VALUE 0x70D2B TKW_VV_VV_UB 100.0 FORMULA_0003 0.0 255.0000 /end CHARACTERISTIC
/begin CHARACTERISTIC K_ED_TZ6.DEC_VOR_EINTRAG "Filterverringerung vorm Fehlerspeichereintrag | EN: Fault code TZ6 - debounce filter decrement before fault-memory entry" VALUE 0x70D45 TKW_VV_VV_UB 100.0 FORMULA_0003 0.0 255.0000 /end CHARACTERISTIC
/begin CHARACTERISTIC K_ED_TZ7.DEC_VOR_EINTRAG "Filterverringerung vorm Fehlerspeichereintrag | EN: Fault code TZ7 - debounce filter decrement before fault-memory entry" VALUE 0x70D5F TKW_VV_VV_UB 100.0 FORMULA_0003 0.0 255.0000 /end CHARACTERISTIC
/begin CHARACTERISTIC K_ED_TZ8.DEC_VOR_EINTRAG "Filterverringerung vorm Fehlerspeichereintrag | EN: Fault code TZ8 - debounce filter decrement before fault-memory entry" VALUE 0x70D79 TKW_VV_VV_UB 100.0 FORMULA_0003 0.0 255.0000 /end CHARACTERISTIC
/begin CHARACTERISTIC K_ED_TZ9.DEC_VOR_EINTRAG "Filterverringerung vorm Fehlerspeichereintrag | EN: Fault code TZ9 - debounce filter decrement before fault-memory entry" VALUE 0x70D93 TKW_VV_VV_UB 100.0 FORMULA_0003 0.0 255.0000 /end CHARACTERISTIC
/begin CHARACTERISTIC K_ED_TZ10.DEC_VOR_EINTRAG "Filterverringerung vorm Fehlerspeichereintrag | EN: Fault code TZ10 - debounce filter decrement before fault-memory entry" VALUE 0x70DAD TKW_VV_VV_UB 100.0 FORMULA_0003 0.0 255.0000 /end CHARACTERISTIC
/begin CHARACTERISTIC K_ED_VAN_ANSCHL_E1.DEC_VOR_EINTRAG "Filterverringerung vorm Fehlerspeichereintrag | EN: Fault code VAN_ANSCHL_E1 - debounce filter decrement before fault-memory entry" VALUE 0x70DFB TKW_VV_VV_UB 100.0 FORMULA_0003 0.0 255.0000 /end CHARACTERISTIC
/begin CHARACTERISTIC K_ED_VAN_ANSCHL_A1.DEC_VOR_EINTRAG "Filterverringerung vorm Fehlerspeichereintrag | EN: Fault code VAN_ANSCHL_A1 - debounce filter decrement before fault-memory entry" VALUE 0x70E15 TKW_VV_VV_UB 100.0 FORMULA_0003 0.0 255.0000 /end CHARACTERISTIC
/begin CHARACTERISTIC K_ED_VAN_ANSCHL_E2.DEC_VOR_EINTRAG "Filterverringerung vorm Fehlerspeichereintrag | EN: Fault code VAN_ANSCHL_E2 - debounce filter decrement before fault-memory entry" VALUE 0x70E2F TKW_VV_VV_UB 100.0 FORMULA_0003 0.0 255.0000 /end CHARACTERISTIC
/begin CHARACTERISTIC K_ED_VAN_ANSCHL_A2.DEC_VOR_EINTRAG "Filterverringerung vorm Fehlerspeichereintrag | EN: Fault code VAN_ANSCHL_A2 - debounce filter decrement before fault-memory entry" VALUE 0x70E49 TKW_VV_VV_UB 100.0 FORMULA_0003 0.0 255.0000 /end CHARACTERISTIC
/begin CHARACTERISTIC K_ED_VAN_VENT_A1.DEC_VOR_EINTRAG "Filterverringerung vorm Fehlerspeichereintrag | EN: Fault code VAN_VENT_A1 - debounce filter decrement before fault-memory entry" VALUE 0x70E7D TKW_VV_VV_UB 100.0 FORMULA_0003 0.0 255.0000 /end CHARACTERISTIC
/begin CHARACTERISTIC K_ED_PT_VEHMOD.DEC_VOR_EINTRAG "Filterverringerung vorm Fehlerspeichereintrag | EN: Fault code PT_VEHMOD - debounce filter decrement before fault-memory entry" VALUE 0x7101D TKW_VV_VV_UB 100.0 FORMULA_0003 0.0 255.0000 /end CHARACTERISTIC
/begin CHARACTERISTIC K_ED_RLU87.DEC_VOR_EINTRAG "Filterverringerung vorm Fehlerspeichereintrag | EN: Fault code RLU87 - debounce filter decrement before fault-memory entry" VALUE 0x71121 TKW_VV_VV_UB 100.0 FORMULA_0003 0.0 255.0000 /end CHARACTERISTIC
/begin CHARACTERISTIC K_ED_SSP.DEC_VOR_EINTRAG "Filterverringerung vorm Fehlerspeichereintrag" VALUE 0x71155 TKW_VV_VV_UB 100.0 FORMULA_0003 0.0 255.0000 /end CHARACTERISTIC
/begin CHARACTERISTIC K_ED_TD.DEC_VOR_EINTRAG "Filterverringerung vorm Fehlerspeichereintrag | EN: Fault code TD - debounce filter decrement before fault-memory entry" VALUE 0x7116F TKW_VV_VV_UB 100.0 FORMULA_0003 0.0 255.0000 /end CHARACTERISTIC
/begin CHARACTERISTIC K_ED_RLSLP.DEC_VOR_EINTRAG "Filterverringerung vorm Fehlerspeichereintrag | EN: Fault code RLSLP - debounce filter decrement before fault-memory entry" VALUE 0x71189 TKW_VV_VV_UB 100.0 FORMULA_0003 0.0 255.0000 /end CHARACTERISTIC
/begin CHARACTERISTIC K_ED_SLV.DEC_VOR_EINTRAG "Filterverringerung vorm Fehlerspeichereintrag | EN: Fault code SLV - debounce filter decrement before fault-memory entry" VALUE 0x711A3 TKW_VV_VV_UB 100.0 FORMULA_0003 0.0 255.0000 /end CHARACTERISTIC
/begin CHARACTERISTIC K_ED_VAN_DSV.DEC_VOR_EINTRAG "Filterverringerung vorm Fehlerspeichereintrag | EN: Fault code VAN_DSV - debounce filter decrement before fault-memory entry" VALUE 0x71273 TKW_VV_VV_UB 100.0 FORMULA_0003 0.0 255.0000 /end CHARACTERISTIC
/begin CHARACTERISTIC K_ED_SK_MANAGER_INJ.DEC_VOR_EINTRAG "Filterverringerung vorm Fehlerspeichereintrag | EN: Fault code SK_MANAGER_INJ - debounce filter decrement before fault-memory entry" VALUE 0x71391 TKW_VV_VV_UB 100.0 FORMULA_0003 0.0 255.0000 /end CHARACTERISTIC
/begin CHARACTERISTIC K_ED_SSP_DIAG.DEC_VOR_EINTRAG "Filterverringerung vorm Fehlerspeichereintrag" VALUE 0x713AB TKW_VV_VV_UB 100.0 FORMULA_0003 0.0 255.0000 /end CHARACTERISTIC
/begin CHARACTERISTIC K_ED_SG_INJ.DEC_VOR_EINTRAG "Filterverringerung vorm Fehlerspeichereintrag | EN: Fault code SG_INJ - debounce filter decrement before fault-memory entry" VALUE 0x71495 TKW_VV_VV_UB 100.0 FORMULA_0003 0.0 255.0000 /end CHARACTERISTIC
/begin CHARACTERISTIC K_ED_S_POEL_DIAG.DEC_VOR_EINTRAG "Filterverringerung vorm Fehlerspeichereintrag | EN: Fault code S_POEL_DIAG - debounce filter decrement before fault-memory entry" VALUE 0x714E3 TKW_VV_VV_UB 100.0 FORMULA_0003 0.0 255.0000 /end CHARACTERISTIC
/begin CHARACTERISTIC K_ED_TE_OBD_1.DEC_VOR_EINTRAG "Filterverringerung vorm Fehlerspeichereintrag | EN: Fault code TE_OBD_1 - debounce filter decrement before fault-memory entry" VALUE 0x714FD TKW_VV_VV_UB 100.0 FORMULA_0003 0.0 255.0000 /end CHARACTERISTIC
/begin CHARACTERISTIC K_ED_TE_OBD_2.DEC_VOR_EINTRAG "Filterverringerung vorm Fehlerspeichereintrag | EN: Fault code TE_OBD_2 - debounce filter decrement before fault-memory entry" VALUE 0x71517 TKW_VV_VV_UB 100.0 FORMULA_0003 0.0 255.0000 /end CHARACTERISTIC
/begin CHARACTERISTIC K_ED_TEV1.DEC_VOR_EINTRAG "Filterverringerung vorm Fehlerspeichereintrag | EN: Fault code TEV1 - debounce filter decrement before fault-memory entry" VALUE 0x71531 TKW_VV_VV_UB 100.0 FORMULA_0003 0.0 255.0000 /end CHARACTERISTIC
/begin CHARACTERISTIC K_ED_TEV2.DEC_VOR_EINTRAG "Filterverringerung vorm Fehlerspeichereintrag | EN: Fault code TEV2 - debounce filter decrement before fault-memory entry" VALUE 0x7154B TKW_VV_VV_UB 100.0 FORMULA_0003 0.0 255.0000 /end CHARACTERISTIC
/begin CHARACTERISTIC K_ED_SLP.DEC_VOR_EINTRAG "Filterverringerung vorm Fehlerspeichereintrag | EN: Fault code SLP - debounce filter decrement before fault-memory entry" VALUE 0x7161B TKW_VV_VV_UB 100.0 FORMULA_0003 0.0 255.0000 /end CHARACTERISTIC
/begin CHARACTERISTIC K_ED_SL_DURCHS_B1.DEC_VOR_EINTRAG "Filterverringerung vorm Fehlerspeichereintrag | EN: Fault code SL_DURCHS_B1 - debounce filter decrement before fault-memory entry" VALUE 0x71635 TKW_VV_VV_UB 100.0 FORMULA_0003 0.0 255.0000 /end CHARACTERISTIC
/begin CHARACTERISTIC K_ED_SL_DURCHS_B2.DEC_VOR_EINTRAG "Filterverringerung vorm Fehlerspeichereintrag | EN: Fault code SL_DURCHS_B2 - debounce filter decrement before fault-memory entry" VALUE 0x7164F TKW_VV_VV_UB 100.0 FORMULA_0003 0.0 255.0000 /end CHARACTERISTIC
/begin CHARACTERISTIC K_ED_SL_DURCHS_HSTRANG.DEC_VOR_EINTRAG "Filterverringerung vorm Fehlerspeichereintrag | EN: Fault code SL_DURCHS_HSTRANG - debounce filter decrement before fault-memory entry" VALUE 0x71669 TKW_VV_VV_UB 100.0 FORMULA_0003 0.0 255.0000 /end CHARACTERISTIC
/begin CHARACTERISTIC K_ED_S_GETR_HS.DEC_VOR_EINTRAG "Filterverringerung vorm Fehlerspeichereintrag | EN: Fault code S_GETR_HS - debounce filter decrement before fault-memory entry" VALUE 0x7169D TKW_VV_VV_UB 100.0 FORMULA_0003 0.0 255.0000 /end CHARACTERISTIC
/begin CHARACTERISTIC K_ED_S_KUPP_HS.DEC_VOR_EINTRAG "Filterverringerung vorm Fehlerspeichereintrag | EN: Fault code S_KUPP_HS - debounce filter decrement before fault-memory entry" VALUE 0x716B7 TKW_VV_VV_UB 100.0 FORMULA_0003 0.0 255.0000 /end CHARACTERISTIC
/begin CHARACTERISTIC K_ED_VAN_DRUCK.DEC_VOR_EINTRAG "Filterverringerung vorm Fehlerspeichereintrag | EN: Fault code VAN_DRUCK - debounce filter decrement before fault-memory entry" VALUE 0x716D1 TKW_VV_VV_UB 100.0 FORMULA_0003 0.0 255.0000 /end CHARACTERISTIC
/begin CHARACTERISTIC K_ED_PT_STATANH.DEC_VOR_EINTRAG "Filterverringerung vorm Fehlerspeichereintrag | EN: Fault code PT_STATANH - debounce filter decrement before fault-memory entry" VALUE 0x7171F TKW_VV_VV_UB 100.0 FORMULA_0003 0.0 255.0000 /end CHARACTERISTIC
/begin CHARACTERISTIC K_ED_PT_STATGRB.DEC_VOR_EINTRAG "Filterverringerung vorm Fehlerspeichereintrag" VALUE 0x717A1 TKW_VV_VV_UB 100.0 FORMULA_0003 0.0 255.0000 /end CHARACTERISTIC
/begin CHARACTERISTIC K_ED_TANK_LEER.DEC_VOR_EINTRAG "Filterverringerung vorm Fehlerspeichereintrag | EN: Fault code TANK_LEER - debounce filter decrement before fault-memory entry" VALUE 0x717EF TKW_VV_VV_UB 100.0 FORMULA_0003 0.0 255.0000 /end CHARACTERISTIC
/begin CHARACTERISTIC K_ED_PT_TOMA.DEC_VOR_EINTRAG "Filterverringerung vorm Fehlerspeichereintrag | EN: Fault code PT_TOMA - debounce filter decrement before fault-memory entry" VALUE 0x71809 TKW_VV_VV_UB 100.0 FORMULA_0003 0.0 255.0000 /end CHARACTERISTIC
/begin CHARACTERISTIC K_ED_PUMG_OBD.DEC_VOR_EINTRAG "Filterverringerung vorm Fehlerspeichereintrag | EN: Fault code PUMG_OBD - debounce filter decrement before fault-memory entry" VALUE 0x7183D TKW_VV_VV_UB 100.0 FORMULA_0003 0.0 255.0000 /end CHARACTERISTIC
/begin CHARACTERISTIC K_ED_SL_ML_HFM_OBD.DEC_VOR_EINTRAG "Filterverringerung vorm Fehlerspeichereintrag | EN: Fault code SL_ML_HFM_OBD - debounce filter decrement before fault-memory entry" VALUE 0x71857 TKW_VV_VV_UB 100.0 FORMULA_0003 0.0 255.0000 /end CHARACTERISTIC
/begin CHARACTERISTIC K_ED_TGETR_HS.DEC_VOR_EINTRAG "Filterverringerung vorm Fehlerspeichereintrag | EN: Fault code TGETR_HS - debounce filter decrement before fault-memory entry" VALUE 0x7198F TKW_VV_VV_UB 100.0 FORMULA_0003 0.0 255.0000 /end CHARACTERISTIC
/begin CHARACTERISTIC K_ED_PT_OBD_ED.DEC_VOR_EINTRAG "Filterverringerung vorm Fehlerspeichereintrag" VALUE 0x719DD TKW_VV_VV_UB 100.0 FORMULA_0003 0.0 255.0000 /end CHARACTERISTIC
/begin CHARACTERISTIC K_ED_SK_TR_INJ.INC_NACH_EINTRAG "Filtererhoehung nach Fehlerspeichereintrag | EN: Filtererhoehung nach Fehlerspeichereintrag" VALUE 0x705F6 TKW_VV_VV_UB 100.0 FORMULA_0003 0.0 255.0000 /end CHARACTERISTIC
/begin CHARACTERISTIC K_ED_PUMG.INC_NACH_EINTRAG "Filtererhoehung nach Fehlerspeichereintrag | EN: Fault code PUMG - debounce filter increment after fault-memory entry" VALUE 0x70610 TKW_VV_VV_UB 100.0 FORMULA_0003 0.0 255.0000 /end CHARACTERISTIC
/begin CHARACTERISTIC K_ED_VAN_HALL_E1.INC_NACH_EINTRAG "Filtererhoehung nach Fehlerspeichereintrag | EN: Fault code VAN_HALL_E1 - debounce filter increment after fault-memory entry" VALUE 0x70692 TKW_VV_VV_UB 100.0 FORMULA_0003 0.0 255.0000 /end CHARACTERISTIC
/begin CHARACTERISTIC K_ED_VAN_HALL_A1.INC_NACH_EINTRAG "Filtererhoehung nach Fehlerspeichereintrag | EN: Fault code VAN_HALL_A1 - debounce filter increment after fault-memory entry" VALUE 0x706AC TKW_VV_VV_UB 100.0 FORMULA_0003 0.0 255.0000 /end CHARACTERISTIC
/begin CHARACTERISTIC K_ED_VAN_HALL_E2.INC_NACH_EINTRAG "Filtererhoehung nach Fehlerspeichereintrag | EN: Fault code VAN_HALL_E2 - debounce filter increment after fault-memory entry" VALUE 0x706C6 TKW_VV_VV_UB 100.0 FORMULA_0003 0.0 255.0000 /end CHARACTERISTIC
/begin CHARACTERISTIC K_ED_VAN_HALL_A2.INC_NACH_EINTRAG "Filtererhoehung nach Fehlerspeichereintrag | EN: Fault code VAN_HALL_A2 - debounce filter increment after fault-memory entry" VALUE 0x706E0 TKW_VV_VV_UB 100.0 FORMULA_0003 0.0 255.0000 /end CHARACTERISTIC
/begin CHARACTERISTIC K_ED_VAN_REGL_E1.INC_NACH_EINTRAG "Filtererhoehung nach Fehlerspeichereintrag | EN: Fault code VAN_REGL_E1 - debounce filter increment after fault-memory entry" VALUE 0x706FA TKW_VV_VV_UB 100.0 FORMULA_0003 0.0 255.0000 /end CHARACTERISTIC
/begin CHARACTERISTIC K_ED_VAN_REGL_A1.INC_NACH_EINTRAG "Filtererhoehung nach Fehlerspeichereintrag | EN: Fault code VAN_REGL_A1 - debounce filter increment after fault-memory entry" VALUE 0x70714 TKW_VV_VV_UB 100.0 FORMULA_0003 0.0 255.0000 /end CHARACTERISTIC
/begin CHARACTERISTIC K_ED_VAN_REGL_E2.INC_NACH_EINTRAG "Filtererhoehung nach Fehlerspeichereintrag | EN: Fault code VAN_REGL_E2 - debounce filter increment after fault-memory entry" VALUE 0x7072E TKW_VV_VV_UB 100.0 FORMULA_0003 0.0 255.0000 /end CHARACTERISTIC
/begin CHARACTERISTIC K_ED_VAN_REGL_A2.INC_NACH_EINTRAG "Filtererhoehung nach Fehlerspeichereintrag | EN: Fault code VAN_REGL_A2 - debounce filter increment after fault-memory entry" VALUE 0x70748 TKW_VV_VV_UB 100.0 FORMULA_0003 0.0 255.0000 /end CHARACTERISTIC
/begin CHARACTERISTIC K_ED_PT_STATDKG.INC_NACH_EINTRAG "Filtererhoehung nach Fehlerspeichereintrag | EN: Fault code PT_STATDKG - debounce filter increment after fault-memory entry" VALUE 0x707B0 TKW_VV_VV_UB 100.0 FORMULA_0003 0.0 255.0000 /end CHARACTERISTIC
/begin CHARACTERISTIC K_ED_PT_STATR.INC_NACH_EINTRAG "Filtererhoehung nach Fehlerspeichereintrag | EN: Fault code PT_STATR - debounce filter increment after fault-memory entry" VALUE 0x707E4 TKW_VV_VV_UB 100.0 FORMULA_0003 0.0 255.0000 /end CHARACTERISTIC
/begin CHARACTERISTIC K_ED_PT_TORQDSC.INC_NACH_EINTRAG "Filtererhoehung nach Fehlerspeichereintrag | EN: Fault code PT_TORQDSC - debounce filter increment after fault-memory entry" VALUE 0x7091C TKW_VV_VV_UB 100.0 FORMULA_0003 0.0 255.0000 /end CHARACTERISTIC
/begin CHARACTERISTIC K_ED_PT_STDSC.INC_NACH_EINTRAG "Filtererhoehung nach Fehlerspeichereintrag | EN: Fault code PT_STDSC - debounce filter increment after fault-memory entry" VALUE 0x70936 TKW_VV_VV_UB 100.0 FORMULA_0003 0.0 255.0000 /end CHARACTERISTIC
/begin CHARACTERISTIC K_ED_PT_VRAD.INC_NACH_EINTRAG "Filtererhoehung nach Fehlerspeichereintrag | EN: Fault code PT_VRAD - debounce filter increment after fault-memory entry" VALUE 0x70950 TKW_VV_VV_UB 100.0 FORMULA_0003 0.0 255.0000 /end CHARACTERISTIC
/begin CHARACTERISTIC K_ED_PT_VFZG.INC_NACH_EINTRAG "Filtererhoehung nach Fehlerspeichereintrag | EN: Fault code PT_VFZG - debounce filter increment after fault-memory entry" VALUE 0x7096A TKW_VV_VV_UB 100.0 FORMULA_0003 0.0 255.0000 /end CHARACTERISTIC
/begin CHARACTERISTIC K_ED_SL_ML_HFM.INC_NACH_EINTRAG "Filtererhoehung nach Fehlerspeichereintrag | EN: Fault code SL_ML_HFM - debounce filter increment after fault-memory entry" VALUE 0x70A20 TKW_VV_VV_UB 100.0 FORMULA_0003 0.0 255.0000 /end CHARACTERISTIC
/begin CHARACTERISTIC K_ED_TZ1.INC_NACH_EINTRAG "Filtererhoehung nach Fehlerspeichereintrag | EN: Fault code TZ1 - debounce filter increment after fault-memory entry" VALUE 0x70CC4 TKW_VV_VV_UB 100.0 FORMULA_0003 0.0 255.0000 /end CHARACTERISTIC
/begin CHARACTERISTIC K_ED_TZ2.INC_NACH_EINTRAG "Filtererhoehung nach Fehlerspeichereintrag | EN: Fault code TZ2 - debounce filter increment after fault-memory entry" VALUE 0x70CDE TKW_VV_VV_UB 100.0 FORMULA_0003 0.0 255.0000 /end CHARACTERISTIC
/begin CHARACTERISTIC K_ED_TZ3.INC_NACH_EINTRAG "Filtererhoehung nach Fehlerspeichereintrag | EN: Fault code TZ3 - debounce filter increment after fault-memory entry" VALUE 0x70CF8 TKW_VV_VV_UB 100.0 FORMULA_0003 0.0 255.0000 /end CHARACTERISTIC
/begin CHARACTERISTIC K_ED_TZ4.INC_NACH_EINTRAG "Filtererhoehung nach Fehlerspeichereintrag | EN: Fault code TZ4 - debounce filter increment after fault-memory entry" VALUE 0x70D12 TKW_VV_VV_UB 100.0 FORMULA_0003 0.0 255.0000 /end CHARACTERISTIC
/begin CHARACTERISTIC K_ED_TZ5.INC_NACH_EINTRAG "Filtererhoehung nach Fehlerspeichereintrag | EN: Fault code TZ5 - debounce filter increment after fault-memory entry" VALUE 0x70D2C TKW_VV_VV_UB 100.0 FORMULA_0003 0.0 255.0000 /end CHARACTERISTIC
/begin CHARACTERISTIC K_ED_TZ6.INC_NACH_EINTRAG "Filtererhoehung nach Fehlerspeichereintrag | EN: Fault code TZ6 - debounce filter increment after fault-memory entry" VALUE 0x70D46 TKW_VV_VV_UB 100.0 FORMULA_0003 0.0 255.0000 /end CHARACTERISTIC
/begin CHARACTERISTIC K_ED_TZ7.INC_NACH_EINTRAG "Filtererhoehung nach Fehlerspeichereintrag | EN: Fault code TZ7 - debounce filter increment after fault-memory entry" VALUE 0x70D60 TKW_VV_VV_UB 100.0 FORMULA_0003 0.0 255.0000 /end CHARACTERISTIC
/begin CHARACTERISTIC K_ED_TZ8.INC_NACH_EINTRAG "Filtererhoehung nach Fehlerspeichereintrag | EN: Fault code TZ8 - debounce filter increment after fault-memory entry" VALUE 0x70D7A TKW_VV_VV_UB 100.0 FORMULA_0003 0.0 255.0000 /end CHARACTERISTIC
/begin CHARACTERISTIC K_ED_TZ9.INC_NACH_EINTRAG "Filtererhoehung nach Fehlerspeichereintrag | EN: Fault code TZ9 - debounce filter increment after fault-memory entry" VALUE 0x70D94 TKW_VV_VV_UB 100.0 FORMULA_0003 0.0 255.0000 /end CHARACTERISTIC
/begin CHARACTERISTIC K_ED_TZ10.INC_NACH_EINTRAG "Filtererhoehung nach Fehlerspeichereintrag | EN: Fault code TZ10 - debounce filter increment after fault-memory entry" VALUE 0x70DAE TKW_VV_VV_UB 100.0 FORMULA_0003 0.0 255.0000 /end CHARACTERISTIC
/begin CHARACTERISTIC K_ED_VAN_ANSCHL_E1.INC_NACH_EINTRAG "Filtererhoehung nach Fehlerspeichereintrag | EN: Fault code VAN_ANSCHL_E1 - debounce filter increment after fault-memory entry" VALUE 0x70DFC TKW_VV_VV_UB 100.0 FORMULA_0003 0.0 255.0000 /end CHARACTERISTIC
/begin CHARACTERISTIC K_ED_VAN_ANSCHL_A1.INC_NACH_EINTRAG "Filtererhoehung nach Fehlerspeichereintrag | EN: Fault code VAN_ANSCHL_A1 - debounce filter increment after fault-memory entry" VALUE 0x70E16 TKW_VV_VV_UB 100.0 FORMULA_0003 0.0 255.0000 /end CHARACTERISTIC
/begin CHARACTERISTIC K_ED_VAN_ANSCHL_E2.INC_NACH_EINTRAG "Filtererhoehung nach Fehlerspeichereintrag | EN: Fault code VAN_ANSCHL_E2 - debounce filter increment after fault-memory entry" VALUE 0x70E30 TKW_VV_VV_UB 100.0 FORMULA_0003 0.0 255.0000 /end CHARACTERISTIC
/begin CHARACTERISTIC K_ED_VAN_ANSCHL_A2.INC_NACH_EINTRAG "Filtererhoehung nach Fehlerspeichereintrag | EN: Fault code VAN_ANSCHL_A2 - debounce filter increment after fault-memory entry" VALUE 0x70E4A TKW_VV_VV_UB 100.0 FORMULA_0003 0.0 255.0000 /end CHARACTERISTIC
/begin CHARACTERISTIC K_ED_VAN_VENT_A1.INC_NACH_EINTRAG "Filtererhoehung nach Fehlerspeichereintrag | EN: Fault code VAN_VENT_A1 - debounce filter increment after fault-memory entry" VALUE 0x70E7E TKW_VV_VV_UB 100.0 FORMULA_0003 0.0 255.0000 /end CHARACTERISTIC
/begin CHARACTERISTIC K_ED_PT_VEHMOD.INC_NACH_EINTRAG "Filtererhoehung nach Fehlerspeichereintrag | EN: Fault code PT_VEHMOD - debounce filter increment after fault-memory entry" VALUE 0x7101E TKW_VV_VV_UB 100.0 FORMULA_0003 0.0 255.0000 /end CHARACTERISTIC
/begin CHARACTERISTIC K_ED_RLU87.INC_NACH_EINTRAG "Filtererhoehung nach Fehlerspeichereintrag | EN: Fault code RLU87 - debounce filter increment after fault-memory entry" VALUE 0x71122 TKW_VV_VV_UB 100.0 FORMULA_0003 0.0 255.0000 /end CHARACTERISTIC
/begin CHARACTERISTIC K_ED_SSP.INC_NACH_EINTRAG "Filtererhoehung nach Fehlerspeichereintrag" VALUE 0x71156 TKW_VV_VV_UB 100.0 FORMULA_0003 0.0 255.0000 /end CHARACTERISTIC
/begin CHARACTERISTIC K_ED_TD.INC_NACH_EINTRAG "Filtererhoehung nach Fehlerspeichereintrag | EN: Fault code TD - debounce filter increment after fault-memory entry" VALUE 0x71170 TKW_VV_VV_UB 100.0 FORMULA_0003 0.0 255.0000 /end CHARACTERISTIC
/begin CHARACTERISTIC K_ED_RLSLP.INC_NACH_EINTRAG "Filtererhoehung nach Fehlerspeichereintrag | EN: Fault code RLSLP - debounce filter increment after fault-memory entry" VALUE 0x7118A TKW_VV_VV_UB 100.0 FORMULA_0003 0.0 255.0000 /end CHARACTERISTIC
/begin CHARACTERISTIC K_ED_SLV.INC_NACH_EINTRAG "Filtererhoehung nach Fehlerspeichereintrag | EN: Fault code SLV - debounce filter increment after fault-memory entry" VALUE 0x711A4 TKW_VV_VV_UB 100.0 FORMULA_0003 0.0 255.0000 /end CHARACTERISTIC
/begin CHARACTERISTIC K_ED_VAN_DSV.INC_NACH_EINTRAG "Filtererhoehung nach Fehlerspeichereintrag | EN: Fault code VAN_DSV - debounce filter increment after fault-memory entry" VALUE 0x71274 TKW_VV_VV_UB 100.0 FORMULA_0003 0.0 255.0000 /end CHARACTERISTIC
/begin CHARACTERISTIC K_ED_SK_MANAGER_INJ.INC_NACH_EINTRAG "Filtererhoehung nach Fehlerspeichereintrag | EN: Fault code SK_MANAGER_INJ - debounce filter increment after fault-memory entry" VALUE 0x71392 TKW_VV_VV_UB 100.0 FORMULA_0003 0.0 255.0000 /end CHARACTERISTIC
/begin CHARACTERISTIC K_ED_SSP_DIAG.INC_NACH_EINTRAG "Filtererhoehung nach Fehlerspeichereintrag" VALUE 0x713AC TKW_VV_VV_UB 100.0 FORMULA_0003 0.0 255.0000 /end CHARACTERISTIC
/begin CHARACTERISTIC K_ED_SG_INJ.INC_NACH_EINTRAG "Filtererhoehung nach Fehlerspeichereintrag | EN: Fault code SG_INJ - debounce filter increment after fault-memory entry" VALUE 0x71496 TKW_VV_VV_UB 100.0 FORMULA_0003 0.0 255.0000 /end CHARACTERISTIC
/begin CHARACTERISTIC K_ED_S_POEL_DIAG.INC_NACH_EINTRAG "Filtererhoehung nach Fehlerspeichereintrag | EN: Fault code S_POEL_DIAG - debounce filter increment after fault-memory entry" VALUE 0x714E4 TKW_VV_VV_UB 100.0 FORMULA_0003 0.0 255.0000 /end CHARACTERISTIC
/begin CHARACTERISTIC K_ED_TE_OBD_1.INC_NACH_EINTRAG "Filtererhoehung nach Fehlerspeichereintrag | EN: Fault code TE_OBD_1 - debounce filter increment after fault-memory entry" VALUE 0x714FE TKW_VV_VV_UB 100.0 FORMULA_0003 0.0 255.0000 /end CHARACTERISTIC
/begin CHARACTERISTIC K_ED_TE_OBD_2.INC_NACH_EINTRAG "Filtererhoehung nach Fehlerspeichereintrag | EN: Fault code TE_OBD_2 - debounce filter increment after fault-memory entry" VALUE 0x71518 TKW_VV_VV_UB 100.0 FORMULA_0003 0.0 255.0000 /end CHARACTERISTIC
/begin CHARACTERISTIC K_ED_TEV1.INC_NACH_EINTRAG "Filtererhoehung nach Fehlerspeichereintrag | EN: Fault code TEV1 - debounce filter increment after fault-memory entry" VALUE 0x71532 TKW_VV_VV_UB 100.0 FORMULA_0003 0.0 255.0000 /end CHARACTERISTIC
/begin CHARACTERISTIC K_ED_TEV2.INC_NACH_EINTRAG "Filtererhoehung nach Fehlerspeichereintrag | EN: Fault code TEV2 - debounce filter increment after fault-memory entry" VALUE 0x7154C TKW_VV_VV_UB 100.0 FORMULA_0003 0.0 255.0000 /end CHARACTERISTIC
/begin CHARACTERISTIC K_ED_SLP.INC_NACH_EINTRAG "Filtererhoehung nach Fehlerspeichereintrag | EN: Fault code SLP - debounce filter increment after fault-memory entry" VALUE 0x7161C TKW_VV_VV_UB 100.0 FORMULA_0003 0.0 255.0000 /end CHARACTERISTIC
/begin CHARACTERISTIC K_ED_SL_DURCHS_B1.INC_NACH_EINTRAG "Filtererhoehung nach Fehlerspeichereintrag | EN: Fault code SL_DURCHS_B1 - debounce filter increment after fault-memory entry" VALUE 0x71636 TKW_VV_VV_UB 100.0 FORMULA_0003 0.0 255.0000 /end CHARACTERISTIC
/begin CHARACTERISTIC K_ED_SL_DURCHS_B2.INC_NACH_EINTRAG "Filtererhoehung nach Fehlerspeichereintrag | EN: Fault code SL_DURCHS_B2 - debounce filter increment after fault-memory entry" VALUE 0x71650 TKW_VV_VV_UB 100.0 FORMULA_0003 0.0 255.0000 /end CHARACTERISTIC
/begin CHARACTERISTIC K_ED_SL_DURCHS_HSTRANG.INC_NACH_EINTRAG "Filtererhoehung nach Fehlerspeichereintrag | EN: Fault code SL_DURCHS_HSTRANG - debounce filter increment after fault-memory entry" VALUE 0x7166A TKW_VV_VV_UB 100.0 FORMULA_0003 0.0 255.0000 /end CHARACTERISTIC
/begin CHARACTERISTIC K_ED_S_GETR_HS.INC_NACH_EINTRAG "Filtererhoehung nach Fehlerspeichereintrag | EN: Fault code S_GETR_HS - debounce filter increment after fault-memory entry" VALUE 0x7169E TKW_VV_VV_UB 100.0 FORMULA_0003 0.0 255.0000 /end CHARACTERISTIC
/begin CHARACTERISTIC K_ED_S_KUPP_HS.INC_NACH_EINTRAG "Filtererhoehung nach Fehlerspeichereintrag | EN: Fault code S_KUPP_HS - debounce filter increment after fault-memory entry" VALUE 0x716B8 TKW_VV_VV_UB 100.0 FORMULA_0003 0.0 255.0000 /end CHARACTERISTIC
/begin CHARACTERISTIC K_ED_VAN_DRUCK.INC_NACH_EINTRAG "Filtererhoehung nach Fehlerspeichereintrag | EN: Fault code VAN_DRUCK - debounce filter increment after fault-memory entry" VALUE 0x716D2 TKW_VV_VV_UB 100.0 FORMULA_0003 0.0 255.0000 /end CHARACTERISTIC
/begin CHARACTERISTIC K_ED_PT_STATANH.INC_NACH_EINTRAG "Filtererhoehung nach Fehlerspeichereintrag | EN: Fault code PT_STATANH - debounce filter increment after fault-memory entry" VALUE 0x71720 TKW_VV_VV_UB 100.0 FORMULA_0003 0.0 255.0000 /end CHARACTERISTIC
/begin CHARACTERISTIC K_ED_PT_STATGRB.INC_NACH_EINTRAG "Filtererhoehung nach Fehlerspeichereintrag" VALUE 0x717A2 TKW_VV_VV_UB 100.0 FORMULA_0003 0.0 255.0000 /end CHARACTERISTIC
/begin CHARACTERISTIC K_ED_TANK_LEER.INC_NACH_EINTRAG "Filtererhoehung nach Fehlerspeichereintrag | EN: Fault code TANK_LEER - debounce filter increment after fault-memory entry" VALUE 0x717F0 TKW_VV_VV_UB 100.0 FORMULA_0003 0.0 255.0000 /end CHARACTERISTIC
/begin CHARACTERISTIC K_ED_PT_TOMA.INC_NACH_EINTRAG "Filtererhoehung nach Fehlerspeichereintrag | EN: Fault code PT_TOMA - debounce filter increment after fault-memory entry" VALUE 0x7180A TKW_VV_VV_UB 100.0 FORMULA_0003 0.0 255.0000 /end CHARACTERISTIC
/begin CHARACTERISTIC K_ED_PUMG_OBD.INC_NACH_EINTRAG "Filtererhoehung nach Fehlerspeichereintrag | EN: Fault code PUMG_OBD - debounce filter increment after fault-memory entry" VALUE 0x7183E TKW_VV_VV_UB 100.0 FORMULA_0003 0.0 255.0000 /end CHARACTERISTIC
/begin CHARACTERISTIC K_ED_SL_ML_HFM_OBD.INC_NACH_EINTRAG "Filtererhoehung nach Fehlerspeichereintrag | EN: Fault code SL_ML_HFM_OBD - debounce filter increment after fault-memory entry" VALUE 0x71858 TKW_VV_VV_UB 100.0 FORMULA_0003 0.0 255.0000 /end CHARACTERISTIC
/begin CHARACTERISTIC K_ED_TGETR_HS.INC_NACH_EINTRAG "Filtererhoehung nach Fehlerspeichereintrag | EN: Fault code TGETR_HS - debounce filter increment after fault-memory entry" VALUE 0x71990 TKW_VV_VV_UB 100.0 FORMULA_0003 0.0 255.0000 /end CHARACTERISTIC
/begin CHARACTERISTIC K_ED_PT_OBD_ED.INC_NACH_EINTRAG "Filtererhoehung nach Fehlerspeichereintrag" VALUE 0x719DE TKW_VV_VV_UB 100.0 FORMULA_0003 0.0 255.0000 /end CHARACTERISTIC
/begin CHARACTERISTIC K_ED_SK_TR_INJ.DEC_NACH_EINTRAG "Filterverringerung nach Fehlerspeichereintrag | EN: Filterverringerung nach Fehlerspeichereintrag" VALUE 0x705F7 TKW_VV_VV_UB 100.0 FORMULA_0003 0.0 255.0000 /end CHARACTERISTIC
/begin CHARACTERISTIC K_ED_PUMG.DEC_NACH_EINTRAG "Filterverringerung nach Fehlerspeichereintrag | EN: Fault code PUMG - debounce filter decrement after fault-memory entry" VALUE 0x70611 TKW_VV_VV_UB 100.0 FORMULA_0003 0.0 255.0000 /end CHARACTERISTIC
/begin CHARACTERISTIC K_ED_VAN_HALL_E1.DEC_NACH_EINTRAG "Filterverringerung nach Fehlerspeichereintrag | EN: Fault code VAN_HALL_E1 - debounce filter decrement after fault-memory entry" VALUE 0x70693 TKW_VV_VV_UB 100.0 FORMULA_0003 0.0 255.0000 /end CHARACTERISTIC
/begin CHARACTERISTIC K_ED_VAN_HALL_A1.DEC_NACH_EINTRAG "Filterverringerung nach Fehlerspeichereintrag | EN: Fault code VAN_HALL_A1 - debounce filter decrement after fault-memory entry" VALUE 0x706AD TKW_VV_VV_UB 100.0 FORMULA_0003 0.0 255.0000 /end CHARACTERISTIC
/begin CHARACTERISTIC K_ED_VAN_HALL_E2.DEC_NACH_EINTRAG "Filterverringerung nach Fehlerspeichereintrag | EN: Fault code VAN_HALL_E2 - debounce filter decrement after fault-memory entry" VALUE 0x706C7 TKW_VV_VV_UB 100.0 FORMULA_0003 0.0 255.0000 /end CHARACTERISTIC
/begin CHARACTERISTIC K_ED_VAN_HALL_A2.DEC_NACH_EINTRAG "Filterverringerung nach Fehlerspeichereintrag | EN: Fault code VAN_HALL_A2 - debounce filter decrement after fault-memory entry" VALUE 0x706E1 TKW_VV_VV_UB 100.0 FORMULA_0003 0.0 255.0000 /end CHARACTERISTIC
/begin CHARACTERISTIC K_ED_PT_STATDKG.DEC_NACH_EINTRAG "Filterverringerung nach Fehlerspeichereintrag | EN: Fault code PT_STATDKG - debounce filter decrement after fault-memory entry" VALUE 0x707B1 TKW_VV_VV_UB 100.0 FORMULA_0003 0.0 255.0000 /end CHARACTERISTIC
/begin CHARACTERISTIC K_ED_PT_STATR.DEC_NACH_EINTRAG "Filterverringerung nach Fehlerspeichereintrag | EN: Fault code PT_STATR - debounce filter decrement after fault-memory entry" VALUE 0x707E5 TKW_VV_VV_UB 100.0 FORMULA_0003 0.0 255.0000 /end CHARACTERISTIC
/begin CHARACTERISTIC K_ED_PT_TORQDSC.DEC_NACH_EINTRAG "Filterverringerung nach Fehlerspeichereintrag | EN: Fault code PT_TORQDSC - debounce filter decrement after fault-memory entry" VALUE 0x7091D TKW_VV_VV_UB 100.0 FORMULA_0003 0.0 255.0000 /end CHARACTERISTIC
/begin CHARACTERISTIC K_ED_PT_STDSC.DEC_NACH_EINTRAG "Filterverringerung nach Fehlerspeichereintrag | EN: Fault code PT_STDSC - debounce filter decrement after fault-memory entry" VALUE 0x70937 TKW_VV_VV_UB 100.0 FORMULA_0003 0.0 255.0000 /end CHARACTERISTIC
/begin CHARACTERISTIC K_ED_PT_VRAD.DEC_NACH_EINTRAG "Filterverringerung nach Fehlerspeichereintrag | EN: Fault code PT_VRAD - debounce filter decrement after fault-memory entry" VALUE 0x70951 TKW_VV_VV_UB 100.0 FORMULA_0003 0.0 255.0000 /end CHARACTERISTIC
/begin CHARACTERISTIC K_ED_PT_VFZG.DEC_NACH_EINTRAG "Filterverringerung nach Fehlerspeichereintrag | EN: Fault code PT_VFZG - debounce filter decrement after fault-memory entry" VALUE 0x7096B TKW_VV_VV_UB 100.0 FORMULA_0003 0.0 255.0000 /end CHARACTERISTIC
/begin CHARACTERISTIC K_ED_SL_ML_HFM.DEC_NACH_EINTRAG "Filterverringerung nach Fehlerspeichereintrag | EN: Fault code SL_ML_HFM - debounce filter decrement after fault-memory entry" VALUE 0x70A21 TKW_VV_VV_UB 100.0 FORMULA_0003 0.0 255.0000 /end CHARACTERISTIC
/begin CHARACTERISTIC K_ED_TZ1.DEC_NACH_EINTRAG "Filterverringerung nach Fehlerspeichereintrag | EN: Fault code TZ1 - debounce filter decrement after fault-memory entry" VALUE 0x70CC5 TKW_VV_VV_UB 100.0 FORMULA_0003 0.0 255.0000 /end CHARACTERISTIC
/begin CHARACTERISTIC K_ED_TZ2.DEC_NACH_EINTRAG "Filterverringerung nach Fehlerspeichereintrag | EN: Fault code TZ2 - debounce filter decrement after fault-memory entry" VALUE 0x70CDF TKW_VV_VV_UB 100.0 FORMULA_0003 0.0 255.0000 /end CHARACTERISTIC
/begin CHARACTERISTIC K_ED_TZ3.DEC_NACH_EINTRAG "Filterverringerung nach Fehlerspeichereintrag | EN: Fault code TZ3 - debounce filter decrement after fault-memory entry" VALUE 0x70CF9 TKW_VV_VV_UB 100.0 FORMULA_0003 0.0 255.0000 /end CHARACTERISTIC
/begin CHARACTERISTIC K_ED_TZ4.DEC_NACH_EINTRAG "Filterverringerung nach Fehlerspeichereintrag | EN: Fault code TZ4 - debounce filter decrement after fault-memory entry" VALUE 0x70D13 TKW_VV_VV_UB 100.0 FORMULA_0003 0.0 255.0000 /end CHARACTERISTIC
/begin CHARACTERISTIC K_ED_TZ5.DEC_NACH_EINTRAG "Filterverringerung nach Fehlerspeichereintrag | EN: Fault code TZ5 - debounce filter decrement after fault-memory entry" VALUE 0x70D2D TKW_VV_VV_UB 100.0 FORMULA_0003 0.0 255.0000 /end CHARACTERISTIC
/begin CHARACTERISTIC K_ED_TZ6.DEC_NACH_EINTRAG "Filterverringerung nach Fehlerspeichereintrag | EN: Fault code TZ6 - debounce filter decrement after fault-memory entry" VALUE 0x70D47 TKW_VV_VV_UB 100.0 FORMULA_0003 0.0 255.0000 /end CHARACTERISTIC
/begin CHARACTERISTIC K_ED_TZ7.DEC_NACH_EINTRAG "Filterverringerung nach Fehlerspeichereintrag | EN: Fault code TZ7 - debounce filter decrement after fault-memory entry" VALUE 0x70D61 TKW_VV_VV_UB 100.0 FORMULA_0003 0.0 255.0000 /end CHARACTERISTIC
/begin CHARACTERISTIC K_ED_TZ8.DEC_NACH_EINTRAG "Filterverringerung nach Fehlerspeichereintrag | EN: Fault code TZ8 - debounce filter decrement after fault-memory entry" VALUE 0x70D7B TKW_VV_VV_UB 100.0 FORMULA_0003 0.0 255.0000 /end CHARACTERISTIC
/begin CHARACTERISTIC K_ED_TZ9.DEC_NACH_EINTRAG "Filterverringerung nach Fehlerspeichereintrag | EN: Fault code TZ9 - debounce filter decrement after fault-memory entry" VALUE 0x70D95 TKW_VV_VV_UB 100.0 FORMULA_0003 0.0 255.0000 /end CHARACTERISTIC
/begin CHARACTERISTIC K_ED_TZ10.DEC_NACH_EINTRAG "Filterverringerung nach Fehlerspeichereintrag | EN: Fault code TZ10 - debounce filter decrement after fault-memory entry" VALUE 0x70DAF TKW_VV_VV_UB 100.0 FORMULA_0003 0.0 255.0000 /end CHARACTERISTIC
/begin CHARACTERISTIC K_ED_VAN_ANSCHL_E1.DEC_NACH_EINTRAG "Filterverringerung nach Fehlerspeichereintrag | EN: Fault code VAN_ANSCHL_E1 - debounce filter decrement after fault-memory entry" VALUE 0x70DFD TKW_VV_VV_UB 100.0 FORMULA_0003 0.0 255.0000 /end CHARACTERISTIC
/begin CHARACTERISTIC K_ED_VAN_ANSCHL_A1.DEC_NACH_EINTRAG "Filterverringerung nach Fehlerspeichereintrag | EN: Fault code VAN_ANSCHL_A1 - debounce filter decrement after fault-memory entry" VALUE 0x70E17 TKW_VV_VV_UB 100.0 FORMULA_0003 0.0 255.0000 /end CHARACTERISTIC
/begin CHARACTERISTIC K_ED_VAN_ANSCHL_E2.DEC_NACH_EINTRAG "Filterverringerung nach Fehlerspeichereintrag | EN: Fault code VAN_ANSCHL_E2 - debounce filter decrement after fault-memory entry" VALUE 0x70E31 TKW_VV_VV_UB 100.0 FORMULA_0003 0.0 255.0000 /end CHARACTERISTIC
/begin CHARACTERISTIC K_ED_VAN_ANSCHL_A2.DEC_NACH_EINTRAG "Filterverringerung nach Fehlerspeichereintrag | EN: Fault code VAN_ANSCHL_A2 - debounce filter decrement after fault-memory entry" VALUE 0x70E4B TKW_VV_VV_UB 100.0 FORMULA_0003 0.0 255.0000 /end CHARACTERISTIC
/begin CHARACTERISTIC K_ED_VAN_VENT_A1.DEC_NACH_EINTRAG "Filterverringerung nach Fehlerspeichereintrag | EN: Fault code VAN_VENT_A1 - debounce filter decrement after fault-memory entry" VALUE 0x70E7F TKW_VV_VV_UB 100.0 FORMULA_0003 0.0 255.0000 /end CHARACTERISTIC
/begin CHARACTERISTIC K_ED_PT_VEHMOD.DEC_NACH_EINTRAG "Filterverringerung nach Fehlerspeichereintrag | EN: Fault code PT_VEHMOD - debounce filter decrement after fault-memory entry" VALUE 0x7101F TKW_VV_VV_UB 100.0 FORMULA_0003 0.0 255.0000 /end CHARACTERISTIC
/begin CHARACTERISTIC K_ED_RLU87.DEC_NACH_EINTRAG "Filterverringerung nach Fehlerspeichereintrag | EN: Fault code RLU87 - debounce filter decrement after fault-memory entry" VALUE 0x71123 TKW_VV_VV_UB 100.0 FORMULA_0003 0.0 255.0000 /end CHARACTERISTIC
/begin CHARACTERISTIC K_ED_SSP.DEC_NACH_EINTRAG "Filterverringerung nach Fehlerspeichereintrag" VALUE 0x71157 TKW_VV_VV_UB 100.0 FORMULA_0003 0.0 255.0000 /end CHARACTERISTIC
/begin CHARACTERISTIC K_ED_TD.DEC_NACH_EINTRAG "Filterverringerung nach Fehlerspeichereintrag | EN: Fault code TD - debounce filter decrement after fault-memory entry" VALUE 0x71171 TKW_VV_VV_UB 100.0 FORMULA_0003 0.0 255.0000 /end CHARACTERISTIC
/begin CHARACTERISTIC K_ED_RLSLP.DEC_NACH_EINTRAG "Filterverringerung nach Fehlerspeichereintrag | EN: Fault code RLSLP - debounce filter decrement after fault-memory entry" VALUE 0x7118B TKW_VV_VV_UB 100.0 FORMULA_0003 0.0 255.0000 /end CHARACTERISTIC
/begin CHARACTERISTIC K_ED_SLV.DEC_NACH_EINTRAG "Filterverringerung nach Fehlerspeichereintrag | EN: Fault code SLV - debounce filter decrement after fault-memory entry" VALUE 0x711A5 TKW_VV_VV_UB 100.0 FORMULA_0003 0.0 255.0000 /end CHARACTERISTIC
/begin CHARACTERISTIC K_ED_VAN_DSV.DEC_NACH_EINTRAG "Filterverringerung nach Fehlerspeichereintrag | EN: Fault code VAN_DSV - debounce filter decrement after fault-memory entry" VALUE 0x71275 TKW_VV_VV_UB 100.0 FORMULA_0003 0.0 255.0000 /end CHARACTERISTIC
/begin CHARACTERISTIC K_ED_SK_MANAGER_INJ.DEC_NACH_EINTRAG "Filterverringerung nach Fehlerspeichereintrag | EN: Fault code SK_MANAGER_INJ - debounce filter decrement after fault-memory entry" VALUE 0x71393 TKW_VV_VV_UB 100.0 FORMULA_0003 0.0 255.0000 /end CHARACTERISTIC
/begin CHARACTERISTIC K_ED_SSP_DIAG.DEC_NACH_EINTRAG "Filterverringerung nach Fehlerspeichereintrag" VALUE 0x713AD TKW_VV_VV_UB 100.0 FORMULA_0003 0.0 255.0000 /end CHARACTERISTIC
/begin CHARACTERISTIC K_ED_SG_INJ.DEC_NACH_EINTRAG "Filterverringerung nach Fehlerspeichereintrag | EN: Fault code SG_INJ - debounce filter decrement after fault-memory entry" VALUE 0x71497 TKW_VV_VV_UB 100.0 FORMULA_0003 0.0 255.0000 /end CHARACTERISTIC
/begin CHARACTERISTIC K_ED_S_POEL_DIAG.DEC_NACH_EINTRAG "Filterverringerung nach Fehlerspeichereintrag | EN: Fault code S_POEL_DIAG - debounce filter decrement after fault-memory entry" VALUE 0x714E5 TKW_VV_VV_UB 100.0 FORMULA_0003 0.0 255.0000 /end CHARACTERISTIC
/begin CHARACTERISTIC K_ED_TE_OBD_1.DEC_NACH_EINTRAG "Filterverringerung nach Fehlerspeichereintrag | EN: Fault code TE_OBD_1 - debounce filter decrement after fault-memory entry" VALUE 0x714FF TKW_VV_VV_UB 100.0 FORMULA_0003 0.0 255.0000 /end CHARACTERISTIC
/begin CHARACTERISTIC K_ED_TE_OBD_2.DEC_NACH_EINTRAG "Filterverringerung nach Fehlerspeichereintrag | EN: Fault code TE_OBD_2 - debounce filter decrement after fault-memory entry" VALUE 0x71519 TKW_VV_VV_UB 100.0 FORMULA_0003 0.0 255.0000 /end CHARACTERISTIC
/begin CHARACTERISTIC K_ED_TEV1.DEC_NACH_EINTRAG "Filterverringerung nach Fehlerspeichereintrag | EN: Fault code TEV1 - debounce filter decrement after fault-memory entry" VALUE 0x71533 TKW_VV_VV_UB 100.0 FORMULA_0003 0.0 255.0000 /end CHARACTERISTIC
/begin CHARACTERISTIC K_ED_TEV2.DEC_NACH_EINTRAG "Filterverringerung nach Fehlerspeichereintrag | EN: Fault code TEV2 - debounce filter decrement after fault-memory entry" VALUE 0x7154D TKW_VV_VV_UB 100.0 FORMULA_0003 0.0 255.0000 /end CHARACTERISTIC
/begin CHARACTERISTIC K_ED_SLP.DEC_NACH_EINTRAG "Filterverringerung nach Fehlerspeichereintrag | EN: Fault code SLP - debounce filter decrement after fault-memory entry" VALUE 0x7161D TKW_VV_VV_UB 100.0 FORMULA_0003 0.0 255.0000 /end CHARACTERISTIC
/begin CHARACTERISTIC K_ED_SL_DURCHS_B1.DEC_NACH_EINTRAG "Filterverringerung nach Fehlerspeichereintrag | EN: Fault code SL_DURCHS_B1 - debounce filter decrement after fault-memory entry" VALUE 0x71637 TKW_VV_VV_UB 100.0 FORMULA_0003 0.0 255.0000 /end CHARACTERISTIC
/begin CHARACTERISTIC K_ED_SL_DURCHS_B2.DEC_NACH_EINTRAG "Filterverringerung nach Fehlerspeichereintrag | EN: Fault code SL_DURCHS_B2 - debounce filter decrement after fault-memory entry" VALUE 0x71651 TKW_VV_VV_UB 100.0 FORMULA_0003 0.0 255.0000 /end CHARACTERISTIC
/begin CHARACTERISTIC K_ED_SL_DURCHS_HSTRANG.DEC_NACH_EINTRAG "Filterverringerung nach Fehlerspeichereintrag | EN: Fault code SL_DURCHS_HSTRANG - debounce filter decrement after fault-memory entry" VALUE 0x7166B TKW_VV_VV_UB 100.0 FORMULA_0003 0.0 255.0000 /end CHARACTERISTIC
/begin CHARACTERISTIC K_ED_S_GETR_HS.DEC_NACH_EINTRAG "Filterverringerung nach Fehlerspeichereintrag | EN: Fault code S_GETR_HS - debounce filter decrement after fault-memory entry" VALUE 0x7169F TKW_VV_VV_UB 100.0 FORMULA_0003 0.0 255.0000 /end CHARACTERISTIC
/begin CHARACTERISTIC K_ED_S_KUPP_HS.DEC_NACH_EINTRAG "Filterverringerung nach Fehlerspeichereintrag | EN: Fault code S_KUPP_HS - debounce filter decrement after fault-memory entry" VALUE 0x716B9 TKW_VV_VV_UB 100.0 FORMULA_0003 0.0 255.0000 /end CHARACTERISTIC
/begin CHARACTERISTIC K_ED_VAN_DRUCK.DEC_NACH_EINTRAG "Filterverringerung nach Fehlerspeichereintrag | EN: Fault code VAN_DRUCK - debounce filter decrement after fault-memory entry" VALUE 0x716D3 TKW_VV_VV_UB 100.0 FORMULA_0003 0.0 255.0000 /end CHARACTERISTIC
/begin CHARACTERISTIC K_ED_PT_STATANH.DEC_NACH_EINTRAG "Filterverringerung nach Fehlerspeichereintrag | EN: Fault code PT_STATANH - debounce filter decrement after fault-memory entry" VALUE 0x71721 TKW_VV_VV_UB 100.0 FORMULA_0003 0.0 255.0000 /end CHARACTERISTIC
/begin CHARACTERISTIC K_ED_PT_STATGRB.DEC_NACH_EINTRAG "Filterverringerung nach Fehlerspeichereintrag" VALUE 0x717A3 TKW_VV_VV_UB 100.0 FORMULA_0003 0.0 255.0000 /end CHARACTERISTIC
/begin CHARACTERISTIC K_ED_TANK_LEER.DEC_NACH_EINTRAG "Filterverringerung nach Fehlerspeichereintrag | EN: Fault code TANK_LEER - debounce filter decrement after fault-memory entry" VALUE 0x717F1 TKW_VV_VV_UB 100.0 FORMULA_0003 0.0 255.0000 /end CHARACTERISTIC
/begin CHARACTERISTIC K_ED_PT_TOMA.DEC_NACH_EINTRAG "Filterverringerung nach Fehlerspeichereintrag | EN: Fault code PT_TOMA - debounce filter decrement after fault-memory entry" VALUE 0x7180B TKW_VV_VV_UB 100.0 FORMULA_0003 0.0 255.0000 /end CHARACTERISTIC
/begin CHARACTERISTIC K_ED_PUMG_OBD.DEC_NACH_EINTRAG "Filterverringerung nach Fehlerspeichereintrag | EN: Fault code PUMG_OBD - debounce filter decrement after fault-memory entry" VALUE 0x7183F TKW_VV_VV_UB 100.0 FORMULA_0003 0.0 255.0000 /end CHARACTERISTIC
/begin CHARACTERISTIC K_ED_SL_ML_HFM_OBD.DEC_NACH_EINTRAG "Filterverringerung nach Fehlerspeichereintrag | EN: Fault code SL_ML_HFM_OBD - debounce filter decrement after fault-memory entry" VALUE 0x71859 TKW_VV_VV_UB 100.0 FORMULA_0003 0.0 255.0000 /end CHARACTERISTIC
/begin CHARACTERISTIC K_ED_TGETR_HS.DEC_NACH_EINTRAG "Filterverringerung nach Fehlerspeichereintrag | EN: Fault code TGETR_HS - debounce filter decrement after fault-memory entry" VALUE 0x71991 TKW_VV_VV_UB 100.0 FORMULA_0003 0.0 255.0000 /end CHARACTERISTIC
/begin CHARACTERISTIC K_ED_PT_OBD_ED.DEC_NACH_EINTRAG "Filterverringerung nach Fehlerspeichereintrag" VALUE 0x719DF TKW_VV_VV_UB 100.0 FORMULA_0003 0.0 255.0000 /end CHARACTERISTIC
/begin CHARACTERISTIC K_ED_SK_TR_INJ.KLASSENINDEX "Auswahl der Fehlerklasse | EN: Fault code SK_TR_INJ - fault class selection (lamp / warning behaviour)" VALUE 0x705F8 TKW_VV_VV_UB 100.0 FORMULA_0003 0.0 8.0000 /end CHARACTERISTIC
/begin CHARACTERISTIC K_ED_VAN_HALL_E1.KLASSENINDEX "Auswahl der Fehlerklasse | EN: Fault code VAN_HALL_E1 - fault class selection (lamp / warning behaviour)" VALUE 0x70694 TKW_VV_VV_UB 100.0 FORMULA_0003 0.0 8.0000 /end CHARACTERISTIC
/begin CHARACTERISTIC K_ED_VAN_HALL_A1.KLASSENINDEX "Auswahl der Fehlerklasse | EN: Fault code VAN_HALL_A1 - fault class selection (lamp / warning behaviour)" VALUE 0x706AE TKW_VV_VV_UB 100.0 FORMULA_0003 0.0 8.0000 /end CHARACTERISTIC
/begin CHARACTERISTIC K_ED_VAN_HALL_E2.KLASSENINDEX "Auswahl der Fehlerklasse | EN: Fault code VAN_HALL_E2 - fault class selection (lamp / warning behaviour)" VALUE 0x706C8 TKW_VV_VV_UB 100.0 FORMULA_0003 0.0 8.0000 /end CHARACTERISTIC
/begin CHARACTERISTIC K_ED_VAN_HALL_A2.KLASSENINDEX "Auswahl der Fehlerklasse | EN: Fault code VAN_HALL_A2 - fault class selection (lamp / warning behaviour)" VALUE 0x706E2 TKW_VV_VV_UB 100.0 FORMULA_0003 0.0 8.0000 /end CHARACTERISTIC
/begin CHARACTERISTIC K_ED_VAN_REGL_E1.KLASSENINDEX "Auswahl der Fehlerklasse | EN: Fault code VAN_REGL_E1 - fault class selection (lamp / warning behaviour)" VALUE 0x706FC TKW_VV_VV_UB 100.0 FORMULA_0003 0.0 8.0000 /end CHARACTERISTIC
/begin CHARACTERISTIC K_ED_VAN_REGL_A1.KLASSENINDEX "Auswahl der Fehlerklasse | EN: Fault code VAN_REGL_A1 - fault class selection (lamp / warning behaviour)" VALUE 0x70716 TKW_VV_VV_UB 100.0 FORMULA_0003 0.0 8.0000 /end CHARACTERISTIC
/begin CHARACTERISTIC K_ED_VAN_REGL_E2.KLASSENINDEX "Auswahl der Fehlerklasse | EN: Fault code VAN_REGL_E2 - fault class selection (lamp / warning behaviour)" VALUE 0x70730 TKW_VV_VV_UB 100.0 FORMULA_0003 0.0 8.0000 /end CHARACTERISTIC
/begin CHARACTERISTIC K_ED_VAN_REGL_A2.KLASSENINDEX "Auswahl der Fehlerklasse | EN: Fault code VAN_REGL_A2 - fault class selection (lamp / warning behaviour)" VALUE 0x7074A TKW_VV_VV_UB 100.0 FORMULA_0003 0.0 8.0000 /end CHARACTERISTIC
/begin CHARACTERISTIC K_ED_PT_STATDKG.KLASSENINDEX "Auswahl der Fehlerklasse | EN: Fault code PT_STATDKG - fault class selection (lamp / warning behaviour)" VALUE 0x707B2 TKW_VV_VV_UB 100.0 FORMULA_0003 0.0 8.0000 /end CHARACTERISTIC
/begin CHARACTERISTIC K_ED_PT_STATR.KLASSENINDEX "Auswahl der Fehlerklasse | EN: Fault code PT_STATR - fault class selection (lamp / warning behaviour)" VALUE 0x707E6 TKW_VV_VV_UB 100.0 FORMULA_0003 0.0 8.0000 /end CHARACTERISTIC
/begin CHARACTERISTIC K_ED_PT_TORQDSC.KLASSENINDEX "Auswahl der Fehlerklasse | EN: Fault code PT_TORQDSC - fault class selection (lamp / warning behaviour)" VALUE 0x7091E TKW_VV_VV_UB 100.0 FORMULA_0003 0.0 8.0000 /end CHARACTERISTIC
/begin CHARACTERISTIC K_ED_PT_STDSC.KLASSENINDEX "Auswahl der Fehlerklasse | EN: Fault code PT_STDSC - fault class selection (lamp / warning behaviour) [V912: differs from V452 160E]" VALUE 0x70938 TKW_VV_VV_UB 100.0 FORMULA_0003 0.0 8.0000 /end CHARACTERISTIC
/begin CHARACTERISTIC K_ED_PT_VRAD.KLASSENINDEX "Auswahl der Fehlerklasse | EN: Fault code PT_VRAD - fault class selection (lamp / warning behaviour)" VALUE 0x70952 TKW_VV_VV_UB 100.0 FORMULA_0003 0.0 8.0000 /end CHARACTERISTIC
/begin CHARACTERISTIC K_ED_PT_VFZG.KLASSENINDEX "Auswahl der Fehlerklasse | EN: Fault code PT_VFZG - fault class selection (lamp / warning behaviour)" VALUE 0x7096C TKW_VV_VV_UB 100.0 FORMULA_0003 0.0 8.0000 /end CHARACTERISTIC
/begin CHARACTERISTIC K_ED_PT_LRW.KLASSENINDEX "Auswahl der Fehlerklasse | EN: Fault code PT_LRW - fault class selection (lamp / warning behaviour)" VALUE 0x709D4 TKW_VV_VV_UB 100.0 FORMULA_0003 0.0 8.0000 /end CHARACTERISTIC
/begin CHARACTERISTIC K_ED_SL_ML_HFM.KLASSENINDEX "Auswahl der Fehlerklasse | EN: Fault code SL_ML_HFM - fault class selection (lamp / warning behaviour) [V912: differs from V452 160E]" VALUE 0x70A22 TKW_VV_VV_UB 100.0 FORMULA_0003 0.0 8.0000 /end CHARACTERISTIC
/begin CHARACTERISTIC K_ED_TZ1.KLASSENINDEX "Auswahl der Fehlerklasse | EN: Fault code TZ1 - fault class selection (lamp / warning behaviour)" VALUE 0x70CC6 TKW_VV_VV_UB 100.0 FORMULA_0003 0.0 8.0000 /end CHARACTERISTIC
/begin CHARACTERISTIC K_ED_TZ2.KLASSENINDEX "Auswahl der Fehlerklasse | EN: Fault code TZ2 - fault class selection (lamp / warning behaviour)" VALUE 0x70CE0 TKW_VV_VV_UB 100.0 FORMULA_0003 0.0 8.0000 /end CHARACTERISTIC
/begin CHARACTERISTIC K_ED_TZ3.KLASSENINDEX "Auswahl der Fehlerklasse | EN: Fault code TZ3 - fault class selection (lamp / warning behaviour)" VALUE 0x70CFA TKW_VV_VV_UB 100.0 FORMULA_0003 0.0 8.0000 /end CHARACTERISTIC
/begin CHARACTERISTIC K_ED_TZ4.KLASSENINDEX "Auswahl der Fehlerklasse | EN: Fault code TZ4 - fault class selection (lamp / warning behaviour)" VALUE 0x70D14 TKW_VV_VV_UB 100.0 FORMULA_0003 0.0 8.0000 /end CHARACTERISTIC
/begin CHARACTERISTIC K_ED_TZ5.KLASSENINDEX "Auswahl der Fehlerklasse | EN: Fault code TZ5 - fault class selection (lamp / warning behaviour)" VALUE 0x70D2E TKW_VV_VV_UB 100.0 FORMULA_0003 0.0 8.0000 /end CHARACTERISTIC
/begin CHARACTERISTIC K_ED_TZ6.KLASSENINDEX "Auswahl der Fehlerklasse | EN: Fault code TZ6 - fault class selection (lamp / warning behaviour)" VALUE 0x70D48 TKW_VV_VV_UB 100.0 FORMULA_0003 0.0 8.0000 /end CHARACTERISTIC
/begin CHARACTERISTIC K_ED_TZ7.KLASSENINDEX "Auswahl der Fehlerklasse | EN: Fault code TZ7 - fault class selection (lamp / warning behaviour)" VALUE 0x70D62 TKW_VV_VV_UB 100.0 FORMULA_0003 0.0 8.0000 /end CHARACTERISTIC
/begin CHARACTERISTIC K_ED_TZ8.KLASSENINDEX "Auswahl der Fehlerklasse | EN: Fault code TZ8 - fault class selection (lamp / warning behaviour)" VALUE 0x70D7C TKW_VV_VV_UB 100.0 FORMULA_0003 0.0 8.0000 /end CHARACTERISTIC
/begin CHARACTERISTIC K_ED_TZ9.KLASSENINDEX "Auswahl der Fehlerklasse | EN: Fault code TZ9 - fault class selection (lamp / warning behaviour)" VALUE 0x70D96 TKW_VV_VV_UB 100.0 FORMULA_0003 0.0 8.0000 /end CHARACTERISTIC
/begin CHARACTERISTIC K_ED_TZ10.KLASSENINDEX "Auswahl der Fehlerklasse | EN: Fault code TZ10 - fault class selection (lamp / warning behaviour)" VALUE 0x70DB0 TKW_VV_VV_UB 100.0 FORMULA_0003 0.0 8.0000 /end CHARACTERISTIC
/begin CHARACTERISTIC K_ED_VAN_ANSCHL_E1.KLASSENINDEX "Auswahl der Fehlerklasse | EN: Fault code VAN_ANSCHL_E1 - fault class selection (lamp / warning behaviour)" VALUE 0x70DFE TKW_VV_VV_UB 100.0 FORMULA_0003 0.0 8.0000 /end CHARACTERISTIC
/begin CHARACTERISTIC K_ED_VAN_ANSCHL_A1.KLASSENINDEX "Auswahl der Fehlerklasse | EN: Fault code VAN_ANSCHL_A1 - fault class selection (lamp / warning behaviour)" VALUE 0x70E18 TKW_VV_VV_UB 100.0 FORMULA_0003 0.0 8.0000 /end CHARACTERISTIC
/begin CHARACTERISTIC K_ED_VAN_ANSCHL_E2.KLASSENINDEX "Auswahl der Fehlerklasse | EN: Fault code VAN_ANSCHL_E2 - fault class selection (lamp / warning behaviour)" VALUE 0x70E32 TKW_VV_VV_UB 100.0 FORMULA_0003 0.0 8.0000 /end CHARACTERISTIC
/begin CHARACTERISTIC K_ED_VAN_ANSCHL_A2.KLASSENINDEX "Auswahl der Fehlerklasse | EN: Fault code VAN_ANSCHL_A2 - fault class selection (lamp / warning behaviour)" VALUE 0x70E4C TKW_VV_VV_UB 100.0 FORMULA_0003 0.0 8.0000 /end CHARACTERISTIC
/begin CHARACTERISTIC K_ED_PT_VEHMOD.KLASSENINDEX "Auswahl der Fehlerklasse | EN: Fault code PT_VEHMOD - fault class selection (lamp / warning behaviour)" VALUE 0x71020 TKW_VV_VV_UB 100.0 FORMULA_0003 0.0 8.0000 /end CHARACTERISTIC
/begin CHARACTERISTIC K_ED_RLU87.KLASSENINDEX "Auswahl der Fehlerklasse | EN: Fault code RLU87 - fault class selection (lamp / warning behaviour)" VALUE 0x71124 TKW_VV_VV_UB 100.0 FORMULA_0003 0.0 8.0000 /end CHARACTERISTIC
/begin CHARACTERISTIC K_ED_SSP.KLASSENINDEX "Auswahl der Fehlerklasse" VALUE 0x71158 TKW_VV_VV_UB 100.0 FORMULA_0003 0.0 8.0000 /end CHARACTERISTIC
/begin CHARACTERISTIC K_ED_TD.KLASSENINDEX "Auswahl der Fehlerklasse | EN: Fault code TD - fault class selection (lamp / warning behaviour)" VALUE 0x71172 TKW_VV_VV_UB 100.0 FORMULA_0003 0.0 8.0000 /end CHARACTERISTIC
/begin CHARACTERISTIC K_ED_RLSLP.KLASSENINDEX "Auswahl der Fehlerklasse | EN: Fault code RLSLP - fault class selection (lamp / warning behaviour)" VALUE 0x7118C TKW_VV_VV_UB 100.0 FORMULA_0003 0.0 8.0000 /end CHARACTERISTIC
/begin CHARACTERISTIC K_ED_SLV.KLASSENINDEX "Auswahl der Fehlerklasse | EN: Fault code SLV - fault class selection (lamp / warning behaviour)" VALUE 0x711A6 TKW_VV_VV_UB 100.0 FORMULA_0003 0.0 8.0000 /end CHARACTERISTIC
/begin CHARACTERISTIC K_ED_VAN_DSV.KLASSENINDEX "Auswahl der Fehlerklasse | EN: Fault code VAN_DSV - fault class selection (lamp / warning behaviour)" VALUE 0x71276 TKW_VV_VV_UB 100.0 FORMULA_0003 0.0 8.0000 /end CHARACTERISTIC
/begin CHARACTERISTIC K_ED_SK_MANAGER_INJ.KLASSENINDEX "Auswahl der Fehlerklasse | EN: Fault code SK_MANAGER_INJ - fault class selection (lamp / warning behaviour)" VALUE 0x71394 TKW_VV_VV_UB 100.0 FORMULA_0003 0.0 8.0000 /end CHARACTERISTIC
/begin CHARACTERISTIC K_ED_SSP_DIAG.KLASSENINDEX "Auswahl der Fehlerklasse" VALUE 0x713AE TKW_VV_VV_UB 100.0 FORMULA_0003 0.0 8.0000 /end CHARACTERISTIC
/begin CHARACTERISTIC K_ED_SG_INJ.KLASSENINDEX "Auswahl der Fehlerklasse | EN: Fault code SG_INJ - fault class selection (lamp / warning behaviour)" VALUE 0x71498 TKW_VV_VV_UB 100.0 FORMULA_0003 0.0 8.0000 /end CHARACTERISTIC
/begin CHARACTERISTIC K_ED_S_POEL_DIAG.KLASSENINDEX "Auswahl der Fehlerklasse | EN: Fault code S_POEL_DIAG - fault class selection (lamp / warning behaviour)" VALUE 0x714E6 TKW_VV_VV_UB 100.0 FORMULA_0003 0.0 8.0000 /end CHARACTERISTIC
/begin CHARACTERISTIC K_ED_TE_OBD_1.KLASSENINDEX "Auswahl der Fehlerklasse | EN: Fault code TE_OBD_1 - fault class selection (lamp / warning behaviour) [V912: differs from V452 160E]" VALUE 0x71500 TKW_VV_VV_UB 100.0 FORMULA_0003 0.0 8.0000 /end CHARACTERISTIC
/begin CHARACTERISTIC K_ED_TE_OBD_2.KLASSENINDEX "Auswahl der Fehlerklasse | EN: Fault code TE_OBD_2 - fault class selection (lamp / warning behaviour) [V912: differs from V452 160E]" VALUE 0x7151A TKW_VV_VV_UB 100.0 FORMULA_0003 0.0 8.0000 /end CHARACTERISTIC
/begin CHARACTERISTIC K_ED_TEV1.KLASSENINDEX "Auswahl der Fehlerklasse | EN: Fault code TEV1 - fault class selection (lamp / warning behaviour)" VALUE 0x71534 TKW_VV_VV_UB 100.0 FORMULA_0003 0.0 8.0000 /end CHARACTERISTIC
/begin CHARACTERISTIC K_ED_TEV2.KLASSENINDEX "Auswahl der Fehlerklasse | EN: Fault code TEV2 - fault class selection (lamp / warning behaviour)" VALUE 0x7154E TKW_VV_VV_UB 100.0 FORMULA_0003 0.0 8.0000 /end CHARACTERISTIC
/begin CHARACTERISTIC K_ED_SLP.KLASSENINDEX "Auswahl der Fehlerklasse | EN: Fault code SLP - fault class selection (lamp / warning behaviour) [V912: differs from V452 160E]" VALUE 0x7161E TKW_VV_VV_UB 100.0 FORMULA_0003 0.0 8.0000 /end CHARACTERISTIC
/begin CHARACTERISTIC K_ED_SL_DURCHS_B1.KLASSENINDEX "Auswahl der Fehlerklasse | EN: Fault code SL_DURCHS_B1 - fault class selection (lamp / warning behaviour) [V912: differs from V452 160E]" VALUE 0x71638 TKW_VV_VV_UB 100.0 FORMULA_0003 0.0 8.0000 /end CHARACTERISTIC
/begin CHARACTERISTIC K_ED_SL_DURCHS_B2.KLASSENINDEX "Auswahl der Fehlerklasse | EN: Fault code SL_DURCHS_B2 - fault class selection (lamp / warning behaviour) [V912: differs from V452 160E]" VALUE 0x71652 TKW_VV_VV_UB 100.0 FORMULA_0003 0.0 8.0000 /end CHARACTERISTIC
/begin CHARACTERISTIC K_ED_SL_DURCHS_HSTRANG.KLASSENINDEX "Auswahl der Fehlerklasse | EN: Fault code SL_DURCHS_HSTRANG - fault class selection (lamp / warning behaviour) [V912: differs from V452 160E]" VALUE 0x7166C TKW_VV_VV_UB 100.0 FORMULA_0003 0.0 8.0000 /end CHARACTERISTIC
/begin CHARACTERISTIC K_ED_S_GETR_HS.KLASSENINDEX "Auswahl der Fehlerklasse | EN: Fault code S_GETR_HS - fault class selection (lamp / warning behaviour)" VALUE 0x716A0 TKW_VV_VV_UB 100.0 FORMULA_0003 0.0 8.0000 /end CHARACTERISTIC
/begin CHARACTERISTIC K_ED_S_KUPP_HS.KLASSENINDEX "Auswahl der Fehlerklasse | EN: Fault code S_KUPP_HS - fault class selection (lamp / warning behaviour)" VALUE 0x716BA TKW_VV_VV_UB 100.0 FORMULA_0003 0.0 8.0000 /end CHARACTERISTIC
/begin CHARACTERISTIC K_ED_VAN_DRUCK.KLASSENINDEX "Auswahl der Fehlerklasse | EN: Fault code VAN_DRUCK - fault class selection (lamp / warning behaviour)" VALUE 0x716D4 TKW_VV_VV_UB 100.0 FORMULA_0003 0.0 8.0000 /end CHARACTERISTIC
/begin CHARACTERISTIC K_ED_PT_STATANH.KLASSENINDEX "Auswahl der Fehlerklasse | EN: Fault code PT_STATANH - fault class selection (lamp / warning behaviour)" VALUE 0x71722 TKW_VV_VV_UB 100.0 FORMULA_0003 0.0 8.0000 /end CHARACTERISTIC
/begin CHARACTERISTIC K_ED_PT_STATGRB.KLASSENINDEX "Auswahl der Fehlerklasse" VALUE 0x717A4 TKW_VV_VV_UB 100.0 FORMULA_0003 0.0 8.0000 /end CHARACTERISTIC
/begin CHARACTERISTIC K_ED_TANK_LEER.KLASSENINDEX "Auswahl der Fehlerklasse | EN: Fault code TANK_LEER - fault class selection (lamp / warning behaviour)" VALUE 0x717F2 TKW_VV_VV_UB 100.0 FORMULA_0003 0.0 8.0000 /end CHARACTERISTIC
/begin CHARACTERISTIC K_ED_PT_TOMA.KLASSENINDEX "Auswahl der Fehlerklasse | EN: Fault code PT_TOMA - fault class selection (lamp / warning behaviour)" VALUE 0x7180C TKW_VV_VV_UB 100.0 FORMULA_0003 0.0 8.0000 /end CHARACTERISTIC
/begin CHARACTERISTIC K_ED_PUMG_OBD.KLASSENINDEX "Auswahl der Fehlerklasse | EN: Fault code PUMG_OBD - fault class selection (lamp / warning behaviour) [V912: differs from V452 160E]" VALUE 0x71840 TKW_VV_VV_UB 100.0 FORMULA_0003 0.0 8.0000 /end CHARACTERISTIC
/begin CHARACTERISTIC K_ED_SL_ML_HFM_OBD.KLASSENINDEX "Auswahl der Fehlerklasse | EN: Fault code SL_ML_HFM_OBD - fault class selection (lamp / warning behaviour) [V912: differs from V452 160E]" VALUE 0x7185A TKW_VV_VV_UB 100.0 FORMULA_0003 0.0 8.0000 /end CHARACTERISTIC
/begin CHARACTERISTIC K_ED_TGETR_HS.KLASSENINDEX "Auswahl der Fehlerklasse | EN: Fault code TGETR_HS - fault class selection (lamp / warning behaviour)" VALUE 0x71992 TKW_VV_VV_UB 100.0 FORMULA_0003 0.0 8.0000 /end CHARACTERISTIC
/begin CHARACTERISTIC K_ED_PT_OBD_ED.KLASSENINDEX "Auswahl der Fehlerklasse" VALUE 0x719E0 TKW_VV_VV_UB 100.0 FORMULA_0003 0.0 8.0000 /end CHARACTERISTIC
/begin CHARACTERISTIC K_ED_RBM_TIME_SLP "SLP-Mindestzeit fuer Fahrzyklus | EN: SLP-Mindestzeit fuer Fahrzyklus" VALUE 0x71CAA TKW_VV_VV_UW 100.0 FORMULA_0073 0.0 6553.5000 FORMAT "%4.1" /end CHARACTERISTIC
/begin FUNCTION Eigendiagnose ""
 /begin DEF_CHARACTERISTIC K_ED_PT_LRW.KLASSENINDEX K_ED_PT_LRW.OK_SCHWELLE K_ED_PT_LRW.P_CODE_OPENLOAD K_ED_PT_LRW.P_CODE_SH_TO_GND K_ED_PT_LRW.P_CODE_SH_TO_UB K_ED_PT_LRW.P_CODE_UNPLAUSIBEL K_ED_PT_OBD_ED.DEC_NACH_EINTRAG K_ED_PT_OBD_ED.DEC_VOR_EINTRAG K_ED_PT_OBD_ED.FEHLERSCHWELLE K_ED_PT_OBD_ED.INC_NACH_EINTRAG K_ED_PT_OBD_ED.INC_VOR_EINTRAG K_ED_PT_OBD_ED.KLASSENINDEX K_ED_PT_OBD_ED.OK_SCHWELLE K_ED_PT_OBD_ED.P_CODE_OPENLOAD K_ED_PT_OBD_ED.P_CODE_SH_TO_GND K_ED_PT_OBD_ED.P_CODE_SH_TO_UB K_ED_PT_OBD_ED.P_CODE_UNPLAUSIBEL K_ED_PT_STATANH.DEC_NACH_EINTRAG K_ED_PT_STATANH.DEC_VOR_EINTRAG K_ED_PT_STATANH.FEHLERSCHWELLE K_ED_PT_STATANH.INC_NACH_EINTRAG K_ED_PT_STATANH.INC_VOR_EINTRAG K_ED_PT_STATANH.KLASSENINDEX K_ED_PT_STATANH.OK_SCHWELLE K_ED_PT_STATANH.P_CODE_OPENLOAD K_ED_PT_STATANH.P_CODE_SH_TO_GND K_ED_PT_STATANH.P_CODE_SH_TO_UB K_ED_PT_STATANH.P_CODE_UNPLAUSIBEL K_ED_PT_STATDKG.DEC_NACH_EINTRAG K_ED_PT_STATDKG.DEC_VOR_EINTRAG K_ED_PT_STATDKG.FEHLERSCHWELLE K_ED_PT_STATDKG.INC_NACH_EINTRAG K_ED_PT_STATDKG.INC_VOR_EINTRAG K_ED_PT_STATDKG.KLASSENINDEX K_ED_PT_STATDKG.OK_SCHWELLE K_ED_PT_STATDKG.P_CODE_OPENLOAD K_ED_PT_STATDKG.P_CODE_SH_TO_GND K_ED_PT_STATDKG.P_CODE_SH_TO_UB K_ED_PT_STATDKG.P_CODE_UNPLAUSIBEL K_ED_PT_STATGRB.DEC_NACH_EINTRAG K_ED_PT_STATGRB.DEC_VOR_EINTRAG K_ED_PT_STATGRB.FEHLERSCHWELLE K_ED_PT_STATGRB.INC_NACH_EINTRAG K_ED_PT_STATGRB.INC_VOR_EINTRAG K_ED_PT_STATGRB.KLASSENINDEX K_ED_PT_STATGRB.OK_SCHWELLE K_ED_PT_STATGRB.P_CODE_OPENLOAD K_ED_PT_STATGRB.P_CODE_SH_TO_GND K_ED_PT_STATGRB.P_CODE_SH_TO_UB K_ED_PT_STATGRB.P_CODE_UNPLAUSIBEL K_ED_PT_STATR.DEC_NACH_EINTRAG K_ED_PT_STATR.DEC_VOR_EINTRAG K_ED_PT_STATR.FEHLERSCHWELLE K_ED_PT_STATR.INC_NACH_EINTRAG K_ED_PT_STATR.INC_VOR_EINTRAG K_ED_PT_STATR.KLASSENINDEX K_ED_PT_STATR.OK_SCHWELLE K_ED_PT_STATR.P_CODE_OPENLOAD K_ED_PT_STATR.P_CODE_SH_TO_GND K_ED_PT_STATR.P_CODE_SH_TO_UB K_ED_PT_STATR.P_CODE_UNPLAUSIBEL K_ED_PT_STDSC.DEC_NACH_EINTRAG K_ED_PT_STDSC.DEC_VOR_EINTRAG K_ED_PT_STDSC.FEHLERSCHWELLE K_ED_PT_STDSC.INC_NACH_EINTRAG K_ED_PT_STDSC.INC_VOR_EINTRAG K_ED_PT_STDSC.KLASSENINDEX K_ED_PT_STDSC.OK_SCHWELLE K_ED_PT_STDSC.P_CODE_OPENLOAD K_ED_PT_STDSC.P_CODE_SH_TO_GND K_ED_PT_STDSC.P_CODE_SH_TO_UB K_ED_PT_STDSC.P_CODE_UNPLAUSIBEL K_ED_PT_TOMA.DEC_NACH_EINTRAG K_ED_PT_TOMA.DEC_VOR_EINTRAG K_ED_PT_TOMA.FEHLERSCHWELLE K_ED_PT_TOMA.INC_NACH_EINTRAG K_ED_PT_TOMA.INC_VOR_EINTRAG K_ED_PT_TOMA.KLASSENINDEX K_ED_PT_TOMA.OK_SCHWELLE K_ED_PT_TOMA.P_CODE_OPENLOAD K_ED_PT_TOMA.P_CODE_SH_TO_GND K_ED_PT_TOMA.P_CODE_SH_TO_UB K_ED_PT_TOMA.P_CODE_UNPLAUSIBEL K_ED_PT_TORQDSC.DEC_NACH_EINTRAG K_ED_PT_TORQDSC.DEC_VOR_EINTRAG K_ED_PT_TORQDSC.FEHLERSCHWELLE K_ED_PT_TORQDSC.INC_NACH_EINTRAG K_ED_PT_TORQDSC.INC_VOR_EINTRAG K_ED_PT_TORQDSC.KLASSENINDEX K_ED_PT_TORQDSC.OK_SCHWELLE K_ED_PT_TORQDSC.P_CODE_OPENLOAD K_ED_PT_TORQDSC.P_CODE_SH_TO_GND K_ED_PT_TORQDSC.P_CODE_SH_TO_UB K_ED_PT_TORQDSC.P_CODE_UNPLAUSIBEL K_ED_PT_VEHMOD.DEC_NACH_EINTRAG K_ED_PT_VEHMOD.DEC_VOR_EINTRAG K_ED_PT_VEHMOD.FEHLERSCHWELLE K_ED_PT_VEHMOD.INC_NACH_EINTRAG K_ED_PT_VEHMOD.INC_VOR_EINTRAG K_ED_PT_VEHMOD.KLASSENINDEX K_ED_PT_VEHMOD.OK_SCHWELLE K_ED_PT_VEHMOD.P_CODE_OPENLOAD K_ED_PT_VEHMOD.P_CODE_SH_TO_GND K_ED_PT_VEHMOD.P_CODE_SH_TO_UB K_ED_PT_VEHMOD.P_CODE_UNPLAUSIBEL K_ED_PT_VFZG.DEC_NACH_EINTRAG K_ED_PT_VFZG.DEC_VOR_EINTRAG K_ED_PT_VFZG.FEHLERSCHWELLE K_ED_PT_VFZG.INC_NACH_EINTRAG K_ED_PT_VFZG.INC_VOR_EINTRAG K_ED_PT_VFZG.KLASSENINDEX K_ED_PT_VFZG.OK_SCHWELLE K_ED_PT_VFZG.P_CODE_OPENLOAD K_ED_PT_VFZG.P_CODE_SH_TO_GND K_ED_PT_VFZG.P_CODE_SH_TO_UB K_ED_PT_VFZG.P_CODE_UNPLAUSIBEL K_ED_PT_VRAD.DEC_NACH_EINTRAG K_ED_PT_VRAD.DEC_VOR_EINTRAG K_ED_PT_VRAD.FEHLERSCHWELLE K_ED_PT_VRAD.INC_NACH_EINTRAG K_ED_PT_VRAD.INC_VOR_EINTRAG K_ED_PT_VRAD.KLASSENINDEX K_ED_PT_VRAD.OK_SCHWELLE K_ED_PT_VRAD.P_CODE_OPENLOAD K_ED_PT_VRAD.P_CODE_SH_TO_GND K_ED_PT_VRAD.P_CODE_SH_TO_UB K_ED_PT_VRAD.P_CODE_UNPLAUSIBEL K_ED_PUMG.DEC_NACH_EINTRAG K_ED_PUMG.DEC_VOR_EINTRAG K_ED_PUMG.FEHLERSCHWELLE K_ED_PUMG.INC_NACH_EINTRAG K_ED_PUMG.INC_VOR_EINTRAG K_ED_PUMG.OK_SCHWELLE K_ED_PUMG.P_CODE_SH_TO_GND K_ED_PUMG.P_CODE_SH_TO_UB K_ED_PUMG_OBD.DEC_NACH_EINTRAG K_ED_PUMG_OBD.DEC_VOR_EINTRAG K_ED_PUMG_OBD.FEHLERSCHWELLE K_ED_PUMG_OBD.INC_NACH_EINTRAG K_ED_PUMG_OBD.INC_VOR_EINTRAG K_ED_PUMG_OBD.KLASSENINDEX K_ED_PUMG_OBD.OK_SCHWELLE K_ED_PUMG_OBD.P_CODE_OPENLOAD K_ED_PUMG_OBD.P_CODE_SH_TO_GND K_ED_PUMG_OBD.P_CODE_SH_TO_UB K_ED_PUMG_OBD.P_CODE_UNPLAUSIBEL K_ED_RBM_EVAP_MAX K_ED_RBM_EVAP_MIN K_ED_RBM_EVAP_TEMP_DELTA K_ED_RBM_PUMG_MIN K_ED_RBM_TIME K_ED_RBM_TIME_LL K_ED_RBM_TIME_SLP K_ED_RBM_TIME_V K_ED_RBM_TUMG_MIN K_ED_RBM_V_MIN K_ED_RLSLP.DEC_NACH_EINTRAG K_ED_RLSLP.DEC_VOR_EINTRAG K_ED_RLSLP.FEHLERSCHWELLE K_ED_RLSLP.INC_NACH_EINTRAG K_ED_RLSLP.INC_VOR_EINTRAG K_ED_RLSLP.KLASSENINDEX K_ED_RLSLP.OK_SCHWELLE K_ED_RLSLP.P_CODE_OPENLOAD K_ED_RLSLP.P_CODE_SH_TO_GND K_ED_RLSLP.P_CODE_SH_TO_UB K_ED_RLSLP.P_CODE_UNPLAUSIBEL K_ED_RLU87.DEC_NACH_EINTRAG K_ED_RLU87.DEC_VOR_EINTRAG K_ED_RLU87.FEHLERSCHWELLE K_ED_RLU87.INC_NACH_EINTRAG K_ED_RLU87.INC_VOR_EINTRAG K_ED_RLU87.KLASSENINDEX K_ED_RLU87.OK_SCHWELLE K_ED_RLU87.P_CODE_OPENLOAD K_ED_RLU87.P_CODE_SH_TO_GND K_ED_RLU87.P_CODE_SH_TO_UB K_ED_RLU87.P_CODE_UNPLAUSIBEL K_ED_SCDN_ABDECKUNG_AUSTRAG K_ED_SCDN_ABDECKUNG_EINTRAG K_ED_SG_INJ.DEC_NACH_EINTRAG K_ED_SG_INJ.DEC_VOR_EINTRAG K_ED_SG_INJ.FEHLERSCHWELLE K_ED_SG_INJ.INC_NACH_EINTRAG K_ED_SG_INJ.INC_VOR_EINTRAG K_ED_SG_INJ.KLASSENINDEX K_ED_SG_INJ.OK_SCHWELLE K_ED_SG_INJ.P_CODE_OPENLOAD K_ED_SG_INJ.P_CODE_SH_TO_GND K_ED_SG_INJ.P_CODE_SH_TO_UB K_ED_SG_INJ.P_CODE_UNPLAUSIBEL K_ED_SK_MANAGER_INJ.DEC_NACH_EINTRAG K_ED_SK_MANAGER_INJ.DEC_VOR_EINTRAG K_ED_SK_MANAGER_INJ.FEHLERSCHWELLE K_ED_SK_MANAGER_INJ.INC_NACH_EINTRAG K_ED_SK_MANAGER_INJ.INC_VOR_EINTRAG K_ED_SK_MANAGER_INJ.KLASSENINDEX K_ED_SK_MANAGER_INJ.OK_SCHWELLE K_ED_SK_MANAGER_INJ.P_CODE_OPENLOAD K_ED_SK_MANAGER_INJ.P_CODE_SH_TO_GND K_ED_SK_MANAGER_INJ.P_CODE_SH_TO_UB K_ED_SK_MANAGER_INJ.P_CODE_UNPLAUSIBEL K_ED_SK_TR_INJ.DEC_NACH_EINTRAG K_ED_SK_TR_INJ.DEC_VOR_EINTRAG K_ED_SK_TR_INJ.FEHLERSCHWELLE K_ED_SK_TR_INJ.INC_NACH_EINTRAG K_ED_SK_TR_INJ.INC_VOR_EINTRAG K_ED_SK_TR_INJ.KLASSENINDEX K_ED_SK_TR_INJ.OK_SCHWELLE K_ED_SK_TR_INJ.P_CODE_OPENLOAD K_ED_SK_TR_INJ.P_CODE_SH_TO_GND K_ED_SK_TR_INJ.P_CODE_SH_TO_UB K_ED_SK_TR_INJ.P_CODE_UNPLAUSIBEL K_ED_SLP.DEC_NACH_EINTRAG K_ED_SLP.DEC_VOR_EINTRAG K_ED_SLP.FEHLERSCHWELLE K_ED_SLP.INC_NACH_EINTRAG K_ED_SLP.INC_VOR_EINTRAG K_ED_SLP.KLASSENINDEX K_ED_SLP.OK_SCHWELLE K_ED_SLP.P_CODE_OPENLOAD K_ED_SLP.P_CODE_SH_TO_GND K_ED_SLP.P_CODE_SH_TO_UB K_ED_SLP.P_CODE_UNPLAUSIBEL K_ED_SLV.DEC_NACH_EINTRAG K_ED_SLV.DEC_VOR_EINTRAG K_ED_SLV.FEHLERSCHWELLE K_ED_SLV.INC_NACH_EINTRAG K_ED_SLV.INC_VOR_EINTRAG K_ED_SLV.KLASSENINDEX K_ED_SLV.OK_SCHWELLE K_ED_SLV.P_CODE_OPENLOAD K_ED_SLV.P_CODE_SH_TO_GND K_ED_SLV.P_CODE_SH_TO_UB K_ED_SLV.P_CODE_UNPLAUSIBEL K_ED_SL_DURCHS_B1.DEC_NACH_EINTRAG K_ED_SL_DURCHS_B1.DEC_VOR_EINTRAG K_ED_SL_DURCHS_B1.FEHLERSCHWELLE K_ED_SL_DURCHS_B1.INC_NACH_EINTRAG K_ED_SL_DURCHS_B1.INC_VOR_EINTRAG K_ED_SL_DURCHS_B1.KLASSENINDEX K_ED_SL_DURCHS_B1.OK_SCHWELLE K_ED_SL_DURCHS_B1.P_CODE_OPENLOAD K_ED_SL_DURCHS_B1.P_CODE_SH_TO_GND K_ED_SL_DURCHS_B1.P_CODE_SH_TO_UB K_ED_SL_DURCHS_B1.P_CODE_UNPLAUSIBEL K_ED_SL_DURCHS_B2.DEC_NACH_EINTRAG K_ED_SL_DURCHS_B2.DEC_VOR_EINTRAG K_ED_SL_DURCHS_B2.FEHLERSCHWELLE K_ED_SL_DURCHS_B2.INC_NACH_EINTRAG K_ED_SL_DURCHS_B2.INC_VOR_EINTRAG K_ED_SL_DURCHS_B2.KLASSENINDEX K_ED_SL_DURCHS_B2.OK_SCHWELLE K_ED_SL_DURCHS_B2.P_CODE_OPENLOAD K_ED_SL_DURCHS_B2.P_CODE_SH_TO_GND K_ED_SL_DURCHS_B2.P_CODE_SH_TO_UB K_ED_SL_DURCHS_B2.P_CODE_UNPLAUSIBEL K_ED_SL_DURCHS_HSTRANG.DEC_NACH_EINTRAG K_ED_SL_DURCHS_HSTRANG.DEC_VOR_EINTRAG K_ED_SL_DURCHS_HSTRANG.FEHLERSCHWELLE K_ED_SL_DURCHS_HSTRANG.INC_NACH_EINTRAG K_ED_SL_DURCHS_HSTRANG.INC_VOR_EINTRAG K_ED_SL_DURCHS_HSTRANG.KLASSENINDEX K_ED_SL_DURCHS_HSTRANG.OK_SCHWELLE K_ED_SL_DURCHS_HSTRANG.P_CODE_OPENLOAD K_ED_SL_DURCHS_HSTRANG.P_CODE_SH_TO_GND K_ED_SL_DURCHS_HSTRANG.P_CODE_SH_TO_UB K_ED_SL_DURCHS_HSTRANG.P_CODE_UNPLAUSIBEL K_ED_SL_ML_HFM.DEC_NACH_EINTRAG K_ED_SL_ML_HFM.DEC_VOR_EINTRAG K_ED_SL_ML_HFM.FEHLERSCHWELLE K_ED_SL_ML_HFM.INC_NACH_EINTRAG K_ED_SL_ML_HFM.INC_VOR_EINTRAG K_ED_SL_ML_HFM.KLASSENINDEX K_ED_SL_ML_HFM.OK_SCHWELLE K_ED_SL_ML_HFM.P_CODE_OPENLOAD K_ED_SL_ML_HFM.P_CODE_SH_TO_GND K_ED_SL_ML_HFM.P_CODE_SH_TO_UB K_ED_SL_ML_HFM.P_CODE_UNPLAUSIBEL K_ED_SL_ML_HFM_OBD.DEC_NACH_EINTRAG K_ED_SL_ML_HFM_OBD.DEC_VOR_EINTRAG K_ED_SL_ML_HFM_OBD.FEHLERSCHWELLE K_ED_SL_ML_HFM_OBD.INC_NACH_EINTRAG K_ED_SL_ML_HFM_OBD.INC_VOR_EINTRAG K_ED_SL_ML_HFM_OBD.KLASSENINDEX K_ED_SL_ML_HFM_OBD.OK_SCHWELLE K_ED_SL_ML_HFM_OBD.P_CODE_OPENLOAD K_ED_SL_ML_HFM_OBD.P_CODE_SH_TO_GND K_ED_SL_ML_HFM_OBD.P_CODE_SH_TO_UB K_ED_SL_ML_HFM_OBD.P_CODE_UNPLAUSIBEL K_ED_SSP.DEC_NACH_EINTRAG K_ED_SSP.DEC_VOR_EINTRAG K_ED_SSP.FEHLERSCHWELLE K_ED_SSP.INC_NACH_EINTRAG K_ED_SSP.INC_VOR_EINTRAG K_ED_SSP.KLASSENINDEX K_ED_SSP.OK_SCHWELLE K_ED_SSP.P_CODE_OPENLOAD K_ED_SSP.P_CODE_SH_TO_GND K_ED_SSP.P_CODE_SH_TO_UB K_ED_SSP.P_CODE_UNPLAUSIBEL K_ED_SSP_DIAG.DEC_NACH_EINTRAG K_ED_SSP_DIAG.DEC_VOR_EINTRAG K_ED_SSP_DIAG.FEHLERSCHWELLE K_ED_SSP_DIAG.INC_NACH_EINTRAG K_ED_SSP_DIAG.INC_VOR_EINTRAG K_ED_SSP_DIAG.KLASSENINDEX K_ED_SSP_DIAG.OK_SCHWELLE K_ED_SSP_DIAG.P_CODE_OPENLOAD K_ED_SSP_DIAG.P_CODE_SH_TO_GND K_ED_SSP_DIAG.P_CODE_SH_TO_UB K_ED_SSP_DIAG.P_CODE_UNPLAUSIBEL K_ED_S_GETR_HS.DEC_NACH_EINTRAG K_ED_S_GETR_HS.DEC_VOR_EINTRAG K_ED_S_GETR_HS.FEHLERSCHWELLE K_ED_S_GETR_HS.INC_NACH_EINTRAG K_ED_S_GETR_HS.INC_VOR_EINTRAG K_ED_S_GETR_HS.KLASSENINDEX K_ED_S_GETR_HS.OK_SCHWELLE K_ED_S_GETR_HS.P_CODE_OPENLOAD K_ED_S_GETR_HS.P_CODE_SH_TO_GND K_ED_S_GETR_HS.P_CODE_SH_TO_UB K_ED_S_GETR_HS.P_CODE_UNPLAUSIBEL K_ED_S_KUPP_HS.DEC_NACH_EINTRAG K_ED_S_KUPP_HS.DEC_VOR_EINTRAG K_ED_S_KUPP_HS.FEHLERSCHWELLE K_ED_S_KUPP_HS.INC_NACH_EINTRAG K_ED_S_KUPP_HS.INC_VOR_EINTRAG K_ED_S_KUPP_HS.KLASSENINDEX K_ED_S_KUPP_HS.OK_SCHWELLE K_ED_S_KUPP_HS.P_CODE_OPENLOAD K_ED_S_KUPP_HS.P_CODE_SH_TO_GND K_ED_S_KUPP_HS.P_CODE_SH_TO_UB K_ED_S_KUPP_HS.P_CODE_UNPLAUSIBEL K_ED_S_POEL_DIAG.DEC_NACH_EINTRAG K_ED_S_POEL_DIAG.DEC_VOR_EINTRAG K_ED_S_POEL_DIAG.FEHLERSCHWELLE K_ED_S_POEL_DIAG.INC_NACH_EINTRAG K_ED_S_POEL_DIAG.INC_VOR_EINTRAG K_ED_S_POEL_DIAG.KLASSENINDEX K_ED_S_POEL_DIAG.OK_SCHWELLE K_ED_S_POEL_DIAG.P_CODE_OPENLOAD K_ED_S_POEL_DIAG.P_CODE_SH_TO_GND K_ED_S_POEL_DIAG.P_CODE_SH_TO_UB K_ED_S_POEL_DIAG.P_CODE_UNPLAUSIBEL K_ED_TANK_LEER.DEC_NACH_EINTRAG K_ED_TANK_LEER.DEC_VOR_EINTRAG K_ED_TANK_LEER.FEHLERSCHWELLE K_ED_TANK_LEER.INC_NACH_EINTRAG K_ED_TANK_LEER.INC_VOR_EINTRAG K_ED_TANK_LEER.KLASSENINDEX K_ED_TANK_LEER.OK_SCHWELLE K_ED_TANK_LEER.P_CODE_OPENLOAD K_ED_TANK_LEER.P_CODE_SH_TO_GND K_ED_TANK_LEER.P_CODE_SH_TO_UB K_ED_TANK_LEER.P_CODE_UNPLAUSIBEL K_ED_TD.DEC_NACH_EINTRAG K_ED_TD.DEC_VOR_EINTRAG K_ED_TD.FEHLERSCHWELLE K_ED_TD.INC_NACH_EINTRAG K_ED_TD.INC_VOR_EINTRAG K_ED_TD.KLASSENINDEX K_ED_TD.OK_SCHWELLE K_ED_TD.P_CODE_OPENLOAD K_ED_TD.P_CODE_SH_TO_GND K_ED_TD.P_CODE_SH_TO_UB K_ED_TD.P_CODE_UNPLAUSIBEL K_ED_TEV1.DEC_NACH_EINTRAG K_ED_TEV1.DEC_VOR_EINTRAG K_ED_TEV1.FEHLERSCHWELLE K_ED_TEV1.INC_NACH_EINTRAG K_ED_TEV1.INC_VOR_EINTRAG K_ED_TEV1.KLASSENINDEX K_ED_TEV1.OK_SCHWELLE K_ED_TEV1.P_CODE_OPENLOAD K_ED_TEV1.P_CODE_SH_TO_GND K_ED_TEV1.P_CODE_SH_TO_UB K_ED_TEV1.P_CODE_UNPLAUSIBEL K_ED_TEV2.DEC_NACH_EINTRAG K_ED_TEV2.DEC_VOR_EINTRAG K_ED_TEV2.FEHLERSCHWELLE K_ED_TEV2.INC_NACH_EINTRAG K_ED_TEV2.INC_VOR_EINTRAG K_ED_TEV2.KLASSENINDEX K_ED_TEV2.OK_SCHWELLE K_ED_TEV2.P_CODE_OPENLOAD K_ED_TEV2.P_CODE_SH_TO_GND K_ED_TEV2.P_CODE_SH_TO_UB K_ED_TEV2.P_CODE_UNPLAUSIBEL K_ED_TE_OBD_1.DEC_NACH_EINTRAG K_ED_TE_OBD_1.DEC_VOR_EINTRAG K_ED_TE_OBD_1.FEHLERSCHWELLE K_ED_TE_OBD_1.INC_NACH_EINTRAG K_ED_TE_OBD_1.INC_VOR_EINTRAG K_ED_TE_OBD_1.KLASSENINDEX K_ED_TE_OBD_1.OK_SCHWELLE K_ED_TE_OBD_1.P_CODE_OPENLOAD K_ED_TE_OBD_1.P_CODE_SH_TO_GND K_ED_TE_OBD_1.P_CODE_SH_TO_UB K_ED_TE_OBD_1.P_CODE_UNPLAUSIBEL K_ED_TE_OBD_2.DEC_NACH_EINTRAG K_ED_TE_OBD_2.DEC_VOR_EINTRAG K_ED_TE_OBD_2.FEHLERSCHWELLE K_ED_TE_OBD_2.INC_NACH_EINTRAG K_ED_TE_OBD_2.INC_VOR_EINTRAG K_ED_TE_OBD_2.KLASSENINDEX K_ED_TE_OBD_2.OK_SCHWELLE K_ED_TE_OBD_2.P_CODE_OPENLOAD K_ED_TE_OBD_2.P_CODE_SH_TO_GND K_ED_TE_OBD_2.P_CODE_SH_TO_UB K_ED_TE_OBD_2.P_CODE_UNPLAUSIBEL K_ED_TGETR_HS.DEC_NACH_EINTRAG K_ED_TGETR_HS.DEC_VOR_EINTRAG K_ED_TGETR_HS.FEHLERSCHWELLE K_ED_TGETR_HS.INC_NACH_EINTRAG K_ED_TGETR_HS.INC_VOR_EINTRAG K_ED_TGETR_HS.KLASSENINDEX K_ED_TGETR_HS.OK_SCHWELLE K_ED_TGETR_HS.P_CODE_OPENLOAD K_ED_TGETR_HS.P_CODE_SH_TO_GND K_ED_TGETR_HS.P_CODE_SH_TO_UB K_ED_TGETR_HS.P_CODE_UNPLAUSIBEL K_ED_TZ1.DEC_NACH_EINTRAG K_ED_TZ1.DEC_VOR_EINTRAG K_ED_TZ1.FEHLERSCHWELLE K_ED_TZ1.INC_NACH_EINTRAG K_ED_TZ1.INC_VOR_EINTRAG K_ED_TZ1.KLASSENINDEX K_ED_TZ1.OK_SCHWELLE K_ED_TZ1.P_CODE_OPENLOAD K_ED_TZ1.P_CODE_SH_TO_GND K_ED_TZ1.P_CODE_SH_TO_UB K_ED_TZ1.P_CODE_UNPLAUSIBEL K_ED_TZ10.DEC_NACH_EINTRAG K_ED_TZ10.DEC_VOR_EINTRAG K_ED_TZ10.FEHLERSCHWELLE K_ED_TZ10.INC_NACH_EINTRAG K_ED_TZ10.INC_VOR_EINTRAG K_ED_TZ10.KLASSENINDEX K_ED_TZ10.OK_SCHWELLE K_ED_TZ10.P_CODE_OPENLOAD K_ED_TZ10.P_CODE_SH_TO_GND K_ED_TZ10.P_CODE_SH_TO_UB K_ED_TZ10.P_CODE_UNPLAUSIBEL K_ED_TZ2.DEC_NACH_EINTRAG K_ED_TZ2.DEC_VOR_EINTRAG K_ED_TZ2.FEHLERSCHWELLE K_ED_TZ2.INC_NACH_EINTRAG K_ED_TZ2.INC_VOR_EINTRAG K_ED_TZ2.KLASSENINDEX K_ED_TZ2.OK_SCHWELLE K_ED_TZ2.P_CODE_OPENLOAD K_ED_TZ2.P_CODE_SH_TO_GND K_ED_TZ2.P_CODE_SH_TO_UB K_ED_TZ2.P_CODE_UNPLAUSIBEL K_ED_TZ3.DEC_NACH_EINTRAG K_ED_TZ3.DEC_VOR_EINTRAG K_ED_TZ3.FEHLERSCHWELLE K_ED_TZ3.INC_NACH_EINTRAG K_ED_TZ3.INC_VOR_EINTRAG K_ED_TZ3.KLASSENINDEX K_ED_TZ3.OK_SCHWELLE K_ED_TZ3.P_CODE_OPENLOAD K_ED_TZ3.P_CODE_SH_TO_GND K_ED_TZ3.P_CODE_SH_TO_UB K_ED_TZ3.P_CODE_UNPLAUSIBEL K_ED_TZ4.DEC_NACH_EINTRAG K_ED_TZ4.DEC_VOR_EINTRAG K_ED_TZ4.FEHLERSCHWELLE K_ED_TZ4.INC_NACH_EINTRAG K_ED_TZ4.INC_VOR_EINTRAG K_ED_TZ4.KLASSENINDEX K_ED_TZ4.OK_SCHWELLE K_ED_TZ4.P_CODE_OPENLOAD K_ED_TZ4.P_CODE_SH_TO_GND K_ED_TZ4.P_CODE_SH_TO_UB K_ED_TZ4.P_CODE_UNPLAUSIBEL K_ED_TZ5.DEC_NACH_EINTRAG K_ED_TZ5.DEC_VOR_EINTRAG K_ED_TZ5.FEHLERSCHWELLE K_ED_TZ5.INC_NACH_EINTRAG K_ED_TZ5.INC_VOR_EINTRAG K_ED_TZ5.KLASSENINDEX K_ED_TZ5.OK_SCHWELLE K_ED_TZ5.P_CODE_OPENLOAD K_ED_TZ5.P_CODE_SH_TO_GND K_ED_TZ5.P_CODE_SH_TO_UB K_ED_TZ5.P_CODE_UNPLAUSIBEL K_ED_TZ6.DEC_NACH_EINTRAG K_ED_TZ6.DEC_VOR_EINTRAG K_ED_TZ6.FEHLERSCHWELLE K_ED_TZ6.INC_NACH_EINTRAG K_ED_TZ6.INC_VOR_EINTRAG K_ED_TZ6.KLASSENINDEX K_ED_TZ6.OK_SCHWELLE K_ED_TZ6.P_CODE_OPENLOAD K_ED_TZ6.P_CODE_SH_TO_GND K_ED_TZ6.P_CODE_SH_TO_UB K_ED_TZ6.P_CODE_UNPLAUSIBEL K_ED_TZ7.DEC_NACH_EINTRAG K_ED_TZ7.DEC_VOR_EINTRAG K_ED_TZ7.FEHLERSCHWELLE K_ED_TZ7.INC_NACH_EINTRAG K_ED_TZ7.INC_VOR_EINTRAG K_ED_TZ7.KLASSENINDEX K_ED_TZ7.OK_SCHWELLE K_ED_TZ7.P_CODE_OPENLOAD K_ED_TZ7.P_CODE_SH_TO_GND K_ED_TZ7.P_CODE_SH_TO_UB K_ED_TZ7.P_CODE_UNPLAUSIBEL K_ED_TZ8.DEC_NACH_EINTRAG K_ED_TZ8.DEC_VOR_EINTRAG K_ED_TZ8.FEHLERSCHWELLE K_ED_TZ8.INC_NACH_EINTRAG K_ED_TZ8.INC_VOR_EINTRAG K_ED_TZ8.KLASSENINDEX K_ED_TZ8.OK_SCHWELLE K_ED_TZ8.P_CODE_OPENLOAD K_ED_TZ8.P_CODE_SH_TO_GND K_ED_TZ8.P_CODE_SH_TO_UB K_ED_TZ8.P_CODE_UNPLAUSIBEL K_ED_TZ9.DEC_NACH_EINTRAG K_ED_TZ9.DEC_VOR_EINTRAG K_ED_TZ9.FEHLERSCHWELLE K_ED_TZ9.INC_NACH_EINTRAG K_ED_TZ9.INC_VOR_EINTRAG K_ED_TZ9.KLASSENINDEX K_ED_TZ9.OK_SCHWELLE K_ED_TZ9.P_CODE_OPENLOAD K_ED_TZ9.P_CODE_SH_TO_GND K_ED_TZ9.P_CODE_SH_TO_UB K_ED_TZ9.P_CODE_UNPLAUSIBEL K_ED_UBMIN K_ED_VAN_ANSCHL_A1.DEC_NACH_EINTRAG K_ED_VAN_ANSCHL_A1.DEC_VOR_EINTRAG K_ED_VAN_ANSCHL_A1.FEHLERSCHWELLE K_ED_VAN_ANSCHL_A1.INC_NACH_EINTRAG K_ED_VAN_ANSCHL_A1.INC_VOR_EINTRAG K_ED_VAN_ANSCHL_A1.KLASSENINDEX K_ED_VAN_ANSCHL_A1.OK_SCHWELLE K_ED_VAN_ANSCHL_A1.P_CODE_OPENLOAD K_ED_VAN_ANSCHL_A1.P_CODE_SH_TO_GND K_ED_VAN_ANSCHL_A1.P_CODE_SH_TO_UB K_ED_VAN_ANSCHL_A1.P_CODE_UNPLAUSIBEL K_ED_VAN_ANSCHL_A2.DEC_NACH_EINTRAG K_ED_VAN_ANSCHL_A2.DEC_VOR_EINTRAG K_ED_VAN_ANSCHL_A2.FEHLERSCHWELLE K_ED_VAN_ANSCHL_A2.INC_NACH_EINTRAG K_ED_VAN_ANSCHL_A2.INC_VOR_EINTRAG K_ED_VAN_ANSCHL_A2.KLASSENINDEX K_ED_VAN_ANSCHL_A2.OK_SCHWELLE K_ED_VAN_ANSCHL_A2.P_CODE_OPENLOAD K_ED_VAN_ANSCHL_A2.P_CODE_SH_TO_GND K_ED_VAN_ANSCHL_A2.P_CODE_SH_TO_UB K_ED_VAN_ANSCHL_A2.P_CODE_UNPLAUSIBEL K_ED_VAN_ANSCHL_E1.DEC_NACH_EINTRAG K_ED_VAN_ANSCHL_E1.DEC_VOR_EINTRAG K_ED_VAN_ANSCHL_E1.FEHLERSCHWELLE K_ED_VAN_ANSCHL_E1.INC_NACH_EINTRAG K_ED_VAN_ANSCHL_E1.INC_VOR_EINTRAG K_ED_VAN_ANSCHL_E1.KLASSENINDEX K_ED_VAN_ANSCHL_E1.OK_SCHWELLE K_ED_VAN_ANSCHL_E1.P_CODE_OPENLOAD K_ED_VAN_ANSCHL_E1.P_CODE_SH_TO_GND K_ED_VAN_ANSCHL_E1.P_CODE_SH_TO_UB K_ED_VAN_ANSCHL_E1.P_CODE_UNPLAUSIBEL K_ED_VAN_ANSCHL_E2.DEC_NACH_EINTRAG K_ED_VAN_ANSCHL_E2.DEC_VOR_EINTRAG K_ED_VAN_ANSCHL_E2.FEHLERSCHWELLE K_ED_VAN_ANSCHL_E2.INC_NACH_EINTRAG K_ED_VAN_ANSCHL_E2.INC_VOR_EINTRAG K_ED_VAN_ANSCHL_E2.KLASSENINDEX K_ED_VAN_ANSCHL_E2.OK_SCHWELLE K_ED_VAN_ANSCHL_E2.P_CODE_OPENLOAD K_ED_VAN_ANSCHL_E2.P_CODE_SH_TO_GND K_ED_VAN_ANSCHL_E2.P_CODE_SH_TO_UB K_ED_VAN_ANSCHL_E2.P_CODE_UNPLAUSIBEL K_ED_VAN_DRUCK.DEC_NACH_EINTRAG K_ED_VAN_DRUCK.DEC_VOR_EINTRAG K_ED_VAN_DRUCK.FEHLERSCHWELLE K_ED_VAN_DRUCK.INC_NACH_EINTRAG K_ED_VAN_DRUCK.INC_VOR_EINTRAG K_ED_VAN_DRUCK.KLASSENINDEX K_ED_VAN_DRUCK.OK_SCHWELLE K_ED_VAN_DRUCK.P_CODE_OPENLOAD K_ED_VAN_DRUCK.P_CODE_SH_TO_GND K_ED_VAN_DRUCK.P_CODE_SH_TO_UB K_ED_VAN_DRUCK.P_CODE_UNPLAUSIBEL K_ED_VAN_DSV.DEC_NACH_EINTRAG K_ED_VAN_DSV.DEC_VOR_EINTRAG K_ED_VAN_DSV.FEHLERSCHWELLE K_ED_VAN_DSV.INC_NACH_EINTRAG K_ED_VAN_DSV.INC_VOR_EINTRAG K_ED_VAN_DSV.KLASSENINDEX K_ED_VAN_DSV.OK_SCHWELLE K_ED_VAN_DSV.P_CODE_OPENLOAD K_ED_VAN_DSV.P_CODE_SH_TO_GND K_ED_VAN_DSV.P_CODE_SH_TO_UB K_ED_VAN_DSV.P_CODE_UNPLAUSIBEL K_ED_VAN_HALL_A1.DEC_NACH_EINTRAG K_ED_VAN_HALL_A1.DEC_VOR_EINTRAG K_ED_VAN_HALL_A1.FEHLERSCHWELLE K_ED_VAN_HALL_A1.INC_NACH_EINTRAG K_ED_VAN_HALL_A1.INC_VOR_EINTRAG K_ED_VAN_HALL_A1.KLASSENINDEX K_ED_VAN_HALL_A1.OK_SCHWELLE K_ED_VAN_HALL_A1.P_CODE_OPENLOAD K_ED_VAN_HALL_A1.P_CODE_SH_TO_GND K_ED_VAN_HALL_A1.P_CODE_SH_TO_UB K_ED_VAN_HALL_A1.P_CODE_UNPLAUSIBEL K_ED_VAN_HALL_A2.DEC_NACH_EINTRAG K_ED_VAN_HALL_A2.DEC_VOR_EINTRAG K_ED_VAN_HALL_A2.FEHLERSCHWELLE K_ED_VAN_HALL_A2.INC_NACH_EINTRAG K_ED_VAN_HALL_A2.INC_VOR_EINTRAG K_ED_VAN_HALL_A2.KLASSENINDEX K_ED_VAN_HALL_A2.OK_SCHWELLE K_ED_VAN_HALL_A2.P_CODE_OPENLOAD K_ED_VAN_HALL_A2.P_CODE_SH_TO_GND K_ED_VAN_HALL_A2.P_CODE_SH_TO_UB K_ED_VAN_HALL_A2.P_CODE_UNPLAUSIBEL K_ED_VAN_HALL_E1.DEC_NACH_EINTRAG K_ED_VAN_HALL_E1.DEC_VOR_EINTRAG K_ED_VAN_HALL_E1.FEHLERSCHWELLE K_ED_VAN_HALL_E1.INC_NACH_EINTRAG K_ED_VAN_HALL_E1.INC_VOR_EINTRAG K_ED_VAN_HALL_E1.KLASSENINDEX K_ED_VAN_HALL_E1.OK_SCHWELLE K_ED_VAN_HALL_E1.P_CODE_OPENLOAD K_ED_VAN_HALL_E1.P_CODE_SH_TO_GND K_ED_VAN_HALL_E1.P_CODE_SH_TO_UB K_ED_VAN_HALL_E2.DEC_NACH_EINTRAG K_ED_VAN_HALL_E2.DEC_VOR_EINTRAG K_ED_VAN_HALL_E2.FEHLERSCHWELLE K_ED_VAN_HALL_E2.INC_NACH_EINTRAG K_ED_VAN_HALL_E2.INC_VOR_EINTRAG K_ED_VAN_HALL_E2.KLASSENINDEX K_ED_VAN_HALL_E2.OK_SCHWELLE K_ED_VAN_HALL_E2.P_CODE_OPENLOAD K_ED_VAN_HALL_E2.P_CODE_SH_TO_GND K_ED_VAN_HALL_E2.P_CODE_SH_TO_UB K_ED_VAN_REGL_A1.DEC_VOR_EINTRAG K_ED_VAN_REGL_A1.FEHLERSCHWELLE K_ED_VAN_REGL_A1.INC_NACH_EINTRAG K_ED_VAN_REGL_A1.INC_VOR_EINTRAG K_ED_VAN_REGL_A1.KLASSENINDEX K_ED_VAN_REGL_A1.P_CODE_SH_TO_GND K_ED_VAN_REGL_A1.P_CODE_SH_TO_UB K_ED_VAN_REGL_A1.P_CODE_UNPLAUSIBEL K_ED_VAN_REGL_A2.DEC_VOR_EINTRAG K_ED_VAN_REGL_A2.FEHLERSCHWELLE K_ED_VAN_REGL_A2.INC_NACH_EINTRAG K_ED_VAN_REGL_A2.INC_VOR_EINTRAG K_ED_VAN_REGL_A2.KLASSENINDEX K_ED_VAN_REGL_A2.P_CODE_SH_TO_GND K_ED_VAN_REGL_A2.P_CODE_SH_TO_UB K_ED_VAN_REGL_A2.P_CODE_UNPLAUSIBEL K_ED_VAN_REGL_E1.DEC_VOR_EINTRAG K_ED_VAN_REGL_E1.FEHLERSCHWELLE K_ED_VAN_REGL_E1.INC_NACH_EINTRAG K_ED_VAN_REGL_E1.INC_VOR_EINTRAG K_ED_VAN_REGL_E1.KLASSENINDEX K_ED_VAN_REGL_E1.P_CODE_SH_TO_GND K_ED_VAN_REGL_E1.P_CODE_SH_TO_UB K_ED_VAN_REGL_E1.P_CODE_UNPLAUSIBEL K_ED_VAN_REGL_E2.DEC_VOR_EINTRAG K_ED_VAN_REGL_E2.FEHLERSCHWELLE K_ED_VAN_REGL_E2.INC_NACH_EINTRAG K_ED_VAN_REGL_E2.INC_VOR_EINTRAG K_ED_VAN_REGL_E2.KLASSENINDEX K_ED_VAN_REGL_E2.P_CODE_SH_TO_GND K_ED_VAN_REGL_E2.P_CODE_SH_TO_UB K_ED_VAN_REGL_E2.P_CODE_UNPLAUSIBEL K_ED_VAN_VENT_A1.DEC_NACH_EINTRAG K_ED_VAN_VENT_A1.DEC_VOR_EINTRAG K_ED_VAN_VENT_A1.FEHLERSCHWELLE K_ED_VAN_VENT_A1.INC_NACH_EINTRAG K_ED_VAN_VENT_A1.INC_VOR_EINTRAG /end DEF_CHARACTERISTIC
/end FUNCTION
/begin RECORD_LAYOUT TKW_VV_VV_UB FNC_VALUES 1 UBYTE COLUMN_DIR DIRECT /end RECORD_LAYOUT
/begin RECORD_LAYOUT TKW_VV_VV_UW FNC_VALUES 1 UWORD COLUMN_DIR DIRECT /end RECORD_LAYOUT
/begin RECORD_LAYOUT TKW_VV_VV_SW FNC_VALUES 1 SWORD COLUMN_DIR DIRECT /end RECORD_LAYOUT
/end MODULE
/end PROJECT
