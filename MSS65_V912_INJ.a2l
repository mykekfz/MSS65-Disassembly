/begin PROJECT MSS65-inj-V912 "MSS65 INJ - V912.00-B204.00, data set 0569Q60Z520E"
/begin HEADER "" VERSION "V912.00-B204.00" /end HEADER
/begin MODULE _MSS65-inj "MSS65 INJ - V912.00-B204.00, data 7842800"
/begin MOD_COMMON "" BYTE_ORDER MSB_FIRST /* Default byteorder (Motorola) */ /end MOD_COMMON
/begin COMPU_METHOD FORMULA_0003 "FORMULA_0003" RAT_FUNC "%3.0" "-" COEFFS 0 1 0 0 0 1 /end COMPU_METHOD
/begin COMPU_METHOD FORMULA_0010 "FORMULA_0010" RAT_FUNC "%5.0" "-" COEFFS 0 1 0 0 0 1 /end COMPU_METHOD
/* ------------------ Abschnitt erzeugt aus ed.dat ------------------ */
/begin COMPU_METHOD FORMULA_0668 "FORMULA_0668" TAB_VERB "%3.0" "-" COMPU_TAB_REF FORMULA_0668_VTAB /end COMPU_METHOD
/begin COMPU_VTAB FORMULA_0668_VTAB "FORMULA_0668_VTAB" TAB_VERB 5 0 "MIL immer aus" 1 "ohne Predrive" 2 "nur Predrive" 134 "OBD" 142 "OBD+SMG" /end COMPU_VTAB
/begin CHARACTERISTIC K_ED_PCTRL_INJ.P_CODE_SH_TO_UB "P-Code fuer die Art SH_TO_UB | EN: Fault code PCTRL_INJ - OBD P-code reported for short to battery voltage" VALUE 0x7078A TKW_VV_VV_UW 100.0 FORMULA_0010 0.0 65535.0000 /end CHARACTERISTIC
/begin CHARACTERISTIC K_ED_PKS.P_CODE_SH_TO_UB "P-Code fuer die Art SH_TO_UB | EN: Fault code PKS - OBD P-code reported for short to battery voltage" VALUE 0x707BE TKW_VV_VV_UW 100.0 FORMULA_0010 0.0 65535.0000 /end CHARACTERISTIC
/begin CHARACTERISTIC K_ED_LAVK2.P_CODE_SH_TO_UB "P-Code fuer die Art SH_TO_UB | EN: Fault code LAVK2 - OBD P-code reported for short to battery voltage" VALUE 0x7080C TKW_VV_VV_UW 100.0 FORMULA_0010 0.0 65535.0000 /end CHARACTERISTIC
/begin CHARACTERISTIC K_ED_LAVK1_OBD_PLAU.P_CODE_SH_TO_UB "P-Code fuer die Art SH_TO_UB | EN: Fault code LAVK1_OBD_PLAU - OBD P-code reported for short to battery voltage" VALUE 0x70826 TKW_VV_VV_UW 100.0 FORMULA_0010 0.0 65535.0000 /end CHARACTERISTIC
/begin CHARACTERISTIC K_ED_LAVK2_OBD_PLAU.P_CODE_SH_TO_UB "P-Code fuer die Art SH_TO_UB | EN: Fault code LAVK2_OBD_PLAU - OBD P-code reported for short to battery voltage" VALUE 0x70840 TKW_VV_VV_UW 100.0 FORMULA_0010 0.0 65535.0000 /end CHARACTERISTIC
/begin CHARACTERISTIC K_ED_LAVK1_OBD_SA.P_CODE_SH_TO_UB "P-Code fuer die Art SH_TO_UB | EN: Fault code LAVK1_OBD_SA - OBD P-code reported for short to battery voltage" VALUE 0x7085A TKW_VV_VV_UW 100.0 FORMULA_0010 0.0 65535.0000 /end CHARACTERISTIC
/begin CHARACTERISTIC K_ED_LAVK2_OBD_SA.P_CODE_SH_TO_UB "P-Code fuer die Art SH_TO_UB | EN: Fault code LAVK2_OBD_SA - OBD P-code reported for short to battery voltage" VALUE 0x70874 TKW_VV_VV_UW 100.0 FORMULA_0010 0.0 65535.0000 /end CHARACTERISTIC
/begin CHARACTERISTIC K_ED_LSHNK1.P_CODE_SH_TO_UB "P-Code fuer die Art SH_TO_UB | EN: Fault code LSHNK1 - OBD P-code reported for short to battery voltage" VALUE 0x708C2 TKW_VV_VV_UW 100.0 FORMULA_0010 0.0 65535.0000 /end CHARACTERISTIC
/begin CHARACTERISTIC K_ED_LSHNK2.P_CODE_SH_TO_UB "P-Code fuer die Art SH_TO_UB | EN: Fault code LSHNK2 - OBD P-code reported for short to battery voltage" VALUE 0x708DC TKW_VV_VV_UW 100.0 FORMULA_0010 0.0 65535.0000 /end CHARACTERISTIC
/begin CHARACTERISTIC K_ED_PT_BUSOFF.P_CODE_SH_TO_UB "P-Code fuer die Art SH_TO_UB | EN: Fault code PT_BUSOFF - OBD P-code reported for short to battery voltage" VALUE 0x708F6 TKW_VV_VV_UW 100.0 FORMULA_0010 0.0 65535.0000 /end CHARACTERISTIC
/begin CHARACTERISTIC K_ED_PT_ATEMP.P_CODE_SH_TO_UB "P-Code fuer die Art SH_TO_UB | EN: Fault code PT_ATEMP - OBD P-code reported for short to battery voltage" VALUE 0x70978 TKW_VV_VV_UW 100.0 FORMULA_0010 0.0 65535.0000 /end CHARACTERISTIC
/begin CHARACTERISTIC K_ED_PT_KLST.P_CODE_SH_TO_UB "P-Code fuer die Art SH_TO_UB | EN: Fault code PT_KLST - OBD P-code reported for short to battery voltage" VALUE 0x70992 TKW_VV_VV_UW 100.0 FORMULA_0010 0.0 65535.0000 /end CHARACTERISTIC
/begin CHARACTERISTIC K_ED_PT_KKOS.P_CODE_SH_TO_UB "P-Code fuer die Art SH_TO_UB | EN: Fault code PT_KKOS - OBD P-code reported for short to battery voltage" VALUE 0x709AC TKW_VV_VV_UW 100.0 FORMULA_0010 0.0 65535.0000 /end CHARACTERISTIC
/begin CHARACTERISTIC K_ED_LAVK1_OBD_TL.P_CODE_SH_TO_UB "P-Code fuer die Art SH_TO_UB | EN: Fault code LAVK1_OBD_TL - OBD P-code reported for short to battery voltage" VALUE 0x70A62 TKW_VV_VV_UW 100.0 FORMULA_0010 0.0 65535.0000 /end CHARACTERISTIC
/begin CHARACTERISTIC K_ED_LAVK2_OBD_TL.P_CODE_SH_TO_UB "P-Code fuer die Art SH_TO_UB | EN: Fault code LAVK2_OBD_TL - OBD P-code reported for short to battery voltage" VALUE 0x70A7C TKW_VV_VV_UW 100.0 FORMULA_0010 0.0 65535.0000 /end CHARACTERISTIC
/begin CHARACTERISTIC K_ED_LSHVK1.P_CODE_SH_TO_UB "P-Code fuer die Art SH_TO_UB | EN: Fault code LSHVK1 - OBD P-code reported for short to battery voltage" VALUE 0x70A96 TKW_VV_VV_UW 100.0 FORMULA_0010 0.0 65535.0000 /end CHARACTERISTIC
/begin CHARACTERISTIC K_ED_LSHVK2.P_CODE_SH_TO_UB "P-Code fuer die Art SH_TO_UB | EN: Fault code LSHVK2 - OBD P-code reported for short to battery voltage" VALUE 0x70AB0 TKW_VV_VV_UW 100.0 FORMULA_0010 0.0 65535.0000 /end CHARACTERISTIC
/begin CHARACTERISTIC K_ED_LSRVK1_OBD_REG.P_CODE_SH_TO_UB "P-Code fuer die Art SH_TO_UB | EN: Fault code LSRVK1_OBD_REG - OBD P-code reported for short to battery voltage" VALUE 0x70ACA TKW_VV_VV_UW 100.0 FORMULA_0010 0.0 65535.0000 /end CHARACTERISTIC
/begin CHARACTERISTIC K_ED_LSRVK2_OBD_REG.P_CODE_SH_TO_UB "P-Code fuer die Art SH_TO_UB | EN: Fault code LSRVK2_OBD_REG - OBD P-code reported for short to battery voltage" VALUE 0x70AE4 TKW_VV_VV_UW 100.0 FORMULA_0010 0.0 65535.0000 /end CHARACTERISTIC
/begin CHARACTERISTIC K_ED_LSHVK1_R.P_CODE_SH_TO_UB "P-Code fuer die Art SH_TO_UB | EN: Fault code LSHVK1_R - OBD P-code reported for short to battery voltage" VALUE 0x70AFE TKW_VV_VV_UW 100.0 FORMULA_0010 0.0 65535.0000 /end CHARACTERISTIC
/begin CHARACTERISTIC K_ED_LSHVK2_R.P_CODE_SH_TO_UB "P-Code fuer die Art SH_TO_UB | EN: Fault code LSHVK2_R - OBD P-code reported for short to battery voltage" VALUE 0x70B18 TKW_VV_VV_UW 100.0 FORMULA_0010 0.0 65535.0000 /end CHARACTERISTIC
/begin CHARACTERISTIC K_ED_LSRVK1_OBD_START.P_CODE_SH_TO_UB "P-Code fuer die Art SH_TO_UB | EN: Fault code LSRVK1_OBD_START - OBD P-code reported for short to battery voltage" VALUE 0x70B32 TKW_VV_VV_UW 100.0 FORMULA_0010 0.0 65535.0000 /end CHARACTERISTIC
/begin CHARACTERISTIC K_ED_LSRVK2_OBD_START.P_CODE_SH_TO_UB "P-Code fuer die Art SH_TO_UB | EN: Fault code LSRVK2_OBD_START - OBD P-code reported for short to battery voltage" VALUE 0x70B4C TKW_VV_VV_UW 100.0 FORMULA_0010 0.0 65535.0000 /end CHARACTERISTIC
/begin CHARACTERISTIC K_ED_LSRVK1_OBD_REF.P_CODE_SH_TO_UB "P-Code fuer die Art SH_TO_UB | EN: Fault code LSRVK1_OBD_REF - OBD P-code reported for short to battery voltage" VALUE 0x70B66 TKW_VV_VV_UW 100.0 FORMULA_0010 0.0 65535.0000 /end CHARACTERISTIC
/begin CHARACTERISTIC K_ED_LSRVK2_OBD_REF.P_CODE_SH_TO_UB "P-Code fuer die Art SH_TO_UB | EN: Fault code LSRVK2_OBD_REF - OBD P-code reported for short to battery voltage" VALUE 0x70B80 TKW_VV_VV_UW 100.0 FORMULA_0010 0.0 65535.0000 /end CHARACTERISTIC
/begin CHARACTERISTIC K_ED_LAVK2_DIAG.P_CODE_SH_TO_UB "P-Code fuer die Art SH_TO_UB | EN: Fault code LAVK2_DIAG - OBD P-code reported for short to battery voltage" VALUE 0x70BB4 TKW_VV_VV_UW 100.0 FORMULA_0010 0.0 65535.0000 /end CHARACTERISTIC
/begin CHARACTERISTIC K_ED_LAVK1_IA_OPENLOAD.P_CODE_SH_TO_UB "P-Code fuer die Art SH_TO_UB | EN: Fault code LAVK1_IA_OPENLOAD - OBD P-code reported for short to battery voltage" VALUE 0x70BCE TKW_VV_VV_UW 100.0 FORMULA_0010 0.0 65535.0000 /end CHARACTERISTIC
/begin CHARACTERISTIC K_ED_LAVK2_IA_OPENLOAD.P_CODE_SH_TO_UB "P-Code fuer die Art SH_TO_UB | EN: Fault code LAVK2_IA_OPENLOAD - OBD P-code reported for short to battery voltage" VALUE 0x70BE8 TKW_VV_VV_UW 100.0 FORMULA_0010 0.0 65535.0000 /end CHARACTERISTIC
/begin CHARACTERISTIC K_ED_PT_GRB.P_CODE_SH_TO_UB "P-Code fuer die Art SH_TO_UB | EN: Fault code PT_GRB - OBD P-code reported for short to battery voltage" VALUE 0x70C02 TKW_VV_VV_UW 100.0 FORMULA_0010 0.0 65535.0000 /end CHARACTERISTIC
/begin CHARACTERISTIC K_ED_PT_GRB2.P_CODE_SH_TO_UB "P-Code fuer die Art SH_TO_UB | EN: Fault code PT_GRB2 - OBD P-code reported for short to battery voltage" VALUE 0x70C1C TKW_VV_VV_UW 100.0 FORMULA_0010 0.0 65535.0000 /end CHARACTERISTIC
/begin CHARACTERISTIC K_ED_LAVK1_UN_OPENLOAD.P_CODE_SH_TO_UB "P-Code fuer die Art SH_TO_UB | EN: Fault code LAVK1_UN_OPENLOAD - OBD P-code reported for short to battery voltage" VALUE 0x70C36 TKW_VV_VV_UW 100.0 FORMULA_0010 0.0 65535.0000 /end CHARACTERISTIC
/begin CHARACTERISTIC K_ED_LAVK2_UN_OPENLOAD.P_CODE_SH_TO_UB "P-Code fuer die Art SH_TO_UB | EN: Fault code LAVK2_UN_OPENLOAD - OBD P-code reported for short to battery voltage" VALUE 0x70C50 TKW_VV_VV_UW 100.0 FORMULA_0010 0.0 65535.0000 /end CHARACTERISTIC
/begin CHARACTERISTIC K_ED_LAVK1_IP_OPENLOAD.P_CODE_SH_TO_UB "P-Code fuer die Art SH_TO_UB | EN: Fault code LAVK1_IP_OPENLOAD - OBD P-code reported for short to battery voltage" VALUE 0x70C6A TKW_VV_VV_UW 100.0 FORMULA_0010 0.0 65535.0000 /end CHARACTERISTIC
/begin CHARACTERISTIC K_ED_LAVK2_IP_OPENLOAD.P_CODE_SH_TO_UB "P-Code fuer die Art SH_TO_UB | EN: Fault code LAVK2_IP_OPENLOAD - OBD P-code reported for short to battery voltage" VALUE 0x70C84 TKW_VV_VV_UW 100.0 FORMULA_0010 0.0 65535.0000 /end CHARACTERISTIC
/begin CHARACTERISTIC K_ED_LAVK1_OBD_DYN.P_CODE_SH_TO_UB "P-Code fuer die Art SH_TO_UB | EN: Fault code LAVK1_OBD_DYN - OBD P-code reported for short to battery voltage" VALUE 0x70FC4 TKW_VV_VV_UW 100.0 FORMULA_0010 0.0 65535.0000 /end CHARACTERISTIC
/begin CHARACTERISTIC K_ED_LAVK2_OBD_DYN.P_CODE_SH_TO_UB "P-Code fuer die Art SH_TO_UB | EN: Fault code LAVK2_OBD_DYN - OBD P-code reported for short to battery voltage" VALUE 0x70FDE TKW_VV_VV_UW 100.0 FORMULA_0010 0.0 65535.0000 /end CHARACTERISTIC
/begin CHARACTERISTIC K_ED_PT_CRASH.P_CODE_SH_TO_UB "P-Code fuer die Art SH_TO_UB | EN: Fault code PT_CRASH - OBD P-code reported for short to battery voltage" VALUE 0x70FF8 TKW_VV_VV_UW 100.0 FORMULA_0010 0.0 65535.0000 /end CHARACTERISTIC
/begin CHARACTERISTIC K_ED_PT_BEDFGR.P_CODE_SH_TO_UB "P-Code fuer die Art SH_TO_UB | EN: Fault code PT_BEDFGR - OBD P-code reported for short to battery voltage" VALUE 0x7102C TKW_VV_VV_UW 100.0 FORMULA_0010 0.0 65535.0000 /end CHARACTERISTIC
/begin CHARACTERISTIC K_ED_LAVK1_TRIM.P_CODE_SH_TO_UB "P-Code fuer die Art SH_TO_UB | EN: Fault code LAVK1_TRIM - OBD P-code reported for short to battery voltage" VALUE 0x710E2 TKW_VV_VV_UW 100.0 FORMULA_0010 0.0 65535.0000 /end CHARACTERISTIC
/begin CHARACTERISTIC K_ED_LAVK2_TRIM.P_CODE_SH_TO_UB "P-Code fuer die Art SH_TO_UB | EN: Fault code LAVK2_TRIM - OBD P-code reported for short to battery voltage" VALUE 0x710FC TKW_VV_VV_UW 100.0 FORMULA_0010 0.0 65535.0000 /end CHARACTERISTIC
/begin CHARACTERISTIC K_ED_PT_KM.P_CODE_SH_TO_UB "P-Code fuer die Art SH_TO_UB | EN: Fault code PT_KM - OBD P-code reported for short to battery voltage" VALUE 0x711B2 TKW_VV_VV_UW 100.0 FORMULA_0010 0.0 65535.0000 /end CHARACTERISTIC
/begin CHARACTERISTIC K_ED_PT_KOMBI.P_CODE_SH_TO_UB "P-Code fuer die Art SH_TO_UB | EN: Fault code PT_KOMBI - OBD P-code reported for short to battery voltage" VALUE 0x711CC TKW_VV_VV_UW 100.0 FORMULA_0010 0.0 65535.0000 /end CHARACTERISTIC
/begin CHARACTERISTIC K_ED_PKS_LL.P_CODE_SH_TO_UB "P-Code fuer die Art SH_TO_UB | EN: Fault code PKS_LL - OBD P-code reported for short to battery voltage" VALUE 0x711E6 TKW_VV_VV_UW 100.0 FORMULA_0010 0.0 65535.0000 /end CHARACTERISTIC
/begin CHARACTERISTIC K_ED_PKS_TL.P_CODE_SH_TO_UB "P-Code fuer die Art SH_TO_UB | EN: Fault code PKS_TL - OBD P-code reported for short to battery voltage" VALUE 0x71200 TKW_VV_VV_UW 100.0 FORMULA_0010 0.0 65535.0000 /end CHARACTERISTIC
/begin CHARACTERISTIC K_ED_PKS_Q.P_CODE_SH_TO_UB "P-Code fuer die Art SH_TO_UB | EN: Fault code PKS_Q - OBD P-code reported for short to battery voltage" VALUE 0x7121A TKW_VV_VV_UW 100.0 FORMULA_0010 0.0 65535.0000 /end CHARACTERISTIC
/begin CHARACTERISTIC K_ED_MVAC_DRUCKSENSOR.P_CODE_SH_TO_UB "P-Code fuer die Art SH_TO_UB | EN: Fault code MVAC_DRUCKSENSOR - OBD P-code reported for short to battery voltage" VALUE 0x71352 TKW_VV_VV_UW 100.0 FORMULA_0010 0.0 65535.0000 /end CHARACTERISTIC
/begin CHARACTERISTIC K_ED_PT_BEDAT.P_CODE_SH_TO_UB "P-Code fuer die Art SH_TO_UB | EN: Fault code PT_BEDAT - OBD P-code reported for short to battery voltage" VALUE 0x7136C TKW_VV_VV_UW 100.0 FORMULA_0010 0.0 65535.0000 /end CHARACTERISTIC
/begin CHARACTERISTIC K_ED_PT_ANFRADMOM.P_CODE_SH_TO_UB "P-Code fuer die Art SH_TO_UB | EN: Fault code PT_ANFRADMOM - OBD P-code reported for short to battery voltage" VALUE 0x717B0 TKW_VV_VV_UW 100.0 FORMULA_0010 0.0 65535.0000 /end CHARACTERISTIC
/begin CHARACTERISTIC K_ED_LSHNK1_R.P_CODE_SH_TO_UB "P-Code fuer die Art SH_TO_UB | EN: Fault code LSHNK1_R - OBD P-code reported for short to battery voltage" VALUE 0x71902 TKW_VV_VV_UW 100.0 FORMULA_0010 0.0 65535.0000 /end CHARACTERISTIC
/begin CHARACTERISTIC K_ED_LSHNK2_R.P_CODE_SH_TO_UB "P-Code fuer die Art SH_TO_UB | EN: Fault code LSHNK2_R - OBD P-code reported for short to battery voltage" VALUE 0x7191C TKW_VV_VV_UW 100.0 FORMULA_0010 0.0 65535.0000 /end CHARACTERISTIC
/begin CHARACTERISTIC K_ED_PKS_MODELL.P_CODE_SH_TO_UB "P-Code fuer die Art SH_TO_UB | EN: Fault code PKS_MODELL - OBD P-code reported for short to battery voltage" VALUE 0x71936 TKW_VV_VV_UW 100.0 FORMULA_0010 0.0 65535.0000 /end CHARACTERISTIC
/begin CHARACTERISTIC K_ED_PKS_PAUFBAU.P_CODE_SH_TO_UB "P-Code fuer die Art SH_TO_UB | EN: Fault code PKS_PAUFBAU - OBD P-code reported for short to battery voltage" VALUE 0x71950 TKW_VV_VV_UW 100.0 FORMULA_0010 0.0 65535.0000 /end CHARACTERISTIC
/begin CHARACTERISTIC K_ED_PKS_ADAPT_ANSCHL.P_CODE_SH_TO_UB "P-Code fuer die Art SH_TO_UB | EN: Fault code PKS_ADAPT_ANSCHL - OBD P-code reported for short to battery voltage" VALUE 0x7196A TKW_VV_VV_UW 100.0 FORMULA_0010 0.0 65535.0000 /end CHARACTERISTIC
/begin CHARACTERISTIC K_ED_LAVK_ATIC42.P_CODE_SH_TO_UB "P-Code fuer die Art SH_TO_UB | EN: Fault code LAVK_ATIC42 - OBD P-code reported for short to battery voltage" VALUE 0x7199E TKW_VV_VV_UW 100.0 FORMULA_0010 0.0 65535.0000 /end CHARACTERISTIC
/begin CHARACTERISTIC K_ED_PT_AX.P_CODE_SH_TO_UB "P-Code fuer die Art SH_TO_UB | EN: Fault code PT_AX - OBD P-code reported for short to battery voltage" VALUE 0x719B8 TKW_VV_VV_UW 100.0 FORMULA_0010 0.0 65535.0000 /end CHARACTERISTIC
/begin CHARACTERISTIC K_ED_MVAC_OBD.P_CODE_SH_TO_UB "P-Code fuer die Art SH_TO_UB" VALUE 0x71A54 TKW_VV_VV_UW 100.0 FORMULA_0010 0.0 65535.0000 /end CHARACTERISTIC
/begin CHARACTERISTIC K_ED_LAVK2_ATIC42.P_CODE_SH_TO_UB "P-Code fuer die Art SH_TO_UB" VALUE 0x71A88 TKW_VV_VV_UW 100.0 FORMULA_0010 0.0 65535.0000 /end CHARACTERISTIC
/begin CHARACTERISTIC K_ED_PCTRL_INJ.P_CODE_SH_TO_GND "P-Code fuer die Art SH_TO_GND | EN: Fault code PCTRL_INJ - OBD P-code reported for short to ground" VALUE 0x7078C TKW_VV_VV_UW 100.0 FORMULA_0010 0.0 65535.0000 /end CHARACTERISTIC
/begin CHARACTERISTIC K_ED_PKS.P_CODE_SH_TO_GND "P-Code fuer die Art SH_TO_GND | EN: Fault code PKS - OBD P-code reported for short to ground" VALUE 0x707C0 TKW_VV_VV_UW 100.0 FORMULA_0010 0.0 65535.0000 /end CHARACTERISTIC
/begin CHARACTERISTIC K_ED_LAVK2.P_CODE_SH_TO_GND "P-Code fuer die Art SH_TO_GND | EN: Fault code LAVK2 - OBD P-code reported for short to ground" VALUE 0x7080E TKW_VV_VV_UW 100.0 FORMULA_0010 0.0 65535.0000 /end CHARACTERISTIC
/begin CHARACTERISTIC K_ED_LAVK1_OBD_PLAU.P_CODE_SH_TO_GND "P-Code fuer die Art SH_TO_GND | EN: Fault code LAVK1_OBD_PLAU - OBD P-code reported for short to ground" VALUE 0x70828 TKW_VV_VV_UW 100.0 FORMULA_0010 0.0 65535.0000 /end CHARACTERISTIC
/begin CHARACTERISTIC K_ED_LAVK2_OBD_PLAU.P_CODE_SH_TO_GND "P-Code fuer die Art SH_TO_GND | EN: Fault code LAVK2_OBD_PLAU - OBD P-code reported for short to ground" VALUE 0x70842 TKW_VV_VV_UW 100.0 FORMULA_0010 0.0 65535.0000 /end CHARACTERISTIC
/begin CHARACTERISTIC K_ED_LAVK1_OBD_SA.P_CODE_SH_TO_GND "P-Code fuer die Art SH_TO_GND | EN: Fault code LAVK1_OBD_SA - OBD P-code reported for short to ground" VALUE 0x7085C TKW_VV_VV_UW 100.0 FORMULA_0010 0.0 65535.0000 /end CHARACTERISTIC
/begin CHARACTERISTIC K_ED_LAVK2_OBD_SA.P_CODE_SH_TO_GND "P-Code fuer die Art SH_TO_GND | EN: Fault code LAVK2_OBD_SA - OBD P-code reported for short to ground" VALUE 0x70876 TKW_VV_VV_UW 100.0 FORMULA_0010 0.0 65535.0000 /end CHARACTERISTIC
/begin CHARACTERISTIC K_ED_LSHNK1.P_CODE_SH_TO_GND "P-Code fuer die Art SH_TO_GND | EN: Fault code LSHNK1 - OBD P-code reported for short to ground" VALUE 0x708C4 TKW_VV_VV_UW 100.0 FORMULA_0010 0.0 65535.0000 /end CHARACTERISTIC
/begin CHARACTERISTIC K_ED_LSHNK2.P_CODE_SH_TO_GND "P-Code fuer die Art SH_TO_GND | EN: Fault code LSHNK2 - OBD P-code reported for short to ground" VALUE 0x708DE TKW_VV_VV_UW 100.0 FORMULA_0010 0.0 65535.0000 /end CHARACTERISTIC
/begin CHARACTERISTIC K_ED_PT_BUSOFF.P_CODE_SH_TO_GND "P-Code fuer die Art SH_TO_GND | EN: Fault code PT_BUSOFF - OBD P-code reported for short to ground" VALUE 0x708F8 TKW_VV_VV_UW 100.0 FORMULA_0010 0.0 65535.0000 /end CHARACTERISTIC
/begin CHARACTERISTIC K_ED_PT_ATEMP.P_CODE_SH_TO_GND "P-Code fuer die Art SH_TO_GND | EN: Fault code PT_ATEMP - OBD P-code reported for short to ground" VALUE 0x7097A TKW_VV_VV_UW 100.0 FORMULA_0010 0.0 65535.0000 /end CHARACTERISTIC
/begin CHARACTERISTIC K_ED_PT_KLST.P_CODE_SH_TO_GND "P-Code fuer die Art SH_TO_GND | EN: Fault code PT_KLST - OBD P-code reported for short to ground" VALUE 0x70994 TKW_VV_VV_UW 100.0 FORMULA_0010 0.0 65535.0000 /end CHARACTERISTIC
/begin CHARACTERISTIC K_ED_PT_KKOS.P_CODE_SH_TO_GND "P-Code fuer die Art SH_TO_GND | EN: Fault code PT_KKOS - OBD P-code reported for short to ground" VALUE 0x709AE TKW_VV_VV_UW 100.0 FORMULA_0010 0.0 65535.0000 /end CHARACTERISTIC
/begin CHARACTERISTIC K_ED_LAVK1_OBD_TL.P_CODE_SH_TO_GND "P-Code fuer die Art SH_TO_GND | EN: Fault code LAVK1_OBD_TL - OBD P-code reported for short to ground" VALUE 0x70A64 TKW_VV_VV_UW 100.0 FORMULA_0010 0.0 65535.0000 /end CHARACTERISTIC
/begin CHARACTERISTIC K_ED_LAVK2_OBD_TL.P_CODE_SH_TO_GND "P-Code fuer die Art SH_TO_GND | EN: Fault code LAVK2_OBD_TL - OBD P-code reported for short to ground" VALUE 0x70A7E TKW_VV_VV_UW 100.0 FORMULA_0010 0.0 65535.0000 /end CHARACTERISTIC
/begin CHARACTERISTIC K_ED_LSHVK1.P_CODE_SH_TO_GND "P-Code fuer die Art SH_TO_GND | EN: Fault code LSHVK1 - OBD P-code reported for short to ground" VALUE 0x70A98 TKW_VV_VV_UW 100.0 FORMULA_0010 0.0 65535.0000 /end CHARACTERISTIC
/begin CHARACTERISTIC K_ED_LSHVK2.P_CODE_SH_TO_GND "P-Code fuer die Art SH_TO_GND | EN: Fault code LSHVK2 - OBD P-code reported for short to ground" VALUE 0x70AB2 TKW_VV_VV_UW 100.0 FORMULA_0010 0.0 65535.0000 /end CHARACTERISTIC
/begin CHARACTERISTIC K_ED_LSRVK1_OBD_REG.P_CODE_SH_TO_GND "P-Code fuer die Art SH_TO_GND | EN: Fault code LSRVK1_OBD_REG - OBD P-code reported for short to ground" VALUE 0x70ACC TKW_VV_VV_UW 100.0 FORMULA_0010 0.0 65535.0000 /end CHARACTERISTIC
/begin CHARACTERISTIC K_ED_LSRVK2_OBD_REG.P_CODE_SH_TO_GND "P-Code fuer die Art SH_TO_GND | EN: Fault code LSRVK2_OBD_REG - OBD P-code reported for short to ground" VALUE 0x70AE6 TKW_VV_VV_UW 100.0 FORMULA_0010 0.0 65535.0000 /end CHARACTERISTIC
/begin CHARACTERISTIC K_ED_LSHVK1_R.P_CODE_SH_TO_GND "P-Code fuer die Art SH_TO_GND | EN: Fault code LSHVK1_R - OBD P-code reported for short to ground" VALUE 0x70B00 TKW_VV_VV_UW 100.0 FORMULA_0010 0.0 65535.0000 /end CHARACTERISTIC
/begin CHARACTERISTIC K_ED_LSHVK2_R.P_CODE_SH_TO_GND "P-Code fuer die Art SH_TO_GND | EN: Fault code LSHVK2_R - OBD P-code reported for short to ground" VALUE 0x70B1A TKW_VV_VV_UW 100.0 FORMULA_0010 0.0 65535.0000 /end CHARACTERISTIC
/begin CHARACTERISTIC K_ED_LSRVK1_OBD_START.P_CODE_SH_TO_GND "P-Code fuer die Art SH_TO_GND | EN: Fault code LSRVK1_OBD_START - OBD P-code reported for short to ground" VALUE 0x70B34 TKW_VV_VV_UW 100.0 FORMULA_0010 0.0 65535.0000 /end CHARACTERISTIC
/begin CHARACTERISTIC K_ED_LSRVK2_OBD_START.P_CODE_SH_TO_GND "P-Code fuer die Art SH_TO_GND | EN: Fault code LSRVK2_OBD_START - OBD P-code reported for short to ground" VALUE 0x70B4E TKW_VV_VV_UW 100.0 FORMULA_0010 0.0 65535.0000 /end CHARACTERISTIC
/begin CHARACTERISTIC K_ED_LSRVK1_OBD_REF.P_CODE_SH_TO_GND "P-Code fuer die Art SH_TO_GND | EN: Fault code LSRVK1_OBD_REF - OBD P-code reported for short to ground" VALUE 0x70B68 TKW_VV_VV_UW 100.0 FORMULA_0010 0.0 65535.0000 /end CHARACTERISTIC
/begin CHARACTERISTIC K_ED_LSRVK2_OBD_REF.P_CODE_SH_TO_GND "P-Code fuer die Art SH_TO_GND | EN: Fault code LSRVK2_OBD_REF - OBD P-code reported for short to ground" VALUE 0x70B82 TKW_VV_VV_UW 100.0 FORMULA_0010 0.0 65535.0000 /end CHARACTERISTIC
/begin CHARACTERISTIC K_ED_LAVK2_DIAG.P_CODE_SH_TO_GND "P-Code fuer die Art SH_TO_GND | EN: Fault code LAVK2_DIAG - OBD P-code reported for short to ground" VALUE 0x70BB6 TKW_VV_VV_UW 100.0 FORMULA_0010 0.0 65535.0000 /end CHARACTERISTIC
/begin CHARACTERISTIC K_ED_LAVK1_IA_OPENLOAD.P_CODE_SH_TO_GND "P-Code fuer die Art SH_TO_GND | EN: Fault code LAVK1_IA_OPENLOAD - OBD P-code reported for short to ground" VALUE 0x70BD0 TKW_VV_VV_UW 100.0 FORMULA_0010 0.0 65535.0000 /end CHARACTERISTIC
/begin CHARACTERISTIC K_ED_LAVK2_IA_OPENLOAD.P_CODE_SH_TO_GND "P-Code fuer die Art SH_TO_GND | EN: Fault code LAVK2_IA_OPENLOAD - OBD P-code reported for short to ground" VALUE 0x70BEA TKW_VV_VV_UW 100.0 FORMULA_0010 0.0 65535.0000 /end CHARACTERISTIC
/begin CHARACTERISTIC K_ED_PT_GRB.P_CODE_SH_TO_GND "P-Code fuer die Art SH_TO_GND | EN: Fault code PT_GRB - OBD P-code reported for short to ground" VALUE 0x70C04 TKW_VV_VV_UW 100.0 FORMULA_0010 0.0 65535.0000 /end CHARACTERISTIC
/begin CHARACTERISTIC K_ED_PT_GRB2.P_CODE_SH_TO_GND "P-Code fuer die Art SH_TO_GND | EN: Fault code PT_GRB2 - OBD P-code reported for short to ground" VALUE 0x70C1E TKW_VV_VV_UW 100.0 FORMULA_0010 0.0 65535.0000 /end CHARACTERISTIC
/begin CHARACTERISTIC K_ED_LAVK1_UN_OPENLOAD.P_CODE_SH_TO_GND "P-Code fuer die Art SH_TO_GND | EN: Fault code LAVK1_UN_OPENLOAD - OBD P-code reported for short to ground" VALUE 0x70C38 TKW_VV_VV_UW 100.0 FORMULA_0010 0.0 65535.0000 /end CHARACTERISTIC
/begin CHARACTERISTIC K_ED_LAVK2_UN_OPENLOAD.P_CODE_SH_TO_GND "P-Code fuer die Art SH_TO_GND | EN: Fault code LAVK2_UN_OPENLOAD - OBD P-code reported for short to ground" VALUE 0x70C52 TKW_VV_VV_UW 100.0 FORMULA_0010 0.0 65535.0000 /end CHARACTERISTIC
/begin CHARACTERISTIC K_ED_LAVK1_IP_OPENLOAD.P_CODE_SH_TO_GND "P-Code fuer die Art SH_TO_GND | EN: Fault code LAVK1_IP_OPENLOAD - OBD P-code reported for short to ground" VALUE 0x70C6C TKW_VV_VV_UW 100.0 FORMULA_0010 0.0 65535.0000 /end CHARACTERISTIC
/begin CHARACTERISTIC K_ED_LAVK2_IP_OPENLOAD.P_CODE_SH_TO_GND "P-Code fuer die Art SH_TO_GND | EN: Fault code LAVK2_IP_OPENLOAD - OBD P-code reported for short to ground" VALUE 0x70C86 TKW_VV_VV_UW 100.0 FORMULA_0010 0.0 65535.0000 /end CHARACTERISTIC
/begin CHARACTERISTIC K_ED_LAVK1_OBD_DYN.P_CODE_SH_TO_GND "P-Code fuer die Art SH_TO_GND | EN: Fault code LAVK1_OBD_DYN - OBD P-code reported for short to ground" VALUE 0x70FC6 TKW_VV_VV_UW 100.0 FORMULA_0010 0.0 65535.0000 /end CHARACTERISTIC
/begin CHARACTERISTIC K_ED_LAVK2_OBD_DYN.P_CODE_SH_TO_GND "P-Code fuer die Art SH_TO_GND | EN: Fault code LAVK2_OBD_DYN - OBD P-code reported for short to ground" VALUE 0x70FE0 TKW_VV_VV_UW 100.0 FORMULA_0010 0.0 65535.0000 /end CHARACTERISTIC
/begin CHARACTERISTIC K_ED_PT_CRASH.P_CODE_SH_TO_GND "P-Code fuer die Art SH_TO_GND | EN: Fault code PT_CRASH - OBD P-code reported for short to ground" VALUE 0x70FFA TKW_VV_VV_UW 100.0 FORMULA_0010 0.0 65535.0000 /end CHARACTERISTIC
/begin CHARACTERISTIC K_ED_PT_BEDFGR.P_CODE_SH_TO_GND "P-Code fuer die Art SH_TO_GND | EN: Fault code PT_BEDFGR - OBD P-code reported for short to ground" VALUE 0x7102E TKW_VV_VV_UW 100.0 FORMULA_0010 0.0 65535.0000 /end CHARACTERISTIC
/begin CHARACTERISTIC K_ED_LAVK1_TRIM.P_CODE_SH_TO_GND "P-Code fuer die Art SH_TO_GND | EN: Fault code LAVK1_TRIM - OBD P-code reported for short to ground" VALUE 0x710E4 TKW_VV_VV_UW 100.0 FORMULA_0010 0.0 65535.0000 /end CHARACTERISTIC
/begin CHARACTERISTIC K_ED_LAVK2_TRIM.P_CODE_SH_TO_GND "P-Code fuer die Art SH_TO_GND | EN: Fault code LAVK2_TRIM - OBD P-code reported for short to ground" VALUE 0x710FE TKW_VV_VV_UW 100.0 FORMULA_0010 0.0 65535.0000 /end CHARACTERISTIC
/begin CHARACTERISTIC K_ED_PT_KM.P_CODE_SH_TO_GND "P-Code fuer die Art SH_TO_GND | EN: Fault code PT_KM - OBD P-code reported for short to ground" VALUE 0x711B4 TKW_VV_VV_UW 100.0 FORMULA_0010 0.0 65535.0000 /end CHARACTERISTIC
/begin CHARACTERISTIC K_ED_PT_KOMBI.P_CODE_SH_TO_GND "P-Code fuer die Art SH_TO_GND | EN: Fault code PT_KOMBI - OBD P-code reported for short to ground" VALUE 0x711CE TKW_VV_VV_UW 100.0 FORMULA_0010 0.0 65535.0000 /end CHARACTERISTIC
/begin CHARACTERISTIC K_ED_PKS_LL.P_CODE_SH_TO_GND "P-Code fuer die Art SH_TO_GND | EN: Fault code PKS_LL - OBD P-code reported for short to ground" VALUE 0x711E8 TKW_VV_VV_UW 100.0 FORMULA_0010 0.0 65535.0000 /end CHARACTERISTIC
/begin CHARACTERISTIC K_ED_PKS_TL.P_CODE_SH_TO_GND "P-Code fuer die Art SH_TO_GND | EN: Fault code PKS_TL - OBD P-code reported for short to ground" VALUE 0x71202 TKW_VV_VV_UW 100.0 FORMULA_0010 0.0 65535.0000 /end CHARACTERISTIC
/begin CHARACTERISTIC K_ED_PKS_Q.P_CODE_SH_TO_GND "P-Code fuer die Art SH_TO_GND | EN: Fault code PKS_Q - OBD P-code reported for short to ground" VALUE 0x7121C TKW_VV_VV_UW 100.0 FORMULA_0010 0.0 65535.0000 /end CHARACTERISTIC
/begin CHARACTERISTIC K_ED_MVAC_DRUCKSENSOR.P_CODE_SH_TO_GND "P-Code fuer die Art SH_TO_GND | EN: Fault code MVAC_DRUCKSENSOR - OBD P-code reported for short to ground" VALUE 0x71354 TKW_VV_VV_UW 100.0 FORMULA_0010 0.0 65535.0000 /end CHARACTERISTIC
/begin CHARACTERISTIC K_ED_PT_BEDAT.P_CODE_SH_TO_GND "P-Code fuer die Art SH_TO_GND | EN: Fault code PT_BEDAT - OBD P-code reported for short to ground" VALUE 0x7136E TKW_VV_VV_UW 100.0 FORMULA_0010 0.0 65535.0000 /end CHARACTERISTIC
/begin CHARACTERISTIC K_ED_PT_ANFRADMOM.P_CODE_SH_TO_GND "P-Code fuer die Art SH_TO_GND | EN: Fault code PT_ANFRADMOM - OBD P-code reported for short to ground" VALUE 0x717B2 TKW_VV_VV_UW 100.0 FORMULA_0010 0.0 65535.0000 /end CHARACTERISTIC
/begin CHARACTERISTIC K_ED_LSHNK1_R.P_CODE_SH_TO_GND "P-Code fuer die Art SH_TO_GND | EN: Fault code LSHNK1_R - OBD P-code reported for short to ground" VALUE 0x71904 TKW_VV_VV_UW 100.0 FORMULA_0010 0.0 65535.0000 /end CHARACTERISTIC
/begin CHARACTERISTIC K_ED_LSHNK2_R.P_CODE_SH_TO_GND "P-Code fuer die Art SH_TO_GND | EN: Fault code LSHNK2_R - OBD P-code reported for short to ground" VALUE 0x7191E TKW_VV_VV_UW 100.0 FORMULA_0010 0.0 65535.0000 /end CHARACTERISTIC
/begin CHARACTERISTIC K_ED_PKS_MODELL.P_CODE_SH_TO_GND "P-Code fuer die Art SH_TO_GND | EN: Fault code PKS_MODELL - OBD P-code reported for short to ground" VALUE 0x71938 TKW_VV_VV_UW 100.0 FORMULA_0010 0.0 65535.0000 /end CHARACTERISTIC
/begin CHARACTERISTIC K_ED_PKS_PAUFBAU.P_CODE_SH_TO_GND "P-Code fuer die Art SH_TO_GND | EN: Fault code PKS_PAUFBAU - OBD P-code reported for short to ground" VALUE 0x71952 TKW_VV_VV_UW 100.0 FORMULA_0010 0.0 65535.0000 /end CHARACTERISTIC
/begin CHARACTERISTIC K_ED_PKS_ADAPT_ANSCHL.P_CODE_SH_TO_GND "P-Code fuer die Art SH_TO_GND | EN: Fault code PKS_ADAPT_ANSCHL - OBD P-code reported for short to ground" VALUE 0x7196C TKW_VV_VV_UW 100.0 FORMULA_0010 0.0 65535.0000 /end CHARACTERISTIC
/begin CHARACTERISTIC K_ED_LAVK_ATIC42.P_CODE_SH_TO_GND "P-Code fuer die Art SH_TO_GND | EN: Fault code LAVK_ATIC42 - OBD P-code reported for short to ground" VALUE 0x719A0 TKW_VV_VV_UW 100.0 FORMULA_0010 0.0 65535.0000 /end CHARACTERISTIC
/begin CHARACTERISTIC K_ED_PT_AX.P_CODE_SH_TO_GND "P-Code fuer die Art SH_TO_GND | EN: Fault code PT_AX - OBD P-code reported for short to ground" VALUE 0x719BA TKW_VV_VV_UW 100.0 FORMULA_0010 0.0 65535.0000 /end CHARACTERISTIC
/begin CHARACTERISTIC K_ED_MVAC_OBD.P_CODE_SH_TO_GND "P-Code fuer die Art SH_TO_GND" VALUE 0x71A56 TKW_VV_VV_UW 100.0 FORMULA_0010 0.0 65535.0000 /end CHARACTERISTIC
/begin CHARACTERISTIC K_ED_LAVK2_ATIC42.P_CODE_SH_TO_GND "P-Code fuer die Art SH_TO_GND" VALUE 0x71A8A TKW_VV_VV_UW 100.0 FORMULA_0010 0.0 65535.0000 /end CHARACTERISTIC
/begin CHARACTERISTIC K_ED_PCTRL_INJ.P_CODE_OPENLOAD "P-Code fuer die Art OPENLOAD | EN: Fault code PCTRL_INJ - OBD P-code reported for open circuit" VALUE 0x7078E TKW_VV_VV_UW 100.0 FORMULA_0010 0.0 65535.0000 /end CHARACTERISTIC
/begin CHARACTERISTIC K_ED_PKS.P_CODE_OPENLOAD "P-Code fuer die Art OPENLOAD | EN: Fault code PKS - OBD P-code reported for open circuit" VALUE 0x707C2 TKW_VV_VV_UW 100.0 FORMULA_0010 0.0 65535.0000 /end CHARACTERISTIC
/begin CHARACTERISTIC K_ED_LAVK2.P_CODE_OPENLOAD "P-Code fuer die Art OPENLOAD | EN: Fault code LAVK2 - OBD P-code reported for open circuit" VALUE 0x70810 TKW_VV_VV_UW 100.0 FORMULA_0010 0.0 65535.0000 /end CHARACTERISTIC
/begin CHARACTERISTIC K_ED_LAVK1_OBD_PLAU.P_CODE_OPENLOAD "P-Code fuer die Art OPENLOAD | EN: Fault code LAVK1_OBD_PLAU - OBD P-code reported for open circuit" VALUE 0x7082A TKW_VV_VV_UW 100.0 FORMULA_0010 0.0 65535.0000 /end CHARACTERISTIC
/begin CHARACTERISTIC K_ED_LAVK2_OBD_PLAU.P_CODE_OPENLOAD "P-Code fuer die Art OPENLOAD | EN: Fault code LAVK2_OBD_PLAU - OBD P-code reported for open circuit" VALUE 0x70844 TKW_VV_VV_UW 100.0 FORMULA_0010 0.0 65535.0000 /end CHARACTERISTIC
/begin CHARACTERISTIC K_ED_LAVK1_OBD_SA.P_CODE_OPENLOAD "P-Code fuer die Art OPENLOAD | EN: Fault code LAVK1_OBD_SA - OBD P-code reported for open circuit" VALUE 0x7085E TKW_VV_VV_UW 100.0 FORMULA_0010 0.0 65535.0000 /end CHARACTERISTIC
/begin CHARACTERISTIC K_ED_LAVK2_OBD_SA.P_CODE_OPENLOAD "P-Code fuer die Art OPENLOAD | EN: Fault code LAVK2_OBD_SA - OBD P-code reported for open circuit" VALUE 0x70878 TKW_VV_VV_UW 100.0 FORMULA_0010 0.0 65535.0000 /end CHARACTERISTIC
/begin CHARACTERISTIC K_ED_LSHNK1.P_CODE_OPENLOAD "P-Code fuer die Art OPENLOAD | EN: Fault code LSHNK1 - OBD P-code reported for open circuit" VALUE 0x708C6 TKW_VV_VV_UW 100.0 FORMULA_0010 0.0 65535.0000 /end CHARACTERISTIC
/begin CHARACTERISTIC K_ED_LSHNK2.P_CODE_OPENLOAD "P-Code fuer die Art OPENLOAD | EN: Fault code LSHNK2 - OBD P-code reported for open circuit" VALUE 0x708E0 TKW_VV_VV_UW 100.0 FORMULA_0010 0.0 65535.0000 /end CHARACTERISTIC
/begin CHARACTERISTIC K_ED_PT_BUSOFF.P_CODE_OPENLOAD "P-Code fuer die Art OPENLOAD | EN: Fault code PT_BUSOFF - OBD P-code reported for open circuit" VALUE 0x708FA TKW_VV_VV_UW 100.0 FORMULA_0010 0.0 65535.0000 /end CHARACTERISTIC
/begin CHARACTERISTIC K_ED_PT_ATEMP.P_CODE_OPENLOAD "P-Code fuer die Art OPENLOAD | EN: Fault code PT_ATEMP - OBD P-code reported for open circuit" VALUE 0x7097C TKW_VV_VV_UW 100.0 FORMULA_0010 0.0 65535.0000 /end CHARACTERISTIC
/begin CHARACTERISTIC K_ED_PT_KLST.P_CODE_OPENLOAD "P-Code fuer die Art OPENLOAD | EN: Fault code PT_KLST - OBD P-code reported for open circuit" VALUE 0x70996 TKW_VV_VV_UW 100.0 FORMULA_0010 0.0 65535.0000 /end CHARACTERISTIC
/begin CHARACTERISTIC K_ED_PT_KKOS.P_CODE_OPENLOAD "P-Code fuer die Art OPENLOAD | EN: Fault code PT_KKOS - OBD P-code reported for open circuit" VALUE 0x709B0 TKW_VV_VV_UW 100.0 FORMULA_0010 0.0 65535.0000 /end CHARACTERISTIC
/begin CHARACTERISTIC K_ED_LAVK1_OBD_TL.P_CODE_OPENLOAD "P-Code fuer die Art OPENLOAD | EN: Fault code LAVK1_OBD_TL - OBD P-code reported for open circuit" VALUE 0x70A66 TKW_VV_VV_UW 100.0 FORMULA_0010 0.0 65535.0000 /end CHARACTERISTIC
/begin CHARACTERISTIC K_ED_LAVK2_OBD_TL.P_CODE_OPENLOAD "P-Code fuer die Art OPENLOAD | EN: Fault code LAVK2_OBD_TL - OBD P-code reported for open circuit" VALUE 0x70A80 TKW_VV_VV_UW 100.0 FORMULA_0010 0.0 65535.0000 /end CHARACTERISTIC
/begin CHARACTERISTIC K_ED_LSHVK1.P_CODE_OPENLOAD "P-Code fuer die Art OPENLOAD | EN: Fault code LSHVK1 - OBD P-code reported for open circuit" VALUE 0x70A9A TKW_VV_VV_UW 100.0 FORMULA_0010 0.0 65535.0000 /end CHARACTERISTIC
/begin CHARACTERISTIC K_ED_LSHVK2.P_CODE_OPENLOAD "P-Code fuer die Art OPENLOAD | EN: Fault code LSHVK2 - OBD P-code reported for open circuit" VALUE 0x70AB4 TKW_VV_VV_UW 100.0 FORMULA_0010 0.0 65535.0000 /end CHARACTERISTIC
/begin CHARACTERISTIC K_ED_LSRVK1_OBD_REG.P_CODE_OPENLOAD "P-Code fuer die Art OPENLOAD | EN: Fault code LSRVK1_OBD_REG - OBD P-code reported for open circuit" VALUE 0x70ACE TKW_VV_VV_UW 100.0 FORMULA_0010 0.0 65535.0000 /end CHARACTERISTIC
/begin CHARACTERISTIC K_ED_LSRVK2_OBD_REG.P_CODE_OPENLOAD "P-Code fuer die Art OPENLOAD | EN: Fault code LSRVK2_OBD_REG - OBD P-code reported for open circuit" VALUE 0x70AE8 TKW_VV_VV_UW 100.0 FORMULA_0010 0.0 65535.0000 /end CHARACTERISTIC
/begin CHARACTERISTIC K_ED_LSHVK1_R.P_CODE_OPENLOAD "P-Code fuer die Art OPENLOAD | EN: Fault code LSHVK1_R - OBD P-code reported for open circuit" VALUE 0x70B02 TKW_VV_VV_UW 100.0 FORMULA_0010 0.0 65535.0000 /end CHARACTERISTIC
/begin CHARACTERISTIC K_ED_LSHVK2_R.P_CODE_OPENLOAD "P-Code fuer die Art OPENLOAD | EN: Fault code LSHVK2_R - OBD P-code reported for open circuit" VALUE 0x70B1C TKW_VV_VV_UW 100.0 FORMULA_0010 0.0 65535.0000 /end CHARACTERISTIC
/begin CHARACTERISTIC K_ED_LSRVK1_OBD_START.P_CODE_OPENLOAD "P-Code fuer die Art OPENLOAD | EN: Fault code LSRVK1_OBD_START - OBD P-code reported for open circuit" VALUE 0x70B36 TKW_VV_VV_UW 100.0 FORMULA_0010 0.0 65535.0000 /end CHARACTERISTIC
/begin CHARACTERISTIC K_ED_LSRVK2_OBD_START.P_CODE_OPENLOAD "P-Code fuer die Art OPENLOAD | EN: Fault code LSRVK2_OBD_START - OBD P-code reported for open circuit" VALUE 0x70B50 TKW_VV_VV_UW 100.0 FORMULA_0010 0.0 65535.0000 /end CHARACTERISTIC
/begin CHARACTERISTIC K_ED_LSRVK1_OBD_REF.P_CODE_OPENLOAD "P-Code fuer die Art OPENLOAD | EN: Fault code LSRVK1_OBD_REF - OBD P-code reported for open circuit" VALUE 0x70B6A TKW_VV_VV_UW 100.0 FORMULA_0010 0.0 65535.0000 /end CHARACTERISTIC
/begin CHARACTERISTIC K_ED_LSRVK2_OBD_REF.P_CODE_OPENLOAD "P-Code fuer die Art OPENLOAD | EN: Fault code LSRVK2_OBD_REF - OBD P-code reported for open circuit" VALUE 0x70B84 TKW_VV_VV_UW 100.0 FORMULA_0010 0.0 65535.0000 /end CHARACTERISTIC
/begin CHARACTERISTIC K_ED_LAVK2_DIAG.P_CODE_OPENLOAD "P-Code fuer die Art OPENLOAD | EN: Fault code LAVK2_DIAG - OBD P-code reported for open circuit" VALUE 0x70BB8 TKW_VV_VV_UW 100.0 FORMULA_0010 0.0 65535.0000 /end CHARACTERISTIC
/begin CHARACTERISTIC K_ED_LAVK1_IA_OPENLOAD.P_CODE_OPENLOAD "P-Code fuer die Art OPENLOAD | EN: Fault code LAVK1_IA_OPENLOAD - OBD P-code reported for open circuit" VALUE 0x70BD2 TKW_VV_VV_UW 100.0 FORMULA_0010 0.0 65535.0000 /end CHARACTERISTIC
/begin CHARACTERISTIC K_ED_LAVK2_IA_OPENLOAD.P_CODE_OPENLOAD "P-Code fuer die Art OPENLOAD | EN: Fault code LAVK2_IA_OPENLOAD - OBD P-code reported for open circuit" VALUE 0x70BEC TKW_VV_VV_UW 100.0 FORMULA_0010 0.0 65535.0000 /end CHARACTERISTIC
/begin CHARACTERISTIC K_ED_PT_GRB.P_CODE_OPENLOAD "P-Code fuer die Art OPENLOAD | EN: Fault code PT_GRB - OBD P-code reported for open circuit" VALUE 0x70C06 TKW_VV_VV_UW 100.0 FORMULA_0010 0.0 65535.0000 /end CHARACTERISTIC
/begin CHARACTERISTIC K_ED_PT_GRB2.P_CODE_OPENLOAD "P-Code fuer die Art OPENLOAD | EN: Fault code PT_GRB2 - OBD P-code reported for open circuit" VALUE 0x70C20 TKW_VV_VV_UW 100.0 FORMULA_0010 0.0 65535.0000 /end CHARACTERISTIC
/begin CHARACTERISTIC K_ED_LAVK1_UN_OPENLOAD.P_CODE_OPENLOAD "P-Code fuer die Art OPENLOAD | EN: Fault code LAVK1_UN_OPENLOAD - OBD P-code reported for open circuit" VALUE 0x70C3A TKW_VV_VV_UW 100.0 FORMULA_0010 0.0 65535.0000 /end CHARACTERISTIC
/begin CHARACTERISTIC K_ED_LAVK2_UN_OPENLOAD.P_CODE_OPENLOAD "P-Code fuer die Art OPENLOAD | EN: Fault code LAVK2_UN_OPENLOAD - OBD P-code reported for open circuit" VALUE 0x70C54 TKW_VV_VV_UW 100.0 FORMULA_0010 0.0 65535.0000 /end CHARACTERISTIC
/begin CHARACTERISTIC K_ED_LAVK1_IP_OPENLOAD.P_CODE_OPENLOAD "P-Code fuer die Art OPENLOAD | EN: Fault code LAVK1_IP_OPENLOAD - OBD P-code reported for open circuit" VALUE 0x70C6E TKW_VV_VV_UW 100.0 FORMULA_0010 0.0 65535.0000 /end CHARACTERISTIC
/begin CHARACTERISTIC K_ED_LAVK2_IP_OPENLOAD.P_CODE_OPENLOAD "P-Code fuer die Art OPENLOAD | EN: Fault code LAVK2_IP_OPENLOAD - OBD P-code reported for open circuit" VALUE 0x70C88 TKW_VV_VV_UW 100.0 FORMULA_0010 0.0 65535.0000 /end CHARACTERISTIC
/begin CHARACTERISTIC K_ED_LAVK1_OBD_DYN.P_CODE_OPENLOAD "P-Code fuer die Art OPENLOAD | EN: Fault code LAVK1_OBD_DYN - OBD P-code reported for open circuit" VALUE 0x70FC8 TKW_VV_VV_UW 100.0 FORMULA_0010 0.0 65535.0000 /end CHARACTERISTIC
/begin CHARACTERISTIC K_ED_LAVK2_OBD_DYN.P_CODE_OPENLOAD "P-Code fuer die Art OPENLOAD | EN: Fault code LAVK2_OBD_DYN - OBD P-code reported for open circuit" VALUE 0x70FE2 TKW_VV_VV_UW 100.0 FORMULA_0010 0.0 65535.0000 /end CHARACTERISTIC
/begin CHARACTERISTIC K_ED_PT_CRASH.P_CODE_OPENLOAD "P-Code fuer die Art OPENLOAD | EN: Fault code PT_CRASH - OBD P-code reported for open circuit" VALUE 0x70FFC TKW_VV_VV_UW 100.0 FORMULA_0010 0.0 65535.0000 /end CHARACTERISTIC
/begin CHARACTERISTIC K_ED_PT_BEDFGR.P_CODE_OPENLOAD "P-Code fuer die Art OPENLOAD | EN: Fault code PT_BEDFGR - OBD P-code reported for open circuit" VALUE 0x71030 TKW_VV_VV_UW 100.0 FORMULA_0010 0.0 65535.0000 /end CHARACTERISTIC
/begin CHARACTERISTIC K_ED_LAVK1_TRIM.P_CODE_OPENLOAD "P-Code fuer die Art OPENLOAD | EN: Fault code LAVK1_TRIM - OBD P-code reported for open circuit" VALUE 0x710E6 TKW_VV_VV_UW 100.0 FORMULA_0010 0.0 65535.0000 /end CHARACTERISTIC
/begin CHARACTERISTIC K_ED_LAVK2_TRIM.P_CODE_OPENLOAD "P-Code fuer die Art OPENLOAD | EN: Fault code LAVK2_TRIM - OBD P-code reported for open circuit" VALUE 0x71100 TKW_VV_VV_UW 100.0 FORMULA_0010 0.0 65535.0000 /end CHARACTERISTIC
/begin CHARACTERISTIC K_ED_PT_KM.P_CODE_OPENLOAD "P-Code fuer die Art OPENLOAD | EN: Fault code PT_KM - OBD P-code reported for open circuit" VALUE 0x711B6 TKW_VV_VV_UW 100.0 FORMULA_0010 0.0 65535.0000 /end CHARACTERISTIC
/begin CHARACTERISTIC K_ED_PT_KOMBI.P_CODE_OPENLOAD "P-Code fuer die Art OPENLOAD | EN: Fault code PT_KOMBI - OBD P-code reported for open circuit" VALUE 0x711D0 TKW_VV_VV_UW 100.0 FORMULA_0010 0.0 65535.0000 /end CHARACTERISTIC
/begin CHARACTERISTIC K_ED_PKS_LL.P_CODE_OPENLOAD "P-Code fuer die Art OPENLOAD | EN: Fault code PKS_LL - OBD P-code reported for open circuit" VALUE 0x711EA TKW_VV_VV_UW 100.0 FORMULA_0010 0.0 65535.0000 /end CHARACTERISTIC
/begin CHARACTERISTIC K_ED_PKS_TL.P_CODE_OPENLOAD "P-Code fuer die Art OPENLOAD | EN: Fault code PKS_TL - OBD P-code reported for open circuit" VALUE 0x71204 TKW_VV_VV_UW 100.0 FORMULA_0010 0.0 65535.0000 /end CHARACTERISTIC
/begin CHARACTERISTIC K_ED_PKS_Q.P_CODE_OPENLOAD "P-Code fuer die Art OPENLOAD | EN: Fault code PKS_Q - OBD P-code reported for open circuit" VALUE 0x7121E TKW_VV_VV_UW 100.0 FORMULA_0010 0.0 65535.0000 /end CHARACTERISTIC
/begin CHARACTERISTIC K_ED_MVAC_DRUCKSENSOR.P_CODE_OPENLOAD "P-Code fuer die Art OPENLOAD | EN: Fault code MVAC_DRUCKSENSOR - OBD P-code reported for open circuit" VALUE 0x71356 TKW_VV_VV_UW 100.0 FORMULA_0010 0.0 65535.0000 /end CHARACTERISTIC
/begin CHARACTERISTIC K_ED_PT_BEDAT.P_CODE_OPENLOAD "P-Code fuer die Art OPENLOAD | EN: Fault code PT_BEDAT - OBD P-code reported for open circuit" VALUE 0x71370 TKW_VV_VV_UW 100.0 FORMULA_0010 0.0 65535.0000 /end CHARACTERISTIC
/begin CHARACTERISTIC K_ED_PT_ANFRADMOM.P_CODE_OPENLOAD "P-Code fuer die Art OPENLOAD | EN: Fault code PT_ANFRADMOM - OBD P-code reported for open circuit" VALUE 0x717B4 TKW_VV_VV_UW 100.0 FORMULA_0010 0.0 65535.0000 /end CHARACTERISTIC
/begin CHARACTERISTIC K_ED_LSHNK1_R.P_CODE_OPENLOAD "P-Code fuer die Art OPENLOAD | EN: Fault code LSHNK1_R - OBD P-code reported for open circuit" VALUE 0x71906 TKW_VV_VV_UW 100.0 FORMULA_0010 0.0 65535.0000 /end CHARACTERISTIC
/begin CHARACTERISTIC K_ED_LSHNK2_R.P_CODE_OPENLOAD "P-Code fuer die Art OPENLOAD | EN: Fault code LSHNK2_R - OBD P-code reported for open circuit" VALUE 0x71920 TKW_VV_VV_UW 100.0 FORMULA_0010 0.0 65535.0000 /end CHARACTERISTIC
/begin CHARACTERISTIC K_ED_PKS_MODELL.P_CODE_OPENLOAD "P-Code fuer die Art OPENLOAD | EN: Fault code PKS_MODELL - OBD P-code reported for open circuit" VALUE 0x7193A TKW_VV_VV_UW 100.0 FORMULA_0010 0.0 65535.0000 /end CHARACTERISTIC
/begin CHARACTERISTIC K_ED_PKS_PAUFBAU.P_CODE_OPENLOAD "P-Code fuer die Art OPENLOAD | EN: Fault code PKS_PAUFBAU - OBD P-code reported for open circuit" VALUE 0x71954 TKW_VV_VV_UW 100.0 FORMULA_0010 0.0 65535.0000 /end CHARACTERISTIC
/begin CHARACTERISTIC K_ED_PKS_ADAPT_ANSCHL.P_CODE_OPENLOAD "P-Code fuer die Art OPENLOAD | EN: Fault code PKS_ADAPT_ANSCHL - OBD P-code reported for open circuit" VALUE 0x7196E TKW_VV_VV_UW 100.0 FORMULA_0010 0.0 65535.0000 /end CHARACTERISTIC
/begin CHARACTERISTIC K_ED_LAVK_ATIC42.P_CODE_OPENLOAD "P-Code fuer die Art OPENLOAD | EN: Fault code LAVK_ATIC42 - OBD P-code reported for open circuit" VALUE 0x719A2 TKW_VV_VV_UW 100.0 FORMULA_0010 0.0 65535.0000 /end CHARACTERISTIC
/begin CHARACTERISTIC K_ED_PT_AX.P_CODE_OPENLOAD "P-Code fuer die Art OPENLOAD | EN: Fault code PT_AX - OBD P-code reported for open circuit" VALUE 0x719BC TKW_VV_VV_UW 100.0 FORMULA_0010 0.0 65535.0000 /end CHARACTERISTIC
/begin CHARACTERISTIC K_ED_MVAC_OBD.P_CODE_OPENLOAD "P-Code fuer die Art OPENLOAD" VALUE 0x71A58 TKW_VV_VV_UW 100.0 FORMULA_0010 0.0 65535.0000 /end CHARACTERISTIC
/begin CHARACTERISTIC K_ED_LAVK2_ATIC42.P_CODE_OPENLOAD "P-Code fuer die Art OPENLOAD" VALUE 0x71A8C TKW_VV_VV_UW 100.0 FORMULA_0010 0.0 65535.0000 /end CHARACTERISTIC
/begin CHARACTERISTIC K_ED_NW1_SYNC.P_CODE_UNPLAUSIBEL "P-Code fuer die Art UNPLAUSIBEL" VALUE 0x7075C TKW_VV_VV_UW 100.0 FORMULA_0010 0.0 65535.0000 /end CHARACTERISTIC
/begin CHARACTERISTIC K_ED_NW2_SYNC.P_CODE_UNPLAUSIBEL "P-Code fuer die Art UNPLAUSIBEL" VALUE 0x70776 TKW_VV_VV_UW 100.0 FORMULA_0010 0.0 65535.0000 /end CHARACTERISTIC
/begin CHARACTERISTIC K_ED_PCTRL_INJ.P_CODE_UNPLAUSIBEL "P-Code fuer die Art UNPLAUSIBEL | EN: Fault code PCTRL_INJ - OBD P-code reported for implausible signal" VALUE 0x70790 TKW_VV_VV_UW 100.0 FORMULA_0010 0.0 65535.0000 /end CHARACTERISTIC
/begin CHARACTERISTIC K_ED_PKS.P_CODE_UNPLAUSIBEL "P-Code fuer die Art UNPLAUSIBEL | EN: Fault code PKS - OBD P-code reported for implausible signal" VALUE 0x707C4 TKW_VV_VV_UW 100.0 FORMULA_0010 0.0 65535.0000 /end CHARACTERISTIC
/begin CHARACTERISTIC K_ED_LAVK2.P_CODE_UNPLAUSIBEL "P-Code fuer die Art UNPLAUSIBEL | EN: Fault code LAVK2 - OBD P-code reported for implausible signal" VALUE 0x70812 TKW_VV_VV_UW 100.0 FORMULA_0010 0.0 65535.0000 /end CHARACTERISTIC
/begin CHARACTERISTIC K_ED_LAVK1_OBD_PLAU.P_CODE_UNPLAUSIBEL "P-Code fuer die Art UNPLAUSIBEL | EN: Fault code LAVK1_OBD_PLAU - OBD P-code reported for implausible signal" VALUE 0x7082C TKW_VV_VV_UW 100.0 FORMULA_0010 0.0 65535.0000 /end CHARACTERISTIC
/begin CHARACTERISTIC K_ED_LAVK2_OBD_PLAU.P_CODE_UNPLAUSIBEL "P-Code fuer die Art UNPLAUSIBEL | EN: Fault code LAVK2_OBD_PLAU - OBD P-code reported for implausible signal" VALUE 0x70846 TKW_VV_VV_UW 100.0 FORMULA_0010 0.0 65535.0000 /end CHARACTERISTIC
/begin CHARACTERISTIC K_ED_LAVK1_OBD_SA.P_CODE_UNPLAUSIBEL "P-Code fuer die Art UNPLAUSIBEL | EN: Fault code LAVK1_OBD_SA - OBD P-code reported for implausible signal" VALUE 0x70860 TKW_VV_VV_UW 100.0 FORMULA_0010 0.0 65535.0000 /end CHARACTERISTIC
/begin CHARACTERISTIC K_ED_LAVK2_OBD_SA.P_CODE_UNPLAUSIBEL "P-Code fuer die Art UNPLAUSIBEL | EN: Fault code LAVK2_OBD_SA - OBD P-code reported for implausible signal" VALUE 0x7087A TKW_VV_VV_UW 100.0 FORMULA_0010 0.0 65535.0000 /end CHARACTERISTIC
/begin CHARACTERISTIC K_ED_LSHNK1.P_CODE_UNPLAUSIBEL "P-Code fuer die Art UNPLAUSIBEL | EN: Fault code LSHNK1 - OBD P-code reported for implausible signal" VALUE 0x708C8 TKW_VV_VV_UW 100.0 FORMULA_0010 0.0 65535.0000 /end CHARACTERISTIC
/begin CHARACTERISTIC K_ED_LSHNK2.P_CODE_UNPLAUSIBEL "P-Code fuer die Art UNPLAUSIBEL | EN: Fault code LSHNK2 - OBD P-code reported for implausible signal" VALUE 0x708E2 TKW_VV_VV_UW 100.0 FORMULA_0010 0.0 65535.0000 /end CHARACTERISTIC
/begin CHARACTERISTIC K_ED_PT_BUSOFF.P_CODE_UNPLAUSIBEL "P-Code fuer die Art UNPLAUSIBEL | EN: Fault code PT_BUSOFF - OBD P-code reported for implausible signal" VALUE 0x708FC TKW_VV_VV_UW 100.0 FORMULA_0010 0.0 65535.0000 /end CHARACTERISTIC
/begin CHARACTERISTIC K_ED_PT_ATEMP.P_CODE_UNPLAUSIBEL "P-Code fuer die Art UNPLAUSIBEL | EN: Fault code PT_ATEMP - OBD P-code reported for implausible signal" VALUE 0x7097E TKW_VV_VV_UW 100.0 FORMULA_0010 0.0 65535.0000 /end CHARACTERISTIC
/begin CHARACTERISTIC K_ED_PT_KLST.P_CODE_UNPLAUSIBEL "P-Code fuer die Art UNPLAUSIBEL | EN: Fault code PT_KLST - OBD P-code reported for implausible signal" VALUE 0x70998 TKW_VV_VV_UW 100.0 FORMULA_0010 0.0 65535.0000 /end CHARACTERISTIC
/begin CHARACTERISTIC K_ED_PT_KKOS.P_CODE_UNPLAUSIBEL "P-Code fuer die Art UNPLAUSIBEL | EN: Fault code PT_KKOS - OBD P-code reported for implausible signal" VALUE 0x709B2 TKW_VV_VV_UW 100.0 FORMULA_0010 0.0 65535.0000 /end CHARACTERISTIC
/begin CHARACTERISTIC K_ED_LAVK1_OBD_TL.P_CODE_UNPLAUSIBEL "P-Code fuer die Art UNPLAUSIBEL | EN: Fault code LAVK1_OBD_TL - OBD P-code reported for implausible signal" VALUE 0x70A68 TKW_VV_VV_UW 100.0 FORMULA_0010 0.0 65535.0000 /end CHARACTERISTIC
/begin CHARACTERISTIC K_ED_LAVK2_OBD_TL.P_CODE_UNPLAUSIBEL "P-Code fuer die Art UNPLAUSIBEL | EN: Fault code LAVK2_OBD_TL - OBD P-code reported for implausible signal" VALUE 0x70A82 TKW_VV_VV_UW 100.0 FORMULA_0010 0.0 65535.0000 /end CHARACTERISTIC
/begin CHARACTERISTIC K_ED_LSHVK1.P_CODE_UNPLAUSIBEL "P-Code fuer die Art UNPLAUSIBEL | EN: Fault code LSHVK1 - OBD P-code reported for implausible signal" VALUE 0x70A9C TKW_VV_VV_UW 100.0 FORMULA_0010 0.0 65535.0000 /end CHARACTERISTIC
/begin CHARACTERISTIC K_ED_LSHVK2.P_CODE_UNPLAUSIBEL "P-Code fuer die Art UNPLAUSIBEL | EN: Fault code LSHVK2 - OBD P-code reported for implausible signal" VALUE 0x70AB6 TKW_VV_VV_UW 100.0 FORMULA_0010 0.0 65535.0000 /end CHARACTERISTIC
/begin CHARACTERISTIC K_ED_LSRVK1_OBD_REG.P_CODE_UNPLAUSIBEL "P-Code fuer die Art UNPLAUSIBEL | EN: Fault code LSRVK1_OBD_REG - OBD P-code reported for implausible signal" VALUE 0x70AD0 TKW_VV_VV_UW 100.0 FORMULA_0010 0.0 65535.0000 /end CHARACTERISTIC
/begin CHARACTERISTIC K_ED_LSRVK2_OBD_REG.P_CODE_UNPLAUSIBEL "P-Code fuer die Art UNPLAUSIBEL | EN: Fault code LSRVK2_OBD_REG - OBD P-code reported for implausible signal" VALUE 0x70AEA TKW_VV_VV_UW 100.0 FORMULA_0010 0.0 65535.0000 /end CHARACTERISTIC
/begin CHARACTERISTIC K_ED_LSHVK1_R.P_CODE_UNPLAUSIBEL "P-Code fuer die Art UNPLAUSIBEL | EN: Fault code LSHVK1_R - OBD P-code reported for implausible signal" VALUE 0x70B04 TKW_VV_VV_UW 100.0 FORMULA_0010 0.0 65535.0000 /end CHARACTERISTIC
/begin CHARACTERISTIC K_ED_LSHVK2_R.P_CODE_UNPLAUSIBEL "P-Code fuer die Art UNPLAUSIBEL | EN: Fault code LSHVK2_R - OBD P-code reported for implausible signal" VALUE 0x70B1E TKW_VV_VV_UW 100.0 FORMULA_0010 0.0 65535.0000 /end CHARACTERISTIC
/begin CHARACTERISTIC K_ED_LSRVK1_OBD_START.P_CODE_UNPLAUSIBEL "P-Code fuer die Art UNPLAUSIBEL | EN: Fault code LSRVK1_OBD_START - OBD P-code reported for implausible signal" VALUE 0x70B38 TKW_VV_VV_UW 100.0 FORMULA_0010 0.0 65535.0000 /end CHARACTERISTIC
/begin CHARACTERISTIC K_ED_LSRVK2_OBD_START.P_CODE_UNPLAUSIBEL "P-Code fuer die Art UNPLAUSIBEL | EN: Fault code LSRVK2_OBD_START - OBD P-code reported for implausible signal" VALUE 0x70B52 TKW_VV_VV_UW 100.0 FORMULA_0010 0.0 65535.0000 /end CHARACTERISTIC
/begin CHARACTERISTIC K_ED_LSRVK1_OBD_REF.P_CODE_UNPLAUSIBEL "P-Code fuer die Art UNPLAUSIBEL | EN: Fault code LSRVK1_OBD_REF - OBD P-code reported for implausible signal" VALUE 0x70B6C TKW_VV_VV_UW 100.0 FORMULA_0010 0.0 65535.0000 /end CHARACTERISTIC
/begin CHARACTERISTIC K_ED_LSRVK2_OBD_REF.P_CODE_UNPLAUSIBEL "P-Code fuer die Art UNPLAUSIBEL | EN: Fault code LSRVK2_OBD_REF - OBD P-code reported for implausible signal" VALUE 0x70B86 TKW_VV_VV_UW 100.0 FORMULA_0010 0.0 65535.0000 /end CHARACTERISTIC
/begin CHARACTERISTIC K_ED_LAVK2_DIAG.P_CODE_UNPLAUSIBEL "P-Code fuer die Art UNPLAUSIBEL | EN: Fault code LAVK2_DIAG - OBD P-code reported for implausible signal" VALUE 0x70BBA TKW_VV_VV_UW 100.0 FORMULA_0010 0.0 65535.0000 /end CHARACTERISTIC
/begin CHARACTERISTIC K_ED_LAVK1_IA_OPENLOAD.P_CODE_UNPLAUSIBEL "P-Code fuer die Art UNPLAUSIBEL | EN: Fault code LAVK1_IA_OPENLOAD - OBD P-code reported for implausible signal" VALUE 0x70BD4 TKW_VV_VV_UW 100.0 FORMULA_0010 0.0 65535.0000 /end CHARACTERISTIC
/begin CHARACTERISTIC K_ED_LAVK2_IA_OPENLOAD.P_CODE_UNPLAUSIBEL "P-Code fuer die Art UNPLAUSIBEL | EN: Fault code LAVK2_IA_OPENLOAD - OBD P-code reported for implausible signal" VALUE 0x70BEE TKW_VV_VV_UW 100.0 FORMULA_0010 0.0 65535.0000 /end CHARACTERISTIC
/begin CHARACTERISTIC K_ED_PT_GRB.P_CODE_UNPLAUSIBEL "P-Code fuer die Art UNPLAUSIBEL | EN: Fault code PT_GRB - OBD P-code reported for implausible signal" VALUE 0x70C08 TKW_VV_VV_UW 100.0 FORMULA_0010 0.0 65535.0000 /end CHARACTERISTIC
/begin CHARACTERISTIC K_ED_PT_GRB2.P_CODE_UNPLAUSIBEL "P-Code fuer die Art UNPLAUSIBEL | EN: Fault code PT_GRB2 - OBD P-code reported for implausible signal" VALUE 0x70C22 TKW_VV_VV_UW 100.0 FORMULA_0010 0.0 65535.0000 /end CHARACTERISTIC
/begin CHARACTERISTIC K_ED_LAVK1_UN_OPENLOAD.P_CODE_UNPLAUSIBEL "P-Code fuer die Art UNPLAUSIBEL | EN: Fault code LAVK1_UN_OPENLOAD - OBD P-code reported for implausible signal" VALUE 0x70C3C TKW_VV_VV_UW 100.0 FORMULA_0010 0.0 65535.0000 /end CHARACTERISTIC
/begin CHARACTERISTIC K_ED_LAVK2_UN_OPENLOAD.P_CODE_UNPLAUSIBEL "P-Code fuer die Art UNPLAUSIBEL | EN: Fault code LAVK2_UN_OPENLOAD - OBD P-code reported for implausible signal" VALUE 0x70C56 TKW_VV_VV_UW 100.0 FORMULA_0010 0.0 65535.0000 /end CHARACTERISTIC
/begin CHARACTERISTIC K_ED_LAVK1_IP_OPENLOAD.P_CODE_UNPLAUSIBEL "P-Code fuer die Art UNPLAUSIBEL | EN: Fault code LAVK1_IP_OPENLOAD - OBD P-code reported for implausible signal" VALUE 0x70C70 TKW_VV_VV_UW 100.0 FORMULA_0010 0.0 65535.0000 /end CHARACTERISTIC
/begin CHARACTERISTIC K_ED_LAVK2_IP_OPENLOAD.P_CODE_UNPLAUSIBEL "P-Code fuer die Art UNPLAUSIBEL | EN: Fault code LAVK2_IP_OPENLOAD - OBD P-code reported for implausible signal" VALUE 0x70C8A TKW_VV_VV_UW 100.0 FORMULA_0010 0.0 65535.0000 /end CHARACTERISTIC
/begin CHARACTERISTIC K_ED_LAVK1_OBD_DYN.P_CODE_UNPLAUSIBEL "P-Code fuer die Art UNPLAUSIBEL | EN: Fault code LAVK1_OBD_DYN - OBD P-code reported for implausible signal" VALUE 0x70FCA TKW_VV_VV_UW 100.0 FORMULA_0010 0.0 65535.0000 /end CHARACTERISTIC
/begin CHARACTERISTIC K_ED_LAVK2_OBD_DYN.P_CODE_UNPLAUSIBEL "P-Code fuer die Art UNPLAUSIBEL | EN: Fault code LAVK2_OBD_DYN - OBD P-code reported for implausible signal" VALUE 0x70FE4 TKW_VV_VV_UW 100.0 FORMULA_0010 0.0 65535.0000 /end CHARACTERISTIC
/begin CHARACTERISTIC K_ED_PT_CRASH.P_CODE_UNPLAUSIBEL "P-Code fuer die Art UNPLAUSIBEL | EN: Fault code PT_CRASH - OBD P-code reported for implausible signal" VALUE 0x70FFE TKW_VV_VV_UW 100.0 FORMULA_0010 0.0 65535.0000 /end CHARACTERISTIC
/begin CHARACTERISTIC K_ED_PT_BEDFGR.P_CODE_UNPLAUSIBEL "P-Code fuer die Art UNPLAUSIBEL | EN: Fault code PT_BEDFGR - OBD P-code reported for implausible signal" VALUE 0x71032 TKW_VV_VV_UW 100.0 FORMULA_0010 0.0 65535.0000 /end CHARACTERISTIC
/begin CHARACTERISTIC K_ED_LAVK1_TRIM.P_CODE_UNPLAUSIBEL "P-Code fuer die Art UNPLAUSIBEL | EN: Fault code LAVK1_TRIM - OBD P-code reported for implausible signal" VALUE 0x710E8 TKW_VV_VV_UW 100.0 FORMULA_0010 0.0 65535.0000 /end CHARACTERISTIC
/begin CHARACTERISTIC K_ED_LAVK2_TRIM.P_CODE_UNPLAUSIBEL "P-Code fuer die Art UNPLAUSIBEL | EN: Fault code LAVK2_TRIM - OBD P-code reported for implausible signal" VALUE 0x71102 TKW_VV_VV_UW 100.0 FORMULA_0010 0.0 65535.0000 /end CHARACTERISTIC
/begin CHARACTERISTIC K_ED_PT_KM.P_CODE_UNPLAUSIBEL "P-Code fuer die Art UNPLAUSIBEL | EN: Fault code PT_KM - OBD P-code reported for implausible signal" VALUE 0x711B8 TKW_VV_VV_UW 100.0 FORMULA_0010 0.0 65535.0000 /end CHARACTERISTIC
/begin CHARACTERISTIC K_ED_PT_KOMBI.P_CODE_UNPLAUSIBEL "P-Code fuer die Art UNPLAUSIBEL | EN: Fault code PT_KOMBI - OBD P-code reported for implausible signal" VALUE 0x711D2 TKW_VV_VV_UW 100.0 FORMULA_0010 0.0 65535.0000 /end CHARACTERISTIC
/begin CHARACTERISTIC K_ED_PKS_LL.P_CODE_UNPLAUSIBEL "P-Code fuer die Art UNPLAUSIBEL | EN: Fault code PKS_LL - OBD P-code reported for implausible signal" VALUE 0x711EC TKW_VV_VV_UW 100.0 FORMULA_0010 0.0 65535.0000 /end CHARACTERISTIC
/begin CHARACTERISTIC K_ED_PKS_TL.P_CODE_UNPLAUSIBEL "P-Code fuer die Art UNPLAUSIBEL | EN: Fault code PKS_TL - OBD P-code reported for implausible signal" VALUE 0x71206 TKW_VV_VV_UW 100.0 FORMULA_0010 0.0 65535.0000 /end CHARACTERISTIC
/begin CHARACTERISTIC K_ED_PKS_Q.P_CODE_UNPLAUSIBEL "P-Code fuer die Art UNPLAUSIBEL | EN: Fault code PKS_Q - OBD P-code reported for implausible signal" VALUE 0x71220 TKW_VV_VV_UW 100.0 FORMULA_0010 0.0 65535.0000 /end CHARACTERISTIC
/begin CHARACTERISTIC K_ED_MVAC_DRUCKSENSOR.P_CODE_UNPLAUSIBEL "P-Code fuer die Art UNPLAUSIBEL | EN: Fault code MVAC_DRUCKSENSOR - OBD P-code reported for implausible signal" VALUE 0x71358 TKW_VV_VV_UW 100.0 FORMULA_0010 0.0 65535.0000 /end CHARACTERISTIC
/begin CHARACTERISTIC K_ED_PT_BEDAT.P_CODE_UNPLAUSIBEL "P-Code fuer die Art UNPLAUSIBEL | EN: Fault code PT_BEDAT - OBD P-code reported for implausible signal" VALUE 0x71372 TKW_VV_VV_UW 100.0 FORMULA_0010 0.0 65535.0000 /end CHARACTERISTIC
/begin CHARACTERISTIC K_ED_PT_ANFRADMOM.P_CODE_UNPLAUSIBEL "P-Code fuer die Art UNPLAUSIBEL | EN: Fault code PT_ANFRADMOM - OBD P-code reported for implausible signal" VALUE 0x717B6 TKW_VV_VV_UW 100.0 FORMULA_0010 0.0 65535.0000 /end CHARACTERISTIC
/begin CHARACTERISTIC K_ED_LSHNK1_R.P_CODE_UNPLAUSIBEL "P-Code fuer die Art UNPLAUSIBEL | EN: Fault code LSHNK1_R - OBD P-code reported for implausible signal" VALUE 0x71908 TKW_VV_VV_UW 100.0 FORMULA_0010 0.0 65535.0000 /end CHARACTERISTIC
/begin CHARACTERISTIC K_ED_LSHNK2_R.P_CODE_UNPLAUSIBEL "P-Code fuer die Art UNPLAUSIBEL | EN: Fault code LSHNK2_R - OBD P-code reported for implausible signal" VALUE 0x71922 TKW_VV_VV_UW 100.0 FORMULA_0010 0.0 65535.0000 /end CHARACTERISTIC
/begin CHARACTERISTIC K_ED_PKS_MODELL.P_CODE_UNPLAUSIBEL "P-Code fuer die Art UNPLAUSIBEL | EN: Fault code PKS_MODELL - OBD P-code reported for implausible signal" VALUE 0x7193C TKW_VV_VV_UW 100.0 FORMULA_0010 0.0 65535.0000 /end CHARACTERISTIC
/begin CHARACTERISTIC K_ED_PKS_PAUFBAU.P_CODE_UNPLAUSIBEL "P-Code fuer die Art UNPLAUSIBEL | EN: Fault code PKS_PAUFBAU - OBD P-code reported for implausible signal" VALUE 0x71956 TKW_VV_VV_UW 100.0 FORMULA_0010 0.0 65535.0000 /end CHARACTERISTIC
/begin CHARACTERISTIC K_ED_PKS_ADAPT_ANSCHL.P_CODE_UNPLAUSIBEL "P-Code fuer die Art UNPLAUSIBEL | EN: Fault code PKS_ADAPT_ANSCHL - OBD P-code reported for implausible signal" VALUE 0x71970 TKW_VV_VV_UW 100.0 FORMULA_0010 0.0 65535.0000 /end CHARACTERISTIC
/begin CHARACTERISTIC K_ED_LAVK_ATIC42.P_CODE_UNPLAUSIBEL "P-Code fuer die Art UNPLAUSIBEL | EN: Fault code LAVK_ATIC42 - OBD P-code reported for implausible signal" VALUE 0x719A4 TKW_VV_VV_UW 100.0 FORMULA_0010 0.0 65535.0000 /end CHARACTERISTIC
/begin CHARACTERISTIC K_ED_PT_AX.P_CODE_UNPLAUSIBEL "P-Code fuer die Art UNPLAUSIBEL | EN: Fault code PT_AX - OBD P-code reported for implausible signal" VALUE 0x719BE TKW_VV_VV_UW 100.0 FORMULA_0010 0.0 65535.0000 /end CHARACTERISTIC
/begin CHARACTERISTIC K_ED_MVAC_OBD.P_CODE_UNPLAUSIBEL "P-Code fuer die Art UNPLAUSIBEL" VALUE 0x71A5A TKW_VV_VV_UW 100.0 FORMULA_0010 0.0 65535.0000 /end CHARACTERISTIC
/begin CHARACTERISTIC K_ED_LAVK2_ATIC42.P_CODE_UNPLAUSIBEL "P-Code fuer die Art UNPLAUSIBEL" VALUE 0x71A8E TKW_VV_VV_UW 100.0 FORMULA_0010 0.0 65535.0000 /end CHARACTERISTIC
/begin CHARACTERISTIC K_ED_PSAU1.FEHLERSCHWELLE "Filterschwelle fuer Fehlereintrag | EN: Fault code PSAU1 - debounce filter threshold for setting the fault" VALUE 0x7065A TKW_VV_VV_UB 100.0 FORMULA_0003 0.0 255.0000 /end CHARACTERISTIC
/begin CHARACTERISTIC K_ED_PSAU2.FEHLERSCHWELLE "Filterschwelle fuer Fehlereintrag | EN: Fault code PSAU2 - debounce filter threshold for setting the fault" VALUE 0x70674 TKW_VV_VV_UB 100.0 FORMULA_0003 0.0 255.0000 /end CHARACTERISTIC
/begin CHARACTERISTIC K_ED_NW1_SYNC.FEHLERSCHWELLE "Filterschwelle fuer Fehlereintrag" VALUE 0x7075E TKW_VV_VV_UB 100.0 FORMULA_0003 0.0 255.0000 /end CHARACTERISTIC
/begin CHARACTERISTIC K_ED_NW2_SYNC.FEHLERSCHWELLE "Filterschwelle fuer Fehlereintrag" VALUE 0x70778 TKW_VV_VV_UB 100.0 FORMULA_0003 0.0 255.0000 /end CHARACTERISTIC
/begin CHARACTERISTIC K_ED_PCTRL_INJ.FEHLERSCHWELLE "Filterschwelle fuer Fehlereintrag | EN: Fault code PCTRL_INJ - debounce filter threshold for setting the fault" VALUE 0x70792 TKW_VV_VV_UB 100.0 FORMULA_0003 0.0 255.0000 /end CHARACTERISTIC
/begin CHARACTERISTIC K_ED_PKS.FEHLERSCHWELLE "Filterschwelle fuer Fehlereintrag | EN: Fault code PKS - debounce filter threshold for setting the fault" VALUE 0x707C6 TKW_VV_VV_UB 100.0 FORMULA_0003 0.0 255.0000 /end CHARACTERISTIC
/begin CHARACTERISTIC K_ED_LAVK2.FEHLERSCHWELLE "Filterschwelle fuer Fehlereintrag | EN: Fault code LAVK2 - debounce filter threshold for setting the fault" VALUE 0x70814 TKW_VV_VV_UB 100.0 FORMULA_0003 0.0 255.0000 /end CHARACTERISTIC
/begin CHARACTERISTIC K_ED_LAVK1_OBD_PLAU.FEHLERSCHWELLE "Filterschwelle fuer Fehlereintrag | EN: Fault code LAVK1_OBD_PLAU - debounce filter threshold for setting the fault" VALUE 0x7082E TKW_VV_VV_UB 100.0 FORMULA_0003 0.0 255.0000 /end CHARACTERISTIC
/begin CHARACTERISTIC K_ED_LAVK2_OBD_PLAU.FEHLERSCHWELLE "Filterschwelle fuer Fehlereintrag | EN: Fault code LAVK2_OBD_PLAU - debounce filter threshold for setting the fault" VALUE 0x70848 TKW_VV_VV_UB 100.0 FORMULA_0003 0.0 255.0000 /end CHARACTERISTIC
/begin CHARACTERISTIC K_ED_LAVK1_OBD_SA.FEHLERSCHWELLE "Filterschwelle fuer Fehlereintrag | EN: Fault code LAVK1_OBD_SA - debounce filter threshold for setting the fault [V912: differs from V452 160E]" VALUE 0x70862 TKW_VV_VV_UB 100.0 FORMULA_0003 0.0 255.0000 /end CHARACTERISTIC
/begin CHARACTERISTIC K_ED_LAVK2_OBD_SA.FEHLERSCHWELLE "Filterschwelle fuer Fehlereintrag | EN: Fault code LAVK2_OBD_SA - debounce filter threshold for setting the fault [V912: differs from V452 160E]" VALUE 0x7087C TKW_VV_VV_UB 100.0 FORMULA_0003 0.0 255.0000 /end CHARACTERISTIC
/begin CHARACTERISTIC K_ED_LSHNK1.FEHLERSCHWELLE "Filterschwelle fuer Fehlereintrag | EN: Fault code LSHNK1 - debounce filter threshold for setting the fault" VALUE 0x708CA TKW_VV_VV_UB 100.0 FORMULA_0003 0.0 255.0000 /end CHARACTERISTIC
/begin CHARACTERISTIC K_ED_LSHNK2.FEHLERSCHWELLE "Filterschwelle fuer Fehlereintrag | EN: Fault code LSHNK2 - debounce filter threshold for setting the fault" VALUE 0x708E4 TKW_VV_VV_UB 100.0 FORMULA_0003 0.0 255.0000 /end CHARACTERISTIC
/begin CHARACTERISTIC K_ED_PT_BUSOFF.FEHLERSCHWELLE "Filterschwelle fuer Fehlereintrag | EN: Fault code PT_BUSOFF - debounce filter threshold for setting the fault" VALUE 0x708FE TKW_VV_VV_UB 100.0 FORMULA_0003 0.0 255.0000 /end CHARACTERISTIC
/begin CHARACTERISTIC K_ED_PT_ATEMP.FEHLERSCHWELLE "Filterschwelle fuer Fehlereintrag | EN: Fault code PT_ATEMP - debounce filter threshold for setting the fault" VALUE 0x70980 TKW_VV_VV_UB 100.0 FORMULA_0003 0.0 255.0000 /end CHARACTERISTIC
/begin CHARACTERISTIC K_ED_PT_KLST.FEHLERSCHWELLE "Filterschwelle fuer Fehlereintrag | EN: Fault code PT_KLST - debounce filter threshold for setting the fault" VALUE 0x7099A TKW_VV_VV_UB 100.0 FORMULA_0003 0.0 255.0000 /end CHARACTERISTIC
/begin CHARACTERISTIC K_ED_PT_KKOS.FEHLERSCHWELLE "Filterschwelle fuer Fehlereintrag | EN: Fault code PT_KKOS - debounce filter threshold for setting the fault" VALUE 0x709B4 TKW_VV_VV_UB 100.0 FORMULA_0003 0.0 255.0000 /end CHARACTERISTIC
/begin CHARACTERISTIC K_ED_PT_LRW.FEHLERSCHWELLE "Filterschwelle fuer Fehlereintrag | EN: Fault code PT_LRW - debounce filter threshold for setting the fault" VALUE 0x709CE TKW_VV_VV_UB 100.0 FORMULA_0003 0.0 255.0000 /end CHARACTERISTIC
/begin CHARACTERISTIC K_ED_LAVK1_OBD_TL.FEHLERSCHWELLE "Filterschwelle fuer Fehlereintrag | EN: Fault code LAVK1_OBD_TL - debounce filter threshold for setting the fault [V912: differs from V452 160E]" VALUE 0x70A6A TKW_VV_VV_UB 100.0 FORMULA_0003 0.0 255.0000 /end CHARACTERISTIC
/begin CHARACTERISTIC K_ED_LAVK2_OBD_TL.FEHLERSCHWELLE "Filterschwelle fuer Fehlereintrag | EN: Fault code LAVK2_OBD_TL - debounce filter threshold for setting the fault [V912: differs from V452 160E]" VALUE 0x70A84 TKW_VV_VV_UB 100.0 FORMULA_0003 0.0 255.0000 /end CHARACTERISTIC
/begin CHARACTERISTIC K_ED_LSHVK1.FEHLERSCHWELLE "Filterschwelle fuer Fehlereintrag | EN: Fault code LSHVK1 - debounce filter threshold for setting the fault" VALUE 0x70A9E TKW_VV_VV_UB 100.0 FORMULA_0003 0.0 255.0000 /end CHARACTERISTIC
/begin CHARACTERISTIC K_ED_LSHVK2.FEHLERSCHWELLE "Filterschwelle fuer Fehlereintrag | EN: Fault code LSHVK2 - debounce filter threshold for setting the fault" VALUE 0x70AB8 TKW_VV_VV_UB 100.0 FORMULA_0003 0.0 255.0000 /end CHARACTERISTIC
/begin CHARACTERISTIC K_ED_LSRVK1_OBD_REG.FEHLERSCHWELLE "Filterschwelle fuer Fehlereintrag | EN: Fault code LSRVK1_OBD_REG - debounce filter threshold for setting the fault" VALUE 0x70AD2 TKW_VV_VV_UB 100.0 FORMULA_0003 0.0 255.0000 /end CHARACTERISTIC
/begin CHARACTERISTIC K_ED_LSRVK2_OBD_REG.FEHLERSCHWELLE "Filterschwelle fuer Fehlereintrag | EN: Fault code LSRVK2_OBD_REG - debounce filter threshold for setting the fault" VALUE 0x70AEC TKW_VV_VV_UB 100.0 FORMULA_0003 0.0 255.0000 /end CHARACTERISTIC
/begin CHARACTERISTIC K_ED_LSHVK1_R.FEHLERSCHWELLE "Filterschwelle fuer Fehlereintrag | EN: Fault code LSHVK1_R - debounce filter threshold for setting the fault" VALUE 0x70B06 TKW_VV_VV_UB 100.0 FORMULA_0003 0.0 255.0000 /end CHARACTERISTIC
/begin CHARACTERISTIC K_ED_LSHVK2_R.FEHLERSCHWELLE "Filterschwelle fuer Fehlereintrag | EN: Fault code LSHVK2_R - debounce filter threshold for setting the fault" VALUE 0x70B20 TKW_VV_VV_UB 100.0 FORMULA_0003 0.0 255.0000 /end CHARACTERISTIC
/begin CHARACTERISTIC K_ED_LSRVK1_OBD_START.FEHLERSCHWELLE "Filterschwelle fuer Fehlereintrag | EN: Fault code LSRVK1_OBD_START - debounce filter threshold for setting the fault" VALUE 0x70B3A TKW_VV_VV_UB 100.0 FORMULA_0003 0.0 255.0000 /end CHARACTERISTIC
/begin CHARACTERISTIC K_ED_LSRVK2_OBD_START.FEHLERSCHWELLE "Filterschwelle fuer Fehlereintrag | EN: Fault code LSRVK2_OBD_START - debounce filter threshold for setting the fault" VALUE 0x70B54 TKW_VV_VV_UB 100.0 FORMULA_0003 0.0 255.0000 /end CHARACTERISTIC
/begin CHARACTERISTIC K_ED_LSRVK1_OBD_REF.FEHLERSCHWELLE "Filterschwelle fuer Fehlereintrag | EN: Fault code LSRVK1_OBD_REF - debounce filter threshold for setting the fault" VALUE 0x70B6E TKW_VV_VV_UB 100.0 FORMULA_0003 0.0 255.0000 /end CHARACTERISTIC
/begin CHARACTERISTIC K_ED_LSRVK2_OBD_REF.FEHLERSCHWELLE "Filterschwelle fuer Fehlereintrag | EN: Fault code LSRVK2_OBD_REF - debounce filter threshold for setting the fault" VALUE 0x70B88 TKW_VV_VV_UB 100.0 FORMULA_0003 0.0 255.0000 /end CHARACTERISTIC
/begin CHARACTERISTIC K_ED_LAVK2_DIAG.FEHLERSCHWELLE "Filterschwelle fuer Fehlereintrag | EN: Fault code LAVK2_DIAG - debounce filter threshold for setting the fault" VALUE 0x70BBC TKW_VV_VV_UB 100.0 FORMULA_0003 0.0 255.0000 /end CHARACTERISTIC
/begin CHARACTERISTIC K_ED_LAVK1_IA_OPENLOAD.FEHLERSCHWELLE "Filterschwelle fuer Fehlereintrag | EN: Fault code LAVK1_IA_OPENLOAD - debounce filter threshold for setting the fault" VALUE 0x70BD6 TKW_VV_VV_UB 100.0 FORMULA_0003 0.0 255.0000 /end CHARACTERISTIC
/begin CHARACTERISTIC K_ED_LAVK2_IA_OPENLOAD.FEHLERSCHWELLE "Filterschwelle fuer Fehlereintrag | EN: Fault code LAVK2_IA_OPENLOAD - debounce filter threshold for setting the fault" VALUE 0x70BF0 TKW_VV_VV_UB 100.0 FORMULA_0003 0.0 255.0000 /end CHARACTERISTIC
/begin CHARACTERISTIC K_ED_PT_GRB.FEHLERSCHWELLE "Filterschwelle fuer Fehlereintrag | EN: Fault code PT_GRB - debounce filter threshold for setting the fault" VALUE 0x70C0A TKW_VV_VV_UB 100.0 FORMULA_0003 0.0 255.0000 /end CHARACTERISTIC
/begin CHARACTERISTIC K_ED_PT_GRB2.FEHLERSCHWELLE "Filterschwelle fuer Fehlereintrag | EN: Fault code PT_GRB2 - debounce filter threshold for setting the fault" VALUE 0x70C24 TKW_VV_VV_UB 100.0 FORMULA_0003 0.0 255.0000 /end CHARACTERISTIC
/begin CHARACTERISTIC K_ED_LAVK1_UN_OPENLOAD.FEHLERSCHWELLE "Filterschwelle fuer Fehlereintrag | EN: Fault code LAVK1_UN_OPENLOAD - debounce filter threshold for setting the fault" VALUE 0x70C3E TKW_VV_VV_UB 100.0 FORMULA_0003 0.0 255.0000 /end CHARACTERISTIC
/begin CHARACTERISTIC K_ED_LAVK2_UN_OPENLOAD.FEHLERSCHWELLE "Filterschwelle fuer Fehlereintrag | EN: Fault code LAVK2_UN_OPENLOAD - debounce filter threshold for setting the fault" VALUE 0x70C58 TKW_VV_VV_UB 100.0 FORMULA_0003 0.0 255.0000 /end CHARACTERISTIC
/begin CHARACTERISTIC K_ED_LAVK1_IP_OPENLOAD.FEHLERSCHWELLE "Filterschwelle fuer Fehlereintrag | EN: Fault code LAVK1_IP_OPENLOAD - debounce filter threshold for setting the fault" VALUE 0x70C72 TKW_VV_VV_UB 100.0 FORMULA_0003 0.0 255.0000 /end CHARACTERISTIC
/begin CHARACTERISTIC K_ED_LAVK2_IP_OPENLOAD.FEHLERSCHWELLE "Filterschwelle fuer Fehlereintrag | EN: Fault code LAVK2_IP_OPENLOAD - debounce filter threshold for setting the fault" VALUE 0x70C8C TKW_VV_VV_UB 100.0 FORMULA_0003 0.0 255.0000 /end CHARACTERISTIC
/begin CHARACTERISTIC K_ED_LAVK1_OBD_DYN.FEHLERSCHWELLE "Filterschwelle fuer Fehlereintrag | EN: Fault code LAVK1_OBD_DYN - debounce filter threshold for setting the fault" VALUE 0x70FCC TKW_VV_VV_UB 100.0 FORMULA_0003 0.0 255.0000 /end CHARACTERISTIC
/begin CHARACTERISTIC K_ED_LAVK2_OBD_DYN.FEHLERSCHWELLE "Filterschwelle fuer Fehlereintrag | EN: Fault code LAVK2_OBD_DYN - debounce filter threshold for setting the fault" VALUE 0x70FE6 TKW_VV_VV_UB 100.0 FORMULA_0003 0.0 255.0000 /end CHARACTERISTIC
/begin CHARACTERISTIC K_ED_PT_CRASH.FEHLERSCHWELLE "Filterschwelle fuer Fehlereintrag | EN: Fault code PT_CRASH - debounce filter threshold for setting the fault" VALUE 0x71000 TKW_VV_VV_UB 100.0 FORMULA_0003 0.0 255.0000 /end CHARACTERISTIC
/begin CHARACTERISTIC K_ED_PT_BEDFGR.FEHLERSCHWELLE "Filterschwelle fuer Fehlereintrag | EN: Fault code PT_BEDFGR - debounce filter threshold for setting the fault" VALUE 0x71034 TKW_VV_VV_UB 100.0 FORMULA_0003 0.0 255.0000 /end CHARACTERISTIC
/begin CHARACTERISTIC K_ED_LAVK1_TRIM.FEHLERSCHWELLE "Filterschwelle fuer Fehlereintrag | EN: Fault code LAVK1_TRIM - debounce filter threshold for setting the fault" VALUE 0x710EA TKW_VV_VV_UB 100.0 FORMULA_0003 0.0 255.0000 /end CHARACTERISTIC
/begin CHARACTERISTIC K_ED_LAVK2_TRIM.FEHLERSCHWELLE "Filterschwelle fuer Fehlereintrag | EN: Fault code LAVK2_TRIM - debounce filter threshold for setting the fault" VALUE 0x71104 TKW_VV_VV_UB 100.0 FORMULA_0003 0.0 255.0000 /end CHARACTERISTIC
/begin CHARACTERISTIC K_ED_PT_KM.FEHLERSCHWELLE "Filterschwelle fuer Fehlereintrag | EN: Fault code PT_KM - debounce filter threshold for setting the fault" VALUE 0x711BA TKW_VV_VV_UB 100.0 FORMULA_0003 0.0 255.0000 /end CHARACTERISTIC
/begin CHARACTERISTIC K_ED_PT_KOMBI.FEHLERSCHWELLE "Filterschwelle fuer Fehlereintrag | EN: Fault code PT_KOMBI - debounce filter threshold for setting the fault" VALUE 0x711D4 TKW_VV_VV_UB 100.0 FORMULA_0003 0.0 255.0000 /end CHARACTERISTIC
/begin CHARACTERISTIC K_ED_PKS_LL.FEHLERSCHWELLE "Filterschwelle fuer Fehlereintrag | EN: Fault code PKS_LL - debounce filter threshold for setting the fault" VALUE 0x711EE TKW_VV_VV_UB 100.0 FORMULA_0003 0.0 255.0000 /end CHARACTERISTIC
/begin CHARACTERISTIC K_ED_PKS_TL.FEHLERSCHWELLE "Filterschwelle fuer Fehlereintrag | EN: Fault code PKS_TL - debounce filter threshold for setting the fault" VALUE 0x71208 TKW_VV_VV_UB 100.0 FORMULA_0003 0.0 255.0000 /end CHARACTERISTIC
/begin CHARACTERISTIC K_ED_PKS_Q.FEHLERSCHWELLE "Filterschwelle fuer Fehlereintrag | EN: Fault code PKS_Q - debounce filter threshold for setting the fault" VALUE 0x71222 TKW_VV_VV_UB 100.0 FORMULA_0003 0.0 255.0000 /end CHARACTERISTIC
/begin CHARACTERISTIC K_ED_MVAC_DRUCKSENSOR.FEHLERSCHWELLE "Filterschwelle fuer Fehlereintrag | EN: Fault code MVAC_DRUCKSENSOR - debounce filter threshold for setting the fault" VALUE 0x7135A TKW_VV_VV_UB 100.0 FORMULA_0003 0.0 255.0000 /end CHARACTERISTIC
/begin CHARACTERISTIC K_ED_PT_BEDAT.FEHLERSCHWELLE "Filterschwelle fuer Fehlereintrag | EN: Fault code PT_BEDAT - debounce filter threshold for setting the fault" VALUE 0x71374 TKW_VV_VV_UB 100.0 FORMULA_0003 0.0 255.0000 /end CHARACTERISTIC
/begin CHARACTERISTIC K_ED_PT_ANFRADMOM.FEHLERSCHWELLE "Filterschwelle fuer Fehlereintrag | EN: Fault code PT_ANFRADMOM - debounce filter threshold for setting the fault" VALUE 0x717B8 TKW_VV_VV_UB 100.0 FORMULA_0003 0.0 255.0000 /end CHARACTERISTIC
/begin CHARACTERISTIC K_ED_LSHNK1_R.FEHLERSCHWELLE "Filterschwelle fuer Fehlereintrag | EN: Fault code LSHNK1_R - debounce filter threshold for setting the fault" VALUE 0x7190A TKW_VV_VV_UB 100.0 FORMULA_0003 0.0 255.0000 /end CHARACTERISTIC
/begin CHARACTERISTIC K_ED_LSHNK2_R.FEHLERSCHWELLE "Filterschwelle fuer Fehlereintrag | EN: Fault code LSHNK2_R - debounce filter threshold for setting the fault" VALUE 0x71924 TKW_VV_VV_UB 100.0 FORMULA_0003 0.0 255.0000 /end CHARACTERISTIC
/begin CHARACTERISTIC K_ED_PKS_MODELL.FEHLERSCHWELLE "Filterschwelle fuer Fehlereintrag | EN: Fault code PKS_MODELL - debounce filter threshold for setting the fault" VALUE 0x7193E TKW_VV_VV_UB 100.0 FORMULA_0003 0.0 255.0000 /end CHARACTERISTIC
/begin CHARACTERISTIC K_ED_PKS_PAUFBAU.FEHLERSCHWELLE "Filterschwelle fuer Fehlereintrag | EN: Fault code PKS_PAUFBAU - debounce filter threshold for setting the fault" VALUE 0x71958 TKW_VV_VV_UB 100.0 FORMULA_0003 0.0 255.0000 /end CHARACTERISTIC
/begin CHARACTERISTIC K_ED_PKS_ADAPT_ANSCHL.FEHLERSCHWELLE "Filterschwelle fuer Fehlereintrag | EN: Fault code PKS_ADAPT_ANSCHL - debounce filter threshold for setting the fault" VALUE 0x71972 TKW_VV_VV_UB 100.0 FORMULA_0003 0.0 255.0000 /end CHARACTERISTIC
/begin CHARACTERISTIC K_ED_LAVK_ATIC42.FEHLERSCHWELLE "Filterschwelle fuer Fehlereintrag | EN: Fault code LAVK_ATIC42 - debounce filter threshold for setting the fault" VALUE 0x719A6 TKW_VV_VV_UB 100.0 FORMULA_0003 0.0 255.0000 /end CHARACTERISTIC
/begin CHARACTERISTIC K_ED_PT_AX.FEHLERSCHWELLE "Filterschwelle fuer Fehlereintrag | EN: Fault code PT_AX - debounce filter threshold for setting the fault" VALUE 0x719C0 TKW_VV_VV_UB 100.0 FORMULA_0003 0.0 255.0000 /end CHARACTERISTIC
/begin CHARACTERISTIC K_ED_MVAC_OBD.FEHLERSCHWELLE "Filterschwelle fuer Fehlereintrag" VALUE 0x71A5C TKW_VV_VV_UB 100.0 FORMULA_0003 0.0 255.0000 /end CHARACTERISTIC
/begin CHARACTERISTIC K_ED_LAVK2_ATIC42.FEHLERSCHWELLE "Filterschwelle fuer Fehlereintrag" VALUE 0x71A90 TKW_VV_VV_UB 100.0 FORMULA_0003 0.0 255.0000 /end CHARACTERISTIC
/begin CHARACTERISTIC K_ED_PSAU1.OK_SCHWELLE "Filterschwelle fuer Fehleraustrag | EN: Fault code PSAU1 - debounce filter threshold for clearing (healing) the fault" VALUE 0x7065B TKW_VV_VV_UB 100.0 FORMULA_0003 0.0 255.0000 /end CHARACTERISTIC
/begin CHARACTERISTIC K_ED_PSAU2.OK_SCHWELLE "Filterschwelle fuer Fehleraustrag | EN: Fault code PSAU2 - debounce filter threshold for clearing (healing) the fault" VALUE 0x70675 TKW_VV_VV_UB 100.0 FORMULA_0003 0.0 255.0000 /end CHARACTERISTIC
/begin CHARACTERISTIC K_ED_NW1_SYNC.OK_SCHWELLE "Filterschwelle fuer Fehleraustrag" VALUE 0x7075F TKW_VV_VV_UB 100.0 FORMULA_0003 0.0 255.0000 /end CHARACTERISTIC
/begin CHARACTERISTIC K_ED_NW2_SYNC.OK_SCHWELLE "Filterschwelle fuer Fehleraustrag" VALUE 0x70779 TKW_VV_VV_UB 100.0 FORMULA_0003 0.0 255.0000 /end CHARACTERISTIC
/begin CHARACTERISTIC K_ED_PCTRL_INJ.OK_SCHWELLE "Filterschwelle fuer Fehleraustrag | EN: Fault code PCTRL_INJ - debounce filter threshold for clearing (healing) the fault" VALUE 0x70793 TKW_VV_VV_UB 100.0 FORMULA_0003 0.0 255.0000 /end CHARACTERISTIC
/begin CHARACTERISTIC K_ED_PKS.OK_SCHWELLE "Filterschwelle fuer Fehleraustrag | EN: Fault code PKS - debounce filter threshold for clearing (healing) the fault" VALUE 0x707C7 TKW_VV_VV_UB 100.0 FORMULA_0003 0.0 255.0000 /end CHARACTERISTIC
/begin CHARACTERISTIC K_ED_LAVK2.OK_SCHWELLE "Filterschwelle fuer Fehleraustrag | EN: Fault code LAVK2 - debounce filter threshold for clearing (healing) the fault" VALUE 0x70815 TKW_VV_VV_UB 100.0 FORMULA_0003 0.0 255.0000 /end CHARACTERISTIC
/begin CHARACTERISTIC K_ED_LAVK1_OBD_PLAU.OK_SCHWELLE "Filterschwelle fuer Fehleraustrag | EN: Fault code LAVK1_OBD_PLAU - debounce filter threshold for clearing (healing) the fault" VALUE 0x7082F TKW_VV_VV_UB 100.0 FORMULA_0003 0.0 255.0000 /end CHARACTERISTIC
/begin CHARACTERISTIC K_ED_LAVK2_OBD_PLAU.OK_SCHWELLE "Filterschwelle fuer Fehleraustrag | EN: Fault code LAVK2_OBD_PLAU - debounce filter threshold for clearing (healing) the fault" VALUE 0x70849 TKW_VV_VV_UB 100.0 FORMULA_0003 0.0 255.0000 /end CHARACTERISTIC
/begin CHARACTERISTIC K_ED_LAVK1_OBD_SA.OK_SCHWELLE "Filterschwelle fuer Fehleraustrag | EN: Fault code LAVK1_OBD_SA - debounce filter threshold for clearing (healing) the fault" VALUE 0x70863 TKW_VV_VV_UB 100.0 FORMULA_0003 0.0 255.0000 /end CHARACTERISTIC
/begin CHARACTERISTIC K_ED_LAVK2_OBD_SA.OK_SCHWELLE "Filterschwelle fuer Fehleraustrag | EN: Fault code LAVK2_OBD_SA - debounce filter threshold for clearing (healing) the fault" VALUE 0x7087D TKW_VV_VV_UB 100.0 FORMULA_0003 0.0 255.0000 /end CHARACTERISTIC
/begin CHARACTERISTIC K_ED_LSHNK1.OK_SCHWELLE "Filterschwelle fuer Fehleraustrag | EN: Fault code LSHNK1 - debounce filter threshold for clearing (healing) the fault" VALUE 0x708CB TKW_VV_VV_UB 100.0 FORMULA_0003 0.0 255.0000 /end CHARACTERISTIC
/begin CHARACTERISTIC K_ED_LSHNK2.OK_SCHWELLE "Filterschwelle fuer Fehleraustrag | EN: Fault code LSHNK2 - debounce filter threshold for clearing (healing) the fault" VALUE 0x708E5 TKW_VV_VV_UB 100.0 FORMULA_0003 0.0 255.0000 /end CHARACTERISTIC
/begin CHARACTERISTIC K_ED_PT_BUSOFF.OK_SCHWELLE "Filterschwelle fuer Fehleraustrag | EN: Fault code PT_BUSOFF - debounce filter threshold for clearing (healing) the fault" VALUE 0x708FF TKW_VV_VV_UB 100.0 FORMULA_0003 0.0 255.0000 /end CHARACTERISTIC
/begin CHARACTERISTIC K_ED_PT_ATEMP.OK_SCHWELLE "Filterschwelle fuer Fehleraustrag | EN: Fault code PT_ATEMP - debounce filter threshold for clearing (healing) the fault" VALUE 0x70981 TKW_VV_VV_UB 100.0 FORMULA_0003 0.0 255.0000 /end CHARACTERISTIC
/begin CHARACTERISTIC K_ED_PT_KLST.OK_SCHWELLE "Filterschwelle fuer Fehleraustrag | EN: Fault code PT_KLST - debounce filter threshold for clearing (healing) the fault" VALUE 0x7099B TKW_VV_VV_UB 100.0 FORMULA_0003 0.0 255.0000 /end CHARACTERISTIC
/begin CHARACTERISTIC K_ED_PT_KKOS.OK_SCHWELLE "Filterschwelle fuer Fehleraustrag | EN: Fault code PT_KKOS - debounce filter threshold for clearing (healing) the fault" VALUE 0x709B5 TKW_VV_VV_UB 100.0 FORMULA_0003 0.0 255.0000 /end CHARACTERISTIC
/begin CHARACTERISTIC K_ED_LAVK1_OBD_TL.OK_SCHWELLE "Filterschwelle fuer Fehleraustrag | EN: Fault code LAVK1_OBD_TL - debounce filter threshold for clearing (healing) the fault [V912: differs from V452 160E]" VALUE 0x70A6B TKW_VV_VV_UB 100.0 FORMULA_0003 0.0 255.0000 /end CHARACTERISTIC
/begin CHARACTERISTIC K_ED_LAVK2_OBD_TL.OK_SCHWELLE "Filterschwelle fuer Fehleraustrag | EN: Fault code LAVK2_OBD_TL - debounce filter threshold for clearing (healing) the fault [V912: differs from V452 160E]" VALUE 0x70A85 TKW_VV_VV_UB 100.0 FORMULA_0003 0.0 255.0000 /end CHARACTERISTIC
/begin CHARACTERISTIC K_ED_LSHVK1.OK_SCHWELLE "Filterschwelle fuer Fehleraustrag | EN: Fault code LSHVK1 - debounce filter threshold for clearing (healing) the fault" VALUE 0x70A9F TKW_VV_VV_UB 100.0 FORMULA_0003 0.0 255.0000 /end CHARACTERISTIC
/begin CHARACTERISTIC K_ED_LSHVK2.OK_SCHWELLE "Filterschwelle fuer Fehleraustrag | EN: Fault code LSHVK2 - debounce filter threshold for clearing (healing) the fault" VALUE 0x70AB9 TKW_VV_VV_UB 100.0 FORMULA_0003 0.0 255.0000 /end CHARACTERISTIC
/begin CHARACTERISTIC K_ED_LSRVK1_OBD_REG.OK_SCHWELLE "Filterschwelle fuer Fehleraustrag | EN: Fault code LSRVK1_OBD_REG - debounce filter threshold for clearing (healing) the fault" VALUE 0x70AD3 TKW_VV_VV_UB 100.0 FORMULA_0003 0.0 255.0000 /end CHARACTERISTIC
/begin CHARACTERISTIC K_ED_LSRVK2_OBD_REG.OK_SCHWELLE "Filterschwelle fuer Fehleraustrag | EN: Fault code LSRVK2_OBD_REG - debounce filter threshold for clearing (healing) the fault" VALUE 0x70AED TKW_VV_VV_UB 100.0 FORMULA_0003 0.0 255.0000 /end CHARACTERISTIC
/begin CHARACTERISTIC K_ED_LSHVK1_R.OK_SCHWELLE "Filterschwelle fuer Fehleraustrag | EN: Fault code LSHVK1_R - debounce filter threshold for clearing (healing) the fault" VALUE 0x70B07 TKW_VV_VV_UB 100.0 FORMULA_0003 0.0 255.0000 /end CHARACTERISTIC
/begin CHARACTERISTIC K_ED_LSHVK2_R.OK_SCHWELLE "Filterschwelle fuer Fehleraustrag | EN: Fault code LSHVK2_R - debounce filter threshold for clearing (healing) the fault" VALUE 0x70B21 TKW_VV_VV_UB 100.0 FORMULA_0003 0.0 255.0000 /end CHARACTERISTIC
/begin CHARACTERISTIC K_ED_LSRVK1_OBD_START.OK_SCHWELLE "Filterschwelle fuer Fehleraustrag | EN: Fault code LSRVK1_OBD_START - debounce filter threshold for clearing (healing) the fault" VALUE 0x70B3B TKW_VV_VV_UB 100.0 FORMULA_0003 0.0 255.0000 /end CHARACTERISTIC
/begin CHARACTERISTIC K_ED_LSRVK2_OBD_START.OK_SCHWELLE "Filterschwelle fuer Fehleraustrag | EN: Fault code LSRVK2_OBD_START - debounce filter threshold for clearing (healing) the fault" VALUE 0x70B55 TKW_VV_VV_UB 100.0 FORMULA_0003 0.0 255.0000 /end CHARACTERISTIC
/begin CHARACTERISTIC K_ED_LSRVK1_OBD_REF.OK_SCHWELLE "Filterschwelle fuer Fehleraustrag | EN: Fault code LSRVK1_OBD_REF - debounce filter threshold for clearing (healing) the fault" VALUE 0x70B6F TKW_VV_VV_UB 100.0 FORMULA_0003 0.0 255.0000 /end CHARACTERISTIC
/begin CHARACTERISTIC K_ED_LSRVK2_OBD_REF.OK_SCHWELLE "Filterschwelle fuer Fehleraustrag | EN: Fault code LSRVK2_OBD_REF - debounce filter threshold for clearing (healing) the fault" VALUE 0x70B89 TKW_VV_VV_UB 100.0 FORMULA_0003 0.0 255.0000 /end CHARACTERISTIC
/begin CHARACTERISTIC K_ED_LAVK2_DIAG.OK_SCHWELLE "Filterschwelle fuer Fehleraustrag | EN: Fault code LAVK2_DIAG - debounce filter threshold for clearing (healing) the fault" VALUE 0x70BBD TKW_VV_VV_UB 100.0 FORMULA_0003 0.0 255.0000 /end CHARACTERISTIC
/begin CHARACTERISTIC K_ED_LAVK1_IA_OPENLOAD.OK_SCHWELLE "Filterschwelle fuer Fehleraustrag | EN: Fault code LAVK1_IA_OPENLOAD - debounce filter threshold for clearing (healing) the fault" VALUE 0x70BD7 TKW_VV_VV_UB 100.0 FORMULA_0003 0.0 255.0000 /end CHARACTERISTIC
/begin CHARACTERISTIC K_ED_LAVK2_IA_OPENLOAD.OK_SCHWELLE "Filterschwelle fuer Fehleraustrag | EN: Fault code LAVK2_IA_OPENLOAD - debounce filter threshold for clearing (healing) the fault" VALUE 0x70BF1 TKW_VV_VV_UB 100.0 FORMULA_0003 0.0 255.0000 /end CHARACTERISTIC
/begin CHARACTERISTIC K_ED_PT_GRB.OK_SCHWELLE "Filterschwelle fuer Fehleraustrag | EN: Fault code PT_GRB - debounce filter threshold for clearing (healing) the fault" VALUE 0x70C0B TKW_VV_VV_UB 100.0 FORMULA_0003 0.0 255.0000 /end CHARACTERISTIC
/begin CHARACTERISTIC K_ED_PT_GRB2.OK_SCHWELLE "Filterschwelle fuer Fehleraustrag | EN: Fault code PT_GRB2 - debounce filter threshold for clearing (healing) the fault" VALUE 0x70C25 TKW_VV_VV_UB 100.0 FORMULA_0003 0.0 255.0000 /end CHARACTERISTIC
/begin CHARACTERISTIC K_ED_LAVK1_UN_OPENLOAD.OK_SCHWELLE "Filterschwelle fuer Fehleraustrag | EN: Fault code LAVK1_UN_OPENLOAD - debounce filter threshold for clearing (healing) the fault" VALUE 0x70C3F TKW_VV_VV_UB 100.0 FORMULA_0003 0.0 255.0000 /end CHARACTERISTIC
/begin CHARACTERISTIC K_ED_LAVK2_UN_OPENLOAD.OK_SCHWELLE "Filterschwelle fuer Fehleraustrag | EN: Fault code LAVK2_UN_OPENLOAD - debounce filter threshold for clearing (healing) the fault" VALUE 0x70C59 TKW_VV_VV_UB 100.0 FORMULA_0003 0.0 255.0000 /end CHARACTERISTIC
/begin CHARACTERISTIC K_ED_LAVK1_IP_OPENLOAD.OK_SCHWELLE "Filterschwelle fuer Fehleraustrag | EN: Fault code LAVK1_IP_OPENLOAD - debounce filter threshold for clearing (healing) the fault" VALUE 0x70C73 TKW_VV_VV_UB 100.0 FORMULA_0003 0.0 255.0000 /end CHARACTERISTIC
/begin CHARACTERISTIC K_ED_LAVK2_IP_OPENLOAD.OK_SCHWELLE "Filterschwelle fuer Fehleraustrag | EN: Fault code LAVK2_IP_OPENLOAD - debounce filter threshold for clearing (healing) the fault" VALUE 0x70C8D TKW_VV_VV_UB 100.0 FORMULA_0003 0.0 255.0000 /end CHARACTERISTIC
/begin CHARACTERISTIC K_ED_LAVK1_OBD_DYN.OK_SCHWELLE "Filterschwelle fuer Fehleraustrag | EN: Fault code LAVK1_OBD_DYN - debounce filter threshold for clearing (healing) the fault" VALUE 0x70FCD TKW_VV_VV_UB 100.0 FORMULA_0003 0.0 255.0000 /end CHARACTERISTIC
/begin CHARACTERISTIC K_ED_LAVK2_OBD_DYN.OK_SCHWELLE "Filterschwelle fuer Fehleraustrag | EN: Fault code LAVK2_OBD_DYN - debounce filter threshold for clearing (healing) the fault" VALUE 0x70FE7 TKW_VV_VV_UB 100.0 FORMULA_0003 0.0 255.0000 /end CHARACTERISTIC
/begin CHARACTERISTIC K_ED_PT_CRASH.OK_SCHWELLE "Filterschwelle fuer Fehleraustrag | EN: Fault code PT_CRASH - debounce filter threshold for clearing (healing) the fault" VALUE 0x71001 TKW_VV_VV_UB 100.0 FORMULA_0003 0.0 255.0000 /end CHARACTERISTIC
/begin CHARACTERISTIC K_ED_PT_BEDFGR.OK_SCHWELLE "Filterschwelle fuer Fehleraustrag | EN: Fault code PT_BEDFGR - debounce filter threshold for clearing (healing) the fault" VALUE 0x71035 TKW_VV_VV_UB 100.0 FORMULA_0003 0.0 255.0000 /end CHARACTERISTIC
/begin CHARACTERISTIC K_ED_LAVK1_TRIM.OK_SCHWELLE "Filterschwelle fuer Fehleraustrag | EN: Fault code LAVK1_TRIM - debounce filter threshold for clearing (healing) the fault" VALUE 0x710EB TKW_VV_VV_UB 100.0 FORMULA_0003 0.0 255.0000 /end CHARACTERISTIC
/begin CHARACTERISTIC K_ED_LAVK2_TRIM.OK_SCHWELLE "Filterschwelle fuer Fehleraustrag | EN: Fault code LAVK2_TRIM - debounce filter threshold for clearing (healing) the fault" VALUE 0x71105 TKW_VV_VV_UB 100.0 FORMULA_0003 0.0 255.0000 /end CHARACTERISTIC
/begin CHARACTERISTIC K_ED_PT_KM.OK_SCHWELLE "Filterschwelle fuer Fehleraustrag | EN: Fault code PT_KM - debounce filter threshold for clearing (healing) the fault" VALUE 0x711BB TKW_VV_VV_UB 100.0 FORMULA_0003 0.0 255.0000 /end CHARACTERISTIC
/begin CHARACTERISTIC K_ED_PT_KOMBI.OK_SCHWELLE "Filterschwelle fuer Fehleraustrag | EN: Fault code PT_KOMBI - debounce filter threshold for clearing (healing) the fault" VALUE 0x711D5 TKW_VV_VV_UB 100.0 FORMULA_0003 0.0 255.0000 /end CHARACTERISTIC
/begin CHARACTERISTIC K_ED_PKS_LL.OK_SCHWELLE "Filterschwelle fuer Fehleraustrag | EN: Fault code PKS_LL - debounce filter threshold for clearing (healing) the fault" VALUE 0x711EF TKW_VV_VV_UB 100.0 FORMULA_0003 0.0 255.0000 /end CHARACTERISTIC
/begin CHARACTERISTIC K_ED_PKS_TL.OK_SCHWELLE "Filterschwelle fuer Fehleraustrag | EN: Fault code PKS_TL - debounce filter threshold for clearing (healing) the fault" VALUE 0x71209 TKW_VV_VV_UB 100.0 FORMULA_0003 0.0 255.0000 /end CHARACTERISTIC
/begin CHARACTERISTIC K_ED_PKS_Q.OK_SCHWELLE "Filterschwelle fuer Fehleraustrag | EN: Fault code PKS_Q - debounce filter threshold for clearing (healing) the fault" VALUE 0x71223 TKW_VV_VV_UB 100.0 FORMULA_0003 0.0 255.0000 /end CHARACTERISTIC
/begin CHARACTERISTIC K_ED_MVAC_DRUCKSENSOR.OK_SCHWELLE "Filterschwelle fuer Fehleraustrag | EN: Fault code MVAC_DRUCKSENSOR - debounce filter threshold for clearing (healing) the fault" VALUE 0x7135B TKW_VV_VV_UB 100.0 FORMULA_0003 0.0 255.0000 /end CHARACTERISTIC
/begin CHARACTERISTIC K_ED_PT_BEDAT.OK_SCHWELLE "Filterschwelle fuer Fehleraustrag | EN: Fault code PT_BEDAT - debounce filter threshold for clearing (healing) the fault" VALUE 0x71375 TKW_VV_VV_UB 100.0 FORMULA_0003 0.0 255.0000 /end CHARACTERISTIC
/begin CHARACTERISTIC K_ED_PT_ANFRADMOM.OK_SCHWELLE "Filterschwelle fuer Fehleraustrag | EN: Fault code PT_ANFRADMOM - debounce filter threshold for clearing (healing) the fault" VALUE 0x717B9 TKW_VV_VV_UB 100.0 FORMULA_0003 0.0 255.0000 /end CHARACTERISTIC
/begin CHARACTERISTIC K_ED_LSHNK1_R.OK_SCHWELLE "Filterschwelle fuer Fehleraustrag | EN: Fault code LSHNK1_R - debounce filter threshold for clearing (healing) the fault" VALUE 0x7190B TKW_VV_VV_UB 100.0 FORMULA_0003 0.0 255.0000 /end CHARACTERISTIC
/begin CHARACTERISTIC K_ED_LSHNK2_R.OK_SCHWELLE "Filterschwelle fuer Fehleraustrag | EN: Fault code LSHNK2_R - debounce filter threshold for clearing (healing) the fault" VALUE 0x71925 TKW_VV_VV_UB 100.0 FORMULA_0003 0.0 255.0000 /end CHARACTERISTIC
/begin CHARACTERISTIC K_ED_PKS_MODELL.OK_SCHWELLE "Filterschwelle fuer Fehleraustrag | EN: Fault code PKS_MODELL - debounce filter threshold for clearing (healing) the fault" VALUE 0x7193F TKW_VV_VV_UB 100.0 FORMULA_0003 0.0 255.0000 /end CHARACTERISTIC
/begin CHARACTERISTIC K_ED_PKS_PAUFBAU.OK_SCHWELLE "Filterschwelle fuer Fehleraustrag | EN: Fault code PKS_PAUFBAU - debounce filter threshold for clearing (healing) the fault" VALUE 0x71959 TKW_VV_VV_UB 100.0 FORMULA_0003 0.0 255.0000 /end CHARACTERISTIC
/begin CHARACTERISTIC K_ED_PKS_ADAPT_ANSCHL.OK_SCHWELLE "Filterschwelle fuer Fehleraustrag | EN: Fault code PKS_ADAPT_ANSCHL - debounce filter threshold for clearing (healing) the fault" VALUE 0x71973 TKW_VV_VV_UB 100.0 FORMULA_0003 0.0 255.0000 /end CHARACTERISTIC
/begin CHARACTERISTIC K_ED_LAVK_ATIC42.OK_SCHWELLE "Filterschwelle fuer Fehleraustrag | EN: Fault code LAVK_ATIC42 - debounce filter threshold for clearing (healing) the fault" VALUE 0x719A7 TKW_VV_VV_UB 100.0 FORMULA_0003 0.0 255.0000 /end CHARACTERISTIC
/begin CHARACTERISTIC K_ED_PT_AX.OK_SCHWELLE "Filterschwelle fuer Fehleraustrag | EN: Fault code PT_AX - debounce filter threshold for clearing (healing) the fault" VALUE 0x719C1 TKW_VV_VV_UB 100.0 FORMULA_0003 0.0 255.0000 /end CHARACTERISTIC
/begin CHARACTERISTIC K_ED_MVAC_OBD.OK_SCHWELLE "Filterschwelle fuer Fehleraustrag" VALUE 0x71A5D TKW_VV_VV_UB 100.0 FORMULA_0003 0.0 255.0000 /end CHARACTERISTIC
/begin CHARACTERISTIC K_ED_LAVK2_ATIC42.OK_SCHWELLE "Filterschwelle fuer Fehleraustrag" VALUE 0x71A91 TKW_VV_VV_UB 100.0 FORMULA_0003 0.0 255.0000 /end CHARACTERISTIC
/begin CHARACTERISTIC K_ED_NW1_SYNC.INC_VOR_EINTRAG "Filtererhoehung vorm Fehlerspeichereintrag" VALUE 0x70760 TKW_VV_VV_UB 100.0 FORMULA_0003 0.0 255.0000 /end CHARACTERISTIC
/begin CHARACTERISTIC K_ED_NW2_SYNC.INC_VOR_EINTRAG "Filtererhoehung vorm Fehlerspeichereintrag" VALUE 0x7077A TKW_VV_VV_UB 100.0 FORMULA_0003 0.0 255.0000 /end CHARACTERISTIC
/begin CHARACTERISTIC K_ED_PCTRL_INJ.INC_VOR_EINTRAG "Filtererhoehung vorm Fehlerspeichereintrag | EN: Fault code PCTRL_INJ - debounce filter increment before fault-memory entry" VALUE 0x70794 TKW_VV_VV_UB 100.0 FORMULA_0003 0.0 255.0000 /end CHARACTERISTIC
/begin CHARACTERISTIC K_ED_PKS.INC_VOR_EINTRAG "Filtererhoehung vorm Fehlerspeichereintrag | EN: Fault code PKS - debounce filter increment before fault-memory entry" VALUE 0x707C8 TKW_VV_VV_UB 100.0 FORMULA_0003 0.0 255.0000 /end CHARACTERISTIC
/begin CHARACTERISTIC K_ED_LAVK2.INC_VOR_EINTRAG "Filtererhoehung vorm Fehlerspeichereintrag | EN: Fault code LAVK2 - debounce filter increment before fault-memory entry" VALUE 0x70816 TKW_VV_VV_UB 100.0 FORMULA_0003 0.0 255.0000 /end CHARACTERISTIC
/begin CHARACTERISTIC K_ED_LAVK1_OBD_PLAU.INC_VOR_EINTRAG "Filtererhoehung vorm Fehlerspeichereintrag | EN: Fault code LAVK1_OBD_PLAU - debounce filter increment before fault-memory entry" VALUE 0x70830 TKW_VV_VV_UB 100.0 FORMULA_0003 0.0 255.0000 /end CHARACTERISTIC
/begin CHARACTERISTIC K_ED_LAVK2_OBD_PLAU.INC_VOR_EINTRAG "Filtererhoehung vorm Fehlerspeichereintrag | EN: Fault code LAVK2_OBD_PLAU - debounce filter increment before fault-memory entry" VALUE 0x7084A TKW_VV_VV_UB 100.0 FORMULA_0003 0.0 255.0000 /end CHARACTERISTIC
/begin CHARACTERISTIC K_ED_LAVK1_OBD_SA.INC_VOR_EINTRAG "Filtererhoehung vorm Fehlerspeichereintrag | EN: Fault code LAVK1_OBD_SA - debounce filter increment before fault-memory entry" VALUE 0x70864 TKW_VV_VV_UB 100.0 FORMULA_0003 0.0 255.0000 /end CHARACTERISTIC
/begin CHARACTERISTIC K_ED_LAVK2_OBD_SA.INC_VOR_EINTRAG "Filtererhoehung vorm Fehlerspeichereintrag | EN: Fault code LAVK2_OBD_SA - debounce filter increment before fault-memory entry" VALUE 0x7087E TKW_VV_VV_UB 100.0 FORMULA_0003 0.0 255.0000 /end CHARACTERISTIC
/begin CHARACTERISTIC K_ED_LSHNK1.INC_VOR_EINTRAG "Filtererhoehung vorm Fehlerspeichereintrag | EN: Fault code LSHNK1 - debounce filter increment before fault-memory entry" VALUE 0x708CC TKW_VV_VV_UB 100.0 FORMULA_0003 0.0 255.0000 /end CHARACTERISTIC
/begin CHARACTERISTIC K_ED_LSHNK2.INC_VOR_EINTRAG "Filtererhoehung vorm Fehlerspeichereintrag | EN: Fault code LSHNK2 - debounce filter increment before fault-memory entry" VALUE 0x708E6 TKW_VV_VV_UB 100.0 FORMULA_0003 0.0 255.0000 /end CHARACTERISTIC
/begin CHARACTERISTIC K_ED_PT_BUSOFF.INC_VOR_EINTRAG "Filtererhoehung vorm Fehlerspeichereintrag | EN: Fault code PT_BUSOFF - debounce filter increment before fault-memory entry" VALUE 0x70900 TKW_VV_VV_UB 100.0 FORMULA_0003 0.0 255.0000 /end CHARACTERISTIC
/begin CHARACTERISTIC K_ED_PT_ATEMP.INC_VOR_EINTRAG "Filtererhoehung vorm Fehlerspeichereintrag | EN: Fault code PT_ATEMP - debounce filter increment before fault-memory entry" VALUE 0x70982 TKW_VV_VV_UB 100.0 FORMULA_0003 0.0 255.0000 /end CHARACTERISTIC
/begin CHARACTERISTIC K_ED_PT_KLST.INC_VOR_EINTRAG "Filtererhoehung vorm Fehlerspeichereintrag | EN: Fault code PT_KLST - debounce filter increment before fault-memory entry" VALUE 0x7099C TKW_VV_VV_UB 100.0 FORMULA_0003 0.0 255.0000 /end CHARACTERISTIC
/begin CHARACTERISTIC K_ED_PT_KKOS.INC_VOR_EINTRAG "Filtererhoehung vorm Fehlerspeichereintrag | EN: Fault code PT_KKOS - debounce filter increment before fault-memory entry" VALUE 0x709B6 TKW_VV_VV_UB 100.0 FORMULA_0003 0.0 255.0000 /end CHARACTERISTIC
/begin CHARACTERISTIC K_ED_PT_LRW.INC_VOR_EINTRAG "Filtererhoehung vorm Fehlerspeichereintrag | EN: Fault code PT_LRW - debounce filter increment before fault-memory entry" VALUE 0x709D0 TKW_VV_VV_UB 100.0 FORMULA_0003 0.0 255.0000 /end CHARACTERISTIC
/begin CHARACTERISTIC K_ED_LAVK1_OBD_TL.INC_VOR_EINTRAG "Filtererhoehung vorm Fehlerspeichereintrag | EN: Fault code LAVK1_OBD_TL - debounce filter increment before fault-memory entry" VALUE 0x70A6C TKW_VV_VV_UB 100.0 FORMULA_0003 0.0 255.0000 /end CHARACTERISTIC
/begin CHARACTERISTIC K_ED_LAVK2_OBD_TL.INC_VOR_EINTRAG "Filtererhoehung vorm Fehlerspeichereintrag | EN: Fault code LAVK2_OBD_TL - debounce filter increment before fault-memory entry" VALUE 0x70A86 TKW_VV_VV_UB 100.0 FORMULA_0003 0.0 255.0000 /end CHARACTERISTIC
/begin CHARACTERISTIC K_ED_LSHVK1.INC_VOR_EINTRAG "Filtererhoehung vorm Fehlerspeichereintrag | EN: Fault code LSHVK1 - debounce filter increment before fault-memory entry" VALUE 0x70AA0 TKW_VV_VV_UB 100.0 FORMULA_0003 0.0 255.0000 /end CHARACTERISTIC
/begin CHARACTERISTIC K_ED_LSHVK2.INC_VOR_EINTRAG "Filtererhoehung vorm Fehlerspeichereintrag | EN: Fault code LSHVK2 - debounce filter increment before fault-memory entry" VALUE 0x70ABA TKW_VV_VV_UB 100.0 FORMULA_0003 0.0 255.0000 /end CHARACTERISTIC
/begin CHARACTERISTIC K_ED_LSRVK1_OBD_REG.INC_VOR_EINTRAG "Filtererhoehung vorm Fehlerspeichereintrag | EN: Fault code LSRVK1_OBD_REG - debounce filter increment before fault-memory entry" VALUE 0x70AD4 TKW_VV_VV_UB 100.0 FORMULA_0003 0.0 255.0000 /end CHARACTERISTIC
/begin CHARACTERISTIC K_ED_LSRVK2_OBD_REG.INC_VOR_EINTRAG "Filtererhoehung vorm Fehlerspeichereintrag | EN: Fault code LSRVK2_OBD_REG - debounce filter increment before fault-memory entry" VALUE 0x70AEE TKW_VV_VV_UB 100.0 FORMULA_0003 0.0 255.0000 /end CHARACTERISTIC
/begin CHARACTERISTIC K_ED_LSHVK1_R.INC_VOR_EINTRAG "Filtererhoehung vorm Fehlerspeichereintrag | EN: Fault code LSHVK1_R - debounce filter increment before fault-memory entry" VALUE 0x70B08 TKW_VV_VV_UB 100.0 FORMULA_0003 0.0 255.0000 /end CHARACTERISTIC
/begin CHARACTERISTIC K_ED_LSHVK2_R.INC_VOR_EINTRAG "Filtererhoehung vorm Fehlerspeichereintrag | EN: Fault code LSHVK2_R - debounce filter increment before fault-memory entry" VALUE 0x70B22 TKW_VV_VV_UB 100.0 FORMULA_0003 0.0 255.0000 /end CHARACTERISTIC
/begin CHARACTERISTIC K_ED_LSRVK1_OBD_START.INC_VOR_EINTRAG "Filtererhoehung vorm Fehlerspeichereintrag | EN: Fault code LSRVK1_OBD_START - debounce filter increment before fault-memory entry" VALUE 0x70B3C TKW_VV_VV_UB 100.0 FORMULA_0003 0.0 255.0000 /end CHARACTERISTIC
/begin CHARACTERISTIC K_ED_LSRVK2_OBD_START.INC_VOR_EINTRAG "Filtererhoehung vorm Fehlerspeichereintrag | EN: Fault code LSRVK2_OBD_START - debounce filter increment before fault-memory entry" VALUE 0x70B56 TKW_VV_VV_UB 100.0 FORMULA_0003 0.0 255.0000 /end CHARACTERISTIC
/begin CHARACTERISTIC K_ED_LSRVK1_OBD_REF.INC_VOR_EINTRAG "Filtererhoehung vorm Fehlerspeichereintrag | EN: Fault code LSRVK1_OBD_REF - debounce filter increment before fault-memory entry" VALUE 0x70B70 TKW_VV_VV_UB 100.0 FORMULA_0003 0.0 255.0000 /end CHARACTERISTIC
/begin CHARACTERISTIC K_ED_LSRVK2_OBD_REF.INC_VOR_EINTRAG "Filtererhoehung vorm Fehlerspeichereintrag | EN: Fault code LSRVK2_OBD_REF - debounce filter increment before fault-memory entry" VALUE 0x70B8A TKW_VV_VV_UB 100.0 FORMULA_0003 0.0 255.0000 /end CHARACTERISTIC
/begin CHARACTERISTIC K_ED_LAVK2_DIAG.INC_VOR_EINTRAG "Filtererhoehung vorm Fehlerspeichereintrag | EN: Fault code LAVK2_DIAG - debounce filter increment before fault-memory entry" VALUE 0x70BBE TKW_VV_VV_UB 100.0 FORMULA_0003 0.0 255.0000 /end CHARACTERISTIC
/begin CHARACTERISTIC K_ED_LAVK1_IA_OPENLOAD.INC_VOR_EINTRAG "Filtererhoehung vorm Fehlerspeichereintrag | EN: Fault code LAVK1_IA_OPENLOAD - debounce filter increment before fault-memory entry" VALUE 0x70BD8 TKW_VV_VV_UB 100.0 FORMULA_0003 0.0 255.0000 /end CHARACTERISTIC
/begin CHARACTERISTIC K_ED_LAVK2_IA_OPENLOAD.INC_VOR_EINTRAG "Filtererhoehung vorm Fehlerspeichereintrag | EN: Fault code LAVK2_IA_OPENLOAD - debounce filter increment before fault-memory entry" VALUE 0x70BF2 TKW_VV_VV_UB 100.0 FORMULA_0003 0.0 255.0000 /end CHARACTERISTIC
/begin CHARACTERISTIC K_ED_PT_GRB.INC_VOR_EINTRAG "Filtererhoehung vorm Fehlerspeichereintrag | EN: Fault code PT_GRB - debounce filter increment before fault-memory entry" VALUE 0x70C0C TKW_VV_VV_UB 100.0 FORMULA_0003 0.0 255.0000 /end CHARACTERISTIC
/begin CHARACTERISTIC K_ED_PT_GRB2.INC_VOR_EINTRAG "Filtererhoehung vorm Fehlerspeichereintrag | EN: Fault code PT_GRB2 - debounce filter increment before fault-memory entry" VALUE 0x70C26 TKW_VV_VV_UB 100.0 FORMULA_0003 0.0 255.0000 /end CHARACTERISTIC
/begin CHARACTERISTIC K_ED_LAVK1_UN_OPENLOAD.INC_VOR_EINTRAG "Filtererhoehung vorm Fehlerspeichereintrag | EN: Fault code LAVK1_UN_OPENLOAD - debounce filter increment before fault-memory entry" VALUE 0x70C40 TKW_VV_VV_UB 100.0 FORMULA_0003 0.0 255.0000 /end CHARACTERISTIC
/begin CHARACTERISTIC K_ED_LAVK2_UN_OPENLOAD.INC_VOR_EINTRAG "Filtererhoehung vorm Fehlerspeichereintrag | EN: Fault code LAVK2_UN_OPENLOAD - debounce filter increment before fault-memory entry" VALUE 0x70C5A TKW_VV_VV_UB 100.0 FORMULA_0003 0.0 255.0000 /end CHARACTERISTIC
/begin CHARACTERISTIC K_ED_LAVK1_IP_OPENLOAD.INC_VOR_EINTRAG "Filtererhoehung vorm Fehlerspeichereintrag | EN: Fault code LAVK1_IP_OPENLOAD - debounce filter increment before fault-memory entry" VALUE 0x70C74 TKW_VV_VV_UB 100.0 FORMULA_0003 0.0 255.0000 /end CHARACTERISTIC
/begin CHARACTERISTIC K_ED_LAVK2_IP_OPENLOAD.INC_VOR_EINTRAG "Filtererhoehung vorm Fehlerspeichereintrag | EN: Fault code LAVK2_IP_OPENLOAD - debounce filter increment before fault-memory entry" VALUE 0x70C8E TKW_VV_VV_UB 100.0 FORMULA_0003 0.0 255.0000 /end CHARACTERISTIC
/begin CHARACTERISTIC K_ED_LAVK1_OBD_DYN.INC_VOR_EINTRAG "Filtererhoehung vorm Fehlerspeichereintrag | EN: Fault code LAVK1_OBD_DYN - debounce filter increment before fault-memory entry" VALUE 0x70FCE TKW_VV_VV_UB 100.0 FORMULA_0003 0.0 255.0000 /end CHARACTERISTIC
/begin CHARACTERISTIC K_ED_LAVK2_OBD_DYN.INC_VOR_EINTRAG "Filtererhoehung vorm Fehlerspeichereintrag | EN: Fault code LAVK2_OBD_DYN - debounce filter increment before fault-memory entry" VALUE 0x70FE8 TKW_VV_VV_UB 100.0 FORMULA_0003 0.0 255.0000 /end CHARACTERISTIC
/begin CHARACTERISTIC K_ED_PT_CRASH.INC_VOR_EINTRAG "Filtererhoehung vorm Fehlerspeichereintrag | EN: Fault code PT_CRASH - debounce filter increment before fault-memory entry" VALUE 0x71002 TKW_VV_VV_UB 100.0 FORMULA_0003 0.0 255.0000 /end CHARACTERISTIC
/begin CHARACTERISTIC K_ED_PT_BEDFGR.INC_VOR_EINTRAG "Filtererhoehung vorm Fehlerspeichereintrag | EN: Fault code PT_BEDFGR - debounce filter increment before fault-memory entry" VALUE 0x71036 TKW_VV_VV_UB 100.0 FORMULA_0003 0.0 255.0000 /end CHARACTERISTIC
/begin CHARACTERISTIC K_ED_LAVK1_TRIM.INC_VOR_EINTRAG "Filtererhoehung vorm Fehlerspeichereintrag | EN: Fault code LAVK1_TRIM - debounce filter increment before fault-memory entry" VALUE 0x710EC TKW_VV_VV_UB 100.0 FORMULA_0003 0.0 255.0000 /end CHARACTERISTIC
/begin CHARACTERISTIC K_ED_LAVK2_TRIM.INC_VOR_EINTRAG "Filtererhoehung vorm Fehlerspeichereintrag | EN: Fault code LAVK2_TRIM - debounce filter increment before fault-memory entry" VALUE 0x71106 TKW_VV_VV_UB 100.0 FORMULA_0003 0.0 255.0000 /end CHARACTERISTIC
/begin CHARACTERISTIC K_ED_PT_KM.INC_VOR_EINTRAG "Filtererhoehung vorm Fehlerspeichereintrag | EN: Fault code PT_KM - debounce filter increment before fault-memory entry" VALUE 0x711BC TKW_VV_VV_UB 100.0 FORMULA_0003 0.0 255.0000 /end CHARACTERISTIC
/begin CHARACTERISTIC K_ED_PT_KOMBI.INC_VOR_EINTRAG "Filtererhoehung vorm Fehlerspeichereintrag | EN: Fault code PT_KOMBI - debounce filter increment before fault-memory entry" VALUE 0x711D6 TKW_VV_VV_UB 100.0 FORMULA_0003 0.0 255.0000 /end CHARACTERISTIC
/begin CHARACTERISTIC K_ED_PKS_LL.INC_VOR_EINTRAG "Filtererhoehung vorm Fehlerspeichereintrag | EN: Fault code PKS_LL - debounce filter increment before fault-memory entry" VALUE 0x711F0 TKW_VV_VV_UB 100.0 FORMULA_0003 0.0 255.0000 /end CHARACTERISTIC
/begin CHARACTERISTIC K_ED_PKS_TL.INC_VOR_EINTRAG "Filtererhoehung vorm Fehlerspeichereintrag | EN: Fault code PKS_TL - debounce filter increment before fault-memory entry" VALUE 0x7120A TKW_VV_VV_UB 100.0 FORMULA_0003 0.0 255.0000 /end CHARACTERISTIC
/begin CHARACTERISTIC K_ED_PKS_Q.INC_VOR_EINTRAG "Filtererhoehung vorm Fehlerspeichereintrag | EN: Fault code PKS_Q - debounce filter increment before fault-memory entry" VALUE 0x71224 TKW_VV_VV_UB 100.0 FORMULA_0003 0.0 255.0000 /end CHARACTERISTIC
/begin CHARACTERISTIC K_ED_MVAC_DRUCKSENSOR.INC_VOR_EINTRAG "Filtererhoehung vorm Fehlerspeichereintrag | EN: Fault code MVAC_DRUCKSENSOR - debounce filter increment before fault-memory entry" VALUE 0x7135C TKW_VV_VV_UB 100.0 FORMULA_0003 0.0 255.0000 /end CHARACTERISTIC
/begin CHARACTERISTIC K_ED_PT_BEDAT.INC_VOR_EINTRAG "Filtererhoehung vorm Fehlerspeichereintrag | EN: Fault code PT_BEDAT - debounce filter increment before fault-memory entry" VALUE 0x71376 TKW_VV_VV_UB 100.0 FORMULA_0003 0.0 255.0000 /end CHARACTERISTIC
/begin CHARACTERISTIC K_ED_PT_ANFRADMOM.INC_VOR_EINTRAG "Filtererhoehung vorm Fehlerspeichereintrag | EN: Fault code PT_ANFRADMOM - debounce filter increment before fault-memory entry" VALUE 0x717BA TKW_VV_VV_UB 100.0 FORMULA_0003 0.0 255.0000 /end CHARACTERISTIC
/begin CHARACTERISTIC K_ED_LSHNK1_R.INC_VOR_EINTRAG "Filtererhoehung vorm Fehlerspeichereintrag | EN: Fault code LSHNK1_R - debounce filter increment before fault-memory entry" VALUE 0x7190C TKW_VV_VV_UB 100.0 FORMULA_0003 0.0 255.0000 /end CHARACTERISTIC
/begin CHARACTERISTIC K_ED_LSHNK2_R.INC_VOR_EINTRAG "Filtererhoehung vorm Fehlerspeichereintrag | EN: Fault code LSHNK2_R - debounce filter increment before fault-memory entry" VALUE 0x71926 TKW_VV_VV_UB 100.0 FORMULA_0003 0.0 255.0000 /end CHARACTERISTIC
/begin CHARACTERISTIC K_ED_PKS_MODELL.INC_VOR_EINTRAG "Filtererhoehung vorm Fehlerspeichereintrag | EN: Fault code PKS_MODELL - debounce filter increment before fault-memory entry" VALUE 0x71940 TKW_VV_VV_UB 100.0 FORMULA_0003 0.0 255.0000 /end CHARACTERISTIC
/begin CHARACTERISTIC K_ED_PKS_PAUFBAU.INC_VOR_EINTRAG "Filtererhoehung vorm Fehlerspeichereintrag | EN: Fault code PKS_PAUFBAU - debounce filter increment before fault-memory entry" VALUE 0x7195A TKW_VV_VV_UB 100.0 FORMULA_0003 0.0 255.0000 /end CHARACTERISTIC
/begin CHARACTERISTIC K_ED_PKS_ADAPT_ANSCHL.INC_VOR_EINTRAG "Filtererhoehung vorm Fehlerspeichereintrag | EN: Fault code PKS_ADAPT_ANSCHL - debounce filter increment before fault-memory entry" VALUE 0x71974 TKW_VV_VV_UB 100.0 FORMULA_0003 0.0 255.0000 /end CHARACTERISTIC
/begin CHARACTERISTIC K_ED_LAVK_ATIC42.INC_VOR_EINTRAG "Filtererhoehung vorm Fehlerspeichereintrag | EN: Fault code LAVK_ATIC42 - debounce filter increment before fault-memory entry" VALUE 0x719A8 TKW_VV_VV_UB 100.0 FORMULA_0003 0.0 255.0000 /end CHARACTERISTIC
/begin CHARACTERISTIC K_ED_PT_AX.INC_VOR_EINTRAG "Filtererhoehung vorm Fehlerspeichereintrag | EN: Fault code PT_AX - debounce filter increment before fault-memory entry" VALUE 0x719C2 TKW_VV_VV_UB 100.0 FORMULA_0003 0.0 255.0000 /end CHARACTERISTIC
/begin CHARACTERISTIC K_ED_MVAC_OBD.INC_VOR_EINTRAG "Filtererhoehung vorm Fehlerspeichereintrag" VALUE 0x71A5E TKW_VV_VV_UB 100.0 FORMULA_0003 0.0 255.0000 /end CHARACTERISTIC
/begin CHARACTERISTIC K_ED_LAVK2_ATIC42.INC_VOR_EINTRAG "Filtererhoehung vorm Fehlerspeichereintrag" VALUE 0x71A92 TKW_VV_VV_UB 100.0 FORMULA_0003 0.0 255.0000 /end CHARACTERISTIC
/begin CHARACTERISTIC K_ED_PSAU1.DEC_VOR_EINTRAG "Filterverringerung vorm Fehlerspeichereintrag | EN: Fault code PSAU1 - debounce filter decrement before fault-memory entry" VALUE 0x7065D TKW_VV_VV_UB 100.0 FORMULA_0003 0.0 255.0000 /end CHARACTERISTIC
/begin CHARACTERISTIC K_ED_PSAU2.DEC_VOR_EINTRAG "Filterverringerung vorm Fehlerspeichereintrag | EN: Fault code PSAU2 - debounce filter decrement before fault-memory entry" VALUE 0x70677 TKW_VV_VV_UB 100.0 FORMULA_0003 0.0 255.0000 /end CHARACTERISTIC
/begin CHARACTERISTIC K_ED_NW1_SYNC.DEC_VOR_EINTRAG "Filterverringerung vorm Fehlerspeichereintrag" VALUE 0x70761 TKW_VV_VV_UB 100.0 FORMULA_0003 0.0 255.0000 /end CHARACTERISTIC
/begin CHARACTERISTIC K_ED_NW2_SYNC.DEC_VOR_EINTRAG "Filterverringerung vorm Fehlerspeichereintrag" VALUE 0x7077B TKW_VV_VV_UB 100.0 FORMULA_0003 0.0 255.0000 /end CHARACTERISTIC
/begin CHARACTERISTIC K_ED_PCTRL_INJ.DEC_VOR_EINTRAG "Filterverringerung vorm Fehlerspeichereintrag | EN: Fault code PCTRL_INJ - debounce filter decrement before fault-memory entry" VALUE 0x70795 TKW_VV_VV_UB 100.0 FORMULA_0003 0.0 255.0000 /end CHARACTERISTIC
/begin CHARACTERISTIC K_ED_PKS.DEC_VOR_EINTRAG "Filterverringerung vorm Fehlerspeichereintrag | EN: Fault code PKS - debounce filter decrement before fault-memory entry" VALUE 0x707C9 TKW_VV_VV_UB 100.0 FORMULA_0003 0.0 255.0000 /end CHARACTERISTIC
/begin CHARACTERISTIC K_ED_LAVK2.DEC_VOR_EINTRAG "Filterverringerung vorm Fehlerspeichereintrag | EN: Fault code LAVK2 - debounce filter decrement before fault-memory entry" VALUE 0x70817 TKW_VV_VV_UB 100.0 FORMULA_0003 0.0 255.0000 /end CHARACTERISTIC
/begin CHARACTERISTIC K_ED_LAVK1_OBD_PLAU.DEC_VOR_EINTRAG "Filterverringerung vorm Fehlerspeichereintrag | EN: Fault code LAVK1_OBD_PLAU - debounce filter decrement before fault-memory entry" VALUE 0x70831 TKW_VV_VV_UB 100.0 FORMULA_0003 0.0 255.0000 /end CHARACTERISTIC
/begin CHARACTERISTIC K_ED_LAVK2_OBD_PLAU.DEC_VOR_EINTRAG "Filterverringerung vorm Fehlerspeichereintrag | EN: Fault code LAVK2_OBD_PLAU - debounce filter decrement before fault-memory entry" VALUE 0x7084B TKW_VV_VV_UB 100.0 FORMULA_0003 0.0 255.0000 /end CHARACTERISTIC
/begin CHARACTERISTIC K_ED_LAVK1_OBD_SA.DEC_VOR_EINTRAG "Filterverringerung vorm Fehlerspeichereintrag | EN: Fault code LAVK1_OBD_SA - debounce filter decrement before fault-memory entry" VALUE 0x70865 TKW_VV_VV_UB 100.0 FORMULA_0003 0.0 255.0000 /end CHARACTERISTIC
/begin CHARACTERISTIC K_ED_LAVK2_OBD_SA.DEC_VOR_EINTRAG "Filterverringerung vorm Fehlerspeichereintrag | EN: Fault code LAVK2_OBD_SA - debounce filter decrement before fault-memory entry" VALUE 0x7087F TKW_VV_VV_UB 100.0 FORMULA_0003 0.0 255.0000 /end CHARACTERISTIC
/begin CHARACTERISTIC K_ED_LSHNK1.DEC_VOR_EINTRAG "Filterverringerung vorm Fehlerspeichereintrag | EN: Fault code LSHNK1 - debounce filter decrement before fault-memory entry" VALUE 0x708CD TKW_VV_VV_UB 100.0 FORMULA_0003 0.0 255.0000 /end CHARACTERISTIC
/begin CHARACTERISTIC K_ED_LSHNK2.DEC_VOR_EINTRAG "Filterverringerung vorm Fehlerspeichereintrag | EN: Fault code LSHNK2 - debounce filter decrement before fault-memory entry" VALUE 0x708E7 TKW_VV_VV_UB 100.0 FORMULA_0003 0.0 255.0000 /end CHARACTERISTIC
/begin CHARACTERISTIC K_ED_PT_BUSOFF.DEC_VOR_EINTRAG "Filterverringerung vorm Fehlerspeichereintrag | EN: Fault code PT_BUSOFF - debounce filter decrement before fault-memory entry" VALUE 0x70901 TKW_VV_VV_UB 100.0 FORMULA_0003 0.0 255.0000 /end CHARACTERISTIC
/begin CHARACTERISTIC K_ED_PT_ATEMP.DEC_VOR_EINTRAG "Filterverringerung vorm Fehlerspeichereintrag | EN: Fault code PT_ATEMP - debounce filter decrement before fault-memory entry" VALUE 0x70983 TKW_VV_VV_UB 100.0 FORMULA_0003 0.0 255.0000 /end CHARACTERISTIC
/begin CHARACTERISTIC K_ED_PT_KLST.DEC_VOR_EINTRAG "Filterverringerung vorm Fehlerspeichereintrag | EN: Fault code PT_KLST - debounce filter decrement before fault-memory entry" VALUE 0x7099D TKW_VV_VV_UB 100.0 FORMULA_0003 0.0 255.0000 /end CHARACTERISTIC
/begin CHARACTERISTIC K_ED_PT_KKOS.DEC_VOR_EINTRAG "Filterverringerung vorm Fehlerspeichereintrag | EN: Fault code PT_KKOS - debounce filter decrement before fault-memory entry" VALUE 0x709B7 TKW_VV_VV_UB 100.0 FORMULA_0003 0.0 255.0000 /end CHARACTERISTIC
/begin CHARACTERISTIC K_ED_PT_LRW.DEC_VOR_EINTRAG "Filterverringerung vorm Fehlerspeichereintrag | EN: Fault code PT_LRW - debounce filter decrement before fault-memory entry" VALUE 0x709D1 TKW_VV_VV_UB 100.0 FORMULA_0003 0.0 255.0000 /end CHARACTERISTIC
/begin CHARACTERISTIC K_ED_LAVK1_OBD_TL.DEC_VOR_EINTRAG "Filterverringerung vorm Fehlerspeichereintrag | EN: Fault code LAVK1_OBD_TL - debounce filter decrement before fault-memory entry [V912: differs from V452 160E]" VALUE 0x70A6D TKW_VV_VV_UB 100.0 FORMULA_0003 0.0 255.0000 /end CHARACTERISTIC
/begin CHARACTERISTIC K_ED_LAVK2_OBD_TL.DEC_VOR_EINTRAG "Filterverringerung vorm Fehlerspeichereintrag | EN: Fault code LAVK2_OBD_TL - debounce filter decrement before fault-memory entry [V912: differs from V452 160E]" VALUE 0x70A87 TKW_VV_VV_UB 100.0 FORMULA_0003 0.0 255.0000 /end CHARACTERISTIC
/begin CHARACTERISTIC K_ED_LSHVK1.DEC_VOR_EINTRAG "Filterverringerung vorm Fehlerspeichereintrag | EN: Fault code LSHVK1 - debounce filter decrement before fault-memory entry" VALUE 0x70AA1 TKW_VV_VV_UB 100.0 FORMULA_0003 0.0 255.0000 /end CHARACTERISTIC
/begin CHARACTERISTIC K_ED_LSHVK2.DEC_VOR_EINTRAG "Filterverringerung vorm Fehlerspeichereintrag | EN: Fault code LSHVK2 - debounce filter decrement before fault-memory entry" VALUE 0x70ABB TKW_VV_VV_UB 100.0 FORMULA_0003 0.0 255.0000 /end CHARACTERISTIC
/begin CHARACTERISTIC K_ED_LSRVK1_OBD_REG.DEC_VOR_EINTRAG "Filterverringerung vorm Fehlerspeichereintrag | EN: Fault code LSRVK1_OBD_REG - debounce filter decrement before fault-memory entry" VALUE 0x70AD5 TKW_VV_VV_UB 100.0 FORMULA_0003 0.0 255.0000 /end CHARACTERISTIC
/begin CHARACTERISTIC K_ED_LSRVK2_OBD_REG.DEC_VOR_EINTRAG "Filterverringerung vorm Fehlerspeichereintrag | EN: Fault code LSRVK2_OBD_REG - debounce filter decrement before fault-memory entry" VALUE 0x70AEF TKW_VV_VV_UB 100.0 FORMULA_0003 0.0 255.0000 /end CHARACTERISTIC
/begin CHARACTERISTIC K_ED_LSHVK1_R.DEC_VOR_EINTRAG "Filterverringerung vorm Fehlerspeichereintrag | EN: Fault code LSHVK1_R - debounce filter decrement before fault-memory entry" VALUE 0x70B09 TKW_VV_VV_UB 100.0 FORMULA_0003 0.0 255.0000 /end CHARACTERISTIC
/begin CHARACTERISTIC K_ED_LSHVK2_R.DEC_VOR_EINTRAG "Filterverringerung vorm Fehlerspeichereintrag | EN: Fault code LSHVK2_R - debounce filter decrement before fault-memory entry" VALUE 0x70B23 TKW_VV_VV_UB 100.0 FORMULA_0003 0.0 255.0000 /end CHARACTERISTIC
/begin CHARACTERISTIC K_ED_LSRVK1_OBD_START.DEC_VOR_EINTRAG "Filterverringerung vorm Fehlerspeichereintrag | EN: Fault code LSRVK1_OBD_START - debounce filter decrement before fault-memory entry" VALUE 0x70B3D TKW_VV_VV_UB 100.0 FORMULA_0003 0.0 255.0000 /end CHARACTERISTIC
/begin CHARACTERISTIC K_ED_LSRVK2_OBD_START.DEC_VOR_EINTRAG "Filterverringerung vorm Fehlerspeichereintrag | EN: Fault code LSRVK2_OBD_START - debounce filter decrement before fault-memory entry" VALUE 0x70B57 TKW_VV_VV_UB 100.0 FORMULA_0003 0.0 255.0000 /end CHARACTERISTIC
/begin CHARACTERISTIC K_ED_LSRVK1_OBD_REF.DEC_VOR_EINTRAG "Filterverringerung vorm Fehlerspeichereintrag | EN: Fault code LSRVK1_OBD_REF - debounce filter decrement before fault-memory entry" VALUE 0x70B71 TKW_VV_VV_UB 100.0 FORMULA_0003 0.0 255.0000 /end CHARACTERISTIC
/begin CHARACTERISTIC K_ED_LSRVK2_OBD_REF.DEC_VOR_EINTRAG "Filterverringerung vorm Fehlerspeichereintrag | EN: Fault code LSRVK2_OBD_REF - debounce filter decrement before fault-memory entry" VALUE 0x70B8B TKW_VV_VV_UB 100.0 FORMULA_0003 0.0 255.0000 /end CHARACTERISTIC
/begin CHARACTERISTIC K_ED_LAVK2_DIAG.DEC_VOR_EINTRAG "Filterverringerung vorm Fehlerspeichereintrag | EN: Fault code LAVK2_DIAG - debounce filter decrement before fault-memory entry" VALUE 0x70BBF TKW_VV_VV_UB 100.0 FORMULA_0003 0.0 255.0000 /end CHARACTERISTIC
/begin CHARACTERISTIC K_ED_LAVK1_IA_OPENLOAD.DEC_VOR_EINTRAG "Filterverringerung vorm Fehlerspeichereintrag | EN: Fault code LAVK1_IA_OPENLOAD - debounce filter decrement before fault-memory entry" VALUE 0x70BD9 TKW_VV_VV_UB 100.0 FORMULA_0003 0.0 255.0000 /end CHARACTERISTIC
/begin CHARACTERISTIC K_ED_LAVK2_IA_OPENLOAD.DEC_VOR_EINTRAG "Filterverringerung vorm Fehlerspeichereintrag | EN: Fault code LAVK2_IA_OPENLOAD - debounce filter decrement before fault-memory entry" VALUE 0x70BF3 TKW_VV_VV_UB 100.0 FORMULA_0003 0.0 255.0000 /end CHARACTERISTIC
/begin CHARACTERISTIC K_ED_PT_GRB.DEC_VOR_EINTRAG "Filterverringerung vorm Fehlerspeichereintrag | EN: Fault code PT_GRB - debounce filter decrement before fault-memory entry" VALUE 0x70C0D TKW_VV_VV_UB 100.0 FORMULA_0003 0.0 255.0000 /end CHARACTERISTIC
/begin CHARACTERISTIC K_ED_PT_GRB2.DEC_VOR_EINTRAG "Filterverringerung vorm Fehlerspeichereintrag | EN: Fault code PT_GRB2 - debounce filter decrement before fault-memory entry" VALUE 0x70C27 TKW_VV_VV_UB 100.0 FORMULA_0003 0.0 255.0000 /end CHARACTERISTIC
/begin CHARACTERISTIC K_ED_LAVK1_UN_OPENLOAD.DEC_VOR_EINTRAG "Filterverringerung vorm Fehlerspeichereintrag | EN: Fault code LAVK1_UN_OPENLOAD - debounce filter decrement before fault-memory entry" VALUE 0x70C41 TKW_VV_VV_UB 100.0 FORMULA_0003 0.0 255.0000 /end CHARACTERISTIC
/begin CHARACTERISTIC K_ED_LAVK2_UN_OPENLOAD.DEC_VOR_EINTRAG "Filterverringerung vorm Fehlerspeichereintrag | EN: Fault code LAVK2_UN_OPENLOAD - debounce filter decrement before fault-memory entry" VALUE 0x70C5B TKW_VV_VV_UB 100.0 FORMULA_0003 0.0 255.0000 /end CHARACTERISTIC
/begin CHARACTERISTIC K_ED_LAVK1_IP_OPENLOAD.DEC_VOR_EINTRAG "Filterverringerung vorm Fehlerspeichereintrag | EN: Fault code LAVK1_IP_OPENLOAD - debounce filter decrement before fault-memory entry" VALUE 0x70C75 TKW_VV_VV_UB 100.0 FORMULA_0003 0.0 255.0000 /end CHARACTERISTIC
/begin CHARACTERISTIC K_ED_LAVK2_IP_OPENLOAD.DEC_VOR_EINTRAG "Filterverringerung vorm Fehlerspeichereintrag | EN: Fault code LAVK2_IP_OPENLOAD - debounce filter decrement before fault-memory entry" VALUE 0x70C8F TKW_VV_VV_UB 100.0 FORMULA_0003 0.0 255.0000 /end CHARACTERISTIC
/begin CHARACTERISTIC K_ED_LAVK1_OBD_DYN.DEC_VOR_EINTRAG "Filterverringerung vorm Fehlerspeichereintrag | EN: Fault code LAVK1_OBD_DYN - debounce filter decrement before fault-memory entry" VALUE 0x70FCF TKW_VV_VV_UB 100.0 FORMULA_0003 0.0 255.0000 /end CHARACTERISTIC
/begin CHARACTERISTIC K_ED_LAVK2_OBD_DYN.DEC_VOR_EINTRAG "Filterverringerung vorm Fehlerspeichereintrag | EN: Fault code LAVK2_OBD_DYN - debounce filter decrement before fault-memory entry" VALUE 0x70FE9 TKW_VV_VV_UB 100.0 FORMULA_0003 0.0 255.0000 /end CHARACTERISTIC
/begin CHARACTERISTIC K_ED_PT_CRASH.DEC_VOR_EINTRAG "Filterverringerung vorm Fehlerspeichereintrag | EN: Fault code PT_CRASH - debounce filter decrement before fault-memory entry" VALUE 0x71003 TKW_VV_VV_UB 100.0 FORMULA_0003 0.0 255.0000 /end CHARACTERISTIC
/begin CHARACTERISTIC K_ED_PT_BEDFGR.DEC_VOR_EINTRAG "Filterverringerung vorm Fehlerspeichereintrag | EN: Fault code PT_BEDFGR - debounce filter decrement before fault-memory entry" VALUE 0x71037 TKW_VV_VV_UB 100.0 FORMULA_0003 0.0 255.0000 /end CHARACTERISTIC
/begin CHARACTERISTIC K_ED_LAVK1_TRIM.DEC_VOR_EINTRAG "Filterverringerung vorm Fehlerspeichereintrag | EN: Fault code LAVK1_TRIM - debounce filter decrement before fault-memory entry" VALUE 0x710ED TKW_VV_VV_UB 100.0 FORMULA_0003 0.0 255.0000 /end CHARACTERISTIC
/begin CHARACTERISTIC K_ED_LAVK2_TRIM.DEC_VOR_EINTRAG "Filterverringerung vorm Fehlerspeichereintrag | EN: Fault code LAVK2_TRIM - debounce filter decrement before fault-memory entry" VALUE 0x71107 TKW_VV_VV_UB 100.0 FORMULA_0003 0.0 255.0000 /end CHARACTERISTIC
/begin CHARACTERISTIC K_ED_PT_KM.DEC_VOR_EINTRAG "Filterverringerung vorm Fehlerspeichereintrag | EN: Fault code PT_KM - debounce filter decrement before fault-memory entry" VALUE 0x711BD TKW_VV_VV_UB 100.0 FORMULA_0003 0.0 255.0000 /end CHARACTERISTIC
/begin CHARACTERISTIC K_ED_PT_KOMBI.DEC_VOR_EINTRAG "Filterverringerung vorm Fehlerspeichereintrag | EN: Fault code PT_KOMBI - debounce filter decrement before fault-memory entry" VALUE 0x711D7 TKW_VV_VV_UB 100.0 FORMULA_0003 0.0 255.0000 /end CHARACTERISTIC
/begin CHARACTERISTIC K_ED_PKS_LL.DEC_VOR_EINTRAG "Filterverringerung vorm Fehlerspeichereintrag | EN: Fault code PKS_LL - debounce filter decrement before fault-memory entry" VALUE 0x711F1 TKW_VV_VV_UB 100.0 FORMULA_0003 0.0 255.0000 /end CHARACTERISTIC
/begin CHARACTERISTIC K_ED_PKS_TL.DEC_VOR_EINTRAG "Filterverringerung vorm Fehlerspeichereintrag | EN: Fault code PKS_TL - debounce filter decrement before fault-memory entry" VALUE 0x7120B TKW_VV_VV_UB 100.0 FORMULA_0003 0.0 255.0000 /end CHARACTERISTIC
/begin CHARACTERISTIC K_ED_PKS_Q.DEC_VOR_EINTRAG "Filterverringerung vorm Fehlerspeichereintrag | EN: Fault code PKS_Q - debounce filter decrement before fault-memory entry" VALUE 0x71225 TKW_VV_VV_UB 100.0 FORMULA_0003 0.0 255.0000 /end CHARACTERISTIC
/begin CHARACTERISTIC K_ED_MVAC_DRUCKSENSOR.DEC_VOR_EINTRAG "Filterverringerung vorm Fehlerspeichereintrag | EN: Fault code MVAC_DRUCKSENSOR - debounce filter decrement before fault-memory entry" VALUE 0x7135D TKW_VV_VV_UB 100.0 FORMULA_0003 0.0 255.0000 /end CHARACTERISTIC
/begin CHARACTERISTIC K_ED_PT_BEDAT.DEC_VOR_EINTRAG "Filterverringerung vorm Fehlerspeichereintrag | EN: Fault code PT_BEDAT - debounce filter decrement before fault-memory entry" VALUE 0x71377 TKW_VV_VV_UB 100.0 FORMULA_0003 0.0 255.0000 /end CHARACTERISTIC
/begin CHARACTERISTIC K_ED_PT_ANFRADMOM.DEC_VOR_EINTRAG "Filterverringerung vorm Fehlerspeichereintrag | EN: Fault code PT_ANFRADMOM - debounce filter decrement before fault-memory entry" VALUE 0x717BB TKW_VV_VV_UB 100.0 FORMULA_0003 0.0 255.0000 /end CHARACTERISTIC
/begin CHARACTERISTIC K_ED_LSHNK1_R.DEC_VOR_EINTRAG "Filterverringerung vorm Fehlerspeichereintrag | EN: Fault code LSHNK1_R - debounce filter decrement before fault-memory entry" VALUE 0x7190D TKW_VV_VV_UB 100.0 FORMULA_0003 0.0 255.0000 /end CHARACTERISTIC
/begin CHARACTERISTIC K_ED_LSHNK2_R.DEC_VOR_EINTRAG "Filterverringerung vorm Fehlerspeichereintrag | EN: Fault code LSHNK2_R - debounce filter decrement before fault-memory entry" VALUE 0x71927 TKW_VV_VV_UB 100.0 FORMULA_0003 0.0 255.0000 /end CHARACTERISTIC
/begin CHARACTERISTIC K_ED_PKS_MODELL.DEC_VOR_EINTRAG "Filterverringerung vorm Fehlerspeichereintrag | EN: Fault code PKS_MODELL - debounce filter decrement before fault-memory entry" VALUE 0x71941 TKW_VV_VV_UB 100.0 FORMULA_0003 0.0 255.0000 /end CHARACTERISTIC
/begin CHARACTERISTIC K_ED_PKS_PAUFBAU.DEC_VOR_EINTRAG "Filterverringerung vorm Fehlerspeichereintrag | EN: Fault code PKS_PAUFBAU - debounce filter decrement before fault-memory entry" VALUE 0x7195B TKW_VV_VV_UB 100.0 FORMULA_0003 0.0 255.0000 /end CHARACTERISTIC
/begin CHARACTERISTIC K_ED_PKS_ADAPT_ANSCHL.DEC_VOR_EINTRAG "Filterverringerung vorm Fehlerspeichereintrag | EN: Fault code PKS_ADAPT_ANSCHL - debounce filter decrement before fault-memory entry" VALUE 0x71975 TKW_VV_VV_UB 100.0 FORMULA_0003 0.0 255.0000 /end CHARACTERISTIC
/begin CHARACTERISTIC K_ED_LAVK_ATIC42.DEC_VOR_EINTRAG "Filterverringerung vorm Fehlerspeichereintrag | EN: Fault code LAVK_ATIC42 - debounce filter decrement before fault-memory entry" VALUE 0x719A9 TKW_VV_VV_UB 100.0 FORMULA_0003 0.0 255.0000 /end CHARACTERISTIC
/begin CHARACTERISTIC K_ED_PT_AX.DEC_VOR_EINTRAG "Filterverringerung vorm Fehlerspeichereintrag | EN: Fault code PT_AX - debounce filter decrement before fault-memory entry" VALUE 0x719C3 TKW_VV_VV_UB 100.0 FORMULA_0003 0.0 255.0000 /end CHARACTERISTIC
/begin CHARACTERISTIC K_ED_MVAC_OBD.DEC_VOR_EINTRAG "Filterverringerung vorm Fehlerspeichereintrag" VALUE 0x71A5F TKW_VV_VV_UB 100.0 FORMULA_0003 0.0 255.0000 /end CHARACTERISTIC
/begin CHARACTERISTIC K_ED_LAVK2_ATIC42.DEC_VOR_EINTRAG "Filterverringerung vorm Fehlerspeichereintrag" VALUE 0x71A93 TKW_VV_VV_UB 100.0 FORMULA_0003 0.0 255.0000 /end CHARACTERISTIC
/begin CHARACTERISTIC K_ED_PSAU1.INC_NACH_EINTRAG "Filtererhoehung nach Fehlerspeichereintrag | EN: Fault code PSAU1 - debounce filter increment after fault-memory entry" VALUE 0x7065E TKW_VV_VV_UB 100.0 FORMULA_0003 0.0 255.0000 /end CHARACTERISTIC
/begin CHARACTERISTIC K_ED_PSAU2.INC_NACH_EINTRAG "Filtererhoehung nach Fehlerspeichereintrag | EN: Fault code PSAU2 - debounce filter increment after fault-memory entry" VALUE 0x70678 TKW_VV_VV_UB 100.0 FORMULA_0003 0.0 255.0000 /end CHARACTERISTIC
/begin CHARACTERISTIC K_ED_NW1_SYNC.INC_NACH_EINTRAG "Filtererhoehung nach Fehlerspeichereintrag" VALUE 0x70762 TKW_VV_VV_UB 100.0 FORMULA_0003 0.0 255.0000 /end CHARACTERISTIC
/begin CHARACTERISTIC K_ED_NW2_SYNC.INC_NACH_EINTRAG "Filtererhoehung nach Fehlerspeichereintrag" VALUE 0x7077C TKW_VV_VV_UB 100.0 FORMULA_0003 0.0 255.0000 /end CHARACTERISTIC
/begin CHARACTERISTIC K_ED_PCTRL_INJ.INC_NACH_EINTRAG "Filtererhoehung nach Fehlerspeichereintrag | EN: Fault code PCTRL_INJ - debounce filter increment after fault-memory entry" VALUE 0x70796 TKW_VV_VV_UB 100.0 FORMULA_0003 0.0 255.0000 /end CHARACTERISTIC
/begin CHARACTERISTIC K_ED_PKS.INC_NACH_EINTRAG "Filtererhoehung nach Fehlerspeichereintrag | EN: Fault code PKS - debounce filter increment after fault-memory entry" VALUE 0x707CA TKW_VV_VV_UB 100.0 FORMULA_0003 0.0 255.0000 /end CHARACTERISTIC
/begin CHARACTERISTIC K_ED_LAVK2.INC_NACH_EINTRAG "Filtererhoehung nach Fehlerspeichereintrag | EN: Fault code LAVK2 - debounce filter increment after fault-memory entry" VALUE 0x70818 TKW_VV_VV_UB 100.0 FORMULA_0003 0.0 255.0000 /end CHARACTERISTIC
/begin CHARACTERISTIC K_ED_LAVK1_OBD_PLAU.INC_NACH_EINTRAG "Filtererhoehung nach Fehlerspeichereintrag | EN: Fault code LAVK1_OBD_PLAU - debounce filter increment after fault-memory entry" VALUE 0x70832 TKW_VV_VV_UB 100.0 FORMULA_0003 0.0 255.0000 /end CHARACTERISTIC
/begin CHARACTERISTIC K_ED_LAVK2_OBD_PLAU.INC_NACH_EINTRAG "Filtererhoehung nach Fehlerspeichereintrag | EN: Fault code LAVK2_OBD_PLAU - debounce filter increment after fault-memory entry" VALUE 0x7084C TKW_VV_VV_UB 100.0 FORMULA_0003 0.0 255.0000 /end CHARACTERISTIC
/begin CHARACTERISTIC K_ED_LAVK1_OBD_SA.INC_NACH_EINTRAG "Filtererhoehung nach Fehlerspeichereintrag | EN: Fault code LAVK1_OBD_SA - debounce filter increment after fault-memory entry" VALUE 0x70866 TKW_VV_VV_UB 100.0 FORMULA_0003 0.0 255.0000 /end CHARACTERISTIC
/begin CHARACTERISTIC K_ED_LAVK2_OBD_SA.INC_NACH_EINTRAG "Filtererhoehung nach Fehlerspeichereintrag | EN: Fault code LAVK2_OBD_SA - debounce filter increment after fault-memory entry" VALUE 0x70880 TKW_VV_VV_UB 100.0 FORMULA_0003 0.0 255.0000 /end CHARACTERISTIC
/begin CHARACTERISTIC K_ED_LSHNK1.INC_NACH_EINTRAG "Filtererhoehung nach Fehlerspeichereintrag | EN: Fault code LSHNK1 - debounce filter increment after fault-memory entry" VALUE 0x708CE TKW_VV_VV_UB 100.0 FORMULA_0003 0.0 255.0000 /end CHARACTERISTIC
/begin CHARACTERISTIC K_ED_LSHNK2.INC_NACH_EINTRAG "Filtererhoehung nach Fehlerspeichereintrag | EN: Fault code LSHNK2 - debounce filter increment after fault-memory entry" VALUE 0x708E8 TKW_VV_VV_UB 100.0 FORMULA_0003 0.0 255.0000 /end CHARACTERISTIC
/begin CHARACTERISTIC K_ED_PT_BUSOFF.INC_NACH_EINTRAG "Filtererhoehung nach Fehlerspeichereintrag | EN: Fault code PT_BUSOFF - debounce filter increment after fault-memory entry" VALUE 0x70902 TKW_VV_VV_UB 100.0 FORMULA_0003 0.0 255.0000 /end CHARACTERISTIC
/begin CHARACTERISTIC K_ED_PT_ATEMP.INC_NACH_EINTRAG "Filtererhoehung nach Fehlerspeichereintrag | EN: Fault code PT_ATEMP - debounce filter increment after fault-memory entry" VALUE 0x70984 TKW_VV_VV_UB 100.0 FORMULA_0003 0.0 255.0000 /end CHARACTERISTIC
/begin CHARACTERISTIC K_ED_PT_KLST.INC_NACH_EINTRAG "Filtererhoehung nach Fehlerspeichereintrag | EN: Fault code PT_KLST - debounce filter increment after fault-memory entry" VALUE 0x7099E TKW_VV_VV_UB 100.0 FORMULA_0003 0.0 255.0000 /end CHARACTERISTIC
/begin CHARACTERISTIC K_ED_PT_KKOS.INC_NACH_EINTRAG "Filtererhoehung nach Fehlerspeichereintrag | EN: Fault code PT_KKOS - debounce filter increment after fault-memory entry" VALUE 0x709B8 TKW_VV_VV_UB 100.0 FORMULA_0003 0.0 255.0000 /end CHARACTERISTIC
/begin CHARACTERISTIC K_ED_PT_LRW.INC_NACH_EINTRAG "Filtererhoehung nach Fehlerspeichereintrag | EN: Fault code PT_LRW - debounce filter increment after fault-memory entry" VALUE 0x709D2 TKW_VV_VV_UB 100.0 FORMULA_0003 0.0 255.0000 /end CHARACTERISTIC
/begin CHARACTERISTIC K_ED_LAVK1_OBD_TL.INC_NACH_EINTRAG "Filtererhoehung nach Fehlerspeichereintrag | EN: Fault code LAVK1_OBD_TL - debounce filter increment after fault-memory entry" VALUE 0x70A6E TKW_VV_VV_UB 100.0 FORMULA_0003 0.0 255.0000 /end CHARACTERISTIC
/begin CHARACTERISTIC K_ED_LAVK2_OBD_TL.INC_NACH_EINTRAG "Filtererhoehung nach Fehlerspeichereintrag | EN: Fault code LAVK2_OBD_TL - debounce filter increment after fault-memory entry" VALUE 0x70A88 TKW_VV_VV_UB 100.0 FORMULA_0003 0.0 255.0000 /end CHARACTERISTIC
/begin CHARACTERISTIC K_ED_LSHVK1.INC_NACH_EINTRAG "Filtererhoehung nach Fehlerspeichereintrag | EN: Fault code LSHVK1 - debounce filter increment after fault-memory entry" VALUE 0x70AA2 TKW_VV_VV_UB 100.0 FORMULA_0003 0.0 255.0000 /end CHARACTERISTIC
/begin CHARACTERISTIC K_ED_LSHVK2.INC_NACH_EINTRAG "Filtererhoehung nach Fehlerspeichereintrag | EN: Fault code LSHVK2 - debounce filter increment after fault-memory entry" VALUE 0x70ABC TKW_VV_VV_UB 100.0 FORMULA_0003 0.0 255.0000 /end CHARACTERISTIC
/begin CHARACTERISTIC K_ED_LSRVK1_OBD_REG.INC_NACH_EINTRAG "Filtererhoehung nach Fehlerspeichereintrag | EN: Fault code LSRVK1_OBD_REG - debounce filter increment after fault-memory entry" VALUE 0x70AD6 TKW_VV_VV_UB 100.0 FORMULA_0003 0.0 255.0000 /end CHARACTERISTIC
/begin CHARACTERISTIC K_ED_LSRVK2_OBD_REG.INC_NACH_EINTRAG "Filtererhoehung nach Fehlerspeichereintrag | EN: Fault code LSRVK2_OBD_REG - debounce filter increment after fault-memory entry" VALUE 0x70AF0 TKW_VV_VV_UB 100.0 FORMULA_0003 0.0 255.0000 /end CHARACTERISTIC
/begin CHARACTERISTIC K_ED_LSHVK1_R.INC_NACH_EINTRAG "Filtererhoehung nach Fehlerspeichereintrag | EN: Fault code LSHVK1_R - debounce filter increment after fault-memory entry" VALUE 0x70B0A TKW_VV_VV_UB 100.0 FORMULA_0003 0.0 255.0000 /end CHARACTERISTIC
/begin CHARACTERISTIC K_ED_LSHVK2_R.INC_NACH_EINTRAG "Filtererhoehung nach Fehlerspeichereintrag | EN: Fault code LSHVK2_R - debounce filter increment after fault-memory entry" VALUE 0x70B24 TKW_VV_VV_UB 100.0 FORMULA_0003 0.0 255.0000 /end CHARACTERISTIC
/begin CHARACTERISTIC K_ED_LSRVK1_OBD_START.INC_NACH_EINTRAG "Filtererhoehung nach Fehlerspeichereintrag | EN: Fault code LSRVK1_OBD_START - debounce filter increment after fault-memory entry" VALUE 0x70B3E TKW_VV_VV_UB 100.0 FORMULA_0003 0.0 255.0000 /end CHARACTERISTIC
/begin CHARACTERISTIC K_ED_LSRVK2_OBD_START.INC_NACH_EINTRAG "Filtererhoehung nach Fehlerspeichereintrag | EN: Fault code LSRVK2_OBD_START - debounce filter increment after fault-memory entry" VALUE 0x70B58 TKW_VV_VV_UB 100.0 FORMULA_0003 0.0 255.0000 /end CHARACTERISTIC
/begin CHARACTERISTIC K_ED_LSRVK1_OBD_REF.INC_NACH_EINTRAG "Filtererhoehung nach Fehlerspeichereintrag | EN: Fault code LSRVK1_OBD_REF - debounce filter increment after fault-memory entry" VALUE 0x70B72 TKW_VV_VV_UB 100.0 FORMULA_0003 0.0 255.0000 /end CHARACTERISTIC
/begin CHARACTERISTIC K_ED_LSRVK2_OBD_REF.INC_NACH_EINTRAG "Filtererhoehung nach Fehlerspeichereintrag | EN: Fault code LSRVK2_OBD_REF - debounce filter increment after fault-memory entry" VALUE 0x70B8C TKW_VV_VV_UB 100.0 FORMULA_0003 0.0 255.0000 /end CHARACTERISTIC
/begin CHARACTERISTIC K_ED_LAVK2_DIAG.INC_NACH_EINTRAG "Filtererhoehung nach Fehlerspeichereintrag | EN: Fault code LAVK2_DIAG - debounce filter increment after fault-memory entry" VALUE 0x70BC0 TKW_VV_VV_UB 100.0 FORMULA_0003 0.0 255.0000 /end CHARACTERISTIC
/begin CHARACTERISTIC K_ED_LAVK1_IA_OPENLOAD.INC_NACH_EINTRAG "Filtererhoehung nach Fehlerspeichereintrag | EN: Fault code LAVK1_IA_OPENLOAD - debounce filter increment after fault-memory entry" VALUE 0x70BDA TKW_VV_VV_UB 100.0 FORMULA_0003 0.0 255.0000 /end CHARACTERISTIC
/begin CHARACTERISTIC K_ED_LAVK2_IA_OPENLOAD.INC_NACH_EINTRAG "Filtererhoehung nach Fehlerspeichereintrag | EN: Fault code LAVK2_IA_OPENLOAD - debounce filter increment after fault-memory entry" VALUE 0x70BF4 TKW_VV_VV_UB 100.0 FORMULA_0003 0.0 255.0000 /end CHARACTERISTIC
/begin CHARACTERISTIC K_ED_PT_GRB.INC_NACH_EINTRAG "Filtererhoehung nach Fehlerspeichereintrag | EN: Fault code PT_GRB - debounce filter increment after fault-memory entry" VALUE 0x70C0E TKW_VV_VV_UB 100.0 FORMULA_0003 0.0 255.0000 /end CHARACTERISTIC
/begin CHARACTERISTIC K_ED_PT_GRB2.INC_NACH_EINTRAG "Filtererhoehung nach Fehlerspeichereintrag | EN: Fault code PT_GRB2 - debounce filter increment after fault-memory entry" VALUE 0x70C28 TKW_VV_VV_UB 100.0 FORMULA_0003 0.0 255.0000 /end CHARACTERISTIC
/begin CHARACTERISTIC K_ED_LAVK1_UN_OPENLOAD.INC_NACH_EINTRAG "Filtererhoehung nach Fehlerspeichereintrag | EN: Fault code LAVK1_UN_OPENLOAD - debounce filter increment after fault-memory entry" VALUE 0x70C42 TKW_VV_VV_UB 100.0 FORMULA_0003 0.0 255.0000 /end CHARACTERISTIC
/begin CHARACTERISTIC K_ED_LAVK2_UN_OPENLOAD.INC_NACH_EINTRAG "Filtererhoehung nach Fehlerspeichereintrag | EN: Fault code LAVK2_UN_OPENLOAD - debounce filter increment after fault-memory entry" VALUE 0x70C5C TKW_VV_VV_UB 100.0 FORMULA_0003 0.0 255.0000 /end CHARACTERISTIC
/begin CHARACTERISTIC K_ED_LAVK1_IP_OPENLOAD.INC_NACH_EINTRAG "Filtererhoehung nach Fehlerspeichereintrag | EN: Fault code LAVK1_IP_OPENLOAD - debounce filter increment after fault-memory entry" VALUE 0x70C76 TKW_VV_VV_UB 100.0 FORMULA_0003 0.0 255.0000 /end CHARACTERISTIC
/begin CHARACTERISTIC K_ED_LAVK2_IP_OPENLOAD.INC_NACH_EINTRAG "Filtererhoehung nach Fehlerspeichereintrag | EN: Fault code LAVK2_IP_OPENLOAD - debounce filter increment after fault-memory entry" VALUE 0x70C90 TKW_VV_VV_UB 100.0 FORMULA_0003 0.0 255.0000 /end CHARACTERISTIC
/begin CHARACTERISTIC K_ED_LAVK1_OBD_DYN.INC_NACH_EINTRAG "Filtererhoehung nach Fehlerspeichereintrag | EN: Fault code LAVK1_OBD_DYN - debounce filter increment after fault-memory entry" VALUE 0x70FD0 TKW_VV_VV_UB 100.0 FORMULA_0003 0.0 255.0000 /end CHARACTERISTIC
/begin CHARACTERISTIC K_ED_LAVK2_OBD_DYN.INC_NACH_EINTRAG "Filtererhoehung nach Fehlerspeichereintrag | EN: Fault code LAVK2_OBD_DYN - debounce filter increment after fault-memory entry" VALUE 0x70FEA TKW_VV_VV_UB 100.0 FORMULA_0003 0.0 255.0000 /end CHARACTERISTIC
/begin CHARACTERISTIC K_ED_PT_CRASH.INC_NACH_EINTRAG "Filtererhoehung nach Fehlerspeichereintrag | EN: Fault code PT_CRASH - debounce filter increment after fault-memory entry" VALUE 0x71004 TKW_VV_VV_UB 100.0 FORMULA_0003 0.0 255.0000 /end CHARACTERISTIC
/begin CHARACTERISTIC K_ED_PT_BEDFGR.INC_NACH_EINTRAG "Filtererhoehung nach Fehlerspeichereintrag | EN: Fault code PT_BEDFGR - debounce filter increment after fault-memory entry" VALUE 0x71038 TKW_VV_VV_UB 100.0 FORMULA_0003 0.0 255.0000 /end CHARACTERISTIC
/begin CHARACTERISTIC K_ED_LAVK1_TRIM.INC_NACH_EINTRAG "Filtererhoehung nach Fehlerspeichereintrag | EN: Fault code LAVK1_TRIM - debounce filter increment after fault-memory entry" VALUE 0x710EE TKW_VV_VV_UB 100.0 FORMULA_0003 0.0 255.0000 /end CHARACTERISTIC
/begin CHARACTERISTIC K_ED_LAVK2_TRIM.INC_NACH_EINTRAG "Filtererhoehung nach Fehlerspeichereintrag | EN: Fault code LAVK2_TRIM - debounce filter increment after fault-memory entry" VALUE 0x71108 TKW_VV_VV_UB 100.0 FORMULA_0003 0.0 255.0000 /end CHARACTERISTIC
/begin CHARACTERISTIC K_ED_PT_KM.INC_NACH_EINTRAG "Filtererhoehung nach Fehlerspeichereintrag | EN: Fault code PT_KM - debounce filter increment after fault-memory entry" VALUE 0x711BE TKW_VV_VV_UB 100.0 FORMULA_0003 0.0 255.0000 /end CHARACTERISTIC
/begin CHARACTERISTIC K_ED_PT_KOMBI.INC_NACH_EINTRAG "Filtererhoehung nach Fehlerspeichereintrag | EN: Fault code PT_KOMBI - debounce filter increment after fault-memory entry" VALUE 0x711D8 TKW_VV_VV_UB 100.0 FORMULA_0003 0.0 255.0000 /end CHARACTERISTIC
/begin CHARACTERISTIC K_ED_PKS_LL.INC_NACH_EINTRAG "Filtererhoehung nach Fehlerspeichereintrag | EN: Fault code PKS_LL - debounce filter increment after fault-memory entry" VALUE 0x711F2 TKW_VV_VV_UB 100.0 FORMULA_0003 0.0 255.0000 /end CHARACTERISTIC
/begin CHARACTERISTIC K_ED_PKS_TL.INC_NACH_EINTRAG "Filtererhoehung nach Fehlerspeichereintrag | EN: Fault code PKS_TL - debounce filter increment after fault-memory entry" VALUE 0x7120C TKW_VV_VV_UB 100.0 FORMULA_0003 0.0 255.0000 /end CHARACTERISTIC
/begin CHARACTERISTIC K_ED_PKS_Q.INC_NACH_EINTRAG "Filtererhoehung nach Fehlerspeichereintrag | EN: Fault code PKS_Q - debounce filter increment after fault-memory entry" VALUE 0x71226 TKW_VV_VV_UB 100.0 FORMULA_0003 0.0 255.0000 /end CHARACTERISTIC
/begin CHARACTERISTIC K_ED_MVAC_DRUCKSENSOR.INC_NACH_EINTRAG "Filtererhoehung nach Fehlerspeichereintrag | EN: Fault code MVAC_DRUCKSENSOR - debounce filter increment after fault-memory entry" VALUE 0x7135E TKW_VV_VV_UB 100.0 FORMULA_0003 0.0 255.0000 /end CHARACTERISTIC
/begin CHARACTERISTIC K_ED_PT_BEDAT.INC_NACH_EINTRAG "Filtererhoehung nach Fehlerspeichereintrag | EN: Fault code PT_BEDAT - debounce filter increment after fault-memory entry" VALUE 0x71378 TKW_VV_VV_UB 100.0 FORMULA_0003 0.0 255.0000 /end CHARACTERISTIC
/begin CHARACTERISTIC K_ED_PT_ANFRADMOM.INC_NACH_EINTRAG "Filtererhoehung nach Fehlerspeichereintrag | EN: Fault code PT_ANFRADMOM - debounce filter increment after fault-memory entry" VALUE 0x717BC TKW_VV_VV_UB 100.0 FORMULA_0003 0.0 255.0000 /end CHARACTERISTIC
/begin CHARACTERISTIC K_ED_LSHNK1_R.INC_NACH_EINTRAG "Filtererhoehung nach Fehlerspeichereintrag | EN: Fault code LSHNK1_R - debounce filter increment after fault-memory entry" VALUE 0x7190E TKW_VV_VV_UB 100.0 FORMULA_0003 0.0 255.0000 /end CHARACTERISTIC
/begin CHARACTERISTIC K_ED_LSHNK2_R.INC_NACH_EINTRAG "Filtererhoehung nach Fehlerspeichereintrag | EN: Fault code LSHNK2_R - debounce filter increment after fault-memory entry" VALUE 0x71928 TKW_VV_VV_UB 100.0 FORMULA_0003 0.0 255.0000 /end CHARACTERISTIC
/begin CHARACTERISTIC K_ED_PKS_MODELL.INC_NACH_EINTRAG "Filtererhoehung nach Fehlerspeichereintrag | EN: Fault code PKS_MODELL - debounce filter increment after fault-memory entry" VALUE 0x71942 TKW_VV_VV_UB 100.0 FORMULA_0003 0.0 255.0000 /end CHARACTERISTIC
/begin CHARACTERISTIC K_ED_PKS_PAUFBAU.INC_NACH_EINTRAG "Filtererhoehung nach Fehlerspeichereintrag | EN: Fault code PKS_PAUFBAU - debounce filter increment after fault-memory entry" VALUE 0x7195C TKW_VV_VV_UB 100.0 FORMULA_0003 0.0 255.0000 /end CHARACTERISTIC
/begin CHARACTERISTIC K_ED_PKS_ADAPT_ANSCHL.INC_NACH_EINTRAG "Filtererhoehung nach Fehlerspeichereintrag | EN: Fault code PKS_ADAPT_ANSCHL - debounce filter increment after fault-memory entry" VALUE 0x71976 TKW_VV_VV_UB 100.0 FORMULA_0003 0.0 255.0000 /end CHARACTERISTIC
/begin CHARACTERISTIC K_ED_LAVK_ATIC42.INC_NACH_EINTRAG "Filtererhoehung nach Fehlerspeichereintrag | EN: Fault code LAVK_ATIC42 - debounce filter increment after fault-memory entry" VALUE 0x719AA TKW_VV_VV_UB 100.0 FORMULA_0003 0.0 255.0000 /end CHARACTERISTIC
/begin CHARACTERISTIC K_ED_PT_AX.INC_NACH_EINTRAG "Filtererhoehung nach Fehlerspeichereintrag | EN: Fault code PT_AX - debounce filter increment after fault-memory entry" VALUE 0x719C4 TKW_VV_VV_UB 100.0 FORMULA_0003 0.0 255.0000 /end CHARACTERISTIC
/begin CHARACTERISTIC K_ED_MVAC_OBD.INC_NACH_EINTRAG "Filtererhoehung nach Fehlerspeichereintrag" VALUE 0x71A60 TKW_VV_VV_UB 100.0 FORMULA_0003 0.0 255.0000 /end CHARACTERISTIC
/begin CHARACTERISTIC K_ED_LAVK2_ATIC42.INC_NACH_EINTRAG "Filtererhoehung nach Fehlerspeichereintrag" VALUE 0x71A94 TKW_VV_VV_UB 100.0 FORMULA_0003 0.0 255.0000 /end CHARACTERISTIC
/begin CHARACTERISTIC K_ED_PSAU1.DEC_NACH_EINTRAG "Filterverringerung nach Fehlerspeichereintrag | EN: Fault code PSAU1 - debounce filter decrement after fault-memory entry" VALUE 0x7065F TKW_VV_VV_UB 100.0 FORMULA_0003 0.0 255.0000 /end CHARACTERISTIC
/begin CHARACTERISTIC K_ED_PSAU2.DEC_NACH_EINTRAG "Filterverringerung nach Fehlerspeichereintrag | EN: Fault code PSAU2 - debounce filter decrement after fault-memory entry" VALUE 0x70679 TKW_VV_VV_UB 100.0 FORMULA_0003 0.0 255.0000 /end CHARACTERISTIC
/begin CHARACTERISTIC K_ED_NW1_SYNC.DEC_NACH_EINTRAG "Filterverringerung nach Fehlerspeichereintrag" VALUE 0x70763 TKW_VV_VV_UB 100.0 FORMULA_0003 0.0 255.0000 /end CHARACTERISTIC
/begin CHARACTERISTIC K_ED_NW2_SYNC.DEC_NACH_EINTRAG "Filterverringerung nach Fehlerspeichereintrag" VALUE 0x7077D TKW_VV_VV_UB 100.0 FORMULA_0003 0.0 255.0000 /end CHARACTERISTIC
/begin CHARACTERISTIC K_ED_PCTRL_INJ.DEC_NACH_EINTRAG "Filterverringerung nach Fehlerspeichereintrag | EN: Fault code PCTRL_INJ - debounce filter decrement after fault-memory entry" VALUE 0x70797 TKW_VV_VV_UB 100.0 FORMULA_0003 0.0 255.0000 /end CHARACTERISTIC
/begin CHARACTERISTIC K_ED_PKS.DEC_NACH_EINTRAG "Filterverringerung nach Fehlerspeichereintrag | EN: Fault code PKS - debounce filter decrement after fault-memory entry" VALUE 0x707CB TKW_VV_VV_UB 100.0 FORMULA_0003 0.0 255.0000 /end CHARACTERISTIC
/begin CHARACTERISTIC K_ED_LAVK2.DEC_NACH_EINTRAG "Filterverringerung nach Fehlerspeichereintrag | EN: Fault code LAVK2 - debounce filter decrement after fault-memory entry" VALUE 0x70819 TKW_VV_VV_UB 100.0 FORMULA_0003 0.0 255.0000 /end CHARACTERISTIC
/begin CHARACTERISTIC K_ED_LAVK1_OBD_PLAU.DEC_NACH_EINTRAG "Filterverringerung nach Fehlerspeichereintrag | EN: Fault code LAVK1_OBD_PLAU - debounce filter decrement after fault-memory entry" VALUE 0x70833 TKW_VV_VV_UB 100.0 FORMULA_0003 0.0 255.0000 /end CHARACTERISTIC
/begin CHARACTERISTIC K_ED_LAVK2_OBD_PLAU.DEC_NACH_EINTRAG "Filterverringerung nach Fehlerspeichereintrag | EN: Fault code LAVK2_OBD_PLAU - debounce filter decrement after fault-memory entry" VALUE 0x7084D TKW_VV_VV_UB 100.0 FORMULA_0003 0.0 255.0000 /end CHARACTERISTIC
/begin CHARACTERISTIC K_ED_LAVK1_OBD_SA.DEC_NACH_EINTRAG "Filterverringerung nach Fehlerspeichereintrag | EN: Fault code LAVK1_OBD_SA - debounce filter decrement after fault-memory entry" VALUE 0x70867 TKW_VV_VV_UB 100.0 FORMULA_0003 0.0 255.0000 /end CHARACTERISTIC
/begin CHARACTERISTIC K_ED_LAVK2_OBD_SA.DEC_NACH_EINTRAG "Filterverringerung nach Fehlerspeichereintrag | EN: Fault code LAVK2_OBD_SA - debounce filter decrement after fault-memory entry" VALUE 0x70881 TKW_VV_VV_UB 100.0 FORMULA_0003 0.0 255.0000 /end CHARACTERISTIC
/begin CHARACTERISTIC K_ED_LSHNK1.DEC_NACH_EINTRAG "Filterverringerung nach Fehlerspeichereintrag | EN: Fault code LSHNK1 - debounce filter decrement after fault-memory entry" VALUE 0x708CF TKW_VV_VV_UB 100.0 FORMULA_0003 0.0 255.0000 /end CHARACTERISTIC
/begin CHARACTERISTIC K_ED_LSHNK2.DEC_NACH_EINTRAG "Filterverringerung nach Fehlerspeichereintrag | EN: Fault code LSHNK2 - debounce filter decrement after fault-memory entry" VALUE 0x708E9 TKW_VV_VV_UB 100.0 FORMULA_0003 0.0 255.0000 /end CHARACTERISTIC
/begin CHARACTERISTIC K_ED_PT_BUSOFF.DEC_NACH_EINTRAG "Filterverringerung nach Fehlerspeichereintrag | EN: Fault code PT_BUSOFF - debounce filter decrement after fault-memory entry" VALUE 0x70903 TKW_VV_VV_UB 100.0 FORMULA_0003 0.0 255.0000 /end CHARACTERISTIC
/begin CHARACTERISTIC K_ED_PT_ATEMP.DEC_NACH_EINTRAG "Filterverringerung nach Fehlerspeichereintrag | EN: Fault code PT_ATEMP - debounce filter decrement after fault-memory entry" VALUE 0x70985 TKW_VV_VV_UB 100.0 FORMULA_0003 0.0 255.0000 /end CHARACTERISTIC
/begin CHARACTERISTIC K_ED_PT_KLST.DEC_NACH_EINTRAG "Filterverringerung nach Fehlerspeichereintrag | EN: Fault code PT_KLST - debounce filter decrement after fault-memory entry" VALUE 0x7099F TKW_VV_VV_UB 100.0 FORMULA_0003 0.0 255.0000 /end CHARACTERISTIC
/begin CHARACTERISTIC K_ED_PT_KKOS.DEC_NACH_EINTRAG "Filterverringerung nach Fehlerspeichereintrag | EN: Fault code PT_KKOS - debounce filter decrement after fault-memory entry" VALUE 0x709B9 TKW_VV_VV_UB 100.0 FORMULA_0003 0.0 255.0000 /end CHARACTERISTIC
/begin CHARACTERISTIC K_ED_PT_LRW.DEC_NACH_EINTRAG "Filterverringerung nach Fehlerspeichereintrag | EN: Fault code PT_LRW - debounce filter decrement after fault-memory entry" VALUE 0x709D3 TKW_VV_VV_UB 100.0 FORMULA_0003 0.0 255.0000 /end CHARACTERISTIC
/begin CHARACTERISTIC K_ED_LAVK1_OBD_TL.DEC_NACH_EINTRAG "Filterverringerung nach Fehlerspeichereintrag | EN: Fault code LAVK1_OBD_TL - debounce filter decrement after fault-memory entry [V912: differs from V452 160E]" VALUE 0x70A6F TKW_VV_VV_UB 100.0 FORMULA_0003 0.0 255.0000 /end CHARACTERISTIC
/begin CHARACTERISTIC K_ED_LAVK2_OBD_TL.DEC_NACH_EINTRAG "Filterverringerung nach Fehlerspeichereintrag | EN: Fault code LAVK2_OBD_TL - debounce filter decrement after fault-memory entry [V912: differs from V452 160E]" VALUE 0x70A89 TKW_VV_VV_UB 100.0 FORMULA_0003 0.0 255.0000 /end CHARACTERISTIC
/begin CHARACTERISTIC K_ED_LSHVK1.DEC_NACH_EINTRAG "Filterverringerung nach Fehlerspeichereintrag | EN: Fault code LSHVK1 - debounce filter decrement after fault-memory entry" VALUE 0x70AA3 TKW_VV_VV_UB 100.0 FORMULA_0003 0.0 255.0000 /end CHARACTERISTIC
/begin CHARACTERISTIC K_ED_LSHVK2.DEC_NACH_EINTRAG "Filterverringerung nach Fehlerspeichereintrag | EN: Fault code LSHVK2 - debounce filter decrement after fault-memory entry" VALUE 0x70ABD TKW_VV_VV_UB 100.0 FORMULA_0003 0.0 255.0000 /end CHARACTERISTIC
/begin CHARACTERISTIC K_ED_LSRVK1_OBD_REG.DEC_NACH_EINTRAG "Filterverringerung nach Fehlerspeichereintrag | EN: Fault code LSRVK1_OBD_REG - debounce filter decrement after fault-memory entry" VALUE 0x70AD7 TKW_VV_VV_UB 100.0 FORMULA_0003 0.0 255.0000 /end CHARACTERISTIC
/begin CHARACTERISTIC K_ED_LSRVK2_OBD_REG.DEC_NACH_EINTRAG "Filterverringerung nach Fehlerspeichereintrag | EN: Fault code LSRVK2_OBD_REG - debounce filter decrement after fault-memory entry" VALUE 0x70AF1 TKW_VV_VV_UB 100.0 FORMULA_0003 0.0 255.0000 /end CHARACTERISTIC
/begin CHARACTERISTIC K_ED_LSHVK1_R.DEC_NACH_EINTRAG "Filterverringerung nach Fehlerspeichereintrag | EN: Fault code LSHVK1_R - debounce filter decrement after fault-memory entry" VALUE 0x70B0B TKW_VV_VV_UB 100.0 FORMULA_0003 0.0 255.0000 /end CHARACTERISTIC
/begin CHARACTERISTIC K_ED_LSHVK2_R.DEC_NACH_EINTRAG "Filterverringerung nach Fehlerspeichereintrag | EN: Fault code LSHVK2_R - debounce filter decrement after fault-memory entry" VALUE 0x70B25 TKW_VV_VV_UB 100.0 FORMULA_0003 0.0 255.0000 /end CHARACTERISTIC
/begin CHARACTERISTIC K_ED_LSRVK1_OBD_START.DEC_NACH_EINTRAG "Filterverringerung nach Fehlerspeichereintrag | EN: Fault code LSRVK1_OBD_START - debounce filter decrement after fault-memory entry" VALUE 0x70B3F TKW_VV_VV_UB 100.0 FORMULA_0003 0.0 255.0000 /end CHARACTERISTIC
/begin CHARACTERISTIC K_ED_LSRVK2_OBD_START.DEC_NACH_EINTRAG "Filterverringerung nach Fehlerspeichereintrag | EN: Fault code LSRVK2_OBD_START - debounce filter decrement after fault-memory entry" VALUE 0x70B59 TKW_VV_VV_UB 100.0 FORMULA_0003 0.0 255.0000 /end CHARACTERISTIC
/begin CHARACTERISTIC K_ED_LSRVK1_OBD_REF.DEC_NACH_EINTRAG "Filterverringerung nach Fehlerspeichereintrag | EN: Fault code LSRVK1_OBD_REF - debounce filter decrement after fault-memory entry" VALUE 0x70B73 TKW_VV_VV_UB 100.0 FORMULA_0003 0.0 255.0000 /end CHARACTERISTIC
/begin CHARACTERISTIC K_ED_LSRVK2_OBD_REF.DEC_NACH_EINTRAG "Filterverringerung nach Fehlerspeichereintrag | EN: Fault code LSRVK2_OBD_REF - debounce filter decrement after fault-memory entry" VALUE 0x70B8D TKW_VV_VV_UB 100.0 FORMULA_0003 0.0 255.0000 /end CHARACTERISTIC
/begin CHARACTERISTIC K_ED_LAVK2_DIAG.DEC_NACH_EINTRAG "Filterverringerung nach Fehlerspeichereintrag | EN: Fault code LAVK2_DIAG - debounce filter decrement after fault-memory entry" VALUE 0x70BC1 TKW_VV_VV_UB 100.0 FORMULA_0003 0.0 255.0000 /end CHARACTERISTIC
/begin CHARACTERISTIC K_ED_LAVK1_IA_OPENLOAD.DEC_NACH_EINTRAG "Filterverringerung nach Fehlerspeichereintrag | EN: Fault code LAVK1_IA_OPENLOAD - debounce filter decrement after fault-memory entry" VALUE 0x70BDB TKW_VV_VV_UB 100.0 FORMULA_0003 0.0 255.0000 /end CHARACTERISTIC
/begin CHARACTERISTIC K_ED_LAVK2_IA_OPENLOAD.DEC_NACH_EINTRAG "Filterverringerung nach Fehlerspeichereintrag | EN: Fault code LAVK2_IA_OPENLOAD - debounce filter decrement after fault-memory entry" VALUE 0x70BF5 TKW_VV_VV_UB 100.0 FORMULA_0003 0.0 255.0000 /end CHARACTERISTIC
/begin CHARACTERISTIC K_ED_PT_GRB.DEC_NACH_EINTRAG "Filterverringerung nach Fehlerspeichereintrag | EN: Fault code PT_GRB - debounce filter decrement after fault-memory entry" VALUE 0x70C0F TKW_VV_VV_UB 100.0 FORMULA_0003 0.0 255.0000 /end CHARACTERISTIC
/begin CHARACTERISTIC K_ED_PT_GRB2.DEC_NACH_EINTRAG "Filterverringerung nach Fehlerspeichereintrag | EN: Fault code PT_GRB2 - debounce filter decrement after fault-memory entry" VALUE 0x70C29 TKW_VV_VV_UB 100.0 FORMULA_0003 0.0 255.0000 /end CHARACTERISTIC
/begin CHARACTERISTIC K_ED_LAVK1_UN_OPENLOAD.DEC_NACH_EINTRAG "Filterverringerung nach Fehlerspeichereintrag | EN: Fault code LAVK1_UN_OPENLOAD - debounce filter decrement after fault-memory entry" VALUE 0x70C43 TKW_VV_VV_UB 100.0 FORMULA_0003 0.0 255.0000 /end CHARACTERISTIC
/begin CHARACTERISTIC K_ED_LAVK2_UN_OPENLOAD.DEC_NACH_EINTRAG "Filterverringerung nach Fehlerspeichereintrag | EN: Fault code LAVK2_UN_OPENLOAD - debounce filter decrement after fault-memory entry" VALUE 0x70C5D TKW_VV_VV_UB 100.0 FORMULA_0003 0.0 255.0000 /end CHARACTERISTIC
/begin CHARACTERISTIC K_ED_LAVK1_IP_OPENLOAD.DEC_NACH_EINTRAG "Filterverringerung nach Fehlerspeichereintrag | EN: Fault code LAVK1_IP_OPENLOAD - debounce filter decrement after fault-memory entry" VALUE 0x70C77 TKW_VV_VV_UB 100.0 FORMULA_0003 0.0 255.0000 /end CHARACTERISTIC
/begin CHARACTERISTIC K_ED_LAVK2_IP_OPENLOAD.DEC_NACH_EINTRAG "Filterverringerung nach Fehlerspeichereintrag | EN: Fault code LAVK2_IP_OPENLOAD - debounce filter decrement after fault-memory entry" VALUE 0x70C91 TKW_VV_VV_UB 100.0 FORMULA_0003 0.0 255.0000 /end CHARACTERISTIC
/begin CHARACTERISTIC K_ED_LAVK1_OBD_DYN.DEC_NACH_EINTRAG "Filterverringerung nach Fehlerspeichereintrag | EN: Fault code LAVK1_OBD_DYN - debounce filter decrement after fault-memory entry" VALUE 0x70FD1 TKW_VV_VV_UB 100.0 FORMULA_0003 0.0 255.0000 /end CHARACTERISTIC
/begin CHARACTERISTIC K_ED_LAVK2_OBD_DYN.DEC_NACH_EINTRAG "Filterverringerung nach Fehlerspeichereintrag | EN: Fault code LAVK2_OBD_DYN - debounce filter decrement after fault-memory entry" VALUE 0x70FEB TKW_VV_VV_UB 100.0 FORMULA_0003 0.0 255.0000 /end CHARACTERISTIC
/begin CHARACTERISTIC K_ED_PT_CRASH.DEC_NACH_EINTRAG "Filterverringerung nach Fehlerspeichereintrag | EN: Fault code PT_CRASH - debounce filter decrement after fault-memory entry" VALUE 0x71005 TKW_VV_VV_UB 100.0 FORMULA_0003 0.0 255.0000 /end CHARACTERISTIC
/begin CHARACTERISTIC K_ED_PT_BEDFGR.DEC_NACH_EINTRAG "Filterverringerung nach Fehlerspeichereintrag | EN: Fault code PT_BEDFGR - debounce filter decrement after fault-memory entry" VALUE 0x71039 TKW_VV_VV_UB 100.0 FORMULA_0003 0.0 255.0000 /end CHARACTERISTIC
/begin CHARACTERISTIC K_ED_LAVK1_TRIM.DEC_NACH_EINTRAG "Filterverringerung nach Fehlerspeichereintrag | EN: Fault code LAVK1_TRIM - debounce filter decrement after fault-memory entry" VALUE 0x710EF TKW_VV_VV_UB 100.0 FORMULA_0003 0.0 255.0000 /end CHARACTERISTIC
/begin CHARACTERISTIC K_ED_LAVK2_TRIM.DEC_NACH_EINTRAG "Filterverringerung nach Fehlerspeichereintrag | EN: Fault code LAVK2_TRIM - debounce filter decrement after fault-memory entry" VALUE 0x71109 TKW_VV_VV_UB 100.0 FORMULA_0003 0.0 255.0000 /end CHARACTERISTIC
/begin CHARACTERISTIC K_ED_PT_KM.DEC_NACH_EINTRAG "Filterverringerung nach Fehlerspeichereintrag | EN: Fault code PT_KM - debounce filter decrement after fault-memory entry" VALUE 0x711BF TKW_VV_VV_UB 100.0 FORMULA_0003 0.0 255.0000 /end CHARACTERISTIC
/begin CHARACTERISTIC K_ED_PT_KOMBI.DEC_NACH_EINTRAG "Filterverringerung nach Fehlerspeichereintrag | EN: Fault code PT_KOMBI - debounce filter decrement after fault-memory entry" VALUE 0x711D9 TKW_VV_VV_UB 100.0 FORMULA_0003 0.0 255.0000 /end CHARACTERISTIC
/begin CHARACTERISTIC K_ED_PKS_LL.DEC_NACH_EINTRAG "Filterverringerung nach Fehlerspeichereintrag | EN: Fault code PKS_LL - debounce filter decrement after fault-memory entry" VALUE 0x711F3 TKW_VV_VV_UB 100.0 FORMULA_0003 0.0 255.0000 /end CHARACTERISTIC
/begin CHARACTERISTIC K_ED_PKS_TL.DEC_NACH_EINTRAG "Filterverringerung nach Fehlerspeichereintrag | EN: Fault code PKS_TL - debounce filter decrement after fault-memory entry" VALUE 0x7120D TKW_VV_VV_UB 100.0 FORMULA_0003 0.0 255.0000 /end CHARACTERISTIC
/begin CHARACTERISTIC K_ED_PKS_Q.DEC_NACH_EINTRAG "Filterverringerung nach Fehlerspeichereintrag | EN: Fault code PKS_Q - debounce filter decrement after fault-memory entry" VALUE 0x71227 TKW_VV_VV_UB 100.0 FORMULA_0003 0.0 255.0000 /end CHARACTERISTIC
/begin CHARACTERISTIC K_ED_MVAC_DRUCKSENSOR.DEC_NACH_EINTRAG "Filterverringerung nach Fehlerspeichereintrag | EN: Fault code MVAC_DRUCKSENSOR - debounce filter decrement after fault-memory entry" VALUE 0x7135F TKW_VV_VV_UB 100.0 FORMULA_0003 0.0 255.0000 /end CHARACTERISTIC
/begin CHARACTERISTIC K_ED_PT_BEDAT.DEC_NACH_EINTRAG "Filterverringerung nach Fehlerspeichereintrag | EN: Fault code PT_BEDAT - debounce filter decrement after fault-memory entry" VALUE 0x71379 TKW_VV_VV_UB 100.0 FORMULA_0003 0.0 255.0000 /end CHARACTERISTIC
/begin CHARACTERISTIC K_ED_PT_ANFRADMOM.DEC_NACH_EINTRAG "Filterverringerung nach Fehlerspeichereintrag | EN: Fault code PT_ANFRADMOM - debounce filter decrement after fault-memory entry" VALUE 0x717BD TKW_VV_VV_UB 100.0 FORMULA_0003 0.0 255.0000 /end CHARACTERISTIC
/begin CHARACTERISTIC K_ED_LSHNK1_R.DEC_NACH_EINTRAG "Filterverringerung nach Fehlerspeichereintrag | EN: Fault code LSHNK1_R - debounce filter decrement after fault-memory entry" VALUE 0x7190F TKW_VV_VV_UB 100.0 FORMULA_0003 0.0 255.0000 /end CHARACTERISTIC
/begin CHARACTERISTIC K_ED_LSHNK2_R.DEC_NACH_EINTRAG "Filterverringerung nach Fehlerspeichereintrag | EN: Fault code LSHNK2_R - debounce filter decrement after fault-memory entry" VALUE 0x71929 TKW_VV_VV_UB 100.0 FORMULA_0003 0.0 255.0000 /end CHARACTERISTIC
/begin CHARACTERISTIC K_ED_PKS_MODELL.DEC_NACH_EINTRAG "Filterverringerung nach Fehlerspeichereintrag | EN: Fault code PKS_MODELL - debounce filter decrement after fault-memory entry" VALUE 0x71943 TKW_VV_VV_UB 100.0 FORMULA_0003 0.0 255.0000 /end CHARACTERISTIC
/begin CHARACTERISTIC K_ED_PKS_PAUFBAU.DEC_NACH_EINTRAG "Filterverringerung nach Fehlerspeichereintrag | EN: Fault code PKS_PAUFBAU - debounce filter decrement after fault-memory entry" VALUE 0x7195D TKW_VV_VV_UB 100.0 FORMULA_0003 0.0 255.0000 /end CHARACTERISTIC
/begin CHARACTERISTIC K_ED_PKS_ADAPT_ANSCHL.DEC_NACH_EINTRAG "Filterverringerung nach Fehlerspeichereintrag | EN: Fault code PKS_ADAPT_ANSCHL - debounce filter decrement after fault-memory entry" VALUE 0x71977 TKW_VV_VV_UB 100.0 FORMULA_0003 0.0 255.0000 /end CHARACTERISTIC
/begin CHARACTERISTIC K_ED_LAVK_ATIC42.DEC_NACH_EINTRAG "Filterverringerung nach Fehlerspeichereintrag | EN: Fault code LAVK_ATIC42 - debounce filter decrement after fault-memory entry" VALUE 0x719AB TKW_VV_VV_UB 100.0 FORMULA_0003 0.0 255.0000 /end CHARACTERISTIC
/begin CHARACTERISTIC K_ED_PT_AX.DEC_NACH_EINTRAG "Filterverringerung nach Fehlerspeichereintrag | EN: Fault code PT_AX - debounce filter decrement after fault-memory entry" VALUE 0x719C5 TKW_VV_VV_UB 100.0 FORMULA_0003 0.0 255.0000 /end CHARACTERISTIC
/begin CHARACTERISTIC K_ED_MVAC_OBD.DEC_NACH_EINTRAG "Filterverringerung nach Fehlerspeichereintrag" VALUE 0x71A61 TKW_VV_VV_UB 100.0 FORMULA_0003 0.0 255.0000 /end CHARACTERISTIC
/begin CHARACTERISTIC K_ED_LAVK2_ATIC42.DEC_NACH_EINTRAG "Filterverringerung nach Fehlerspeichereintrag" VALUE 0x71A95 TKW_VV_VV_UB 100.0 FORMULA_0003 0.0 255.0000 /end CHARACTERISTIC
/begin CHARACTERISTIC K_ED_NW1_SYNC.KLASSENINDEX "Auswahl der Fehlerklasse" VALUE 0x70764 TKW_VV_VV_UB 100.0 FORMULA_0003 0.0 8.0000 /end CHARACTERISTIC
/begin CHARACTERISTIC K_ED_NW2_SYNC.KLASSENINDEX "Auswahl der Fehlerklasse" VALUE 0x7077E TKW_VV_VV_UB 100.0 FORMULA_0003 0.0 8.0000 /end CHARACTERISTIC
/begin CHARACTERISTIC K_ED_PCTRL_INJ.KLASSENINDEX "Auswahl der Fehlerklasse | EN: Fault code PCTRL_INJ - fault class selection (lamp / warning behaviour) [V912: differs from V452 160E]" VALUE 0x70798 TKW_VV_VV_UB 100.0 FORMULA_0003 0.0 8.0000 /end CHARACTERISTIC
/begin CHARACTERISTIC K_ED_PKS.KLASSENINDEX "Auswahl der Fehlerklasse | EN: Fault code PKS - fault class selection (lamp / warning behaviour)" VALUE 0x707CC TKW_VV_VV_UB 100.0 FORMULA_0003 0.0 8.0000 /end CHARACTERISTIC
/begin CHARACTERISTIC K_ED_LAVK2.KLASSENINDEX "Auswahl der Fehlerklasse | EN: Fault code LAVK2 - fault class selection (lamp / warning behaviour)" VALUE 0x7081A TKW_VV_VV_UB 100.0 FORMULA_0003 0.0 8.0000 /end CHARACTERISTIC
/begin CHARACTERISTIC K_ED_LAVK1_OBD_PLAU.KLASSENINDEX "Auswahl der Fehlerklasse | EN: Fault code LAVK1_OBD_PLAU - fault class selection (lamp / warning behaviour)" VALUE 0x70834 TKW_VV_VV_UB 100.0 FORMULA_0003 0.0 8.0000 /end CHARACTERISTIC
/begin CHARACTERISTIC K_ED_LAVK2_OBD_PLAU.KLASSENINDEX "Auswahl der Fehlerklasse | EN: Fault code LAVK2_OBD_PLAU - fault class selection (lamp / warning behaviour)" VALUE 0x7084E TKW_VV_VV_UB 100.0 FORMULA_0003 0.0 8.0000 /end CHARACTERISTIC
/begin CHARACTERISTIC K_ED_LAVK1_OBD_SA.KLASSENINDEX "Auswahl der Fehlerklasse | EN: Fault code LAVK1_OBD_SA - fault class selection (lamp / warning behaviour)" VALUE 0x70868 TKW_VV_VV_UB 100.0 FORMULA_0003 0.0 8.0000 /end CHARACTERISTIC
/begin CHARACTERISTIC K_ED_LAVK2_OBD_SA.KLASSENINDEX "Auswahl der Fehlerklasse | EN: Fault code LAVK2_OBD_SA - fault class selection (lamp / warning behaviour)" VALUE 0x70882 TKW_VV_VV_UB 100.0 FORMULA_0003 0.0 8.0000 /end CHARACTERISTIC
/begin CHARACTERISTIC K_ED_LSHNK1.KLASSENINDEX "Auswahl der Fehlerklasse | EN: Fault code LSHNK1 - fault class selection (lamp / warning behaviour)" VALUE 0x708D0 TKW_VV_VV_UB 100.0 FORMULA_0003 0.0 8.0000 /end CHARACTERISTIC
/begin CHARACTERISTIC K_ED_LSHNK2.KLASSENINDEX "Auswahl der Fehlerklasse | EN: Fault code LSHNK2 - fault class selection (lamp / warning behaviour)" VALUE 0x708EA TKW_VV_VV_UB 100.0 FORMULA_0003 0.0 8.0000 /end CHARACTERISTIC
/begin CHARACTERISTIC K_ED_PT_BUSOFF.KLASSENINDEX "Auswahl der Fehlerklasse | EN: Fault code PT_BUSOFF - fault class selection (lamp / warning behaviour)" VALUE 0x70904 TKW_VV_VV_UB 100.0 FORMULA_0003 0.0 8.0000 /end CHARACTERISTIC
/begin CHARACTERISTIC K_ED_PT_ATEMP.KLASSENINDEX "Auswahl der Fehlerklasse | EN: Fault code PT_ATEMP - fault class selection (lamp / warning behaviour) [V912: differs from V452 160E]" VALUE 0x70986 TKW_VV_VV_UB 100.0 FORMULA_0003 0.0 8.0000 /end CHARACTERISTIC
/begin CHARACTERISTIC K_ED_PT_KLST.KLASSENINDEX "Auswahl der Fehlerklasse | EN: Fault code PT_KLST - fault class selection (lamp / warning behaviour)" VALUE 0x709A0 TKW_VV_VV_UB 100.0 FORMULA_0003 0.0 8.0000 /end CHARACTERISTIC
/begin CHARACTERISTIC K_ED_PT_KKOS.KLASSENINDEX "Auswahl der Fehlerklasse | EN: Fault code PT_KKOS - fault class selection (lamp / warning behaviour)" VALUE 0x709BA TKW_VV_VV_UB 100.0 FORMULA_0003 0.0 8.0000 /end CHARACTERISTIC
/begin CHARACTERISTIC K_ED_LAVK1_OBD_TL.KLASSENINDEX "Auswahl der Fehlerklasse | EN: Fault code LAVK1_OBD_TL - fault class selection (lamp / warning behaviour)" VALUE 0x70A70 TKW_VV_VV_UB 100.0 FORMULA_0003 0.0 8.0000 /end CHARACTERISTIC
/begin CHARACTERISTIC K_ED_LAVK2_OBD_TL.KLASSENINDEX "Auswahl der Fehlerklasse | EN: Fault code LAVK2_OBD_TL - fault class selection (lamp / warning behaviour)" VALUE 0x70A8A TKW_VV_VV_UB 100.0 FORMULA_0003 0.0 8.0000 /end CHARACTERISTIC
/begin CHARACTERISTIC K_ED_LSHVK1.KLASSENINDEX "Auswahl der Fehlerklasse | EN: Fault code LSHVK1 - fault class selection (lamp / warning behaviour)" VALUE 0x70AA4 TKW_VV_VV_UB 100.0 FORMULA_0003 0.0 8.0000 /end CHARACTERISTIC
/begin CHARACTERISTIC K_ED_LSHVK2.KLASSENINDEX "Auswahl der Fehlerklasse | EN: Fault code LSHVK2 - fault class selection (lamp / warning behaviour)" VALUE 0x70ABE TKW_VV_VV_UB 100.0 FORMULA_0003 0.0 8.0000 /end CHARACTERISTIC
/begin CHARACTERISTIC K_ED_LSRVK1_OBD_REG.KLASSENINDEX "Auswahl der Fehlerklasse | EN: Fault code LSRVK1_OBD_REG - fault class selection (lamp / warning behaviour)" VALUE 0x70AD8 TKW_VV_VV_UB 100.0 FORMULA_0003 0.0 8.0000 /end CHARACTERISTIC
/begin CHARACTERISTIC K_ED_LSRVK2_OBD_REG.KLASSENINDEX "Auswahl der Fehlerklasse | EN: Fault code LSRVK2_OBD_REG - fault class selection (lamp / warning behaviour)" VALUE 0x70AF2 TKW_VV_VV_UB 100.0 FORMULA_0003 0.0 8.0000 /end CHARACTERISTIC
/begin CHARACTERISTIC K_ED_LSHVK1_R.KLASSENINDEX "Auswahl der Fehlerklasse | EN: Fault code LSHVK1_R - fault class selection (lamp / warning behaviour)" VALUE 0x70B0C TKW_VV_VV_UB 100.0 FORMULA_0003 0.0 8.0000 /end CHARACTERISTIC
/begin CHARACTERISTIC K_ED_LSHVK2_R.KLASSENINDEX "Auswahl der Fehlerklasse | EN: Fault code LSHVK2_R - fault class selection (lamp / warning behaviour)" VALUE 0x70B26 TKW_VV_VV_UB 100.0 FORMULA_0003 0.0 8.0000 /end CHARACTERISTIC
/begin CHARACTERISTIC K_ED_LSRVK1_OBD_START.KLASSENINDEX "Auswahl der Fehlerklasse | EN: Fault code LSRVK1_OBD_START - fault class selection (lamp / warning behaviour)" VALUE 0x70B40 TKW_VV_VV_UB 100.0 FORMULA_0003 0.0 8.0000 /end CHARACTERISTIC
/begin CHARACTERISTIC K_ED_LSRVK2_OBD_START.KLASSENINDEX "Auswahl der Fehlerklasse | EN: Fault code LSRVK2_OBD_START - fault class selection (lamp / warning behaviour)" VALUE 0x70B5A TKW_VV_VV_UB 100.0 FORMULA_0003 0.0 8.0000 /end CHARACTERISTIC
/begin CHARACTERISTIC K_ED_LSRVK1_OBD_REF.KLASSENINDEX "Auswahl der Fehlerklasse | EN: Fault code LSRVK1_OBD_REF - fault class selection (lamp / warning behaviour)" VALUE 0x70B74 TKW_VV_VV_UB 100.0 FORMULA_0003 0.0 8.0000 /end CHARACTERISTIC
/begin CHARACTERISTIC K_ED_LSRVK2_OBD_REF.KLASSENINDEX "Auswahl der Fehlerklasse | EN: Fault code LSRVK2_OBD_REF - fault class selection (lamp / warning behaviour)" VALUE 0x70B8E TKW_VV_VV_UB 100.0 FORMULA_0003 0.0 8.0000 /end CHARACTERISTIC
/begin CHARACTERISTIC K_ED_LAVK2_DIAG.KLASSENINDEX "Auswahl der Fehlerklasse | EN: Fault code LAVK2_DIAG - fault class selection (lamp / warning behaviour)" VALUE 0x70BC2 TKW_VV_VV_UB 100.0 FORMULA_0003 0.0 8.0000 /end CHARACTERISTIC
/begin CHARACTERISTIC K_ED_LAVK1_IA_OPENLOAD.KLASSENINDEX "Auswahl der Fehlerklasse | EN: Fault code LAVK1_IA_OPENLOAD - fault class selection (lamp / warning behaviour)" VALUE 0x70BDC TKW_VV_VV_UB 100.0 FORMULA_0003 0.0 8.0000 /end CHARACTERISTIC
/begin CHARACTERISTIC K_ED_LAVK2_IA_OPENLOAD.KLASSENINDEX "Auswahl der Fehlerklasse | EN: Fault code LAVK2_IA_OPENLOAD - fault class selection (lamp / warning behaviour)" VALUE 0x70BF6 TKW_VV_VV_UB 100.0 FORMULA_0003 0.0 8.0000 /end CHARACTERISTIC
/begin CHARACTERISTIC K_ED_PT_GRB.KLASSENINDEX "Auswahl der Fehlerklasse | EN: Fault code PT_GRB - fault class selection (lamp / warning behaviour)" VALUE 0x70C10 TKW_VV_VV_UB 100.0 FORMULA_0003 0.0 8.0000 /end CHARACTERISTIC
/begin CHARACTERISTIC K_ED_PT_GRB2.KLASSENINDEX "Auswahl der Fehlerklasse | EN: Fault code PT_GRB2 - fault class selection (lamp / warning behaviour)" VALUE 0x70C2A TKW_VV_VV_UB 100.0 FORMULA_0003 0.0 8.0000 /end CHARACTERISTIC
/begin CHARACTERISTIC K_ED_LAVK1_UN_OPENLOAD.KLASSENINDEX "Auswahl der Fehlerklasse | EN: Fault code LAVK1_UN_OPENLOAD - fault class selection (lamp / warning behaviour)" VALUE 0x70C44 TKW_VV_VV_UB 100.0 FORMULA_0003 0.0 8.0000 /end CHARACTERISTIC
/begin CHARACTERISTIC K_ED_LAVK2_UN_OPENLOAD.KLASSENINDEX "Auswahl der Fehlerklasse | EN: Fault code LAVK2_UN_OPENLOAD - fault class selection (lamp / warning behaviour)" VALUE 0x70C5E TKW_VV_VV_UB 100.0 FORMULA_0003 0.0 8.0000 /end CHARACTERISTIC
/begin CHARACTERISTIC K_ED_LAVK1_IP_OPENLOAD.KLASSENINDEX "Auswahl der Fehlerklasse | EN: Fault code LAVK1_IP_OPENLOAD - fault class selection (lamp / warning behaviour)" VALUE 0x70C78 TKW_VV_VV_UB 100.0 FORMULA_0003 0.0 8.0000 /end CHARACTERISTIC
/begin CHARACTERISTIC K_ED_LAVK2_IP_OPENLOAD.KLASSENINDEX "Auswahl der Fehlerklasse | EN: Fault code LAVK2_IP_OPENLOAD - fault class selection (lamp / warning behaviour)" VALUE 0x70C92 TKW_VV_VV_UB 100.0 FORMULA_0003 0.0 8.0000 /end CHARACTERISTIC
/begin CHARACTERISTIC K_ED_LAVK1_OBD_DYN.KLASSENINDEX "Auswahl der Fehlerklasse | EN: Fault code LAVK1_OBD_DYN - fault class selection (lamp / warning behaviour)" VALUE 0x70FD2 TKW_VV_VV_UB 100.0 FORMULA_0003 0.0 8.0000 /end CHARACTERISTIC
/begin CHARACTERISTIC K_ED_LAVK2_OBD_DYN.KLASSENINDEX "Auswahl der Fehlerklasse | EN: Fault code LAVK2_OBD_DYN - fault class selection (lamp / warning behaviour)" VALUE 0x70FEC TKW_VV_VV_UB 100.0 FORMULA_0003 0.0 8.0000 /end CHARACTERISTIC
/begin CHARACTERISTIC K_ED_PT_CRASH.KLASSENINDEX "Auswahl der Fehlerklasse | EN: Fault code PT_CRASH - fault class selection (lamp / warning behaviour)" VALUE 0x71006 TKW_VV_VV_UB 100.0 FORMULA_0003 0.0 8.0000 /end CHARACTERISTIC
/begin CHARACTERISTIC K_ED_PT_BEDFGR.KLASSENINDEX "Auswahl der Fehlerklasse | EN: Fault code PT_BEDFGR - fault class selection (lamp / warning behaviour)" VALUE 0x7103A TKW_VV_VV_UB 100.0 FORMULA_0003 0.0 8.0000 /end CHARACTERISTIC
/begin CHARACTERISTIC K_ED_LAVK1_TRIM.KLASSENINDEX "Auswahl der Fehlerklasse | EN: Fault code LAVK1_TRIM - fault class selection (lamp / warning behaviour)" VALUE 0x710F0 TKW_VV_VV_UB 100.0 FORMULA_0003 0.0 8.0000 /end CHARACTERISTIC
/begin CHARACTERISTIC K_ED_LAVK2_TRIM.KLASSENINDEX "Auswahl der Fehlerklasse | EN: Fault code LAVK2_TRIM - fault class selection (lamp / warning behaviour)" VALUE 0x7110A TKW_VV_VV_UB 100.0 FORMULA_0003 0.0 8.0000 /end CHARACTERISTIC
/begin CHARACTERISTIC K_ED_PT_KM.KLASSENINDEX "Auswahl der Fehlerklasse | EN: Fault code PT_KM - fault class selection (lamp / warning behaviour)" VALUE 0x711C0 TKW_VV_VV_UB 100.0 FORMULA_0003 0.0 8.0000 /end CHARACTERISTIC
/begin CHARACTERISTIC K_ED_PT_KOMBI.KLASSENINDEX "Auswahl der Fehlerklasse | EN: Fault code PT_KOMBI - fault class selection (lamp / warning behaviour) [V912: differs from V452 160E]" VALUE 0x711DA TKW_VV_VV_UB 100.0 FORMULA_0003 0.0 8.0000 /end CHARACTERISTIC
/begin CHARACTERISTIC K_ED_PKS_LL.KLASSENINDEX "Auswahl der Fehlerklasse | EN: Fault code PKS_LL - fault class selection (lamp / warning behaviour) [V912: differs from V452 160E]" VALUE 0x711F4 TKW_VV_VV_UB 100.0 FORMULA_0003 0.0 8.0000 /end CHARACTERISTIC
/begin CHARACTERISTIC K_ED_PKS_TL.KLASSENINDEX "Auswahl der Fehlerklasse | EN: Fault code PKS_TL - fault class selection (lamp / warning behaviour) [V912: differs from V452 160E]" VALUE 0x7120E TKW_VV_VV_UB 100.0 FORMULA_0003 0.0 8.0000 /end CHARACTERISTIC
/begin CHARACTERISTIC K_ED_PKS_Q.KLASSENINDEX "Auswahl der Fehlerklasse | EN: Fault code PKS_Q - fault class selection (lamp / warning behaviour) [V912: differs from V452 160E]" VALUE 0x71228 TKW_VV_VV_UB 100.0 FORMULA_0003 0.0 8.0000 /end CHARACTERISTIC
/begin CHARACTERISTIC K_ED_MVAC_DRUCKSENSOR.KLASSENINDEX "Auswahl der Fehlerklasse | EN: Fault code MVAC_DRUCKSENSOR - fault class selection (lamp / warning behaviour) [V912: differs from V452 160E]" VALUE 0x71360 TKW_VV_VV_UB 100.0 FORMULA_0003 0.0 8.0000 /end CHARACTERISTIC
/begin CHARACTERISTIC K_ED_PT_BEDAT.KLASSENINDEX "Auswahl der Fehlerklasse | EN: Fault code PT_BEDAT - fault class selection (lamp / warning behaviour)" VALUE 0x7137A TKW_VV_VV_UB 100.0 FORMULA_0003 0.0 8.0000 /end CHARACTERISTIC
/begin CHARACTERISTIC K_ED_PT_ANFRADMOM.KLASSENINDEX "Auswahl der Fehlerklasse | EN: Fault code PT_ANFRADMOM - fault class selection (lamp / warning behaviour)" VALUE 0x717BE TKW_VV_VV_UB 100.0 FORMULA_0003 0.0 8.0000 /end CHARACTERISTIC
/begin CHARACTERISTIC K_ED_LSHNK1_R.KLASSENINDEX "Auswahl der Fehlerklasse | EN: Fault code LSHNK1_R - fault class selection (lamp / warning behaviour)" VALUE 0x71910 TKW_VV_VV_UB 100.0 FORMULA_0003 0.0 8.0000 /end CHARACTERISTIC
/begin CHARACTERISTIC K_ED_LSHNK2_R.KLASSENINDEX "Auswahl der Fehlerklasse | EN: Fault code LSHNK2_R - fault class selection (lamp / warning behaviour)" VALUE 0x7192A TKW_VV_VV_UB 100.0 FORMULA_0003 0.0 8.0000 /end CHARACTERISTIC
/begin CHARACTERISTIC K_ED_PKS_MODELL.KLASSENINDEX "Auswahl der Fehlerklasse | EN: Fault code PKS_MODELL - fault class selection (lamp / warning behaviour) [V912: differs from V452 160E]" VALUE 0x71944 TKW_VV_VV_UB 100.0 FORMULA_0003 0.0 8.0000 /end CHARACTERISTIC
/begin CHARACTERISTIC K_ED_PKS_PAUFBAU.KLASSENINDEX "Auswahl der Fehlerklasse | EN: Fault code PKS_PAUFBAU - fault class selection (lamp / warning behaviour)" VALUE 0x7195E TKW_VV_VV_UB 100.0 FORMULA_0003 0.0 8.0000 /end CHARACTERISTIC
/begin CHARACTERISTIC K_ED_PKS_ADAPT_ANSCHL.KLASSENINDEX "Auswahl der Fehlerklasse | EN: Fault code PKS_ADAPT_ANSCHL - fault class selection (lamp / warning behaviour)" VALUE 0x71978 TKW_VV_VV_UB 100.0 FORMULA_0003 0.0 8.0000 /end CHARACTERISTIC
/begin CHARACTERISTIC K_ED_LAVK_ATIC42.KLASSENINDEX "Auswahl der Fehlerklasse | EN: Fault code LAVK_ATIC42 - fault class selection (lamp / warning behaviour)" VALUE 0x719AC TKW_VV_VV_UB 100.0 FORMULA_0003 0.0 8.0000 /end CHARACTERISTIC
/begin CHARACTERISTIC K_ED_PT_AX.KLASSENINDEX "Auswahl der Fehlerklasse | EN: Fault code PT_AX - fault class selection (lamp / warning behaviour)" VALUE 0x719C6 TKW_VV_VV_UB 100.0 FORMULA_0003 0.0 8.0000 /end CHARACTERISTIC
/begin CHARACTERISTIC K_ED_MVAC_OBD.KLASSENINDEX "Auswahl der Fehlerklasse [V912: differs from V452 160E]" VALUE 0x71A62 TKW_VV_VV_UB 100.0 FORMULA_0003 0.0 8.0000 /end CHARACTERISTIC
/begin CHARACTERISTIC K_ED_LAVK2_ATIC42.KLASSENINDEX "Auswahl der Fehlerklasse" VALUE 0x71A96 TKW_VV_VV_UB 100.0 FORMULA_0003 0.0 8.0000 /end CHARACTERISTIC
/begin CHARACTERISTIC K_ED_MIL_MASKE "Auswahl wer Mil ansteuert | EN: Auswahl wer Mil ansteuert [V912: differs from V452 160E]" VALUE 0x71CA8 TKW_VV_VV_UB 100.0 FORMULA_0668 0.0 255.0 /end CHARACTERISTIC
/begin FUNCTION Eigendiagnose ""
 /begin DEF_CHARACTERISTIC K_ED_LAVK1_IA_OPENLOAD.DEC_NACH_EINTRAG K_ED_LAVK1_IA_OPENLOAD.DEC_VOR_EINTRAG K_ED_LAVK1_IA_OPENLOAD.FEHLERSCHWELLE K_ED_LAVK1_IA_OPENLOAD.INC_NACH_EINTRAG K_ED_LAVK1_IA_OPENLOAD.INC_VOR_EINTRAG K_ED_LAVK1_IA_OPENLOAD.KLASSENINDEX K_ED_LAVK1_IA_OPENLOAD.OK_SCHWELLE K_ED_LAVK1_IA_OPENLOAD.P_CODE_OPENLOAD K_ED_LAVK1_IA_OPENLOAD.P_CODE_SH_TO_GND K_ED_LAVK1_IA_OPENLOAD.P_CODE_SH_TO_UB K_ED_LAVK1_IA_OPENLOAD.P_CODE_UNPLAUSIBEL K_ED_LAVK1_IP_OPENLOAD.DEC_NACH_EINTRAG K_ED_LAVK1_IP_OPENLOAD.DEC_VOR_EINTRAG K_ED_LAVK1_IP_OPENLOAD.FEHLERSCHWELLE K_ED_LAVK1_IP_OPENLOAD.INC_NACH_EINTRAG K_ED_LAVK1_IP_OPENLOAD.INC_VOR_EINTRAG K_ED_LAVK1_IP_OPENLOAD.KLASSENINDEX K_ED_LAVK1_IP_OPENLOAD.OK_SCHWELLE K_ED_LAVK1_IP_OPENLOAD.P_CODE_OPENLOAD K_ED_LAVK1_IP_OPENLOAD.P_CODE_SH_TO_GND K_ED_LAVK1_IP_OPENLOAD.P_CODE_SH_TO_UB K_ED_LAVK1_IP_OPENLOAD.P_CODE_UNPLAUSIBEL K_ED_LAVK1_OBD_DYN.DEC_NACH_EINTRAG K_ED_LAVK1_OBD_DYN.DEC_VOR_EINTRAG K_ED_LAVK1_OBD_DYN.FEHLERSCHWELLE K_ED_LAVK1_OBD_DYN.INC_NACH_EINTRAG K_ED_LAVK1_OBD_DYN.INC_VOR_EINTRAG K_ED_LAVK1_OBD_DYN.KLASSENINDEX K_ED_LAVK1_OBD_DYN.OK_SCHWELLE K_ED_LAVK1_OBD_DYN.P_CODE_OPENLOAD K_ED_LAVK1_OBD_DYN.P_CODE_SH_TO_GND K_ED_LAVK1_OBD_DYN.P_CODE_SH_TO_UB K_ED_LAVK1_OBD_DYN.P_CODE_UNPLAUSIBEL K_ED_LAVK1_OBD_PLAU.DEC_NACH_EINTRAG K_ED_LAVK1_OBD_PLAU.DEC_VOR_EINTRAG K_ED_LAVK1_OBD_PLAU.FEHLERSCHWELLE K_ED_LAVK1_OBD_PLAU.INC_NACH_EINTRAG K_ED_LAVK1_OBD_PLAU.INC_VOR_EINTRAG K_ED_LAVK1_OBD_PLAU.KLASSENINDEX K_ED_LAVK1_OBD_PLAU.OK_SCHWELLE K_ED_LAVK1_OBD_PLAU.P_CODE_OPENLOAD K_ED_LAVK1_OBD_PLAU.P_CODE_SH_TO_GND K_ED_LAVK1_OBD_PLAU.P_CODE_SH_TO_UB K_ED_LAVK1_OBD_PLAU.P_CODE_UNPLAUSIBEL K_ED_LAVK1_OBD_SA.DEC_NACH_EINTRAG K_ED_LAVK1_OBD_SA.DEC_VOR_EINTRAG K_ED_LAVK1_OBD_SA.FEHLERSCHWELLE K_ED_LAVK1_OBD_SA.INC_NACH_EINTRAG K_ED_LAVK1_OBD_SA.INC_VOR_EINTRAG K_ED_LAVK1_OBD_SA.KLASSENINDEX K_ED_LAVK1_OBD_SA.OK_SCHWELLE K_ED_LAVK1_OBD_SA.P_CODE_OPENLOAD K_ED_LAVK1_OBD_SA.P_CODE_SH_TO_GND K_ED_LAVK1_OBD_SA.P_CODE_SH_TO_UB K_ED_LAVK1_OBD_SA.P_CODE_UNPLAUSIBEL K_ED_LAVK1_OBD_TL.DEC_NACH_EINTRAG K_ED_LAVK1_OBD_TL.DEC_VOR_EINTRAG K_ED_LAVK1_OBD_TL.FEHLERSCHWELLE K_ED_LAVK1_OBD_TL.INC_NACH_EINTRAG K_ED_LAVK1_OBD_TL.INC_VOR_EINTRAG K_ED_LAVK1_OBD_TL.KLASSENINDEX K_ED_LAVK1_OBD_TL.OK_SCHWELLE K_ED_LAVK1_OBD_TL.P_CODE_OPENLOAD K_ED_LAVK1_OBD_TL.P_CODE_SH_TO_GND K_ED_LAVK1_OBD_TL.P_CODE_SH_TO_UB K_ED_LAVK1_OBD_TL.P_CODE_UNPLAUSIBEL K_ED_LAVK1_TRIM.DEC_NACH_EINTRAG K_ED_LAVK1_TRIM.DEC_VOR_EINTRAG K_ED_LAVK1_TRIM.FEHLERSCHWELLE K_ED_LAVK1_TRIM.INC_NACH_EINTRAG K_ED_LAVK1_TRIM.INC_VOR_EINTRAG K_ED_LAVK1_TRIM.KLASSENINDEX K_ED_LAVK1_TRIM.OK_SCHWELLE K_ED_LAVK1_TRIM.P_CODE_OPENLOAD K_ED_LAVK1_TRIM.P_CODE_SH_TO_GND K_ED_LAVK1_TRIM.P_CODE_SH_TO_UB K_ED_LAVK1_TRIM.P_CODE_UNPLAUSIBEL K_ED_LAVK1_UN_OPENLOAD.DEC_NACH_EINTRAG K_ED_LAVK1_UN_OPENLOAD.DEC_VOR_EINTRAG K_ED_LAVK1_UN_OPENLOAD.FEHLERSCHWELLE K_ED_LAVK1_UN_OPENLOAD.INC_NACH_EINTRAG K_ED_LAVK1_UN_OPENLOAD.INC_VOR_EINTRAG K_ED_LAVK1_UN_OPENLOAD.KLASSENINDEX K_ED_LAVK1_UN_OPENLOAD.OK_SCHWELLE K_ED_LAVK1_UN_OPENLOAD.P_CODE_OPENLOAD K_ED_LAVK1_UN_OPENLOAD.P_CODE_SH_TO_GND K_ED_LAVK1_UN_OPENLOAD.P_CODE_SH_TO_UB K_ED_LAVK1_UN_OPENLOAD.P_CODE_UNPLAUSIBEL K_ED_LAVK2.DEC_NACH_EINTRAG K_ED_LAVK2.DEC_VOR_EINTRAG K_ED_LAVK2.FEHLERSCHWELLE K_ED_LAVK2.INC_NACH_EINTRAG K_ED_LAVK2.INC_VOR_EINTRAG K_ED_LAVK2.KLASSENINDEX K_ED_LAVK2.OK_SCHWELLE K_ED_LAVK2.P_CODE_OPENLOAD K_ED_LAVK2.P_CODE_SH_TO_GND K_ED_LAVK2.P_CODE_SH_TO_UB K_ED_LAVK2.P_CODE_UNPLAUSIBEL K_ED_LAVK2_ATIC42.DEC_NACH_EINTRAG K_ED_LAVK2_ATIC42.DEC_VOR_EINTRAG K_ED_LAVK2_ATIC42.FEHLERSCHWELLE K_ED_LAVK2_ATIC42.INC_NACH_EINTRAG K_ED_LAVK2_ATIC42.INC_VOR_EINTRAG K_ED_LAVK2_ATIC42.KLASSENINDEX K_ED_LAVK2_ATIC42.OK_SCHWELLE K_ED_LAVK2_ATIC42.P_CODE_OPENLOAD K_ED_LAVK2_ATIC42.P_CODE_SH_TO_GND K_ED_LAVK2_ATIC42.P_CODE_SH_TO_UB K_ED_LAVK2_ATIC42.P_CODE_UNPLAUSIBEL K_ED_LAVK2_DIAG.DEC_NACH_EINTRAG K_ED_LAVK2_DIAG.DEC_VOR_EINTRAG K_ED_LAVK2_DIAG.FEHLERSCHWELLE K_ED_LAVK2_DIAG.INC_NACH_EINTRAG K_ED_LAVK2_DIAG.INC_VOR_EINTRAG K_ED_LAVK2_DIAG.KLASSENINDEX K_ED_LAVK2_DIAG.OK_SCHWELLE K_ED_LAVK2_DIAG.P_CODE_OPENLOAD K_ED_LAVK2_DIAG.P_CODE_SH_TO_GND K_ED_LAVK2_DIAG.P_CODE_SH_TO_UB K_ED_LAVK2_DIAG.P_CODE_UNPLAUSIBEL K_ED_LAVK2_IA_OPENLOAD.DEC_NACH_EINTRAG K_ED_LAVK2_IA_OPENLOAD.DEC_VOR_EINTRAG K_ED_LAVK2_IA_OPENLOAD.FEHLERSCHWELLE K_ED_LAVK2_IA_OPENLOAD.INC_NACH_EINTRAG K_ED_LAVK2_IA_OPENLOAD.INC_VOR_EINTRAG K_ED_LAVK2_IA_OPENLOAD.KLASSENINDEX K_ED_LAVK2_IA_OPENLOAD.OK_SCHWELLE K_ED_LAVK2_IA_OPENLOAD.P_CODE_OPENLOAD K_ED_LAVK2_IA_OPENLOAD.P_CODE_SH_TO_GND K_ED_LAVK2_IA_OPENLOAD.P_CODE_SH_TO_UB K_ED_LAVK2_IA_OPENLOAD.P_CODE_UNPLAUSIBEL K_ED_LAVK2_IP_OPENLOAD.DEC_NACH_EINTRAG K_ED_LAVK2_IP_OPENLOAD.DEC_VOR_EINTRAG K_ED_LAVK2_IP_OPENLOAD.FEHLERSCHWELLE K_ED_LAVK2_IP_OPENLOAD.INC_NACH_EINTRAG K_ED_LAVK2_IP_OPENLOAD.INC_VOR_EINTRAG K_ED_LAVK2_IP_OPENLOAD.KLASSENINDEX K_ED_LAVK2_IP_OPENLOAD.OK_SCHWELLE K_ED_LAVK2_IP_OPENLOAD.P_CODE_OPENLOAD K_ED_LAVK2_IP_OPENLOAD.P_CODE_SH_TO_GND K_ED_LAVK2_IP_OPENLOAD.P_CODE_SH_TO_UB K_ED_LAVK2_IP_OPENLOAD.P_CODE_UNPLAUSIBEL K_ED_LAVK2_OBD_DYN.DEC_NACH_EINTRAG K_ED_LAVK2_OBD_DYN.DEC_VOR_EINTRAG K_ED_LAVK2_OBD_DYN.FEHLERSCHWELLE K_ED_LAVK2_OBD_DYN.INC_NACH_EINTRAG K_ED_LAVK2_OBD_DYN.INC_VOR_EINTRAG K_ED_LAVK2_OBD_DYN.KLASSENINDEX K_ED_LAVK2_OBD_DYN.OK_SCHWELLE K_ED_LAVK2_OBD_DYN.P_CODE_OPENLOAD K_ED_LAVK2_OBD_DYN.P_CODE_SH_TO_GND K_ED_LAVK2_OBD_DYN.P_CODE_SH_TO_UB K_ED_LAVK2_OBD_DYN.P_CODE_UNPLAUSIBEL K_ED_LAVK2_OBD_PLAU.DEC_NACH_EINTRAG K_ED_LAVK2_OBD_PLAU.DEC_VOR_EINTRAG K_ED_LAVK2_OBD_PLAU.FEHLERSCHWELLE K_ED_LAVK2_OBD_PLAU.INC_NACH_EINTRAG K_ED_LAVK2_OBD_PLAU.INC_VOR_EINTRAG K_ED_LAVK2_OBD_PLAU.KLASSENINDEX K_ED_LAVK2_OBD_PLAU.OK_SCHWELLE K_ED_LAVK2_OBD_PLAU.P_CODE_OPENLOAD K_ED_LAVK2_OBD_PLAU.P_CODE_SH_TO_GND K_ED_LAVK2_OBD_PLAU.P_CODE_SH_TO_UB K_ED_LAVK2_OBD_PLAU.P_CODE_UNPLAUSIBEL K_ED_LAVK2_OBD_SA.DEC_NACH_EINTRAG K_ED_LAVK2_OBD_SA.DEC_VOR_EINTRAG K_ED_LAVK2_OBD_SA.FEHLERSCHWELLE K_ED_LAVK2_OBD_SA.INC_NACH_EINTRAG K_ED_LAVK2_OBD_SA.INC_VOR_EINTRAG K_ED_LAVK2_OBD_SA.KLASSENINDEX K_ED_LAVK2_OBD_SA.OK_SCHWELLE K_ED_LAVK2_OBD_SA.P_CODE_OPENLOAD K_ED_LAVK2_OBD_SA.P_CODE_SH_TO_GND K_ED_LAVK2_OBD_SA.P_CODE_SH_TO_UB K_ED_LAVK2_OBD_SA.P_CODE_UNPLAUSIBEL K_ED_LAVK2_OBD_TL.DEC_NACH_EINTRAG K_ED_LAVK2_OBD_TL.DEC_VOR_EINTRAG K_ED_LAVK2_OBD_TL.FEHLERSCHWELLE K_ED_LAVK2_OBD_TL.INC_NACH_EINTRAG K_ED_LAVK2_OBD_TL.INC_VOR_EINTRAG K_ED_LAVK2_OBD_TL.KLASSENINDEX K_ED_LAVK2_OBD_TL.OK_SCHWELLE K_ED_LAVK2_OBD_TL.P_CODE_OPENLOAD K_ED_LAVK2_OBD_TL.P_CODE_SH_TO_GND K_ED_LAVK2_OBD_TL.P_CODE_SH_TO_UB K_ED_LAVK2_OBD_TL.P_CODE_UNPLAUSIBEL K_ED_LAVK2_TRIM.DEC_NACH_EINTRAG K_ED_LAVK2_TRIM.DEC_VOR_EINTRAG K_ED_LAVK2_TRIM.FEHLERSCHWELLE K_ED_LAVK2_TRIM.INC_NACH_EINTRAG K_ED_LAVK2_TRIM.INC_VOR_EINTRAG K_ED_LAVK2_TRIM.KLASSENINDEX K_ED_LAVK2_TRIM.OK_SCHWELLE K_ED_LAVK2_TRIM.P_CODE_OPENLOAD K_ED_LAVK2_TRIM.P_CODE_SH_TO_GND K_ED_LAVK2_TRIM.P_CODE_SH_TO_UB K_ED_LAVK2_TRIM.P_CODE_UNPLAUSIBEL K_ED_LAVK2_UN_OPENLOAD.DEC_NACH_EINTRAG K_ED_LAVK2_UN_OPENLOAD.DEC_VOR_EINTRAG K_ED_LAVK2_UN_OPENLOAD.FEHLERSCHWELLE K_ED_LAVK2_UN_OPENLOAD.INC_NACH_EINTRAG K_ED_LAVK2_UN_OPENLOAD.INC_VOR_EINTRAG K_ED_LAVK2_UN_OPENLOAD.KLASSENINDEX K_ED_LAVK2_UN_OPENLOAD.OK_SCHWELLE K_ED_LAVK2_UN_OPENLOAD.P_CODE_OPENLOAD K_ED_LAVK2_UN_OPENLOAD.P_CODE_SH_TO_GND K_ED_LAVK2_UN_OPENLOAD.P_CODE_SH_TO_UB K_ED_LAVK2_UN_OPENLOAD.P_CODE_UNPLAUSIBEL K_ED_LAVK_ATIC42.DEC_NACH_EINTRAG K_ED_LAVK_ATIC42.DEC_VOR_EINTRAG K_ED_LAVK_ATIC42.FEHLERSCHWELLE K_ED_LAVK_ATIC42.INC_NACH_EINTRAG K_ED_LAVK_ATIC42.INC_VOR_EINTRAG K_ED_LAVK_ATIC42.KLASSENINDEX K_ED_LAVK_ATIC42.OK_SCHWELLE K_ED_LAVK_ATIC42.P_CODE_OPENLOAD K_ED_LAVK_ATIC42.P_CODE_SH_TO_GND K_ED_LAVK_ATIC42.P_CODE_SH_TO_UB K_ED_LAVK_ATIC42.P_CODE_UNPLAUSIBEL K_ED_LSHNK1.DEC_NACH_EINTRAG K_ED_LSHNK1.DEC_VOR_EINTRAG K_ED_LSHNK1.FEHLERSCHWELLE K_ED_LSHNK1.INC_NACH_EINTRAG K_ED_LSHNK1.INC_VOR_EINTRAG K_ED_LSHNK1.KLASSENINDEX K_ED_LSHNK1.OK_SCHWELLE K_ED_LSHNK1.P_CODE_OPENLOAD K_ED_LSHNK1.P_CODE_SH_TO_GND K_ED_LSHNK1.P_CODE_SH_TO_UB K_ED_LSHNK1.P_CODE_UNPLAUSIBEL K_ED_LSHNK1_R.DEC_NACH_EINTRAG K_ED_LSHNK1_R.DEC_VOR_EINTRAG K_ED_LSHNK1_R.FEHLERSCHWELLE K_ED_LSHNK1_R.INC_NACH_EINTRAG K_ED_LSHNK1_R.INC_VOR_EINTRAG K_ED_LSHNK1_R.KLASSENINDEX K_ED_LSHNK1_R.OK_SCHWELLE K_ED_LSHNK1_R.P_CODE_OPENLOAD K_ED_LSHNK1_R.P_CODE_SH_TO_GND K_ED_LSHNK1_R.P_CODE_SH_TO_UB K_ED_LSHNK1_R.P_CODE_UNPLAUSIBEL K_ED_LSHNK2.DEC_NACH_EINTRAG K_ED_LSHNK2.DEC_VOR_EINTRAG K_ED_LSHNK2.FEHLERSCHWELLE K_ED_LSHNK2.INC_NACH_EINTRAG K_ED_LSHNK2.INC_VOR_EINTRAG K_ED_LSHNK2.KLASSENINDEX K_ED_LSHNK2.OK_SCHWELLE K_ED_LSHNK2.P_CODE_OPENLOAD K_ED_LSHNK2.P_CODE_SH_TO_GND K_ED_LSHNK2.P_CODE_SH_TO_UB K_ED_LSHNK2.P_CODE_UNPLAUSIBEL K_ED_LSHNK2_R.DEC_NACH_EINTRAG K_ED_LSHNK2_R.DEC_VOR_EINTRAG K_ED_LSHNK2_R.FEHLERSCHWELLE K_ED_LSHNK2_R.INC_NACH_EINTRAG K_ED_LSHNK2_R.INC_VOR_EINTRAG K_ED_LSHNK2_R.KLASSENINDEX K_ED_LSHNK2_R.OK_SCHWELLE K_ED_LSHNK2_R.P_CODE_OPENLOAD K_ED_LSHNK2_R.P_CODE_SH_TO_GND K_ED_LSHNK2_R.P_CODE_SH_TO_UB K_ED_LSHNK2_R.P_CODE_UNPLAUSIBEL K_ED_LSHVK1.DEC_NACH_EINTRAG K_ED_LSHVK1.DEC_VOR_EINTRAG K_ED_LSHVK1.FEHLERSCHWELLE K_ED_LSHVK1.INC_NACH_EINTRAG K_ED_LSHVK1.INC_VOR_EINTRAG K_ED_LSHVK1.KLASSENINDEX K_ED_LSHVK1.OK_SCHWELLE K_ED_LSHVK1.P_CODE_OPENLOAD K_ED_LSHVK1.P_CODE_SH_TO_GND K_ED_LSHVK1.P_CODE_SH_TO_UB K_ED_LSHVK1.P_CODE_UNPLAUSIBEL K_ED_LSHVK1_R.DEC_NACH_EINTRAG K_ED_LSHVK1_R.DEC_VOR_EINTRAG K_ED_LSHVK1_R.FEHLERSCHWELLE K_ED_LSHVK1_R.INC_NACH_EINTRAG K_ED_LSHVK1_R.INC_VOR_EINTRAG K_ED_LSHVK1_R.KLASSENINDEX K_ED_LSHVK1_R.OK_SCHWELLE K_ED_LSHVK1_R.P_CODE_OPENLOAD K_ED_LSHVK1_R.P_CODE_SH_TO_GND K_ED_LSHVK1_R.P_CODE_SH_TO_UB K_ED_LSHVK1_R.P_CODE_UNPLAUSIBEL K_ED_LSHVK2.DEC_NACH_EINTRAG K_ED_LSHVK2.DEC_VOR_EINTRAG K_ED_LSHVK2.FEHLERSCHWELLE K_ED_LSHVK2.INC_NACH_EINTRAG K_ED_LSHVK2.INC_VOR_EINTRAG K_ED_LSHVK2.KLASSENINDEX K_ED_LSHVK2.OK_SCHWELLE K_ED_LSHVK2.P_CODE_OPENLOAD K_ED_LSHVK2.P_CODE_SH_TO_GND K_ED_LSHVK2.P_CODE_SH_TO_UB K_ED_LSHVK2.P_CODE_UNPLAUSIBEL K_ED_LSHVK2_R.DEC_NACH_EINTRAG K_ED_LSHVK2_R.DEC_VOR_EINTRAG K_ED_LSHVK2_R.FEHLERSCHWELLE K_ED_LSHVK2_R.INC_NACH_EINTRAG K_ED_LSHVK2_R.INC_VOR_EINTRAG K_ED_LSHVK2_R.KLASSENINDEX K_ED_LSHVK2_R.OK_SCHWELLE K_ED_LSHVK2_R.P_CODE_OPENLOAD K_ED_LSHVK2_R.P_CODE_SH_TO_GND K_ED_LSHVK2_R.P_CODE_SH_TO_UB K_ED_LSHVK2_R.P_CODE_UNPLAUSIBEL K_ED_LSRVK1_OBD_REF.DEC_NACH_EINTRAG K_ED_LSRVK1_OBD_REF.DEC_VOR_EINTRAG K_ED_LSRVK1_OBD_REF.FEHLERSCHWELLE K_ED_LSRVK1_OBD_REF.INC_NACH_EINTRAG K_ED_LSRVK1_OBD_REF.INC_VOR_EINTRAG K_ED_LSRVK1_OBD_REF.KLASSENINDEX K_ED_LSRVK1_OBD_REF.OK_SCHWELLE K_ED_LSRVK1_OBD_REF.P_CODE_OPENLOAD K_ED_LSRVK1_OBD_REF.P_CODE_SH_TO_GND K_ED_LSRVK1_OBD_REF.P_CODE_SH_TO_UB K_ED_LSRVK1_OBD_REF.P_CODE_UNPLAUSIBEL K_ED_LSRVK1_OBD_REG.DEC_NACH_EINTRAG K_ED_LSRVK1_OBD_REG.DEC_VOR_EINTRAG K_ED_LSRVK1_OBD_REG.FEHLERSCHWELLE K_ED_LSRVK1_OBD_REG.INC_NACH_EINTRAG K_ED_LSRVK1_OBD_REG.INC_VOR_EINTRAG K_ED_LSRVK1_OBD_REG.KLASSENINDEX K_ED_LSRVK1_OBD_REG.OK_SCHWELLE K_ED_LSRVK1_OBD_REG.P_CODE_OPENLOAD K_ED_LSRVK1_OBD_REG.P_CODE_SH_TO_GND K_ED_LSRVK1_OBD_REG.P_CODE_SH_TO_UB K_ED_LSRVK1_OBD_REG.P_CODE_UNPLAUSIBEL K_ED_LSRVK1_OBD_START.DEC_NACH_EINTRAG K_ED_LSRVK1_OBD_START.DEC_VOR_EINTRAG K_ED_LSRVK1_OBD_START.FEHLERSCHWELLE K_ED_LSRVK1_OBD_START.INC_NACH_EINTRAG K_ED_LSRVK1_OBD_START.INC_VOR_EINTRAG K_ED_LSRVK1_OBD_START.KLASSENINDEX K_ED_LSRVK1_OBD_START.OK_SCHWELLE K_ED_LSRVK1_OBD_START.P_CODE_OPENLOAD K_ED_LSRVK1_OBD_START.P_CODE_SH_TO_GND K_ED_LSRVK1_OBD_START.P_CODE_SH_TO_UB K_ED_LSRVK1_OBD_START.P_CODE_UNPLAUSIBEL K_ED_LSRVK2_OBD_REF.DEC_NACH_EINTRAG K_ED_LSRVK2_OBD_REF.DEC_VOR_EINTRAG K_ED_LSRVK2_OBD_REF.FEHLERSCHWELLE K_ED_LSRVK2_OBD_REF.INC_NACH_EINTRAG K_ED_LSRVK2_OBD_REF.INC_VOR_EINTRAG K_ED_LSRVK2_OBD_REF.KLASSENINDEX K_ED_LSRVK2_OBD_REF.OK_SCHWELLE K_ED_LSRVK2_OBD_REF.P_CODE_OPENLOAD K_ED_LSRVK2_OBD_REF.P_CODE_SH_TO_GND K_ED_LSRVK2_OBD_REF.P_CODE_SH_TO_UB K_ED_LSRVK2_OBD_REF.P_CODE_UNPLAUSIBEL K_ED_LSRVK2_OBD_REG.DEC_NACH_EINTRAG K_ED_LSRVK2_OBD_REG.DEC_VOR_EINTRAG K_ED_LSRVK2_OBD_REG.FEHLERSCHWELLE K_ED_LSRVK2_OBD_REG.INC_NACH_EINTRAG K_ED_LSRVK2_OBD_REG.INC_VOR_EINTRAG K_ED_LSRVK2_OBD_REG.KLASSENINDEX K_ED_LSRVK2_OBD_REG.OK_SCHWELLE K_ED_LSRVK2_OBD_REG.P_CODE_OPENLOAD K_ED_LSRVK2_OBD_REG.P_CODE_SH_TO_GND K_ED_LSRVK2_OBD_REG.P_CODE_SH_TO_UB K_ED_LSRVK2_OBD_REG.P_CODE_UNPLAUSIBEL K_ED_LSRVK2_OBD_START.DEC_NACH_EINTRAG K_ED_LSRVK2_OBD_START.DEC_VOR_EINTRAG K_ED_LSRVK2_OBD_START.FEHLERSCHWELLE K_ED_LSRVK2_OBD_START.INC_NACH_EINTRAG K_ED_LSRVK2_OBD_START.INC_VOR_EINTRAG K_ED_LSRVK2_OBD_START.KLASSENINDEX K_ED_LSRVK2_OBD_START.OK_SCHWELLE K_ED_LSRVK2_OBD_START.P_CODE_OPENLOAD K_ED_LSRVK2_OBD_START.P_CODE_SH_TO_GND K_ED_LSRVK2_OBD_START.P_CODE_SH_TO_UB K_ED_LSRVK2_OBD_START.P_CODE_UNPLAUSIBEL K_ED_MIL_MASKE K_ED_MVAC_DRUCKSENSOR.DEC_NACH_EINTRAG K_ED_MVAC_DRUCKSENSOR.DEC_VOR_EINTRAG K_ED_MVAC_DRUCKSENSOR.FEHLERSCHWELLE K_ED_MVAC_DRUCKSENSOR.INC_NACH_EINTRAG K_ED_MVAC_DRUCKSENSOR.INC_VOR_EINTRAG K_ED_MVAC_DRUCKSENSOR.KLASSENINDEX K_ED_MVAC_DRUCKSENSOR.OK_SCHWELLE K_ED_MVAC_DRUCKSENSOR.P_CODE_OPENLOAD K_ED_MVAC_DRUCKSENSOR.P_CODE_SH_TO_GND K_ED_MVAC_DRUCKSENSOR.P_CODE_SH_TO_UB K_ED_MVAC_DRUCKSENSOR.P_CODE_UNPLAUSIBEL K_ED_MVAC_OBD.DEC_NACH_EINTRAG K_ED_MVAC_OBD.DEC_VOR_EINTRAG K_ED_MVAC_OBD.FEHLERSCHWELLE K_ED_MVAC_OBD.INC_NACH_EINTRAG K_ED_MVAC_OBD.INC_VOR_EINTRAG K_ED_MVAC_OBD.KLASSENINDEX K_ED_MVAC_OBD.OK_SCHWELLE K_ED_MVAC_OBD.P_CODE_OPENLOAD K_ED_MVAC_OBD.P_CODE_SH_TO_GND K_ED_MVAC_OBD.P_CODE_SH_TO_UB K_ED_MVAC_OBD.P_CODE_UNPLAUSIBEL K_ED_NW1_SYNC.DEC_NACH_EINTRAG K_ED_NW1_SYNC.DEC_VOR_EINTRAG K_ED_NW1_SYNC.FEHLERSCHWELLE K_ED_NW1_SYNC.INC_NACH_EINTRAG K_ED_NW1_SYNC.INC_VOR_EINTRAG K_ED_NW1_SYNC.KLASSENINDEX K_ED_NW1_SYNC.OK_SCHWELLE K_ED_NW1_SYNC.P_CODE_UNPLAUSIBEL K_ED_NW2_SYNC.DEC_NACH_EINTRAG K_ED_NW2_SYNC.DEC_VOR_EINTRAG K_ED_NW2_SYNC.FEHLERSCHWELLE K_ED_NW2_SYNC.INC_NACH_EINTRAG K_ED_NW2_SYNC.INC_VOR_EINTRAG K_ED_NW2_SYNC.KLASSENINDEX K_ED_NW2_SYNC.OK_SCHWELLE K_ED_NW2_SYNC.P_CODE_UNPLAUSIBEL K_ED_PCTRL_INJ.DEC_NACH_EINTRAG K_ED_PCTRL_INJ.DEC_VOR_EINTRAG K_ED_PCTRL_INJ.FEHLERSCHWELLE K_ED_PCTRL_INJ.INC_NACH_EINTRAG K_ED_PCTRL_INJ.INC_VOR_EINTRAG K_ED_PCTRL_INJ.KLASSENINDEX K_ED_PCTRL_INJ.OK_SCHWELLE K_ED_PCTRL_INJ.P_CODE_OPENLOAD K_ED_PCTRL_INJ.P_CODE_SH_TO_GND K_ED_PCTRL_INJ.P_CODE_SH_TO_UB K_ED_PCTRL_INJ.P_CODE_UNPLAUSIBEL K_ED_PKS.DEC_NACH_EINTRAG K_ED_PKS.DEC_VOR_EINTRAG K_ED_PKS.FEHLERSCHWELLE K_ED_PKS.INC_NACH_EINTRAG K_ED_PKS.INC_VOR_EINTRAG K_ED_PKS.KLASSENINDEX K_ED_PKS.OK_SCHWELLE K_ED_PKS.P_CODE_OPENLOAD K_ED_PKS.P_CODE_SH_TO_GND K_ED_PKS.P_CODE_SH_TO_UB K_ED_PKS.P_CODE_UNPLAUSIBEL K_ED_PKS_ADAPT_ANSCHL.DEC_NACH_EINTRAG K_ED_PKS_ADAPT_ANSCHL.DEC_VOR_EINTRAG K_ED_PKS_ADAPT_ANSCHL.FEHLERSCHWELLE K_ED_PKS_ADAPT_ANSCHL.INC_NACH_EINTRAG K_ED_PKS_ADAPT_ANSCHL.INC_VOR_EINTRAG K_ED_PKS_ADAPT_ANSCHL.KLASSENINDEX K_ED_PKS_ADAPT_ANSCHL.OK_SCHWELLE K_ED_PKS_ADAPT_ANSCHL.P_CODE_OPENLOAD K_ED_PKS_ADAPT_ANSCHL.P_CODE_SH_TO_GND K_ED_PKS_ADAPT_ANSCHL.P_CODE_SH_TO_UB K_ED_PKS_ADAPT_ANSCHL.P_CODE_UNPLAUSIBEL K_ED_PKS_LL.DEC_NACH_EINTRAG K_ED_PKS_LL.DEC_VOR_EINTRAG K_ED_PKS_LL.FEHLERSCHWELLE K_ED_PKS_LL.INC_NACH_EINTRAG K_ED_PKS_LL.INC_VOR_EINTRAG K_ED_PKS_LL.KLASSENINDEX K_ED_PKS_LL.OK_SCHWELLE K_ED_PKS_LL.P_CODE_OPENLOAD K_ED_PKS_LL.P_CODE_SH_TO_GND K_ED_PKS_LL.P_CODE_SH_TO_UB K_ED_PKS_LL.P_CODE_UNPLAUSIBEL K_ED_PKS_MODELL.DEC_NACH_EINTRAG K_ED_PKS_MODELL.DEC_VOR_EINTRAG K_ED_PKS_MODELL.FEHLERSCHWELLE K_ED_PKS_MODELL.INC_NACH_EINTRAG K_ED_PKS_MODELL.INC_VOR_EINTRAG K_ED_PKS_MODELL.KLASSENINDEX K_ED_PKS_MODELL.OK_SCHWELLE K_ED_PKS_MODELL.P_CODE_OPENLOAD K_ED_PKS_MODELL.P_CODE_SH_TO_GND K_ED_PKS_MODELL.P_CODE_SH_TO_UB K_ED_PKS_MODELL.P_CODE_UNPLAUSIBEL K_ED_PKS_PAUFBAU.DEC_NACH_EINTRAG K_ED_PKS_PAUFBAU.DEC_VOR_EINTRAG K_ED_PKS_PAUFBAU.FEHLERSCHWELLE K_ED_PKS_PAUFBAU.INC_NACH_EINTRAG K_ED_PKS_PAUFBAU.INC_VOR_EINTRAG K_ED_PKS_PAUFBAU.KLASSENINDEX K_ED_PKS_PAUFBAU.OK_SCHWELLE K_ED_PKS_PAUFBAU.P_CODE_OPENLOAD K_ED_PKS_PAUFBAU.P_CODE_SH_TO_GND K_ED_PKS_PAUFBAU.P_CODE_SH_TO_UB K_ED_PKS_PAUFBAU.P_CODE_UNPLAUSIBEL K_ED_PKS_Q.DEC_NACH_EINTRAG K_ED_PKS_Q.DEC_VOR_EINTRAG K_ED_PKS_Q.FEHLERSCHWELLE K_ED_PKS_Q.INC_NACH_EINTRAG K_ED_PKS_Q.INC_VOR_EINTRAG K_ED_PKS_Q.KLASSENINDEX K_ED_PKS_Q.OK_SCHWELLE K_ED_PKS_Q.P_CODE_OPENLOAD K_ED_PKS_Q.P_CODE_SH_TO_GND K_ED_PKS_Q.P_CODE_SH_TO_UB K_ED_PKS_Q.P_CODE_UNPLAUSIBEL K_ED_PKS_TL.DEC_NACH_EINTRAG K_ED_PKS_TL.DEC_VOR_EINTRAG K_ED_PKS_TL.FEHLERSCHWELLE K_ED_PKS_TL.INC_NACH_EINTRAG K_ED_PKS_TL.INC_VOR_EINTRAG K_ED_PKS_TL.KLASSENINDEX K_ED_PKS_TL.OK_SCHWELLE K_ED_PKS_TL.P_CODE_OPENLOAD K_ED_PKS_TL.P_CODE_SH_TO_GND K_ED_PKS_TL.P_CODE_SH_TO_UB K_ED_PKS_TL.P_CODE_UNPLAUSIBEL K_ED_PSAU1.DEC_NACH_EINTRAG K_ED_PSAU1.DEC_VOR_EINTRAG K_ED_PSAU1.FEHLERSCHWELLE K_ED_PSAU1.INC_NACH_EINTRAG K_ED_PSAU1.OK_SCHWELLE K_ED_PSAU2.DEC_NACH_EINTRAG K_ED_PSAU2.DEC_VOR_EINTRAG K_ED_PSAU2.FEHLERSCHWELLE K_ED_PSAU2.INC_NACH_EINTRAG K_ED_PSAU2.OK_SCHWELLE K_ED_PT_ANFRADMOM.DEC_NACH_EINTRAG K_ED_PT_ANFRADMOM.DEC_VOR_EINTRAG K_ED_PT_ANFRADMOM.FEHLERSCHWELLE K_ED_PT_ANFRADMOM.INC_NACH_EINTRAG K_ED_PT_ANFRADMOM.INC_VOR_EINTRAG K_ED_PT_ANFRADMOM.KLASSENINDEX K_ED_PT_ANFRADMOM.OK_SCHWELLE K_ED_PT_ANFRADMOM.P_CODE_OPENLOAD K_ED_PT_ANFRADMOM.P_CODE_SH_TO_GND K_ED_PT_ANFRADMOM.P_CODE_SH_TO_UB K_ED_PT_ANFRADMOM.P_CODE_UNPLAUSIBEL K_ED_PT_ATEMP.DEC_NACH_EINTRAG K_ED_PT_ATEMP.DEC_VOR_EINTRAG K_ED_PT_ATEMP.FEHLERSCHWELLE K_ED_PT_ATEMP.INC_NACH_EINTRAG K_ED_PT_ATEMP.INC_VOR_EINTRAG K_ED_PT_ATEMP.KLASSENINDEX K_ED_PT_ATEMP.OK_SCHWELLE K_ED_PT_ATEMP.P_CODE_OPENLOAD K_ED_PT_ATEMP.P_CODE_SH_TO_GND K_ED_PT_ATEMP.P_CODE_SH_TO_UB K_ED_PT_ATEMP.P_CODE_UNPLAUSIBEL K_ED_PT_AX.DEC_NACH_EINTRAG K_ED_PT_AX.DEC_VOR_EINTRAG K_ED_PT_AX.FEHLERSCHWELLE K_ED_PT_AX.INC_NACH_EINTRAG K_ED_PT_AX.INC_VOR_EINTRAG K_ED_PT_AX.KLASSENINDEX K_ED_PT_AX.OK_SCHWELLE K_ED_PT_AX.P_CODE_OPENLOAD K_ED_PT_AX.P_CODE_SH_TO_GND K_ED_PT_AX.P_CODE_SH_TO_UB K_ED_PT_AX.P_CODE_UNPLAUSIBEL K_ED_PT_BEDAT.DEC_NACH_EINTRAG K_ED_PT_BEDAT.DEC_VOR_EINTRAG K_ED_PT_BEDAT.FEHLERSCHWELLE K_ED_PT_BEDAT.INC_NACH_EINTRAG K_ED_PT_BEDAT.INC_VOR_EINTRAG K_ED_PT_BEDAT.KLASSENINDEX K_ED_PT_BEDAT.OK_SCHWELLE K_ED_PT_BEDAT.P_CODE_OPENLOAD K_ED_PT_BEDAT.P_CODE_SH_TO_GND K_ED_PT_BEDAT.P_CODE_SH_TO_UB K_ED_PT_BEDAT.P_CODE_UNPLAUSIBEL K_ED_PT_BEDFGR.DEC_NACH_EINTRAG K_ED_PT_BEDFGR.DEC_VOR_EINTRAG K_ED_PT_BEDFGR.FEHLERSCHWELLE K_ED_PT_BEDFGR.INC_NACH_EINTRAG K_ED_PT_BEDFGR.INC_VOR_EINTRAG K_ED_PT_BEDFGR.KLASSENINDEX K_ED_PT_BEDFGR.OK_SCHWELLE K_ED_PT_BEDFGR.P_CODE_OPENLOAD K_ED_PT_BEDFGR.P_CODE_SH_TO_GND K_ED_PT_BEDFGR.P_CODE_SH_TO_UB K_ED_PT_BEDFGR.P_CODE_UNPLAUSIBEL K_ED_PT_BUSOFF.DEC_NACH_EINTRAG K_ED_PT_BUSOFF.DEC_VOR_EINTRAG K_ED_PT_BUSOFF.FEHLERSCHWELLE K_ED_PT_BUSOFF.INC_NACH_EINTRAG K_ED_PT_BUSOFF.INC_VOR_EINTRAG K_ED_PT_BUSOFF.KLASSENINDEX K_ED_PT_BUSOFF.OK_SCHWELLE K_ED_PT_BUSOFF.P_CODE_OPENLOAD K_ED_PT_BUSOFF.P_CODE_SH_TO_GND K_ED_PT_BUSOFF.P_CODE_SH_TO_UB K_ED_PT_BUSOFF.P_CODE_UNPLAUSIBEL K_ED_PT_CRASH.DEC_NACH_EINTRAG K_ED_PT_CRASH.DEC_VOR_EINTRAG K_ED_PT_CRASH.FEHLERSCHWELLE K_ED_PT_CRASH.INC_NACH_EINTRAG K_ED_PT_CRASH.INC_VOR_EINTRAG K_ED_PT_CRASH.KLASSENINDEX K_ED_PT_CRASH.OK_SCHWELLE K_ED_PT_CRASH.P_CODE_OPENLOAD K_ED_PT_CRASH.P_CODE_SH_TO_GND K_ED_PT_CRASH.P_CODE_SH_TO_UB K_ED_PT_CRASH.P_CODE_UNPLAUSIBEL K_ED_PT_GRB.DEC_NACH_EINTRAG K_ED_PT_GRB.DEC_VOR_EINTRAG K_ED_PT_GRB.FEHLERSCHWELLE K_ED_PT_GRB.INC_NACH_EINTRAG K_ED_PT_GRB.INC_VOR_EINTRAG K_ED_PT_GRB.KLASSENINDEX K_ED_PT_GRB.OK_SCHWELLE K_ED_PT_GRB.P_CODE_OPENLOAD K_ED_PT_GRB.P_CODE_SH_TO_GND K_ED_PT_GRB.P_CODE_SH_TO_UB K_ED_PT_GRB.P_CODE_UNPLAUSIBEL K_ED_PT_GRB2.DEC_NACH_EINTRAG K_ED_PT_GRB2.DEC_VOR_EINTRAG K_ED_PT_GRB2.FEHLERSCHWELLE K_ED_PT_GRB2.INC_NACH_EINTRAG K_ED_PT_GRB2.INC_VOR_EINTRAG K_ED_PT_GRB2.KLASSENINDEX K_ED_PT_GRB2.OK_SCHWELLE K_ED_PT_GRB2.P_CODE_OPENLOAD K_ED_PT_GRB2.P_CODE_SH_TO_GND K_ED_PT_GRB2.P_CODE_SH_TO_UB K_ED_PT_GRB2.P_CODE_UNPLAUSIBEL K_ED_PT_KKOS.DEC_NACH_EINTRAG K_ED_PT_KKOS.DEC_VOR_EINTRAG K_ED_PT_KKOS.FEHLERSCHWELLE K_ED_PT_KKOS.INC_NACH_EINTRAG K_ED_PT_KKOS.INC_VOR_EINTRAG K_ED_PT_KKOS.KLASSENINDEX K_ED_PT_KKOS.OK_SCHWELLE K_ED_PT_KKOS.P_CODE_OPENLOAD K_ED_PT_KKOS.P_CODE_SH_TO_GND K_ED_PT_KKOS.P_CODE_SH_TO_UB K_ED_PT_KKOS.P_CODE_UNPLAUSIBEL K_ED_PT_KLST.DEC_NACH_EINTRAG K_ED_PT_KLST.DEC_VOR_EINTRAG K_ED_PT_KLST.FEHLERSCHWELLE K_ED_PT_KLST.INC_NACH_EINTRAG K_ED_PT_KLST.INC_VOR_EINTRAG K_ED_PT_KLST.KLASSENINDEX K_ED_PT_KLST.OK_SCHWELLE K_ED_PT_KLST.P_CODE_OPENLOAD K_ED_PT_KLST.P_CODE_SH_TO_GND K_ED_PT_KLST.P_CODE_SH_TO_UB K_ED_PT_KLST.P_CODE_UNPLAUSIBEL K_ED_PT_KM.DEC_NACH_EINTRAG K_ED_PT_KM.DEC_VOR_EINTRAG K_ED_PT_KM.FEHLERSCHWELLE K_ED_PT_KM.INC_NACH_EINTRAG K_ED_PT_KM.INC_VOR_EINTRAG K_ED_PT_KM.KLASSENINDEX K_ED_PT_KM.OK_SCHWELLE K_ED_PT_KM.P_CODE_OPENLOAD K_ED_PT_KM.P_CODE_SH_TO_GND K_ED_PT_KM.P_CODE_SH_TO_UB K_ED_PT_KM.P_CODE_UNPLAUSIBEL K_ED_PT_KOMBI.DEC_NACH_EINTRAG K_ED_PT_KOMBI.DEC_VOR_EINTRAG K_ED_PT_KOMBI.FEHLERSCHWELLE K_ED_PT_KOMBI.INC_NACH_EINTRAG K_ED_PT_KOMBI.INC_VOR_EINTRAG K_ED_PT_KOMBI.KLASSENINDEX K_ED_PT_KOMBI.OK_SCHWELLE K_ED_PT_KOMBI.P_CODE_OPENLOAD K_ED_PT_KOMBI.P_CODE_SH_TO_GND K_ED_PT_KOMBI.P_CODE_SH_TO_UB K_ED_PT_KOMBI.P_CODE_UNPLAUSIBEL K_ED_PT_LRW.DEC_NACH_EINTRAG K_ED_PT_LRW.DEC_VOR_EINTRAG K_ED_PT_LRW.FEHLERSCHWELLE K_ED_PT_LRW.INC_NACH_EINTRAG K_ED_PT_LRW.INC_VOR_EINTRAG /end DEF_CHARACTERISTIC
/end FUNCTION
/begin RECORD_LAYOUT TKW_VV_VV_UB FNC_VALUES 1 UBYTE COLUMN_DIR DIRECT /end RECORD_LAYOUT
/begin RECORD_LAYOUT TKW_VV_VV_UW FNC_VALUES 1 UWORD COLUMN_DIR DIRECT /end RECORD_LAYOUT
/end MODULE
/end PROJECT
