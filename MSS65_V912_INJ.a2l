/begin PROJECT MSS65-inj-V912 "MSS65 INJ - V912.00-B204.00, data set 0569Q60Z520E"
/begin HEADER "" VERSION "V912.00-B204.00" /end HEADER
/begin MODULE _MSS65-inj "MSS65 INJ - V912.00-B204.00, data 7842800"
/begin MOD_COMMON "" BYTE_ORDER MSB_FIRST /* Default byteorder (Motorola) */ /end MOD_COMMON
/* Formel fuer 1:1-Wiedergabe ohne Einheit */
/begin COMPU_METHOD FORMULA_USER1 "FORMULA_USER1" RAT_FUNC "%7.0" "-" COEFFS 0 1 0 0 0 1 /end COMPU_METHOD
/begin COMPU_METHOD FORMULA_0001 "FORMULA_0001" RAT_FUNC "%6.1" "%" COEFFS 0 10 0 0 0 1 /end COMPU_METHOD
/begin COMPU_METHOD FORMULA_0003 "FORMULA_0003" RAT_FUNC "%3.0" "-" COEFFS 0 1 0 0 0 1 /end COMPU_METHOD
/begin COMPU_METHOD FORMULA_0006 "FORMULA_0006" RAT_FUNC "%5.0" "Upm" COEFFS 0 1 0 0 0 1 /end COMPU_METHOD
/begin COMPU_METHOD FORMULA_0007 "FORMULA_0007" RAT_FUNC "%8.3" "-" COEFFS 0 10000 0 0 0 1 /end COMPU_METHOD
/begin COMPU_METHOD FORMULA_0008 "FORMULA_0008" RAT_FUNC "%6.1" "V" COEFFS 0 10 0 0 0 1 /end COMPU_METHOD
/begin COMPU_METHOD FORMULA_0009 "FORMULA_0009" RAT_FUNC "%6.1" "Nm" COEFFS 0 10 0 0 0 1 /end COMPU_METHOD
/begin COMPU_METHOD FORMULA_0010 "FORMULA_0010" RAT_FUNC "%5.0" "-" COEFFS 0 1 0 0 0 1 /end COMPU_METHOD
/begin COMPU_METHOD FORMULA_0021 "FORMULA_0021" RAT_FUNC "%7.2" "s" COEFFS 0 100 0 0 0 1 /end COMPU_METHOD
/* ------------------ Abschnitt erzeugt aus adapt_glob.dat ------------------ */
/begin COMPU_METHOD FORMULA_0023 "FORMULA_0023" RAT_FUNC "%6.1" "�C" COEFFS 0 10 2732 0 0 1 /end COMPU_METHOD
/begin COMPU_METHOD FORMULA_0024 "FORMULA_0024" RAT_FUNC "%9.4" "-" COEFFS 0 32768 0 0 0 1 /end COMPU_METHOD
/begin COMPU_METHOD FORMULA_0025 "FORMULA_0025" RAT_FUNC "%8.3" "-" COEFFS 0 16384 0 0 0 1 /end COMPU_METHOD
/begin COMPU_METHOD FORMULA_0073 "FORMULA_0073" RAT_FUNC "%6.1" "s" COEFFS 0 10 0 0 0 1 /end COMPU_METHOD
/begin COMPU_METHOD FORMULA_0075 "FORMULA_0075" RAT_FUNC "%8.3" "-" COEFFS 0 1024 0 0 0 1 /end COMPU_METHOD
/begin COMPU_METHOD FORMULA_0077 "FORMULA_0077" RAT_FUNC "%6.1" "mbar" COEFFS 0 16 0 0 0 1 /end COMPU_METHOD
/begin COMPU_METHOD FORMULA_0078 "FORMULA_0078" RAT_FUNC "%6.1" "km/h" COEFFS 0 16 0 0 0 1 /end COMPU_METHOD
/begin COMPU_METHOD FORMULA_0111 "FORMULA_0111" RAT_FUNC "%6.1" "�KW" COEFFS 0 10 0 0 0 1 /end COMPU_METHOD
/begin COMPU_METHOD FORMULA_0112 "FORMULA_0112" RAT_FUNC "%6.1" "kg/h" COEFFS 0 10 0 0 0 1 /end COMPU_METHOD
/begin COMPU_METHOD FORMULA_0114 "FORMULA_0114" RAT_FUNC "%5.0" "Upm/s" COEFFS 0 1 0 0 0 1 /end COMPU_METHOD
/begin COMPU_METHOD FORMULA_0117 "FORMULA_0117" RAT_FUNC "%7.2" "s" COEFFS 0 200 0 0 0 1 /end COMPU_METHOD
/begin COMPU_METHOD FORMULA_0123 "FORMULA_0123" RAT_FUNC "%5.0" "digit" COEFFS 0 1 0 0 0 1 /end COMPU_METHOD
/begin COMPU_METHOD FORMULA_0228 "FORMULA_0228" TAB_VERB "%5.2" "-" COMPU_TAB_REF FORMULA_0228_VTAB /end COMPU_METHOD
/begin COMPU_VTAB FORMULA_0228_VTAB "FORMULA_0228_VTAB" TAB_VERB 16 0 "O.K." 1 "SH_TO_UB" 2 "SH_TO_GND" 3 "UB+GND" 4 "OPENLOAD" 5 "UB+OL" 6 "GND+OL" 7 "UB+GND+OL" 8 "UNPLAUSI" 9 "UB+UP" 10 "GND+UP" 11 "UB+GND+UP" 12 "OL+UP" 13 "UB+OL+UP" 14 "GND+OL+UP" 15 "UB+GND+OL+UP" /end COMPU_VTAB
/begin COMPU_METHOD FORMULA_0532 "FORMULA_0532" RAT_FUNC "%5.0" "mV" COEFFS 0 1024 0 0 0 5000 /end COMPU_METHOD
/begin COMPU_METHOD FORMULA_0556 "FORMULA_0556" RAT_FUNC "%9.4" "-" COEFFS 0 10000 0 0 0 1 /end COMPU_METHOD
/begin COMPU_METHOD FORMULA_0651 "FORMULA_0651" RAT_FUNC "%6.3" "s" COEFFS 0 0 1.28 0 1 0 /end COMPU_METHOD
/begin COMPU_METHOD FORMULA_0664 "FORMULA_0664" RAT_FUNC "%5.2" "s" COEFFS 0 0 2.56 0 1 0 /end COMPU_METHOD
/begin COMPU_METHOD FORMULA_0709 "FORMULA_0709" RAT_FUNC "%6.1" "%" COEFFS 0 100 0 0 0 1 /end COMPU_METHOD
/begin COMPU_METHOD FORMULA_0712 "FORMULA_0712" TAB_VERB "%5.2" "-" COMPU_TAB_REF FORMULA_0712_VTAB /end COMPU_METHOD
/begin COMPU_VTAB FORMULA_0712_VTAB "FORMULA_0712_VTAB" TAB_VERB 3 0 "Inaktiv" 1 "Aktiv" 2 "Aktiv Test" DEFAULT_VALUE "ungueltig" /end COMPU_VTAB
/begin COMPU_METHOD FORMULA_0718 "FORMULA_0718" RAT_FUNC "%5.2" "s" COEFFS 0 0 256 0 1 0 /end COMPU_METHOD
/begin COMPU_METHOD FORMULA_0798 "FORMULA_0798" TAB_VERB "%7.2" "-" COMPU_TAB_REF FORMULA_0798_VTAB /end COMPU_METHOD
/begin COMPU_VTAB FORMULA_0798_VTAB "FORMULA_0798_VTAB" TAB_VERB 2 0 "inaktiv" 1 "aktiv" /end COMPU_VTAB
/begin COMPU_METHOD FORMULA_0880 "FORMULA_0880" TAB_VERB "%7.2" "-" COMPU_TAB_REF FORMULA_0880_VTAB /end COMPU_METHOD
/begin COMPU_VTAB FORMULA_0880_VTAB "FORMULA_0880_VTAB" TAB_VERB 1 0 "Off" DEFAULT_VALUE "On" /end COMPU_VTAB
/begin COMPU_METHOD FORMULA_0881 "FORMULA_0881" TAB_VERB "%7.2" "-" COMPU_TAB_REF FORMULA_0881_VTAB /end COMPU_METHOD
/begin COMPU_VTAB FORMULA_0881_VTAB "FORMULA_0881_VTAB" TAB_VERB 1 0 "Off" DEFAULT_VALUE "On" /end COMPU_VTAB
/begin COMPU_METHOD FORMULA_0882 "FORMULA_0882" TAB_VERB "%5.2" "-" COMPU_TAB_REF FORMULA_0882_VTAB /end COMPU_METHOD
/begin COMPU_VTAB FORMULA_0882_VTAB "FORMULA_0882_VTAB" TAB_VERB 2 0 "Range 1" 1 "Range 2" /end COMPU_VTAB
/begin COMPU_METHOD FORMULA_0883 "FORMULA_0883" TAB_VERB "%5.2" "-" COMPU_TAB_REF FORMULA_0883_VTAB /end COMPU_METHOD
/begin COMPU_VTAB FORMULA_0883_VTAB "FORMULA_0883_VTAB" TAB_VERB 2 0 "Disable" 1 "Enable" /end COMPU_VTAB
/begin COMPU_METHOD FORMULA_0884 "FORMULA_0884" TAB_VERB "%5.2" "-" COMPU_TAB_REF FORMULA_0884_VTAB /end COMPU_METHOD
/begin COMPU_VTAB FORMULA_0884_VTAB "FORMULA_0884_VTAB" TAB_VERB 2 0 "inaktiv" 1 "aktiv" /end COMPU_VTAB
/begin COMPU_METHOD FORMULA_0885 "FORMULA_0885" RAT_FUNC "%5.0" "uA" COEFFS 0 -1 5.15 0 0 -5.15 /end COMPU_METHOD
/begin COMPU_METHOD FORMULA_0886 "FORMULA_0886" RAT_FUNC "%6.1" "ms" COEFFS 0 -1 0.8 0 0 -0.1 /end COMPU_METHOD
/begin COMPU_METHOD FORMULA_0887 "FORMULA_0887" RAT_FUNC "%8.3" "kHz" COEFFS 0 -1 1.9531 0 0 -0.122 /end COMPU_METHOD
/begin COMPU_METHOD FORMULA_0888 "FORMULA_0888" TAB_VERB "%5.2" "-" COMPU_TAB_REF FORMULA_0888_VTAB /end COMPU_METHOD
/begin COMPU_VTAB FORMULA_0888_VTAB "FORMULA_0888_VTAB" TAB_VERB 2 0 "keine DIAG-Info" 1 "DIAG-Info" /end COMPU_VTAB
/* ------------------ Abschnitt erzeugt aus la_trim.dat ------------------ */
/begin COMPU_METHOD FORMULA_0895 "FORMULA_0895" TAB_VERB "%7.2" "-" COMPU_TAB_REF FORMULA_0895_VTAB /end COMPU_METHOD
/begin COMPU_VTAB FORMULA_0895_VTAB "FORMULA_0895_VTAB" TAB_VERB 1 0 "inaktiv" DEFAULT_VALUE "aktiv" /end COMPU_VTAB
/begin COMPU_METHOD FORMULA_0896 "FORMULA_0896" TAB_VERB "%7.2" "-" COMPU_TAB_REF FORMULA_0896_VTAB /end COMPU_METHOD
/begin COMPU_VTAB FORMULA_0896_VTAB "FORMULA_0896_VTAB" TAB_VERB 1 0 "verletzt" DEFAULT_VALUE "i.O." /end COMPU_VTAB
/begin COMPU_METHOD FORMULA_0897 "FORMULA_0897" TAB_VERB "%7.2" "-" COMPU_TAB_REF FORMULA_0897_VTAB /end COMPU_METHOD
/begin COMPU_VTAB FORMULA_0897_VTAB "FORMULA_0897_VTAB" TAB_VERB 1 0 "nein" DEFAULT_VALUE "ja" /end COMPU_VTAB
/begin COMPU_METHOD FORMULA_0898 "FORMULA_0898" TAB_VERB "%7.2" "-" COMPU_TAB_REF FORMULA_0898_VTAB /end COMPU_METHOD
/begin COMPU_VTAB FORMULA_0898_VTAB "FORMULA_0898_VTAB" TAB_VERB 1 0 "nein" DEFAULT_VALUE "ja" /end COMPU_VTAB
/begin COMPU_METHOD FORMULA_0899 "FORMULA_0899" TAB_VERB "%7.2" "-" COMPU_TAB_REF FORMULA_0899_VTAB /end COMPU_METHOD
/begin COMPU_VTAB FORMULA_0899_VTAB "FORMULA_0899_VTAB" TAB_VERB 1 0 "n.i.O." DEFAULT_VALUE "i.O." /end COMPU_VTAB
/begin COMPU_METHOD FORMULA_0900 "FORMULA_0900" TAB_VERB "%7.2" "-" COMPU_TAB_REF FORMULA_0900_VTAB /end COMPU_METHOD
/begin COMPU_VTAB FORMULA_0900_VTAB "FORMULA_0900_VTAB" TAB_VERB 1 0 "n.i.O." DEFAULT_VALUE "i.O." /end COMPU_VTAB
/begin COMPU_METHOD FORMULA_0901 "FORMULA_0901" TAB_VERB "%7.2" "-" COMPU_TAB_REF FORMULA_0901_VTAB /end COMPU_METHOD
/begin COMPU_VTAB FORMULA_0901_VTAB "FORMULA_0901_VTAB" TAB_VERB 1 0 "aktiv" DEFAULT_VALUE "inaktiv" /end COMPU_VTAB
/begin COMPU_METHOD FORMULA_0902 "FORMULA_0902" TAB_VERB "%7.2" "-" COMPU_TAB_REF FORMULA_0902_VTAB /end COMPU_METHOD
/begin COMPU_VTAB FORMULA_0902_VTAB "FORMULA_0902_VTAB" TAB_VERB 1 0 "aktiv" DEFAULT_VALUE "inaktiv" /end COMPU_VTAB
/begin COMPU_METHOD FORMULA_0903 "FORMULA_0903" TAB_VERB "%7.2" "-" COMPU_TAB_REF FORMULA_0903_VTAB /end COMPU_METHOD
/begin COMPU_VTAB FORMULA_0903_VTAB "FORMULA_0903_VTAB" TAB_VERB 1 0 "aktiv" DEFAULT_VALUE "inaktiv" /end COMPU_VTAB
/begin COMPU_METHOD FORMULA_0904 "FORMULA_0904" TAB_VERB "%7.2" "-" COMPU_TAB_REF FORMULA_0904_VTAB /end COMPU_METHOD
/begin COMPU_VTAB FORMULA_0904_VTAB "FORMULA_0904_VTAB" TAB_VERB 1 0 "aktiv" DEFAULT_VALUE "inaktiv" /end COMPU_VTAB
/begin COMPU_METHOD FORMULA_0905 "FORMULA_0905" TAB_VERB "%7.2" "-" COMPU_TAB_REF FORMULA_0905_VTAB /end COMPU_METHOD
/begin COMPU_VTAB FORMULA_0905_VTAB "FORMULA_0905_VTAB" TAB_VERB 1 0 "aktiv" DEFAULT_VALUE "inaktiv" /end COMPU_VTAB
/begin COMPU_METHOD FORMULA_0906 "FORMULA_0906" TAB_VERB "%7.2" "-" COMPU_TAB_REF FORMULA_0906_VTAB /end COMPU_METHOD
/begin COMPU_VTAB FORMULA_0906_VTAB "FORMULA_0906_VTAB" TAB_VERB 1 0 "n.i.O." DEFAULT_VALUE "i.O." /end COMPU_VTAB
/begin COMPU_METHOD FORMULA_0907 "FORMULA_0907" TAB_VERB "%7.2" "-" COMPU_TAB_REF FORMULA_0907_VTAB /end COMPU_METHOD
/begin COMPU_VTAB FORMULA_0907_VTAB "FORMULA_0907_VTAB" TAB_VERB 1 0 "vorhanden" DEFAULT_VALUE "nicht vorhanden" /end COMPU_VTAB
/begin COMPU_METHOD FORMULA_0908 "FORMULA_0908" TAB_VERB "%7.2" "-" COMPU_TAB_REF FORMULA_0908_VTAB /end COMPU_METHOD
/begin COMPU_VTAB FORMULA_0908_VTAB "FORMULA_0908_VTAB" TAB_VERB 1 0 "aktiv" DEFAULT_VALUE "inaktiv" /end COMPU_VTAB
/begin COMPU_METHOD FORMULA_0909 "FORMULA_0909" TAB_VERB "%7.2" "-" COMPU_TAB_REF FORMULA_0909_VTAB /end COMPU_METHOD
/begin COMPU_VTAB FORMULA_0909_VTAB "FORMULA_0909_VTAB" TAB_VERB 1 0 "Verletzung" DEFAULT_VALUE "i.O." /end COMPU_VTAB
/begin COMPU_METHOD FORMULA_0910 "FORMULA_0910" TAB_VERB "%7.2" "-" COMPU_TAB_REF FORMULA_0910_VTAB /end COMPU_METHOD
/begin COMPU_VTAB FORMULA_0910_VTAB "FORMULA_0910_VTAB" TAB_VERB 1 0 "-" DEFAULT_VALUE "P-Anteil" /end COMPU_VTAB
/begin COMPU_METHOD FORMULA_0911 "FORMULA_0911" TAB_VERB "%7.2" "-" COMPU_TAB_REF FORMULA_0911_VTAB /end COMPU_METHOD
/begin COMPU_VTAB FORMULA_0911_VTAB "FORMULA_0911_VTAB" TAB_VERB 1 0 "-" DEFAULT_VALUE "abgeregelt" /end COMPU_VTAB
/begin COMPU_METHOD FORMULA_0912 "FORMULA_0912" TAB_VERB "%7.2" "-" COMPU_TAB_REF FORMULA_0912_VTAB /end COMPU_METHOD
/begin COMPU_VTAB FORMULA_0912_VTAB "FORMULA_0912_VTAB" TAB_VERB 1 0 "-" DEFAULT_VALUE "I-Anteil auf I-GMW" /end COMPU_VTAB
/begin COMPU_METHOD FORMULA_0913 "FORMULA_0913" TAB_VERB "%7.2" "-" COMPU_TAB_REF FORMULA_0913_VTAB /end COMPU_METHOD
/begin COMPU_VTAB FORMULA_0913_VTAB "FORMULA_0913_VTAB" TAB_VERB 1 0 "-" DEFAULT_VALUE "O2-Beladung" /end COMPU_VTAB
/begin COMPU_METHOD FORMULA_0914 "FORMULA_0914" TAB_VERB "%7.2" "-" COMPU_TAB_REF FORMULA_0914_VTAB /end COMPU_METHOD
/begin COMPU_VTAB FORMULA_0914_VTAB "FORMULA_0914_VTAB" TAB_VERB 1 0 "-" DEFAULT_VALUE "I-MAX" /end COMPU_VTAB
/begin COMPU_METHOD FORMULA_0915 "FORMULA_0915" TAB_VERB "%7.2" "-" COMPU_TAB_REF FORMULA_0915_VTAB /end COMPU_METHOD
/begin COMPU_VTAB FORMULA_0915_VTAB "FORMULA_0915_VTAB" TAB_VERB 1 0 "-" DEFAULT_VALUE "I-MIN" /end COMPU_VTAB
/begin COMPU_METHOD FORMULA_0916 "FORMULA_0916" TAB_VERB "%7.2" "-" COMPU_TAB_REF FORMULA_0916_VTAB /end COMPU_METHOD
/begin COMPU_VTAB FORMULA_0916_VTAB "FORMULA_0916_VTAB" TAB_VERB 1 0 "-" DEFAULT_VALUE "AD-Wert" /end COMPU_VTAB
/begin COMPU_METHOD FORMULA_0917 "FORMULA_0917" TAB_VERB "%7.2" "-" COMPU_TAB_REF FORMULA_0917_VTAB /end COMPU_METHOD
/begin COMPU_VTAB FORMULA_0917_VTAB "FORMULA_0917_VTAB" TAB_VERB 1 0 "-" DEFAULT_VALUE "AD-MAX" /end COMPU_VTAB
/begin COMPU_METHOD FORMULA_0918 "FORMULA_0918" TAB_VERB "%7.2" "-" COMPU_TAB_REF FORMULA_0918_VTAB /end COMPU_METHOD
/begin COMPU_VTAB FORMULA_0918_VTAB "FORMULA_0918_VTAB" TAB_VERB 1 0 "-" DEFAULT_VALUE "AD-MIN" /end COMPU_VTAB
/begin COMPU_METHOD FORMULA_0919 "FORMULA_0919" RAT_FUNC "%7.2" "10exp-3 -/mV" COEFFS 0 80 0 0 0 1 /end COMPU_METHOD
/begin COMPU_METHOD FORMULA_0920 "FORMULA_0920" RAT_FUNC "%10.3" "-/s" COEFFS 0 16384 0 0 0 1 /end COMPU_METHOD
/begin COMPU_METHOD FORMULA_0921 "FORMULA_0921" TAB_VERB "%7.2" "-" COMPU_TAB_REF FORMULA_0921_VTAB /end COMPU_METHOD
/begin COMPU_VTAB FORMULA_0921_VTAB "FORMULA_0921_VTAB" TAB_VERB 1 0 "-" DEFAULT_VALUE "M-Verdacht" /end COMPU_VTAB
/begin COMPU_METHOD FORMULA_0922 "FORMULA_0922" TAB_VERB "%7.2" "-" COMPU_TAB_REF FORMULA_0922_VTAB /end COMPU_METHOD
/begin COMPU_VTAB FORMULA_0922_VTAB "FORMULA_0922_VTAB" TAB_VERB 1 0 "-" DEFAULT_VALUE "F-Verdacht" /end COMPU_VTAB
/begin COMPU_METHOD FORMULA_0923 "FORMULA_0923" TAB_VERB "%7.2" "-" COMPU_TAB_REF FORMULA_0923_VTAB /end COMPU_METHOD
/begin COMPU_VTAB FORMULA_0923_VTAB "FORMULA_0923_VTAB" TAB_VERB 3 0 "inaktiv" 1 "aktiv" 2 "RESET" /end COMPU_VTAB
/begin COMPU_METHOD FORMULA_0924 "FORMULA_0924" TAB_VERB "%7.2" "-" COMPU_TAB_REF FORMULA_0924_VTAB /end COMPU_METHOD
/begin COMPU_VTAB FORMULA_0924_VTAB "FORMULA_0924_VTAB" TAB_VERB 6 0 "AUS" 1 "P-Anteil" 2 "I-Anteil" 6 "I-Anteil+MW-Begr." 14 "I-Anteil+MW-Begr.+Adapt." 15 "komplett" /end COMPU_VTAB
/begin COMPU_METHOD FORMULA_0925 "FORMULA_0925" RAT_FUNC "%7.2" "s" COEFFS 0 1 0 0 0 1 /end COMPU_METHOD
/begin COMPU_METHOD FORMULA_0926 "FORMULA_0926" RAT_FUNC "%5.0" "mV/10msec" COEFFS 0 1024 0 0 0 5000 /end COMPU_METHOD
/begin COMPU_METHOD FORMULA_0927 "FORMULA_0927" RAT_FUNC "%7.2" "-" COEFFS 0 1024 0 0 0 1 /end COMPU_METHOD
/* ------------------ Abschnitt erzeugt aus lsh_nk.dat ------------------ */
/begin COMPU_METHOD FORMULA_0928 "FORMULA_0928" TAB_VERB "%7.2" "-" COMPU_TAB_REF FORMULA_0928_VTAB /end COMPU_METHOD
/begin COMPU_VTAB FORMULA_0928_VTAB "FORMULA_0928_VTAB" TAB_VERB 1 0 "LSHN inaktiv" DEFAULT_VALUE "LSHN aktiv" /end COMPU_VTAB
/begin COMPU_METHOD FORMULA_0929 "FORMULA_0929" TAB_VERB "%7.2" "-" COMPU_TAB_REF FORMULA_0929_VTAB /end COMPU_METHOD
/begin COMPU_VTAB FORMULA_0929_VTAB "FORMULA_0929_VTAB" TAB_VERB 1 0 "unter TAUP" DEFAULT_VALUE "TAUP erreicht" /end COMPU_VTAB
/begin COMPU_METHOD FORMULA_0930 "FORMULA_0930" TAB_VERB "%7.2" "-" COMPU_TAB_REF FORMULA_0930_VTAB /end COMPU_METHOD
/begin COMPU_VTAB FORMULA_0930_VTAB "FORMULA_0930_VTAB" TAB_VERB 1 0 "-" DEFAULT_VALUE "Anforderung" /end COMPU_VTAB
/begin COMPU_METHOD FORMULA_0933 "FORMULA_0933" TAB_VERB "%7.2" "-" COMPU_TAB_REF FORMULA_0933_VTAB /end COMPU_METHOD
/begin COMPU_VTAB FORMULA_0933_VTAB "FORMULA_0933_VTAB" TAB_VERB 1 0 "Diag. inaktiv" DEFAULT_VALUE "Diag. aktiv" /end COMPU_VTAB
/begin COMPU_METHOD FORMULA_0934 "FORMULA_0934" TAB_VERB "%7.2" "-" COMPU_TAB_REF FORMULA_0934_VTAB /end COMPU_METHOD
/begin COMPU_VTAB FORMULA_0934_VTAB "FORMULA_0934_VTAB" TAB_VERB 1 0 "R-Messung" DEFAULT_VALUE "R-Messung efolgt" /end COMPU_VTAB
/begin COMPU_METHOD FORMULA_0935 "FORMULA_0935" TAB_VERB "%7.2" "-" COMPU_TAB_REF FORMULA_0935_VTAB /end COMPU_METHOD
/begin COMPU_VTAB FORMULA_0935_VTAB "FORMULA_0935_VTAB" TAB_VERB 1 0 "i.O." DEFAULT_VALUE "SH_TO_X_SPERREN" /end COMPU_VTAB
/begin COMPU_METHOD FORMULA_0936 "FORMULA_0936" RAT_FUNC "%7.2" "A" COEFFS 0 215 0 0 0 1 /end COMPU_METHOD
/* ------------------ Abschnitt erzeugt aus lsh_vk.dat ------------------ */
/begin COMPU_METHOD FORMULA_0937 "FORMULA_0937" TAB_VERB "%7.2" "-" COMPU_TAB_REF FORMULA_0937_VTAB /end COMPU_METHOD
/begin COMPU_VTAB FORMULA_0937_VTAB "FORMULA_0937_VTAB" TAB_VERB 1 0 "LSHVK gesperrt" DEFAULT_VALUE "LSHVK freigegeben" /end COMPU_VTAB
/begin COMPU_METHOD FORMULA_0938 "FORMULA_0938" TAB_VERB "%7.2" "-" COMPU_TAB_REF FORMULA_0938_VTAB /end COMPU_METHOD
/begin COMPU_VTAB FORMULA_0938_VTAB "FORMULA_0938_VTAB" TAB_VERB 1 0 "LSHVK-REG inaktiv" DEFAULT_VALUE "LSHVK-REG aktiv" /end COMPU_VTAB
/begin COMPU_METHOD FORMULA_0939 "FORMULA_0939" TAB_VERB "%7.2" "-" COMPU_TAB_REF FORMULA_0939_VTAB /end COMPU_METHOD
/begin COMPU_VTAB FORMULA_0939_VTAB "FORMULA_0939_VTAB" TAB_VERB 1 0 "TEMP n.i.O." DEFAULT_VALUE "TEMP eingeregelt" /end COMPU_VTAB
/begin COMPU_METHOD FORMULA_0940 "FORMULA_0940" TAB_VERB "%7.2" "-" COMPU_TAB_REF FORMULA_0940_VTAB /end COMPU_METHOD
/begin COMPU_VTAB FORMULA_0940_VTAB "FORMULA_0940_VTAB" TAB_VERB 1 0 "TEMP i.O." DEFAULT_VALUE "MAX-TEMP" /end COMPU_VTAB
/begin COMPU_METHOD FORMULA_0941 "FORMULA_0941" TAB_VERB "%7.2" "-" COMPU_TAB_REF FORMULA_0941_VTAB /end COMPU_METHOD
/begin COMPU_VTAB FORMULA_0941_VTAB "FORMULA_0941_VTAB" TAB_VERB 1 0 "TEMP i.O." DEFAULT_VALUE "MIN-TEMP" /end COMPU_VTAB
/begin COMPU_METHOD FORMULA_0942 "FORMULA_0942" TAB_VERB "%7.2" "-" COMPU_TAB_REF FORMULA_0942_VTAB /end COMPU_METHOD
/begin COMPU_VTAB FORMULA_0942_VTAB "FORMULA_0942_VTAB" TAB_VERB 1 0 "i.O." DEFAULT_VALUE "MAX" /end COMPU_VTAB
/begin COMPU_METHOD FORMULA_0943 "FORMULA_0943" TAB_VERB "%7.2" "-" COMPU_TAB_REF FORMULA_0943_VTAB /end COMPU_METHOD
/begin COMPU_VTAB FORMULA_0943_VTAB "FORMULA_0943_VTAB" TAB_VERB 1 0 "i.O." DEFAULT_VALUE "MIN" /end COMPU_VTAB
/begin COMPU_METHOD FORMULA_0944 "FORMULA_0944" TAB_VERB "%7.2" "-" COMPU_TAB_REF FORMULA_0944_VTAB /end COMPU_METHOD
/begin COMPU_VTAB FORMULA_0944_VTAB "FORMULA_0944_VTAB" TAB_VERB 1 0 "-" DEFAULT_VALUE "Anforderung" /end COMPU_VTAB
/begin COMPU_METHOD FORMULA_0947 "FORMULA_0947" RAT_FUNC "%7.2" "%/s" COEFFS 0 2048 0 0 0 100 /end COMPU_METHOD
/begin COMPU_METHOD FORMULA_0948 "FORMULA_0948" RAT_FUNC "%3.0" "s" COEFFS 0 10 0 0 0 1 /end COMPU_METHOD
/begin COMPU_METHOD FORMULA_0949 "FORMULA_0949" TAB_VERB "%7.2" "-" COMPU_TAB_REF FORMULA_0949_VTAB /end COMPU_METHOD
/begin COMPU_VTAB FORMULA_0949_VTAB "FORMULA_0949_VTAB" TAB_VERB 1 0 "Diagnose gesperrt" DEFAULT_VALUE "Diagnose freigegeben" /end COMPU_VTAB
/begin COMPU_METHOD FORMULA_0950 "FORMULA_0950" TAB_VERB "%7.2" "-" COMPU_TAB_REF FORMULA_0950_VTAB /end COMPU_METHOD
/begin COMPU_VTAB FORMULA_0950_VTAB "FORMULA_0950_VTAB" TAB_VERB 1 0 "kein Regleranschlag" DEFAULT_VALUE "max. Regleranschlag" /end COMPU_VTAB
/begin COMPU_METHOD FORMULA_0951 "FORMULA_0951" TAB_VERB "%7.2" "-" COMPU_TAB_REF FORMULA_0951_VTAB /end COMPU_METHOD
/begin COMPU_VTAB FORMULA_0951_VTAB "FORMULA_0951_VTAB" TAB_VERB 1 0 "Diagnose inaktiv" DEFAULT_VALUE "Diagnose aktiv" /end COMPU_VTAB
/begin COMPU_METHOD FORMULA_0952 "FORMULA_0952" TAB_VERB "%7.2" "-" COMPU_TAB_REF FORMULA_0952_VTAB /end COMPU_METHOD
/begin COMPU_VTAB FORMULA_0952_VTAB "FORMULA_0952_VTAB" TAB_VERB 1 0 "Diagnose inaktiv" DEFAULT_VALUE "Diagnose aktiv" /end COMPU_VTAB
/begin COMPU_METHOD FORMULA_0953 "FORMULA_0953" TAB_VERB "%7.2" "-" COMPU_TAB_REF FORMULA_0953_VTAB /end COMPU_METHOD
/begin COMPU_VTAB FORMULA_0953_VTAB "FORMULA_0953_VTAB" TAB_VERB 1 0 "inaktiv" DEFAULT_VALUE "FREIGABE" /end COMPU_VTAB
/begin COMPU_METHOD FORMULA_0954 "FORMULA_0954" TAB_VERB "%7.2" "-" COMPU_TAB_REF FORMULA_0954_VTAB /end COMPU_METHOD
/begin COMPU_VTAB FORMULA_0954_VTAB "FORMULA_0954_VTAB" TAB_VERB 1 0 "inaktiv" DEFAULT_VALUE "FREIGABE" /end COMPU_VTAB
/begin COMPU_METHOD FORMULA_0955 "FORMULA_0955" TAB_VERB "%7.2" "-" COMPU_TAB_REF FORMULA_0955_VTAB /end COMPU_METHOD
/begin COMPU_VTAB FORMULA_0955_VTAB "FORMULA_0955_VTAB" TAB_VERB 1 0 "no" DEFAULT_VALUE "yes" /end COMPU_VTAB
/begin COMPU_METHOD FORMULA_0956 "FORMULA_0956" TAB_VERB "%7.2" "-" COMPU_TAB_REF FORMULA_0956_VTAB /end COMPU_METHOD
/begin COMPU_VTAB FORMULA_0956_VTAB "FORMULA_0956_VTAB" TAB_VERB 1 0 "no" DEFAULT_VALUE "yes" /end COMPU_VTAB
/* ------------------ Abschnitt erzeugt aus mdrv.dat ------------------ */
/begin COMPU_METHOD FORMULA_0963 "FORMULA_0963" TAB_VERB "%3.0" "-" COMPU_TAB_REF FORMULA_0963_VTAB /end COMPU_METHOD
/begin COMPU_VTAB FORMULA_0963_VTAB "FORMULA_0963_VTAB" TAB_VERB 3 0 "MDrv off" 1 "MDrv on" 2 "MDrv left" DEFAULT_VALUE "undef" /end COMPU_VTAB
/begin COMPU_METHOD FORMULA_0964 "FORMULA_0964" TAB_VERB "%3.0" "-" COMPU_TAB_REF FORMULA_0964_VTAB /end COMPU_METHOD
/begin COMPU_VTAB FORMULA_0964_VTAB "FORMULA_0964_VTAB" TAB_VERB 1 0 "Aus" DEFAULT_VALUE "Ein" /end COMPU_VTAB
/begin COMPU_METHOD FORMULA_0965 "FORMULA_0965" TAB_VERB "%3.0" "-" COMPU_TAB_REF FORMULA_0965_VTAB /end COMPU_METHOD
/begin COMPU_VTAB FORMULA_0965_VTAB "FORMULA_0965_VTAB" TAB_VERB 1 0 "Aus" DEFAULT_VALUE "Ein" /end COMPU_VTAB
/* ------------------ Abschnitt erzeugt aus msa.dat ------------------ */
/begin COMPU_METHOD FORMULA_0968 "FORMULA_0968" TAB_VERB "%5.2" "-" COMPU_TAB_REF FORMULA_0968_VTAB /end COMPU_METHOD
/begin COMPU_VTAB FORMULA_0968_VTAB "FORMULA_0968_VTAB" TAB_VERB 2 0 "gesperrt" 1 "frei" /end COMPU_VTAB
/begin COMPU_METHOD FORMULA_0969 "FORMULA_0969" TAB_VERB "%5.2" "-" COMPU_TAB_REF FORMULA_0969_VTAB /end COMPU_METHOD
/begin COMPU_VTAB FORMULA_0969_VTAB "FORMULA_0969_VTAB" TAB_VERB 2 0 "Low" 1 "High" /end COMPU_VTAB
/* ------------------ Abschnitt erzeugt aus msg.dat ------------------ */
/begin COMPU_METHOD FORMULA_0970 "FORMULA_0970" TAB_VERB "%3.0" "-" COMPU_TAB_REF FORMULA_0970_VTAB /end COMPU_METHOD
/begin COMPU_VTAB FORMULA_0970_VTAB "FORMULA_0970_VTAB" TAB_VERB 7 0 "empty" 2 "StVehM" 1 "Req" 48 "BOS" 50 "BOS_2" 64 "CC" 65 "CCext" DEFAULT_VALUE "undef" /end COMPU_VTAB
/begin COMPU_METHOD FORMULA_0971 "FORMULA_0971" TAB_VERB "%3.0" "-" COMPU_TAB_REF FORMULA_0971_VTAB /end COMPU_METHOD
/begin COMPU_VTAB FORMULA_0971_VTAB "FORMULA_0971_VTAB" TAB_VERB 1 255 "empty" DEFAULT_VALUE "full" /end COMPU_VTAB
/begin COMPU_METHOD FORMULA_0972 "FORMULA_0972" TAB_VERB "%5.0" "-" COMPU_TAB_REF FORMULA_0972_VTAB /end COMPU_METHOD
/begin COMPU_VTAB FORMULA_0972_VTAB "FORMULA_0972_VTAB" TAB_VERB 27 0 "empty" 1 "Oel" 917 "Req395" 26 "FGR" 27 "MinOel_1" 28 "MinOel_2" 29 "EML" 31 "MIL" 32 "Tank" 33 "Auss_1" 34 "Auss_2" 39 "Tmot_rot" 103 "Tgetr" 104 "Tsmg" 182 "Oel-Err" 212 "Oeldruck" 213 "noLoad" 220 "highLoad" 229 "BattLow" 247 "PM-Err" 257 "Tmot_gelb" 304 "BattZust" 305 "BattKont" 306 "BattVerb" 367 "ZWS" 18193 "unused" 65535 "VehMode" DEFAULT_VALUE "undef" /end COMPU_VTAB
/begin COMPU_METHOD FORMULA_0973 "FORMULA_0973" TAB_VERB "%3.0" "-" COMPU_TAB_REF FORMULA_0973_VTAB /end COMPU_METHOD
/begin COMPU_VTAB FORMULA_0973_VTAB "FORMULA_0973_VTAB" TAB_VERB 3 0 "-" 1 "sende BOS nach Kl.wechsel" 2 "sende BOS nach Kombireset" /end COMPU_VTAB
/begin COMPU_METHOD FORMULA_0974 "FORMULA_0974" TAB_VERB "%5.2" "-" COMPU_TAB_REF FORMULA_0974_VTAB /end COMPU_METHOD
/begin COMPU_VTAB FORMULA_0974_VTAB "FORMULA_0974_VTAB" TAB_VERB 2 0 "Normal" 1 "SMG-CC" /end COMPU_VTAB
/* ------------------ Abschnitt erzeugt aus mvac.dat ------------------ */
/begin COMPU_METHOD FORMULA_0975 "FORMULA_0975" RAT_FUNC "%9.4" "g" COEFFS 0 512 0 0 0 1 /end COMPU_METHOD
/begin COMPU_METHOD FORMULA_0976 "FORMULA_0976" RAT_FUNC "%11.4" "kg/h" COEFFS 0 512 0 0 0 1 /end COMPU_METHOD
/begin COMPU_METHOD FORMULA_0977 "FORMULA_0977" TAB_VERB "%5.2" "-" COMPU_TAB_REF FORMULA_0977_VTAB /end COMPU_METHOD
/begin COMPU_VTAB FORMULA_0977_VTAB "FORMULA_0977_VTAB" TAB_VERB 2 0 "geschlossen" 1 "offen" DEFAULT_VALUE "undef" /end COMPU_VTAB
/begin COMPU_METHOD FORMULA_0978 "FORMULA_0978" RAT_FUNC "%8.1" "(kg/h)/mbar2^20" COEFFS 0 16 0 0 0 1 /end COMPU_METHOD
/begin COMPU_METHOD FORMULA_0981 "FORMULA_0981" RAT_FUNC "%11.4" "Pa/s" COEFFS 0 1600 0 0 0 1 /end COMPU_METHOD
/begin COMPU_METHOD FORMULA_0982 "FORMULA_0982" TAB_VERB "%5.2" "-" COMPU_TAB_REF FORMULA_0982_VTAB /end COMPU_METHOD
/begin COMPU_VTAB FORMULA_0982_VTAB "FORMULA_0982_VTAB" TAB_VERB 2 0 "inaktiv" 1 "aktiv" DEFAULT_VALUE "undef" /end COMPU_VTAB
/begin COMPU_METHOD FORMULA_0983 "FORMULA_0983" TAB_VERB "%5.2" "-" COMPU_TAB_REF FORMULA_0983_VTAB /end COMPU_METHOD
/begin COMPU_VTAB FORMULA_0983_VTAB "FORMULA_0983_VTAB" TAB_VERB 2 0 "nein" 1 "ja" DEFAULT_VALUE "undef" /end COMPU_VTAB
/* ------------------ Abschnitt erzeugt aus mzyl.dat ------------------ */
/begin COMPU_METHOD FORMULA_0996 "FORMULA_0996" RAT_FUNC "%8.1" "mg" COEFFS 0 10 0 0 0 1 /end COMPU_METHOD
/begin COMPU_METHOD FORMULA_0999 "FORMULA_0999" TAB_VERB "%3.0" "-" COMPU_TAB_REF FORMULA_0999_VTAB /end COMPU_METHOD
/begin COMPU_VTAB FORMULA_0999_VTAB "FORMULA_0999_VTAB" TAB_VERB 4 1 "HFM" 2 "PSAU" 4 "AQ" 8 "HFM-AQ Komb" DEFAULT_VALUE "undefiniert" /end COMPU_VTAB
/* ------------------ Abschnitt erzeugt aus nwm.dat ------------------ */
/begin COMPU_METHOD FORMULA_1006 "FORMULA_1006" TAB_VERB "%3.0" "-" COMPU_TAB_REF FORMULA_1006_VTAB /end COMPU_METHOD
/begin COMPU_VTAB FORMULA_1006_VTAB "FORMULA_1006_VTAB" TAB_VERB 13 0 "ZGM" 18 "DME1" 19 "DME2" 22 "AFS" 23 "EKP" 24 "SMG" 33 "ACC" 34 "ALC" 35 "ARS" 37 "GRS" 41 "DSC" 42 "EMF" 57 "EDCK" DEFAULT_VALUE "unbekannt" /end COMPU_VTAB
/begin COMPU_METHOD FORMULA_1007 "FORMULA_1007" TAB_VERB "%3.0" "-" COMPU_TAB_REF FORMULA_1007_VTAB /end COMPU_METHOD
/begin COMPU_VTAB FORMULA_1007_VTAB "FORMULA_1007_VTAB" TAB_VERB 21 1 "Alive" 2 "Ring" 4 "Notlauf" 8 "reserved" 16 "SleepInd" 17 "SleepInd/Alive" 18 "SleepInd/Ring" 20 "SleepInd/Notlauf" 32 "SleepAck" 33 "SleepAck/Alive" 34 "SleepAck/Ring" 36 "SleepAck/Notlauf" 64 "Umlauf" 65 "Umlauf/Alive" 66 "Umlauf/Ring" 68 "Umlauf/Notlauf" 80 "SleepInd" 81 "SleepInd/Alive" 82 "SleepInd/Ring" 84 "SleepInd/Notlauf" 128 "reserved" /end COMPU_VTAB
/begin COMPU_METHOD FORMULA_1008 "FORMULA_1008" TAB_VERB "%3.0" "-" COMPU_TAB_REF FORMULA_1008_VTAB /end COMPU_METHOD
/begin COMPU_VTAB FORMULA_1008_VTAB "FORMULA_1008_VTAB" TAB_VERB 10 0 "Nothing" 1 "Start" 2 "WaitTockenSnd" 3 "WaitRingMsg" 4 "SndSkippedAlive" 5 "WaitLimp" 6 "PrepSleep" 7 "GoSleep" 8 "Sleep" 128 "Repeat" /end COMPU_VTAB
/* ------------------ Abschnitt erzeugt aus n_max.dat ------------------ */
/begin COMPU_METHOD FORMULA_1009 "FORMULA_1009" TAB_VERB "%7.2" "-" COMPU_TAB_REF FORMULA_1009_VTAB /end COMPU_METHOD
/begin COMPU_VTAB FORMULA_1009_VTAB "FORMULA_1009_VTAB" TAB_VERB 11 1 "Standard" 2 "SK" 4 "Toel kalt" 8 "Toel heiss" 16 "Tmot kalt" 32 "FeTraWe" 64 "Fzg steht" 128 "v-Fehler" 256 "TZ-Schutz" 512 "Extern" 1024 "Tgetr heiss" /end COMPU_VTAB
/begin COMPU_METHOD FORMULA_1010 "FORMULA_1010" TAB_VERB "%5.2" "-" COMPU_TAB_REF FORMULA_1010_VTAB /end COMPU_METHOD
/begin COMPU_VTAB FORMULA_1010_VTAB "FORMULA_1010_VTAB" TAB_VERB 4 0 "inaktiv" 1 "ueber nbegr" 2 "neuer FF" 3 "ueber nbegr und FF" /end COMPU_VTAB
/* ------------------ Abschnitt erzeugt aus o2_obd.dat ------------------ */
/begin COMPU_METHOD FORMULA_1014 "FORMULA_1014" TAB_VERB "%7.2" "-" COMPU_TAB_REF FORMULA_1014_VTAB /end COMPU_METHOD
/begin COMPU_VTAB FORMULA_1014_VTAB "FORMULA_1014_VTAB" TAB_VERB 1 0 "inaktiv" DEFAULT_VALUE "Pulsgenerator" /end COMPU_VTAB
/begin COMPU_METHOD FORMULA_1015 "FORMULA_1015" TAB_VERB "%7.2" "-" COMPU_TAB_REF FORMULA_1015_VTAB /end COMPU_METHOD
/begin COMPU_VTAB FORMULA_1015_VTAB "FORMULA_1015_VTAB" TAB_VERB 1 0 "-" DEFAULT_VALUE "FETT-Hub-Trigger" /end COMPU_VTAB
/begin COMPU_METHOD FORMULA_1016 "FORMULA_1016" TAB_VERB "%7.2" "-" COMPU_TAB_REF FORMULA_1016_VTAB /end COMPU_METHOD
/begin COMPU_VTAB FORMULA_1016_VTAB "FORMULA_1016_VTAB" TAB_VERB 1 0 "-" DEFAULT_VALUE "MAGER-Hub-Trigger" /end COMPU_VTAB
/begin COMPU_METHOD FORMULA_1017 "FORMULA_1017" TAB_VERB "%7.2" "-" COMPU_TAB_REF FORMULA_1017_VTAB /end COMPU_METHOD
/begin COMPU_VTAB FORMULA_1017_VTAB "FORMULA_1017_VTAB" TAB_VERB 1 0 "-" DEFAULT_VALUE "UKP" /end COMPU_VTAB
/begin COMPU_METHOD FORMULA_1018 "FORMULA_1018" TAB_VERB "%7.2" "-" COMPU_TAB_REF FORMULA_1018_VTAB /end COMPU_METHOD
/begin COMPU_VTAB FORMULA_1018_VTAB "FORMULA_1018_VTAB" TAB_VERB 1 0 "-" DEFAULT_VALUE "UKP" /end COMPU_VTAB
/begin COMPU_METHOD FORMULA_1019 "FORMULA_1019" TAB_VERB "%7.2" "-" COMPU_TAB_REF FORMULA_1019_VTAB /end COMPU_METHOD
/begin COMPU_VTAB FORMULA_1019_VTAB "FORMULA_1019_VTAB" TAB_VERB 1 0 "-" DEFAULT_VALUE "Berechnung" /end COMPU_VTAB
/begin COMPU_METHOD FORMULA_1020 "FORMULA_1020" TAB_VERB "%7.2" "-" COMPU_TAB_REF FORMULA_1020_VTAB /end COMPU_METHOD
/begin COMPU_VTAB FORMULA_1020_VTAB "FORMULA_1020_VTAB" TAB_VERB 1 0 "sperrt" DEFAULT_VALUE "Freigabe" /end COMPU_VTAB
/begin COMPU_METHOD FORMULA_1021 "FORMULA_1021" TAB_VERB "%7.2" "-" COMPU_TAB_REF FORMULA_1021_VTAB /end COMPU_METHOD
/begin COMPU_VTAB FORMULA_1021_VTAB "FORMULA_1021_VTAB" TAB_VERB 1 0 "sperrt" DEFAULT_VALUE "Freigabe" /end COMPU_VTAB
/begin COMPU_METHOD FORMULA_1022 "FORMULA_1022" TAB_VERB "%7.2" "-" COMPU_TAB_REF FORMULA_1022_VTAB /end COMPU_METHOD
/begin COMPU_VTAB FORMULA_1022_VTAB "FORMULA_1022_VTAB" TAB_VERB 1 0 "-" DEFAULT_VALUE "FETT->MAGER" /end COMPU_VTAB
/begin COMPU_METHOD FORMULA_1023 "FORMULA_1023" TAB_VERB "%7.2" "-" COMPU_TAB_REF FORMULA_1023_VTAB /end COMPU_METHOD
/begin COMPU_VTAB FORMULA_1023_VTAB "FORMULA_1023_VTAB" TAB_VERB 1 0 "-" DEFAULT_VALUE "i.O." /end COMPU_VTAB
/begin COMPU_METHOD FORMULA_1024 "FORMULA_1024" TAB_VERB "%7.2" "-" COMPU_TAB_REF FORMULA_1024_VTAB /end COMPU_METHOD
/begin COMPU_VTAB FORMULA_1024_VTAB "FORMULA_1024_VTAB" TAB_VERB 1 0 "-" DEFAULT_VALUE "i.O." /end COMPU_VTAB
/begin COMPU_METHOD FORMULA_1025 "FORMULA_1025" TAB_VERB "%7.2" "-" COMPU_TAB_REF FORMULA_1025_VTAB /end COMPU_METHOD
/begin COMPU_VTAB FORMULA_1025_VTAB "FORMULA_1025_VTAB" TAB_VERB 1 0 "-" DEFAULT_VALUE "aktiv" /end COMPU_VTAB
/begin COMPU_METHOD FORMULA_1026 "FORMULA_1026" TAB_VERB "%7.2" "-" COMPU_TAB_REF FORMULA_1026_VTAB /end COMPU_METHOD
/begin COMPU_VTAB FORMULA_1026_VTAB "FORMULA_1026_VTAB" TAB_VERB 1 0 "-" DEFAULT_VALUE "fertig" /end COMPU_VTAB
/begin COMPU_METHOD FORMULA_1027 "FORMULA_1027" TAB_VERB "%7.2" "-" COMPU_TAB_REF FORMULA_1027_VTAB /end COMPU_METHOD
/begin COMPU_VTAB FORMULA_1027_VTAB "FORMULA_1027_VTAB" TAB_VERB 1 0 "-" DEFAULT_VALUE "aktiv" /end COMPU_VTAB
/begin COMPU_METHOD FORMULA_1028 "FORMULA_1028" RAT_FUNC "%10.3" "-" COEFFS 0 16384 0 0 0 1 /end COMPU_METHOD
/* ------------------ Abschnitt erzeugt aus pabg.dat ------------------ */
/begin COMPU_METHOD FORMULA_1032 "FORMULA_1032" RAT_FUNC "%7.2" "s" COEFFS 0 0 25.6 0 1 0 /end COMPU_METHOD
/begin COMPU_METHOD FORMULA_1035 "FORMULA_1035" TAB_VERB "%5.2" "-" COMPU_TAB_REF FORMULA_1035_VTAB /end COMPU_METHOD
/begin COMPU_VTAB FORMULA_1035_VTAB "FORMULA_1035_VTAB" TAB_VERB 2 0 "IO" 1 "100%" DEFAULT_VALUE "ungueltig" /end COMPU_VTAB
/begin COMPU_METHOD FORMULA_1036 "FORMULA_1036" TAB_VERB "%5.2" "-" COMPU_TAB_REF FORMULA_1036_VTAB /end COMPU_METHOD
/begin COMPU_VTAB FORMULA_1036_VTAB "FORMULA_1036_VTAB" TAB_VERB 4 0 "noDIAG" 1 "LL-100Proz" 2 "TL" 4 "Q-Max" DEFAULT_VALUE "ungueltig" /end COMPU_VTAB
/begin COMPU_METHOD FORMULA_1042 "FORMULA_1042" TAB_VERB "%5.2" "-" COMPU_TAB_REF FORMULA_1042_VTAB /end COMPU_METHOD
/begin COMPU_VTAB FORMULA_1042_VTAB "FORMULA_1042_VTAB" TAB_VERB 7 1 "EKP 100%" 2 "EKP geregelt" 4 "EKP gesteuert" 8 "Diagnose EKP1" 16 "Diagnose EKP2" 32 "EKPs abgeschaltet" 64 "EKP_100_Relais" DEFAULT_VALUE "ungueltig" /end COMPU_VTAB
/begin COMPU_METHOD FORMULA_1043 "FORMULA_1043" TAB_VERB "%7.2" "-" COMPU_TAB_REF FORMULA_1043_VTAB /end COMPU_METHOD
/begin COMPU_VTAB FORMULA_1043_VTAB "FORMULA_1043_VTAB" TAB_VERB 2 0 "AUS" 1 "EIN" DEFAULT_VALUE "ungueltig" /end COMPU_VTAB
/begin COMPU_METHOD FORMULA_1044 "FORMULA_1044" TAB_VERB "%7.2" "-" COMPU_TAB_REF FORMULA_1044_VTAB /end COMPU_METHOD
/begin COMPU_VTAB FORMULA_1044_VTAB "FORMULA_1044_VTAB" TAB_VERB 6 0 "ALLES IO" 1 "SENSNIO2.5" 2 "SENSNIO5.5" 4 "EKP2 NIO" 8 "SSP NIO" 16 "PABFALL VORL" /end COMPU_VTAB
/begin COMPU_METHOD FORMULA_1045 "FORMULA_1045" RAT_FUNC "%8.3" "bar/100ms" COEFFS 0 1000 0 0 0 1 /end COMPU_METHOD
/* ------------------ Abschnitt erzeugt aus pumg.dat ------------------ */
/begin COMPU_METHOD FORMULA_1056 "FORMULA_1056" TAB_VERB "%3.0" "-" COMPU_TAB_REF FORMULA_1056_VTAB /end COMPU_METHOD
/begin COMPU_VTAB FORMULA_1056_VTAB "FORMULA_1056_VTAB" TAB_VERB 2 0 "nein" 1 "ja" DEFAULT_VALUE "undef" /end COMPU_VTAB
/begin COMPU_METHOD FORMULA_1057 "FORMULA_1057" RAT_FUNC "%8.1" "mbar" COEFFS 0 16 0 0 0 1 /end COMPU_METHOD
/* ------------------ Abschnitt erzeugt aus qadc_conf.dat ------------------ */
/begin COMPU_METHOD FORMULA_1064 "FORMULA_1064" RAT_FUNC "%3.0" "z/asp" COEFFS 0 1 0 0 0 1 /end COMPU_METHOD
/* ------------------ Abschnitt erzeugt aus rf.dat ------------------ */
/begin COMPU_METHOD FORMULA_1065 "FORMULA_1065" RAT_FUNC "%5.2" "Segmente" COEFFS 0 2 0 0 0 1 /end COMPU_METHOD
/begin COMPU_METHOD FORMULA_1066 "FORMULA_1066" TAB_VERB "%5.2" "-" COMPU_TAB_REF FORMULA_1066_VTAB /end COMPU_METHOD
/begin COMPU_VTAB FORMULA_1066_VTAB "FORMULA_1066_VTAB" TAB_VERB 1 0 "RF_DYN aus" DEFAULT_VALUE "RF_DYN ein" /end COMPU_VTAB
/begin COMPU_METHOD FORMULA_1067 "FORMULA_1067" TAB_VERB "%5.2" "-" COMPU_TAB_REF FORMULA_1067_VTAB /end COMPU_METHOD
/begin COMPU_VTAB FORMULA_1067_VTAB "FORMULA_1067_VTAB" TAB_VERB 1 0 "RF_DYN aus" DEFAULT_VALUE "RF_DYN ein" /end COMPU_VTAB
/begin COMPU_METHOD FORMULA_1068 "FORMULA_1068" TAB_VERB "%5.2" "-" COMPU_TAB_REF FORMULA_1068_VTAB /end COMPU_METHOD
/begin COMPU_VTAB FORMULA_1068_VTAB "FORMULA_1068_VTAB" TAB_VERB 1 0 "RF_DYN aus" DEFAULT_VALUE "RF_DYN ein" /end COMPU_VTAB
/begin COMPU_METHOD FORMULA_1069 "FORMULA_1069" TAB_VERB "%5.2" "-" COMPU_TAB_REF FORMULA_1069_VTAB /end COMPU_METHOD
/begin COMPU_VTAB FORMULA_1069_VTAB "FORMULA_1069_VTAB" TAB_VERB 1 0 "RF_DYN aus" DEFAULT_VALUE "RF_DYN ein" /end COMPU_VTAB
/begin COMPU_METHOD FORMULA_1070 "FORMULA_1070" TAB_VERB "%5.2" "-" COMPU_TAB_REF FORMULA_1070_VTAB /end COMPU_METHOD
/begin COMPU_VTAB FORMULA_1070_VTAB "FORMULA_1070_VTAB" TAB_VERB 1 0 "RF_DYN aus" DEFAULT_VALUE "RF_DYN ein" /end COMPU_VTAB
/* ------------------ Abschnitt erzeugt aus rf_e2.dat ------------------ */
/begin COMPU_METHOD FORMULA_1074 "FORMULA_1074" TAB_VERB "%5.2" "-" COMPU_TAB_REF FORMULA_1074_VTAB /end COMPU_METHOD
/begin COMPU_VTAB FORMULA_1074_VTAB "FORMULA_1074_VTAB" TAB_VERB 2 0 "RF_DYN aus" 1 "RF_DYN ein" /end COMPU_VTAB
/* ------------------ Abschnitt erzeugt aus rg.dat ------------------ */
/begin COMPU_METHOD FORMULA_1075 "FORMULA_1075" RAT_FUNC "%9.4" "mg/ccm" COEFFS 0 4096 0 0 0 1 /end COMPU_METHOD
/* ------------------ Abschnitt erzeugt aus rps.dat ------------------ */
/begin COMPU_METHOD FORMULA_1079 "FORMULA_1079" TAB_VERB "%7.2" "-" COMPU_TAB_REF FORMULA_1079_VTAB /end COMPU_METHOD
/begin COMPU_VTAB FORMULA_1079_VTAB "FORMULA_1079_VTAB" TAB_VERB 3 1 "Regler-RESET" 2 "Regler aktiv" 4 "Regler inaktiv" /end COMPU_VTAB
/begin COMPU_METHOD FORMULA_1080 "FORMULA_1080" TAB_VERB "%7.2" "-" COMPU_TAB_REF FORMULA_1080_VTAB /end COMPU_METHOD
/begin COMPU_VTAB FORMULA_1080_VTAB "FORMULA_1080_VTAB" TAB_VERB 5 1 "LAA-RESET" 2 "LAA-AUS" 4 "LAA-F" 8 "LAA-TE-F" 16 "LAA-OFFS" /end COMPU_VTAB
/begin COMPU_METHOD FORMULA_1081 "FORMULA_1081" TAB_VERB "%5.2" "-" COMPU_TAB_REF FORMULA_1081_VTAB /end COMPU_METHOD
/begin COMPU_VTAB FORMULA_1081_VTAB "FORMULA_1081_VTAB" TAB_VERB 2 0 "kein Fehler" 1 "PKS-Fehler" /end COMPU_VTAB
/begin COMPU_METHOD FORMULA_1083 "FORMULA_1083" TAB_VERB "%5.2" "-" COMPU_TAB_REF FORMULA_1083_VTAB /end COMPU_METHOD
/begin COMPU_VTAB FORMULA_1083_VTAB "FORMULA_1083_VTAB" TAB_VERB 19 0 "Inaktiv" 1 "Wandfilm" 2 "Lambdaregler" 3 "Lambdaadaption" 4 "Restgas" 5 "Abgasgegendruck" 6 "Ansauglufttemp" 7 "Fahrerwunsch" 8 "Leerlaufregler" 9 "Ionenstrom" 10 "Aussetzer" 11 "Vanoskatheizen" 12 "Motortemperatur" 13 "Kraftstoffdruck" 14 "Lastschlag" 15 "Zylindergleichst." 16 "Tankentlueftung" 17 "Aut. KF-Bedatung" 18 "Riemenstarter" DEFAULT_VALUE "undef" /end COMPU_VTAB
/* ------------------ Abschnitt erzeugt aus schalter_inj.dat ------------------ */
/begin COMPU_METHOD FORMULA_1084 "FORMULA_1084" TAB_VERB "%7.2" "-" COMPU_TAB_REF FORMULA_1084_VTAB /end COMPU_METHOD
/begin COMPU_VTAB FORMULA_1084_VTAB "FORMULA_1084_VTAB" TAB_VERB 1 0 "offen" DEFAULT_VALUE "geschlossen" /end COMPU_VTAB
/begin COMPU_METHOD FORMULA_1085 "FORMULA_1085" TAB_VERB "%5.2" "-" COMPU_TAB_REF FORMULA_1085_VTAB /end COMPU_METHOD
/begin COMPU_VTAB FORMULA_1085_VTAB "FORMULA_1085_VTAB" TAB_VERB 2 0 "nein" 1 "ja" /end COMPU_VTAB
/begin COMPU_METHOD FORMULA_1086 "FORMULA_1086" TAB_VERB "%7.2" "-" COMPU_TAB_REF FORMULA_1086_VTAB /end COMPU_METHOD
/begin COMPU_VTAB FORMULA_1086_VTAB "FORMULA_1086_VTAB" TAB_VERB 1 0 "offen" DEFAULT_VALUE "Kraftschluss" /end COMPU_VTAB
/* ------------------ Abschnitt erzeugt aus sk_inj.dat ------------------ */
/begin COMPU_METHOD FORMULA_1089 "FORMULA_1089" TAB_VERB "%3.0" "-" COMPU_TAB_REF FORMULA_1089_VTAB /end COMPU_METHOD
/begin COMPU_VTAB FORMULA_1089_VTAB "FORMULA_1089_VTAB" TAB_VERB 2 0 "Ok" 1 "AD-Err" /end COMPU_VTAB
/begin COMPU_METHOD FORMULA_1090 "FORMULA_1090" TAB_VERB "%3.0" "-" COMPU_TAB_REF FORMULA_1090_VTAB /end COMPU_METHOD
/begin COMPU_VTAB FORMULA_1090_VTAB "FORMULA_1090_VTAB" TAB_VERB 5 0 "Init" 1 "Wait" 2 "Error_1" 3 "Error_2" 4 "New" /end COMPU_VTAB
/* ------------------ Abschnitt erzeugt aus sls_obd.dat ------------------ */
/begin COMPU_METHOD FORMULA_1096 "FORMULA_1096" RAT_FUNC "%8.1" "kg*s/h" COEFFS 0 1000 0 0 0 1 /end COMPU_METHOD
/begin COMPU_METHOD FORMULA_1098 "FORMULA_1098" TAB_VERB "%8.1" "-" COMPU_TAB_REF FORMULA_1098_VTAB /end COMPU_METHOD
/begin COMPU_VTAB FORMULA_1098_VTAB "FORMULA_1098_VTAB" TAB_VERB 14 0 "nicht angelaufen" 1 "Mini-HFM IO" 2 "Mini-HFM NIO" 5 "ML-Plausi IO" 9 "SLP inaktiv" 17 "SLV kl.geschl.,Haupt-Ltg verstopft" 37 "MDF IO" 69 "SLS grobe Undichtigkeit" 133 "SLS blockiert" 293 "ZWD IO" 549 "ZWD klemmt" 1317 "SLV IO" 2341 "EUV haengt offen" 4389 "ASV re. haengt offen" /end COMPU_VTAB
/begin COMPU_METHOD FORMULA_1099 "FORMULA_1099" TAB_VERB "%6.1" "-" COMPU_TAB_REF FORMULA_1099_VTAB /end COMPU_METHOD
/begin COMPU_VTAB FORMULA_1099_VTAB "FORMULA_1099_VTAB" TAB_VERB 7 0 "nicht angelaufen" 1 "MDF DIAG IO" 2 "Max Intg zu gross" 4 "Min Intg zu gross" 16 "LAM B1 gr B2" 32 "LAM B1 kl B2" 64 "LAM B1 gl B2" DEFAULT_VALUE "undef" /end COMPU_VTAB
/begin COMPU_METHOD FORMULA_1100 "FORMULA_1100" TAB_VERB "%7.2" "-" COMPU_TAB_REF FORMULA_1100_VTAB /end COMPU_METHOD
/begin COMPU_VTAB FORMULA_1100_VTAB "FORMULA_1100_VTAB" TAB_VERB 1 0 "IO" DEFAULT_VALUE "abbruch" /end COMPU_VTAB
/begin COMPU_METHOD FORMULA_1101 "FORMULA_1101" TAB_VERB "%7.2" "-" COMPU_TAB_REF FORMULA_1101_VTAB /end COMPU_METHOD
/begin COMPU_VTAB FORMULA_1101_VTAB "FORMULA_1101_VTAB" TAB_VERB 2 0 "IO" 1 "abbruch" /end COMPU_VTAB
/begin COMPU_METHOD FORMULA_1102 "FORMULA_1102" TAB_VERB "%7.2" "-" COMPU_TAB_REF FORMULA_1102_VTAB /end COMPU_METHOD
/begin COMPU_VTAB FORMULA_1102_VTAB "FORMULA_1102_VTAB" TAB_VERB 2 0 "IO" 1 "abbruch" /end COMPU_VTAB
/begin COMPU_METHOD FORMULA_1103 "FORMULA_1103" TAB_VERB "%7.2" "-" COMPU_TAB_REF FORMULA_1103_VTAB /end COMPU_METHOD
/begin COMPU_VTAB FORMULA_1103_VTAB "FORMULA_1103_VTAB" TAB_VERB 2 0 "IO" 1 "abbruch" /end COMPU_VTAB
/begin COMPU_METHOD FORMULA_1104 "FORMULA_1104" TAB_VERB "%7.2" "-" COMPU_TAB_REF FORMULA_1104_VTAB /end COMPU_METHOD
/begin COMPU_VTAB FORMULA_1104_VTAB "FORMULA_1104_VTAB" TAB_VERB 2 0 "IO" 1 "abbruch" /end COMPU_VTAB
/begin COMPU_METHOD FORMULA_1105 "FORMULA_1105" TAB_VERB "%7.2" "-" COMPU_TAB_REF FORMULA_1105_VTAB /end COMPU_METHOD
/begin COMPU_VTAB FORMULA_1105_VTAB "FORMULA_1105_VTAB" TAB_VERB 2 0 "IO" 1 "abbruch" /end COMPU_VTAB
/begin COMPU_METHOD FORMULA_1106 "FORMULA_1106" TAB_VERB "%7.2" "-" COMPU_TAB_REF FORMULA_1106_VTAB /end COMPU_METHOD
/begin COMPU_VTAB FORMULA_1106_VTAB "FORMULA_1106_VTAB" TAB_VERB 2 0 "IO" 1 "abbruch" /end COMPU_VTAB
/begin COMPU_METHOD FORMULA_1107 "FORMULA_1107" TAB_VERB "%7.2" "-" COMPU_TAB_REF FORMULA_1107_VTAB /end COMPU_METHOD
/begin COMPU_VTAB FORMULA_1107_VTAB "FORMULA_1107_VTAB" TAB_VERB 2 0 "IO" 1 "abbruch" /end COMPU_VTAB
/begin COMPU_METHOD FORMULA_1108 "FORMULA_1108" TAB_VERB "%7.2" "-" COMPU_TAB_REF FORMULA_1108_VTAB /end COMPU_METHOD
/begin COMPU_VTAB FORMULA_1108_VTAB "FORMULA_1108_VTAB" TAB_VERB 2 0 "IO" 1 "abbruch" /end COMPU_VTAB
/begin COMPU_METHOD FORMULA_1109 "FORMULA_1109" TAB_VERB "%7.2" "-" COMPU_TAB_REF FORMULA_1109_VTAB /end COMPU_METHOD
/begin COMPU_VTAB FORMULA_1109_VTAB "FORMULA_1109_VTAB" TAB_VERB 2 0 "IO" 1 "abbruch" /end COMPU_VTAB
/begin COMPU_METHOD FORMULA_1110 "FORMULA_1110" TAB_VERB "%7.2" "-" COMPU_TAB_REF FORMULA_1110_VTAB /end COMPU_METHOD
/begin COMPU_VTAB FORMULA_1110_VTAB "FORMULA_1110_VTAB" TAB_VERB 2 0 "IO" 1 "abbruch" /end COMPU_VTAB
/begin COMPU_METHOD FORMULA_1111 "FORMULA_1111" TAB_VERB "%7.2" "-" COMPU_TAB_REF FORMULA_1111_VTAB /end COMPU_METHOD
/begin COMPU_VTAB FORMULA_1111_VTAB "FORMULA_1111_VTAB" TAB_VERB 2 0 "IO" 1 "abbruch" /end COMPU_VTAB
/begin COMPU_METHOD FORMULA_1112 "FORMULA_1112" TAB_VERB "%7.2" "-" COMPU_TAB_REF FORMULA_1112_VTAB /end COMPU_METHOD
/begin COMPU_VTAB FORMULA_1112_VTAB "FORMULA_1112_VTAB" TAB_VERB 2 0 "IO" 1 "abbruch" /end COMPU_VTAB
/begin COMPU_METHOD FORMULA_1113 "FORMULA_1113" TAB_VERB "%7.2" "-" COMPU_TAB_REF FORMULA_1113_VTAB /end COMPU_METHOD
/begin COMPU_VTAB FORMULA_1113_VTAB "FORMULA_1113_VTAB" TAB_VERB 2 0 "IO" 1 "abbruch" /end COMPU_VTAB
/begin COMPU_METHOD FORMULA_1114 "FORMULA_1114" TAB_VERB "%7.2" "-" COMPU_TAB_REF FORMULA_1114_VTAB /end COMPU_METHOD
/begin COMPU_VTAB FORMULA_1114_VTAB "FORMULA_1114_VTAB" TAB_VERB 2 0 "IO" 1 "abbruch" /end COMPU_VTAB
/begin COMPU_METHOD FORMULA_1115 "FORMULA_1115" TAB_VERB "%7.2" "-" COMPU_TAB_REF FORMULA_1115_VTAB /end COMPU_METHOD
/begin COMPU_VTAB FORMULA_1115_VTAB "FORMULA_1115_VTAB" TAB_VERB 2 0 "IO" 1 "abbruch" /end COMPU_VTAB
/begin COMPU_METHOD FORMULA_1116 "FORMULA_1116" TAB_VERB "%7.2" "-" COMPU_TAB_REF FORMULA_1116_VTAB /end COMPU_METHOD
/begin COMPU_VTAB FORMULA_1116_VTAB "FORMULA_1116_VTAB" TAB_VERB 2 0 "IO" 1 "abbruch" /end COMPU_VTAB
/begin COMPU_METHOD FORMULA_1117 "FORMULA_1117" RAT_FUNC "%10.3" "-*s" COEFFS 0 16384 0 0 0 1 /end COMPU_METHOD
/begin COMPU_METHOD FORMULA_1119 "FORMULA_1119" TAB_VERB "%5.2" "-" COMPU_TAB_REF FORMULA_1119_VTAB /end COMPU_METHOD
/begin COMPU_VTAB FORMULA_1119_VTAB "FORMULA_1119_VTAB" TAB_VERB 2 0 "AUS" 1 "AN" DEFAULT_VALUE "undefiniert" /end COMPU_VTAB
/* ------------------ Abschnitt erzeugt aus spgr.dat ------------------ */
/begin COMPU_METHOD FORMULA_1125 "FORMULA_1125" RAT_FUNC "%3.0" "kHz" COEFFS 0 0 10000000 0 714 0 /end COMPU_METHOD
/begin COMPU_METHOD FORMULA_1126 "FORMULA_1126" RAT_FUNC "%5.0" "kHz" COEFFS 0 0 10000000 0 714 0 /end COMPU_METHOD
/* ------------------ Abschnitt erzeugt aus ssp.dat ------------------ */
/begin COMPU_METHOD FORMULA_1127 "FORMULA_1127" RAT_FUNC "%8.1" "qmm" COEFFS 0 10 0 0 0 1 /end COMPU_METHOD
/* ------------------ Abschnitt erzeugt aus tanzyl.dat ------------------ */
/begin COMPU_METHOD FORMULA_1129 "FORMULA_1129" TAB_VERB "%3.0" "-" COMPU_TAB_REF FORMULA_1129_VTAB /end COMPU_METHOD
/begin COMPU_VTAB FORMULA_1129_VTAB "FORMULA_1129_VTAB" TAB_VERB 2 0 "Modellierung" 255 "Initialisierung" /end COMPU_VTAB
/* ------------------ Abschnitt erzeugt aus te.dat ------------------ */
/begin COMPU_METHOD FORMULA_1131 "FORMULA_1131" TAB_VERB "%5.2" "-" COMPU_TAB_REF FORMULA_1131_VTAB /end COMPU_METHOD
/begin COMPU_VTAB FORMULA_1131_VTAB "FORMULA_1131_VTAB" TAB_VERB 2 0 "nein" 1 "ja" /end COMPU_VTAB
/begin COMPU_METHOD FORMULA_1132 "FORMULA_1132" TAB_VERB "%5.2" "-" COMPU_TAB_REF FORMULA_1132_VTAB /end COMPU_METHOD
/begin COMPU_VTAB FORMULA_1132_VTAB "FORMULA_1132_VTAB" TAB_VERB 2 0 "nein -" 1 "ja" /end COMPU_VTAB
/begin COMPU_METHOD FORMULA_1133 "FORMULA_1133" TAB_VERB "%5.2" "-" COMPU_TAB_REF FORMULA_1133_VTAB /end COMPU_METHOD
/begin COMPU_VTAB FORMULA_1133_VTAB "FORMULA_1133_VTAB" TAB_VERB 2 0 "nein" 1 "ja" /end COMPU_VTAB
/begin COMPU_METHOD FORMULA_1134 "FORMULA_1134" TAB_VERB "%5.2" "-" COMPU_TAB_REF FORMULA_1134_VTAB /end COMPU_METHOD
/begin COMPU_VTAB FORMULA_1134_VTAB "FORMULA_1134_VTAB" TAB_VERB 8 0 "keine" 1 "LAM_REG" 2 "TI_MIN" 3 "LAM_REG+TI_MIN" 4 "LAM_DELTA" 5 "LAM_REG+LAM_DELTA" 6 "TI_MIN+LAM_DELTA" 7 "LAM_REG+TI_MIN+LAM_DELTA" DEFAULT_VALUE "undef" /end COMPU_VTAB
/begin COMPU_METHOD FORMULA_1135 "FORMULA_1135" TAB_VERB "%7.2" "-" COMPU_TAB_REF FORMULA_1135_VTAB /end COMPU_METHOD
/begin COMPU_VTAB FORMULA_1135_VTAB "FORMULA_1135_VTAB" TAB_VERB 4 1 "INI" 2 "RESET" 4 "LERNEN" 8 "RED.LERNEN" DEFAULT_VALUE "nicht verf." /end COMPU_VTAB
/begin COMPU_METHOD FORMULA_1136 "FORMULA_1136" TAB_VERB "%7.2" "-" COMPU_TAB_REF FORMULA_1136_VTAB /end COMPU_METHOD
/begin COMPU_VTAB FORMULA_1136_VTAB "FORMULA_1136_VTAB" TAB_VERB 2 0 "-" 1 "aktiviert" /end COMPU_VTAB
/begin COMPU_METHOD FORMULA_1137 "FORMULA_1137" TAB_VERB "%7.2" "-" COMPU_TAB_REF FORMULA_1137_VTAB /end COMPU_METHOD
/begin COMPU_VTAB FORMULA_1137_VTAB "FORMULA_1137_VTAB" TAB_VERB 2 0 "-" 1 "aktiviert" /end COMPU_VTAB
/begin COMPU_METHOD FORMULA_1138 "FORMULA_1138" RAT_FUNC "%9.4" "1/100ms" COEFFS 0 32768 0 0 0 1 /end COMPU_METHOD
/begin COMPU_METHOD FORMULA_1139 "FORMULA_1139" RAT_FUNC "%8.3" "m3/kg" COEFFS 0 1000 0 0 0 1 /end COMPU_METHOD
/begin COMPU_METHOD FORMULA_1141 "FORMULA_1141" RAT_FUNC "%5.0" "kg/(m2*s)" COEFFS 0 1 0 0 0 1 /end COMPU_METHOD
/begin COMPU_METHOD FORMULA_1145 "FORMULA_1145" RAT_FUNC "%8.3" "l/min" COEFFS 0 500 0 0 0 1 /end COMPU_METHOD
/begin COMPU_METHOD FORMULA_1146 "FORMULA_1146" RAT_FUNC "%9.2" "l" COEFFS 0 300000 0 0 0 1 /end COMPU_METHOD
/* ------------------ Abschnitt erzeugt aus te_obd.dat ------------------ */
/begin COMPU_METHOD FORMULA_1153 "FORMULA_1153" RAT_FUNC "%7.2" "nSs" COEFFS 0 1 0 0 0 0.00061 /end COMPU_METHOD
/begin COMPU_METHOD FORMULA_1154 "FORMULA_1154" RAT_FUNC "%7.2" "kg/h" COEFFS 0 640 0 0 0 1 /end COMPU_METHOD
/begin COMPU_METHOD FORMULA_1155 "FORMULA_1155" TAB_VERB "%5.2" "-" COMPU_TAB_REF FORMULA_1155_VTAB /end COMPU_METHOD
/begin COMPU_VTAB FORMULA_1155_VTAB "FORMULA_1155_VTAB" TAB_VERB 6 0 "AUS" 1 "MESSEN" 2 "DEFEKT" 3 "OK_LAM" 4 "OK_AUSS" 5 "OK_LL" /end COMPU_VTAB
/begin COMPU_METHOD FORMULA_1156 "FORMULA_1156" TAB_VERB "%5.2" "-" COMPU_TAB_REF FORMULA_1156_VTAB /end COMPU_METHOD
/begin COMPU_VTAB FORMULA_1156_VTAB "FORMULA_1156_VTAB" TAB_VERB 28 0 "AUS" 1 "WAIT_TOEL" 2 "WAIT_KATH" 3 "WAIT_TESTER" 4 "WAIT_LRW" 5 "WAIT_V" 6 "WAIT_KKOS" 7 "WAIT_GEN" 8 "WAIT_BLS" 9 "WAIT_ML" 10 "WAIT_LL" 11 "WAIT_UB" 12 "WAIT_FEHLER" 13 "WAIT_DMTL" 14 "WAIT_LAM" 15 "WAIT_TZ" 16 "WAIT_PRUEFSTAND" 17 "WAIT_LLR" 18 "START_DELAY" 19 "PRE_SCHL" 20 "PRE_ZU" 21 "TEV_OEFFNEN" 22 "TEV_OFFEN" 23 "TEV_SCHLIESSEN" 24 "TEV_ZU" 25 "ABBRUCH" 26 "FERTIG" 27 "NEUSTART" /end COMPU_VTAB
/begin COMPU_METHOD FORMULA_1160 "FORMULA_1160" TAB_VERB "%3.0" "-" COMPU_TAB_REF FORMULA_1160_VTAB /end COMPU_METHOD
/begin COMPU_VTAB FORMULA_1160_VTAB "FORMULA_1160_VTAB" TAB_VERB 2 0 "Lampe aus" 1 "Lampe an" /end COMPU_VTAB
/begin COMPU_METHOD FORMULA_1166 "FORMULA_1166" TAB_VERB "%7.2" "-" COMPU_TAB_REF FORMULA_1166_VTAB /end COMPU_METHOD
/begin COMPU_VTAB FORMULA_1166_VTAB "FORMULA_1166_VTAB" TAB_VERB 1 0 "inaktiv" DEFAULT_VALUE "aktiv" /end COMPU_VTAB
/begin COMPU_METHOD FORMULA_1168 "FORMULA_1168" TAB_VERB "%7.2" "-" COMPU_TAB_REF FORMULA_1168_VTAB /end COMPU_METHOD
/begin COMPU_VTAB FORMULA_1168_VTAB "FORMULA_1168_VTAB" TAB_VERB 1 0 "no" DEFAULT_VALUE "yes" /end COMPU_VTAB
/begin COMPU_METHOD FORMULA_1169 "FORMULA_1169" TAB_VERB "%7.2" "-" COMPU_TAB_REF FORMULA_1169_VTAB /end COMPU_METHOD
/begin COMPU_VTAB FORMULA_1169_VTAB "FORMULA_1169_VTAB" TAB_VERB 1 0 "-" DEFAULT_VALUE "max" /end COMPU_VTAB
/begin COMPU_METHOD FORMULA_1170 "FORMULA_1170" TAB_VERB "%7.2" "-" COMPU_TAB_REF FORMULA_1170_VTAB /end COMPU_METHOD
/begin COMPU_VTAB FORMULA_1170_VTAB "FORMULA_1170_VTAB" TAB_VERB 1 0 "-" DEFAULT_VALUE "min" /end COMPU_VTAB
/begin COMPU_METHOD FORMULA_1171 "FORMULA_1171" RAT_FUNC "%5.0" "Zylinder" COEFFS 0 1 0 0 0 1 /end COMPU_METHOD
/* ------------------ Abschnitt erzeugt aus vanos.dat ------------------ */
/begin COMPU_METHOD FORMULA_1191 "FORMULA_1191" RAT_FUNC "%5.0" "�KW/s" COEFFS 0 1 0 0 0 1 /end COMPU_METHOD
/begin COMPU_METHOD FORMULA_1193 "FORMULA_1193" TAB_VERB "%5.2" "-" COMPU_TAB_REF FORMULA_1193_VTAB /end COMPU_METHOD
/begin COMPU_VTAB FORMULA_1193_VTAB "FORMULA_1193_VTAB" TAB_VERB 38 0 "AUS" 1 "START" 2 "WAIT_LLR_HOCH" 3 "ANSCHL_MAX_E1" 4 "ANSCHL_MIN_E1" 5 "ANSCHL_MAX_A1" 6 "ANSCHL_MIN_A1" 7 "ANSCHL_MAX_E2" 8 "ANSCHL_MIN_E2" 9 "ANSCHL_MAX_A2" 10 "ANSCHL_MIN_A2" 11 "VERST_PRE_KLEIN_E1" 12 "VERST_KLEIN_E1" 13 "VERST_PRE_GROSS_E1" 14 "VERST_GROSS_E1" 15 "VERST_PRE_KLEIN_A1" 16 "VERST_KLEIN_A1" 17 "VERST_PRE_GROSS_A1" 18 "VERST_GROSS_A1" 19 "VERST_PRE_KLEIN_E2" 20 "VERST_KLEIN_E2" 21 "VERST_PRE_GROSS_E2" 22 "VERST_GROSS_E2" 23 "VERST_PRE_KLEIN_A2" 24 "VERST_KLEIN_A2" 25 "VERST_PRE_GROSS_A2" 26 "VERST_GROSS_A2" 27 "WAIT_LLR_NORM" 28 "MESS_GUETE" 29 "DSV1" 30 "DSV2" 31 "DSV3" 32 "DSV4" 33 "DSV5" 34 "DSV6" 35 "DSV7" 36 "DSV8" 37 "VAN_ABBRUCH" DEFAULT_VALUE "undef" /end COMPU_VTAB
/begin COMPU_METHOD FORMULA_1195 "FORMULA_1195" TAB_VERB "%5.2" "-" COMPU_TAB_REF FORMULA_1195_VTAB /end COMPU_METHOD
/begin COMPU_VTAB FORMULA_1195_VTAB "FORMULA_1195_VTAB" TAB_VERB 2 0 "kein Druck" 1 "Druck" /end COMPU_VTAB
/begin COMPU_METHOD FORMULA_1196 "FORMULA_1196" TAB_VERB "%5.2" "-" COMPU_TAB_REF FORMULA_1196_VTAB /end COMPU_METHOD
/begin COMPU_VTAB FORMULA_1196_VTAB "FORMULA_1196_VTAB" TAB_VERB 2 0 "aus" 1 "aktiv" /end COMPU_VTAB
/begin COMPU_METHOD FORMULA_1199 "FORMULA_1199" RAT_FUNC "%7.0" "mA" COEFFS 0 65536 0 0 0 1 /end COMPU_METHOD
/begin COMPU_METHOD FORMULA_1204 "FORMULA_1204" TAB_VERB "%5.2" "-" COMPU_TAB_REF FORMULA_1204_VTAB /end COMPU_METHOD
/begin COMPU_VTAB FORMULA_1204_VTAB "FORMULA_1204_VTAB" TAB_VERB 2 0 "Kein Eingriff" 1 "SMG Schaltung" DEFAULT_VALUE "undef." /end COMPU_VTAB
/begin COMPU_METHOD FORMULA_1206 "FORMULA_1206" TAB_VERB "%5.2" "-" COMPU_TAB_REF FORMULA_1206_VTAB /end COMPU_METHOD
/begin COMPU_VTAB FORMULA_1206_VTAB "FORMULA_1206_VTAB" TAB_VERB 1 3 "ja" DEFAULT_VALUE "nein" /end COMPU_VTAB
/begin COMPU_METHOD FORMULA_1207 "FORMULA_1207" TAB_VERB "%5.2" "-" COMPU_TAB_REF FORMULA_1207_VTAB /end COMPU_METHOD
/begin COMPU_VTAB FORMULA_1207_VTAB "FORMULA_1207_VTAB" TAB_VERB 1 3 "ja" DEFAULT_VALUE "nein" /end COMPU_VTAB
/begin COMPU_METHOD FORMULA_1208 "FORMULA_1208" TAB_VERB "%5.2" "-" COMPU_TAB_REF FORMULA_1208_VTAB /end COMPU_METHOD
/begin COMPU_VTAB FORMULA_1208_VTAB "FORMULA_1208_VTAB" TAB_VERB 1 0 "nein" DEFAULT_VALUE "ja" /end COMPU_VTAB
/begin COMPU_METHOD FORMULA_1209 "FORMULA_1209" TAB_VERB "%5.2" "-" COMPU_TAB_REF FORMULA_1209_VTAB /end COMPU_METHOD
/begin COMPU_VTAB FORMULA_1209_VTAB "FORMULA_1209_VTAB" TAB_VERB 2 0 "o.k" 1 "unplausibel" DEFAULT_VALUE "undef." /end COMPU_VTAB
/begin COMPU_METHOD FORMULA_1210 "FORMULA_1210" TAB_VERB "%5.2" "-" COMPU_TAB_REF FORMULA_1210_VTAB /end COMPU_METHOD
/begin COMPU_VTAB FORMULA_1210_VTAB "FORMULA_1210_VTAB" TAB_VERB 3 0 "verriegelt" 1 "dyn begrenzt" 2 "frei" DEFAULT_VALUE "undef." /end COMPU_VTAB
/* ------------------ Abschnitt erzeugt aus van_dsv.dat ------------------ */
/begin COMPU_METHOD FORMULA_1226 "FORMULA_1226" TAB_VERB "%3.0" "-" COMPU_TAB_REF FORMULA_1226_VTAB /end COMPU_METHOD
/begin COMPU_VTAB FORMULA_1226_VTAB "FORMULA_1226_VTAB" TAB_VERB 8 0 "AUS" 1 "EIN_BEI_START" 2 "EIN_NACH_START" 3 "ABFALLEN_START" 4 "AUS_DRUCKERKENN" 5 "EIN_BEI_DRUCK" 6 "ABFALLEN_ABSTELL" 7 "KS_AUS" DEFAULT_VALUE "undef" /end COMPU_VTAB
/* ------------------ Abschnitt erzeugt aus vfz.dat ------------------ */
/begin COMPU_METHOD FORMULA_1229 "FORMULA_1229" TAB_VERB "%3.0" "-" COMPU_TAB_REF FORMULA_1229_VTAB /end COMPU_METHOD
/begin COMPU_VTAB FORMULA_1229_VTAB "FORMULA_1229_VTAB" TAB_VERB 2 0 "v_direkt" 1 "v_CAN" DEFAULT_VALUE "undef" /end COMPU_VTAB
/* ------------------ Abschnitt erzeugt aus wf.dat ------------------ */
/begin COMPU_METHOD FORMULA_1231 "FORMULA_1231" RAT_FUNC "%5.0" "Segm" COEFFS 0 1 0 0 0 1 /end COMPU_METHOD
/begin COMPU_METHOD FORMULA_1233 "FORMULA_1233" RAT_FUNC "%5.2" "-/segm" COEFFS 0 256 0 0 0 1 /end COMPU_METHOD
/* ------------------ Abschnitt erzeugt aus zust_inj.dat ------------------ */
/begin COMPU_METHOD FORMULA_1238 "FORMULA_1238" TAB_VERB "%5.2" "-" COMPU_TAB_REF FORMULA_1238_VTAB /end COMPU_METHOD
/begin COMPU_VTAB FORMULA_1238_VTAB "FORMULA_1238_VTAB" TAB_VERB 2 1 "powerDown" 3 "powerDown hart" DEFAULT_VALUE "aus" /end COMPU_VTAB
/begin COMPU_METHOD FORMULA_1239 "FORMULA_1239" TAB_VERB "%5.2" "-" COMPU_TAB_REF FORMULA_1239_VTAB /end COMPU_METHOD
/begin COMPU_VTAB FORMULA_1239_VTAB "FORMULA_1239_VTAB" TAB_VERB 3 0 "Inaktiv" 1 "Aktiv" 2 "Ist-Md" /end COMPU_VTAB
/begin COMPU_METHOD FORMULA_1240 "FORMULA_1240" RAT_FUNC "%7.2" "ms" COEFFS 0 1 0 0 0 1 /end COMPU_METHOD
/* ------------------ Abschnitt erzeugt aus zwktibs.dat ------------------ */
/begin COMPU_METHOD FORMULA_1241 "FORMULA_1241" TAB_VERB "%3.0" "-" COMPU_TAB_REF FORMULA_1241_VTAB /end COMPU_METHOD
/begin COMPU_VTAB FORMULA_1241_VTAB "FORMULA_1241_VTAB" TAB_VERB 12 0 "BSD_IDLE" 1 "BSDHTOK" 2 "BSDWRITE" 4 "BSDDO/BSDHTOK" 5 "BSDDO/BSDHTOK" 7 "BSDDO/BSDWRITE/BSDHTOK" 8 "BSDBSY" 16 "BSDRXRDY" 17 "BSDRXRDY/BSDHTOK" 32 "BSDTXOK" 64 "BSDDTRQ" 48 "BSDTXIND" /end COMPU_VTAB
/* ------------------ Abschnitt erzeugt aus fplau.dat ------------------ */
/begin CHARACTERISTIC K_FPLAU_OBD_CFG "Freigabe Bit f�r die Plausibilit�tsdiagnose | EN: Enable bit for the plausibility diagnosis" VALUE 0x71E72 TKW_VV_VV_UB 100.0 FORMULA_0712 0.0 255.0 /end CHARACTERISTIC
/begin CHARACTERISTIC K_FPLAU_OBD_TMOT_MIN "K�hlwassertemperaturschwelle zum Aktiveren der Diagnose " VALUE 0x71E74 TKW_VV_VV_SW 100.0 FORMULA_0023 -50.0000 170.0000 FORMAT "%4.1" /end CHARACTERISTIC
/begin CHARACTERISTIC K_FPLAU_OBD_T_MIN "Diagnose Sperrzeit nach Motor Start | EN: Diagnose Sperrzeit nach Motor Start" VALUE 0x71E76 TKW_VV_VV_UW 100.0 FORMULA_0073 0.0 6553.5000 FORMAT "%4.1" /end CHARACTERISTIC
/begin CHARACTERISTIC K_FPLAU_OBD_N_MIN "Minimale Motordrehzahl zum Aktiveren der Diagnose | EN: Minimale Motordrehzahl zum Aktiveren der Diagnose" VALUE 0x71E78 TKW_VV_VV_SW 100.0 FORMULA_0006 0.0 10000.0000 /end CHARACTERISTIC
/begin CHARACTERISTIC K_FPLAU_OBD_N_MAX "Maximale Motordrehzahl zum Aktiveren der Diagnose | EN: Maximale Motordrehzahl  zum Aktiveren der Diagnose" VALUE 0x71E7A TKW_VV_VV_SW 100.0 FORMULA_0006 0.0 10000.0000 /end CHARACTERISTIC
/begin CHARACTERISTIC K_FPLAU_OBD_T_MAX "Maximale Zeit, in der die Abweichung anliegen muss, bis ein Fehler eingetragen wird | EN: Maximale Zeit, in der die Abwe i- chung anliegen muss, bis ein Fehler eingetragen wird" VALUE 0x71E7C TKW_VV_VV_UW 100.0 FORMULA_0073 0.0 6553.5000 FORMAT "%4.1" /end CHARACTERISTIC
/begin CHARACTERISTIC K_FPLAU_OBD_T_DELTA "Zeit nach der die Diagnose als IO betrachtet wird | EN: Zeit nach der die Diagnose als IO betrachtet wird Luftmassenmesser/ Saugrohrdrucksensor Plausibilitä" VALUE 0x71E7E TKW_VV_VV_UW 100.0 FORMULA_0073 0.0 6553.5000 FORMAT "%4.1" /end CHARACTERISTIC
/begin CHARACTERISTIC K_FPLAU_HFM_OBD_CNT "Fehlerschwelle, wenn �berschritten erfolgt ein Fehlereintrag | EN: Fehlerschwelle, wenn ï¿½berschritten erfolgt ein Fehlereintrag" VALUE 0x71E80 TKW_VV_VV_UB 100.0 FORMULA_0003 0.0 255.0000 /end CHARACTERISTIC
/begin CHARACTERISTIC K_FPLAU_LAM_OBD_CNT "Fehlerschwelle, wenn �berschritten erfolgt ein Fehlereintrag | EN: Fehlerschwelle, wenn überschri t-ten erfolgt ein Fehlereintrag" VALUE 0x71E81 TKW_VV_VV_UB 100.0 FORMULA_0003 0.0 255.0000 /end CHARACTERISTIC
/begin CHARACTERISTIC K_FPLAU_AQ_OBD_CNT "Fehlerschwelle, wenn �berschritten erfolgt ein Fehlereintrag | EN: Fehlerschwelle, wenn überschri t-ten erfolgt ein Fehlereintrag" VALUE 0x71E82 TKW_VV_VV_UB 100.0 FORMULA_0003 0.0 255.0000 /end CHARACTERISTIC
/begin CHARACTERISTIC K_FPLAU_OBD_DYN_DELTA_RF "Dynamikschwelle RF | EN: Dynamikschwelle RF" VALUE 0x71E84 TKW_VV_VV_SW 100.0 FORMULA_0007 0.0 2.0000 FORMAT "%6.3" /end CHARACTERISTIC
/begin CHARACTERISTIC K_FPLAU_OBD_DYN_RF_T "Zeit nach Dynamikabbruch durch rf, bevor die Diagnose weiterlaeuft | EN: Zeit nach Dynamikabbruch durch rf, bevor die Diagnose weiterlaeuft" VALUE 0x71E86 TKW_VV_VV_UW 100.0 FORMULA_0021 0.0 655.0000 FORMAT "%5.2" /end CHARACTERISTIC
/begin CHARACTERISTIC K_FPLAU_OBD_ML_MIN "Minimale Luftmasse zum Aktiveren der Diagnose" VALUE 0x71E88 TKW_VV_VV_SW 100.0 FORMULA_0112 -100.0000 1400.0000 FORMAT "%4.1" /end CHARACTERISTIC
/begin CHARACTERISTIC K_FPLAU_OBD_ML_MAX "Maximale Luftmasse zum Aktiveren der Diagnose | EN: Maximale Luftmasse zum Aktiv e-ren der Diagnose" VALUE 0x71E8A TKW_VV_VV_SW 100.0 FORMULA_0112 -100.0000 1400.0000 FORMAT "%4.1" /end CHARACTERISTIC
/begin CHARACTERISTIC K_FPLAU_OBD_FR_ADAP_F "Aufweitungsfaktor wenn FR noch nicht eingeregelt" VALUE 0x71E8C TKW_VV_VV_UW 100.0 FORMULA_0075 0.0 4.0000 FORMAT "%6.3" /end CHARACTERISTIC
/begin CHARACTERISTIC K_FPLAU_OBD_KH_F "Aufweitungsfaktor bei KH" VALUE 0x71E8E TKW_VV_VV_UW 100.0 FORMULA_0075 0.0 4.0000 FORMAT "%6.3" /end CHARACTERISTIC
/begin CHARACTERISTIC K_FPLAU_OBD_TMOT_CSS "Temperaturschwelle CSS TMOT [V912: differs from V452 160E]" VALUE 0x71E90 TKW_VV_VV_SW 100.0 FORMULA_0023 -50.0000 150.0000 FORMAT "%4.1" /end CHARACTERISTIC
/begin CHARACTERISTIC K_FPLAU_OBD_PUMG_CSS "PUMG Schwelle fuer CSS" VALUE 0x71E92 TKW_VV_VV_SW 100.0 FORMULA_0077 400.0000 1200.0000 FORMAT "%4.1" /end CHARACTERISTIC
/begin CHARACTERISTIC KF_FPLAU_OBD_HFM_DELTA_ML_MAX "Max. erlaubte Abweichung | EN: Maximum permitted deviation" MAP 0x71E94 TKF_SW_SW_SW 100.0 FORMULA_0709 -200.0000 255.0000 /begin AXIS_DESCR STD_AXIS FORMULA_0006 8 0.0 10000.0000 /end AXIS_DESCR /begin AXIS_DESCR STD_AXIS FORMULA_0007 8 0.0 2.0000 FORMAT "%6.3" /end AXIS_DESCR FORMAT "%4.1" /end CHARACTERISTIC
/begin CHARACTERISTIC KF_FPLAU_OBD_AQ_DELTA_ML_MAX "Max. erlaubte Abweichung | EN: Maximum permitted deviation" MAP 0x71F36 TKF_SW_SW_SW 100.0 FORMULA_0709 -200.0000 255.0000 /begin AXIS_DESCR STD_AXIS FORMULA_0006 8 0.0 10000.0000 /end AXIS_DESCR /begin AXIS_DESCR STD_AXIS FORMULA_0007 8 0.0 2.0000 FORMAT "%6.3" /end AXIS_DESCR FORMAT "%4.1" /end CHARACTERISTIC
/begin CHARACTERISTIC KF_FPLAU_OBD_LAM_DELTA_ML_MAX "Max. erlaubte Abweichung" MAP 0x71FD8 TKF_SW_SW_SW 100.0 FORMULA_0709 -200.0000 255.0000 /begin AXIS_DESCR STD_AXIS FORMULA_0006 3 0.0 10000.0000 /end AXIS_DESCR /begin AXIS_DESCR STD_AXIS FORMULA_0007 8 0.0 2.0000 FORMAT "%6.3" /end AXIS_DESCR FORMAT "%4.1" /end CHARACTERISTIC
/* ------------------ Abschnitt erzeugt aus la_trim.dat ------------------ */
/begin CHARACTERISTIC K_LA_TRIM_CFG "Freigabe Trimmregelung | EN: 0x0 inaktiv 0x1 aktiv 0x2 RESET Freigabe Trimmregelung" VALUE 0x7385E TKW_VV_VV_UW 100.0 FORMULA_0923 0.0 1.0 FORMAT "%5.2" /end CHARACTERISTIC
/begin CHARACTERISTIC K_LA_TRIM_FKT_CFG "Auswahl Trimmregelung-Fkt. | EN: Selection of trim-control function" VALUE 0x73860 TKW_VV_VV_UW 100.0 FORMULA_0924 1.0 16.0 BIT_MASK 0xF FORMAT "%5.2" /end CHARACTERISTIC
/begin CHARACTERISTIC K_LA_TRIM_DIAG_CFG "Freigabe Trimmregelungsdiagnose | EN: 0 inaktiv 1 aktiv Freigabe Trimmregelungsdiagnose" VALUE 0x73862 TKW_VV_VV_UW 100.0 FORMULA_0798 0.0 1.0 FORMAT "%5.2" /end CHARACTERISTIC
/begin CHARACTERISTIC K_LA_TRIM_RF_HYS "Hsysterese f. relative F�llung - LA-TRIM | EN: Hsysterese f. relative Füllung - LA-TRIM" VALUE 0x73864 TKW_VV_VV_SW 100.0 FORMULA_0007 0.0 2.0000 FORMAT "%6.3" /end CHARACTERISTIC
/begin CHARACTERISTIC K_LA_TRIM_TABG_NKAT "min. NKAT-Abgastemperatur | EN: min. NKAT-Abgastemperatur" VALUE 0x73866 TKW_VV_VV_SW 100.0 FORMULA_0023 -50.0000 1250.0000 FORMAT "%4.1" /end CHARACTERISTIC
/begin CHARACTERISTIC K_LA_TRIM_TE_C_AKF_MAX "max. Konzentration aus AKF | EN: max. Konzentration aus AKF [V912: differs from V452 160E]" VALUE 0x73868 TKW_VV_VV_UW 100.0 FORMULA_0556 0.0 2.0000 FORMAT "%7.4" /end CHARACTERISTIC
/begin CHARACTERISTIC K_LA_TRIM_LAA_F_TE "max. TE-Offset auf LAA-Faktor" VALUE 0x7386A TKW_VV_VV_SW 100.0 FORMULA_0024 -1.0000 0.9999 FORMAT "%7.4" /end CHARACTERISTIC
/begin CHARACTERISTIC K_LA_TRIM_P_MAX "max. P-Anteil der Trimmregelung | EN: -2p     max. P-Anteil der Trimmregelung" VALUE 0x7386C TKW_VV_VV_SW 100.0 FORMULA_0025 -2.0000 1.9990 FORMAT "%6.3" /end CHARACTERISTIC
/begin CHARACTERISTIC K_LA_TRIM_P_MIN "min. P-Anteil der Trimmregelung | EN: -2p     min. P-Anteil der Trimmregelung" VALUE 0x7386E TKW_VV_VV_SW 100.0 FORMULA_0025 -2.0000 1.9990 FORMAT "%6.3" /end CHARACTERISTIC
/begin CHARACTERISTIC K_LA_TRIM_US_EINGER "Hys.-Spannung f. I-Regler-STOP | EN: Hys.-Spannung f. I-Regler-STOP [V912: differs from V452 160E]" VALUE 0x73870 TKW_VV_VV_UW 100.0 FORMULA_0532 0.0 1200.0000 /end CHARACTERISTIC
/begin CHARACTERISTIC K_LA_TRIM_US_EINGESCHW "Hys.-Sp.-Erkennung Signal eingeschw. | EN: Hysteresis voltage detection, signal settled [mV] [V912: differs from V452 160E]" VALUE 0x73872 TKW_VV_VV_UW 100.0 FORMULA_0532 0.0 1200.0000 /end CHARACTERISTIC
/begin CHARACTERISTIC K_LA_TRIM_US_O2_MAX "Hysterese f. Freigabe O2-Beladung (obere Schwelle) | EN: Hysterese f. Freigabe O2-Beladung (obere Schwelle) [V912: differs from V452 160E]" VALUE 0x73874 TKW_VV_VV_UW 100.0 FORMULA_0532 0.0 1200.0000 /end CHARACTERISTIC
/begin CHARACTERISTIC K_LA_TRIM_US_O2_MIN "Hysterese f. Freigabe O2-Beladung (untere Schwelle) | EN: Hysterese f. Freigabe O2-Beladung (untere Schwelle) [V912: differs from V452 160E]" VALUE 0x73876 TKW_VV_VV_UW 100.0 FORMULA_0532 0.0 1200.0000 /end CHARACTERISTIC
/begin CHARACTERISTIC K_LA_TRIM_DYN_DELTA_RF "RF-Delta fur Freigabe Trimmregelung | EN: RF-Delta fur Freigabe Trimmregelung" VALUE 0x73878 TKW_VV_VV_SW 100.0 FORMULA_0007 0.0 2.0000 FORMAT "%6.3" /end CHARACTERISTIC
/begin CHARACTERISTIC K_LA_TRIM_DYN_RF_T "Sperrzeit f�r Trimmregelung nach rf-Dynamik | EN: Sperrzeit für Trimmregelung nach rf-Dynamik" VALUE 0x7387A TKW_VV_VV_UW 100.0 FORMULA_0021 0.0 655.0000 FORMAT "%5.2" /end CHARACTERISTIC
/begin CHARACTERISTIC K_LA_TRIM_I_GMW_DLY "Verz.-Zeit nach Eintitt ins I-GMW-Band | EN: Delay time after entering the integral mean-value band [s]" VALUE 0x7387C TKW_VV_VV_UW 100.0 FORMULA_0925 0.0 65535.0000 FORMAT "%5.2" /end CHARACTERISTIC
/begin CHARACTERISTIC K_LA_TRIM_DYN_T "Verz.-Zeit nach begr. Dyn | EN: Verz.-Zeit nach begr. Dyn" VALUE 0x7387E TKW_VV_VV_UW 100.0 FORMULA_0021 0.0 655.3500 FORMAT "%5.2" /end CHARACTERISTIC
/begin CHARACTERISTIC K_LA_TRIM_DLY_T "Verz.-Zeit nach Abbruch Trimmregelung | EN: Verz.-Zeit nach Abbruch Trimmregelung" VALUE 0x73880 TKW_VV_VV_UW 100.0 FORMULA_0021 0.0 655.3500 FORMAT "%5.2" /end CHARACTERISTIC
/begin CHARACTERISTIC K_LA_TRIM_I_MAX "max. I-Anteil der Trimmregelung | EN: -2p     max. I-Anteil der Trimmregelung [V912: differs from V452 160E]" VALUE 0x73882 TKW_VV_VV_SW 100.0 FORMULA_0025 -2.0000 1.9990 FORMAT "%6.3" /end CHARACTERISTIC
/begin CHARACTERISTIC K_LA_TRIM_I_MIN "min. I-Anteil der Trimmregelung | EN: -2p     min. I-Anteil der Trimmregelung [V912: differs from V452 160E]" VALUE 0x73884 TKW_VV_VV_SW 100.0 FORMULA_0025 -2.0000 1.9990 FORMAT "%6.3" /end CHARACTERISTIC
/begin CHARACTERISTIC K_LA_TRIM_I_GMW_MAX "max. gemittelter I-Anteil der Trimmregelung | EN: Maximum averaged integral share of trim control" VALUE 0x73886 TKW_VV_VV_SW 100.0 FORMULA_0025 -2.0000 1.9990 FORMAT "%6.3" /end CHARACTERISTIC
/begin CHARACTERISTIC K_LA_TRIM_I_GMW_MIN "min. gemittelter I-Anteil der Trimmregelung | EN: Minimum averaged integral share of trim control" VALUE 0x73888 TKW_VV_VV_SW 100.0 FORMULA_0025 -2.0000 1.9990 FORMAT "%6.3" /end CHARACTERISTIC
/begin CHARACTERISTIC K_LA_TRIM_I_AD_MAX "max. I-Adaptionsanteil | EN: -2p     max. I-Adaptionsanteil [V912: differs from V452 160E]" VALUE 0x7388A TKW_VV_VV_SW 100.0 FORMULA_0025 -2.0000 1.9990 FORMAT "%6.3" /end CHARACTERISTIC
/begin CHARACTERISTIC K_LA_TRIM_I_AD_MIN "min. I-Adaptionsanteil | EN: -2p     min. I-Adaptionsanteil" VALUE 0x7388C TKW_VV_VV_SW 100.0 FORMULA_0025 -2.0000 1.9990 FORMAT "%6.3" /end CHARACTERISTIC
/begin CHARACTERISTIC K_LA_TRIM_US_SOLL_GRAD "AEBG. d. SOLL-Spannung | EN: AEBG. d. SOLL-Spannung" VALUE 0x7388E TKW_VV_VV_UW 100.0 FORMULA_0926 0.0 1200.0000 /end CHARACTERISTIC
/begin CHARACTERISTIC K_LA_TRIM_I_GMW_TAU "Zeitkonstante gem. I-Anteil | EN: Time constant, averaged integral share [s]" VALUE 0x73890 TKW_VV_VV_UB 100.0 FORMULA_0718 1.0040 256.0000 /end CHARACTERISTIC
/begin CHARACTERISTIC K_LA_TRIM_I_AD_F "Uebernahme I-Anteil in AD-Wert | EN: Uebernahme I-Anteil in AD-Wert [V912: differs from V452 160E]" VALUE 0x73892 TKW_VV_VV_UW 100.0 FORMULA_0001 0.0 100.0000 FORMAT "%4.1" /end CHARACTERISTIC
/begin CHARACTERISTIC K_LA_TRIM_P_ANZ_MAX "max. Anzahl der P-Anteil Triggerungen | EN: max. Anzahl der P-Anteil Triggerungen [V912: differs from V452 160E]" VALUE 0x73894 TKW_VV_VV_UW 100.0 FORMULA_0010 0.0 65535.0000 /end CHARACTERISTIC
/begin CHARACTERISTIC K_LA_TRIM_I_US_DELTA_MIN "OFFSET fuer min. Schwelle d. I-Anteil Ermittlung" VALUE 0x73896 TKW_VV_VV_UW 100.0 FORMULA_0532 0.0 1200.0000 /end CHARACTERISTIC
/begin CHARACTERISTIC K_LA_TRIM_I_US_DELTA_MAX "OFFSET fuer max. Schwelle d. I-Anteil Ermittlung" VALUE 0x73898 TKW_VV_VV_UW 100.0 FORMULA_0532 0.0 1200.0000 /end CHARACTERISTIC
/begin CHARACTERISTIC K_LA_TRIM_P_US_OFFSET "OFFSET fuer Verhinderung P-Anteil Toggeln | EN: OFFSET fuer Verhinderung P-Anteil Toggeln" VALUE 0x7389A TKW_VV_VV_UW 100.0 FORMULA_0532 0.0 1200.0000 /end CHARACTERISTIC
/begin CHARACTERISTIC K_LA_TRIM_DIAG_P_SCHW "Anzahl P-Anteil-Fkt.-Durchlaeufe  | EN: Anzahl P-Anteil-Fkt.-Durchlaeufe [V912: differs from V452 160E]" VALUE 0x7389C TKW_VV_VV_UW 100.0 FORMULA_0010 0.0 65535.0000 /end CHARACTERISTIC
/begin CHARACTERISTIC K_LA_TRIM_DIAG_I_MIN_SCHW "Schwelle f. Anzahl I-Anteil min. Begrenzung | EN: Schwelle f. Anzahl I-Anteil min. Begrenzung" VALUE 0x7389E TKW_VV_VV_UW 100.0 FORMULA_0010 0.0 65535.0000 /end CHARACTERISTIC
/begin CHARACTERISTIC K_LA_TRIM_DIAG_I_MAX_SCHW "Schwelle f. Anzahl I-Anteil max. Begrenzung | EN: Schwelle f. Anzahl I-Anteil max. Begrenzung" VALUE 0x738A0 TKW_VV_VV_UW 100.0 FORMULA_0010 0.0 65535.0000 /end CHARACTERISTIC
/begin CHARACTERISTIC K_LA_TRIM_DIAG_I_ED_F "Aufweitungsfaktor auf d. I-Anteils-Bereichsgrenzen | EN: Aufweitungsfaktor auf d. I-Anteils-Bereichsgrenzen [V912: differs from V452 160E]" VALUE 0x738A2 TKW_VV_VV_UW 100.0 FORMULA_0075 0.0 4.0000 FORMAT "%6.3" /end CHARACTERISTIC
/begin CHARACTERISTIC K_LA_TRIM_TAN_MIN "min. TAN-Schwelle | EN: min. TAN-Schwelle" VALUE 0x738A4 TKW_VV_VV_SW 100.0 FORMULA_0023 -50.0000 170.0000 FORMAT "%4.1" /end CHARACTERISTIC
/begin CHARACTERISTIC K_LA_TRIM_TAN_MAX "max. TAN-Schwelle | EN: max. TAN-Schwelle" VALUE 0x738A6 TKW_VV_VV_SW 100.0 FORMULA_0023 -50.0000 170.0000 FORMAT "%4.1" /end CHARACTERISTIC
/begin CHARACTERISTIC K_LA_TRIM_V_SCHWELLE "max. Geschwindigkeitsschwelle | EN: max. Geschwindigkeitsschwelle" VALUE 0x738A8 TKW_VV_VV_SW 100.0 FORMULA_0078 -80.0000 360.0000 FORMAT "%4.1" /end CHARACTERISTIC
/begin CHARACTERISTIC K_LA_TRIM_DIAG_I_AD_F "Aufweitungsfaktor auf d. I-Adaptionss-Bereichsgrenzen | EN: Aufweitungsfaktor auf d. I-Adaptionss-Bereichsgrenzen [V912: differs from V452 160E]" VALUE 0x738AA TKW_VV_VV_UW 100.0 FORMULA_0075 0.0 4.0000 FORMAT "%6.3" /end CHARACTERISTIC
/begin CHARACTERISTIC K_LA_TRIM_DIAG_I_AD_MIN_SCHW "Schwelle f. Anzahl I-Adaption min. Begrenzung | EN: Schwelle f. Anzahl I-Adaption min. Begrenzung" VALUE 0x738AC TKW_VV_VV_UW 100.0 FORMULA_0010 0.0 65535.0000 /end CHARACTERISTIC
/begin CHARACTERISTIC K_LA_TRIM_DIAG_I_AD_MAX_SCHW "Schwelle f. Anzahl I-Adaption max. Begrenzung | EN: Schwelle f. Anzahl I-Adaption max. Begrenzung" VALUE 0x738AE TKW_VV_VV_UW 100.0 FORMULA_0010 0.0 65535.0000 /end CHARACTERISTIC
/begin CHARACTERISTIC K_LA_TRIM_DIAG_I_T "min. Zeit fuer Anschlag d. I-Aneiles | EN: min. Zeit fuer Anschlag d. I-Aneiles" VALUE 0x738B0 TKW_VV_VV_UW 100.0 FORMULA_0021 0.0 655.3500 FORMAT "%5.2" /end CHARACTERISTIC
/begin CHARACTERISTIC K_LA_TRIM_LAM_DELTA_MAX "LA-Regelabweichung - Freigabe Trimmregelung | EN: LA-Regelabweichung - Freigabe Trimmregelung" VALUE 0x738B2 TKW_VV_VV_SW 100.0 FORMULA_0025 -2.0000 1.9999 FORMAT "%6.3" /end CHARACTERISTIC
/begin CHARACTERISTIC K_LA_TRIM_I_AD_MCS "I-Adaptionsanteil - MCS-Popel-Groesse fuer CFG-RESET | EN: -2p I-Adaptionsanteil - MCS- Popel-Groesse fuer CFG- RESET" VALUE 0x738B4 TKW_VV_VV_SW 100.0 FORMULA_0025 -2.0000 1.9990 FORMAT "%6.3" /end CHARACTERISTIC
/begin CHARACTERISTIC KL_LA_TRIM_I_FAK_OBD "Faktor I-Anteil aus KAT-Alterung | EN: Factor on integral share from catalyst ageing" CURVE 0x738B6 TKL_UW_VV_UW 100.0 FORMULA_0075 0.0 4.0000
 /begin AXIS_DESCR STD_AXIS kat_obd_wert FORMULA_0025 8 0.0 3.9990 FORMAT "%6.3" /end AXIS_DESCR
 FORMAT "%6.3" /end CHARACTERISTIC
/begin CHARACTERISTIC KL_LA_TRIM_P_FAK_OBD "Faktor P-Anteil aus KAT-Alterung | EN: Factor on P share from catalyst ageing" CURVE 0x738D8 TKL_UW_VV_UW 100.0 FORMULA_0075 0.0 4.0000
 /begin AXIS_DESCR STD_AXIS kat_obd_wert FORMULA_0025 8 0.0 3.9990 FORMAT "%6.3" /end AXIS_DESCR
 FORMAT "%6.3" /end CHARACTERISTIC
/begin CHARACTERISTIC KL_LA_TRIM_RF_MIN "min. relative F�llung - LA-TRIM | EN: Minimum relative charge - lambda trim" CURVE 0x738FA TKL_SW_VV_SW 100.0 FORMULA_0007 0.0 2.0000 /begin AXIS_DESCR STD_AXIS FORMULA_0006 8 0.0 10000.0000 /end AXIS_DESCR FORMAT "%6.3" /end CHARACTERISTIC
/begin CHARACTERISTIC KL_LA_TRIM_RF_MAX "max. relative F�llung - LA-TRIM | EN: Max. relative charge - lambda trim" CURVE 0x7391C TKL_SW_VV_SW 100.0 FORMULA_0007 0.0 2.0000 /begin AXIS_DESCR STD_AXIS FORMULA_0006 8 0.0 10000.0000 /end AXIS_DESCR FORMAT "%6.3" /end CHARACTERISTIC
/begin CHARACTERISTIC KL_LA_TRIM_I_GMW_RF_MIN "min. relative F�llung - Mittelwert I-Anteil | EN: Min. relative charge - I-share mean value [V912: differs from V452 160E]" CURVE 0x7393E TKL_SW_VV_SW 100.0 FORMULA_0007 0.0 2.0000 /begin AXIS_DESCR STD_AXIS FORMULA_0006 8 0.0 10000.0000 /end AXIS_DESCR FORMAT "%6.3" /end CHARACTERISTIC
/begin CHARACTERISTIC KL_LA_TRIM_I_GMW_RF_MAX "max. relative F�llung - Mittelwert I-Anteil | EN: Max. relative charge - I-share mean value" CURVE 0x73960 TKL_SW_VV_SW 100.0 FORMULA_0007 0.0 2.0000 /begin AXIS_DESCR STD_AXIS FORMULA_0006 8 0.0 10000.0000 /end AXIS_DESCR FORMAT "%6.3" /end CHARACTERISTIC
/begin CHARACTERISTIC KF_LA_TRIM_USN_SOLL "NKAT-Sollspannung - Trimmregelung | EN: Post-cat target voltage, trim control" MAP 0x73982 TKF_SW_SW_UW 100.0 FORMULA_0532 0.0 1200.0000 /begin AXIS_DESCR STD_AXIS FORMULA_0006 8 0.0 10000.0000 /end AXIS_DESCR /begin AXIS_DESCR STD_AXIS rf FORMULA_0007 8 0.0 2.0000 FORMAT "%6.3" /end AXIS_DESCR /end CHARACTERISTIC
/begin CHARACTERISTIC KF_LA_TRIM_P "P-Anteil - Trimmregelung | EN: P share - trim control" MAP 0x73A24 TKF_SW_SW_UW 100.0 FORMULA_0025 0.0 3.9990 /begin AXIS_DESCR STD_AXIS FORMULA_0006 8 0.0 10000.0000 /end AXIS_DESCR /begin AXIS_DESCR STD_AXIS rf FORMULA_0007 8 0.0 2.0000 FORMAT "%6.3" /end AXIS_DESCR FORMAT "%6.3" /end CHARACTERISTIC
/begin CHARACTERISTIC KF_LA_TRIM_I "I-Anteil - Trimmregelung | EN: Integral share - trim control" MAP 0x73AC6 TKF_SW_SW_UW 100.0 FORMULA_0919 0.0 819.0000 /begin AXIS_DESCR STD_AXIS FORMULA_0006 8 0.0 10000.0000 /end AXIS_DESCR /begin AXIS_DESCR STD_AXIS rf FORMULA_0007 8 0.0 2.0000 FORMAT "%6.3" /end AXIS_DESCR FORMAT "%5.2" /end CHARACTERISTIC
/begin CHARACTERISTIC KF_LA_TRIM_P_DLY "Haltezeit f�r P-Anteil | EN: Hold time for P share" MAP 0x73B68 TKF_SW_SW_UW 100.0 FORMULA_0021 0.0 655.3500 /begin AXIS_DESCR STD_AXIS FORMULA_0006 8 0.0 10000.0000 /end AXIS_DESCR /begin AXIS_DESCR STD_AXIS rf FORMULA_0007 8 0.0 2.0000 FORMAT "%6.3" /end AXIS_DESCR FORMAT "%5.2" /end CHARACTERISTIC
/begin CHARACTERISTIC KF_LA_TRIM_P_WAIT "Warteezeit f�r weiteren P-Anteil | EN: Wait time for further P share" MAP 0x73C0A TKF_SW_SW_UW 100.0 FORMULA_0021 0.0 655.3500 /begin AXIS_DESCR STD_AXIS FORMULA_0006 8 0.0 10000.0000 /end AXIS_DESCR /begin AXIS_DESCR STD_AXIS rf FORMULA_0007 8 0.0 2.0000 FORMAT "%6.3" /end AXIS_DESCR FORMAT "%5.2" /end CHARACTERISTIC
/begin CHARACTERISTIC KF_LA_TRIM_I_DLY "Haltezeit f�r I-Anteil | EN: Hold time for integral share" MAP 0x73CAC TKF_SW_SW_UW 100.0 FORMULA_0021 0.0 655.3500 /begin AXIS_DESCR STD_AXIS FORMULA_0006 8 0.0 10000.0000 /end AXIS_DESCR /begin AXIS_DESCR STD_AXIS rf FORMULA_0007 8 0.0 2.0000 FORMAT "%6.3" /end AXIS_DESCR FORMAT "%5.2" /end CHARACTERISTIC
/begin CHARACTERISTIC KF_LA_TRIM_P_ABR "Abregelungszeit P-Anteil | EN: Ramp-down time, P share" MAP 0x73D4E TKF_SW_SW_UW 100.0 FORMULA_0021 0.0 655.3500 /begin AXIS_DESCR STD_AXIS FORMULA_0006 8 0.0 10000.0000 /end AXIS_DESCR /begin AXIS_DESCR STD_AXIS rf FORMULA_0007 8 0.0 2.0000 FORMAT "%6.3" /end AXIS_DESCR FORMAT "%5.2" /end CHARACTERISTIC
/begin CHARACTERISTIC KF_LA_TRIM_AD_WICHT "Wichtungsfaktor auf lam_trim_ad | EN: Weighting factor on lam_trim_ad" MAP 0x73DF0 TKF_SW_SW_UW 100.0 FORMULA_0927 0.0 10.0000 /begin AXIS_DESCR STD_AXIS FORMULA_0006 8 0.0 10000.0000 /end AXIS_DESCR /begin AXIS_DESCR STD_AXIS rf FORMULA_0007 8 0.0 2.0000 FORMAT "%6.3" /end AXIS_DESCR FORMAT "%5.2" /end CHARACTERISTIC
/begin CHARACTERISTIC KF_LA_TRIM_I_GMW_WICHT "Wichtungsfaktor auf lam_trim_i_gmw" MAP 0x73E92 TKF_SW_SW_UW 100.0 FORMULA_0927 0.0 10.0000 /begin AXIS_DESCR STD_AXIS FORMULA_0006 8 0.0 10000.0000 /end AXIS_DESCR /begin AXIS_DESCR STD_AXIS rf FORMULA_0007 8 0.0 2.0000 FORMAT "%6.3" /end AXIS_DESCR FORMAT "%5.2" /end CHARACTERISTIC
/* ------------------ Abschnitt erzeugt aus pabg.dat ------------------ */
/begin CHARACTERISTIC K_PABG_STAT_TAU "Filterzeitkonstante PABG | EN: Filter time constant, exhaust back-pressure [s] [V912: differs from V452 160E]" VALUE 0x75E14 TKW_VV_VV_UB 100.0 FORMULA_0664 0.0101 2.5600 /end CHARACTERISTIC
/begin CHARACTERISTIC KL_PABG_STAT_ML "Grundkennfeld relativer PABG | EN: Base map, relative exhaust back-pressure" CURVE 0x75E16 TKL_SW_VV_SW 100.0 FORMULA_0077 0.0 1500.0000
 /begin AXIS_DESCR STD_AXIS ml FORMULA_0112 8 -100.0000 1400.0000 FORMAT "%4.1" /end AXIS_DESCR
 FORMAT "%4.1" /end CHARACTERISTIC
/* ------------------ Abschnitt erzeugt aus rf_e2.dat ------------------ */
/begin CHARACTERISTIC K_RF_E2_T_MAX "Maximale Fehlerzeit Last fuer Ebene 2." VALUE 0x7A2DA TKW_VV_VV_UW 100.0 FORMULA_0021 0.0 655.0000 FORMAT "%5.2" /end CHARACTERISTIC
/begin CHARACTERISTIC K_RF_E2_DYN_TAU "Filterkonstante fuer rf_e2_dyn" VALUE 0x7A2DC TKW_VV_VV_UB 100.0 FORMULA_0664 0.0101 2.5600 /end CHARACTERISTIC
/begin CHARACTERISTIC K_RF_E2_DYN_T "Zeit nach Dynamikabbruch durch rf" VALUE 0x7A2DE TKW_VV_VV_UW 100.0 FORMULA_0021 0.0 655.0000 FORMAT "%5.2" /end CHARACTERISTIC
/begin CHARACTERISTIC K_RF_E2_DYN_DELTA "Dynamikschwelle RF" VALUE 0x7A2E0 TKW_VV_VV_SW 100.0 FORMULA_0007 0.0 2.0000 FORMAT "%6.3" /end CHARACTERISTIC
/begin CHARACTERISTIC K_RF_E2_HFM_TAU "Tau fuer RF-E2 Filterung" VALUE 0x7A2E2 TKW_VV_VV_UB 100.0 FORMULA_0651 0.0051 1.2800 /end CHARACTERISTIC
/begin CHARACTERISTIC KL_RF_E2_HFM_AD "Kennlinie HFM Ebene 2" CURVE 0x7A2E4 TKL_SW_VV_SW 100.0 FORMULA_0112 -100.0000 1400.0000 /begin AXIS_DESCR STD_AXIS hfm_5ms_ad_b1 FORMULA_0123 11 0.0 1023.0000 /end AXIS_DESCR FORMAT "%4.1" /end CHARACTERISTIC
/begin CHARACTERISTIC KL_RF_E2_PUMG_KORR "Korrekturfaktor in Abh. vom Luftdruck | EN: Correction factor depending on air pressure" CURVE 0x7A312 TKL_SW_VV_SW 100.0 FORMULA_0075 -4.0000 4.0000 /begin AXIS_DESCR STD_AXIS FORMULA_0077 8 400.0000 1200.0000 FORMAT "%4.1" /end AXIS_DESCR FORMAT "%6.3" /end CHARACTERISTIC
/begin CHARACTERISTIC KL_RF_E2_TAN_KORR "-" CURVE 0x7A334 TKL_SW_VV_UW 100.0 FORMULA_0075 0.0 4.0000
 /begin AXIS_DESCR STD_AXIS temperatur FORMULA_0023 8 -50.0000 170.0000 FORMAT "%4.1" /end AXIS_DESCR
 FORMAT "%6.3" /end CHARACTERISTIC
/begin CHARACTERISTIC KF_RF_E2_MAX "Max. erlaubte Abweichung [V912: differs from V452 160E]" MAP 0x7A356 TKF_SW_SW_SW 100.0 FORMULA_0709 -200.0000 255.0000 /begin AXIS_DESCR STD_AXIS FORMULA_0006 6 0.0 10000.0000 /end AXIS_DESCR /begin AXIS_DESCR STD_AXIS FORMULA_0007 8 0.0 2.0000 FORMAT "%6.3" /end AXIS_DESCR FORMAT "%4.1" /end CHARACTERISTIC
/* ------------------ Abschnitt erzeugt aus rps.dat ------------------ */
/begin CHARACTERISTIC K_RPS_CFG "Auswahl RPS-Modell" VALUE 0x77394 TKW_VV_VV_UB 100.0 FORMULA_1083 0.0 255.0 /end CHARACTERISTIC
/* ------------------ Abschnitt erzeugt aus sa_we.dat ------------------ */
/begin CHARACTERISTIC K_SA_MD_FW_REL_MIN "relatvie Momenentenschwelle Zugbetr. in Schubbetrieb direkt | EN: relatvie Momenentenschwelle Zugbetr. in Schubbetrieb direkt" VALUE 0x77396 TKW_VV_VV_SW 100.0 FORMULA_0001 0.0 100.0000 FORMAT "%4.1" /end CHARACTERISTIC
/begin CHARACTERISTIC K_SA_MD_HYS "absolute Drehmomenthyst. fuer Erkennung SA | EN: absolute Drehm omenthyst. fuer Erkennung SA" VALUE 0x77398 TKW_VV_VV_SW 100.0 FORMULA_0001 0.0 100.0000 FORMAT "%4.1" /end CHARACTERISTIC
/begin CHARACTERISTIC K_SA_MD_IND_NE_MAX "max. ind. Motormoment nach Eingriff fuer direkten Ueberg. nach SA | EN: max. ind. Motormoment nach Eingriff fuer dire kten Ueberg. nach SA" VALUE 0x7739A TKW_VV_VV_SW 100.0 FORMULA_0009 -100.0000 1000.0000 FORMAT "%4.1" /end CHARACTERISTIC
/begin CHARACTERISTIC K_SA_MD_IND_NE_MIN "absolute md-Schwelle fuer Aktivierung der SA | EN: absolute md -Schwelle fuer Aktivierung der SA" VALUE 0x7739C TKW_VV_VV_SW 100.0 FORMULA_0009 -100.0000 1000.0000 FORMAT "%4.1" /end CHARACTERISTIC
/begin CHARACTERISTIC K_SA_TKAT_MIN "minimale Katalysatortemp. fuer Freigabe SA | EN: minimale Kataly satortemp. fuer Freigabe SA" VALUE 0x7739E TKW_VV_VV_SW 100.0 FORMULA_0023 -1000.0000 1000.0000 FORMAT "%4.1" /end CHARACTERISTIC
/begin CHARACTERISTIC K_SA_WE_MD_HYS "absolute md-Schwelle fuer Erkennung WE | EN: absolute md -Schwelle fuer Erkennung WE" VALUE 0x773A0 TKW_VV_VV_SW 100.0 FORMULA_0001 0.0 100.0000 FORMAT "%4.1" /end CHARACTERISTIC
/begin CHARACTERISTIC K_SA_N_HYS "allg. Hyst. SA-Drehzahl | EN: allg. Hyst. SA-Drehzahl" VALUE 0x773A2 TKW_VV_VV_SW 100.0 FORMULA_0006 0.0 10000.0000 /end CHARACTERISTIC
/begin CHARACTERISTIC K_SA_TZ_MIN_HYS "Hysterese f�r tzmin | EN: Hysterese für tzmin" VALUE 0x773A4 TKW_VV_VV_SW 100.0 FORMULA_0111 -50.0000 60.0000 FORMAT "%4.1" /end CHARACTERISTIC
/begin CHARACTERISTIC K_SA_MSR_SPERRZEIT "Hysterese f�r tzmin | EN: Hysterese für tzmin" VALUE 0x773A6 TKW_VV_VV_UW 100.0 FORMULA_0117 0.0 325.0000 FORMAT "%5.2" /end CHARACTERISTIC
/begin CHARACTERISTIC KL_SA_N_GANG "gangabhaengiger Offset fuer WE-drehzalberechnung | EN: gangabhaengiger Offset fuer WE -drehzalberechnung" CURVE 0x773A8 TKL_SW_VV_SW 100.0 FORMULA_0006 0.0 10000.0000 /begin AXIS_DESCR STD_AXIS FORMULA_0010 10 -1.0000 10.0000 /end AXIS_DESCR /end CHARACTERISTIC
/begin CHARACTERISTIC KL_SA_N_TMOT "tmot abhaeng. Offset fuer WA-berechnung | EN: Engine-temperature-dependent offset for resume calculation" CURVE 0x773D2 TKL_SW_VV_SW 100.0 FORMULA_0006 0.0 10000.0000 /begin AXIS_DESCR STD_AXIS FORMULA_0023 4 -50.0000 170.0000 FORMAT "%4.1" /end AXIS_DESCR /end CHARACTERISTIC
/begin CHARACTERISTIC KL_SA_N_DYN "Drehzalgradientenabhae. Offset fuer WA-Drezahlberechnung | EN: Engine-speed-gradient-dependent offset for overrun-resume speed calculation" CURVE 0x773E4 TKL_SW_VV_SW 100.0 FORMULA_0006 0.0 10000.0000 /begin AXIS_DESCR STD_AXIS dn FORMULA_0114 4 -10000.0000 10000.0000 /end AXIS_DESCR /end CHARACTERISTIC
/begin CHARACTERISTIC KL_SA_N_HYS_GANG "gangabh. Hyst. SA-Drehzahl | EN: Gear-dependent hysteresis of fuel cut-off speed" CURVE 0x773F6 TKL_SW_VV_SW 100.0 FORMULA_0006 0.0 10000.0000 /begin AXIS_DESCR STD_AXIS FORMULA_0010 10 -1.0000 10.0000 /end AXIS_DESCR /end CHARACTERISTIC
/begin CHARACTERISTIC KF_SA_T_TRIG_MAX "Saugrohrdruckdelta | EN: Intake manifold pressure delta (dwell time)" MAP 0x77420 TKF_SW_SW_UW 100.0 FORMULA_0117 0.0 325.0000
 /begin AXIS_DESCR STD_AXIS tmot_loc FORMULA_0023 4 -50.0000 170.0000 FORMAT "%4.1" /end AXIS_DESCR
 /begin AXIS_DESCR STD_AXIS FORMULA_0006 6 0.0 10000.0000 /end AXIS_DESCR
 FORMAT "%5.2" /end CHARACTERISTIC
/* ------------------ Abschnitt erzeugt aus slv.dat ------------------ */ /* ------------------ Abschnitt erzeugt aus spgr.dat ------------------ */
/begin CHARACTERISTIC KL_SPGR_FREQ "Spannungesregler Switchingfreq | EN: Voltage regulator switching frequency" CURVE 0x77A50 TKL_SW_VV_UW 100.0 FORMULA_1126 228.0000 700.0000
 /begin AXIS_DESCR STD_AXIS temperatur FORMULA_0023 2 -50.0000 170.0000 FORMAT "%4.1" /end AXIS_DESCR
/end CHARACTERISTIC
/* ------------------ Abschnitt erzeugt aus stat_data.dat ------------------ */
/begin CHARACTERISTIC KL_STAT_DATA_N "Kennlinie Drehzahl n fuer Statistik | EN: Curve: engine speed for statistics" CURVE 0x77A76 TKL_SW_VV_SW 100.0 FORMULA_0010 0.0 7.0000 /begin AXIS_DESCR STD_AXIS FORMULA_0006 8 0.0 10000.0000 /end AXIS_DESCR /end CHARACTERISTIC
/begin CHARACTERISTIC KL_STAT_DATA_RF "Kennlinie relative Fuellung rf fuer Statistik | EN: Curve: relative charge for statistics" CURVE 0x77A98 TKL_SW_VV_SW 100.0 FORMULA_0010 0.0 6.0000 /begin AXIS_DESCR STD_AXIS FORMULA_0007 7 0.0 2.0000 FORMAT "%6.3" /end AXIS_DESCR /end CHARACTERISTIC
/begin CHARACTERISTIC KL_STAT_DATA_TMOT "Kennlinie Motor-Temperatur tmot fuer Statistik | EN: Curve: engine temperature for statistics" CURVE 0x77AB6 TKL_SW_VV_SW 100.0 FORMULA_0010 0.0 7.0000 /begin AXIS_DESCR STD_AXIS FORMULA_0023 8 -50.0000 170.0000 FORMAT "%4.1" /end AXIS_DESCR /end CHARACTERISTIC
/begin CHARACTERISTIC KL_STAT_DATA_TOEL "KL Oel-Temperatur toel am Oelfilterkopf fuer Statistik | EN: Curve: oil temperature at oil filter head for statistics" CURVE 0x77AD8 TKL_SW_VV_SW 100.0 FORMULA_0010 0.0 7.0000 /begin AXIS_DESCR STD_AXIS FORMULA_0023 8 -50.0000 170.0000 FORMAT "%4.1" /end AXIS_DESCR /end CHARACTERISTIC
/begin CHARACTERISTIC KL_STAT_DATA_TDME "Kennlinie ECU-Temperatur tdme fuer Statistik | EN: Curve: ECU temperature for statistics" CURVE 0x77AFA TKL_SW_VV_SW 100.0 FORMULA_0010 0.0 7.0000 /begin AXIS_DESCR STD_AXIS FORMULA_0023 8 -50.0000 170.0000 FORMAT "%4.1" /end AXIS_DESCR /end CHARACTERISTIC
/* ------------------ Abschnitt erzeugt aus td_diag.dat ------------------ */
/begin CHARACTERISTIC K_TD_DIAG_CFG "Aktivierung der Fehlerarten. | EN: Aktivierung der Fehlerarten." VALUE 0x77BB2 TKW_VV_VV_UB 100.0 FORMULA_0228 0.0 15.0 BIT_MASK 0xF /end CHARACTERISTIC
/* ------------------ Abschnitt erzeugt aus zust_inj.dat ------------------ */
/begin CHARACTERISTIC K_ZUST_POWER "Konfiguration Powertaster | EN: 0x0 Inaktiv 0x1 Aktiv 0x2 Ist-Md Konfiguration Powertaster" VALUE 0x7A28E TKW_VV_VV_UB 100.0 FORMULA_1239 0.0 255.0 /end CHARACTERISTIC
/begin CHARACTERISTIC K_ZUST_N_PS_LL "Drehzahlschwelle f. Uebergang PRESYNC --> LL | EN: Drehzahlschwelle f. Ueber gang PRESYNC --> LL" VALUE 0x7A290 TKW_VV_VV_SW 100.0 FORMULA_0006 0.0 3000.0000 /end CHARACTERISTIC
/begin CHARACTERISTIC K_ZUST_MD_LL_TL "Momentenschwelle f. Uebergang LL --> TL | EN: Momentenschwelle f. Uebergang LL --> TL" VALUE 0x7A292 TKW_VV_VV_SW 100.0 FORMULA_0001 0.0 100.0000 FORMAT "%4.1" /end CHARACTERISTIC
/begin CHARACTERISTIC K_ZUST_MD_HYST_LL_TL "MD Hysterese f. Uebergang TL --> LL | EN: MD Hysterese f. Uebergang TL --> LL" VALUE 0x7A294 TKW_VV_VV_SW 100.0 FORMULA_0001 0.0 100.0000 FORMAT "%4.1" /end CHARACTERISTIC
/begin CHARACTERISTIC K_ZUST_MD_HYST_TL_VL "MD Hysterese f. Uebergang TL --> VL | EN: MD Hysterese f. Uebergang TL --> VL | [Code V452] Hysteresis for the part-load/full-load state switch (2 %)." VALUE 0x7A296 TKW_VV_VV_SW 100.0 FORMULA_0001 0.0 100.0000 FORMAT "%4.1" /end CHARACTERISTIC
/begin CHARACTERISTIC K_ZUST_T_NL "Nachlaufzeit | EN: Nachlaufzeit" VALUE 0x7A298 TKW_VV_VV_UW 100.0 FORMULA_0021 0.0 655.3500 FORMAT "%5.2" /end CHARACTERISTIC
/begin CHARACTERISTIC K_ZUST_NL_TIMOUT_INJ "Timeoutueberwachung fuer INJ | EN: Timeoutueberwachung fuer INJ" VALUE 0x7A29A TKW_VV_VV_UW 100.0 FORMULA_1240 0.0 40000.0000 FORMAT "%5.2" /end CHARACTERISTIC
/begin CHARACTERISTIC KL_ZUST_N_ST_LL "Drehzahlschwelle fuer Start Exit" CURVE 0x7A29C TKL_SW_VV_SW 100.0 FORMULA_0006 0.0 10000.0000 /begin AXIS_DESCR STD_AXIS FORMULA_0023 3 -50.0000 170.0000 FORMAT "%4.1" /end AXIS_DESCR /end CHARACTERISTIC
/begin CHARACTERISTIC KL_ZUST_MD_TL_VL "md_rel fuer Uebergang TL -> VL | EN: Relative torque for transition part load to full load | [Code V452] Torque-demand threshold for the part-load -> full-load state (zust_md_rel_tl_vl, also sent to IGN). Ignition blends from KF_TZ_GRUND to KF_TZ_VL between this value (90 %) and 100 % md_wunsch_rel (IGN 0x66284)." CURVE 0x7A2AA TKL_SW_VV_SW 100.0 FORMULA_0001 0.0 100.0000 /begin AXIS_DESCR STD_AXIS FORMULA_0006 6 0.0 10000.0000 /end AXIS_DESCR FORMAT "%4.1" /end CHARACTERISTIC
/begin FUNCTION Zustand ""
 /begin DEF_CHARACTERISTIC KL_ZUST_MD_TL_VL KL_ZUST_N_ST_LL K_ZUST_MD_HYST_LL_TL K_ZUST_MD_HYST_TL_VL K_ZUST_MD_LL_TL K_ZUST_NL_TIMOUT_INJ K_ZUST_N_PS_LL K_ZUST_POWER K_ZUST_T_NL /end DEF_CHARACTERISTIC
 /begin REF_CHARACTERISTIC /end REF_CHARACTERISTIC
 /begin IN_MEASUREMENT /end IN_MEASUREMENT
 /begin OUT_MEASUREMENT /end OUT_MEASUREMENT
/end FUNCTION
/begin FUNCTION diag_tr "" /begin DEF_CHARACTERISTIC K_TD_DIAG_CFG /end DEF_CHARACTERISTIC /begin REF_CHARACTERISTIC /end REF_CHARACTERISTIC /begin IN_MEASUREMENT /end IN_MEASUREMENT /begin OUT_MEASUREMENT /end OUT_MEASUREMENT /end FUNCTION
/begin FUNCTION fplau ""
 /begin DEF_CHARACTERISTIC KF_FPLAU_OBD_AQ_DELTA_ML_MAX KF_FPLAU_OBD_HFM_DELTA_ML_MAX KF_FPLAU_OBD_LAM_DELTA_ML_MAX K_FPLAU_AQ_OBD_CNT K_FPLAU_HFM_OBD_CNT K_FPLAU_LAM_OBD_CNT K_FPLAU_OBD_CFG K_FPLAU_OBD_DYN_DELTA_RF K_FPLAU_OBD_DYN_RF_T K_FPLAU_OBD_FR_ADAP_F K_FPLAU_OBD_KH_F K_FPLAU_OBD_ML_MAX K_FPLAU_OBD_ML_MIN K_FPLAU_OBD_N_MAX K_FPLAU_OBD_N_MIN K_FPLAU_OBD_PUMG_CSS K_FPLAU_OBD_TMOT_CSS K_FPLAU_OBD_TMOT_MIN K_FPLAU_OBD_T_DELTA K_FPLAU_OBD_T_MAX K_FPLAU_OBD_T_MIN /end DEF_CHARACTERISTIC
 /begin REF_CHARACTERISTIC /end REF_CHARACTERISTIC
 /begin IN_MEASUREMENT /end IN_MEASUREMENT
 /begin OUT_MEASUREMENT /end OUT_MEASUREMENT
/end FUNCTION
/begin FUNCTION kl87 "" /begin DEF_CHARACTERISTIC /end DEF_CHARACTERISTIC /begin REF_CHARACTERISTIC /end REF_CHARACTERISTIC /begin IN_MEASUREMENT /end IN_MEASUREMENT /begin OUT_MEASUREMENT /end OUT_MEASUREMENT /end FUNCTION
/begin FUNCTION kwp_fetrawe "" /begin DEF_CHARACTERISTIC /end DEF_CHARACTERISTIC /begin REF_CHARACTERISTIC /end REF_CHARACTERISTIC /begin IN_MEASUREMENT /end IN_MEASUREMENT /begin OUT_MEASUREMENT /end OUT_MEASUREMENT /end FUNCTION
/begin FUNCTION la_TRIM ""
 /begin DEF_CHARACTERISTIC KF_LA_TRIM_AD_WICHT KF_LA_TRIM_I KF_LA_TRIM_I_DLY KF_LA_TRIM_I_GMW_WICHT KF_LA_TRIM_P KF_LA_TRIM_P_ABR KF_LA_TRIM_P_DLY KF_LA_TRIM_P_WAIT KF_LA_TRIM_USN_SOLL KL_LA_TRIM_I_FAK_OBD KL_LA_TRIM_I_GMW_RF_MAX KL_LA_TRIM_I_GMW_RF_MIN KL_LA_TRIM_P_FAK_OBD KL_LA_TRIM_RF_MAX KL_LA_TRIM_RF_MIN K_LA_TRIM_CFG K_LA_TRIM_DIAG_CFG K_LA_TRIM_DIAG_I_AD_F K_LA_TRIM_DIAG_I_AD_MAX_SCHW K_LA_TRIM_DIAG_I_AD_MIN_SCHW K_LA_TRIM_DIAG_I_ED_F K_LA_TRIM_DIAG_I_MAX_SCHW K_LA_TRIM_DIAG_I_MIN_SCHW K_LA_TRIM_DIAG_I_T K_LA_TRIM_DIAG_P_SCHW K_LA_TRIM_DLY_T K_LA_TRIM_DYN_DELTA_RF K_LA_TRIM_DYN_RF_T K_LA_TRIM_DYN_T K_LA_TRIM_FKT_CFG K_LA_TRIM_I_AD_F K_LA_TRIM_I_AD_MAX K_LA_TRIM_I_AD_MCS K_LA_TRIM_I_AD_MIN K_LA_TRIM_I_GMW_DLY K_LA_TRIM_I_GMW_MAX K_LA_TRIM_I_GMW_MIN K_LA_TRIM_I_GMW_TAU K_LA_TRIM_I_MAX K_LA_TRIM_I_MIN K_LA_TRIM_I_US_DELTA_MAX K_LA_TRIM_I_US_DELTA_MIN K_LA_TRIM_LAA_F_TE K_LA_TRIM_LAM_DELTA_MAX K_LA_TRIM_P_ANZ_MAX K_LA_TRIM_P_MAX K_LA_TRIM_P_MIN K_LA_TRIM_P_US_OFFSET K_LA_TRIM_RF_HYS K_LA_TRIM_TABG_NKAT K_LA_TRIM_TAN_MAX K_LA_TRIM_TAN_MIN K_LA_TRIM_TE_C_AKF_MAX K_LA_TRIM_US_EINGER K_LA_TRIM_US_EINGESCHW K_LA_TRIM_US_O2_MAX K_LA_TRIM_US_O2_MIN K_LA_TRIM_US_SOLL_GRAD K_LA_TRIM_V_SCHWELLE /end DEF_CHARACTERISTIC
 /begin REF_CHARACTERISTIC /end REF_CHARACTERISTIC
 /begin IN_MEASUREMENT /end IN_MEASUREMENT
 /begin OUT_MEASUREMENT /end OUT_MEASUREMENT
/end FUNCTION
/begin FUNCTION pabg "" /begin DEF_CHARACTERISTIC KL_PABG_STAT_ML K_PABG_STAT_TAU /end DEF_CHARACTERISTIC /begin REF_CHARACTERISTIC /end REF_CHARACTERISTIC /begin IN_MEASUREMENT /end IN_MEASUREMENT /begin OUT_MEASUREMENT /end OUT_MEASUREMENT /end FUNCTION
/begin FUNCTION qadc_conf "" /begin DEF_CHARACTERISTIC /end DEF_CHARACTERISTIC /begin REF_CHARACTERISTIC /end REF_CHARACTERISTIC /begin IN_MEASUREMENT /end IN_MEASUREMENT /begin OUT_MEASUREMENT /end OUT_MEASUREMENT /end FUNCTION
/begin FUNCTION rf_e2 ""
 /begin DEF_CHARACTERISTIC KF_RF_E2_MAX KL_RF_E2_HFM_AD KL_RF_E2_PUMG_KORR KL_RF_E2_TAN_KORR K_RF_E2_DYN_DELTA K_RF_E2_DYN_T K_RF_E2_DYN_TAU K_RF_E2_HFM_TAU K_RF_E2_T_MAX /end DEF_CHARACTERISTIC
 /begin REF_CHARACTERISTIC /end REF_CHARACTERISTIC
 /begin IN_MEASUREMENT /end IN_MEASUREMENT
 /begin OUT_MEASUREMENT /end OUT_MEASUREMENT
/end FUNCTION
/begin FUNCTION rps "" /begin DEF_CHARACTERISTIC K_RPS_CFG /end DEF_CHARACTERISTIC /begin REF_CHARACTERISTIC /end REF_CHARACTERISTIC /begin IN_MEASUREMENT /end IN_MEASUREMENT /begin OUT_MEASUREMENT /end OUT_MEASUREMENT /end FUNCTION
/begin FUNCTION sa_we ""
 /begin DEF_CHARACTERISTIC KF_SA_T_TRIG_MAX KL_SA_N_DYN KL_SA_N_GANG KL_SA_N_HYS_GANG KL_SA_N_TMOT K_SA_MD_FW_REL_MIN K_SA_MD_HYS K_SA_MD_IND_NE_MAX K_SA_MD_IND_NE_MIN K_SA_MSR_SPERRZEIT K_SA_N_HYS K_SA_TKAT_MIN K_SA_TZ_MIN_HYS K_SA_WE_MD_HYS /end DEF_CHARACTERISTIC
 /begin REF_CHARACTERISTIC /end REF_CHARACTERISTIC
 /begin IN_MEASUREMENT /end IN_MEASUREMENT
 /begin OUT_MEASUREMENT /end OUT_MEASUREMENT
/end FUNCTION
/begin FUNCTION spgr "" /begin DEF_CHARACTERISTIC KL_SPGR_FREQ /end DEF_CHARACTERISTIC /begin REF_CHARACTERISTIC /end REF_CHARACTERISTIC /begin IN_MEASUREMENT /end IN_MEASUREMENT /begin OUT_MEASUREMENT /end OUT_MEASUREMENT /end FUNCTION
/begin FUNCTION spi "" /begin DEF_CHARACTERISTIC /end DEF_CHARACTERISTIC /begin REF_CHARACTERISTIC /end REF_CHARACTERISTIC /begin IN_MEASUREMENT /end IN_MEASUREMENT /begin OUT_MEASUREMENT /end OUT_MEASUREMENT /end FUNCTION
/begin FUNCTION stat_data ""
 /begin DEF_CHARACTERISTIC KL_STAT_DATA_N KL_STAT_DATA_RF KL_STAT_DATA_TDME KL_STAT_DATA_TMOT KL_STAT_DATA_TOEL /end DEF_CHARACTERISTIC
 /begin REF_CHARACTERISTIC /end REF_CHARACTERISTIC
 /begin IN_MEASUREMENT /end IN_MEASUREMENT
 /begin OUT_MEASUREMENT /end OUT_MEASUREMENT
/end FUNCTION
/begin FUNCTION sw_confg_exd "" /begin DEF_CHARACTERISTIC /end DEF_CHARACTERISTIC /begin REF_CHARACTERISTIC /end REF_CHARACTERISTIC /begin IN_MEASUREMENT /end IN_MEASUREMENT /begin OUT_MEASUREMENT /end OUT_MEASUREMENT /end FUNCTION
/begin RECORD_LAYOUT TKW_VV_VV_UB FNC_VALUES 1 UBYTE COLUMN_DIR DIRECT /end RECORD_LAYOUT
/begin RECORD_LAYOUT TKW_VV_VV_UW FNC_VALUES 1 UWORD COLUMN_DIR DIRECT /end RECORD_LAYOUT
/begin RECORD_LAYOUT TKW_VV_VV_SW FNC_VALUES 1 SWORD COLUMN_DIR DIRECT /end RECORD_LAYOUT
/begin RECORD_LAYOUT TKL_UW_VV_UW NO_AXIS_PTS_X 1 UBYTE RESERVED 2 BYTE AXIS_PTS_X 3 UWORD INDEX_INCR DIRECT FNC_VALUES 4 UWORD COLUMN_DIR DIRECT /end RECORD_LAYOUT
/begin RECORD_LAYOUT TKL_SW_VV_UW NO_AXIS_PTS_X 1 UBYTE RESERVED 2 BYTE AXIS_PTS_X 3 SWORD INDEX_INCR DIRECT FNC_VALUES 4 UWORD COLUMN_DIR DIRECT /end RECORD_LAYOUT
/begin RECORD_LAYOUT TKL_SW_VV_SW NO_AXIS_PTS_X 1 UBYTE RESERVED 2 BYTE AXIS_PTS_X 3 SWORD INDEX_INCR DIRECT FNC_VALUES 4 SWORD COLUMN_DIR DIRECT /end RECORD_LAYOUT
/begin RECORD_LAYOUT TKF_UB_UB_UB NO_AXIS_PTS_X 1 UBYTE NO_AXIS_PTS_Y 2 UBYTE AXIS_PTS_X 3 UBYTE INDEX_INCR DIRECT AXIS_PTS_Y 4 UBYTE INDEX_INCR DIRECT FNC_VALUES 5 UBYTE COLUMN_DIR DIRECT /end RECORD_LAYOUT
/begin RECORD_LAYOUT TKF_UW_UB_UW NO_AXIS_PTS_X 1 UBYTE NO_AXIS_PTS_Y 2 UBYTE AXIS_PTS_X 3 UBYTE INDEX_INCR DIRECT AXIS_PTS_Y 4 UWORD INDEX_INCR DIRECT FNC_VALUES 5 UWORD COLUMN_DIR DIRECT /end RECORD_LAYOUT
/begin RECORD_LAYOUT TKF_UW_SW_UW NO_AXIS_PTS_X 1 UBYTE NO_AXIS_PTS_Y 2 UBYTE AXIS_PTS_X 3 SWORD INDEX_INCR DIRECT AXIS_PTS_Y 4 UWORD INDEX_INCR DIRECT FNC_VALUES 5 UWORD COLUMN_DIR DIRECT /end RECORD_LAYOUT
/begin RECORD_LAYOUT TKF_SW_UB_UB NO_AXIS_PTS_X 1 UBYTE NO_AXIS_PTS_Y 2 UBYTE AXIS_PTS_X 3 UBYTE INDEX_INCR DIRECT AXIS_PTS_Y 4 SWORD INDEX_INCR DIRECT FNC_VALUES 5 UBYTE COLUMN_DIR DIRECT /end RECORD_LAYOUT
/begin RECORD_LAYOUT TKF_SW_UW_UB NO_AXIS_PTS_X 1 UBYTE NO_AXIS_PTS_Y 2 UBYTE AXIS_PTS_X 3 UWORD INDEX_INCR DIRECT AXIS_PTS_Y 4 SWORD INDEX_INCR DIRECT FNC_VALUES 5 UBYTE COLUMN_DIR DIRECT /end RECORD_LAYOUT
/begin RECORD_LAYOUT TKF_SW_SW_UW NO_AXIS_PTS_X 1 UBYTE NO_AXIS_PTS_Y 2 UBYTE AXIS_PTS_X 3 SWORD INDEX_INCR DIRECT AXIS_PTS_Y 4 SWORD INDEX_INCR DIRECT FNC_VALUES 5 UWORD COLUMN_DIR DIRECT /end RECORD_LAYOUT
/begin RECORD_LAYOUT TKF_SW_SW_SW NO_AXIS_PTS_X 1 UBYTE NO_AXIS_PTS_Y 2 UBYTE AXIS_PTS_X 3 SWORD INDEX_INCR DIRECT AXIS_PTS_Y 4 SWORD INDEX_INCR DIRECT FNC_VALUES 5 SWORD COLUMN_DIR DIRECT /end RECORD_LAYOUT
/* ---- V452-specific parameters (names assigned during V452 reverse engineering) ---- */
/begin CHARACTERISTIC KL_PKSR_QSSP_UB_F "[V452-new, name assigned] Factor on SSP volume flow over battery voltage U_KL87 (fn 0x55B8C: KF_PKSR_PSOLL_QSOLL_TV result x curve /1024 -> RAM 0x3FCCB4)" CURVE 0x76046 TKL_SW_VV_SW 32.0 FORMULA_0075 0.0 31.999 /begin AXIS_DESCR STD_AXIS FORMULA_0008 4 0.0 3276.7 FORMAT "%6.1" /end AXIS_DESCR /end CHARACTERISTIC
/* ---- added 04.11.2026: further code-read calibration ---- */
/begin CHARACTERISTIC UNK_SK_SELFTEST_KL_068B0 "Safety-concept lookup self-test reference table (fixed test vectors from ROM). Not tuning data - DO NOT MODIFY. [Added V452 04.11.2026]" CURVE 0x77612 TKL_SW_VV_SW 32767.0 FORMULA_USER1 -32768.0 32767.0
 /begin AXIS_DESCR STD_AXIS NO_INPUT_QUANTITY FORMULA_USER1 5 -32768.0 32767.0 /end AXIS_DESCR
/end CHARACTERISTIC
/begin CHARACTERISTIC UNK_SK_SELFTEST_KF_068C6 "Safety-concept lookup self-test reference table (fixed test vectors from ROM). Not tuning data - DO NOT MODIFY. [Added V452 04.11.2026]" MAP 0x77628 TKF_SW_SW_SW 32767.0 FORMULA_USER1 -32768.0 32767.0
 /begin AXIS_DESCR STD_AXIS NO_INPUT_QUANTITY FORMULA_USER1 4 -32768.0 32767.0 /end AXIS_DESCR
 /begin AXIS_DESCR STD_AXIS NO_INPUT_QUANTITY FORMULA_USER1 4 -32768.0 32767.0 /end AXIS_DESCR
/end CHARACTERISTIC
/begin CHARACTERISTIC UNK_SK_SELFTEST_KF_068F8 "Safety-concept lookup self-test reference table (fixed test vectors from ROM). Not tuning data - DO NOT MODIFY. [Added V452 04.11.2026]" MAP 0x7765A TKF_SW_SW_SW 32767.0 FORMULA_USER1 -32768.0 32767.0
 /begin AXIS_DESCR STD_AXIS NO_INPUT_QUANTITY FORMULA_USER1 4 -32768.0 32767.0 /end AXIS_DESCR
 /begin AXIS_DESCR STD_AXIS NO_INPUT_QUANTITY FORMULA_USER1 4 -32768.0 32767.0 /end AXIS_DESCR
/end CHARACTERISTIC
/begin CHARACTERISTIC UNK_RD_INJ_0958E "[Added 04.11.2026] Unidentified - engine-state monitoring (code 0x124A70/0x1241B8, fault paths 0x88/0x89): counter limit, fault path 0x88 (raw 20)" VALUE 0x7A2C4 TKW_VV_VV_UB 255.0 FORMULA_USER1 0.0 255.0 FORMAT "%6.0" /end CHARACTERISTIC
/begin CHARACTERISTIC UNK_RD_INJ_09590 "[Added 04.11.2026] Unidentified - engine-state monitoring (code 0x124A70/0x1241B8, fault paths 0x88/0x89): engine speed threshold (raw 1500 rpm)" VALUE 0x7A2C6 TKW_VV_VV_SW 32767.0 FORMULA_USER1 -32768.0 32767.0 FORMAT "%6.0" /end CHARACTERISTIC
/begin CHARACTERISTIC UNK_RD_INJ_09592 "[Added 04.11.2026] Unidentified - engine-state monitoring (code 0x124A70/0x1241B8, fault paths 0x88/0x89): engine speed threshold (raw 2000 rpm)" VALUE 0x7A2C8 TKW_VV_VV_SW 32767.0 FORMULA_USER1 -32768.0 32767.0 FORMAT "%6.0" /end CHARACTERISTIC
/begin CHARACTERISTIC UNK_RD_INJ_09594 "[Added 04.11.2026] Unidentified - engine-state monitoring (code 0x124A70/0x1241B8, fault paths 0x88/0x89): counter limit (raw 5)" VALUE 0x7A2CA TKW_VV_VV_UB 255.0 FORMULA_USER1 0.0 255.0 FORMAT "%6.0" /end CHARACTERISTIC
/begin CHARACTERISTIC UNK_RD_INJ_09595 "[Added 04.11.2026] Unidentified - engine-state monitoring (code 0x124A70/0x1241B8, fault paths 0x88/0x89): counter limit (raw 100)" VALUE 0x7A2CB TKW_VV_VV_UB 255.0 FORMULA_USER1 0.0 255.0 FORMAT "%6.0" /end CHARACTERISTIC
/end MODULE
/end PROJECT
