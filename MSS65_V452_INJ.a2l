/begin PROJECT MSS65-inj-V452 "MSS65 INJ - V452.01-B204.00, data set 0569Q60Z160E"
/begin HEADER "" VERSION "V452.01-B204.00" /end HEADER
/begin MODULE _MSS65-inj "MSS65 INJ - V452.01-B204.00, calibration xxxxxxxx"
/begin MOD_COMMON "" BYTE_ORDER MSB_FIRST /* Default byteorder (Motorola) */ /end MOD_COMMON
/begin COMPU_METHOD FORMULA_0003 "FORMULA_0003" RAT_FUNC "%3.0" "-" COEFFS 0 1 0 0 0 1 /end COMPU_METHOD
/begin COMPU_METHOD FORMULA_0006 "FORMULA_0006" RAT_FUNC "%5.0" "Upm" COEFFS 0 1 0 0 0 1 /end COMPU_METHOD
/begin COMPU_METHOD FORMULA_0007 "FORMULA_0007" RAT_FUNC "%8.3" "-" COEFFS 0 10000 0 0 0 1 /end COMPU_METHOD
/begin COMPU_METHOD FORMULA_0008 "FORMULA_0008" RAT_FUNC "%6.1" "V" COEFFS 0 10 0 0 0 1 /end COMPU_METHOD
/begin COMPU_METHOD FORMULA_0010 "FORMULA_0010" RAT_FUNC "%5.0" "-" COEFFS 0 1 0 0 0 1 /end COMPU_METHOD
/begin COMPU_METHOD FORMULA_0021 "FORMULA_0021" RAT_FUNC "%7.2" "s" COEFFS 0 100 0 0 0 1 /end COMPU_METHOD
/* ------------------ Abschnitt erzeugt aus adapt_glob.dat ------------------ */
/begin COMPU_METHOD FORMULA_0023 "FORMULA_0023" RAT_FUNC "%6.1" "�C" COEFFS 0 10 2732 0 0 1 /end COMPU_METHOD
/begin COMPU_METHOD FORMULA_0024 "FORMULA_0024" RAT_FUNC "%9.4" "-" COEFFS 0 32768 0 0 0 1 /end COMPU_METHOD
/begin COMPU_METHOD FORMULA_0025 "FORMULA_0025" RAT_FUNC "%8.3" "-" COEFFS 0 16384 0 0 0 1 /end COMPU_METHOD
/begin COMPU_METHOD FORMULA_0033 "FORMULA_0033" RAT_FUNC "%5.2" "-" COEFFS 0 1 0 0 0 1 /end COMPU_METHOD
/begin COMPU_METHOD FORMULA_0062 "FORMULA_0062" RAT_FUNC "%5.0" "s" COEFFS 0 1 0 0 0 1 /end COMPU_METHOD
/begin COMPU_METHOD FORMULA_0073 "FORMULA_0073" RAT_FUNC "%6.1" "s" COEFFS 0 10 0 0 0 1 /end COMPU_METHOD
/begin COMPU_METHOD FORMULA_0075 "FORMULA_0075" RAT_FUNC "%8.3" "-" COEFFS 0 1024 0 0 0 1 /end COMPU_METHOD
/begin COMPU_METHOD FORMULA_0076 "FORMULA_0076" RAT_FUNC "%6.1" "Kelvin" COEFFS 0 10 0 0 0 1 /end COMPU_METHOD
/begin COMPU_METHOD FORMULA_0077 "FORMULA_0077" RAT_FUNC "%6.1" "mbar" COEFFS 0 16 0 0 0 1 /end COMPU_METHOD
/begin COMPU_METHOD FORMULA_0078 "FORMULA_0078" RAT_FUNC "%6.1" "km/h" COEFFS 0 16 0 0 0 1 /end COMPU_METHOD
/* ------------------ Abschnitt erzeugt aus glob.dat ------------------ */
/begin COMPU_METHOD FORMULA_0083 "FORMULA_0083" RAT_FUNC "%7.2" "-" COEFFS 0 1 0 0 0 1 /end COMPU_METHOD
/begin COMPU_METHOD FORMULA_0112 "FORMULA_0112" RAT_FUNC "%6.1" "kg/h" COEFFS 0 10 0 0 0 1 /end COMPU_METHOD
/begin COMPU_METHOD FORMULA_0117 "FORMULA_0117" RAT_FUNC "%7.2" "s" COEFFS 0 200 0 0 0 1 /end COMPU_METHOD
/begin COMPU_METHOD FORMULA_0118 "FORMULA_0118" RAT_FUNC "%8.3" "bar" COEFFS 0 1000 0 0 0 1 /end COMPU_METHOD
/begin COMPU_METHOD FORMULA_0123 "FORMULA_0123" RAT_FUNC "%5.0" "digit" COEFFS 0 1 0 0 0 1 /end COMPU_METHOD
/begin COMPU_METHOD FORMULA_0132 "FORMULA_0132" RAT_FUNC "%7.2" "m/(s*s)" COEFFS 0 40 0 0 0 1 /end COMPU_METHOD
/begin COMPU_METHOD FORMULA_0152 "FORMULA_0152" RAT_FUNC "%9.2" "s" COEFFS 0 100 0 0 0 1 /end COMPU_METHOD
/begin COMPU_METHOD FORMULA_0164 "FORMULA_0164" TAB_VERB "%5.2" "-" COMPU_TAB_REF FORMULA_0164_VTAB /end COMPU_METHOD
/begin COMPU_VTAB FORMULA_0164_VTAB "FORMULA_0164_VTAB" TAB_VERB 2 0 "AUS" 1 "EIN" DEFAULT_VALUE "ungueltig" /end COMPU_VTAB
/begin COMPU_METHOD FORMULA_0295 "FORMULA_0295" RAT_FUNC "%9.4" "-" COEFFS 0 16384 0 0 0 1 /end COMPU_METHOD
/begin COMPU_METHOD FORMULA_0431 "FORMULA_0431" RAT_FUNC "%5.2" "mm" COEFFS 0 256 0 0 0 75 /end COMPU_METHOD
/* ------------------ Abschnitt erzeugt aus dgen.dat ------------------ */
/begin COMPU_METHOD FORMULA_0458 "FORMULA_0458" RAT_FUNC "%4.1" "s" COEFFS 0 10 0 0 0 1 /end COMPU_METHOD
/begin COMPU_METHOD FORMULA_0531 "FORMULA_0531" RAT_FUNC "%8.3" "mg/ASP" COEFFS 0 64 0 0 0 1 /end COMPU_METHOD
/begin COMPU_METHOD FORMULA_0532 "FORMULA_0532" RAT_FUNC "%5.0" "mV" COEFFS 0 1024 0 0 0 5000 /end COMPU_METHOD
/begin COMPU_METHOD FORMULA_0537 "FORMULA_0537" RAT_FUNC "%6.1" "Ohm" COEFFS 0 10 0 0 0 1 /end COMPU_METHOD
/begin COMPU_METHOD FORMULA_0539 "FORMULA_0539" RAT_FUNC "%5.0" "ms" COEFFS 0 1 0 0 0 100 /end COMPU_METHOD
/begin COMPU_METHOD FORMULA_0555 "FORMULA_0555" RAT_FUNC "%8.3" "%" COEFFS 0 32768 0 0 0 100 /end COMPU_METHOD
/begin COMPU_METHOD FORMULA_0556 "FORMULA_0556" RAT_FUNC "%9.4" "-" COEFFS 0 10000 0 0 0 1 /end COMPU_METHOD
/begin COMPU_METHOD FORMULA_0557 "FORMULA_0557" RAT_FUNC "%4.1" "l" COEFFS 0 2 0 0 0 1 /end COMPU_METHOD
/begin COMPU_METHOD FORMULA_0562 "FORMULA_0562" RAT_FUNC "%6.1" "kg*5ms/h" COEFFS 0 10 0 0 0 1 /end COMPU_METHOD
/begin COMPU_METHOD FORMULA_0575 "FORMULA_0575" TAB_VERB "%5.2" "-" COMPU_TAB_REF FORMULA_0575_VTAB /end COMPU_METHOD
/begin COMPU_VTAB FORMULA_0575_VTAB "FORMULA_0575_VTAB" TAB_VERB 3 0 "inaktive" 1 "einfangen" 2 "eingeregelt" DEFAULT_VALUE "ungueltig" /end COMPU_VTAB
/begin COMPU_METHOD FORMULA_0600 "FORMULA_0600" RAT_FUNC "%7.2" "min" COEFFS 0 60 0 0 0 1 /end COMPU_METHOD
/begin COMPU_METHOD FORMULA_0606 "FORMULA_0606" RAT_FUNC "%7.2" "mm" COEFFS 0 337 0 0 0 100 /end COMPU_METHOD
/begin COMPU_METHOD FORMULA_0651 "FORMULA_0651" RAT_FUNC "%6.3" "s" COEFFS 0 0 1.28 0 1 0 /end COMPU_METHOD
/begin COMPU_METHOD FORMULA_0664 "FORMULA_0664" RAT_FUNC "%5.2" "s" COEFFS 0 0 2.56 0 1 0 /end COMPU_METHOD
/begin COMPU_METHOD FORMULA_0683 "FORMULA_0683" RAT_FUNC "%5.2" "s" COEFFS 0 0 25.6 0 1 0 /end COMPU_METHOD
/* ------------------ Abschnitt erzeugt aus kats.dat ------------------ */
/begin COMPU_METHOD FORMULA_0727 "FORMULA_0727" TAB_VERB "%5.2" "-" COMPU_TAB_REF FORMULA_0727_VTAB /end COMPU_METHOD
/begin COMPU_VTAB FORMULA_0727_VTAB "FORMULA_0727_VTAB" TAB_VERB 4 0 "keiner" 1 "nkat" 2 "mdl" 4 "vkat" DEFAULT_VALUE "ungueltig" /end COMPU_VTAB
/begin COMPU_METHOD FORMULA_0728 "FORMULA_0728" RAT_FUNC "%8.3" "-/s" COEFFS 0 16384 0 0 0 10 /end COMPU_METHOD
/begin COMPU_METHOD FORMULA_0729 "FORMULA_0729" TAB_VERB "%3.0" "-" COMPU_TAB_REF FORMULA_0729_VTAB /end COMPU_METHOD
/begin COMPU_VTAB FORMULA_0729_VTAB "FORMULA_0729_VTAB" TAB_VERB 2 0 "TNKAT aus MDL" 1 "TNKAT aus tabg_kat" DEFAULT_VALUE "undef" /end COMPU_VTAB
/* ------------------ Abschnitt erzeugt aus kge.dat ------------------ */
/begin COMPU_METHOD FORMULA_0730 "FORMULA_0730" TAB_VERB "%5.2" "-" COMPU_TAB_REF FORMULA_0730_VTAB /end COMPU_METHOD
/begin COMPU_VTAB FORMULA_0730_VTAB "FORMULA_0730_VTAB" TAB_VERB 4 0 "inaktiv" 1 "aktive" 64 "NIO" 128 "IO" /end COMPU_VTAB
/begin COMPU_METHOD FORMULA_0731 "FORMULA_0731" RAT_FUNC "%5.2" "mm" COEFFS 0 337 0 0 0 100 /end COMPU_METHOD
/* ------------------ Abschnitt erzeugt aus kva.dat ------------------ */
/begin COMPU_METHOD FORMULA_0746 "FORMULA_0746" RAT_FUNC "%6.1" "l/h" COEFFS 0 8 0 0 0 1 /end COMPU_METHOD
/begin COMPU_METHOD FORMULA_0755 "FORMULA_0755" RAT_FUNC "%7.2" "-" COEFFS 0 256 0 0 0 1 /end COMPU_METHOD
/begin COMPU_METHOD FORMULA_0768 "FORMULA_0768" TAB_VERB "%7.2" "-" COMPU_TAB_REF FORMULA_0768_VTAB /end COMPU_METHOD
/begin COMPU_VTAB FORMULA_0768_VTAB "FORMULA_0768_VTAB" TAB_VERB 1 0 "inaktiv" DEFAULT_VALUE "aktiv" /end COMPU_VTAB
/begin COMPU_METHOD FORMULA_0770 "FORMULA_0770" TAB_VERB "%7.2" "-" COMPU_TAB_REF FORMULA_0770_VTAB /end COMPU_METHOD
/begin COMPU_VTAB FORMULA_0770_VTAB "FORMULA_0770_VTAB" TAB_VERB 1 0 "inaktiv" DEFAULT_VALUE "aktiv" /end COMPU_VTAB
/begin COMPU_METHOD FORMULA_0771 "FORMULA_0771" TAB_VERB "%7.2" "-" COMPU_TAB_REF FORMULA_0771_VTAB /end COMPU_METHOD
/begin COMPU_VTAB FORMULA_0771_VTAB "FORMULA_0771_VTAB" TAB_VERB 1 0 "inaktiv" DEFAULT_VALUE "aktiv" /end COMPU_VTAB
/begin COMPU_METHOD FORMULA_0782 "FORMULA_0782" TAB_VERB "%7.2" "-" COMPU_TAB_REF FORMULA_0782_VTAB /end COMPU_METHOD
/begin COMPU_VTAB FORMULA_0782_VTAB "FORMULA_0782_VTAB" TAB_VERB 2 0 "automatisch" 1 "manuell" /end COMPU_VTAB
/begin COMPU_METHOD FORMULA_0784 "FORMULA_0784" TAB_VERB "%7.2" "-" COMPU_TAB_REF FORMULA_0784_VTAB /end COMPU_METHOD
/begin COMPU_VTAB FORMULA_0784_VTAB "FORMULA_0784_VTAB" TAB_VERB 2 0 "ADAPTION" 1 "RESET" /end COMPU_VTAB
/begin COMPU_METHOD FORMULA_0791 "FORMULA_0791" RAT_FUNC "%5.0" "�C" COEFFS 0 1 0 0 0 1 /end COMPU_METHOD
/begin COMPU_METHOD FORMULA_0798 "FORMULA_0798" TAB_VERB "%7.2" "-" COMPU_TAB_REF FORMULA_0798_VTAB /end COMPU_METHOD
/begin COMPU_VTAB FORMULA_0798_VTAB "FORMULA_0798_VTAB" TAB_VERB 2 0 "inaktiv" 1 "aktiv" /end COMPU_VTAB
/begin COMPU_METHOD FORMULA_0799 "FORMULA_0799" RAT_FUNC "%5.0" "sec" COEFFS 0 1 0 0 0 1 /end COMPU_METHOD
/begin COMPU_METHOD FORMULA_0800 "FORMULA_0800" RAT_FUNC "%6.1" "�C" COEFFS 0 10 0 0 0 1 /end COMPU_METHOD
/begin COMPU_METHOD FORMULA_0832 "FORMULA_0832" RAT_FUNC "%5.0" "mg" COEFFS 0 1 0 0 0 1 /end COMPU_METHOD
/begin COMPU_METHOD FORMULA_0836 "FORMULA_0836" TAB_VERB "%7.2" "-" COMPU_TAB_REF FORMULA_0836_VTAB /end COMPU_METHOD
/begin COMPU_VTAB FORMULA_0836_VTAB "FORMULA_0836_VTAB" TAB_VERB 1 0 "inaktiv" DEFAULT_VALUE "aktiv" /end COMPU_VTAB
/begin COMPU_METHOD FORMULA_0839 "FORMULA_0839" TAB_VERB "%5.2" "-" COMPU_TAB_REF FORMULA_0839_VTAB /end COMPU_METHOD
/begin COMPU_VTAB FORMULA_0839_VTAB "FORMULA_0839_VTAB" TAB_VERB 2 0 "inaktiv" 1 "aktiv" /end COMPU_VTAB
/begin COMPU_METHOD FORMULA_0840 "FORMULA_0840" RAT_FUNC "%6.1" "%" COEFFS 0 1024 0 0 0 100 /end COMPU_METHOD
/* ------------------ Abschnitt erzeugt aus lavk_obd.dat ------------------ */
/begin COMPU_METHOD FORMULA_0841 "FORMULA_0841" TAB_VERB "%7.2" "-" COMPU_TAB_REF FORMULA_0841_VTAB /end COMPU_METHOD
/begin COMPU_VTAB FORMULA_0841_VTAB "FORMULA_0841_VTAB" TAB_VERB 1 0 "kein OPENLOAD" DEFAULT_VALUE "IA-OPENLOAD" /end COMPU_VTAB
/begin COMPU_METHOD FORMULA_0842 "FORMULA_0842" TAB_VERB "%7.2" "-" COMPU_TAB_REF FORMULA_0842_VTAB /end COMPU_METHOD
/begin COMPU_VTAB FORMULA_0842_VTAB "FORMULA_0842_VTAB" TAB_VERB 1 0 "kein OPENLOAD" DEFAULT_VALUE "IP/VM-OPENLOAD" /end COMPU_VTAB
/begin COMPU_METHOD FORMULA_0843 "FORMULA_0843" TAB_VERB "%7.2" "-" COMPU_TAB_REF FORMULA_0843_VTAB /end COMPU_METHOD
/begin COMPU_VTAB FORMULA_0843_VTAB "FORMULA_0843_VTAB" TAB_VERB 1 0 "kein OPENLOAD" DEFAULT_VALUE "UN-OPENLOAD" /end COMPU_VTAB
/begin COMPU_METHOD FORMULA_0844 "FORMULA_0844" TAB_VERB "%7.2" "-" COMPU_TAB_REF FORMULA_0844_VTAB /end COMPU_METHOD
/begin COMPU_VTAB FORMULA_0844_VTAB "FORMULA_0844_VTAB" TAB_VERB 1 0 "kein OPENLOAD" DEFAULT_VALUE "IP/VM-OPENLOAD" /end COMPU_VTAB
/begin COMPU_METHOD FORMULA_0845 "FORMULA_0845" TAB_VERB "%7.2" "-" COMPU_TAB_REF FORMULA_0845_VTAB /end COMPU_METHOD
/begin COMPU_VTAB FORMULA_0845_VTAB "FORMULA_0845_VTAB" TAB_VERB 1 0 "kein OPENLOAD" DEFAULT_VALUE "IP/VM-VERDACHT" /end COMPU_VTAB
/begin COMPU_METHOD FORMULA_0846 "FORMULA_0846" TAB_VERB "%7.2" "-" COMPU_TAB_REF FORMULA_0846_VTAB /end COMPU_METHOD
/begin COMPU_VTAB FORMULA_0846_VTAB "FORMULA_0846_VTAB" TAB_VERB 1 0 "Diag aktiv" DEFAULT_VALUE "Ausserhalb Band" /end COMPU_VTAB
/begin COMPU_METHOD FORMULA_0847 "FORMULA_0847" TAB_VERB "%7.2" "-" COMPU_TAB_REF FORMULA_0847_VTAB /end COMPU_METHOD
/begin COMPU_VTAB FORMULA_0847_VTAB "FORMULA_0847_VTAB" TAB_VERB 4 1 "Diag. aktiv" 3 "FETT-Plausi" 5 "MAGER-Plausi" 9 "IP/VM-Plausi" DEFAULT_VALUE "inaktiv" /end COMPU_VTAB
/begin COMPU_METHOD FORMULA_0848 "FORMULA_0848" TAB_VERB "%7.2" "-" COMPU_TAB_REF FORMULA_0848_VTAB /end COMPU_METHOD
/begin COMPU_VTAB FORMULA_0848_VTAB "FORMULA_0848_VTAB" TAB_VERB 1 0 "Oszi an" DEFAULT_VALUE "Oszi aus" /end COMPU_VTAB
/begin COMPU_METHOD FORMULA_0849 "FORMULA_0849" TAB_VERB "%7.2" "-" COMPU_TAB_REF FORMULA_0849_VTAB /end COMPU_METHOD
/begin COMPU_VTAB FORMULA_0849_VTAB "FORMULA_0849_VTAB" TAB_VERB 1 0 "--" DEFAULT_VALUE "ENDE" /end COMPU_VTAB
/begin COMPU_METHOD FORMULA_0850 "FORMULA_0850" TAB_VERB "%7.2" "-" COMPU_TAB_REF FORMULA_0850_VTAB /end COMPU_METHOD
/begin COMPU_VTAB FORMULA_0850_VTAB "FORMULA_0850_VTAB" TAB_VERB 2 1 "Diag. aktiv" 3 "Diag. erfolgt" DEFAULT_VALUE "inaktiv" /end COMPU_VTAB
/begin COMPU_METHOD FORMULA_0851 "FORMULA_0851" TAB_VERB "%7.2" "-" COMPU_TAB_REF FORMULA_0851_VTAB /end COMPU_METHOD
/begin COMPU_VTAB FORMULA_0851_VTAB "FORMULA_0851_VTAB" TAB_VERB 1 0 "nicht angefordert" DEFAULT_VALUE "angefordert" /end COMPU_VTAB
/begin COMPU_METHOD FORMULA_0852 "FORMULA_0852" TAB_VERB "%7.2" "-" COMPU_TAB_REF FORMULA_0852_VTAB /end COMPU_METHOD
/begin COMPU_VTAB FORMULA_0852_VTAB "FORMULA_0852_VTAB" TAB_VERB 1 0 "inaktiv" DEFAULT_VALUE "aktiv" /end COMPU_VTAB
/begin COMPU_METHOD FORMULA_0853 "FORMULA_0853" TAB_VERB "%7.2" "-" COMPU_TAB_REF FORMULA_0853_VTAB /end COMPU_METHOD
/begin COMPU_VTAB FORMULA_0853_VTAB "FORMULA_0853_VTAB" TAB_VERB 1 0 "-" DEFAULT_VALUE "i.O." /end COMPU_VTAB
/begin COMPU_METHOD FORMULA_0854 "FORMULA_0854" TAB_VERB "%7.2" "-" COMPU_TAB_REF FORMULA_0854_VTAB /end COMPU_METHOD
/begin COMPU_VTAB FORMULA_0854_VTAB "FORMULA_0854_VTAB" TAB_VERB 1 0 "-" DEFAULT_VALUE "i.O." /end COMPU_VTAB
/begin COMPU_METHOD FORMULA_0855 "FORMULA_0855" TAB_VERB "%7.2" "-" COMPU_TAB_REF FORMULA_0855_VTAB /end COMPU_METHOD
/begin COMPU_VTAB FORMULA_0855_VTAB "FORMULA_0855_VTAB" TAB_VERB 1 0 "-" DEFAULT_VALUE "i.O." /end COMPU_VTAB
/begin COMPU_METHOD FORMULA_0856 "FORMULA_0856" TAB_VERB "%7.2" "-" COMPU_TAB_REF FORMULA_0856_VTAB /end COMPU_METHOD
/begin COMPU_VTAB FORMULA_0856_VTAB "FORMULA_0856_VTAB" TAB_VERB 1 0 "-" DEFAULT_VALUE "i.O." /end COMPU_VTAB
/begin COMPU_METHOD FORMULA_0857 "FORMULA_0857" TAB_VERB "%7.2" "-" COMPU_TAB_REF FORMULA_0857_VTAB /end COMPU_METHOD
/begin COMPU_VTAB FORMULA_0857_VTAB "FORMULA_0857_VTAB" TAB_VERB 1 0 "-" DEFAULT_VALUE "n.i.O." /end COMPU_VTAB
/begin COMPU_METHOD FORMULA_0858 "FORMULA_0858" TAB_VERB "%7.2" "-" COMPU_TAB_REF FORMULA_0858_VTAB /end COMPU_METHOD
/begin COMPU_VTAB FORMULA_0858_VTAB "FORMULA_0858_VTAB" TAB_VERB 1 0 "-" DEFAULT_VALUE "n.i.O." /end COMPU_VTAB
/begin COMPU_METHOD FORMULA_0859 "FORMULA_0859" TAB_VERB "%7.2" "-" COMPU_TAB_REF FORMULA_0859_VTAB /end COMPU_METHOD
/begin COMPU_VTAB FORMULA_0859_VTAB "FORMULA_0859_VTAB" TAB_VERB 1 0 "-" DEFAULT_VALUE "n.i.O." /end COMPU_VTAB
/begin COMPU_METHOD FORMULA_0860 "FORMULA_0860" TAB_VERB "%7.2" "-" COMPU_TAB_REF FORMULA_0860_VTAB /end COMPU_METHOD
/begin COMPU_VTAB FORMULA_0860_VTAB "FORMULA_0860_VTAB" TAB_VERB 1 0 "-" DEFAULT_VALUE "n.i.O." /end COMPU_VTAB
/begin COMPU_METHOD FORMULA_0861 "FORMULA_0861" TAB_VERB "%7.2" "-" COMPU_TAB_REF FORMULA_0861_VTAB /end COMPU_METHOD
/begin COMPU_VTAB FORMULA_0861_VTAB "FORMULA_0861_VTAB" TAB_VERB 1 0 "-" DEFAULT_VALUE "ENDE" /end COMPU_VTAB
/begin COMPU_METHOD FORMULA_0862 "FORMULA_0862" RAT_FUNC "%5.0" "s" COEFFS 0 10 0 0 0 1 /end COMPU_METHOD
/begin COMPU_METHOD FORMULA_0863 "FORMULA_0863" TAB_VERB "%7.2" "-" COMPU_TAB_REF FORMULA_0863_VTAB /end COMPU_METHOD
/begin COMPU_VTAB FORMULA_0863_VTAB "FORMULA_0863_VTAB" TAB_VERB 1 0 "-" DEFAULT_VALUE "OEL-Verduennung" /end COMPU_VTAB
/begin COMPU_METHOD FORMULA_0864 "FORMULA_0864" TAB_VERB "%7.2" "-" COMPU_TAB_REF FORMULA_0864_VTAB /end COMPU_METHOD
/begin COMPU_VTAB FORMULA_0864_VTAB "FORMULA_0864_VTAB" TAB_VERB 1 0 "nicht erfuellt" DEFAULT_VALUE "erfuellt" /end COMPU_VTAB
/begin COMPU_METHOD FORMULA_0865 "FORMULA_0865" TAB_VERB "%7.2" "-" COMPU_TAB_REF FORMULA_0865_VTAB /end COMPU_METHOD
/begin COMPU_VTAB FORMULA_0865_VTAB "FORMULA_0865_VTAB" TAB_VERB 1 0 "-" DEFAULT_VALUE "START-Werte" /end COMPU_VTAB
/begin COMPU_METHOD FORMULA_0866 "FORMULA_0866" TAB_VERB "%7.2" "-" COMPU_TAB_REF FORMULA_0866_VTAB /end COMPU_METHOD
/begin COMPU_VTAB FORMULA_0866_VTAB "FORMULA_0866_VTAB" TAB_VERB 1 0 "laueft" DEFAULT_VALUE "fertig" /end COMPU_VTAB
/begin COMPU_METHOD FORMULA_0867 "FORMULA_0867" TAB_VERB "%7.2" "-" COMPU_TAB_REF FORMULA_0867_VTAB /end COMPU_METHOD
/begin COMPU_VTAB FORMULA_0867_VTAB "FORMULA_0867_VTAB" TAB_VERB 1 0 "-" DEFAULT_VALUE "STOP" /end COMPU_VTAB
/begin COMPU_METHOD FORMULA_0868 "FORMULA_0868" TAB_VERB "%7.2" "-" COMPU_TAB_REF FORMULA_0868_VTAB /end COMPU_METHOD
/begin COMPU_VTAB FORMULA_0868_VTAB "FORMULA_0868_VTAB" TAB_VERB 2 0 "OBD-Plausi inaktiv" 1 "OBD-Plausi aktiv" /end COMPU_VTAB
/begin COMPU_METHOD FORMULA_0869 "FORMULA_0869" TAB_VERB "%7.2" "-" COMPU_TAB_REF FORMULA_0869_VTAB /end COMPU_METHOD
/begin COMPU_VTAB FORMULA_0869_VTAB "FORMULA_0869_VTAB" TAB_VERB 2 0 "OBD-SA inaktiv" 1 "OBD-SA aktiv" /end COMPU_VTAB
/begin COMPU_METHOD FORMULA_0870 "FORMULA_0870" TAB_VERB "%7.2" "-" COMPU_TAB_REF FORMULA_0870_VTAB /end COMPU_METHOD
/begin COMPU_VTAB FORMULA_0870_VTAB "FORMULA_0870_VTAB" TAB_VERB 2 0 "OBD-TL/VL inaktiv" 1 "OBD-TL/VL aktiv" /end COMPU_VTAB
/begin COMPU_METHOD FORMULA_0871 "FORMULA_0871" TAB_VERB "%7.2" "-" COMPU_TAB_REF FORMULA_0871_VTAB /end COMPU_METHOD
/begin COMPU_VTAB FORMULA_0871_VTAB "FORMULA_0871_VTAB" TAB_VERB 2 0 "KDS inaktiv" 1 "KSD aktiv" /end COMPU_VTAB
/* ------------------ Abschnitt erzeugt aus lsh_nk.dat ------------------ */
/begin COMPU_METHOD FORMULA_0928 "FORMULA_0928" TAB_VERB "%7.2" "-" COMPU_TAB_REF FORMULA_0928_VTAB /end COMPU_METHOD
/begin COMPU_VTAB FORMULA_0928_VTAB "FORMULA_0928_VTAB" TAB_VERB 1 0 "LSHN inaktiv" DEFAULT_VALUE "LSHN aktiv" /end COMPU_VTAB
/begin COMPU_METHOD FORMULA_0929 "FORMULA_0929" TAB_VERB "%7.2" "-" COMPU_TAB_REF FORMULA_0929_VTAB /end COMPU_METHOD
/begin COMPU_VTAB FORMULA_0929_VTAB "FORMULA_0929_VTAB" TAB_VERB 1 0 "unter TAUP" DEFAULT_VALUE "TAUP erreicht" /end COMPU_VTAB
/begin COMPU_METHOD FORMULA_0930 "FORMULA_0930" TAB_VERB "%7.2" "-" COMPU_TAB_REF FORMULA_0930_VTAB /end COMPU_METHOD
/begin COMPU_VTAB FORMULA_0930_VTAB "FORMULA_0930_VTAB" TAB_VERB 1 0 "-" DEFAULT_VALUE "Anforderung" /end COMPU_VTAB
/begin COMPU_METHOD FORMULA_0931 "FORMULA_0931" RAT_FUNC "%7.2" "%" COEFFS 0 8192 0 0 0 100 /end COMPU_METHOD
/begin COMPU_METHOD FORMULA_0932 "FORMULA_0932" RAT_FUNC "%5.0" "s" COEFFS 0 100 0 0 0 1 /end COMPU_METHOD
/begin COMPU_METHOD FORMULA_0933 "FORMULA_0933" TAB_VERB "%7.2" "-" COMPU_TAB_REF FORMULA_0933_VTAB /end COMPU_METHOD
/begin COMPU_VTAB FORMULA_0933_VTAB "FORMULA_0933_VTAB" TAB_VERB 1 0 "Diag. inaktiv" DEFAULT_VALUE "Diag. aktiv" /end COMPU_VTAB
/begin COMPU_METHOD FORMULA_0934 "FORMULA_0934" TAB_VERB "%7.2" "-" COMPU_TAB_REF FORMULA_0934_VTAB /end COMPU_METHOD
/begin COMPU_VTAB FORMULA_0934_VTAB "FORMULA_0934_VTAB" TAB_VERB 1 0 "R-Messung" DEFAULT_VALUE "R-Messung efolgt" /end COMPU_VTAB
/begin COMPU_METHOD FORMULA_0935 "FORMULA_0935" TAB_VERB "%7.2" "-" COMPU_TAB_REF FORMULA_0935_VTAB /end COMPU_METHOD
/begin COMPU_VTAB FORMULA_0935_VTAB "FORMULA_0935_VTAB" TAB_VERB 1 0 "i.O." DEFAULT_VALUE "SH_TO_X_SPERREN" /end COMPU_VTAB
/begin COMPU_METHOD FORMULA_0936 "FORMULA_0936" RAT_FUNC "%7.2" "A" COEFFS 0 215 0 0 0 1 /end COMPU_METHOD
/* ------------------ Abschnitt erzeugt aus lsh_vk.dat ------------------ */
/begin COMPU_METHOD FORMULA_0937 "FORMULA_0937" TAB_VERB "%7.2" "-" COMPU_TAB_REF FORMULA_0937_VTAB /end COMPU_METHOD
/begin COMPU_VTAB FORMULA_0937_VTAB "FORMULA_0937_VTAB" TAB_VERB 1 0 "LSHVK gesperrt" DEFAULT_VALUE "LSHVK freigegeben" /end COMPU_VTAB
/begin COMPU_METHOD FORMULA_0938 "FORMULA_0938" TAB_VERB "%7.2" "-" COMPU_TAB_REF FORMULA_0938_VTAB /end COMPU_METHOD
/begin COMPU_VTAB FORMULA_0938_VTAB "FORMULA_0938_VTAB" TAB_VERB 1 0 "LSHVK-REG inaktiv" DEFAULT_VALUE "LSHVK-REG aktiv" /end COMPU_VTAB
/begin COMPU_METHOD FORMULA_0939 "FORMULA_0939" TAB_VERB "%7.2" "-" COMPU_TAB_REF FORMULA_0939_VTAB /end COMPU_METHOD
/begin COMPU_VTAB FORMULA_0939_VTAB "FORMULA_0939_VTAB" TAB_VERB 1 0 "TEMP n.i.O." DEFAULT_VALUE "TEMP eingeregelt" /end COMPU_VTAB
/begin COMPU_METHOD FORMULA_0940 "FORMULA_0940" TAB_VERB "%7.2" "-" COMPU_TAB_REF FORMULA_0940_VTAB /end COMPU_METHOD
/begin COMPU_VTAB FORMULA_0940_VTAB "FORMULA_0940_VTAB" TAB_VERB 1 0 "TEMP i.O." DEFAULT_VALUE "MAX-TEMP" /end COMPU_VTAB
/begin COMPU_METHOD FORMULA_0941 "FORMULA_0941" TAB_VERB "%7.2" "-" COMPU_TAB_REF FORMULA_0941_VTAB /end COMPU_METHOD
/begin COMPU_VTAB FORMULA_0941_VTAB "FORMULA_0941_VTAB" TAB_VERB 1 0 "TEMP i.O." DEFAULT_VALUE "MIN-TEMP" /end COMPU_VTAB
/begin COMPU_METHOD FORMULA_0942 "FORMULA_0942" TAB_VERB "%7.2" "-" COMPU_TAB_REF FORMULA_0942_VTAB /end COMPU_METHOD
/begin COMPU_VTAB FORMULA_0942_VTAB "FORMULA_0942_VTAB" TAB_VERB 1 0 "i.O." DEFAULT_VALUE "MAX" /end COMPU_VTAB
/begin COMPU_METHOD FORMULA_0943 "FORMULA_0943" TAB_VERB "%7.2" "-" COMPU_TAB_REF FORMULA_0943_VTAB /end COMPU_METHOD
/begin COMPU_VTAB FORMULA_0943_VTAB "FORMULA_0943_VTAB" TAB_VERB 1 0 "i.O." DEFAULT_VALUE "MIN" /end COMPU_VTAB
/begin COMPU_METHOD FORMULA_0944 "FORMULA_0944" TAB_VERB "%7.2" "-" COMPU_TAB_REF FORMULA_0944_VTAB /end COMPU_METHOD
/begin COMPU_VTAB FORMULA_0944_VTAB "FORMULA_0944_VTAB" TAB_VERB 1 0 "-" DEFAULT_VALUE "Anforderung" /end COMPU_VTAB
/begin COMPU_METHOD FORMULA_0945 "FORMULA_0945" RAT_FUNC "%5.0" "mV" COEFFS 0 1024 0 0 0 5000 /end COMPU_METHOD
/begin COMPU_METHOD FORMULA_0946 "FORMULA_0946" RAT_FUNC "%7.2" "%" COEFFS 0 2048 0 0 0 100 /end COMPU_METHOD
/begin COMPU_METHOD FORMULA_0947 "FORMULA_0947" RAT_FUNC "%7.2" "%/s" COEFFS 0 2048 0 0 0 100 /end COMPU_METHOD
/begin COMPU_METHOD FORMULA_0948 "FORMULA_0948" RAT_FUNC "%3.0" "s" COEFFS 0 10 0 0 0 1 /end COMPU_METHOD
/begin COMPU_METHOD FORMULA_0949 "FORMULA_0949" TAB_VERB "%7.2" "-" COMPU_TAB_REF FORMULA_0949_VTAB /end COMPU_METHOD
/begin COMPU_VTAB FORMULA_0949_VTAB "FORMULA_0949_VTAB" TAB_VERB 1 0 "Diagnose gesperrt" DEFAULT_VALUE "Diagnose freigegeben" /end COMPU_VTAB
/begin COMPU_METHOD FORMULA_0950 "FORMULA_0950" TAB_VERB "%7.2" "-" COMPU_TAB_REF FORMULA_0950_VTAB /end COMPU_METHOD
/begin COMPU_VTAB FORMULA_0950_VTAB "FORMULA_0950_VTAB" TAB_VERB 1 0 "kein Regleranschlag" DEFAULT_VALUE "max. Regleranschlag" /end COMPU_VTAB
/begin COMPU_METHOD FORMULA_0951 "FORMULA_0951" TAB_VERB "%7.2" "-" COMPU_TAB_REF FORMULA_0951_VTAB /end COMPU_METHOD
/begin COMPU_VTAB FORMULA_0951_VTAB "FORMULA_0951_VTAB" TAB_VERB 1 0 "Diagnose inaktiv" DEFAULT_VALUE "Diagnose aktiv" /end COMPU_VTAB
/begin COMPU_METHOD FORMULA_0952 "FORMULA_0952" TAB_VERB "%7.2" "-" COMPU_TAB_REF FORMULA_0952_VTAB /end COMPU_METHOD
/begin COMPU_VTAB FORMULA_0952_VTAB "FORMULA_0952_VTAB" TAB_VERB 1 0 "Diagnose inaktiv" DEFAULT_VALUE "Diagnose aktiv" /end COMPU_VTAB
/begin COMPU_METHOD FORMULA_0953 "FORMULA_0953" TAB_VERB "%7.2" "-" COMPU_TAB_REF FORMULA_0953_VTAB /end COMPU_METHOD
/begin COMPU_VTAB FORMULA_0953_VTAB "FORMULA_0953_VTAB" TAB_VERB 1 0 "inaktiv" DEFAULT_VALUE "FREIGABE" /end COMPU_VTAB
/begin COMPU_METHOD FORMULA_0954 "FORMULA_0954" TAB_VERB "%7.2" "-" COMPU_TAB_REF FORMULA_0954_VTAB /end COMPU_METHOD
/begin COMPU_VTAB FORMULA_0954_VTAB "FORMULA_0954_VTAB" TAB_VERB 1 0 "inaktiv" DEFAULT_VALUE "FREIGABE" /end COMPU_VTAB
/begin COMPU_METHOD FORMULA_0955 "FORMULA_0955" TAB_VERB "%7.2" "-" COMPU_TAB_REF FORMULA_0955_VTAB /end COMPU_METHOD
/begin COMPU_VTAB FORMULA_0955_VTAB "FORMULA_0955_VTAB" TAB_VERB 1 0 "no" DEFAULT_VALUE "yes" /end COMPU_VTAB
/begin COMPU_METHOD FORMULA_0956 "FORMULA_0956" TAB_VERB "%7.2" "-" COMPU_TAB_REF FORMULA_0956_VTAB /end COMPU_METHOD
/begin COMPU_VTAB FORMULA_0956_VTAB "FORMULA_0956_VTAB" TAB_VERB 1 0 "no" DEFAULT_VALUE "yes" /end COMPU_VTAB
/begin COMPU_METHOD FORMULA_0957 "FORMULA_0957" TAB_VERB "%7.2" "-" COMPU_TAB_REF FORMULA_0957_VTAB /end COMPU_METHOD
/begin COMPU_VTAB FORMULA_0957_VTAB "FORMULA_0957_VTAB" TAB_VERB 2 0 "keine Heizung" 1 "Heizung" DEFAULT_VALUE "undefiniert" /end COMPU_VTAB
/begin COMPU_METHOD FORMULA_0958 "FORMULA_0958" RAT_FUNC "%7.2" "%/�C" COEFFS 0 1024 0 0 0 1 /end COMPU_METHOD
/begin COMPU_METHOD FORMULA_0959 "FORMULA_0959" RAT_FUNC "%6.1" "V/s" COEFFS 0 10 0 0 0 1 /end COMPU_METHOD
/begin COMPU_METHOD FORMULA_0960 "FORMULA_0960" RAT_FUNC "%5.0" "-" COEFFS 0 1 0 0 0 100 /end COMPU_METHOD
/begin COMPU_METHOD FORMULA_0961 "FORMULA_0961" TAB_VERB "%7.2" "-" COMPU_TAB_REF FORMULA_0961_VTAB /end COMPU_METHOD
/begin COMPU_VTAB FORMULA_0961_VTAB "FORMULA_0961_VTAB" TAB_VERB 2 0 "tmot_start" 1 "tabg_hys" /end COMPU_VTAB
/begin COMPU_METHOD FORMULA_0962 "FORMULA_0962" RAT_FUNC "%5.0" "-" COEFFS 0 32768 0 0 0 1 /end COMPU_METHOD
/* ------------------ Abschnitt erzeugt aus pksr.dat ------------------ */
/begin COMPU_METHOD FORMULA_1041 "FORMULA_1041" RAT_FUNC "%4.1" "bar/s" COEFFS 0 10 0 0 0 1 /end COMPU_METHOD
/begin COMPU_METHOD FORMULA_1042 "FORMULA_1042" TAB_VERB "%5.2" "-" COMPU_TAB_REF FORMULA_1042_VTAB /end COMPU_METHOD
/begin COMPU_VTAB FORMULA_1042_VTAB "FORMULA_1042_VTAB" TAB_VERB 7 1 "EKP 100%" 2 "EKP geregelt" 4 "EKP gesteuert" 8 "Diagnose EKP1" 16 "Diagnose EKP2" 32 "EKPs abgeschaltet" 64 "EKP_100_Relais" DEFAULT_VALUE "ungueltig" /end COMPU_VTAB
/begin COMPU_METHOD FORMULA_1043 "FORMULA_1043" TAB_VERB "%7.2" "-" COMPU_TAB_REF FORMULA_1043_VTAB /end COMPU_METHOD
/begin COMPU_VTAB FORMULA_1043_VTAB "FORMULA_1043_VTAB" TAB_VERB 2 0 "AUS" 1 "EIN" DEFAULT_VALUE "ungueltig" /end COMPU_VTAB
/begin COMPU_METHOD FORMULA_1044 "FORMULA_1044" TAB_VERB "%7.2" "-" COMPU_TAB_REF FORMULA_1044_VTAB /end COMPU_METHOD
/begin COMPU_VTAB FORMULA_1044_VTAB "FORMULA_1044_VTAB" TAB_VERB 6 0 "ALLES IO" 1 "SENSNIO2.5" 2 "SENSNIO5.5" 4 "EKP2 NIO" 8 "SSP NIO" 16 "PABFALL VORL" /end COMPU_VTAB
/begin COMPU_METHOD FORMULA_1045 "FORMULA_1045" RAT_FUNC "%8.3" "bar/100ms" COEFFS 0 1000 0 0 0 1 /end COMPU_METHOD
/begin COMPU_METHOD FORMULA_1046 "FORMULA_1046" TAB_VERB "%5.2" "-" COMPU_TAB_REF FORMULA_1046_VTAB /end COMPU_METHOD
/begin COMPU_VTAB FORMULA_1046_VTAB "FORMULA_1046_VTAB" TAB_VERB 5 0 "EKP2 n, Si.gen. AUS" 1 "EKP2 j, Si.gen. AUS" 2 "EKP2 n, Si.gen. EIN" 3 "EKP2 ja, Si.gen. EIN" 4 "EKP_100" /end COMPU_VTAB
/begin COMPU_METHOD FORMULA_1047 "FORMULA_1047" TAB_VERB "%5.2" "-" COMPU_TAB_REF FORMULA_1047_VTAB /end COMPU_METHOD
/begin COMPU_VTAB FORMULA_1047_VTAB "FORMULA_1047_VTAB" TAB_VERB 2 0 "EKP-Diagnose AUS" 1 "EKP-Diagnose EIN" DEFAULT_VALUE "ungueltig" /end COMPU_VTAB
/begin COMPU_METHOD FORMULA_1048 "FORMULA_1048" RAT_FUNC "%6.1" "ms" COEFFS 0 1000 0 0 0 1 /end COMPU_METHOD
/begin COMPU_METHOD FORMULA_1049 "FORMULA_1049" RAT_FUNC "%9.4" "-/5ms" COEFFS 0 10000 0 0 0 1 /end COMPU_METHOD
/begin COMPU_METHOD FORMULA_1050 "FORMULA_1050" TAB_VERB "%5.2" "-" COMPU_TAB_REF FORMULA_1050_VTAB /end COMPU_METHOD
/begin COMPU_VTAB FORMULA_1050_VTAB "FORMULA_1050_VTAB" TAB_VERB 2 0 "kein Reset" 1 "Reset aktiv" /end COMPU_VTAB
/begin COMPU_METHOD FORMULA_1051 "FORMULA_1051" RAT_FUNC "%4.1" "%" COEFFS 0 255 0 0 0 100 /end COMPU_METHOD
/begin COMPU_METHOD FORMULA_1052 "FORMULA_1052" RAT_FUNC "%6.1" "%/bar" COEFFS 0 20.97152 0 0 0 1 /end COMPU_METHOD
/begin COMPU_METHOD FORMULA_1053 "FORMULA_1053" RAT_FUNC "%6.1" "%/(bar*s)" COEFFS 0 6.7109 0 0 0 1 /end COMPU_METHOD
/* ------------------ Abschnitt erzeugt aus zwktibs.dat ------------------ */
/begin COMPU_METHOD FORMULA_1241 "FORMULA_1241" TAB_VERB "%3.0" "-" COMPU_TAB_REF FORMULA_1241_VTAB /end COMPU_METHOD
/begin COMPU_VTAB FORMULA_1241_VTAB "FORMULA_1241_VTAB" TAB_VERB 12 0 "BSD_IDLE" 1 "BSDHTOK" 2 "BSDWRITE" 4 "BSDDO/BSDHTOK" 5 "BSDDO/BSDHTOK" 7 "BSDDO/BSDWRITE/BSDHTOK" 8 "BSDBSY" 16 "BSDRXRDY" 17 "BSDRXRDY/BSDHTOK" 32 "BSDTXOK" 64 "BSDDTRQ" 48 "BSDTXIND" /end COMPU_VTAB
/* ------------------ Abschnitt erzeugt aus kats.dat ------------------ */
/begin CHARACTERISTIC K_KATS_LAM_MIN "Lambda min fuer Katschutz | EN: Lambda min fuer Katschutz | [Code V452 INJ 0xF2014] Richest cat-protection lambda (0.70)." VALUE 0x72DDC TKW_VV_VV_UW 100.0 FORMULA_0025 0.0 3.9990 FORMAT "%6.3" /end CHARACTERISTIC
/begin CHARACTERISTIC K_KATS_LAM_GRAD_POS "Aenderungsbegr. pos | EN: Aenderungsbegr. pos | [Code V452 INJ 0xF2014] Rate limit of the cat-protection lambda towards lean (per s)." VALUE 0x72DDE TKW_VV_VV_UW 100.0 FORMULA_0728 0.0 3.9990 FORMAT "%6.3" /end CHARACTERISTIC
/begin CHARACTERISTIC K_KATS_LAM_GRAD_NEG "Aenderungsbegr. neg | EN: Aenderungsbegr. neg | [Code V452 INJ 0xF2014] Rate limit of the cat-protection lambda towards rich (per s)." VALUE 0x72DE0 TKW_VV_VV_UW 100.0 FORMULA_0728 0.0 3.9990 FORMAT "%6.3" /end CHARACTERISTIC
/begin CHARACTERISTIC K_KATS_I_MAX "Max I-Anteil | EN: Max I-Anteil | [Code V452 INJ 0xF2014] Upper limit of the cat-protection I part." VALUE 0x72DE2 TKW_VV_VV_SW 100.0 FORMULA_0025 0.0 0.4000 FORMAT "%6.3" /end CHARACTERISTIC
/begin CHARACTERISTIC K_KATS_I_MIN "Max I-Anteil | EN: Min I-Anteil | [Code V452 INJ 0xF2014] Lower (rich) limit of the cat-protection I part." VALUE 0x72DE4 TKW_VV_VV_SW 100.0 FORMULA_0295 -0.4000 0.0 FORMAT "%7.4" /end CHARACTERISTIC
/begin CHARACTERISTIC K_KATS_T_MAX "Maximale Kattemperatur | EN: Maximum catalyst temperature [°C] | [Code V452 INJ 0xF2014] Max cat/exhaust temperature for the cat-protection model (950 degC); K_KATS_T_MAX_PST in test mode." VALUE 0x72DE6 TKW_VV_VV_SW 100.0 FORMULA_0023 300.0000 1100.0000 FORMAT "%4.1" /end CHARACTERISTIC
/begin CHARACTERISTIC K_KATS_LAM_P_DELTA_MAX "Gradientenschwelle fuer Uergang Einfangen -> Eingeregelt | EN: Gradientenschwelle fuer Uergang Einfangen - > Eingeregelt" VALUE 0x72DE8 TKW_VV_VV_SW 100.0 FORMULA_0295 -2.0000 1.9999 FORMAT "%7.4" /end CHARACTERISTIC
/begin CHARACTERISTIC K_KATS_T_MAX_PST "Maximale Kattemperatur fuer Pruefstand | EN: Maximum catalyst temperature for test bench [°C] | [Code V452 INJ 0xF2014] Max temperature used instead of K_KATS_T_MAX in PST/test-bench mode." VALUE 0x72DEA TKW_VV_VV_SW 100.0 FORMULA_0023 300.0000 1100.0000 FORMAT "%4.1" /end CHARACTERISTIC
/begin CHARACTERISTIC K_KATS_TKAT_MESS_MAX "Maximale Kattemperatur fuer Diagnose | EN: Maximale Kattemperatur fuer Diagnose" VALUE 0x72DEC TKW_VV_VV_SW 100.0 FORMULA_0023 -80.0000 1400.0000 FORMAT "%4.1" /end CHARACTERISTIC
/begin CHARACTERISTIC K_KATS_T_LAM_MIN "Fehlerzeit in der kats_lam_soll gleich K_KATS_LAM_MIN | EN: Fehlerzeit in der kats_lam_soll gleich K_KATS_LAM_MIN" VALUE 0x72DEE TKW_VV_VV_UW 100.0 FORMULA_0073 0.0 6553.5000 FORMAT "%4.1" /end CHARACTERISTIC
/begin CHARACTERISTIC K_KATS_CFG "Schalter fuer KATS Konfig | [Code V452 INJ 0xF2014] Cat-protection enable/config (1 here). Cat protection gives kats_lam_soll_b; the final target is min(target, kats_lam_soll) (richer wins) when active." VALUE 0x72DF0 TKW_VV_VV_UB 100.0 FORMULA_0729 0.0 255.0 /end CHARACTERISTIC
/begin CHARACTERISTIC KL_KATS_NKAT_LAM_OFFS "Lambda offset Katschutz | EN: Lambda offset for catalyst protection - post-cat temperature | [Code V452 INJ 0xF2014] P enrichment over rear-cat temperature delta (all 0 here)." CURVE 0x72DF2 TKL_SW_VV_SW 100.0 FORMULA_0025 -0.5000 0.5000
 /begin AXIS_DESCR STD_AXIS tabg_nkat_delta FORMULA_0076 4 -500.0000 500.0000 FORMAT "%4.1" /end AXIS_DESCR
 FORMAT "%6.3" /end CHARACTERISTIC
/begin CHARACTERISTIC KL_KATS_VKAT_LAM_OFFS "Lambda offset Katschutz | EN: Lambda offset for catalyst protection - pre-cat temperature | [Code V452 INJ 0xF2014] P enrichment over front-cat temperature delta (tabg_vkat_delta): -0.07 at -60 K, -0.30 at +20 K. The richest of the VKAT/NKAT/model offsets is used as P part." CURVE 0x72E04 TKL_SW_VV_SW 100.0 FORMULA_0025 -0.5000 0.5000
 /begin AXIS_DESCR STD_AXIS tabg_vkat_delta FORMULA_0076 4 -500.0000 500.0000 FORMAT "%4.1" /end AXIS_DESCR
 FORMAT "%6.3" /end CHARACTERISTIC
/begin CHARACTERISTIC KL_KATS_MDL_LAM_OFFS "Lambda offset Katschutz | EN: Lambda offset for catalyst protection - catalyst exhaust temperature | [Code V452 INJ 0xF2014] P enrichment over modelled exhaust temperature delta: -0.03 at 0 K, -0.25 at +40 K." CURVE 0x72E16 TKL_SW_VV_SW 100.0 FORMULA_0025 -0.5000 0.5000
 /begin AXIS_DESCR STD_AXIS tabg_mdl_delta FORMULA_0076 4 -500.0000 500.0000 FORMAT "%4.1" /end AXIS_DESCR
 FORMAT "%6.3" /end CHARACTERISTIC
/begin CHARACTERISTIC KL_KATS_LAM_I "I-Anteil Katschutz | EN: Integral share, catalyst protection | [Code V452 INJ 0xF2014] I part rate over middle-cat temperature delta (all 0 here); limited K_KATS_I_MIN..K_KATS_I_MAX." CURVE 0x72E28 TKL_SW_VV_SW 100.0 FORMULA_0295 -0.5000 0.5000
 /begin AXIS_DESCR STD_AXIS tabg_mkat_b1 FORMULA_0076 4 -500.0000 500.0000 FORMAT "%4.1" /end AXIS_DESCR
 FORMAT "%7.4" /end CHARACTERISTIC
/begin MEASUREMENT kats_vkat_lam_offs_b1 "Kats Lambda-Offset aus vkat" SWORD FORMULA_0025 0 0 -0.5000 0.5000 ECU_ADDRESS 0x3FC224 /end MEASUREMENT
/begin MEASUREMENT kats_vkat_lam_offs_b2 "Kats Lambda-Offset aus vkat" SWORD FORMULA_0025 0 0 -0.5000 0.5000 ECU_ADDRESS 0x3FC226 /end MEASUREMENT
/begin MEASUREMENT kats_mdl_lam_offs_b1 "Kats Lambda offset aus nkat(Modell)" SWORD FORMULA_0025 0 0 -0.5000 0.5000 ECU_ADDRESS 0x3FC228 /end MEASUREMENT
/begin MEASUREMENT kats_mdl_lam_offs_b2 "Kats Lambda offset aus nkat(Modell)" SWORD FORMULA_0025 0 0 -0.5000 0.5000 ECU_ADDRESS 0x3FC22A /end MEASUREMENT
/begin MEASUREMENT kats_nkat_lam_offs_b1 "Kats Lambda soll aus nkat(Messung)" SWORD FORMULA_0025 0 0 -0.5000 0.5000 ECU_ADDRESS 0x3FC22C /end MEASUREMENT
/begin MEASUREMENT kats_nkat_lam_offs_b2 "Kats Lambda soll aus nkat(Messung)" SWORD FORMULA_0025 0 0 -0.5000 0.5000 ECU_ADDRESS 0x3FC22E /end MEASUREMENT
/begin MEASUREMENT kats_lam_soll_b1 "SOLL-Lambda + KAT-SCHUTZ" UWORD FORMULA_0025 0 0 0.0 3.9990 ECU_ADDRESS 0x3FC230 /end MEASUREMENT
/begin MEASUREMENT kats_lam_soll_b2 "SOLL-Lambda + KAT-SCHUTZ" UWORD FORMULA_0025 0 0 0.0 3.9990 ECU_ADDRESS 0x3FC232 /end MEASUREMENT
/begin MEASUREMENT kats_lam_soll_roh_b1 "SOLL-Lambda - nach Maxauswahl der Offsets" UWORD FORMULA_0025 0 0 0.0 3.9990 ECU_ADDRESS 0x3FC234 /end MEASUREMENT
/begin MEASUREMENT kats_lam_soll_roh_b2 "SOLL-Lambda - nach Maxauswahl der Offsets" UWORD FORMULA_0025 0 0 0.0 3.9990 ECU_ADDRESS 0x3FC236 /end MEASUREMENT
/begin MEASUREMENT kats_st_b1 "Katschutz-Status" UBYTE FORMULA_0575 0 0 0.0 255.0 ECU_ADDRESS 0x3FC238 /end MEASUREMENT
/begin MEASUREMENT kats_st_b2 "Katschutz-Status" UBYTE FORMULA_0575 0 0 0.0 255.0 ECU_ADDRESS 0x3FC239 /end MEASUREMENT
/begin MEASUREMENT kats_ausloeser_b1 "Temperatur die den Kats ausgeloest hat" UBYTE FORMULA_0727 0 0 0.0 255.0 ECU_ADDRESS 0x3FC23A /end MEASUREMENT
/begin MEASUREMENT kats_ausloeser_b2 "Temperatur die den Kats ausgeloest hat" UBYTE FORMULA_0727 0 0 0.0 255.0 ECU_ADDRESS 0x3FC23B /end MEASUREMENT
/begin MEASUREMENT kats_lam_p_b1 "P-Anteil Katschutz" SWORD FORMULA_0025 0 0 -0.5000 0.5000 ECU_ADDRESS 0x3FC23C /end MEASUREMENT
/begin MEASUREMENT kats_lam_p_b2 "P-Anteil Katschutz" SWORD FORMULA_0025 0 0 -0.5000 0.5000 ECU_ADDRESS 0x3FC23E /end MEASUREMENT
/begin MEASUREMENT kats_lam_i_b1 "I-Anteil Katschutz" SWORD FORMULA_0295 0 0 -0.5000 0.5000 ECU_ADDRESS 0x3FC240 /end MEASUREMENT
/begin MEASUREMENT kats_lam_i_b2 "I-Anteil Katschutz" SWORD FORMULA_0295 0 0 -0.5000 0.5000 ECU_ADDRESS 0x3FC242 /end MEASUREMENT
/begin MEASUREMENT kats_lam_p_delta_max_b1 "Gradient des P-Anteils" SWORD FORMULA_0295 0 0 -2.0000 1.9999 ECU_ADDRESS 0x3FC244 /end MEASUREMENT
/begin MEASUREMENT kats_lam_p_delta_max_b2 "Gradient des P-Anteils" SWORD FORMULA_0295 0 0 -2.0000 1.9999 ECU_ADDRESS 0x3FC246 /end MEASUREMENT
/begin MEASUREMENT kats_lam_p_max_b1 "MAX P-Anteil im Zustand Einfangen" SWORD FORMULA_0025 0 0 -0.5000 0.5000 ECU_ADDRESS 0x3FC248 /end MEASUREMENT
/begin MEASUREMENT kats_lam_p_max_b2 "MAX P-Anteil im Zustand Einfangen" SWORD FORMULA_0025 0 0 -0.5000 0.5000 ECU_ADDRESS 0x3FC24A /end MEASUREMENT
/begin MEASUREMENT kats_lam_min_t_1of2_ "Zeit in der lam_min Begrenzung" UWORD FORMULA_0073 0 0 0.0 6553.5000 ECU_ADDRESS 0x3FC24C /end MEASUREMENT
/begin MEASUREMENT kats_lam_min_t_2of2_ "Zeit in der lam_min Begrenzung" UWORD FORMULA_0073 0 0 0.0 6553.5000 ECU_ADDRESS 0x3FC24E /end MEASUREMENT
/* ------------------ Abschnitt erzeugt aus kge.dat ------------------ */
/begin CHARACTERISTIC K_KGE_HFM_TAU "Tau fuer hfm_5ms" VALUE 0x72E3A TKW_VV_VV_UB 100.0 FORMULA_0651 0.0051 1.2800 /end CHARACTERISTIC
/begin CHARACTERISTIC K_KGE_LL_T_DELAY "Delayzeit fuer Diagnose-Start im LL | EN: Delayzeit fuer Diagnose-Start im LL" VALUE 0x72E3C TKW_VV_VV_UW 100.0 FORMULA_0021 0.0 655.0000 FORMAT "%5.2" /end CHARACTERISTIC
/begin CHARACTERISTIC K_KGE_LL_T_DIAG "LL-Zeit nach der die Diagnose ausgewertet wird" VALUE 0x72E3E TKW_VV_VV_UW 100.0 FORMULA_0021 0.0 655.0000 FORMAT "%5.2" /end CHARACTERISTIC
/begin CHARACTERISTIC K_KGE_RSTART_T "Zeit nach abgelaufener Diagnose bis Diagnose neu startet" VALUE 0x72E40 TKW_VV_VV_UW 100.0 FORMULA_0021 0.0 655.0000 FORMAT "%5.2" /end CHARACTERISTIC
/begin CHARACTERISTIC K_KGE_TMOT "TMOT-Schwelle f. Freigabe" VALUE 0x72E42 TKW_VV_VV_SW 100.0 FORMULA_0023 -50.0000 170.0000 FORMAT "%4.1" /end CHARACTERISTIC
/begin CHARACTERISTIC K_KGE_TOEL "toel_modell-Schwelle f. Freigabe" VALUE 0x72E44 TKW_VV_VV_SW 100.0 FORMULA_0023 -50.0000 170.0000 FORMAT "%4.1" /end CHARACTERISTIC
/begin CHARACTERISTIC K_KGE_AY "Querbeschleunigung f. Sperren" VALUE 0x72E46 TKW_VV_VV_SW 100.0 FORMULA_0132 -20.0000 20.0000 FORMAT "%5.2" /end CHARACTERISTIC
/begin CHARACTERISTIC K_KGE_AX_BERG "Laengsbeschleunigung-Berg f. Sperren" VALUE 0x72E48 TKW_VV_VV_SW 100.0 FORMULA_0132 -20.0000 20.0000 FORMAT "%5.2" /end CHARACTERISTIC
/begin CHARACTERISTIC K_KGE_TIME_ML "Sperrzeit Diagnose nach Start" VALUE 0x72E4A TKW_VV_VV_UW 100.0 FORMULA_0021 0.0 655.0000 FORMAT "%5.2" /end CHARACTERISTIC
/begin CHARACTERISTIC K_KGE_OZ_NIVR_MIN "Sperrniveau fuer min Oelniveau" VALUE 0x72E4C TKW_VV_VV_UB 100.0 FORMULA_0731 0.1000 75.0000 /end CHARACTERISTIC
/begin CHARACTERISTIC K_KGE_SEG_IDX_INTG_1of2_ "Segmentindex fuer das Abweichungsintegral" VALUE 0x72E4D TKW_VV_VV_UB 100.0 FORMULA_0033 0.0 255.0000 /end CHARACTERISTIC
/begin CHARACTERISTIC K_KGE_SEG_IDX_INTG_2of2_ "Segmentindex fuer das Abweichungsintegral | EN: Segmentindex fuer das Abweichungsintegral" VALUE 0x72E4E TKW_VV_VV_UB 100.0 FORMULA_0033 0.0 255.0000 /end CHARACTERISTIC
/begin CHARACTERISTIC K_KGE_OZ_NIVR_MAX "Sperrniveau fuer max Oelniveau" VALUE 0x72E4F TKW_VV_VV_UB 100.0 FORMULA_0431 0.0 74.7070 /end CHARACTERISTIC
/begin CHARACTERISTIC K_KGE_PUMG_MAX "Sperrniveau fuer max Pumg" VALUE 0x72E50 TKW_VV_VV_SW 100.0 FORMULA_0077 400.0000 1200.0000 FORMAT "%4.1" /end CHARACTERISTIC
/begin CHARACTERISTIC KL_KGE_MIN_INTG_B1 "Min-Schwelle fuer Integralwert IO Bank1" CURVE 0x72E52 TKL_SW_VV_UW 100.0 FORMULA_0562 0.0 6553.5000
 /begin AXIS_DESCR STD_AXIS pumg FORMULA_0077 4 400.0000 1200.0000 FORMAT "%4.1" /end AXIS_DESCR
 FORMAT "%4.1" /end CHARACTERISTIC
/begin CHARACTERISTIC KL_KGE_MIN_INTG_B2 "Min-Schwelle fuer Integralwert IO Bank2" CURVE 0x72E64 TKL_SW_VV_UW 100.0 FORMULA_0562 0.0 6553.5000
 /begin AXIS_DESCR STD_AXIS pumg FORMULA_0077 4 400.0000 1200.0000 FORMAT "%4.1" /end AXIS_DESCR
 FORMAT "%4.1" /end CHARACTERISTIC
/begin CHARACTERISTIC KL_KGE_OZ_NIVR_KOR "Korrektur ueber OZ_NIV" CURVE 0x72E76 TKL_UW_VV_UW 100.0 FORMULA_0075 0.0 4.0000
 /begin AXIS_DESCR STD_AXIS Oz_nivr FORMULA_0606 3 0.1000 75.0000 FORMAT "%5.2" /end AXIS_DESCR
 FORMAT "%6.3" /end CHARACTERISTIC
/begin MEASUREMENT kge_ml_fil_b1 "Luftmassenstrom gefiltert" SWORD FORMULA_0112 0 0 -100.0000 1400.0000 ECU_ADDRESS 0x3FC250 /end MEASUREMENT
/begin MEASUREMENT kge_ml_fil_b2 "Luftmassenstrom gefiltert" SWORD FORMULA_0112 0 0 -100.0000 1400.0000 ECU_ADDRESS 0x3FC252 /end MEASUREMENT
/begin MEASUREMENT kge_ml_ac_b1 "Luftmassenstrom ohne Gleichanteil (AC)" SWORD FORMULA_0112 0 0 -100.0000 1400.0000 ECU_ADDRESS 0x3FC254 /end MEASUREMENT
/begin MEASUREMENT kge_ml_ac_b2 "Luftmassenstrom ohne Gleichanteil (AC)" SWORD FORMULA_0112 0 0 -100.0000 1400.0000 ECU_ADDRESS 0x3FC256 /end MEASUREMENT
/begin MEASUREMENT kge_ml_abs_b1 "Luftmassenstrom-AC absolut" SWORD FORMULA_0112 0 0 -100.0000 1400.0000 ECU_ADDRESS 0x3FC258 /end MEASUREMENT
/begin MEASUREMENT kge_ml_abs_b2 "Luftmassenstrom-AC absolut" SWORD FORMULA_0112 0 0 -100.0000 1400.0000 ECU_ADDRESS 0x3FC25A /end MEASUREMENT
/begin MEASUREMENT kge_ml_intg_b1 "Luftmassenstrom-Integral ueber Diagnosezeit" UWORD FORMULA_0562 0 0 0.0 6553.5000 ECU_ADDRESS 0x3FC25C /end MEASUREMENT
/begin MEASUREMENT kge_ml_intg_b2 "Luftmassenstrom-Integral ueber Diagnosezeit" UWORD FORMULA_0562 0 0 0.0 6553.5000 ECU_ADDRESS 0x3FC25E /end MEASUREMENT
/begin MEASUREMENT kge_ml_intg_kor_1of2_ "Luftmassenstrom-Integral ueber Diagnosezeit korregiert" UWORD FORMULA_0562 0 0 0.0 6553.5000 ECU_ADDRESS 0x3FC260 /end MEASUREMENT
/begin MEASUREMENT kge_ml_intg_kor_2of2_ "Luftmassenstrom-Integral ueber Diagnosezeit korregiert" UWORD FORMULA_0562 0 0 0.0 6553.5000 ECU_ADDRESS 0x3FC262 /end MEASUREMENT
/begin MEASUREMENT kge_status_b1 "Statusvariable Kurbelgehaeuseentlueftungsdiagnose" UBYTE FORMULA_0730 0 0 0.0 8.0 ECU_ADDRESS 0x3FC264 /end MEASUREMENT
/begin MEASUREMENT kge_status_b2 "Statusvariable Kurbelgehaeuseentlueftungsdiagnose" UBYTE FORMULA_0730 0 0 0.0 8.0 ECU_ADDRESS 0x3FC265 /end MEASUREMENT
/begin MEASUREMENT kge_time_ll_b1 "Zeit seit keiner Sperrbedingung" UWORD FORMULA_0117 0 0 0.0 325.0000 ECU_ADDRESS 0x3FC266 /end MEASUREMENT
/begin MEASUREMENT kge_time_ll_b2 "Zeit seit keiner Sperrbedingung" UWORD FORMULA_0117 0 0 0.0 325.0000 ECU_ADDRESS 0x3FC268 /end MEASUREMENT
/begin MEASUREMENT kge_ml_mw_intg_1of2_ "Mittelwert Luftmassenstrom-Integral ueber mehrer Fenster" UWORD FORMULA_0562 0 0 0.0 6553.5000 ECU_ADDRESS 0x3FC26A /end MEASUREMENT
/begin MEASUREMENT kge_ml_mw_intg_2of2_ "Mittelwert Luftmassenstrom-Integral ueber mehrer Fenster" UWORD FORMULA_0562 0 0 0.0 6553.5000 ECU_ADDRESS 0x3FC26C /end MEASUREMENT
/* ------------------ Abschnitt erzeugt aus kw_diag_inj.dat ------------------ */
/begin CHARACTERISTIC K_KW_ED_DELTA_N "Max zul. Nockenwellendrehzahl im Startversuch bei n immer noch null. | EN: Max zul. Nockenwellendrehzahl im Startversuch bei n immer noch null." VALUE 0x72EC6 TKW_VV_VV_SW 100.0 FORMULA_0006 0.0 10000.0000 /end CHARACTERISTIC
/begin CHARACTERISTIC K_KW_ED_N_DROP "Max zul. Abrissdrehzahl. | EN: Max zul. Abrissdrehzahl." VALUE 0x72EC8 TKW_VV_VV_SW 100.0 FORMULA_0006 0.0 10000.0000 /end CHARACTERISTIC
/begin CHARACTERISTIC K_KW_ED_DELTA_U "Max zul. Abweichung der mittleren Differenzspannung. | EN: Max zul. Abweichung der mittleren Differenzspannung." VALUE 0x72ECA TKW_VV_VV_SW 100.0 FORMULA_0123 0.0 1023.0000 /end CHARACTERISTIC
/begin CHARACTERISTIC K_KW_ED_DELTA_N_RATE "Fehlerrate Startversuch. | EN: Fehlerrate Startversuch." VALUE 0x72ECC TKW_VV_VV_UW 100.0 FORMULA_0010 0.0 65535.0000 /end CHARACTERISTIC
/begin CHARACTERISTIC K_KW_ED_N_DROP_RATE "Fehlerrate Abriss. | EN: Fehlerrate Abriss." VALUE 0x72ECE TKW_VV_VV_UW 100.0 FORMULA_0010 0.0 65535.0000 /end CHARACTERISTIC
/begin CHARACTERISTIC K_KW_ED_SH_TO_UB_RATE "Fehlerrate Kurzschluss nach Ub. | EN: Fehlerrate Kurzschluss nach Ub." VALUE 0x72ED0 TKW_VV_VV_UW 100.0 FORMULA_0010 0.0 65535.0000 /end CHARACTERISTIC
/begin CHARACTERISTIC K_KW_ED_SH_TO_GND_RATE "Fehlerrate Kurzschluss nach Masse. | EN: Fehlerrate Kurzschluss nach Masse." VALUE 0x72ED2 TKW_VV_VV_UW 100.0 FORMULA_0010 0.0 65535.0000 /end CHARACTERISTIC
/begin CHARACTERISTIC K_KW_ED_MAX_RATE "Max zul. Fehlerrate." VALUE 0x72ED4 TKW_VV_VV_UW 100.0 FORMULA_0010 0.0 65535.0000 /end CHARACTERISTIC
/begin MEASUREMENT kw_ed_delta_n_rate "Aktuelle Fehlerrate Startversuch." UWORD FORMULA_0010 0 0 0.0 65535.0000 ECU_ADDRESS 0x3FC380 /end MEASUREMENT
/begin MEASUREMENT kw_ed_n_drop_rate "Aktuelle Fehlerrate Abriss." UWORD FORMULA_0010 0 0 0.0 65535.0000 ECU_ADDRESS 0x3FC382 /end MEASUREMENT
/begin MEASUREMENT kw_ed_sh_to_ub_rate "Aktuelle Fehlerrate Kurzschluss nach Ub." UWORD FORMULA_0010 0 0 0.0 65535.0000 ECU_ADDRESS 0x3FC384 /end MEASUREMENT
/begin MEASUREMENT kw_ed_sh_to_gnd_rate "Aktuelle Fehlerrate Kurzschluss nach Masse." UWORD FORMULA_0010 0 0 0.0 65535.0000 ECU_ADDRESS 0x3FC386 /end MEASUREMENT
/* ------------------ Abschnitt erzeugt aus lavk_obd.dat ------------------ */
/begin CHARACTERISTIC K_LAVK_OBD_SA_DIAG_OL "VKAT-Lambda MAGER-Schwelle f. OPELNLOAD-Diag. | EN: VKAT-Lambda MAGER-Schwelle f. OPELNLOAD-Diag." VALUE 0x74284 TKW_VV_VV_UW 100.0 FORMULA_0532 0.0 5000.0000 /end CHARACTERISTIC
/begin CHARACTERISTIC K_LA_OBD_DYN_DELTA_RF "rf Differnez fuer Dynamikerkennung | EN: rf Differnez fuer Dynamikerkennung" VALUE 0x74286 TKW_VV_VV_SW 100.0 FORMULA_0007 0.0 2.0000 FORMAT "%6.3" /end CHARACTERISTIC
/begin CHARACTERISTIC K_LA_OBD_DYN_DELTA_PUMP_RF "rf Differnez fuer Dynamikerkennung gegen Pumpen | EN: rf Differnez fuer Dynamikerkennung gegen Pumpen" VALUE 0x74288 TKW_VV_VV_SW 100.0 FORMULA_0007 0.0 2.0000 FORMAT "%6.3" /end CHARACTERISTIC
/begin CHARACTERISTIC K_LA_OBD_DYN_DELTA_CNT "Anzahl der dyn Triggers bis status gesetzt wird | EN: Anzahl der dyn Triggers bis status gesetzt wird" VALUE 0x7428A TKW_VV_VV_UW 100.0 FORMULA_0083 0.0 65535.0000 FORMAT "%5.2" /end CHARACTERISTIC
/begin CHARACTERISTIC K_LA_OBD_DYN_CNT_INC "Counter increments fuer rf_dyn_la_cnt | EN: Counter increments fuer rf_dyn_la_cnt" VALUE 0x7428C TKW_VV_VV_UB 100.0 FORMULA_0033 0.0 255.0000 /end CHARACTERISTIC
/begin CHARACTERISTIC K_LA_OBD_DYN_RF_T "Sperrzeit fuer Ruecknahme rf-Dynamik | EN: Sperrzeit fuer Ruecknahme rf-Dynamik" VALUE 0x7428E TKW_VV_VV_UW 100.0 FORMULA_0021 0.0 655.3500 FORMAT "%5.2" /end CHARACTERISTIC
/begin CHARACTERISTIC K_LAVK_OBD_PLAU_CFG "Freigabe OBD-Plausibilitaet | EN: Freigabe OBD-Plausibilitaet" VALUE 0x74290 TKW_VV_VV_UW 100.0 FORMULA_0868 0.0 1.0 FORMAT "%5.2" /end CHARACTERISTIC
/begin CHARACTERISTIC K_LAVK_OBD_TMOT "min. TMOT-Schwelle f. OBD-PLAUSI | EN: min. TMOT-Schwelle f. OBD-PLAUSI" VALUE 0x74292 TKW_VV_VV_SW 100.0 FORMULA_0023 -50.0000 170.0000 FORMAT "%4.1" /end CHARACTERISTIC
/begin CHARACTERISTIC K_LAVK_OBD_PLAU_RF_MAX "max. relative F�llung f. OBD-Plausi | EN: Maximum relative charge for OBD plausibility" VALUE 0x74294 TKW_VV_VV_SW 100.0 FORMULA_0007 0.0 2.0000 FORMAT "%6.3" /end CHARACTERISTIC
/begin CHARACTERISTIC K_LAVK_OBD_PLAU_RF_MIN "min. relative F�llung f. OBD-Plausi | EN: Minimum relative charge for OBD plausibility" VALUE 0x74296 TKW_VV_VV_SW 100.0 FORMULA_0007 0.0 2.0000 FORMAT "%6.3" /end CHARACTERISTIC
/begin CHARACTERISTIC K_LAVK_OBD_PLAU_TKAT_MIN "min. KAT-Temperatur f. OBD-Plausi | EN: Minimum catalyst temperature for OBD plausibility [°C]" VALUE 0x74298 TKW_VV_VV_SW 100.0 FORMULA_0023 -50.0000 1200.0000 FORMAT "%4.1" /end CHARACTERISTIC
/begin CHARACTERISTIC K_LAVK_OBD_PLAU_TKAT_MAX "max. KAT-Temperatur f. OBD-Plausi | EN: Maximum catalyst temperature for OBD plausibility [°C]" VALUE 0x7429A TKW_VV_VV_SW 100.0 FORMULA_0023 -50.0000 1200.0000 FORMAT "%4.1" /end CHARACTERISTIC
/begin CHARACTERISTIC K_LAVK_OBD_PLAU_LANK_MIN "NKAT-Signal FETT-Schwelle f. OBD-Plausi | EN: Post-cat signal RICH threshold for OBD plausibility" VALUE 0x7429C TKW_VV_VV_UW 100.0 FORMULA_0532 0.0 1200.0000 /end CHARACTERISTIC
/begin CHARACTERISTIC K_LAVK_OBD_PLAU_LANK_MAX "NKAT-Signal MAGER-Schwelle f. OBD-Plausi | EN: Post-cat signal LEAN threshold for OBD plausibility" VALUE 0x7429E TKW_VV_VV_UW 100.0 FORMULA_0532 0.0 1200.0000 /end CHARACTERISTIC
/begin CHARACTERISTIC K_LAVK_OBD_PLAU_UN_SCHW "VKAT-Schwelle f. UN-OPENLOAD-Diag. | EN: Pre-cat threshold for open-load diagnosis [mV]" VALUE 0x742A0 TKW_VV_VV_UW 100.0 FORMULA_0532 0.0 5000.0000 /end CHARACTERISTIC
/begin CHARACTERISTIC K_LAVK_OBD_PLAU_LAM_FETT "VKAT-Lambda FETT-Schwelle f. OBD-Plausi | EN: Pre-cat lambda RICH threshold for OBD plausibility" VALUE 0x742A2 TKW_VV_VV_UW 100.0 FORMULA_0025 0.0 3.9990 FORMAT "%6.3" /end CHARACTERISTIC
/begin CHARACTERISTIC K_LAVK_OBD_PLAU_LAM_MAGER "VKAT-Lambda MAGER-Schwelle f. OBD-Plausi | EN: Pre-cat lambda LEAN threshold for OBD plausibility" VALUE 0x742A4 TKW_VV_VV_UW 100.0 FORMULA_0025 0.0 3.9990 FORMAT "%6.3" /end CHARACTERISTIC
/begin CHARACTERISTIC K_LAVK_OBD_PLAU_LAM_MIN "VKAT-Lambda MIN-Schwelle f. OBD-Plausi | EN: Pre-cat lambda MIN threshold for OBD plausibility" VALUE 0x742A6 TKW_VV_VV_UW 100.0 FORMULA_0025 0.0 3.9990 FORMAT "%6.3" /end CHARACTERISTIC
/begin CHARACTERISTIC K_LAVK_OBD_PLAU_LAM_MAX "VKAT-Lambda MIN-Schwelle f. OBD-Plausi | EN: Pre-cat lambda MIN threshold for OBD plausibility" VALUE 0x742A8 TKW_VV_VV_UW 100.0 FORMULA_0025 0.0 3.9990 FORMAT "%6.3" /end CHARACTERISTIC
/begin CHARACTERISTIC K_LAVK_OBD_PLAU_F_CNT "FETT-Plausi Fehlerzaehler | EN: RICH plausibility fault counter" VALUE 0x742AA TKW_VV_VV_UW 100.0 FORMULA_0010 0.0 255.0000 /end CHARACTERISTIC
/begin CHARACTERISTIC K_LAVK_OBD_PLAU_M_CNT "MAGER-Plausi Fehlerzaehler | EN: LEAN plausibility fault counter" VALUE 0x742AC TKW_VV_VV_UW 100.0 FORMULA_0010 0.0 255.0000 /end CHARACTERISTIC
/begin CHARACTERISTIC K_LAVK_OBD_PLAU_OL_CNT "F/M-Plausi Fehlerzaehler | EN: Rich/lean plausibility fault counter" VALUE 0x742AE TKW_VV_VV_UW 100.0 FORMULA_0010 0.0 65535.0000 /end CHARACTERISTIC
/begin CHARACTERISTIC K_LAVK_OBD_PLAU_T "Verzoegerungszeit OBD-Plausibilisierung | EN: Delay time for OBD plausibility check [s]" VALUE 0x742B0 TKW_VV_VV_UW 100.0 FORMULA_0073 0.0 6553.5000 FORMAT "%4.1" /end CHARACTERISTIC
/begin CHARACTERISTIC K_LAVK_OBD_PLAU_UN_OSZI_OFF "Ausschaltzeit des ATIC42-Oszi f. UN-OL-Diag. | EN: Ausschaltzeit des ATIC42-Oszi f. UN-OL-Diag." VALUE 0x742B2 TKW_VV_VV_UW 100.0 FORMULA_0073 0.0 6553.5000 FORMAT "%4.1" /end CHARACTERISTIC
/begin CHARACTERISTIC K_LAVK_OBD_PLAU_ML_SUM "min. aufsummierte Luftmassenstr. nach SA_WE | EN: min. aufsummierte Luftmassenstr. nach SA_WE" VALUE 0x742B4 TKW_VV_VV_UW 100.0 FORMULA_0832 0.0 65535.0000 /end CHARACTERISTIC
/begin CHARACTERISTIC K_LAVK_OBD_PLAU_IP_STABIL_T "min. Zeit auf Erkennung DYNAMIK | EN: min. Zeit auf Erkennung DYNAMIK" VALUE 0x742B6 TKW_VV_VV_UW 100.0 FORMULA_0539 0.0 6553500.0000 /end CHARACTERISTIC
/begin CHARACTERISTIC K_LAVK_OBD_PLAU_IP_REG_MIN "min. Regelabweichung bei IP/VM-Openload-Verdacht | EN: min. Regelabweichung bei IP/VM-Openload-Verdacht" VALUE 0x742B8 TKW_VV_VV_UW 100.0 FORMULA_0024 0.0 1.9990 FORMAT "%7.4" /end CHARACTERISTIC
/begin CHARACTERISTIC K_LAVK_OBD_PLAU_IP_REG_MAX "max. Regelabweichung bei IP/VM-Openload-Verdacht | EN: max. Regelabweichung bei IP/VM-Openload-Verdacht" VALUE 0x742BA TKW_VV_VV_UW 100.0 FORMULA_0024 0.0 1.9990 FORMAT "%7.4" /end CHARACTERISTIC
/begin CHARACTERISTIC K_LAVK_OBD_PLAU_IP_N_MAX "max. Drehzahl f. IP-/VM-Verdacht bei Plausi-Diag. | EN: max. Drehzahl f. IP-/VM-Verdacht bei Plausi-Diag." VALUE 0x742BC TKW_VV_VV_SW 100.0 FORMULA_0006 0.0 10000.0000 /end CHARACTERISTIC
/begin CHARACTERISTIC K_LAVK_OBD_PLAU_IP_N_MIN "min. Drehzahl f. IP-/VM-Verdacht bei Plausi-Diag. | EN: min. Drehzahl f. IP-/VM-Verdacht bei Plausi-Diag." VALUE 0x742BE TKW_VV_VV_SW 100.0 FORMULA_0006 0.0 10000.0000 /end CHARACTERISTIC
/begin CHARACTERISTIC K_LAVK_OBD_SA_CFG "Freigabe OBD-SA-Pruefung | EN: 0 OBD-SA inaktiv 1 OBD-SA aktiv Freigabe OBD-SA-Pruefung" VALUE 0x742C0 TKW_VV_VV_UW 100.0 FORMULA_0869 0.0 1.0 FORMAT "%5.2" /end CHARACTERISTIC
/begin CHARACTERISTIC K_LAVK_OBD_SA_CNT "SA-Diag.-Fehlerzaehler | EN: SA-Diag.-Fehlerzaehler" VALUE 0x742C2 TKW_VV_VV_UW 100.0 FORMULA_0010 0.0 65535.0000 /end CHARACTERISTIC
/begin CHARACTERISTIC K_LAVK_OBD_SA_T "Verzoegerungszeit OBD-SA-Pruefung | EN: Verzoegerungszeit OBD -SA-Pruefung" VALUE 0x742C4 TKW_VV_VV_UW 100.0 FORMULA_0073 0.0 6553.5000 FORMAT "%4.1" /end CHARACTERISTIC
/begin CHARACTERISTIC K_LAVK_OBD_SA_SCHW "SA-Diag.-Schwelle AD-Wert | EN: SA-Diag.-Schwelle AD-Wert" VALUE 0x742C6 TKW_VV_VV_UW 100.0 FORMULA_0532 0.0 5000.0000 /end CHARACTERISTIC
/begin CHARACTERISTIC K_LAVK_OBD_SA_ML_SUM "min. aufsummierte Luftmassenstr. im ZUST_SA | EN: min. aufsummierte Luftmassenstr. im ZUST_SA" VALUE 0x742C8 TKW_VV_VV_UW 100.0 FORMULA_0832 0.0 65535.0000 /end CHARACTERISTIC
/begin CHARACTERISTIC K_LAVK_OBD_VK_TEMP "min. Sondentemperatur fuer Freigabe | EN: min. Sondentemperatur fuer Freigabe" VALUE 0x742CA TKW_VV_VV_SW 100.0 FORMULA_0791 -50.0000 1250.0000 /end CHARACTERISTIC
/begin CHARACTERISTIC K_LAVK_OBD_TL_CFG "Freigabe OBD-TL/VL-Diagnose | EN: Freigabe OBD-TL/VL-Diagnose" VALUE 0x742CC TKW_VV_VV_UW 100.0 FORMULA_0870 0.0 1.0 FORMAT "%5.2" /end CHARACTERISTIC
/begin CHARACTERISTIC K_LAVK_OBD_TL_CNT "TL/VL-Diag.-Fehlerzaehler | EN: TL/VL-Diag.-Fehlerzaehler" VALUE 0x742CE TKW_VV_VV_UW 100.0 FORMULA_0010 0.0 65535.0000 /end CHARACTERISTIC
/begin CHARACTERISTIC K_LAVK_OBD_TL_T "Verzoegerungszeit OBD-TL/VL-Diagnose | EN: Verzoegerungszeit OBD-TL/VL-Diagnose" VALUE 0x742D0 TKW_VV_VV_UW 100.0 FORMULA_0073 0.0 6553.5000 FORMAT "%4.1" /end CHARACTERISTIC
/begin CHARACTERISTIC K_LAVK_OBD_TL_ML_SUM "min. aufsummierte Luftmassenstr. nach SA_WE | EN: min. aufsummierte Luftmassenstr. nach SA_WE" VALUE 0x742D2 TKW_VV_VV_UW 100.0 FORMULA_0832 0.0 65535.0000 /end CHARACTERISTIC
/begin CHARACTERISTIC K_LAVK_OBD_TL_SCHW_MAX "VKAT-Lambda MAGER-Schwelle f. OPELNLOAD-Diag. | EN: VKAT-Lambda MAGER-Schwelle f. OPELNLOAD-Diag." VALUE 0x742D4 TKW_VV_VV_UW 100.0 FORMULA_0532 0.0 5000.0000 /end CHARACTERISTIC
/begin CHARACTERISTIC K_LAVK_OBD_TL_SCHW_MIN "VKAT-Lambda MAGER-Schwelle f. OPELNLOAD-Diag. | EN: VKAT-Lambda MAGER-Schwelle f. OPELNLOAD-Diag." VALUE 0x742D6 TKW_VV_VV_UW 100.0 FORMULA_0532 0.0 5000.0000 /end CHARACTERISTIC
/begin CHARACTERISTIC K_LAVK_OBD_ACT_TRIM_F "Fehlersimulation TRIM_FETT_FEHLER" VALUE 0x742D8 TKW_VV_VV_UW 100.0 FORMULA_0798 0.0 1.0 FORMAT "%5.2" /end CHARACTERISTIC
/begin CHARACTERISTIC K_LAVK_OBD_ACT_TRIM_M "Fehlersimulation TRIM_MAGER_FEHLER" VALUE 0x742DA TKW_VV_VV_UW 100.0 FORMULA_0798 0.0 1.0 FORMAT "%5.2" /end CHARACTERISTIC
/begin CHARACTERISTIC K_LAVK_OBD_ACT_CFG "Freigabe aktive Plausi-Diagnose" VALUE 0x742DC TKW_VV_VV_UW 100.0 FORMULA_0798 0.0 1.0 FORMAT "%5.2" /end CHARACTERISTIC
/begin CHARACTERISTIC K_LAVK_OBD_ACT_TKAT "min. KAT-Temperatur - aktive Plausi.Diag. | EN: Minimum catalyst temperature - active plausibility diagnosis [°C]" VALUE 0x742DE TKW_VV_VV_SW 100.0 FORMULA_0023 -50.0000 1200.0000 FORMAT "%4.1" /end CHARACTERISTIC
/begin CHARACTERISTIC K_LAVK_OBD_ACT_ML_SUM "min. aufsummierte Luftmassenstr. nach SA_WE | EN: Minimum summed air mass flow after start [mg]" VALUE 0x742E0 TKW_VV_VV_UW 100.0 FORMULA_0832 0.0 65535.0000 /end CHARACTERISTIC
/begin CHARACTERISTIC K_LAVK_OBD_ACT_RF_MAX "max. relative F�llung f. aktive Plausi-Diag. | EN: Maximum relative charge for active plausibility diagnosis" VALUE 0x742E2 TKW_VV_VV_SW 100.0 FORMULA_0007 0.0 2.0000 FORMAT "%6.3" /end CHARACTERISTIC
/begin CHARACTERISTIC K_LAVK_OBD_ACT_RF_MIN "min. relative F�llung f. aktive Plausi-Diag. | EN: Minimum relative charge for active plausibility diagnosis" VALUE 0x742E4 TKW_VV_VV_SW 100.0 FORMULA_0007 0.0 2.0000 FORMAT "%6.3" /end CHARACTERISTIC
/begin CHARACTERISTIC K_LAVK_OBD_ACT_N_MAX "max. Drehzahl f. aktive Plausi-Diag. | EN: Maximum engine speed for active plausibility diagnosis [Upm]" VALUE 0x742E6 TKW_VV_VV_SW 100.0 FORMULA_0006 0.0 10000.0000 /end CHARACTERISTIC
/begin CHARACTERISTIC K_LAVK_OBD_ACT_N_MIN "min. Drehzahl f. aktive Plausi-Diag. | EN: Minimum engine speed for active plausibility diagnosis [Upm]" VALUE 0x742E8 TKW_VV_VV_SW 100.0 FORMULA_0006 0.0 10000.0000 /end CHARACTERISTIC
/begin CHARACTERISTIC K_LAVK_OBD_ACT_M_T "MAGER-Verzoegerungszeit - aktive Plausi-Diag. | EN: LEAN delay time - active plausibility diagnosis [s]" VALUE 0x742EA TKW_VV_VV_UW 100.0 FORMULA_0073 0.0 6553.5000 FORMAT "%4.1" /end CHARACTERISTIC
/begin CHARACTERISTIC K_LAVK_OBD_ACT_F_T "FETT-Verzoegerungszeit - aktive Plausi-Diag. | EN: FETT-Verzoegerungszeit - aktive Plausi-Diag." VALUE 0x742EC TKW_VV_VV_UW 100.0 FORMULA_0073 0.0 6553.5000 FORMAT "%4.1" /end CHARACTERISTIC
/begin CHARACTERISTIC K_LAVK_OBD_ACT_LAM_SOLL_M "SOLL-Lambda - MAGER-Diagnose | EN: SOLL-Lambda - MAGER-Diagnose" VALUE 0x742EE TKW_VV_VV_UW 100.0 FORMULA_0025 0.0 3.9990 FORMAT "%6.3" /end CHARACTERISTIC
/begin CHARACTERISTIC K_LAVK_OBD_ACT_LAM_SOLL_F "SOLL-Lambda - FETT-Diagnose | EN: SOLL-Lambda - FETT-Diagnose" VALUE 0x742F0 TKW_VV_VV_UW 100.0 FORMULA_0025 0.0 3.9990 FORMAT "%6.3" /end CHARACTERISTIC
/begin CHARACTERISTIC K_LAVK_OBD_ACT_LAM_IST_M "LA-Schwelle f. MAGER-Fehler | EN: LA-Schwelle f. MAGER-Fehler" VALUE 0x742F2 TKW_VV_VV_UW 100.0 FORMULA_0025 0.0 3.9990 FORMAT "%6.3" /end CHARACTERISTIC
/begin CHARACTERISTIC K_LAVK_OBD_ACT_LAM_IST_F "LA-Schwelle f. FETT-Fehler | EN: LA-Schwelle f. FETT-Fehler" VALUE 0x742F4 TKW_VV_VV_UW 100.0 FORMULA_0025 0.0 3.9990 FORMAT "%6.3" /end CHARACTERISTIC
/begin CHARACTERISTIC K_LAVK_OBD_ACT_LANK_M "NKAT-Schwelle f. MAGER-Fehler | EN: NKAT-Schwelle f. M AGER-Fehler" VALUE 0x742F6 TKW_VV_VV_UW 100.0 FORMULA_0532 0.0 1200.0000 /end CHARACTERISTIC
/begin CHARACTERISTIC K_LAVK_OBD_ACT_LANK_F "NKAT-Schwelle f. FETT-Fehler | EN: NKAT-Schwelle f. FETT-Fehler" VALUE 0x742F8 TKW_VV_VV_UW 100.0 FORMULA_0532 0.0 1200.0000 /end CHARACTERISTIC
/begin CHARACTERISTIC K_LAVK_OBD_ACT_VK_M_CNT "VKAT Fehlerzaehler - MAGER-Diagnose | EN: VKAT Fehlerzaehler - MAGER-Diagnose" VALUE 0x742FA TKW_VV_VV_UW 100.0 FORMULA_0010 0.0 65535.0000 /end CHARACTERISTIC
/begin CHARACTERISTIC K_LAVK_OBD_ACT_NK_M_CNT "NKAT Fehlerzaehler - MAGER-Diagnose | EN: NKAT Fehlerzaehler -  MA-GER-Diagnose" VALUE 0x742FC TKW_VV_VV_UW 100.0 FORMULA_0010 0.0 65535.0000 /end CHARACTERISTIC
/begin CHARACTERISTIC K_LAVK_OBD_ACT_VK_F_CNT "VKAT Fehlerzaehler - FETT-Diagnose | EN: VKAT Fehlerzaehler -  FETT-Diagnose" VALUE 0x742FE TKW_VV_VV_UW 100.0 FORMULA_0010 0.0 65535.0000 /end CHARACTERISTIC
/begin CHARACTERISTIC K_LAVK_OBD_ACT_NK_F_CNT "NKAT Fehlerzaehler - FETT-Diagnose | EN: NKAT Fehlerzaehler -  FETT-Diagnose" VALUE 0x74300 TKW_VV_VV_UW 100.0 FORMULA_0010 0.0 65535.0000 /end CHARACTERISTIC
/begin CHARACTERISTIC K_LAVK_OBD_ACT_EXD_N_SOLL "Prueflauf - angeforderte Drehzahl | EN: Prueflauf - angeforderte Dreh-zahl" VALUE 0x74302 TKW_VV_VV_SW 100.0 FORMULA_0006 0.0 10000.0000 /end CHARACTERISTIC
/begin CHARACTERISTIC K_LAVK_OBD_ACT_EXD_TIME "Prueflauf Freigabezeit | EN: Prueflauf Freigabezeit" VALUE 0x74304 TKW_VV_VV_UW 100.0 FORMULA_0862 0.0 6553.5000 /end CHARACTERISTIC
/begin CHARACTERISTIC K_KSD_OBD_OEL_SPERR_MAX "Schwelle fuer Erkennung Oelverduennung" VALUE 0x74306 TKW_VV_VV_UB 100.0 FORMULA_0003 0.0 255.0000 /end CHARACTERISTIC
/begin CHARACTERISTIC K_KSD_OBD_CFG "Freigabe Kraftstoffsystemdiagnose" VALUE 0x74308 TKW_VV_VV_UW 100.0 FORMULA_0871 0.0 1.0 FORMAT "%5.2" /end CHARACTERISTIC
/begin CHARACTERISTIC K_KSD_OBD_TMOT_MIN "min. TMOT-Schwelle f. KSD" VALUE 0x7430A TKW_VV_VV_SW 100.0 FORMULA_0023 -50.0000 170.0000 FORMAT "%4.1" /end CHARACTERISTIC
/begin CHARACTERISTIC K_KSD_OBD_RF_MAX "max. relative F�llung f. KSD" VALUE 0x7430C TKW_VV_VV_SW 100.0 FORMULA_0007 0.0 2.0000 FORMAT "%6.3" /end CHARACTERISTIC
/begin CHARACTERISTIC K_KSD_OBD_RF_MIN "min. relative F�llung f. KSD" VALUE 0x7430E TKW_VV_VV_SW 100.0 FORMULA_0007 0.0 2.0000 FORMAT "%6.3" /end CHARACTERISTIC
/begin CHARACTERISTIC K_KSD_OBD_N_MAX "max. Drehzahl f. KSD" VALUE 0x74310 TKW_VV_VV_SW 100.0 FORMULA_0006 0.0 10000.0000 /end CHARACTERISTIC
/begin CHARACTERISTIC K_KSD_OBD_N_MIN "min. Drehzahl f. KSD" VALUE 0x74312 TKW_VV_VV_SW 100.0 FORMULA_0006 0.0 10000.0000 /end CHARACTERISTIC
/begin CHARACTERISTIC K_KSD_OBD_TAN "max. TAN-Schwelle" VALUE 0x74314 TKW_VV_VV_SW 100.0 FORMULA_0023 -50.0000 170.0000 FORMAT "%4.1" /end CHARACTERISTIC
/begin CHARACTERISTIC K_KSD_OBD_PUMG_MIN "min. Umgebungsdruck" VALUE 0x74316 TKW_VV_VV_SW 100.0 FORMULA_0077 400.0000 1200.0000 FORMAT "%4.1" /end CHARACTERISTIC
/begin CHARACTERISTIC K_KSD_OBD_V "max. Fahrzeuggeschwindigkeit f. LL-KSD" VALUE 0x74318 TKW_VV_VV_SW 100.0 FORMULA_0078 -80.0000 360.0000 FORMAT "%4.1" /end CHARACTERISTIC
/begin CHARACTERISTIC K_KSD_OBD_DIAG_T "KSD-Diagnosezeit" VALUE 0x7431A TKW_VV_VV_UW 100.0 FORMULA_0862 0.0 6553.5000 /end CHARACTERISTIC
/begin CHARACTERISTIC K_KSD_OBD_LL_MAX_T "Zeit - MAX-Ueberschr. im LL" VALUE 0x7431C TKW_VV_VV_UW 100.0 FORMULA_0862 0.0 6553.5000 /end CHARACTERISTIC
/begin CHARACTERISTIC K_KSD_OBD_LL_MIN_T "Zeit - MIN-Ueberschr. im LL" VALUE 0x7431E TKW_VV_VV_UW 100.0 FORMULA_0862 0.0 6553.5000 /end CHARACTERISTIC
/begin CHARACTERISTIC K_KSD_OBD_TL_MAX_T "Zeit - MAX-Ueberschr. in TL" VALUE 0x74320 TKW_VV_VV_UW 100.0 FORMULA_0862 0.0 6553.5000 /end CHARACTERISTIC
/begin CHARACTERISTIC K_KSD_OBD_TL_MIN_T "Zeit - MIN-Ueberschr. in TL" VALUE 0x74322 TKW_VV_VV_UW 100.0 FORMULA_0862 0.0 6553.5000 /end CHARACTERISTIC
/begin CHARACTERISTIC K_KSD_OBD_LL_LAM_MAX "MAX-Gesamtabweichung Lambda KSD im LL" VALUE 0x74324 TKW_VV_VV_UW 100.0 FORMULA_0024 0.0 1.9990 FORMAT "%7.4" /end CHARACTERISTIC
/begin CHARACTERISTIC K_KSD_OBD_LL_LAM_MIN "MIN-Gesamtabweichung Lambda KSD im LL" VALUE 0x74326 TKW_VV_VV_UW 100.0 FORMULA_0024 0.0 1.9990 FORMAT "%7.4" /end CHARACTERISTIC
/begin CHARACTERISTIC K_KSD_OBD_TL_LAM_MAX "MAX-Gesamtabweichung Lambda KSD in TL" VALUE 0x74328 TKW_VV_VV_UW 100.0 FORMULA_0024 0.0 1.9990 FORMAT "%7.4" /end CHARACTERISTIC
/begin CHARACTERISTIC K_KSD_OBD_TL_LAM_MIN "MIN-Gesamtabweichung Lambda KSD im LL" VALUE 0x7432A TKW_VV_VV_UW 100.0 FORMULA_0024 0.0 1.9990 FORMAT "%7.4" /end CHARACTERISTIC
/begin CHARACTERISTIC K_KSD_OBD_T_ML "Verzoegerungszeit nach Startende" VALUE 0x7432C TKW_VV_VV_UW 100.0 FORMULA_0021 0.0 655.0000 FORMAT "%5.2" /end CHARACTERISTIC
/begin CHARACTERISTIC KL_KSD_OBD_OEL_INC "INC-Wert fuer Oel-Verduennung" CURVE 0x7432E TKL_SW_VV_UB 100.0 FORMULA_0003 0.0 255.0000
 /begin AXIS_DESCR STD_AXIS tmot FORMULA_0023 4 -50.0000 170.0000 FORMAT "%4.1" /end AXIS_DESCR
/end CHARACTERISTIC
/begin CHARACTERISTIC KL_KSD_OBD_OEL_DEC "DEC-Wert fuer Oel-Verduennung" CURVE 0x7433C TKL_SW_VV_UB 100.0 FORMULA_0003 0.0 255.0000
 /begin AXIS_DESCR STD_AXIS toel FORMULA_0023 4 -50.0000 170.0000 FORMAT "%4.1" /end AXIS_DESCR
/end CHARACTERISTIC
/begin MEASUREMENT lavk_diag_st_b1 "Status DIAG-LAVK-Plausibilisierung" UWORD FORMULA_0083 0 0 0.0 65535.0000 ECU_ADDRESS 0x3FC73C /end MEASUREMENT
/begin MEASUREMENT lavk_diag_st_b2 "Status DIAG-LAVK-Plausibilisierung" UWORD FORMULA_0083 0 0 0.0 65535.0000 ECU_ADDRESS 0x3FC73E /end MEASUREMENT
/begin MEASUREMENT lavk_diag_ia_sa_openload_b1 "IA-OPENLOAD bei SA-Diag." UWORD FORMULA_0841 0 0 0.0 65535.0 ECU_ADDRESS 0x3FC73C BIT_MASK 0x1 /end MEASUREMENT
/begin MEASUREMENT lavk_diag_ia_sa_openload_b2 "IA-OPENLOAD bei SA-Diag." UWORD FORMULA_0841 0 0 0.0 65535.0 ECU_ADDRESS 0x3FC73E BIT_MASK 0x1 /end MEASUREMENT
/begin MEASUREMENT lavk_diag_ip_sa_openload_b1 "IP/VM-OPENLOAD bei SA-Diag." UWORD FORMULA_0842 0 0 0.0 65535.0 ECU_ADDRESS 0x3FC73C BIT_MASK 0x2 /end MEASUREMENT
/begin MEASUREMENT lavk_diag_ip_sa_openload_b2 "IP/VM-OPENLOAD bei SA-Diag." UWORD FORMULA_0842 0 0 0.0 65535.0 ECU_ADDRESS 0x3FC73E BIT_MASK 0x2 /end MEASUREMENT
/begin MEASUREMENT lavk_diag_un_plau_openload_b1 "UN-OPENLOAD bei Plau-Diag." UWORD FORMULA_0843 0 0 0.0 65535.0 ECU_ADDRESS 0x3FC73C BIT_MASK 0x4 /end MEASUREMENT
/begin MEASUREMENT lavk_diag_un_plau_openload_b2 "UN-OPENLOAD bei Plau-Diag." UWORD FORMULA_0843 0 0 0.0 65535.0 ECU_ADDRESS 0x3FC73E BIT_MASK 0x4 /end MEASUREMENT
/begin MEASUREMENT lavk_diag_ip_plau_openload_b1 "IP/VM-OPENLOAD bei Plau-Diag." UWORD FORMULA_0844 0 0 0.0 65535.0 ECU_ADDRESS 0x3FC73C BIT_MASK 0x8 /end MEASUREMENT
/begin MEASUREMENT lavk_diag_ip_plau_openload_b2 "IP/VM-OPENLOAD bei Plau-Diag." UWORD FORMULA_0844 0 0 0.0 65535.0 ECU_ADDRESS 0x3FC73E BIT_MASK 0x8 /end MEASUREMENT
/begin MEASUREMENT lavk_diag_ip_vm_sa_openload_b1 "IP/VM-VERDACHT bei SA-Diag." UWORD FORMULA_0845 0 0 0.0 65535.0 ECU_ADDRESS 0x3FC73C BIT_MASK 0x10 /end MEASUREMENT
/begin MEASUREMENT lavk_diag_ip_vm_sa_openload_b2 "IP/VM-VERDACHT bei SA-Diag." UWORD FORMULA_0845 0 0 0.0 65535.0 ECU_ADDRESS 0x3FC73E BIT_MASK 0x10 /end MEASUREMENT
/begin MEASUREMENT lavk_diag_ip_dynamik_check_b1 "Dynamikdiagnose IP-OL ausserhalb Band." UWORD FORMULA_0846 0 0 0.0 65535.0 ECU_ADDRESS 0x3FC73C BIT_MASK 0x100 /end MEASUREMENT
/begin MEASUREMENT lavk_diag_ip_dynamik_check_b2 "Dynamikdiagnose IP-OL ausserhalb Band." UWORD FORMULA_0846 0 0 0.0 65535.0 ECU_ADDRESS 0x3FC73E BIT_MASK 0x100 /end MEASUREMENT
/begin MEASUREMENT lavk_obd_plau_st_b1 "Status OBD-LAVK-Plausibilisierung" UWORD FORMULA_0083 0 0 0.0 65535.0000 ECU_ADDRESS 0x3FC740 /end MEASUREMENT
/begin MEASUREMENT lavk_obd_plau_st_b2 "Status OBD-LAVK-Plausibilisierung" UWORD FORMULA_0083 0 0 0.0 65535.0000 ECU_ADDRESS 0x3FC742 /end MEASUREMENT
/begin MEASUREMENT lavk_obd_plau_status_b1 "Plausi-Diagnose-Status" UWORD FORMULA_0847 0 0 0.0 65535.0 ECU_ADDRESS 0x3FC740 BIT_MASK 0xF /end MEASUREMENT
/begin MEASUREMENT lavk_obd_plau_status_b2 "Plausi-Diagnose-Status" UWORD FORMULA_0847 0 0 0.0 65535.0 ECU_ADDRESS 0x3FC742 BIT_MASK 0xF /end MEASUREMENT
/begin MEASUREMENT lavk_obd_plau_oszi_off_st_b1 "UN-OL - Abschalten des ATIC42-Oszi" UWORD FORMULA_0848 0 0 0.0 65535.0 ECU_ADDRESS 0x3FC740 BIT_MASK 0x10 /end MEASUREMENT
/begin MEASUREMENT lavk_obd_plau_oszi_off_st_b2 "UN-OL - Abschalten des ATIC42-Oszi" UWORD FORMULA_0848 0 0 0.0 65535.0 ECU_ADDRESS 0x3FC742 BIT_MASK 0x10 /end MEASUREMENT
/begin MEASUREMENT lavk_obd_plau_un_ol_diag_b1 "UN-OL-Diagnose abgelaufen" UWORD FORMULA_0849 0 0 0.0 65535.0 ECU_ADDRESS 0x3FC740 BIT_MASK 0x20 /end MEASUREMENT
/begin MEASUREMENT lavk_obd_plau_un_ol_diag_b2 "UN-OL-Diagnose abgelaufen" UWORD FORMULA_0849 0 0 0.0 65535.0 ECU_ADDRESS 0x3FC742 BIT_MASK 0x20 /end MEASUREMENT
/begin MEASUREMENT lavk_obd_plau_oszi_off_b1 "Ausschaltzeit des ATIC42-Oszi f. UN-OL-Diag." UWORD FORMULA_0073 0 0 0.0 6553.5000 ECU_ADDRESS 0x3FC744 /end MEASUREMENT
/begin MEASUREMENT lavk_obd_plau_oszi_off_b2 "Ausschaltzeit des ATIC42-Oszi f. UN-OL-Diag." UWORD FORMULA_0073 0 0 0.0 6553.5000 ECU_ADDRESS 0x3FC746 /end MEASUREMENT
/begin MEASUREMENT lavk_obd_plau_t_b1 "Verzoegerungszeit Plausi-Diag." UWORD FORMULA_0073 0 0 0.0 6553.5000 ECU_ADDRESS 0x3FC748 /end MEASUREMENT
/begin MEASUREMENT lavk_obd_plau_t_b2 "Verzoegerungszeit Plausi-Diag." UWORD FORMULA_0073 0 0 0.0 6553.5000 ECU_ADDRESS 0x3FC74A /end MEASUREMENT
/begin MEASUREMENT lavk_obd_plau_f_cnt_b1 "Fehlerzaehler FETT-Plausi" UWORD FORMULA_0010 0 0 0.0 65535.0000 ECU_ADDRESS 0x3FC74C /end MEASUREMENT
/begin MEASUREMENT lavk_obd_plau_f_cnt_b2 "Fehlerzaehler FETT-Plausi" UWORD FORMULA_0010 0 0 0.0 65535.0000 ECU_ADDRESS 0x3FC74E /end MEASUREMENT
/begin MEASUREMENT lavk_obd_plau_m_cnt_b1 "Fehlerzaehler MAGER-Plausi" UWORD FORMULA_0010 0 0 0.0 65535.0000 ECU_ADDRESS 0x3FC750 /end MEASUREMENT
/begin MEASUREMENT lavk_obd_plau_m_cnt_b2 "Fehlerzaehler MAGER-Plausi" UWORD FORMULA_0010 0 0 0.0 65535.0000 ECU_ADDRESS 0x3FC752 /end MEASUREMENT
/begin MEASUREMENT lavk_obd_plau_ol_cnt_b1 "Fehlerzaehler OL-Diag IP/VM" UWORD FORMULA_0010 0 0 0.0 65535.0000 ECU_ADDRESS 0x3FC754 /end MEASUREMENT
/begin MEASUREMENT lavk_obd_plau_ol_cnt_b2 "Fehlerzaehler OL-Diag IP/VM" UWORD FORMULA_0010 0 0 0.0 65535.0000 ECU_ADDRESS 0x3FC756 /end MEASUREMENT
/begin MEASUREMENT lavk_obd_plau_ip_stabil_t_b1 "min. Zeit auf Erkennung DYNAMIK" UWORD FORMULA_0539 0 0 0.0 6553500.0000 ECU_ADDRESS 0x3FC758 /end MEASUREMENT
/begin MEASUREMENT lavk_obd_plau_ip_stabil_t_b2 "min. Zeit auf Erkennung DYNAMIK" UWORD FORMULA_0539 0 0 0.0 6553500.0000 ECU_ADDRESS 0x3FC75A /end MEASUREMENT
/begin MEASUREMENT lavk_obd_sa_st_b1 "Status OBD-LAVK-SA-Pruefung" UWORD FORMULA_0850 0 0 0.0 65535.0 ECU_ADDRESS 0x3FC75C BIT_MASK 0x3 /end MEASUREMENT
/begin MEASUREMENT lavk_obd_sa_st_b2 "Status OBD-LAVK-SA-Pruefung" UWORD FORMULA_0850 0 0 0.0 65535.0 ECU_ADDRESS 0x3FC75E BIT_MASK 0x3 /end MEASUREMENT
/begin MEASUREMENT lavk_obd_sa_t_b1 "Verzoegerungszeit SA-Diag." UWORD FORMULA_0073 0 0 0.0 6553.5000 ECU_ADDRESS 0x3FC760 /end MEASUREMENT
/begin MEASUREMENT lavk_obd_sa_t_b2 "Verzoegerungszeit SA-Diag." UWORD FORMULA_0073 0 0 0.0 6553.5000 ECU_ADDRESS 0x3FC762 /end MEASUREMENT
/begin MEASUREMENT lavk_obd_sa_cnt_b1 "Fehlerzaehler SA-Pruefung" UWORD FORMULA_0010 0 0 0.0 65535.0000 ECU_ADDRESS 0x3FC764 /end MEASUREMENT
/begin MEASUREMENT lavk_obd_sa_cnt_b2 "Fehlerzaehler SA-Pruefung" UWORD FORMULA_0010 0 0 0.0 65535.0000 ECU_ADDRESS 0x3FC766 /end MEASUREMENT
/begin MEASUREMENT lavk_obd_tl_st_b1 "Status OBD-LAVK-Plausibilisierung" UWORD FORMULA_0850 0 0 0.0 65535.0 ECU_ADDRESS 0x3FC768 BIT_MASK 0x3 /end MEASUREMENT
/begin MEASUREMENT lavk_obd_tl_st_b2 "Status OBD-LAVK-Plausibilisierung" UWORD FORMULA_0850 0 0 0.0 65535.0 ECU_ADDRESS 0x3FC76A BIT_MASK 0x3 /end MEASUREMENT
/begin MEASUREMENT lavk_obd_tl_t_b1 "Verzoegerungszeit TL/VL-Diag." UWORD FORMULA_0073 0 0 0.0 6553.5000 ECU_ADDRESS 0x3FC76C /end MEASUREMENT
/begin MEASUREMENT lavk_obd_tl_t_b2 "Verzoegerungszeit TL/VL-Diag." UWORD FORMULA_0073 0 0 0.0 6553.5000 ECU_ADDRESS 0x3FC76E /end MEASUREMENT
/begin MEASUREMENT lavk_obd_tl_cnt_b1 "Fehlerzaehler TL/VL-Diagnose" UWORD FORMULA_0010 0 0 0.0 65535.0000 ECU_ADDRESS 0x3FC770 /end MEASUREMENT
/begin MEASUREMENT lavk_obd_tl_cnt_b2 "Fehlerzaehler TL/VL-Diagnose" UWORD FORMULA_0010 0 0 0.0 65535.0000 ECU_ADDRESS 0x3FC772 /end MEASUREMENT
/begin MEASUREMENT lavk_obd_act_st_b1 "Status aktive Plausi.Diagnose" UWORD FORMULA_0083 0 0 0.0 65535.0000 ECU_ADDRESS 0x3FC774 /end MEASUREMENT
/begin MEASUREMENT lavk_obd_act_st_b2 "Status aktive Plausi.Diagnose" UWORD FORMULA_0083 0 0 0.0 65535.0000 ECU_ADDRESS 0x3FC776 /end MEASUREMENT
/begin MEASUREMENT lavk_obd_act_anf_b1 "Anforderung aktive Plausi-Diag." UWORD FORMULA_0851 0 0 0.0 65535.0 ECU_ADDRESS 0x3FC774 BIT_MASK 0x1 /end MEASUREMENT
/begin MEASUREMENT lavk_obd_act_anf_b2 "Anforderung aktive Plausi-Diag." UWORD FORMULA_0851 0 0 0.0 65535.0 ECU_ADDRESS 0x3FC776 BIT_MASK 0x1 /end MEASUREMENT
/begin MEASUREMENT lavk_obd_act_aktiv_b1 "Aktivierung aktive Plausi-Diag." UWORD FORMULA_0852 0 0 0.0 65535.0 ECU_ADDRESS 0x3FC774 BIT_MASK 0x2 /end MEASUREMENT
/begin MEASUREMENT lavk_obd_act_aktiv_b2 "Aktivierung aktive Plausi-Diag." UWORD FORMULA_0852 0 0 0.0 65535.0 ECU_ADDRESS 0x3FC776 BIT_MASK 0x2 /end MEASUREMENT
/begin MEASUREMENT lavk_obd_act_mager_b1 "Mager-Diagnose - aktive Plausi-Diag." UWORD FORMULA_0768 0 0 0.0 65535.0 ECU_ADDRESS 0x3FC774 BIT_MASK 0x4 /end MEASUREMENT
/begin MEASUREMENT lavk_obd_act_mager_b2 "Mager-Diagnose - aktive Plausi-Diag." UWORD FORMULA_0768 0 0 0.0 65535.0 ECU_ADDRESS 0x3FC776 BIT_MASK 0x4 /end MEASUREMENT
/begin MEASUREMENT lavk_obd_act_mager_anf_b1 "Mager-Diag.Anforderung nach FETT-Diag." UWORD FORMULA_0836 0 0 0.0 65535.0 ECU_ADDRESS 0x3FC774 BIT_MASK 0x8 /end MEASUREMENT
/begin MEASUREMENT lavk_obd_act_mager_anf_b2 "Mager-Diag.Anforderung nach FETT-Diag." UWORD FORMULA_0836 0 0 0.0 65535.0 ECU_ADDRESS 0x3FC776 BIT_MASK 0x8 /end MEASUREMENT
/begin MEASUREMENT lavk_obd_act_fett_b1 "FETT-Diagnose - aktive Plausi-Diag." UWORD FORMULA_0770 0 0 0.0 65535.0 ECU_ADDRESS 0x3FC774 BIT_MASK 0x10 /end MEASUREMENT
/begin MEASUREMENT lavk_obd_act_fett_b2 "FETT-Diagnose - aktive Plausi-Diag." UWORD FORMULA_0770 0 0 0.0 65535.0 ECU_ADDRESS 0x3FC776 BIT_MASK 0x10 /end MEASUREMENT
/begin MEASUREMENT lavk_obd_act_fett_anf_b1 "FETT-Diag.Anforderung nach Mager-Diag." UWORD FORMULA_0771 0 0 0.0 65535.0 ECU_ADDRESS 0x3FC774 BIT_MASK 0x20 /end MEASUREMENT
/begin MEASUREMENT lavk_obd_act_fett_anf_b2 "FETT-Diag.Anforderung nach Mager-Diag." UWORD FORMULA_0771 0 0 0.0 65535.0 ECU_ADDRESS 0x3FC776 BIT_MASK 0x20 /end MEASUREMENT
/begin MEASUREMENT lavk_obd_act_vkat_m_io_b1 "VKAT-Mager-Diagnose i.O." UWORD FORMULA_0853 0 0 0.0 65535.0 ECU_ADDRESS 0x3FC774 BIT_MASK 0x40 /end MEASUREMENT
/begin MEASUREMENT lavk_obd_act_vkat_m_io_b2 "VKAT-Mager-Diagnose i.O." UWORD FORMULA_0853 0 0 0.0 65535.0 ECU_ADDRESS 0x3FC776 BIT_MASK 0x40 /end MEASUREMENT
/begin MEASUREMENT lavk_obd_act_nkat_m_io_b1 "NKAT-Mager-Diagnose i.O." UWORD FORMULA_0854 0 0 0.0 65535.0 ECU_ADDRESS 0x3FC774 BIT_MASK 0x80 /end MEASUREMENT
/begin MEASUREMENT lavk_obd_act_nkat_m_io_b2 "NKAT-Mager-Diagnose i.O." UWORD FORMULA_0854 0 0 0.0 65535.0 ECU_ADDRESS 0x3FC776 BIT_MASK 0x80 /end MEASUREMENT
/begin MEASUREMENT lavk_obd_act_vkat_f_io_b1 "VKAT-FETT-Diagnose i.O." UWORD FORMULA_0855 0 0 0.0 65535.0 ECU_ADDRESS 0x3FC774 BIT_MASK 0x100 /end MEASUREMENT
/begin MEASUREMENT lavk_obd_act_vkat_f_io_b2 "VKAT-FETT-Diagnose i.O." UWORD FORMULA_0855 0 0 0.0 65535.0 ECU_ADDRESS 0x3FC776 BIT_MASK 0x100 /end MEASUREMENT
/begin MEASUREMENT lavk_obd_act_nkat_f_io_b1 "NKAT-FETT-Diagnose i.O." UWORD FORMULA_0856 0 0 0.0 65535.0 ECU_ADDRESS 0x3FC774 BIT_MASK 0x200 /end MEASUREMENT
/begin MEASUREMENT lavk_obd_act_nkat_f_io_b2 "NKAT-FETT-Diagnose i.O." UWORD FORMULA_0856 0 0 0.0 65535.0 ECU_ADDRESS 0x3FC776 BIT_MASK 0x200 /end MEASUREMENT
/begin MEASUREMENT lavk_obd_act_vkat_m_nio_b1 "VKAT-Mager-Diagnose n.i.O." UWORD FORMULA_0857 0 0 0.0 65535.0 ECU_ADDRESS 0x3FC774 BIT_MASK 0x400 /end MEASUREMENT
/begin MEASUREMENT lavk_obd_act_vkat_m_nio_b2 "VKAT-Mager-Diagnose n.i.O." UWORD FORMULA_0857 0 0 0.0 65535.0 ECU_ADDRESS 0x3FC776 BIT_MASK 0x400 /end MEASUREMENT
/begin MEASUREMENT lavk_obd_act_nkat_m_nio_b1 "NKAT-Mager-Diagnose n.i.O." UWORD FORMULA_0858 0 0 0.0 65535.0 ECU_ADDRESS 0x3FC774 BIT_MASK 0x800 /end MEASUREMENT
/begin MEASUREMENT lavk_obd_act_nkat_m_nio_b2 "NKAT-Mager-Diagnose n.i.O." UWORD FORMULA_0858 0 0 0.0 65535.0 ECU_ADDRESS 0x3FC776 BIT_MASK 0x800 /end MEASUREMENT
/begin MEASUREMENT lavk_obd_act_vkat_f_nio_b1 "VKAT-FETT-Diagnose n.i.O." UWORD FORMULA_0859 0 0 0.0 65535.0 ECU_ADDRESS 0x3FC774 BIT_MASK 0x1000 /end MEASUREMENT
/begin MEASUREMENT lavk_obd_act_vkat_f_nio_b2 "VKAT-FETT-Diagnose n.i.O." UWORD FORMULA_0859 0 0 0.0 65535.0 ECU_ADDRESS 0x3FC776 BIT_MASK 0x1000 /end MEASUREMENT
/begin MEASUREMENT lavk_obd_act_nkat_f_nio_b1 "NKAT-FETT-Diagnose n.i.O." UWORD FORMULA_0860 0 0 0.0 65535.0 ECU_ADDRESS 0x3FC774 BIT_MASK 0x2000 /end MEASUREMENT
/begin MEASUREMENT lavk_obd_act_nkat_f_nio_b2 "NKAT-FETT-Diagnose n.i.O." UWORD FORMULA_0860 0 0 0.0 65535.0 ECU_ADDRESS 0x3FC776 BIT_MASK 0x2000 /end MEASUREMENT
/begin MEASUREMENT lavk_obd_act_ende_b1 "NKAT-FETT-Diagnose abgelaufen" UWORD FORMULA_0861 0 0 0.0 65535.0 ECU_ADDRESS 0x3FC774 BIT_MASK 0x4000 /end MEASUREMENT
/begin MEASUREMENT lavk_obd_act_ende_b2 "NKAT-FETT-Diagnose abgelaufen" UWORD FORMULA_0861 0 0 0.0 65535.0 ECU_ADDRESS 0x3FC776 BIT_MASK 0x4000 /end MEASUREMENT
/begin MEASUREMENT lavk_obd_act_verz_t_b1 "Verzoegerungszeit" UWORD FORMULA_0073 0 0 0.0 6553.5000 ECU_ADDRESS 0x3FC778 /end MEASUREMENT
/begin MEASUREMENT lavk_obd_act_verz_t_b2 "Verzoegerungszeit" UWORD FORMULA_0073 0 0 0.0 6553.5000 ECU_ADDRESS 0x3FC77A /end MEASUREMENT
/begin MEASUREMENT lavk_obd_act_vk_m_cnt_b1 "Zaehler VKAT - Diagnose MAGER" UWORD FORMULA_0010 0 0 0.0 65535.0000 ECU_ADDRESS 0x3FC77C /end MEASUREMENT
/begin MEASUREMENT lavk_obd_act_vk_m_cnt_b2 "Zaehler VKAT - Diagnose MAGER" UWORD FORMULA_0010 0 0 0.0 65535.0000 ECU_ADDRESS 0x3FC77E /end MEASUREMENT
/begin MEASUREMENT lavk_obd_act_nk_m_cnt_b1 "Zaehler NKAT - Diagnose MAGER" UWORD FORMULA_0010 0 0 0.0 65535.0000 ECU_ADDRESS 0x3FC780 /end MEASUREMENT
/begin MEASUREMENT lavk_obd_act_nk_m_cnt_b2 "Zaehler NKAT - Diagnose MAGER" UWORD FORMULA_0010 0 0 0.0 65535.0000 ECU_ADDRESS 0x3FC782 /end MEASUREMENT
/begin MEASUREMENT lavk_obd_act_nk_f_cnt_b1 "Zaehler VKAT - Diagnose FETT" UWORD FORMULA_0010 0 0 0.0 65535.0000 ECU_ADDRESS 0x3FC784 /end MEASUREMENT
/begin MEASUREMENT lavk_obd_act_nk_f_cnt_b2 "Zaehler VKAT - Diagnose FETT" UWORD FORMULA_0010 0 0 0.0 65535.0000 ECU_ADDRESS 0x3FC786 /end MEASUREMENT
/begin MEASUREMENT lavk_obd_act_vk_f_cnt_b1 "Zaehler NKAT - Diagnose FETT" UWORD FORMULA_0010 0 0 0.0 65535.0000 ECU_ADDRESS 0x3FC788 /end MEASUREMENT
/begin MEASUREMENT lavk_obd_act_vk_f_cnt_b2 "Zaehler NKAT - Diagnose FETT" UWORD FORMULA_0010 0 0 0.0 65535.0000 ECU_ADDRESS 0x3FC78A /end MEASUREMENT
/begin MEASUREMENT lavk_obd_act_exd_time_b1 "Prueflauf Freigabezeit" UWORD FORMULA_0862 0 0 0.0 6553.5000 ECU_ADDRESS 0x3FC78C /end MEASUREMENT
/begin MEASUREMENT lavk_obd_act_exd_time_b2 "Prueflauf Freigabezeit" UWORD FORMULA_0862 0 0 0.0 6553.5000 ECU_ADDRESS 0x3FC78E /end MEASUREMENT
/begin MEASUREMENT ksd_obd_st_b1 "Status Kraftstoffsystemdiagnose" UWORD FORMULA_0083 0 0 0.0 65535.0000 ECU_ADDRESS 0x3FC790 /end MEASUREMENT
/begin MEASUREMENT ksd_obd_st_b2 "Status Kraftstoffsystemdiagnose" UWORD FORMULA_0083 0 0 0.0 65535.0000 ECU_ADDRESS 0x3FC792 /end MEASUREMENT
/begin MEASUREMENT ksd_obd_oel_sperr_b1 "Erkennung auf Oelverduennung" UWORD FORMULA_0863 0 0 0.0 65535.0 ECU_ADDRESS 0x3FC790 BIT_MASK 0x1 /end MEASUREMENT
/begin MEASUREMENT ksd_obd_oel_sperr_b2 "Erkennung auf Oelverduennung" UWORD FORMULA_0863 0 0 0.0 65535.0 ECU_ADDRESS 0x3FC792 BIT_MASK 0x1 /end MEASUREMENT
/begin MEASUREMENT ksd_obd_freig_aktiv_b1 "Freigabebedingungen KSD" UWORD FORMULA_0864 0 0 0.0 65535.0 ECU_ADDRESS 0x3FC790 BIT_MASK 0x2 /end MEASUREMENT
/begin MEASUREMENT ksd_obd_freig_aktiv_b2 "Freigabebedingungen KSD" UWORD FORMULA_0864 0 0 0.0 65535.0 ECU_ADDRESS 0x3FC792 BIT_MASK 0x2 /end MEASUREMENT
/begin MEASUREMENT ksd_obd_start_b1 "START-Werte - KSD-Diag" UWORD FORMULA_0865 0 0 0.0 65535.0 ECU_ADDRESS 0x3FC790 BIT_MASK 0x4 /end MEASUREMENT
/begin MEASUREMENT ksd_obd_start_b2 "START-Werte - KSD-Diag" UWORD FORMULA_0865 0 0 0.0 65535.0 ECU_ADDRESS 0x3FC792 BIT_MASK 0x4 /end MEASUREMENT
/begin MEASUREMENT ksd_obd_diag_time_b1 "KSD Diagzeit" UWORD FORMULA_0866 0 0 0.0 65535.0 ECU_ADDRESS 0x3FC790 BIT_MASK 0x8 /end MEASUREMENT
/begin MEASUREMENT ksd_obd_diag_time_b2 "KSD Diagzeit" UWORD FORMULA_0866 0 0 0.0 65535.0 ECU_ADDRESS 0x3FC792 BIT_MASK 0x8 /end MEASUREMENT
/begin MEASUREMENT ksd_obd_stop_b1 "KSD - SCND STOP" UWORD FORMULA_0867 0 0 0.0 65535.0 ECU_ADDRESS 0x3FC790 BIT_MASK 0x10 /end MEASUREMENT
/begin MEASUREMENT ksd_obd_stop_b2 "KSD - SCND STOP" UWORD FORMULA_0867 0 0 0.0 65535.0 ECU_ADDRESS 0x3FC792 BIT_MASK 0x10 /end MEASUREMENT
/begin MEASUREMENT ksd_obd_laa_f_b1 "LA-Adaptionsfaktor f. KSD" UWORD FORMULA_0024 0 0 0.0 1.9990 ECU_ADDRESS 0x3FC794 /end MEASUREMENT
/begin MEASUREMENT ksd_obd_laa_f_b2 "LA-Adaptionsfaktor f. KSD" UWORD FORMULA_0024 0 0 0.0 1.9990 ECU_ADDRESS 0x3FC796 /end MEASUREMENT
/begin MEASUREMENT ksd_obd_f_rel_b1 "Delta-LA-Adaptionsfaktor f. KSD" SWORD FORMULA_0024 0 0 -1.0000 0.9999 ECU_ADDRESS 0x3FC798 /end MEASUREMENT
/begin MEASUREMENT ksd_obd_f_rel_b2 "Delta-LA-Adaptionsfaktor f. KSD" SWORD FORMULA_0024 0 0 -1.0000 0.9999 ECU_ADDRESS 0x3FC79A /end MEASUREMENT
/begin MEASUREMENT ksd_obd_laa_offs_b1 "Offset-Lambdaadaption f. KSD" SWORD FORMULA_0531 0 0 -512.0000 511.0000 ECU_ADDRESS 0x3FC79C /end MEASUREMENT
/begin MEASUREMENT ksd_obd_laa_offs_b2 "Offset-Lambdaadaption f. KSD" SWORD FORMULA_0531 0 0 -512.0000 511.0000 ECU_ADDRESS 0x3FC79E /end MEASUREMENT
/begin MEASUREMENT ksd_obd_offs_delta_b1 "Dalta-Offset-Lambdaadaption f. KSD" SWORD FORMULA_0531 0 0 -512.0000 511.0000 ECU_ADDRESS 0x3FC7A0 /end MEASUREMENT
/begin MEASUREMENT ksd_obd_offs_delta_b2 "Dalta-Offset-Lambdaadaption f. KSD" SWORD FORMULA_0531 0 0 -512.0000 511.0000 ECU_ADDRESS 0x3FC7A2 /end MEASUREMENT
/begin MEASUREMENT ksd_obd_offs_rel_b1 "Delta-LA-Adaptionsoffset als Faktor f. KSD" SWORD FORMULA_0024 0 0 -1.0000 0.9999 ECU_ADDRESS 0x3FC7A4 /end MEASUREMENT
/begin MEASUREMENT ksd_obd_offs_rel_b2 "Delta-LA-Adaptionsoffset als Faktor f. KSD" SWORD FORMULA_0024 0 0 -1.0000 0.9999 ECU_ADDRESS 0x3FC7A6 /end MEASUREMENT
/begin MEASUREMENT ksd_obd_lam_b1 "Gesamtabweichung Lambda KSD" UWORD FORMULA_0024 0 0 0.0 1.9990 ECU_ADDRESS 0x3FC7A8 /end MEASUREMENT
/begin MEASUREMENT ksd_obd_lam_b2 "Gesamtabweichung Lambda KSD" UWORD FORMULA_0024 0 0 0.0 1.9990 ECU_ADDRESS 0x3FC7AA /end MEASUREMENT
/begin MEASUREMENT ksd_obd_diag_t_b1 "KSD-Diagnosezeit" UWORD FORMULA_0862 0 0 0.0 6553.5000 ECU_ADDRESS 0x3FC7AC /end MEASUREMENT
/begin MEASUREMENT ksd_obd_diag_t_b2 "KSD-Diagnosezeit" UWORD FORMULA_0862 0 0 0.0 6553.5000 ECU_ADDRESS 0x3FC7AE /end MEASUREMENT
/begin MEASUREMENT ksd_obd_ll_max_t_b1 "Zeit d. max. Ueberschreitung im LL" UWORD FORMULA_0862 0 0 0.0 6553.5000 ECU_ADDRESS 0x3FC7B0 /end MEASUREMENT
/begin MEASUREMENT ksd_obd_ll_max_t_b2 "Zeit d. max. Ueberschreitung im LL" UWORD FORMULA_0862 0 0 0.0 6553.5000 ECU_ADDRESS 0x3FC7B2 /end MEASUREMENT
/begin MEASUREMENT ksd_obd_ll_min_t_b1 "Zeit d. min. Ueberschreitung im LL" UWORD FORMULA_0862 0 0 0.0 6553.5000 ECU_ADDRESS 0x3FC7B4 /end MEASUREMENT
/begin MEASUREMENT ksd_obd_ll_min_t_b2 "Zeit d. min. Ueberschreitung im LL" UWORD FORMULA_0862 0 0 0.0 6553.5000 ECU_ADDRESS 0x3FC7B6 /end MEASUREMENT
/begin MEASUREMENT ksd_obd_tl_max_t_b1 "Zeit d. max. Ueberschreitung im TL" UWORD FORMULA_0862 0 0 0.0 6553.5000 ECU_ADDRESS 0x3FC7B8 /end MEASUREMENT
/begin MEASUREMENT ksd_obd_tl_max_t_b2 "Zeit d. max. Ueberschreitung im TL" UWORD FORMULA_0862 0 0 0.0 6553.5000 ECU_ADDRESS 0x3FC7BA /end MEASUREMENT
/begin MEASUREMENT ksd_obd_tl_min_t_b1 "Zeit d. min. Ueberschreitung im TL" UWORD FORMULA_0862 0 0 0.0 6553.5000 ECU_ADDRESS 0x3FC7BC /end MEASUREMENT
/begin MEASUREMENT ksd_obd_tl_min_t_b2 "Zeit d. min. Ueberschreitung im TL" UWORD FORMULA_0862 0 0 0.0 6553.5000 ECU_ADDRESS 0x3FC7BE /end MEASUREMENT
/* ------------------ Abschnitt erzeugt aus lsh_nk.dat ------------------ */
/begin CHARACTERISTIC K_LSHNK_DIAG_CFG "Freigabe d. elektrischen Diag. LSH-NKAT | EN: 0 inaktiv 1 aktiv Freigabe d. elektrischen Diag. LSH-NKAT" VALUE 0x745C2 TKW_VV_VV_UB 100.0 FORMULA_0839 0.0 1.0 /end CHARACTERISTIC
/begin CHARACTERISTIC K_LSHNK_UB_MAX "max. UB-Spannung | EN: max. UB-Spannung" VALUE 0x745C4 TKW_VV_VV_SW 100.0 FORMULA_0008 0.0 28.0000 FORMAT "%4.1" /end CHARACTERISTIC
/begin CHARACTERISTIC K_LSHNK_RF_HYS "Hysterese f. RF-Schwelle | EN: Hysterese f. RF-Schwelle" VALUE 0x745C6 TKW_VV_VV_SW 100.0 FORMULA_0007 0.0 2.0000 FORMAT "%6.3" /end CHARACTERISTIC
/begin CHARACTERISTIC K_LSHNK_TKAT_MAX "max. KAT-Temperatur | EN: max. KAT-Temperatur" VALUE 0x745C8 TKW_VV_VV_SW 100.0 FORMULA_0023 -50.0000 1250.0000 FORMAT "%4.1" /end CHARACTERISTIC
/begin CHARACTERISTIC K_LSHNK_TAUP "Taupunkttemperatur | EN: Taupunkttemperatur" VALUE 0x745CA TKW_VV_VV_SW 100.0 FORMULA_0023 0.0 250.0000 FORMAT "%4.1" /end CHARACTERISTIC
/begin CHARACTERISTIC K_LSHNK_TA_MAX "max. Tastverh�ltnis" VALUE 0x745CC TKW_VV_VV_UW 100.0 FORMULA_0931 0.0 99.9900 FORMAT "%5.2" /end CHARACTERISTIC
/begin CHARACTERISTIC K_LSHNK_DIAG_R_TAU "Zeitkonstante zur Mittelung NKAT | EN: Zeitkonstante zur Mittelung NKAT" VALUE 0x745CE TKW_VV_VV_UB 100.0 FORMULA_0664 0.0101 2.5600 /end CHARACTERISTIC
/begin CHARACTERISTIC K_LSHNK_DIAG_TAUP_T "Zeitschwelle ab Taupunktueberschr. | EN: Zeitschwelle ab Taupunktueberschr." VALUE 0x745D0 TKW_VV_VV_UW 100.0 FORMULA_0021 0.0 655.0000 FORMAT "%5.2" /end CHARACTERISTIC
/begin CHARACTERISTIC K_LSHNK_DIAG_RO "obere NKAT-Widerstandsschwelle | EN: Upper post-cat resistance threshold [Ohm]" VALUE 0x745D2 TKW_VV_VV_UW 100.0 FORMULA_0537 0.0 6553.5000 FORMAT "%4.1" /end CHARACTERISTIC
/begin CHARACTERISTIC K_LSHNK_DIAG_RU "untere NKAT-Widerstandsschwelle | EN: Lower post-cat resistance threshold [Ohm]" VALUE 0x745D4 TKW_VV_VV_UW 100.0 FORMULA_0537 0.0 6553.5000 FORMAT "%4.1" /end CHARACTERISTIC
/begin CHARACTERISTIC K_LSHNK_AKTIV_T "Heizzeit der LSH | EN: Sensor heating time [s]" VALUE 0x745D6 TKW_VV_VV_UW 100.0 FORMULA_0021 0.0 655.0000 FORMAT "%5.2" /end CHARACTERISTIC
/begin CHARACTERISTIC KL_LSHNK_T_EIN "Verzoegerungszeit NKAT | EN: Delay time, post-cat" CURVE 0x745D8 TKL_SW_VV_UW 100.0 FORMULA_0799 0.0 65535.0000
 /begin AXIS_DESCR STD_AXIS tmot FORMULA_0023 3 -50.0000 170.0000 FORMAT "%4.1" /end AXIS_DESCR
/end CHARACTERISTIC
/begin CHARACTERISTIC KL_LSHNK_RF_AUS "RF-Schwelle - Ausschaltbedingung | EN: Relative-charge threshold - switch-off condition" CURVE 0x745E6 TKL_SW_VV_SW 100.0 FORMULA_0007 0.0 2.0000 /begin AXIS_DESCR STD_AXIS n FORMULA_0006 5 0.0 10000.0000 /end AXIS_DESCR FORMAT "%6.3" /end CHARACTERISTIC
/begin CHARACTERISTIC KL_LSHNK_TA "Tastverhaeltnis | EN: Duty cycle" CURVE 0x745FC TKL_SW_VV_UW 100.0 FORMULA_0931 0.0 100.0000 /begin AXIS_DESCR STD_AXIS ub FORMULA_0008 4 0.0 28.0000 FORMAT "%4.1" /end AXIS_DESCR FORMAT "%5.2" /end CHARACTERISTIC
/begin CHARACTERISTIC KL_LSHNK_SOND_TEMP "NKAT-Sondentemperatur | EN: Post-cat sensor temperature" CURVE 0x7460E TKL_UW_VV_SW 100.0 FORMULA_0023 -50.0000 1250.0000
 /begin AXIS_DESCR STD_AXIS lshnk_r_gmw FORMULA_0537 8 0.0 100.0000 FORMAT "%4.1" /end AXIS_DESCR
 FORMAT "%4.1" /end CHARACTERISTIC
/begin MEASUREMENT lshnk_b1.st "NKAT-LSH-Status" UWORD FORMULA_0083 0 0 0.0 65535.0000 ECU_ADDRESS 0x3FC830 /end MEASUREMENT
/begin MEASUREMENT lshnk_b2.st "NKAT-LSH-Status" UWORD FORMULA_0083 0 0 0.0 65535.0000 ECU_ADDRESS 0x3FC836 /end MEASUREMENT
/begin MEASUREMENT lshnk.ein_b1 "NKAT-LSH-EIN" UWORD FORMULA_0928 0 0 0.0 65535.0 ECU_ADDRESS 0x3FC830 BIT_MASK 0x1 /end MEASUREMENT
/begin MEASUREMENT lshnk.ein_b2 "NKAT-LSH-EIN" UWORD FORMULA_0928 0 0 0.0 65535.0 ECU_ADDRESS 0x3FC836 BIT_MASK 0x1 /end MEASUREMENT
/begin MEASUREMENT lshnk.taup_b1 "NKAT-LSH-TAUP" UWORD FORMULA_0929 0 0 0.0 65535.0 ECU_ADDRESS 0x3FC830 BIT_MASK 0x2 /end MEASUREMENT
/begin MEASUREMENT lshnk.taup_b2 "NKAT-LSH-TAUP" UWORD FORMULA_0929 0 0 0.0 65535.0 ECU_ADDRESS 0x3FC836 BIT_MASK 0x2 /end MEASUREMENT
/begin MEASUREMENT lshnk.exd_aktiv_b1 "NKAT-LSH: Tester" UWORD FORMULA_0930 0 0 0.0 65535.0 ECU_ADDRESS 0x3FC830 BIT_MASK 0x4 /end MEASUREMENT
/begin MEASUREMENT lshnk.exd_aktiv_b2 "NKAT-LSH: Tester" UWORD FORMULA_0930 0 0 0.0 65535.0 ECU_ADDRESS 0x3FC836 BIT_MASK 0x4 /end MEASUREMENT
/begin MEASUREMENT lshnk_b1.ta "Ansteuertastverhaeltnis NKAT" UWORD FORMULA_0931 0 0 0.0 100.0000 ECU_ADDRESS 0x3FC832 /end MEASUREMENT
/begin MEASUREMENT lshnk_b2.ta "Ansteuertastverhaeltnis NKAT" UWORD FORMULA_0931 0 0 0.0 100.0000 ECU_ADDRESS 0x3FC838 /end MEASUREMENT
/begin MEASUREMENT lshnk_b1.temp "Sondentemperatur NKAT" SWORD FORMULA_0023 0 0 -50.0000 1250.0000 ECU_ADDRESS 0x3FC834 /end MEASUREMENT
/begin MEASUREMENT lshnk_b2.temp "Sondentemperatur NKAT" SWORD FORMULA_0023 0 0 -50.0000 1250.0000 ECU_ADDRESS 0x3FC83A /end MEASUREMENT
/begin MEASUREMENT lshnk_exd_timeout_b1 "KWP-Ansteuerzeit" UWORD FORMULA_0932 0 0 0.0 655.3500 ECU_ADDRESS 0x3FC83C /end MEASUREMENT
/begin MEASUREMENT lshnk_exd_timeout_b2 "KWP-Ansteuerzeit" UWORD FORMULA_0932 0 0 0.0 655.3500 ECU_ADDRESS 0x3FC83E /end MEASUREMENT
/begin MEASUREMENT lshnk_diag_b1.st "NKAT-LSH-Diag.-Status" UWORD FORMULA_0083 0 0 0.0 65535.0000 ECU_ADDRESS 0x3FC840 /end MEASUREMENT
/begin MEASUREMENT lshnk_diag_b2.st "NKAT-LSH-Diag.-Status" UWORD FORMULA_0083 0 0 0.0 65535.0000 ECU_ADDRESS 0x3FC84E /end MEASUREMENT
/begin MEASUREMENT lshnk_diag.aktiv_b1 "NKAT-LSH-Diag-AKTIV" UWORD FORMULA_0933 0 0 0.0 65535.0 ECU_ADDRESS 0x3FC840 BIT_MASK 0x1 /end MEASUREMENT
/begin MEASUREMENT lshnk_diag.aktiv_b2 "NKAT-LSH-Diag-AKTIV" UWORD FORMULA_0933 0 0 0.0 65535.0 ECU_ADDRESS 0x3FC84E BIT_MASK 0x1 /end MEASUREMENT
/begin MEASUREMENT lshnk_diag.info_b1 "NKAT-LSH-Diag-INFO" UWORD FORMULA_0934 0 0 0.0 65535.0 ECU_ADDRESS 0x3FC840 BIT_MASK 0x2 /end MEASUREMENT
/begin MEASUREMENT lshnk_diag.info_b2 "NKAT-LSH-Diag-INFO" UWORD FORMULA_0934 0 0 0.0 65535.0 ECU_ADDRESS 0x3FC84E BIT_MASK 0x2 /end MEASUREMENT
/begin MEASUREMENT lshnk_diag.sh_to_x_sperren_b1 "NKAT-LSH-Einschalten aufgrund elektr. Diag. sperren" UWORD FORMULA_0935 0 0 0.0 65535.0 ECU_ADDRESS 0x3FC840 BIT_MASK 0x4 /end MEASUREMENT
/begin MEASUREMENT lshnk_diag.sh_to_x_sperren_b2 "NKAT-LSH-Einschalten aufgrund elektr. Diag. sperren" UWORD FORMULA_0935 0 0 0.0 65535.0 ECU_ADDRESS 0x3FC84E BIT_MASK 0x4 /end MEASUREMENT
/begin MEASUREMENT lshnk_diag_b1.i_ad "Heizerstrom NKAT" UWORD FORMULA_0936 0 0 0.0 4.7627 ECU_ADDRESS 0x3FC842 /end MEASUREMENT
/begin MEASUREMENT lshnk_diag_b2.i_ad "Heizerstrom NKAT" UWORD FORMULA_0936 0 0 0.0 4.7627 ECU_ADDRESS 0x3FC850 /end MEASUREMENT
/begin MEASUREMENT lshnk_diag_b1.i_cnt "Summen-Diag.Zaehler NKAT" UWORD FORMULA_0010 0 0 0.0 255.0000 ECU_ADDRESS 0x3FC844 /end MEASUREMENT
/begin MEASUREMENT lshnk_diag_b2.i_cnt "Summen-Diag.Zaehler NKAT" UWORD FORMULA_0010 0 0 0.0 255.0000 ECU_ADDRESS 0x3FC852 /end MEASUREMENT
/begin MEASUREMENT lshnk_diag_b1.i_sum "Summe d. Heizerstroms NKAT" UWORD FORMULA_0936 0 0 0.0 304.8139 ECU_ADDRESS 0x3FC846 /end MEASUREMENT
/begin MEASUREMENT lshnk_diag_b2.i_sum "Summe d. Heizerstroms NKAT" UWORD FORMULA_0936 0 0 0.0 304.8139 ECU_ADDRESS 0x3FC854 /end MEASUREMENT
/begin MEASUREMENT lshnk_diag_b1.i_wert "gemittelter Heizerstrom NKAT" UWORD FORMULA_0936 0 0 0.0 4.7627 ECU_ADDRESS 0x3FC848 /end MEASUREMENT
/begin MEASUREMENT lshnk_diag_b2.i_wert "gemittelter Heizerstrom NKAT" UWORD FORMULA_0936 0 0 0.0 4.7627 ECU_ADDRESS 0x3FC856 /end MEASUREMENT
/begin MEASUREMENT lshnk_diag_b1.r "Heizerwiderstand NKAT" UWORD FORMULA_0537 0 0 0.0 100.0000 ECU_ADDRESS 0x3FC84A /end MEASUREMENT
/begin MEASUREMENT lshnk_diag_b2.r "Heizerwiderstand NKAT" UWORD FORMULA_0537 0 0 0.0 100.0000 ECU_ADDRESS 0x3FC858 /end MEASUREMENT
/begin MEASUREMENT lshnk_rf_aus "Ausschaltschwelle RF fuer LSHN" SWORD FORMULA_0007 0 0 0.0 2.0000 ECU_ADDRESS 0x3FC85C /end MEASUREMENT
/begin MEASUREMENT lshnk_t_ein "Verzoegerungszeit nach START" UWORD FORMULA_0062 0 0 0.0 65535.0000 ECU_ADDRESS 0x3FC85E /end MEASUREMENT
/* ------------------ Abschnitt erzeugt aus lsh_vk.dat ------------------ */
/begin CHARACTERISTIC K_LSHVK_CFG "LSH-Freigabe | EN: 0x0 keine Heizung 0x1 Heizung ELSE undefiniert LSH-Freigabe" VALUE 0x74630 TKW_VV_VV_UW 100.0 FORMULA_0957 0.0 65535.0 FORMAT "%5.2" /end CHARACTERISTIC
/begin CHARACTERISTIC K_LSHVK_T_KL15_MAX "max. Heizdauer bei KL15 an | EN: max. Heizdauer bei KL15 an" VALUE 0x74632 TKW_VV_VV_UW 100.0 FORMULA_0021 0.0 655.0000 FORMAT "%5.2" /end CHARACTERISTIC
/begin CHARACTERISTIC K_LSHVK_TABG_HYS "Hysterese Abgastemperatur" VALUE 0x74634 TKW_VV_VV_SW 100.0 FORMULA_0800 -1000.0000 1250.0000 FORMAT "%4.1" /end CHARACTERISTIC
/begin CHARACTERISTIC K_LSHVK_TEMP_FILT_TAU "" VALUE 0x74636 TKW_VV_VV_UW 100.0 FORMULA_0755 0.0 255.9960 FORMAT "%5.2" /end CHARACTERISTIC
/begin CHARACTERISTIC K_LSHVK_REG_K "Verstaerkungsfaktor PI-Regler | EN: Verstaerkungsfaktor PI -Regler" VALUE 0x74638 TKW_VV_VV_UW 100.0 FORMULA_0958 0.0 1.0000 FORMAT "%5.2" /end CHARACTERISTIC
/begin CHARACTERISTIC K_LSHVK_REG_TN "Nachstellzeit PI-Regler | EN: Nachstellzeit PI-Regler" VALUE 0x7463A TKW_VV_VV_UW 100.0 FORMULA_0062 1.0000 65535.0000 /end CHARACTERISTIC
/begin CHARACTERISTIC K_LSHVK_TV_KORR_MIN "min. Tastverhaeltnis VKAT | EN: min. Tastverhaeltnis VKAT" VALUE 0x7463C TKW_VV_VV_UW 100.0 FORMULA_0946 0.0 99.9500 FORMAT "%5.2" /end CHARACTERISTIC
/begin CHARACTERISTIC K_LSHVK_UB_NORM "Normbordspannung | EN: Normbordspannung" VALUE 0x7463E TKW_VV_VV_UW 100.0 FORMULA_0008 0.0 25.0000 FORMAT "%4.1" /end CHARACTERISTIC
/begin CHARACTERISTIC K_LSHVK_UB_MAX "max. Bordspannung | EN: max. Bordspannung" VALUE 0x74640 TKW_VV_VV_UW 100.0 FORMULA_0008 0.0 25.0000 FORMAT "%4.1" /end CHARACTERISTIC
/begin CHARACTERISTIC K_LSHVK_UEFF_GRAD "Effektivspannungsgradient | EN: Effektivspannungsgradient" VALUE 0x74642 TKW_VV_VV_UW 100.0 FORMULA_0959 0.0 25.0000 FORMAT "%4.1" /end CHARACTERISTIC
/begin CHARACTERISTIC K_LSHVK_TEMP_MAX "max. Sondentemperatur | EN: Maximum sensor temperature [°C]" VALUE 0x74644 TKW_VV_VV_SW 100.0 FORMULA_0791 -50.0000 1250.0000 /end CHARACTERISTIC
/begin CHARACTERISTIC K_LSHVK_TEMP_MIN "min. Sondentemperatur | EN: Minimum sensor temperature [°C]" VALUE 0x74646 TKW_VV_VV_SW 100.0 FORMULA_0791 -50.0000 1250.0000 /end CHARACTERISTIC
/begin CHARACTERISTIC K_LSHVK_TEMP_REG_MIN "min. Sondentemperatur f. REG-Aktivierung | EN: Minimum sensor temperature for controller activation [°C]" VALUE 0x74648 TKW_VV_VV_SW 100.0 FORMULA_0791 -50.0000 1250.0000 /end CHARACTERISTIC
/begin CHARACTERISTIC K_LSHVK_TEMP_DIF_ZUL "zulaessige Temp-Differenz | EN: Permitted temperature difference [°C]" VALUE 0x7464A TKW_VV_VV_SW 100.0 FORMULA_0791 -50.0000 1250.0000 /end CHARACTERISTIC
/begin CHARACTERISTIC K_LSHVK_TEMP_IST_SCHW "Umschalttemperatur f. Filterkonstante | EN: Switchover temperature for filter constant [°C]" VALUE 0x7464C TKW_VV_VV_SW 100.0 FORMULA_0791 -50.0000 1250.0000 /end CHARACTERISTIC
/begin CHARACTERISTIC K_LSHVK_RI_RANGE_SCHW "Umschalttemperatur ATIC42 zwischen Range1/2 Ri-Messung | EN: ATIC42 switchover temperature between range 1/2 Ri measurement [°C]" VALUE 0x7464E TKW_VV_VV_SW 100.0 FORMULA_0791 -50.0000 1250.0000 /end CHARACTERISTIC
/begin CHARACTERISTIC K_LSHVK_TEMP_IST_ENABLE_IP_LOOP "Einschalttemperatur ATIC42 IP Control loop | EN: Switch-on temperature for ATIC42 IP control loop [°C]" VALUE 0x74650 TKW_VV_VV_SW 100.0 FORMULA_0791 -50.0000 1250.0000 /end CHARACTERISTIC
/begin CHARACTERISTIC K_LSHVK_DIAG_CFG "Freigabe d. elektrischen Diag. LSH-VKAT" VALUE 0x74652 TKW_VV_VV_UB 100.0 FORMULA_0839 0.0 1.0 /end CHARACTERISTIC
/begin CHARACTERISTIC K_LSHVK_DIAG_TEMP_IST_MIN "min. Sondentemperatur fuer LSHVK-Diag. | EN: Minimum sensor temperature for pre-cat heater diagnosis [°C]" VALUE 0x74654 TKW_VV_VV_SW 100.0 FORMULA_0791 -50.0000 1250.0000 /end CHARACTERISTIC
/begin CHARACTERISTIC K_LSHVK_DIAG_TEMP_IST_MAX "max. Sondentemperatur fuer LSHVK-Diag. | EN: Maximum sensor temperature for pre-cat heater diagnosis [°C]" VALUE 0x74656 TKW_VV_VV_SW 100.0 FORMULA_0791 -50.0000 1250.0000 /end CHARACTERISTIC
/begin CHARACTERISTIC K_LSHVK_DIAG_R_TAU "Zeitkonstante zur Mittelung VKAT | EN: Time constant for pre-cat averaging [s]" VALUE 0x74658 TKW_VV_VV_UB 100.0 FORMULA_0683 0.1004 25.6000 /end CHARACTERISTIC
/begin CHARACTERISTIC K_LSHVK_DIAG_RO "obere VKAT-Widerstandsschwelle | EN: Upper pre-cat resistance threshold [Ohm]" VALUE 0x7465A TKW_VV_VV_UW 100.0 FORMULA_0537 0.0 6553.5000 FORMAT "%4.1" /end CHARACTERISTIC
/begin CHARACTERISTIC K_LSHVK_DIAG_RU "untere VKAT-Widerstandsschwelle | EN: Lower pre-cat resistance threshold [Ohm]" VALUE 0x7465C TKW_VV_VV_UW 100.0 FORMULA_0537 0.0 6553.5000 FORMAT "%4.1" /end CHARACTERISTIC
/begin CHARACTERISTIC K_LSHVK_DIAG_R_OFFSET "LSHVK-Heizleistungs-Diagnoseoffset | EN: Pre-cat heater power diagnosis offset [Ohm]" VALUE 0x7465E TKW_VV_VV_UW 100.0 FORMULA_0537 0.0 6553.5000 FORMAT "%4.1" /end CHARACTERISTIC
/begin CHARACTERISTIC K_LSHVK_DIAG_R_ADAPT "INIT-Wert der R-Adption | EN: Initial value of resistance adaptation [Ohm]" VALUE 0x74660 TKW_VV_VV_UW 100.0 FORMULA_0537 0.0 6553.5000 FORMAT "%4.1" /end CHARACTERISTIC
/begin CHARACTERISTIC K_LSHVK_DIAG_ANZ_MESS "Anzahl gueltiger Messungen | EN: Number of valid measurements" VALUE 0x74662 TKW_VV_VV_UW 100.0 FORMULA_0010 0.0 65535.0000 /end CHARACTERISTIC
/begin CHARACTERISTIC K_LSRVK_OBD_CFG "Freigabe Sondeninnenwiderstandsdiag. LSH-VKAT" VALUE 0x74664 TKW_VV_VV_UB 100.0 FORMULA_0839 0.0 1.0 /end CHARACTERISTIC
/begin CHARACTERISTIC K_LSRVK_OBD_ML_SUM "min. aufsummierte Luftmassenstr. nach SA_WE | EN: Minimum summed air mass flow after start [mg]" VALUE 0x74666 TKW_VV_VV_UW 100.0 FORMULA_0832 0.0 65535.0000 /end CHARACTERISTIC
/begin CHARACTERISTIC K_LSRVK_OBD_TKAT_MIN "min. KAT-Temperatur f. LSRVK-OBD-Diag. | EN: Minimum catalyst temperature for pre-cat sensor OBD diagnosis [°C]" VALUE 0x74668 TKW_VV_VV_SW 100.0 FORMULA_0023 -50.0000 1200.0000 FORMAT "%4.1" /end CHARACTERISTIC
/begin CHARACTERISTIC K_LSRVK_OBD_TKAT_MAX "max. KAT-Temperatur f. LSRVK-OBD-Diag. | EN: Maximum catalyst temperature for pre-cat sensor OBD diagnosis [°C]" VALUE 0x7466A TKW_VV_VV_SW 100.0 FORMULA_0023 -50.0000 1200.0000 FORMAT "%4.1" /end CHARACTERISTIC
/begin CHARACTERISTIC K_LSRVK_OBD_REG_T "Diag.zeit fuer d. max. Anschlagszeit d. Heizungsreglers | EN: Diagnosis time for maximum end-stop time of heater controller [s]" VALUE 0x7466C TKW_VV_VV_UW 100.0 FORMULA_0062 0.0 65535.0000 /end CHARACTERISTIC
/begin CHARACTERISTIC K_LSRVK_OBD_START_R "max. Ri-Schwelle f. Diag. nach Motorstart | EN: Maximum Ri threshold for diagnosis after engine start" VALUE 0x7466E TKW_VV_VV_UW 100.0 FORMULA_0945 0.0 5000.0000 /end CHARACTERISTIC
/begin CHARACTERISTIC K_LSHVK_AD_TEST "Umschaltung d. Sonden-Ri-Adaption" VALUE 0x74670 TKW_VV_VV_UW 100.0 FORMULA_0782 0.0 1.0 FORMAT "%5.2" /end CHARACTERISTIC
/begin CHARACTERISTIC K_LSHVK_R_AD_RESET "RESET d. Sonden-Ri-Adaption" VALUE 0x74672 TKW_VV_VV_UW 100.0 FORMULA_0784 0.0 1.0 FORMAT "%5.2" /end CHARACTERISTIC
/begin CHARACTERISTIC K_LSHVK_R_REF "Referenzspannung Ri | EN: Ri reference voltage [mV]" VALUE 0x74674 TKW_VV_VV_UW 100.0 FORMULA_0532 0.0 5000.0000 /end CHARACTERISTIC
/begin CHARACTERISTIC K_LSHVK_R_REF_OFFS "Referenzspannung Ri fuer OFFSET-Adaption | EN: Ri reference voltage for offset adaptation [mV]" VALUE 0x74676 TKW_VV_VV_UW 100.0 FORMULA_0532 0.0 5000.0000 /end CHARACTERISTIC
/begin CHARACTERISTIC K_LSHVK_R_AD_OFFS_CNT_MIN "MIN-Zaehler fuer OFFSET-Sonden-Ri-Adaption | EN: Minimum counter for sensor Ri offset adaptation" VALUE 0x74678 TKW_VV_VV_UW 100.0 FORMULA_0010 0.0 65535.0000 /end CHARACTERISTIC
/begin CHARACTERISTIC K_LSHVK_R_AD_OFFS_CNT "Zaehler fuer OFFSET-Sonden-Ri-Adaption | EN: Counter for sensor Ri offset adaptation" VALUE 0x7467A TKW_VV_VV_UW 100.0 FORMULA_0010 0.0 65535.0000 /end CHARACTERISTIC
/begin CHARACTERISTIC K_LSHVK_R_AD_GAIN_CNT_MIN "MIN-Zaehler fuer GAIN-Sonden-Ri-Adaption | EN: Minimum counter for sensor Ri gain adaptation" VALUE 0x7467C TKW_VV_VV_UW 100.0 FORMULA_0010 0.0 65535.0000 /end CHARACTERISTIC
/begin CHARACTERISTIC K_LSHVK_R_AD_GAIN_CNT "Zaehler fuer GAIN-Sonden-Ri-Adaption | EN: Counter for sensor Ri gain adaptation" VALUE 0x7467E TKW_VV_VV_UW 100.0 FORMULA_0010 0.0 65535.0000 /end CHARACTERISTIC
/begin CHARACTERISTIC K_LSHVK_R_AD_OFFS_T "MIN-Zeit zwischen zwei OFFSET-Adapt. | EN: Minimum time between two offset adaptations [s]" VALUE 0x74680 TKW_VV_VV_UW 100.0 FORMULA_0021 0.0 655.0000 FORMAT "%5.2" /end CHARACTERISTIC
/begin CHARACTERISTIC K_LSHVK_R_AD_GAIN_T "MIN-Zeit zwischen zwei GAIN-Adapt. | EN: Minimum time between two gain adaptations [s]" VALUE 0x74682 TKW_VV_VV_UW 100.0 FORMULA_0021 0.0 655.0000 FORMAT "%5.2" /end CHARACTERISTIC
/begin CHARACTERISTIC K_LSHVK_R_AD_OFFS_T1 "Filterkoeffizient - OFFSET-Sonden-Ri-Adapt. | EN: Filter coefficient - sensor Ri offset adaptation" VALUE 0x74684 TKW_VV_VV_UW 100.0 FORMULA_0960 0.0 6553500.0000 /end CHARACTERISTIC
/begin CHARACTERISTIC K_LSHVK_R_AD_GAIN_T1 "Filterkoeffizient - GAIN-Sonden-Ri-Adapt. | EN: Filter coefficient - sensor Ri gain adaptation" VALUE 0x74686 TKW_VV_VV_UW 100.0 FORMULA_0960 0.0 6553500.0000 /end CHARACTERISTIC
/begin CHARACTERISTIC K_LSHVK_R_AD_OFFS_MIN "MIN-Schwelle f. Offset-Sonden-Ri-Adapt. | EN: Minimum threshold for sensor Ri offset adaptation [mV]" VALUE 0x74688 TKW_VV_VV_SW 100.0 FORMULA_0532 -2500.0000 2500.0000 /end CHARACTERISTIC
/begin CHARACTERISTIC K_LSHVK_R_AD_OFFS_MAX "MAX-Schwelle f. Offset-Sonden-Ri-Adapt. | EN: Maximum threshold for sensor Ri offset adaptation [mV]" VALUE 0x7468A TKW_VV_VV_SW 100.0 FORMULA_0532 -2500.0000 2500.0000 /end CHARACTERISTIC
/begin CHARACTERISTIC K_LSHVK_R_AD_GAIN_MIN "MIN-Schwelle f. GAIN-Sonden-Ri-Adapt. | EN: Minimum threshold for sensor Ri gain adaptation [mV]" VALUE 0x7468C TKW_VV_VV_UW 100.0 FORMULA_0532 0.0 5000.0000 /end CHARACTERISTIC
/begin CHARACTERISTIC K_LSHVK_R_AD_GAIN_MAX "MAX-Schwelle f. GAIN-Sonden-Ri-Adapt. | EN: Maximum threshold for sensor Ri gain adaptation [mV]" VALUE 0x7468E TKW_VV_VV_UW 100.0 FORMULA_0532 0.0 5000.0000 /end CHARACTERISTIC
/begin CHARACTERISTIC K_LSHVK_R_AD_OFFS_GRAD "max. OFFEST-Gradient | EN: Maximum offset gradient [mV]" VALUE 0x74690 TKW_VV_VV_UW 100.0 FORMULA_0532 0.0 5000.0000 /end CHARACTERISTIC
/begin CHARACTERISTIC K_LSHVK_R_AD_GAIN_GRAD "max. GAIN-Gradient | EN: Maximum gain gradient" VALUE 0x74692 TKW_VV_VV_UW 100.0 FORMULA_0075 0.0 4.0000 FORMAT "%6.3" /end CHARACTERISTIC
/begin CHARACTERISTIC K_LSRVK_OBD_REF_GAIN_MIN "min. GAIN-Ri-Schwelle - Referenzwiderstandsdiag. | EN: Minimum gain Ri threshold - reference current diagnosis" VALUE 0x74694 TKW_VV_VV_UW 100.0 FORMULA_0075 0.0 4.0000 FORMAT "%6.3" /end CHARACTERISTIC
/begin CHARACTERISTIC K_LSRVK_OBD_REF_GAIN_MAX "max. GAIN-Ri-Schwelle - Referenzwiderstandsdiag. | EN: max. GAIN -Ri-Schwelle - Referenzstromdiag." VALUE 0x74696 TKW_VV_VV_UW 100.0 FORMULA_0075 0.0 4.0000 FORMAT "%6.3" /end CHARACTERISTIC
/begin CHARACTERISTIC K_LSRVK_OBD_REF_CNT "Schwelle LA-Ri-GAIN-Ermittlungen f. Referenzwiderstandsdiagnose | EN: Schwelle LA- Ri-GAIN- Ermittlungen f. Referen z- stromdiagnose" VALUE 0x74698 TKW_VV_VV_UW 100.0 FORMULA_0010 0.0 65535.0000 /end CHARACTERISTIC
/begin CHARACTERISTIC K_LSRVK_OBD_REF_OFFS_MAX "max. OFFSET-Ri-Schwelle - Referenzwiderstandsdiag. | EN: max. OFFSET -Ri- Schwelle - Referenzstromdiag." VALUE 0x7469A TKW_VV_VV_SW 100.0 FORMULA_0532 -5000.0000 5000.0000 /end CHARACTERISTIC
/begin CHARACTERISTIC K_LSRVK_OBD_REF_OFFS_MIN "min. OFFSET-Ri-Schwelle - Referenzwiderstandsdiag. | EN: min. OFFSET-Ri-Schwelle - Referenzstromdiag." VALUE 0x7469C TKW_VV_VV_SW 100.0 FORMULA_0532 -5000.0000 5000.0000 /end CHARACTERISTIC
/begin CHARACTERISTIC K_LSRVK_OBD_REF_OFFS_CNT "Schwelle LA-Ri-OFFSET-Ermittlungen f. Referenzwiderstandsdiagnose | EN: Schwelle LA-Ri-OFFSET-Ermittlungen f. Referenzwiderstandsdiagnose" VALUE 0x7469E TKW_VV_VV_UW 100.0 FORMULA_0010 0.0 65535.0000 /end CHARACTERISTIC
/begin CHARACTERISTIC K_LSH_UB_TAU "Zeitkonstante LSH-UB | EN: Zeitkonstante LSH-UB" VALUE 0x746A0 TKW_VV_VV_UB 100.0 FORMULA_0683 0.1004 25.6000 /end CHARACTERISTIC
/begin CHARACTERISTIC K_LSHVK_R_AD_OFFS_NV_MAX "max. Grenze fuer OFFEST-Sonden-Ri-Adapt. | EN: max. Grenze fuer OFFEST -Sonden-Ri-Adapt." VALUE 0x746A2 TKW_VV_VV_SW 100.0 FORMULA_0532 -5000.0000 5000.0000 /end CHARACTERISTIC
/begin CHARACTERISTIC K_LSHVK_R_AD_OFFS_NV_MIN "min. Grenze fuer OFFEST-Sonden-Ri-Adapt. | EN: min. Grenze fuer OFFEST -Sonden-Ri-Adapt." VALUE 0x746A4 TKW_VV_VV_SW 100.0 FORMULA_0532 -5000.0000 5000.0000 /end CHARACTERISTIC
/begin CHARACTERISTIC K_LSHVK_R_AD_GAIN_NV_MAX "max. Grenze fuer GAIN-Sonden-Ri-Adapt. | EN: max. Grenze fuer GAIN -Sonden-Ri-Adapt." VALUE 0x746A6 TKW_VV_VV_UW 100.0 FORMULA_0075 0.0 4.0000 FORMAT "%6.3" /end CHARACTERISTIC
/begin CHARACTERISTIC K_LSHVK_R_AD_GAIN_NV_MIN "min. Grenze fuer GAIN-Sonden-Ri-Adapt. | EN: min. Grenze fuer GAIN -Sonden-Ri-Adapt." VALUE 0x746A8 TKW_VV_VV_UW 100.0 FORMULA_0075 0.0 4.0000 FORMAT "%6.3" /end CHARACTERISTIC
/begin CHARACTERISTIC K_LSHVK_WSS_CFG "Wasserschlag-Konfiguration" VALUE 0x746AA TKW_VV_VV_UW 100.0 FORMULA_0961 0.0 65535.0 FORMAT "%5.2" /end CHARACTERISTIC
/begin CHARACTERISTIC KL_LSHVK_TEMP_IST_HIGH "IST-Temp. d. Sonde | EN: Actual sensor temperature" CURVE 0x746AC TKL_UW_VV_SW 100.0 FORMULA_0791 -50.0000 1250.0000 /begin AXIS_DESCR STD_AXIS lshvk_r_mess_korr FORMULA_0945 16 0.0 5000.0000 /end AXIS_DESCR /end CHARACTERISTIC
/begin CHARACTERISTIC KL_LSHVK_TEMP_IST_LOW "IST-Temp. d. Sonde m. Range 2 ATIC 42 | EN: Actual sensor temperature with ATIC42 range 2" CURVE 0x746EE TKL_UW_VV_SW 100.0 FORMULA_0791 -50.0000 1250.0000 /begin AXIS_DESCR STD_AXIS lshvk_r_mess_korr FORMULA_0945 16 0.0 5000.0000 /end AXIS_DESCR /end CHARACTERISTIC
/begin CHARACTERISTIC KL_LSHVK_TEMP_SOLL_MS "SOLL-Temp. bei Motor steht | EN: Target sensor temperature with engine stopped" CURVE 0x74730 TKL_SW_VV_SW 100.0 FORMULA_0791 -50.0000 1250.0000
 /begin AXIS_DESCR STD_AXIS tmot FORMULA_0023 6 -50.0000 170.0000 FORMAT "%4.1" /end AXIS_DESCR
/end CHARACTERISTIC
/begin CHARACTERISTIC KL_LSHVK_R_MESS_F "Adapt.Faktor Sonde | EN: Sensor adaptation factor" CURVE 0x7474A TKL_UW_VV_UW 100.0 FORMULA_0962 0.0 1.9999 /begin AXIS_DESCR STD_AXIS Abgasbank FORMULA_0010 2 1.0000 2.0000 /end AXIS_DESCR /end CHARACTERISTIC
/begin CHARACTERISTIC KL_LSHVK_R_MESS_OFFS "Adapt.Offset Sonde | EN: Sensor adaptation offset" CURVE 0x74754 TKL_UW_VV_SW 100.0 FORMULA_0945 -160000.0000 159995.1171 /begin AXIS_DESCR STD_AXIS Abgasbank FORMULA_0010 2 1.0000 2.0000 /end AXIS_DESCR /end CHARACTERISTIC
/begin CHARACTERISTIC KL_LSHVK_SOND_TEMP "VKAT-Sondentemperatur ueber Heizerwiderstand | EN: Pre-cat sensor temperature from heater resistance" CURVE 0x7475E TKL_UW_VV_SW 100.0 FORMULA_0023 -50.0000 1250.0000 /begin AXIS_DESCR STD_AXIS lshvk_r FORMULA_0537 8 0.0 100.0000 FORMAT "%4.1" /end AXIS_DESCR FORMAT "%4.1" /end CHARACTERISTIC
/begin CHARACTERISTIC KL_LSRVK_OBD_START_TML "Zeit, bis VKAT-Arbeitstemperatur erreicht" CURVE 0x74780 TKL_SW_VV_UW 100.0 FORMULA_0021 0.0 655.0000
 /begin AXIS_DESCR STD_AXIS zust_tmot_start FORMULA_0023 4 -50.0000 170.0000 FORMAT "%4.1" /end AXIS_DESCR
 FORMAT "%5.2" /end CHARACTERISTIC
/begin CHARACTERISTIC KL_LSHVK_UEFF_MAX "max. eff. Heizerspannung | EN: Maximum effective heater voltage" CURVE 0x74792 TKL_SW_VV_UW 100.0 FORMULA_0008 0.0 25.0000
 /begin AXIS_DESCR STD_AXIS tabg_vkat FORMULA_0023 6 -50.0000 1250.0000 FORMAT "%4.1" /end AXIS_DESCR
 FORMAT "%4.1" /end CHARACTERISTIC
/begin CHARACTERISTIC KL_LSHVK_DIAG_TIME_ML "Verzoegerungszeit nach Startende | EN: Verzoegerungszeit nach Startende" CURVE 0x747AC TKL_SW_VV_UW 100.0 FORMULA_0021 0.0 655.3500
 /begin AXIS_DESCR STD_AXIS zust_tmot_start FORMULA_0023 4 -50.0000 170.0000 FORMAT "%4.1" /end AXIS_DESCR
 FORMAT "%5.2" /end CHARACTERISTIC
/begin CHARACTERISTIC KL_LSRVK_OBD_TML "Verzoegerungszeit nach Startende" CURVE 0x747BE TKL_SW_VV_UW 100.0 FORMULA_0021 0.0 655.0000
 /begin AXIS_DESCR STD_AXIS zust_tmot_start FORMULA_0023 4 -50.0000 170.0000 FORMAT "%4.1" /end AXIS_DESCR
 FORMAT "%5.2" /end CHARACTERISTIC
/begin CHARACTERISTIC KF_LSHVK_TV_VORST "Vorsteuertastverhaeltnis LSHVK | EN: Pre-control duty cycle, pre-cat sensor heater" MAP 0x747D0 TKF_SW_SW_UW 100.0 FORMULA_0946 0.0 99.9500
 /begin AXIS_DESCR STD_AXIS tabg FORMULA_0023 6 -50.0000 1250.0000 FORMAT "%4.1" /end AXIS_DESCR
 /begin AXIS_DESCR STD_AXIS lshvk_temp_soll FORMULA_0791 6 -50.0000 1250.0000 /end AXIS_DESCR
 FORMAT "%5.2" /end CHARACTERISTIC
/begin CHARACTERISTIC KF_LSHVK_TV_KORR_MAX "max. Tastverhaeltnis VKAT | EN: Maximum duty cycle, pre-cat sensor heater" MAP 0x74832 TKF_SW_SW_UW 100.0 FORMULA_0946 0.0 99.9500 /begin AXIS_DESCR STD_AXIS time_ml FORMULA_0021 6 0.0 327.0000 FORMAT "%5.2" /end AXIS_DESCR
 /begin AXIS_DESCR STD_AXIS lsh_ub_filt FORMULA_0008 6 0.0 28.0000 FORMAT "%4.1" /end AXIS_DESCR
 FORMAT "%5.2" /end CHARACTERISTIC
/begin CHARACTERISTIC KF_LSHVK_TEMP_SOLL "SOLL-Temp. bei Motor laeuft" MAP 0x74894 TKF_SW_SW_SW 100.0 FORMULA_0791 -50.0000 1250.0000
 /begin AXIS_DESCR STD_AXIS tabg_hys-tmot_start FORMULA_0023 10 -50.0000 1250.0000 FORMAT "%4.1" /end AXIS_DESCR
 /begin AXIS_DESCR STD_AXIS time_ml FORMULA_0021 10 0.0 327.0000 FORMAT "%5.2" /end AXIS_DESCR
/end CHARACTERISTIC
/begin MEASUREMENT lshvk_b1.st "VKAT-LSH-Status" UWORD FORMULA_0083 0 0 0.0 65535.0000 ECU_ADDRESS 0x3FC88A /end MEASUREMENT
/begin MEASUREMENT lshvk_b2.st "VKAT-LSH-Status" UWORD FORMULA_0083 0 0 0.0 65535.0000 ECU_ADDRESS 0x3FC8B2 /end MEASUREMENT
/begin MEASUREMENT lshvk.freig_b1 "VKAT-LSH_FREIG" UWORD FORMULA_0937 0 0 0.0 65535.0 ECU_ADDRESS 0x3FC88A BIT_MASK 0x1 /end MEASUREMENT
/begin MEASUREMENT lshvk.freig_b2 "VKAT-LSH_FREIG" UWORD FORMULA_0937 0 0 0.0 65535.0 ECU_ADDRESS 0x3FC8B2 BIT_MASK 0x1 /end MEASUREMENT
/begin MEASUREMENT lshvk.reg_b1 "VKAT-LSH_REG" UWORD FORMULA_0938 0 0 0.0 65535.0 ECU_ADDRESS 0x3FC88A BIT_MASK 0x2 /end MEASUREMENT
/begin MEASUREMENT lshvk.reg_b2 "VKAT-LSH_REG" UWORD FORMULA_0938 0 0 0.0 65535.0 ECU_ADDRESS 0x3FC8B2 BIT_MASK 0x2 /end MEASUREMENT
/begin MEASUREMENT lshvk.temp_b1 "VKAT-LSH-TEMP" UWORD FORMULA_0939 0 0 0.0 65535.0 ECU_ADDRESS 0x3FC88A BIT_MASK 0x4 /end MEASUREMENT
/begin MEASUREMENT lshvk.temp_b2 "VKAT-LSH-TEMP" UWORD FORMULA_0939 0 0 0.0 65535.0 ECU_ADDRESS 0x3FC8B2 BIT_MASK 0x4 /end MEASUREMENT
/begin MEASUREMENT lshvk.max_temp_b1 "VKAT-LSH-MAX-TEMP" UWORD FORMULA_0940 0 0 0.0 65535.0 ECU_ADDRESS 0x3FC88A BIT_MASK 0x8 /end MEASUREMENT
/begin MEASUREMENT lshvk.max_temp_b2 "VKAT-LSH-MAX-TEMP" UWORD FORMULA_0940 0 0 0.0 65535.0 ECU_ADDRESS 0x3FC8B2 BIT_MASK 0x8 /end MEASUREMENT
/begin MEASUREMENT lshvk.min_temp_b1 "VKAT-LSH-MIN-TEMP" UWORD FORMULA_0941 0 0 0.0 65535.0 ECU_ADDRESS 0x3FC88A BIT_MASK 0x10 /end MEASUREMENT
/begin MEASUREMENT lshvk.min_temp_b2 "VKAT-LSH-MIN-TEMP" UWORD FORMULA_0941 0 0 0.0 65535.0 ECU_ADDRESS 0x3FC8B2 BIT_MASK 0x10 /end MEASUREMENT
/begin MEASUREMENT lshvk.begr_max_b1 "VKAT-LSH: MAX-Begrenzung" UWORD FORMULA_0942 0 0 0.0 65535.0 ECU_ADDRESS 0x3FC88A BIT_MASK 0x20 /end MEASUREMENT
/begin MEASUREMENT lshvk.begr_max_b2 "VKAT-LSH: MAX-Begrenzung" UWORD FORMULA_0942 0 0 0.0 65535.0 ECU_ADDRESS 0x3FC8B2 BIT_MASK 0x20 /end MEASUREMENT
/begin MEASUREMENT lshvk.begr_min_b1 "VKAT-LSH: MIN-Begrenzung" UWORD FORMULA_0943 0 0 0.0 65535.0 ECU_ADDRESS 0x3FC88A BIT_MASK 0x40 /end MEASUREMENT
/begin MEASUREMENT lshvk.begr_min_b2 "VKAT-LSH: MIN-Begrenzung" UWORD FORMULA_0943 0 0 0.0 65535.0 ECU_ADDRESS 0x3FC8B2 BIT_MASK 0x40 /end MEASUREMENT
/begin MEASUREMENT lshvk.exd_aktiv_b1 "VKAT-LSH: Tester" UWORD FORMULA_0944 0 0 0.0 65535.0 ECU_ADDRESS 0x3FC88A BIT_MASK 0x80 /end MEASUREMENT
/begin MEASUREMENT lshvk.exd_aktiv_b2 "VKAT-LSH: Tester" UWORD FORMULA_0944 0 0 0.0 65535.0 ECU_ADDRESS 0x3FC8B2 BIT_MASK 0x80 /end MEASUREMENT
/begin MEASUREMENT lshvk_b1.temp_ist_roh "ungefilterte IST-Temp. VKAT" SWORD FORMULA_0791 0 0 -50.0000 1250.0000 ECU_ADDRESS 0x3FC88C /end MEASUREMENT
/begin MEASUREMENT lshvk_b2.temp_ist_roh "ungefilterte IST-Temp. VKAT" SWORD FORMULA_0791 0 0 -50.0000 1250.0000 ECU_ADDRESS 0x3FC8B4 /end MEASUREMENT
/begin MEASUREMENT lshvk_b1.temp_ist "IST-Temp. VKAT" SWORD FORMULA_0791 0 0 -50.0000 1250.0000 ECU_ADDRESS 0x3FC88E /end MEASUREMENT
/begin MEASUREMENT lshvk_b2.temp_ist "IST-Temp. VKAT" SWORD FORMULA_0791 0 0 -50.0000 1250.0000 ECU_ADDRESS 0x3FC8B6 /end MEASUREMENT
/begin MEASUREMENT lshvk_b1.temp_heiz "IST-Temp. VKAT - Heizleistung" SWORD FORMULA_0023 0 0 -50.0000 1250.0000 ECU_ADDRESS 0x3FC890 /end MEASUREMENT
/begin MEASUREMENT lshvk_b2.temp_heiz "IST-Temp. VKAT - Heizleistung" SWORD FORMULA_0023 0 0 -50.0000 1250.0000 ECU_ADDRESS 0x3FC8B8 /end MEASUREMENT
/begin MEASUREMENT lshvk_b1.r_mess "AD-Wert/Sondenwiderstand VKAT" UWORD FORMULA_0945 0 0 0.0 5000.0000 ECU_ADDRESS 0x3FC892 /end MEASUREMENT
/begin MEASUREMENT lshvk_b2.r_mess "AD-Wert/Sondenwiderstand VKAT" UWORD FORMULA_0945 0 0 0.0 5000.0000 ECU_ADDRESS 0x3FC8BA /end MEASUREMENT
/begin MEASUREMENT lshvk_b1.r_mess_korr "korregierter gefilteter AD-Wert/Sondenwiderstand VKAT" UWORD FORMULA_0945 0 0 0.0 5000.0000 ECU_ADDRESS 0x3FC894 /end MEASUREMENT
/begin MEASUREMENT lshvk_b2.r_mess_korr "korregierter gefilteter AD-Wert/Sondenwiderstand VKAT" UWORD FORMULA_0945 0 0 0.0 5000.0000 ECU_ADDRESS 0x3FC8BC /end MEASUREMENT
/begin MEASUREMENT lshvk_b1.tabg_hys "Abgastemperatur inc. HYS-Betrachtung" SWORD FORMULA_0023 0 0 -50.0000 1250.0000 ECU_ADDRESS 0x3FC896 /end MEASUREMENT
/begin MEASUREMENT lshvk_b2.tabg_hys "Abgastemperatur inc. HYS-Betrachtung" SWORD FORMULA_0023 0 0 -50.0000 1250.0000 ECU_ADDRESS 0x3FC8BE /end MEASUREMENT
/begin MEASUREMENT lshvk_b1.temp_soll "SOLL-Temp. VKAT" SWORD FORMULA_0791 0 0 -50.0000 1250.0000 ECU_ADDRESS 0x3FC898 /end MEASUREMENT
/begin MEASUREMENT lshvk_b2.temp_soll "SOLL-Temp. VKAT" SWORD FORMULA_0791 0 0 -50.0000 1250.0000 ECU_ADDRESS 0x3FC8C0 /end MEASUREMENT
/begin MEASUREMENT lshvk_b1.temp_dif "Differenz IST-SOLL-Temp. VKAT" SWORD FORMULA_0791 0 0 -32767.0000 32767.0000 ECU_ADDRESS 0x3FC89A /end MEASUREMENT
/begin MEASUREMENT lshvk_b2.temp_dif "Differenz IST-SOLL-Temp. VKAT" SWORD FORMULA_0791 0 0 -32767.0000 32767.0000 ECU_ADDRESS 0x3FC8C2 /end MEASUREMENT
/begin MEASUREMENT lshvk_b1.tv_vorst "vorgesteuertes TV VKAT" UWORD FORMULA_0946 0 0 0.0 99.9500 ECU_ADDRESS 0x3FC89C /end MEASUREMENT
/begin MEASUREMENT lshvk_b2.tv_vorst "vorgesteuertes TV VKAT" UWORD FORMULA_0946 0 0 0.0 99.9500 ECU_ADDRESS 0x3FC8C4 /end MEASUREMENT
/begin MEASUREMENT lshvk_b1.tv_reg "hochaufgeloestes TV VKAT" UWORD FORMULA_0946 0 0 0.0 99.9500 ECU_ADDRESS 0x3FC89E /end MEASUREMENT
/begin MEASUREMENT lshvk_b2.tv_reg "hochaufgeloestes TV VKAT" UWORD FORMULA_0946 0 0 0.0 99.9500 ECU_ADDRESS 0x3FC8C6 /end MEASUREMENT
/begin MEASUREMENT lshvk_b1.tv_korr "korr. Tastverhaeltnis VKAT" UWORD FORMULA_0946 0 0 0.0 99.9500 ECU_ADDRESS 0x3FC8A0 /end MEASUREMENT
/begin MEASUREMENT lshvk_b2.tv_korr "korr. Tastverhaeltnis VKAT" UWORD FORMULA_0946 0 0 0.0 99.9500 ECU_ADDRESS 0x3FC8C8 /end MEASUREMENT
/begin MEASUREMENT lshvk_b1.tv_begr "TV-Wert aus Aenderungsbegr." UWORD FORMULA_0946 0 0 0.0 99.9500 ECU_ADDRESS 0x3FC8A2 /end MEASUREMENT
/begin MEASUREMENT lshvk_b2.tv_begr "TV-Wert aus Aenderungsbegr." UWORD FORMULA_0946 0 0 0.0 99.9500 ECU_ADDRESS 0x3FC8CA /end MEASUREMENT
/begin MEASUREMENT lshvk_b1.tv_eff_max "max. eff. Heizerspannung" UWORD FORMULA_0946 0 0 0.0 99.9500 ECU_ADDRESS 0x3FC8A4 /end MEASUREMENT
/begin MEASUREMENT lshvk_b2.tv_eff_max "max. eff. Heizerspannung" UWORD FORMULA_0946 0 0 0.0 99.9500 ECU_ADDRESS 0x3FC8CC /end MEASUREMENT
/begin MEASUREMENT lshvk_b1.tv_korr_max "Anteil des Tastverhaeltnisses ueber Aengerungsbegr." SWORD FORMULA_0946 0 0 -99.9500 99.9500 ECU_ADDRESS 0x3FC8A6 /end MEASUREMENT
/begin MEASUREMENT lshvk_b2.tv_korr_max "Anteil des Tastverhaeltnisses ueber Aengerungsbegr." SWORD FORMULA_0946 0 0 -99.9500 99.9500 ECU_ADDRESS 0x3FC8CE /end MEASUREMENT
/begin MEASUREMENT lshvk_b1.tv_add "Additiver Anteil des Tastverhaeltnisses" UWORD FORMULA_0946 0 0 0.0 3199.9511 ECU_ADDRESS 0x3FC8A8 /end MEASUREMENT
/begin MEASUREMENT lshvk_b2.tv_add "Additiver Anteil des Tastverhaeltnisses" UWORD FORMULA_0946 0 0 0.0 3199.9511 ECU_ADDRESS 0x3FC8D0 /end MEASUREMENT
/begin MEASUREMENT lshvk_b1.tv_lim "aenderungsbegr. Tastverhaeltnis VKAT" UWORD FORMULA_0946 0 0 0.0 99.9500 ECU_ADDRESS 0x3FC8AA /end MEASUREMENT
/begin MEASUREMENT lshvk_b2.tv_lim "aenderungsbegr. Tastverhaeltnis VKAT" UWORD FORMULA_0946 0 0 0.0 99.9500 ECU_ADDRESS 0x3FC8D2 /end MEASUREMENT
/begin MEASUREMENT lshvk_b1.tv_grad "pos. Aenderungsbegrenzung" SWORD FORMULA_0947 0 0 -99.9500 99.9500 ECU_ADDRESS 0x3FC8AC /end MEASUREMENT
/begin MEASUREMENT lshvk_b2.tv_grad "pos. Aenderungsbegrenzung" SWORD FORMULA_0947 0 0 -99.9500 99.9500 ECU_ADDRESS 0x3FC8D4 /end MEASUREMENT
/begin MEASUREMENT lshvk_b1.reg_t_max "Heizungsregleranschlagszeit" UWORD FORMULA_0062 0 0 0.0 65535.0000 ECU_ADDRESS 0x3FC8B0 /end MEASUREMENT
/begin MEASUREMENT lshvk_b2.reg_t_max "Heizungsregleranschlagszeit" UWORD FORMULA_0062 0 0 0.0 65535.0000 ECU_ADDRESS 0x3FC8D8 /end MEASUREMENT
/begin MEASUREMENT lshvk_status "VKAT-LSH-Zusatzstatus" UBYTE FORMULA_0003 0 0 0.0 255.0000 ECU_ADDRESS 0x3FC8DA /end MEASUREMENT
/begin MEASUREMENT lshvk_temp_filt_tau "Filterkonstante PT1" UWORD FORMULA_0755 0 0 0.0 255.9960 ECU_ADDRESS 0x3FC8DC /end MEASUREMENT
/begin MEASUREMENT lshvk_exd_timeout_b1 "KWP-Ansteuerzeit" UBYTE FORMULA_0948 0 0 0.0 25.5000 ECU_ADDRESS 0x3FC8DE /end MEASUREMENT
/begin MEASUREMENT lshvk_exd_timeout_b2 "KWP-Ansteuerzeit" UBYTE FORMULA_0948 0 0 0.0 25.5000 ECU_ADDRESS 0x3FC8DF /end MEASUREMENT
/begin MEASUREMENT lshvk_diag_i_ad_b1 "Heizerstrom VKAT" UWORD FORMULA_0936 0 0 0.0 4.7627 ECU_ADDRESS 0x3FC8E0 /end MEASUREMENT
/begin MEASUREMENT lshvk_diag_i_ad_b2 "Heizerstrom VKAT" UWORD FORMULA_0936 0 0 0.0 4.7627 ECU_ADDRESS 0x3FC8E2 /end MEASUREMENT
/begin MEASUREMENT lshvk_diag_r_b1 "Heizerwiderstand VKAT" UWORD FORMULA_0537 0 0 0.0 100.0000 ECU_ADDRESS 0x3FC8E4 /end MEASUREMENT
/begin MEASUREMENT lshvk_diag_r_b2 "Heizerwiderstand VKAT" UWORD FORMULA_0537 0 0 0.0 100.0000 ECU_ADDRESS 0x3FC8E6 /end MEASUREMENT
/begin MEASUREMENT lshvk_diag_mess_cnt_b1 "Anzahl gueltiger VKAT-R-Messungen" UWORD FORMULA_0010 0 0 0.0 65535.0000 ECU_ADDRESS 0x3FC8E8 /end MEASUREMENT
/begin MEASUREMENT lshvk_diag_mess_cnt_b2 "Anzahl gueltiger VKAT-R-Messungen" UWORD FORMULA_0010 0 0 0.0 65535.0000 ECU_ADDRESS 0x3FC8EA /end MEASUREMENT
/begin MEASUREMENT lshvk_diag_time_ml "Verzoegerungszeit - Ermittlung Heizerwiderstand" UWORD FORMULA_0021 0 0 0.0 655.3500 ECU_ADDRESS 0x3FC8EC /end MEASUREMENT
/begin MEASUREMENT lsrvk_obd_st_b1 "VKAT-Ri-OBD-Status" UWORD FORMULA_0083 0 0 0.0 65535.0000 ECU_ADDRESS 0x3FC8EE /end MEASUREMENT
/begin MEASUREMENT lsrvk_obd_st_b2 "VKAT-Ri-OBD-Status" UWORD FORMULA_0083 0 0 0.0 65535.0000 ECU_ADDRESS 0x3FC8F0 /end MEASUREMENT
/begin MEASUREMENT lsrvk_obd_aktiv_b1 "VKAT-Sondeninnenwiderstand Diagnose" UWORD FORMULA_0949 0 0 0.0 65535.0 ECU_ADDRESS 0x3FC8EE BIT_MASK 0x1 /end MEASUREMENT
/begin MEASUREMENT lsrvk_obd_aktiv_b2 "VKAT-Sondeninnenwiderstand Diagnose" UWORD FORMULA_0949 0 0 0.0 65535.0 ECU_ADDRESS 0x3FC8F0 BIT_MASK 0x1 /end MEASUREMENT
/begin MEASUREMENT lsrvk_obd_reg_b1 "Heizerregleranschlagspruefung" UWORD FORMULA_0950 0 0 0.0 65535.0 ECU_ADDRESS 0x3FC8EE BIT_MASK 0x2 /end MEASUREMENT
/begin MEASUREMENT lsrvk_obd_reg_b2 "Heizerregleranschlagspruefung" UWORD FORMULA_0950 0 0 0.0 65535.0 ECU_ADDRESS 0x3FC8F0 BIT_MASK 0x2 /end MEASUREMENT
/begin MEASUREMENT lsrvk_obd_start_b1 "Diagnose nach Motorstart" UWORD FORMULA_0951 0 0 0.0 65535.0 ECU_ADDRESS 0x3FC8EE BIT_MASK 0x4 /end MEASUREMENT
/begin MEASUREMENT lsrvk_obd_start_b2 "Diagnose nach Motorstart" UWORD FORMULA_0951 0 0 0.0 65535.0 ECU_ADDRESS 0x3FC8F0 BIT_MASK 0x4 /end MEASUREMENT
/begin MEASUREMENT lsrvk_obd_ref_b1 "Referenzwiderstandsdiagnose LSU4.9" UWORD FORMULA_0952 0 0 0.0 65535.0 ECU_ADDRESS 0x3FC8EE BIT_MASK 0x8 /end MEASUREMENT
/begin MEASUREMENT lsrvk_obd_ref_b2 "Referenzwiderstandsdiagnose LSU4.9" UWORD FORMULA_0952 0 0 0.0 65535.0 ECU_ADDRESS 0x3FC8F0 BIT_MASK 0x8 /end MEASUREMENT
/begin MEASUREMENT lsrvk_obd_tml "Verzoegerungszeit - LSHVK-Ri-Diagnose" UWORD FORMULA_0021 0 0 0.0 655.0000 ECU_ADDRESS 0x3FC8F2 /end MEASUREMENT
/begin MEASUREMENT lsrvk_obd_ref_cnt_b1 "Anzahl erfolgter LA-Ri-GAIN-Ermittlungen" UWORD FORMULA_0010 0 0 0.0 65535.0000 ECU_ADDRESS 0x3FC8F4 /end MEASUREMENT
/begin MEASUREMENT lsrvk_obd_ref_cnt_b2 "Anzahl erfolgter LA-Ri-GAIN-Ermittlungen" UWORD FORMULA_0010 0 0 0.0 65535.0000 ECU_ADDRESS 0x3FC8F6 /end MEASUREMENT
/begin MEASUREMENT lsrvk_obd_ref_offs_cnt_b1 "Anzahl erfolgter LA-Ri-OFFSET-Ermittlungen" UWORD FORMULA_0010 0 0 0.0 65535.0000 ECU_ADDRESS 0x3FC8F8 /end MEASUREMENT
/begin MEASUREMENT lsrvk_obd_ref_offs_cnt_b2 "Anzahl erfolgter LA-Ri-OFFSET-Ermittlungen" UWORD FORMULA_0010 0 0 0.0 65535.0000 ECU_ADDRESS 0x3FC8FA /end MEASUREMENT
/begin MEASUREMENT lshvk_r_ad_st_b1 "Sonden-Ri-Adation-Status" UWORD FORMULA_0083 0 0 0.0 65535.0000 ECU_ADDRESS 0x3FC8FC /end MEASUREMENT
/begin MEASUREMENT lshvk_r_ad_st_b2 "Sonden-Ri-Adation-Status" UWORD FORMULA_0083 0 0 0.0 65535.0000 ECU_ADDRESS 0x3FC8FE /end MEASUREMENT
/begin MEASUREMENT lshvk_r_ad_offs_freig_b1 "OFFSET-Sonden-Ri-Adaption FREIGABE" UWORD FORMULA_0953 0 0 0.0 65535.0 ECU_ADDRESS 0x3FC8FC BIT_MASK 0x1 /end MEASUREMENT
/begin MEASUREMENT lshvk_r_ad_offs_freig_b2 "OFFSET-Sonden-Ri-Adaption FREIGABE" UWORD FORMULA_0953 0 0 0.0 65535.0 ECU_ADDRESS 0x3FC8FE BIT_MASK 0x1 /end MEASUREMENT
/begin MEASUREMENT lshvk_r_ad_offs_st_b1 "OFFSET-Sonden-Ri-Adaption" UWORD FORMULA_0852 0 0 0.0 65535.0 ECU_ADDRESS 0x3FC8FC BIT_MASK 0x2 /end MEASUREMENT
/begin MEASUREMENT lshvk_r_ad_offs_st_b2 "OFFSET-Sonden-Ri-Adaption" UWORD FORMULA_0852 0 0 0.0 65535.0 ECU_ADDRESS 0x3FC8FE BIT_MASK 0x2 /end MEASUREMENT
/begin MEASUREMENT lshvk_r_ad_offs_filt_st_b1 "OFFSET-Ri-Filterung" UWORD FORMULA_0768 0 0 0.0 65535.0 ECU_ADDRESS 0x3FC8FC BIT_MASK 0x4 /end MEASUREMENT
/begin MEASUREMENT lshvk_r_ad_offs_filt_st_b2 "OFFSET-Ri-Filterung" UWORD FORMULA_0768 0 0 0.0 65535.0 ECU_ADDRESS 0x3FC8FE BIT_MASK 0x4 /end MEASUREMENT
/begin MEASUREMENT lshvk_r_ad_gain_freig_b1 "GAIN-Sonden-Ri-Adaption FREIGABE" UWORD FORMULA_0954 0 0 0.0 65535.0 ECU_ADDRESS 0x3FC8FC BIT_MASK 0x8 /end MEASUREMENT
/begin MEASUREMENT lshvk_r_ad_gain_freig_b2 "GAIN-Sonden-Ri-Adaption FREIGABE" UWORD FORMULA_0954 0 0 0.0 65535.0 ECU_ADDRESS 0x3FC8FE BIT_MASK 0x8 /end MEASUREMENT
/begin MEASUREMENT lshvk_r_ad_gain_st_b1 "GAIN-Sonden-Ri-Adaption" UWORD FORMULA_0770 0 0 0.0 65535.0 ECU_ADDRESS 0x3FC8FC BIT_MASK 0x10 /end MEASUREMENT
/begin MEASUREMENT lshvk_r_ad_gain_st_b2 "GAIN-Sonden-Ri-Adaption" UWORD FORMULA_0770 0 0 0.0 65535.0 ECU_ADDRESS 0x3FC8FE BIT_MASK 0x10 /end MEASUREMENT
/begin MEASUREMENT lshvk_r_ad_gain_filt_st_b1 "GAIN-Ri-Filterung" UWORD FORMULA_0771 0 0 0.0 65535.0 ECU_ADDRESS 0x3FC8FC BIT_MASK 0x20 /end MEASUREMENT
/begin MEASUREMENT lshvk_r_ad_gain_filt_st_b2 "GAIN-Ri-Filterung" UWORD FORMULA_0771 0 0 0.0 65535.0 ECU_ADDRESS 0x3FC8FE BIT_MASK 0x20 /end MEASUREMENT
/begin MEASUREMENT lshvk_r_ad_gain_erfolgt_b1 "Erfolgte GAIN-Ri-Adaption" UWORD FORMULA_0955 0 0 0.0 65535.0 ECU_ADDRESS 0x3FC8FC BIT_MASK 0x40 /end MEASUREMENT
/begin MEASUREMENT lshvk_r_ad_gain_erfolgt_b2 "Erfolgte GAIN-Ri-Adaption" UWORD FORMULA_0955 0 0 0.0 65535.0 ECU_ADDRESS 0x3FC8FE BIT_MASK 0x40 /end MEASUREMENT
/begin MEASUREMENT lshvk_r_ad_offs_erfolgt_b1 "Erfolgte OFFSET-Ri-Adaption" UWORD FORMULA_0956 0 0 0.0 65535.0 ECU_ADDRESS 0x3FC8FC BIT_MASK 0x80 /end MEASUREMENT
/begin MEASUREMENT lshvk_r_ad_offs_erfolgt_b2 "Erfolgte OFFSET-Ri-Adaption" UWORD FORMULA_0956 0 0 0.0 65535.0 ECU_ADDRESS 0x3FC8FE BIT_MASK 0x80 /end MEASUREMENT
/begin MEASUREMENT lshvk_r_ad_offs_cnt_b1 "Zahler fuer Glaettungszeit" UWORD FORMULA_0010 0 0 0.0 65535.0000 ECU_ADDRESS 0x3FC900 /end MEASUREMENT
/begin MEASUREMENT lshvk_r_ad_offs_cnt_b2 "Zahler fuer Glaettungszeit" UWORD FORMULA_0010 0 0 0.0 65535.0000 ECU_ADDRESS 0x3FC902 /end MEASUREMENT
/begin MEASUREMENT lshvk_r_ad_gain_cnt_b1 "Zahler fuer Glaettungszeit" UWORD FORMULA_0010 0 0 0.0 65535.0000 ECU_ADDRESS 0x3FC904 /end MEASUREMENT
/begin MEASUREMENT lshvk_r_ad_gain_cnt_b2 "Zahler fuer Glaettungszeit" UWORD FORMULA_0010 0 0 0.0 65535.0000 ECU_ADDRESS 0x3FC906 /end MEASUREMENT
/begin MEASUREMENT lshvk_r_ad_offs_filt_b1 "gem. AD-Wert f. OFFSET-Sonden-Ri-Adapt." SWORD FORMULA_0532 0 0 -5000.0000 5000.0000 ECU_ADDRESS 0x3FC908 /end MEASUREMENT
/begin MEASUREMENT lshvk_r_ad_offs_filt_b2 "gem. AD-Wert f. OFFSET-Sonden-Ri-Adapt." SWORD FORMULA_0532 0 0 -5000.0000 5000.0000 ECU_ADDRESS 0x3FC90A /end MEASUREMENT
/begin MEASUREMENT lshvk_r_ad_gain_filt_b1 "gem. AD-Wert f. GAIN-Sonden-Ri-Adapt." UWORD FORMULA_0532 0 0 0.0 5000.0000 ECU_ADDRESS 0x3FC90C /end MEASUREMENT
/begin MEASUREMENT lshvk_r_ad_gain_filt_b2 "gem. AD-Wert f. GAIN-Sonden-Ri-Adapt." UWORD FORMULA_0532 0 0 0.0 5000.0000 ECU_ADDRESS 0x3FC90E /end MEASUREMENT
/begin MEASUREMENT lshvk_r_ad_gain_delta_b1 "Delta-Sonden-Ri-Adaption" UWORD FORMULA_0075 0 0 0.0 4.0000 ECU_ADDRESS 0x3FC910 /end MEASUREMENT
/begin MEASUREMENT lshvk_r_ad_gain_delta_b2 "Delta-Sonden-Ri-Adaption" UWORD FORMULA_0075 0 0 0.0 4.0000 ECU_ADDRESS 0x3FC912 /end MEASUREMENT
/begin MEASUREMENT lshvk_r_ad_gain_delta_t_b1 "Delta-Zeit zwischen 2 GAIN-Adaptionen" ULONG FORMULA_0152 0 0 0.0 655.0000 ECU_ADDRESS 0x3FC914 /end MEASUREMENT
/begin MEASUREMENT lshvk_r_ad_gain_delta_t_b2 "Delta-Zeit zwischen 2 GAIN-Adaptionen" ULONG FORMULA_0152 0 0 0.0 655.0000 ECU_ADDRESS 0x3FC918 /end MEASUREMENT
/begin MEASUREMENT lshvk_r_ad_offs_delta_t_b1 "Delta-Zeit zwischen 2 OFFSET-Adaptionen" ULONG FORMULA_0152 0 0 0.0 655.0000 ECU_ADDRESS 0x3FC91C /end MEASUREMENT
/begin MEASUREMENT lshvk_r_ad_offs_delta_t_b2 "Delta-Zeit zwischen 2 OFFSET-Adaptionen" ULONG FORMULA_0152 0 0 0.0 655.0000 ECU_ADDRESS 0x3FC920 /end MEASUREMENT
/begin MEASUREMENT lsh_ub_filt "gefilterter Spannungswert U_KL87 fuer LSH" SWORD FORMULA_0008 0 0 0.0 28.0000 ECU_ADDRESS 0x3FC924 /end MEASUREMENT
/* ------------------ Abschnitt erzeugt aus pksr.dat ------------------ */
/begin CHARACTERISTIC K_PKS_OBD_SOLL_DYN_TAU "Filterkonstante fuer Kraftstoffpumpen-Solldruck | EN: Filterkonstante fuer Kraf t-stoffpumpen-Solldruck" VALUE 0x756B0 TKW_VV_VV_UB 100.0 FORMULA_0664 0.0101 2.5600 /end CHARACTERISTIC
/begin CHARACTERISTIC K_PKSR_P_SSP_SA "Kraftstoffdruck an SSPs bei SA | EN: bar 0 3 x/1000 Kraftstoffdruck an SSPs bei SA" VALUE 0x756B2 TKW_VV_VV_SW 100.0 FORMULA_0118 0.0 10.0000 FORMAT "%6.3" /end CHARACTERISTIC
/begin CHARACTERISTIC K_PKSR_PSOLL_MECH "Kraftstoffsolldruck des mechanischen Druckreglers | EN: bar 0 3 x/1000 Kraftstoffsolldruck des m e-chanischen Druckreglers" VALUE 0x756B4 TKW_VV_VV_SW 100.0 FORMULA_0118 0.0 10.0000 FORMAT "%6.3" /end CHARACTERISTIC
/begin CHARACTERISTIC K_PKSR_I_ANTEIL_MIN "I-Anteil Min-Wert | EN: % -50p 1 (X*100)/1024 I-Anteil Min-Wert" VALUE 0x756B6 TKW_VV_VV_SW 100.0 FORMULA_0840 -50.0000 50.0000 FORMAT "%4.1" /end CHARACTERISTIC
/begin CHARACTERISTIC K_PKSR_I_ANTEIL_MAX "I-Anteil Max-Wert | EN: % -50p 1 (X*100)/1024 I-Anteil Max-Wert" VALUE 0x756B8 TKW_VV_VV_SW 100.0 FORMULA_0840 -50.0000 50.0000 FORMAT "%4.1" /end CHARACTERISTIC
/begin CHARACTERISTIC K_PKSR_TMIN_EKP2 "Mindesteinschaltzeit d. EKP2 | EN: s 0p 2 X/100 Mindesteinschaltzeit d. EKP2" VALUE 0x756BA TKW_VV_VV_SW 100.0 FORMULA_0021 0.0 10.0000 FORMAT "%5.2" /end CHARACTERISTIC
/begin CHARACTERISTIC K_PKSR_N_EKP2 "Einschaltschwelle Motordrehzahl f. EKP2 | EN: Upm 0p 0 x Einschaltschwelle Motordreh-zahl f. EKP2" VALUE 0x756BC TKW_VV_VV_SW 100.0 FORMULA_0006 0.0 10000.0000 /end CHARACTERISTIC
/begin CHARACTERISTIC K_PKSR_N_HYS_EKP2 "Hysterese Motordrehzahl f. Ein-/Ausschalten der EKP2 | EN: Upm 0p 0 x Hysterese Motordrehzahl f. Ein-/Ausschalten der EKP2" VALUE 0x756BE TKW_VV_VV_SW 100.0 FORMULA_0006 0.0 10000.0000 /end CHARACTERISTIC
/begin CHARACTERISTIC K_PKSR_MLSOLL_EKP2 "Einschaltschwelle Fuellungsvorgabe f. EKP2 | EN: kg/h -100p 1 x/10 Einschaltschwelle Fuellung s-vorgabe f. EKP2" VALUE 0x756C0 TKW_VV_VV_SW 100.0 FORMULA_0112 -100.0000 1400.0000 FORMAT "%4.1" /end CHARACTERISTIC
/begin CHARACTERISTIC K_PKSR_MLSOLL_HYS_EKP2 "Hysterese Fuellungsvorgabe f. Ein-/Ausschalten der EKP2 | EN: kg/h -100p 1 x/10 Hysterese Fuellungsvorgabe f. Ein-/Ausschalten der EKP2" VALUE 0x756C2 TKW_VV_VV_SW 100.0 FORMULA_0112 -100.0000 1400.0000 FORMAT "%4.1" /end CHARACTERISTIC
/begin CHARACTERISTIC K_PKSR_CFG "Konfiguration Kraftstoffdruckregelung | EN: pksr_cfg.equ Konfiguration Kraftstoffdruc k-regelung" VALUE 0x756C4 TKW_VV_VV_UB 100.0 FORMULA_1046 0.0 255.0 /end CHARACTERISTIC
/begin CHARACTERISTIC K_PKSR_EKP_100_PSOLL_RAMPE "Delta fuer Rampe nach EKP_100Prozent auf Sollwert | EN: Delta fuer Rampe nach EKP_100Prozent auf Sollwert" VALUE 0x756C5 TKW_VV_VV_UB 100.0 FORMULA_1041 0.0 10.0000 /end CHARACTERISTIC
/begin CHARACTERISTIC K_PKSR_TV_DIAG "vorerst Ersatz f. Diagnose: auszugebender TV-Wert" VALUE 0x756C6 TKW_VV_VV_SW 100.0 FORMULA_0840 0.0 100.0000 FORMAT "%4.1" /end CHARACTERISTIC
/begin CHARACTERISTIC K_PKSR_DIAG "Diagnosebedingung f. Kraftstoffdruckregelung setzen" VALUE 0x756C8 TKW_VV_VV_UB 100.0 FORMULA_1047 0.0 255.0 /end CHARACTERISTIC
/begin CHARACTERISTIC K_PKSR_T_VORLAUF "Vorlaufzeit der EKP bei KL15 EIN | EN: Vorlaufzeit der EKP bei KL15 EIN" VALUE 0x756CA TKW_VV_VV_UW 100.0 FORMULA_0021 0.0 655.0000 FORMAT "%5.2" /end CHARACTERISTIC
/begin CHARACTERISTIC K_PKSR_T_ABST "Nachlauf nach KLA | EN: Nachlauf nach KLA" VALUE 0x756CC TKW_VV_VV_UW 100.0 FORMULA_0021 0.0 655.0000 FORMAT "%5.2" /end CHARACTERISTIC
/begin CHARACTERISTIC K_PKSR_PERIOD "Periodendauer der EKP-PWM | EN: Period of the fuel-pump PWM [ms]" VALUE 0x756CE TKW_VV_VV_UW 100.0 FORMULA_1048 1.0000 65.0000 FORMAT "%4.1" /end CHARACTERISTIC
/begin CHARACTERISTIC K_PKSR_ADAP_DELTA_OFF "PKSR-Adaptions Offset increment/decrement | EN: PKSR-Adaptions Offset i n-crement/decrement" VALUE 0x756D0 TKW_VV_VV_SW 100.0 FORMULA_0555 0.0 1.0000 FORMAT "%6.3" /end CHARACTERISTIC
/begin CHARACTERISTIC K_PKSR_ADAP_OFF_ML_MAX "ML Schwelle fuer Offset Adaption aus" VALUE 0x756D2 TKW_VV_VV_SW 100.0 FORMULA_0112 -100.0000 1400.0000 FORMAT "%4.1" /end CHARACTERISTIC
/begin CHARACTERISTIC K_PKSR_ADAP_OFF_N_MAX "n Schwelle fuer Offset Adaption aus" VALUE 0x756D4 TKW_VV_VV_SW 100.0 FORMULA_0006 0.0 10000.0000 /end CHARACTERISTIC
/begin CHARACTERISTIC K_PKSR_ADAP_OFF_N_NORM "n Normierungswert fuer Verhaeltnis" VALUE 0x756D6 TKW_VV_VV_SW 100.0 FORMULA_0006 0.0 10000.0000 /end CHARACTERISTIC
/begin CHARACTERISTIC K_PKSR_ADAP_DELTA_FAK "PKSR-Adaptionsfaktor inc/-decrement" VALUE 0x756D8 TKW_VV_VV_SW 100.0 FORMULA_1049 0.0 3.2000 FORMAT "%7.4" /end CHARACTERISTIC
/begin CHARACTERISTIC K_PKSR_ADAP_FAK_ML_MIN "ml Schwelle fuer Faktor-Adaption ein | EN: ml Schwelle fuer Faktor -Adaption ein" VALUE 0x756DA TKW_VV_VV_SW 100.0 FORMULA_0112 -100.0000 1400.0000 FORMAT "%4.1" /end CHARACTERISTIC
/begin CHARACTERISTIC K_PKSR_ADAP_FAK_N_MIN "n Schwelle fuer Faktor-Adaption ein" VALUE 0x756DC TKW_VV_VV_SW 100.0 FORMULA_0006 0.0 10000.0000 /end CHARACTERISTIC
/begin CHARACTERISTIC K_PKSR_ADAP_RESET "Reset der Adaption | EN: & 0x1 0x0 kein Reset 0x1 Reset aktiv Reset der Adaption" VALUE 0x756DE TKW_VV_VV_UB 100.0 FORMULA_1050 0.0 255.0 BIT_MASK 0x1 /end CHARACTERISTIC
/begin CHARACTERISTIC K_PKSR_ADAP_OFF_MAX "Max Adaptionsoffset | EN: Max Adaptionsoffset" VALUE 0x756E0 TKW_VV_VV_SW 100.0 FORMULA_0555 0.0 15.0000 FORMAT "%6.3" /end CHARACTERISTIC
/begin CHARACTERISTIC K_PKSR_ADAP_OFF_MIN "Min Adaptionsoffset | EN: Min Adaptionsoffset" VALUE 0x756E2 TKW_VV_VV_SW 100.0 FORMULA_0555 -15.0000 0.0 FORMAT "%6.3" /end CHARACTERISTIC
/begin CHARACTERISTIC K_PKSR_ADAP_FAK_MIN "Min Adaptionsfaktor | EN: Min Adaptionsfaktor" VALUE 0x756E4 TKW_VV_VV_UW 100.0 FORMULA_0556 0.5000 1.0000 FORMAT "%7.4" /end CHARACTERISTIC
/begin CHARACTERISTIC K_PKSR_ADAP_FAK_MAX "Max Adaptionsfaktor | EN: Max Adaptionsfaktor" VALUE 0x756E6 TKW_VV_VV_UW 100.0 FORMULA_0556 1.0000 2.0000 FORMAT "%7.4" /end CHARACTERISTIC
/begin CHARACTERISTIC K_PKSR_EXD_DELTA_TV "Schwelle fuer max. Abweichung der Vorsteuerung und Regler" VALUE 0x756E8 TKW_VV_VV_SW 100.0 FORMULA_0840 0.0 20.0000 FORMAT "%4.1" /end CHARACTERISTIC
/begin CHARACTERISTIC K_PKSR_EXD_PDELTA_DR "Schwelle fuer min. Druckanstieg Oeff.beginn und Ende" VALUE 0x756EA TKW_VV_VV_SW 100.0 FORMULA_0118 0.0 2.0000 FORMAT "%6.3" /end CHARACTERISTIC
/begin CHARACTERISTIC K_PKSR_EXD_FSTLITH_MIN "Min.Schwelle fuer Fuelstand linke Tankhaelfte zu Diagnose" VALUE 0x756EC TKW_VV_VV_UB 100.0 FORMULA_0557 0.0 100.0000 /end CHARACTERISTIC
/begin CHARACTERISTIC K_PKSR_EXD_V_SSPLITH "Schwelle SSP Delta" VALUE 0x756ED TKW_VV_VV_UB 100.0 FORMULA_0557 0.0 100.0000 /end CHARACTERISTIC
/begin CHARACTERISTIC K_PKSR_EXD_DELTA_P_VL "Schwelle Druckabfall Vorlauf" VALUE 0x756EE TKW_VV_VV_SW 100.0 FORMULA_0118 0.0 5.0000 FORMAT "%6.3" /end CHARACTERISTIC
/begin CHARACTERISTIC K_PKSR_EXD_DELTA_P_VL_FE "Schwelle Druckabfall Vorlauf im Fertigungsmode | EN: Schwelle Druckabfall Vorlauf im Fertigungsmode" VALUE 0x756F0 TKW_VV_VV_SW 100.0 FORMULA_0118 0.0 5.0000 FORMAT "%6.3" /end CHARACTERISTIC
/begin CHARACTERISTIC K_PKSR_EXD_EKP1_TV_MAX "Max. TV fuer EKP1 ohne EKP2 | EN: Max. TV fuer EKP1 ohne EKP2" VALUE 0x756F2 TKW_VV_VV_SW 100.0 FORMULA_0840 0.0 100.0000 FORMAT "%4.1" /end CHARACTERISTIC
/begin CHARACTERISTIC K_PKSR_MAX_TV_GEREGELT "Max. TV fuer geregelten Betrieb | EN: % -100p 1 (x*100)/1024 Max. TV fuer geregelten B e-trieb" VALUE 0x756F4 TKW_VV_VV_SW 100.0 FORMULA_0840 -100.0000 100.0000 FORMAT "%4.1" /end CHARACTERISTIC
/begin CHARACTERISTIC K_PKSR_EXD_TAU_PKS_PL "Filterkonstante fuer pks_rel Prueflauf" VALUE 0x756F6 TKW_VV_VV_UB 100.0 FORMULA_0664 0.0101 2.5600 /end CHARACTERISTIC
/begin CHARACTERISTIC K_PKSR_EXD_TAU_PDIF_PL "Filterkonstante fuer pksr_exd_pdif delta" VALUE 0x756F7 TKW_VV_VV_UB 100.0 FORMULA_0683 0.1004 25.6000 /end CHARACTERISTIC
/begin CHARACTERISTIC K_PKSR_EXD_PDIF_T_ADAP "Adaptionszeit Gradient Druckanstieg" VALUE 0x756F8 TKW_VV_VV_UB 100.0 FORMULA_0458 0.0 25.5000 /end CHARACTERISTIC
/begin CHARACTERISTIC K_PKSR_EXD_P_GRAD_REL "Rel. Gradientenschwelle Erkennung DR-Oeffnungsbeginn" VALUE 0x756F9 TKW_VV_VV_UB 100.0 FORMULA_1051 0.0 100.0000 /end CHARACTERISTIC
/begin CHARACTERISTIC K_PKSR_EXD_NMAX "N-MAX bei Prueflauf7 | EN: N-MAX bei Prueflauf7" VALUE 0x756FA TKW_VV_VV_SW 100.0 FORMULA_0006 0.0 10000.0000 /end CHARACTERISTIC
/begin CHARACTERISTIC K_PKSR_EKP_VORL_RESET "Reset fuer EKP Vorlaufsperre | EN: Reset fuer EKP Vorlaufsperre" VALUE 0x756FC TKW_VV_VV_UW 100.0 FORMULA_0600 0.0 120.0000 FORMAT "%5.2" /end CHARACTERISTIC
/begin CHARACTERISTIC K_PKSR_ADAP_DIAG_T "Zeit im Adationsanschlag bis Fehlereintrag | EN: Zeit im Adationsanschlag bis Fehlereintrag" VALUE 0x756FE TKW_VV_VV_UW 100.0 FORMULA_0062 0.0 120.0000 /end CHARACTERISTIC
/begin CHARACTERISTIC K_PKSR_EXD_TV_65 "TV bei fuer Ermittlung Druckabfall | EN: TV bei fuer Ermittlung Druc k-abfall" VALUE 0x75700 TKW_VV_VV_SW 100.0 FORMULA_0840 -100.0000 100.0000 FORMAT "%4.1" /end CHARACTERISTIC
/begin CHARACTERISTIC KL_PKSR_QSSP_PKS "Volumenstrom SSPs �ber Istdruck (rel.) | EN: Volume flow of jet pumps vs pressure" CURVE 0x75714 TKL_SW_VV_SW 100.0 FORMULA_0746 0.0 250.0000 /begin AXIS_DESCR STD_AXIS pks_rel FORMULA_0118 5 0.0 10.0000 FORMAT "%6.3" /end AXIS_DESCR FORMAT "%4.1" /end CHARACTERISTIC
/begin CHARACTERISTIC KL_PKSR_P_FAKTOR "P-Faktor ueber Druckabweichung | EN: P-factor vs pressure deviation (map over volume flow in V762)" CURVE 0x7572A TKL_SW_VV_UW 100.0 FORMULA_1052 0.0 500.0000
 /begin AXIS_DESCR STD_AXIS p_diff FORMULA_0118 5 -10.0000 10.0000 FORMAT "%6.3" /end AXIS_DESCR
 FORMAT "%4.1" /end CHARACTERISTIC
/begin CHARACTERISTIC KL_PKSR_I_FAKTOR "I-Faktor �ber Druckabweichung | EN: I-factor vs pressure deviation (map over volume flow in V762)" CURVE 0x75740 TKL_SW_VV_UW 100.0 FORMULA_1053 0.0 1000.0000
 /begin AXIS_DESCR STD_AXIS p_diff FORMULA_0118 5 -10.0000 10.0000 FORMAT "%6.3" /end AXIS_DESCR
 FORMAT "%4.1" /end CHARACTERISTIC
/begin CHARACTERISTIC KL_PKSR_TKSM_PSOLL "Kraftstoffsolldruck ueber Temperatur | EN: Target fuel pressure vs temperature" CURVE 0x75756 TKL_SW_VV_SW 100.0 FORMULA_0118 0.0 10.0000
 /begin AXIS_DESCR STD_AXIS tksm FORMULA_0023 4 -50.0000 170.0000 FORMAT "%4.1" /end AXIS_DESCR
 FORMAT "%6.3" /end CHARACTERISTIC
/begin CHARACTERISTIC KL_PKSR_TV_HARDWARE "Korrekturkennlinie TV f. Helbako A-Muster | EN: Correction curve duty cycle for Helbako A-sample" CURVE 0x75768 TKL_SW_VV_SW 100.0 FORMULA_0840 0.0 100.0000 /begin AXIS_DESCR STD_AXIS tv_in FORMULA_0840 2 0.0 100.0000 FORMAT "%4.1" /end AXIS_DESCR FORMAT "%4.1" /end CHARACTERISTIC
/begin CHARACTERISTIC KL_PKSR_100P_DAUER_TMOT "Dauer 100% Laufzeit bei kaltem Motor | EN: Duration of 100% run with cold engine" CURVE 0x75772 TKL_SW_VV_UW 100.0 FORMULA_0021 0.0 655.0000
 /begin AXIS_DESCR STD_AXIS tmot_start FORMULA_0023 6 -50.0000 170.0000 FORMAT "%4.1" /end AXIS_DESCR
 FORMAT "%5.2" /end CHARACTERISTIC
/begin CHARACTERISTIC KF_PKSR_PSOLL_QSOLL_TV "Tastverhaeltnis �ber Absolut-Solldruck u. Volumenstrom | EN: Duty cycle vs absolute target pressure and volume flow" MAP 0x7578C TKF_SW_SW_SW 100.0 FORMULA_0840 -100.0000 3199.9023
 /begin AXIS_DESCR STD_AXIS Volumenstrom FORMULA_0746 10 0.0 400.0000 FORMAT "%4.1" /end AXIS_DESCR
 /begin AXIS_DESCR STD_AXIS pks_soll FORMULA_0118 8 0.0 20.0000 FORMAT "%6.3" /end AXIS_DESCR
 FORMAT "%4.1" /end CHARACTERISTIC
/begin CHARACTERISTIC KF_PKSR_RF_N_PSOLL "Kraftstoffsolldruck (rel.) �ber Motorlast u. Drehzahl | EN: Target fuel pressure (relative) vs engine load and speed" MAP 0x75852 TKF_SW_SW_SW 100.0 FORMULA_0118 0.0 10.0000 /begin AXIS_DESCR STD_AXIS rf FORMULA_0007 6 0.0 2.0000 FORMAT "%6.3" /end AXIS_DESCR /begin AXIS_DESCR STD_AXIS n FORMULA_0006 8 0.0 10000.0000 /end AXIS_DESCR FORMAT "%6.3" /end CHARACTERISTIC
/begin MEASUREMENT pksr_ekp_100_rampe "Delta fuer Rampe aus 100Proz" UBYTE FORMULA_1041 0 0 0.0 25.5000 ECU_ADDRESS 0x3FCC96 /end MEASUREMENT
/begin MEASUREMENT pks_soll_dyn "Sollwert Kraftstoffdruck, gefiltert" SWORD FORMULA_0118 0 0 0.0 10.0000 ECU_ADDRESS 0x3FCC98 /end MEASUREMENT
/begin MEASUREMENT pks_soll_dyn_delta "Sollwert Kraftstoffdruck, Filter-Abweichung" SWORD FORMULA_0118 0 0 0.0 10.0000 ECU_ADDRESS 0x3FCC9A /end MEASUREMENT
/begin MEASUREMENT pks_soll_dyn_delta_max "Sollwert Kraftstoffdruck, Filter-Abweichung" SWORD FORMULA_0118 0 0 0.0 10.0000 ECU_ADDRESS 0x3FCC9C /end MEASUREMENT
/begin MEASUREMENT pks_soll "Sollwert Kraftstoffdruck, relativ" SWORD FORMULA_0118 0 0 0.0 10.0000 ECU_ADDRESS 0x3FCC9E /end MEASUREMENT
/begin MEASUREMENT pksr_tv_regler "vom PI-Regler ermitteltes TV inkl. Spgs.-Korrektur" SWORD FORMULA_0840 0 0 -100.0000 100.0000 ECU_ADDRESS 0x3FCCA0 /end MEASUREMENT
/begin MEASUREMENT pksr_tv "auszugebendes TV f. geregelte EKP" SWORD FORMULA_0840 0 0 -100.0000 100.0000 ECU_ADDRESS 0x3FCCA2 /end MEASUREMENT
/begin MEASUREMENT pksr_tv_ekp "auszugebendes TV inkl. Hardware-Anpassung" SWORD FORMULA_0840 0 0 -100.0000 100.0000 ECU_ADDRESS 0x3FCCA4 /end MEASUREMENT
/begin MEASUREMENT pksr_tv_diag "auszugebender Diagnosewert f�r Tastverhaeltnis" SWORD FORMULA_0840 0 0 -100.0000 100.0000 ECU_ADDRESS 0x3FCCA6 /end MEASUREMENT
/begin MEASUREMENT pksr_q_ssp "Volumenstrom Saugstrahlpumpen" SWORD FORMULA_0746 0 0 0.0 250.0000 ECU_ADDRESS 0x3FCCA8 /end MEASUREMENT
/begin MEASUREMENT pksr_q_ekp "Volumenstrom EKP" SWORD FORMULA_0746 0 0 0.0 250.0000 ECU_ADDRESS 0x3FCCAA /end MEASUREMENT
/begin MEASUREMENT pksr_p_anteil "P-Anteil Kraftstoffdruckregler" SWORD FORMULA_0840 0 0 -100.0000 100.0000 ECU_ADDRESS 0x3FCCAC /end MEASUREMENT
/begin MEASUREMENT pksr_i_anteil "I-Anteil Kraftstoffdruckregler" SWORD FORMULA_0840 0 0 -100.0000 100.0000 ECU_ADDRESS 0x3FCCAE /end MEASUREMENT
/begin MEASUREMENT pksr_s_anteil "Steuer-Anteil Kraftstoffdruckregler [V452 CHECK: PKSR RAM block reorganised in V452 (new ub correction of SSP flow); address not valid]" SWORD FORMULA_0840 0 0 -100.0000 100.0000 ECU_ADDRESS 0x3FCCB4 /end MEASUREMENT
/begin MEASUREMENT pksr_status "Status Kraftstoffdruckregelung [V452 CHECK: PKSR RAM block reorganised in V452 (new ub correction of SSP flow); address not valid]" UBYTE FORMULA_1042 0 0 0.0 255.0 ECU_ADDRESS 0x3FCCB6 /end MEASUREMENT
/begin MEASUREMENT pksr_ekp2_enable1 "Zuschaltbedingung1 f. EKP2 [V452 CHECK: PKSR RAM block reorganised in V452 (new ub correction of SSP flow); address not valid]" SWORD FORMULA_1043 0 0 -32768.0 32767.0 ECU_ADDRESS 0x3FCCB8 /end MEASUREMENT
/begin MEASUREMENT pksr_ekp2_enable2 "Zuschaltbedingung2 f. EKP2 [V452 CHECK: PKSR RAM block reorganised in V452 (new ub correction of SSP flow); address not valid]" SWORD FORMULA_1043 0 0 -32768.0 32767.0 ECU_ADDRESS 0x3FCCBC /end MEASUREMENT
/begin MEASUREMENT pksr_b_ekp1_diag "Diagnose EKP1 [V452 CHECK: PKSR RAM block reorganised in V452 (new ub correction of SSP flow); address not valid]" UBYTE FORMULA_0164 0 0 0.0 255.0 ECU_ADDRESS 0x3FCCC4 /end MEASUREMENT
/begin MEASUREMENT pksr_t_vorlauf "Vorlauftimer [V452 CHECK: PKSR RAM block reorganised in V452 (new ub correction of SSP flow); address not valid]" UWORD FORMULA_0021 0 0 0.0 655.0000 ECU_ADDRESS 0x3FCCC6 /end MEASUREMENT
/begin MEASUREMENT pksr_t_abst "Abstelltimer [V452 CHECK: PKSR RAM block reorganised in V452 (new ub correction of SSP flow); address not valid]" UWORD FORMULA_0021 0 0 0.0 655.0000 ECU_ADDRESS 0x3FCCC8 /end MEASUREMENT
/begin MEASUREMENT pksr_b_notlauf "Notlaufbedingung EKP [V452 CHECK: PKSR RAM block reorganised in V452 (new ub correction of SSP flow); address not valid]" UBYTE FORMULA_0164 0 0 0.0 255.0 ECU_ADDRESS 0x3FCCCA /end MEASUREMENT
/begin MEASUREMENT pksr_b_kath "Bedingung Kath-Heizen [V452 CHECK: PKSR RAM block reorganised in V452 (new ub correction of SSP flow); address not valid]" UBYTE FORMULA_0164 0 0 0.0 255.0 ECU_ADDRESS 0x3FCCCB /end MEASUREMENT
/begin MEASUREMENT pksr_adap_offset "PKSR-Adaptionsoffset [V452 CHECK: PKSR RAM block reorganised in V452 (new ub correction of SSP flow); address not valid]" SWORD FORMULA_0555 0 0 -100.0000 99.9900 ECU_ADDRESS 0x3FCCCC /end MEASUREMENT
/begin MEASUREMENT pksr_exd_delta_tv25 "Delta zwischen Vorsteuerung und geregeltem TV bei 2.5bar [V452 CHECK: PKSR RAM block reorganised in V452 (new ub correction of SSP flow); address not valid]" SWORD FORMULA_0840 0 0 -100.0000 100.0000 ECU_ADDRESS 0x3FCCCE /end MEASUREMENT
/begin MEASUREMENT pksr_exd_delta_tv55 "Delta zwischen Vorsteuerung und geregeltem TV bei 5.5bar [V452 CHECK: PKSR RAM block reorganised in V452 (new ub correction of SSP flow); address not valid]" SWORD FORMULA_0840 0 0 -100.0000 100.0000 ECU_ADDRESS 0x3FCCD0 /end MEASUREMENT
/begin MEASUREMENT pksr_exd_delta_fst_0s "Fuellstandsdelta zwischen linker und rechter Tankhaelfte bei Anfang [V452 CHECK: PKSR RAM block reorganised in V452 (new ub correction of SSP flow); address not valid]" SBYTE FORMULA_0557 0 0 -64.0000 63.5000 ECU_ADDRESS 0x3FCCD2 /end MEASUREMENT
/begin MEASUREMENT pksr_exd_fst_li_0s "Fuellstand linke Tankhaelfte bei Anfang [V452 CHECK: PKSR RAM block reorganised in V452 (new ub correction of SSP flow); address not valid]" UBYTE FORMULA_0557 0 0 0.0 127.5000 ECU_ADDRESS 0x3FCCD3 /end MEASUREMENT
/begin MEASUREMENT pksr_exd_p_oeffbeg_dr "PKS bei 0 l/h Durchfluss durch Druckregler [V452 CHECK: PKSR RAM block reorganised in V452 (new ub correction of SSP flow); address not valid]" SWORD FORMULA_0118 0 0 0.0 10.0000 ECU_ADDRESS 0x3FCCD4 /end MEASUREMENT
/begin MEASUREMENT pksr_exd_tv_oeffbeg_dr "TV bei 0 l/h Durchfluss durch Druckregler [V452 CHECK: PKSR RAM block reorganised in V452 (new ub correction of SSP flow); address not valid]" SWORD FORMULA_0840 0 0 -100.0000 100.0000 ECU_ADDRESS 0x3FCCD6 /end MEASUREMENT
/begin MEASUREMENT pksr_exd_p_max_dr "PKS bei ca. 230 l/h Durchfluss durch Druckregler [V452 CHECK: PKSR RAM block reorganised in V452 (new ub correction of SSP flow); address not valid]" SWORD FORMULA_0118 0 0 0.0 10.0000 ECU_ADDRESS 0x3FCCD8 /end MEASUREMENT
/begin MEASUREMENT pksr_exd_p_delta_dr "pksr_exd_p_max_dr - pksr_exd_p_oeffbeg_dr [V452 CHECK: PKSR RAM block reorganised in V452 (new ub correction of SSP flow); address not valid]" SWORD FORMULA_0118 0 0 0.0 10.0000 ECU_ADDRESS 0x3FCCDA /end MEASUREMENT
/begin MEASUREMENT pksr_exd_delta_fst_15s "Fuellstandsdelta zwischen linker und rechter Tankhaelfte nach 15s  [V452 CHECK: PKSR RAM block reorganised in V452 (new ub correction of SSP flow); address not valid]" SBYTE FORMULA_0557 0 0 -64.0000 63.5000 ECU_ADDRESS 0x3FCCDC /end MEASUREMENT
/begin MEASUREMENT pksr_exd_delta_ssp "pksr_exd_delta_fst_0s - pksr_exd_delta_fst_15s [V452 CHECK: PKSR RAM block reorganised in V452 (new ub correction of SSP flow); address not valid]" SBYTE FORMULA_0557 0 0 -64.0000 63.5000 ECU_ADDRESS 0x3FCCDD /end MEASUREMENT
/begin MEASUREMENT pksr_exd_pks65proz "pks_rel bei 65% TV, md_fw_rel = 0% [V452 CHECK: PKSR RAM block reorganised in V452 (new ub correction of SSP flow); address not valid]" SWORD FORMULA_0118 0 0 0.0 10.0000 ECU_ADDRESS 0x3FCCDE /end MEASUREMENT
/begin MEASUREMENT pksr_exd_pks65proz_vl "pks_rel bei 65% TV, md_fw_rel = 100% [V452 CHECK: PKSR RAM block reorganised in V452 (new ub correction of SSP flow); address not valid]" SWORD FORMULA_0118 0 0 0.0 10.0000 ECU_ADDRESS 0x3FCCE0 /end MEASUREMENT
/begin MEASUREMENT pksr_exd_delta_p_vl "pksr_exd_pks65proz - pksr_exd_pks65proz_vl [V452 CHECK: PKSR RAM block reorganised in V452 (new ub correction of SSP flow); address not valid]" SWORD FORMULA_0118 0 0 0.0 10.0000 ECU_ADDRESS 0x3FCCE2 /end MEASUREMENT
/begin MEASUREMENT pksr_exd_t "Timer Prueflauf [V452 CHECK: PKSR RAM block reorganised in V452 (new ub correction of SSP flow); address not valid]" UWORD FORMULA_0021 0 0 0.0 655.0000 ECU_ADDRESS 0x3FCCE4 /end MEASUREMENT
/begin MEASUREMENT pksr_exd_diag_st "Diagstatus Prueflauf [V452 CHECK: PKSR RAM block reorganised in V452 (new ub correction of SSP flow); address not valid]" UWORD FORMULA_1044 0 0 0.0 65535.0 ECU_ADDRESS 0x3FCCE6 /end MEASUREMENT
/begin MEASUREMENT pksr_exd_pks_fil "Kraftstoffdruck, relativ [V452 CHECK: PKSR RAM block reorganised in V452 (new ub correction of SSP flow); address not valid]" SWORD FORMULA_0118 0 0 0.0 10.0000 ECU_ADDRESS 0x3FCCE8 /end MEASUREMENT
/begin MEASUREMENT pksr_exd_pdif "Differenzdruck pks_rel [V452 CHECK: PKSR RAM block reorganised in V452 (new ub correction of SSP flow); address not valid]" SWORD FORMULA_1045 0 0 0.0 10.0000 ECU_ADDRESS 0x3FCCEA /end MEASUREMENT
/begin MEASUREMENT pksr_exd_pdif_fil "gefilterter pksr_exd_pdif [V452 CHECK: PKSR RAM block reorganised in V452 (new ub correction of SSP flow); address not valid]" SWORD FORMULA_1045 0 0 0.0 10.0000 ECU_ADDRESS 0x3FCCEC /end MEASUREMENT
/begin MEASUREMENT pksr_reg_time "Zeit im geregeltem Betrieb [V452 CHECK: PKSR RAM block reorganised in V452 (new ub correction of SSP flow); address not valid]" UWORD FORMULA_0021 0 0 0.0 655.0000 ECU_ADDRESS 0x3FCCEE /end MEASUREMENT
/begin MEASUREMENT pksr_adap_diag_t "Zeit im Adaptionsanschlag [V452 CHECK: PKSR RAM block reorganised in V452 (new ub correction of SSP flow); address not valid]" UWORD FORMULA_0062 0 0 0.0 65535.0000 ECU_ADDRESS 0x3FCCF0 /end MEASUREMENT
/* ------------------ Abschnitt erzeugt aus zwktibs.dat ------------------ */
/begin MEASUREMENT Bsdcontrol "3 Byte Schnittstelle f�r kt_ibs" UBYTE FORMULA_1241 0 0 0.0 255.0 ECU_ADDRESS 0x3FB1AC /end MEASUREMENT
/begin MEASUREMENT Bsdregadr "3 Byte Schnittstelle f�r kt_ibs" UBYTE FORMULA_0003 0 0 0.0 255.0000 ECU_ADDRESS 0x3FB1AD /end MEASUREMENT
/begin MEASUREMENT Bsddata "3 Byte Schnittstelle kt_ibs" UBYTE FORMULA_0003 0 0 0.0 255.0000 ECU_ADDRESS 0x3FB1AE /end MEASUREMENT
/begin FUNCTION KGE ""
 /begin DEF_CHARACTERISTIC KL_KGE_MIN_INTG_B1 KL_KGE_MIN_INTG_B2 KL_KGE_OZ_NIVR_KOR K_KGE_AX_BERG K_KGE_AY K_KGE_HFM_TAU K_KGE_LL_T_DELAY K_KGE_LL_T_DIAG K_KGE_OZ_NIVR_MAX K_KGE_OZ_NIVR_MIN K_KGE_PUMG_MAX K_KGE_RSTART_T K_KGE_SEG_IDX_INTG_1of2_ K_KGE_SEG_IDX_INTG_2of2_ K_KGE_TIME_ML K_KGE_TMOT K_KGE_TOEL /end DEF_CHARACTERISTIC
 /begin REF_CHARACTERISTIC /end REF_CHARACTERISTIC
 /begin IN_MEASUREMENT /end IN_MEASUREMENT
 /begin OUT_MEASUREMENT kge_ml_abs_b1 kge_ml_abs_b2 kge_ml_ac_b1 kge_ml_ac_b2 kge_ml_fil_b1 kge_ml_fil_b2 kge_ml_intg_b1 kge_ml_intg_b2 kge_ml_intg_kor_1of2_ kge_ml_intg_kor_2of2_ kge_ml_mw_intg_1of2_ kge_ml_mw_intg_2of2_ kge_status_b1 kge_status_b2 kge_time_ll_b1 kge_time_ll_b2 /end OUT_MEASUREMENT
/end FUNCTION
/begin FUNCTION KT_IBS "" /begin DEF_CHARACTERISTIC /end DEF_CHARACTERISTIC /begin REF_CHARACTERISTIC /end REF_CHARACTERISTIC /begin IN_MEASUREMENT /end IN_MEASUREMENT /begin OUT_MEASUREMENT Bsdcontrol Bsddata Bsdregadr /end OUT_MEASUREMENT /end FUNCTION
/begin FUNCTION KWP-Jobs "" /begin DEF_CHARACTERISTIC /end DEF_CHARACTERISTIC /begin REF_CHARACTERISTIC /end REF_CHARACTERISTIC /begin IN_MEASUREMENT /end IN_MEASUREMENT /begin OUT_MEASUREMENT /end OUT_MEASUREMENT /end FUNCTION
/begin FUNCTION KWP-Programmierung "" /begin DEF_CHARACTERISTIC /end DEF_CHARACTERISTIC /begin REF_CHARACTERISTIC /end REF_CHARACTERISTIC /begin IN_MEASUREMENT /end IN_MEASUREMENT /begin OUT_MEASUREMENT /end OUT_MEASUREMENT /end FUNCTION
/begin FUNCTION Katschutz ""
 /begin DEF_CHARACTERISTIC KL_KATS_LAM_I KL_KATS_MDL_LAM_OFFS KL_KATS_NKAT_LAM_OFFS KL_KATS_VKAT_LAM_OFFS K_KATS_CFG K_KATS_I_MAX K_KATS_I_MIN K_KATS_LAM_GRAD_NEG K_KATS_LAM_GRAD_POS K_KATS_LAM_MIN K_KATS_LAM_P_DELTA_MAX K_KATS_TKAT_MESS_MAX K_KATS_T_LAM_MIN K_KATS_T_MAX K_KATS_T_MAX_PST /end DEF_CHARACTERISTIC
 /begin REF_CHARACTERISTIC /end REF_CHARACTERISTIC
 /begin IN_MEASUREMENT /end IN_MEASUREMENT
 /begin OUT_MEASUREMENT kats_ausloeser_b1 kats_ausloeser_b2 kats_lam_i_b1 kats_lam_i_b2 kats_lam_min_t_1of2_ kats_lam_min_t_2of2_ kats_lam_p_b1 kats_lam_p_b2 kats_lam_p_delta_max_b1 kats_lam_p_delta_max_b2 kats_lam_p_max_b1 kats_lam_p_max_b2 kats_lam_soll_b1 kats_lam_soll_b2 kats_lam_soll_roh_b1 kats_lam_soll_roh_b2 kats_mdl_lam_offs_b1 kats_mdl_lam_offs_b2 kats_nkat_lam_offs_b1 kats_nkat_lam_offs_b2 kats_st_b1 kats_st_b2 kats_vkat_lam_offs_b1 kats_vkat_lam_offs_b2 /end OUT_MEASUREMENT
/end FUNCTION
/begin FUNCTION Kraftstoffdruckregelung ""
 /begin DEF_CHARACTERISTIC KF_PKSR_PSOLL_QSOLL_TV KF_PKSR_RF_N_PSOLL KL_PKSR_100P_DAUER_TMOT KL_PKSR_I_FAKTOR KL_PKSR_P_FAKTOR KL_PKSR_QSSP_PKS KL_PKSR_TKSM_PSOLL KL_PKSR_TV_HARDWARE K_PKSR_ADAP_DELTA_FAK K_PKSR_ADAP_DELTA_OFF K_PKSR_ADAP_DIAG_T K_PKSR_ADAP_FAK_MAX K_PKSR_ADAP_FAK_MIN K_PKSR_ADAP_FAK_ML_MIN K_PKSR_ADAP_FAK_N_MIN K_PKSR_ADAP_OFF_MAX K_PKSR_ADAP_OFF_MIN K_PKSR_ADAP_OFF_ML_MAX K_PKSR_ADAP_OFF_N_MAX K_PKSR_ADAP_OFF_N_NORM K_PKSR_ADAP_RESET K_PKSR_CFG K_PKSR_DIAG K_PKSR_EKP_100_PSOLL_RAMPE K_PKSR_EKP_VORL_RESET K_PKSR_EXD_DELTA_P_VL K_PKSR_EXD_DELTA_P_VL_FE K_PKSR_EXD_DELTA_TV K_PKSR_EXD_EKP1_TV_MAX K_PKSR_EXD_FSTLITH_MIN K_PKSR_EXD_NMAX K_PKSR_EXD_PDELTA_DR K_PKSR_EXD_PDIF_T_ADAP K_PKSR_EXD_P_GRAD_REL K_PKSR_EXD_TAU_PDIF_PL K_PKSR_EXD_TAU_PKS_PL K_PKSR_EXD_TV_65 K_PKSR_EXD_V_SSPLITH K_PKSR_I_ANTEIL_MAX K_PKSR_I_ANTEIL_MIN K_PKSR_MAX_TV_GEREGELT K_PKSR_MLSOLL_EKP2 K_PKSR_MLSOLL_HYS_EKP2 K_PKSR_N_EKP2 K_PKSR_N_HYS_EKP2 K_PKSR_PERIOD K_PKSR_PSOLL_MECH K_PKSR_P_SSP_SA K_PKSR_TMIN_EKP2 K_PKSR_TV_DIAG K_PKSR_T_ABST K_PKSR_T_VORLAUF K_PKS_OBD_SOLL_DYN_TAU /end DEF_CHARACTERISTIC
 /begin REF_CHARACTERISTIC /end REF_CHARACTERISTIC
 /begin IN_MEASUREMENT /end IN_MEASUREMENT
 /begin OUT_MEASUREMENT pks_soll pks_soll_dyn pks_soll_dyn_delta pks_soll_dyn_delta_max pksr_adap_diag_t pksr_adap_offset pksr_b_ekp1_diag pksr_b_kath pksr_b_notlauf pksr_ekp2_enable1 pksr_ekp2_enable2 pksr_ekp_100_rampe pksr_exd_delta_fst_0s pksr_exd_delta_fst_15s pksr_exd_delta_p_vl pksr_exd_delta_ssp pksr_exd_delta_tv25 pksr_exd_delta_tv55 pksr_exd_diag_st pksr_exd_fst_li_0s pksr_exd_p_delta_dr pksr_exd_p_max_dr pksr_exd_p_oeffbeg_dr pksr_exd_pdif pksr_exd_pdif_fil pksr_exd_pks65proz pksr_exd_pks65proz_vl pksr_exd_pks_fil pksr_exd_t pksr_exd_tv_oeffbeg_dr pksr_i_anteil pksr_p_anteil pksr_q_ekp pksr_q_ssp pksr_reg_time pksr_s_anteil pksr_status pksr_t_abst pksr_t_vorlauf pksr_tv pksr_tv_diag pksr_tv_ekp pksr_tv_regler /end OUT_MEASUREMENT
/end FUNCTION
/begin FUNCTION Kurbelwelle ""
 /begin DEF_CHARACTERISTIC K_KW_ED_DELTA_N K_KW_ED_DELTA_N_RATE K_KW_ED_DELTA_U K_KW_ED_MAX_RATE K_KW_ED_N_DROP K_KW_ED_N_DROP_RATE K_KW_ED_SH_TO_GND_RATE K_KW_ED_SH_TO_UB_RATE /end DEF_CHARACTERISTIC
 /begin REF_CHARACTERISTIC /end REF_CHARACTERISTIC
 /begin IN_MEASUREMENT /end IN_MEASUREMENT
 /begin OUT_MEASUREMENT kw_ed_delta_n_rate kw_ed_n_drop_rate kw_ed_sh_to_gnd_rate kw_ed_sh_to_ub_rate /end OUT_MEASUREMENT
/end FUNCTION
/begin FUNCTION LAVK-OBD ""
 /begin DEF_CHARACTERISTIC KL_KSD_OBD_OEL_DEC KL_KSD_OBD_OEL_INC K_KSD_OBD_CFG K_KSD_OBD_DIAG_T K_KSD_OBD_LL_LAM_MAX K_KSD_OBD_LL_LAM_MIN K_KSD_OBD_LL_MAX_T K_KSD_OBD_LL_MIN_T K_KSD_OBD_N_MAX K_KSD_OBD_N_MIN K_KSD_OBD_OEL_SPERR_MAX K_KSD_OBD_PUMG_MIN K_KSD_OBD_RF_MAX K_KSD_OBD_RF_MIN K_KSD_OBD_TAN K_KSD_OBD_TL_LAM_MAX K_KSD_OBD_TL_LAM_MIN K_KSD_OBD_TL_MAX_T K_KSD_OBD_TL_MIN_T K_KSD_OBD_TMOT_MIN K_KSD_OBD_T_ML K_KSD_OBD_V K_LAVK_OBD_ACT_CFG K_LAVK_OBD_ACT_EXD_N_SOLL K_LAVK_OBD_ACT_EXD_TIME K_LAVK_OBD_ACT_F_T K_LAVK_OBD_ACT_LAM_IST_F K_LAVK_OBD_ACT_LAM_IST_M K_LAVK_OBD_ACT_LAM_SOLL_F K_LAVK_OBD_ACT_LAM_SOLL_M K_LAVK_OBD_ACT_LANK_F K_LAVK_OBD_ACT_LANK_M K_LAVK_OBD_ACT_ML_SUM K_LAVK_OBD_ACT_M_T K_LAVK_OBD_ACT_NK_F_CNT K_LAVK_OBD_ACT_NK_M_CNT K_LAVK_OBD_ACT_N_MAX K_LAVK_OBD_ACT_N_MIN K_LAVK_OBD_ACT_RF_MAX K_LAVK_OBD_ACT_RF_MIN K_LAVK_OBD_ACT_TKAT K_LAVK_OBD_ACT_TRIM_F K_LAVK_OBD_ACT_TRIM_M K_LAVK_OBD_ACT_VK_F_CNT K_LAVK_OBD_ACT_VK_M_CNT K_LAVK_OBD_PLAU_CFG K_LAVK_OBD_PLAU_F_CNT K_LAVK_OBD_PLAU_IP_N_MAX K_LAVK_OBD_PLAU_IP_N_MIN K_LAVK_OBD_PLAU_IP_REG_MAX K_LAVK_OBD_PLAU_IP_REG_MIN K_LAVK_OBD_PLAU_IP_STABIL_T K_LAVK_OBD_PLAU_LAM_FETT K_LAVK_OBD_PLAU_LAM_MAGER K_LAVK_OBD_PLAU_LAM_MAX K_LAVK_OBD_PLAU_LAM_MIN K_LAVK_OBD_PLAU_LANK_MAX K_LAVK_OBD_PLAU_LANK_MIN K_LAVK_OBD_PLAU_ML_SUM K_LAVK_OBD_PLAU_M_CNT K_LAVK_OBD_PLAU_OL_CNT K_LAVK_OBD_PLAU_RF_MAX K_LAVK_OBD_PLAU_RF_MIN K_LAVK_OBD_PLAU_T K_LAVK_OBD_PLAU_TKAT_MAX K_LAVK_OBD_PLAU_TKAT_MIN K_LAVK_OBD_PLAU_UN_OSZI_OFF K_LAVK_OBD_PLAU_UN_SCHW K_LAVK_OBD_SA_CFG K_LAVK_OBD_SA_CNT K_LAVK_OBD_SA_DIAG_OL K_LAVK_OBD_SA_ML_SUM K_LAVK_OBD_SA_SCHW K_LAVK_OBD_SA_T K_LAVK_OBD_TL_CFG K_LAVK_OBD_TL_CNT K_LAVK_OBD_TL_ML_SUM K_LAVK_OBD_TL_SCHW_MAX K_LAVK_OBD_TL_SCHW_MIN K_LAVK_OBD_TL_T K_LAVK_OBD_TMOT K_LAVK_OBD_VK_TEMP K_LA_OBD_DYN_CNT_INC K_LA_OBD_DYN_DELTA_CNT K_LA_OBD_DYN_DELTA_PUMP_RF K_LA_OBD_DYN_DELTA_RF K_LA_OBD_DYN_RF_T /end DEF_CHARACTERISTIC
 /begin REF_CHARACTERISTIC /end REF_CHARACTERISTIC
 /begin IN_MEASUREMENT /end IN_MEASUREMENT
 /begin OUT_MEASUREMENT ksd_obd_diag_t_b1 ksd_obd_diag_t_b2 ksd_obd_diag_time_b1 ksd_obd_diag_time_b2 ksd_obd_f_rel_b1 ksd_obd_f_rel_b2 ksd_obd_freig_aktiv_b1 ksd_obd_freig_aktiv_b2 ksd_obd_laa_f_b1 ksd_obd_laa_f_b2 ksd_obd_laa_offs_b1 ksd_obd_laa_offs_b2 ksd_obd_lam_b1 ksd_obd_lam_b2 ksd_obd_ll_max_t_b1 ksd_obd_ll_max_t_b2 ksd_obd_ll_min_t_b1 ksd_obd_ll_min_t_b2 ksd_obd_oel_sperr_b1 ksd_obd_oel_sperr_b2 ksd_obd_offs_delta_b1 ksd_obd_offs_delta_b2 ksd_obd_offs_rel_b1 ksd_obd_offs_rel_b2 ksd_obd_st_b1 ksd_obd_st_b2 ksd_obd_start_b1 ksd_obd_start_b2 ksd_obd_stop_b1 ksd_obd_stop_b2 ksd_obd_tl_max_t_b1 ksd_obd_tl_max_t_b2 ksd_obd_tl_min_t_b1 ksd_obd_tl_min_t_b2 lavk_diag_ia_sa_openload_b1 lavk_diag_ia_sa_openload_b2 lavk_diag_ip_dynamik_check_b1 lavk_diag_ip_dynamik_check_b2 lavk_diag_ip_plau_openload_b1 lavk_diag_ip_plau_openload_b2 lavk_diag_ip_sa_openload_b1 lavk_diag_ip_sa_openload_b2 lavk_diag_ip_vm_sa_openload_b1 lavk_diag_ip_vm_sa_openload_b2 lavk_diag_st_b1 lavk_diag_st_b2 lavk_diag_un_plau_openload_b1 lavk_diag_un_plau_openload_b2 lavk_obd_act_aktiv_b1 lavk_obd_act_aktiv_b2 lavk_obd_act_anf_b1 lavk_obd_act_anf_b2 lavk_obd_act_ende_b1 lavk_obd_act_ende_b2 lavk_obd_act_exd_time_b1 lavk_obd_act_exd_time_b2 lavk_obd_act_fett_anf_b1 lavk_obd_act_fett_anf_b2 lavk_obd_act_fett_b1 lavk_obd_act_fett_b2 lavk_obd_act_mager_anf_b1 lavk_obd_act_mager_anf_b2 lavk_obd_act_mager_b1 lavk_obd_act_mager_b2 lavk_obd_act_nk_f_cnt_b1 lavk_obd_act_nk_f_cnt_b2 lavk_obd_act_nk_m_cnt_b1 lavk_obd_act_nk_m_cnt_b2 lavk_obd_act_nkat_f_io_b1 lavk_obd_act_nkat_f_io_b2 lavk_obd_act_nkat_f_nio_b1 lavk_obd_act_nkat_f_nio_b2 lavk_obd_act_nkat_m_io_b1 lavk_obd_act_nkat_m_io_b2 lavk_obd_act_nkat_m_nio_b1 lavk_obd_act_nkat_m_nio_b2 lavk_obd_act_st_b1 lavk_obd_act_st_b2 lavk_obd_act_verz_t_b1 lavk_obd_act_verz_t_b2 lavk_obd_act_vk_f_cnt_b1 lavk_obd_act_vk_f_cnt_b2 lavk_obd_act_vk_m_cnt_b1 lavk_obd_act_vk_m_cnt_b2 lavk_obd_act_vkat_f_io_b1 lavk_obd_act_vkat_f_io_b2 lavk_obd_act_vkat_f_nio_b1 lavk_obd_act_vkat_f_nio_b2 lavk_obd_act_vkat_m_io_b1 lavk_obd_act_vkat_m_io_b2 lavk_obd_act_vkat_m_nio_b1 lavk_obd_act_vkat_m_nio_b2 lavk_obd_plau_f_cnt_b1 lavk_obd_plau_f_cnt_b2 lavk_obd_plau_ip_stabil_t_b1 lavk_obd_plau_ip_stabil_t_b2 lavk_obd_plau_m_cnt_b1 lavk_obd_plau_m_cnt_b2 lavk_obd_plau_ol_cnt_b1 lavk_obd_plau_ol_cnt_b2 lavk_obd_plau_oszi_off_b1 lavk_obd_plau_oszi_off_b2 lavk_obd_plau_oszi_off_st_b1 lavk_obd_plau_oszi_off_st_b2 lavk_obd_plau_st_b1 lavk_obd_plau_st_b2 lavk_obd_plau_status_b1 lavk_obd_plau_status_b2 lavk_obd_plau_t_b1 lavk_obd_plau_t_b2 lavk_obd_plau_un_ol_diag_b1 lavk_obd_plau_un_ol_diag_b2 lavk_obd_sa_cnt_b1 lavk_obd_sa_cnt_b2 lavk_obd_sa_st_b1 lavk_obd_sa_st_b2 lavk_obd_sa_t_b1 lavk_obd_sa_t_b2 lavk_obd_tl_cnt_b1 lavk_obd_tl_cnt_b2 lavk_obd_tl_st_b1 lavk_obd_tl_st_b2 lavk_obd_tl_t_b1 lavk_obd_tl_t_b2 /end OUT_MEASUREMENT
/end FUNCTION
/begin FUNCTION LSHNK ""
 /begin DEF_CHARACTERISTIC KF_LSHVK_TEMP_SOLL KF_LSHVK_TV_KORR_MAX KF_LSHVK_TV_VORST KL_LSHNK_RF_AUS KL_LSHNK_SOND_TEMP KL_LSHNK_TA KL_LSHNK_T_EIN KL_LSHVK_DIAG_TIME_ML KL_LSHVK_R_MESS_F KL_LSHVK_R_MESS_OFFS KL_LSHVK_SOND_TEMP KL_LSHVK_TEMP_IST_HIGH KL_LSHVK_TEMP_IST_LOW KL_LSHVK_TEMP_SOLL_MS KL_LSHVK_UEFF_MAX KL_LSRVK_OBD_START_TML KL_LSRVK_OBD_TML K_LSHNK_AKTIV_T K_LSHNK_DIAG_CFG K_LSHNK_DIAG_RO K_LSHNK_DIAG_RU K_LSHNK_DIAG_R_TAU K_LSHNK_DIAG_TAUP_T K_LSHNK_RF_HYS K_LSHNK_TAUP K_LSHNK_TA_MAX K_LSHNK_TKAT_MAX K_LSHNK_UB_MAX K_LSHVK_AD_TEST K_LSHVK_CFG K_LSHVK_DIAG_ANZ_MESS K_LSHVK_DIAG_CFG K_LSHVK_DIAG_RO K_LSHVK_DIAG_RU K_LSHVK_DIAG_R_ADAPT K_LSHVK_DIAG_R_OFFSET K_LSHVK_DIAG_R_TAU K_LSHVK_DIAG_TEMP_IST_MAX K_LSHVK_DIAG_TEMP_IST_MIN K_LSHVK_REG_K K_LSHVK_REG_TN K_LSHVK_RI_RANGE_SCHW K_LSHVK_R_AD_GAIN_CNT K_LSHVK_R_AD_GAIN_CNT_MIN K_LSHVK_R_AD_GAIN_GRAD K_LSHVK_R_AD_GAIN_MAX K_LSHVK_R_AD_GAIN_MIN K_LSHVK_R_AD_GAIN_NV_MAX K_LSHVK_R_AD_GAIN_NV_MIN K_LSHVK_R_AD_GAIN_T K_LSHVK_R_AD_GAIN_T1 K_LSHVK_R_AD_OFFS_CNT K_LSHVK_R_AD_OFFS_CNT_MIN K_LSHVK_R_AD_OFFS_GRAD K_LSHVK_R_AD_OFFS_MAX K_LSHVK_R_AD_OFFS_MIN K_LSHVK_R_AD_OFFS_NV_MAX K_LSHVK_R_AD_OFFS_NV_MIN K_LSHVK_R_AD_OFFS_T K_LSHVK_R_AD_OFFS_T1 K_LSHVK_R_AD_RESET K_LSHVK_R_REF K_LSHVK_R_REF_OFFS K_LSHVK_TABG_HYS K_LSHVK_TEMP_DIF_ZUL K_LSHVK_TEMP_FILT_TAU K_LSHVK_TEMP_IST_ENABLE_IP_LOOP K_LSHVK_TEMP_IST_SCHW K_LSHVK_TEMP_MAX K_LSHVK_TEMP_MIN K_LSHVK_TEMP_REG_MIN K_LSHVK_TV_KORR_MIN K_LSHVK_T_KL15_MAX K_LSHVK_UB_MAX K_LSHVK_UB_NORM K_LSHVK_UEFF_GRAD K_LSHVK_WSS_CFG K_LSH_UB_TAU K_LSRVK_OBD_CFG K_LSRVK_OBD_ML_SUM K_LSRVK_OBD_REF_CNT K_LSRVK_OBD_REF_GAIN_MAX K_LSRVK_OBD_REF_GAIN_MIN K_LSRVK_OBD_REF_OFFS_CNT K_LSRVK_OBD_REF_OFFS_MAX K_LSRVK_OBD_REF_OFFS_MIN K_LSRVK_OBD_REG_T K_LSRVK_OBD_START_R K_LSRVK_OBD_TKAT_MAX K_LSRVK_OBD_TKAT_MIN /end DEF_CHARACTERISTIC
 /begin REF_CHARACTERISTIC /end REF_CHARACTERISTIC
 /begin IN_MEASUREMENT /end IN_MEASUREMENT
 /begin OUT_MEASUREMENT lsh_ub_filt lshnk.ein_b1 lshnk.ein_b2 lshnk.exd_aktiv_b1 lshnk.exd_aktiv_b2 lshnk.taup_b1 lshnk.taup_b2 lshnk_b1.st lshnk_b1.ta lshnk_b1.temp lshnk_b2.st lshnk_b2.ta lshnk_b2.temp lshnk_diag.aktiv_b1 lshnk_diag.aktiv_b2 lshnk_diag.info_b1 lshnk_diag.info_b2 lshnk_diag.sh_to_x_sperren_b1 lshnk_diag.sh_to_x_sperren_b2 lshnk_diag_b1.i_ad lshnk_diag_b1.i_cnt lshnk_diag_b1.i_sum lshnk_diag_b1.i_wert lshnk_diag_b1.r lshnk_diag_b1.st lshnk_diag_b2.i_ad lshnk_diag_b2.i_cnt lshnk_diag_b2.i_sum lshnk_diag_b2.i_wert lshnk_diag_b2.r lshnk_diag_b2.st lshnk_exd_timeout_b1 lshnk_exd_timeout_b2 lshnk_rf_aus lshnk_t_ein lshvk.begr_max_b1 lshvk.begr_max_b2 lshvk.begr_min_b1 lshvk.begr_min_b2 lshvk.exd_aktiv_b1 lshvk.exd_aktiv_b2 lshvk.freig_b1 lshvk.freig_b2 lshvk.max_temp_b1 lshvk.max_temp_b2 lshvk.min_temp_b1 lshvk.min_temp_b2 lshvk.reg_b1 lshvk.reg_b2 lshvk.temp_b1 lshvk.temp_b2 lshvk_b1.r_mess lshvk_b1.r_mess_korr lshvk_b1.reg_t_max lshvk_b1.st lshvk_b1.tabg_hys lshvk_b1.temp_dif lshvk_b1.temp_heiz lshvk_b1.temp_ist lshvk_b1.temp_ist_roh lshvk_b1.temp_soll lshvk_b1.tv_add lshvk_b1.tv_begr lshvk_b1.tv_eff_max lshvk_b1.tv_grad lshvk_b1.tv_korr lshvk_b1.tv_korr_max lshvk_b1.tv_lim lshvk_b1.tv_reg lshvk_b1.tv_vorst lshvk_b2.r_mess lshvk_b2.r_mess_korr lshvk_b2.reg_t_max lshvk_b2.st lshvk_b2.tabg_hys lshvk_b2.temp_dif lshvk_b2.temp_heiz lshvk_b2.temp_ist lshvk_b2.temp_ist_roh lshvk_b2.temp_soll lshvk_b2.tv_add lshvk_b2.tv_begr lshvk_b2.tv_eff_max lshvk_b2.tv_grad lshvk_b2.tv_korr lshvk_b2.tv_korr_max lshvk_b2.tv_lim lshvk_b2.tv_reg lshvk_b2.tv_vorst lshvk_diag_i_ad_b1 lshvk_diag_i_ad_b2 lshvk_diag_mess_cnt_b1 lshvk_diag_mess_cnt_b2 lshvk_diag_r_b1 lshvk_diag_r_b2 lshvk_diag_time_ml lshvk_exd_timeout_b1 lshvk_exd_timeout_b2 lshvk_r_ad_gain_cnt_b1 lshvk_r_ad_gain_cnt_b2 lshvk_r_ad_gain_delta_b1 lshvk_r_ad_gain_delta_b2 lshvk_r_ad_gain_delta_t_b1 lshvk_r_ad_gain_delta_t_b2 lshvk_r_ad_gain_erfolgt_b1 lshvk_r_ad_gain_erfolgt_b2 lshvk_r_ad_gain_filt_b1 lshvk_r_ad_gain_filt_b2 lshvk_r_ad_gain_filt_st_b1 lshvk_r_ad_gain_filt_st_b2 lshvk_r_ad_gain_freig_b1 lshvk_r_ad_gain_freig_b2 lshvk_r_ad_gain_st_b1 lshvk_r_ad_gain_st_b2 lshvk_r_ad_offs_cnt_b1 lshvk_r_ad_offs_cnt_b2 lshvk_r_ad_offs_delta_t_b1 lshvk_r_ad_offs_delta_t_b2 lshvk_r_ad_offs_erfolgt_b1 lshvk_r_ad_offs_erfolgt_b2 lshvk_r_ad_offs_filt_b1 lshvk_r_ad_offs_filt_b2 lshvk_r_ad_offs_filt_st_b1 lshvk_r_ad_offs_filt_st_b2 lshvk_r_ad_offs_freig_b1 lshvk_r_ad_offs_freig_b2 lshvk_r_ad_offs_st_b1 lshvk_r_ad_offs_st_b2 lshvk_r_ad_st_b1 lshvk_r_ad_st_b2 lshvk_status lshvk_temp_filt_tau lsrvk_obd_aktiv_b1 lsrvk_obd_aktiv_b2 lsrvk_obd_ref_b1 lsrvk_obd_ref_b2 lsrvk_obd_ref_cnt_b1 lsrvk_obd_ref_cnt_b2 lsrvk_obd_ref_offs_cnt_b1 lsrvk_obd_ref_offs_cnt_b2 lsrvk_obd_reg_b1 lsrvk_obd_reg_b2 lsrvk_obd_st_b1 lsrvk_obd_st_b2 lsrvk_obd_start_b1 lsrvk_obd_start_b2 lsrvk_obd_tml /end OUT_MEASUREMENT
/end FUNCTION
/begin RECORD_LAYOUT TKW_VV_VV_UB FNC_VALUES 1 UBYTE COLUMN_DIR DIRECT /end RECORD_LAYOUT
/begin RECORD_LAYOUT TKW_VV_VV_UW FNC_VALUES 1 UWORD COLUMN_DIR DIRECT /end RECORD_LAYOUT
/begin RECORD_LAYOUT TKW_VV_VV_SW FNC_VALUES 1 SWORD COLUMN_DIR DIRECT /end RECORD_LAYOUT
/begin RECORD_LAYOUT TKL_UW_VV_UW NO_AXIS_PTS_X 1 UBYTE RESERVED 2 BYTE AXIS_PTS_X 3 UWORD INDEX_INCR DIRECT FNC_VALUES 4 UWORD COLUMN_DIR DIRECT /end RECORD_LAYOUT
/begin RECORD_LAYOUT TKL_UW_VV_SW NO_AXIS_PTS_X 1 UBYTE RESERVED 2 BYTE AXIS_PTS_X 3 UWORD INDEX_INCR DIRECT FNC_VALUES 4 SWORD COLUMN_DIR DIRECT /end RECORD_LAYOUT
/begin RECORD_LAYOUT TKL_SW_VV_UB NO_AXIS_PTS_X 1 UBYTE RESERVED 2 BYTE AXIS_PTS_X 3 SWORD INDEX_INCR DIRECT FNC_VALUES 4 UBYTE COLUMN_DIR DIRECT /end RECORD_LAYOUT
/begin RECORD_LAYOUT TKL_SW_VV_UW NO_AXIS_PTS_X 1 UBYTE RESERVED 2 BYTE AXIS_PTS_X 3 SWORD INDEX_INCR DIRECT FNC_VALUES 4 UWORD COLUMN_DIR DIRECT /end RECORD_LAYOUT
/begin RECORD_LAYOUT TKL_SW_VV_SW NO_AXIS_PTS_X 1 UBYTE RESERVED 2 BYTE AXIS_PTS_X 3 SWORD INDEX_INCR DIRECT FNC_VALUES 4 SWORD COLUMN_DIR DIRECT /end RECORD_LAYOUT
/begin RECORD_LAYOUT TKF_SW_SW_UW NO_AXIS_PTS_X 1 UBYTE NO_AXIS_PTS_Y 2 UBYTE AXIS_PTS_X 3 SWORD INDEX_INCR DIRECT AXIS_PTS_Y 4 SWORD INDEX_INCR DIRECT FNC_VALUES 5 UWORD COLUMN_DIR DIRECT /end RECORD_LAYOUT
/begin RECORD_LAYOUT TKF_SW_SW_SW NO_AXIS_PTS_X 1 UBYTE NO_AXIS_PTS_Y 2 UBYTE AXIS_PTS_X 3 SWORD INDEX_INCR DIRECT AXIS_PTS_Y 4 SWORD INDEX_INCR DIRECT FNC_VALUES 5 SWORD COLUMN_DIR DIRECT /end RECORD_LAYOUT
/end MODULE
/end PROJECT
