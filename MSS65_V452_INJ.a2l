/begin PROJECT MSS65-inj-V452 "MSS65 INJ - V452.01-B204.00, data set 0569Q60Z160E"
/begin HEADER "" VERSION "V452.01-B204.00" /end HEADER
/begin MODULE _MSS65-inj "MSS65 INJ - V452.01-B204.00, calibration xxxxxxxx"
/begin MOD_COMMON "" BYTE_ORDER MSB_FIRST /* Default byteorder (Motorola) */ /end MOD_COMMON
/begin COMPU_METHOD FORMULA_0003 "FORMULA_0003" RAT_FUNC "%3.0" "-" COEFFS 0 1 0 0 0 1 /end COMPU_METHOD
/begin COMPU_METHOD FORMULA_0010 "FORMULA_0010" RAT_FUNC "%5.0" "-" COEFFS 0 1 0 0 0 1 /end COMPU_METHOD
/begin COMPU_METHOD FORMULA_0079 "FORMULA_0079" RAT_FUNC "%6.1" "l" COEFFS 0 2 0 0 0 1 /end COMPU_METHOD
/begin CHARACTERISTIC K_ED_FST_MAX "Maximaler Tankfuellstand" VALUE 0x71FB4 TKW_VV_VV_UW 100.0 FORMULA_0079 0.0 32767.5000 FORMAT "%4.1" /end CHARACTERISTIC
/begin CHARACTERISTIC K_ED_HFM1.P_CODE_SH_TO_UB "P-Code fuer die Art SH_TO_UB | EN: Fault code HFM1 - OBD P-code reported for short to battery voltage" VALUE 0x7090A TKW_VV_VV_UW 100.0 FORMULA_0010 0.0 65535.0000 /end CHARACTERISTIC
/begin CHARACTERISTIC K_ED_HFM2.P_CODE_SH_TO_UB "P-Code fuer die Art SH_TO_UB | EN: Fault code HFM2 - OBD P-code reported for short to battery voltage" VALUE 0x70924 TKW_VV_VV_UW 100.0 FORMULA_0010 0.0 65535.0000 /end CHARACTERISTIC
/begin CHARACTERISTIC K_ED_LAVK1.P_CODE_SH_TO_UB "P-Code fuer die Art SH_TO_UB | EN: Fault code LAVK1 - OBD P-code reported for short to battery voltage" VALUE 0x70ADE TKW_VV_VV_UW 100.0 FORMULA_0010 0.0 65535.0000 /end CHARACTERISTIC
/begin CHARACTERISTIC K_ED_LAVK1_OBD_PLAU.P_CODE_SH_TO_UB "P-Code fuer die Art SH_TO_UB | EN: Fault code LAVK1_OBD_PLAU - OBD P-code reported for short to battery voltage" VALUE 0x70B12 TKW_VV_VV_UW 100.0 FORMULA_0010 0.0 65535.0000 /end CHARACTERISTIC
/begin CHARACTERISTIC K_ED_LAVK1_OBD_SA.P_CODE_SH_TO_UB "P-Code fuer die Art SH_TO_UB | EN: Fault code LAVK1_OBD_SA - OBD P-code reported for short to battery voltage" VALUE 0x70B46 TKW_VV_VV_UW 100.0 FORMULA_0010 0.0 65535.0000 /end CHARACTERISTIC
/begin CHARACTERISTIC K_ED_LANK1.P_CODE_SH_TO_UB "P-Code fuer die Art SH_TO_UB | EN: Fault code LANK1 - OBD P-code reported for short to battery voltage" VALUE 0x70B7A TKW_VV_VV_UW 100.0 FORMULA_0010 0.0 65535.0000 /end CHARACTERISTIC
/begin CHARACTERISTIC K_ED_LANK2.P_CODE_SH_TO_UB "P-Code fuer die Art SH_TO_UB | EN: Fault code LANK2 - OBD P-code reported for short to battery voltage" VALUE 0x70B94 TKW_VV_VV_UW 100.0 FORMULA_0010 0.0 65535.0000 /end CHARACTERISTIC
/begin CHARACTERISTIC K_ED_FPLAU1.P_CODE_SH_TO_UB "P-Code fuer die Art SH_TO_UB | EN: Fault code FPLAU1 - OBD P-code reported for short to battery voltage" VALUE 0x70CCC TKW_VV_VV_UW 100.0 FORMULA_0010 0.0 65535.0000 /end CHARACTERISTIC
/begin CHARACTERISTIC K_ED_FPLAU2.P_CODE_SH_TO_UB "P-Code fuer die Art SH_TO_UB | EN: Fault code FPLAU2 - OBD P-code reported for short to battery voltage" VALUE 0x70CE6 TKW_VV_VV_UW 100.0 FORMULA_0010 0.0 65535.0000 /end CHARACTERISTIC
/begin CHARACTERISTIC K_ED_LANK1_OBD_S.P_CODE_SH_TO_UB "P-Code fuer die Art SH_TO_UB | EN: Fault code LANK1_OBD_S - OBD P-code reported for short to battery voltage" VALUE 0x70D1A TKW_VV_VV_UW 100.0 FORMULA_0010 0.0 65535.0000 /end CHARACTERISTIC
/begin CHARACTERISTIC K_ED_LANK2_OBD_S.P_CODE_SH_TO_UB "P-Code fuer die Art SH_TO_UB | EN: Fault code LANK2_OBD_S - OBD P-code reported for short to battery voltage" VALUE 0x70D34 TKW_VV_VV_UW 100.0 FORMULA_0010 0.0 65535.0000 /end CHARACTERISTIC
/begin CHARACTERISTIC K_ED_LAVK1_OBD_TL.P_CODE_SH_TO_UB "P-Code fuer die Art SH_TO_UB | EN: Fault code LAVK1_OBD_TL - OBD P-code reported for short to battery voltage" VALUE 0x70D4E TKW_VV_VV_UW 100.0 FORMULA_0010 0.0 65535.0000 /end CHARACTERISTIC
/begin CHARACTERISTIC K_ED_LAVK1_DIAG.P_CODE_SH_TO_UB "P-Code fuer die Art SH_TO_UB | EN: Fault code LAVK1_DIAG - OBD P-code reported for short to battery voltage" VALUE 0x70E86 TKW_VV_VV_UW 100.0 FORMULA_0010 0.0 65535.0000 /end CHARACTERISTIC
/begin CHARACTERISTIC K_ED_LAVK1_IA_OPENLOAD.P_CODE_SH_TO_UB "P-Code fuer die Art SH_TO_UB | EN: Fault code LAVK1_IA_OPENLOAD - OBD P-code reported for short to battery voltage" VALUE 0x70EBA TKW_VV_VV_UW 100.0 FORMULA_0010 0.0 65535.0000 /end CHARACTERISTIC
/begin CHARACTERISTIC K_ED_LAVK1_IP_OPENLOAD.P_CODE_SH_TO_UB "P-Code fuer die Art SH_TO_UB | EN: Fault code LAVK1_IP_OPENLOAD - OBD P-code reported for short to battery voltage" VALUE 0x70F56 TKW_VV_VV_UW 100.0 FORMULA_0010 0.0 65535.0000 /end CHARACTERISTIC
/begin CHARACTERISTIC K_ED_LAM1_REG.P_CODE_SH_TO_UB "P-Code fuer die Art SH_TO_UB | EN: Fault code LAM1_REG - OBD P-code reported for short to battery voltage" VALUE 0x710A8 TKW_VV_VV_UW 100.0 FORMULA_0010 0.0 65535.0000 /end CHARACTERISTIC
/begin CHARACTERISTIC K_ED_LAM2_REG.P_CODE_SH_TO_UB "P-Code fuer die Art SH_TO_UB | EN: Fault code LAM2_REG - OBD P-code reported for short to battery voltage" VALUE 0x710C2 TKW_VV_VV_UW 100.0 FORMULA_0010 0.0 65535.0000 /end CHARACTERISTIC
/begin CHARACTERISTIC K_ED_LAVK1_OBD_DYN.P_CODE_SH_TO_UB "P-Code fuer die Art SH_TO_UB | EN: Fault code LAVK1_OBD_DYN - OBD P-code reported for short to battery voltage" VALUE 0x712B0 TKW_VV_VV_UW 100.0 FORMULA_0010 0.0 65535.0000 /end CHARACTERISTIC
/begin CHARACTERISTIC K_ED_LAVK1_TRIM.P_CODE_SH_TO_UB "P-Code fuer die Art SH_TO_UB | EN: Fault code LAVK1_TRIM - OBD P-code reported for short to battery voltage" VALUE 0x713CE TKW_VV_VV_UW 100.0 FORMULA_0010 0.0 65535.0000 /end CHARACTERISTIC
/begin CHARACTERISTIC K_ED_KAT_OBD1.P_CODE_SH_TO_UB "P-Code fuer die Art SH_TO_UB | EN: Fault code KAT_OBD1 - OBD P-code reported for short to battery voltage" VALUE 0x71520 TKW_VV_VV_UW 100.0 FORMULA_0010 0.0 65535.0000 /end CHARACTERISTIC
/begin CHARACTERISTIC K_ED_KAT_OBD2.P_CODE_SH_TO_UB "P-Code fuer die Art SH_TO_UB | EN: Fault code KAT_OBD2 - OBD P-code reported for short to battery voltage" VALUE 0x7153A TKW_VV_VV_UW 100.0 FORMULA_0010 0.0 65535.0000 /end CHARACTERISTIC
/begin CHARACTERISTIC K_ED_FI_QLT.P_CODE_SH_TO_UB "P-Code fuer die Art SH_TO_UB | EN: Fault code FI_QLT - OBD P-code reported for short to battery voltage" VALUE 0x715A2 TKW_VV_VV_UW 100.0 FORMULA_0010 0.0 65535.0000 /end CHARACTERISTIC
/begin CHARACTERISTIC K_ED_FI_PMBN.P_CODE_SH_TO_UB "P-Code fuer die Art SH_TO_UB | EN: Fault code FI_PMBN - OBD P-code reported for short to battery voltage" VALUE 0x7160A TKW_VV_VV_UW 100.0 FORMULA_0010 0.0 65535.0000 /end CHARACTERISTIC
/begin CHARACTERISTIC K_ED_FI_PMRUHVERL.P_CODE_SH_TO_UB "P-Code fuer die Art SH_TO_UB | EN: Fault code FI_PMRUHVERL - OBD P-code reported for short to battery voltage" VALUE 0x71728 TKW_VV_VV_UW 100.0 FORMULA_0010 0.0 65535.0000 /end CHARACTERISTIC
/begin CHARACTERISTIC K_ED_FI_TOENS.P_CODE_SH_TO_UB "P-Code fuer die Art SH_TO_UB | EN: Fault code FI_TOENS - OBD P-code reported for short to battery voltage" VALUE 0x71742 TKW_VV_VV_UW 100.0 FORMULA_0010 0.0 65535.0000 /end CHARACTERISTIC
/begin CHARACTERISTIC K_ED_KW.P_CODE_SH_TO_UB "P-Code fuer die Art SH_TO_UB | EN: Fault code KW - OBD P-code reported for short to battery voltage" VALUE 0x71860 TKW_VV_VV_UW 100.0 FORMULA_0010 0.0 65535.0000 /end CHARACTERISTIC
/begin CHARACTERISTIC K_ED_LA1_ADAPT.P_CODE_SH_TO_UB "P-Code fuer die Art SH_TO_UB | EN: Fault code LA1_ADAPT - OBD P-code reported for short to battery voltage" VALUE 0x7187A TKW_VV_VV_UW 100.0 FORMULA_0010 0.0 65535.0000 /end CHARACTERISTIC
/begin CHARACTERISTIC K_ED_LA2_ADAPT.P_CODE_SH_TO_UB "P-Code fuer die Art SH_TO_UB | EN: Fault code LA2_ADAPT - OBD P-code reported for short to battery voltage" VALUE 0x71894 TKW_VV_VV_UW 100.0 FORMULA_0010 0.0 65535.0000 /end CHARACTERISTIC
/begin CHARACTERISTIC K_ED_KGE1.P_CODE_SH_TO_UB "P-Code fuer die Art SH_TO_UB | EN: Fault code KGE1 - OBD P-code reported for short to battery voltage" VALUE 0x718AE TKW_VV_VV_UW 100.0 FORMULA_0010 0.0 65535.0000 /end CHARACTERISTIC
/begin CHARACTERISTIC K_ED_KGE2.P_CODE_SH_TO_UB "P-Code fuer die Art SH_TO_UB | EN: Fault code KGE2 - OBD P-code reported for short to battery voltage" VALUE 0x718C8 TKW_VV_VV_UW 100.0 FORMULA_0010 0.0 65535.0000 /end CHARACTERISTIC
/begin CHARACTERISTIC K_ED_FST.P_CODE_SH_TO_UB "P-Code fuer die Art SH_TO_UB | EN: Fault code FST - OBD P-code reported for short to battery voltage" VALUE 0x718E2 TKW_VV_VV_UW 100.0 FORMULA_0010 0.0 65535.0000 /end CHARACTERISTIC
/begin CHARACTERISTIC K_ED_KSD1.P_CODE_SH_TO_UB "P-Code fuer die Art SH_TO_UB | EN: Fault code KSD1 - OBD P-code reported for short to battery voltage" VALUE 0x71A1A TKW_VV_VV_UW 100.0 FORMULA_0010 0.0 65535.0000 /end CHARACTERISTIC
/begin CHARACTERISTIC K_ED_KSD2.P_CODE_SH_TO_UB "P-Code fuer die Art SH_TO_UB | EN: Fault code KSD2 - OBD P-code reported for short to battery voltage" VALUE 0x71A34 TKW_VV_VV_UW 100.0 FORMULA_0010 0.0 65535.0000 /end CHARACTERISTIC
/begin CHARACTERISTIC K_ED_KATS_B1.P_CODE_SH_TO_UB "P-Code fuer die Art SH_TO_UB | EN: Fault code KATS_B1 - OBD P-code reported for short to battery voltage" VALUE 0x71A4E TKW_VV_VV_UW 100.0 FORMULA_0010 0.0 65535.0000 /end CHARACTERISTIC
/begin CHARACTERISTIC K_ED_KATS_B2.P_CODE_SH_TO_UB "P-Code fuer die Art SH_TO_UB | EN: Fault code KATS_B2 - OBD P-code reported for short to battery voltage" VALUE 0x71A68 TKW_VV_VV_UW 100.0 FORMULA_0010 0.0 65535.0000 /end CHARACTERISTIC
/begin CHARACTERISTIC K_ED_FST_GEBER.P_CODE_SH_TO_UB "P-Code fuer die Art SH_TO_UB | EN: Fault code FST_GEBER - OBD P-code reported for short to battery voltage" VALUE 0x71AB6 TKW_VV_VV_UW 100.0 FORMULA_0010 0.0 65535.0000 /end CHARACTERISTIC
/begin CHARACTERISTIC K_ED_LA1_TRIM_AD.P_CODE_SH_TO_UB "P-Code fuer die Art SH_TO_UB | EN: Fault code LA1_TRIM_AD - OBD P-code reported for short to battery voltage" VALUE 0x71B52 TKW_VV_VV_UW 100.0 FORMULA_0010 0.0 65535.0000 /end CHARACTERISTIC
/begin CHARACTERISTIC K_ED_LA2_TRIM_AD.P_CODE_SH_TO_UB "P-Code fuer die Art SH_TO_UB | EN: Fault code LA2_TRIM_AD - OBD P-code reported for short to battery voltage" VALUE 0x71B6C TKW_VV_VV_UW 100.0 FORMULA_0010 0.0 65535.0000 /end CHARACTERISTIC
/begin CHARACTERISTIC K_ED_LANK1_OPENLOAD.P_CODE_SH_TO_UB "P-Code fuer die Art SH_TO_UB | EN: Fault code LANK1_OPENLOAD - OBD P-code reported for short to battery voltage" VALUE 0x71B86 TKW_VV_VV_UW 100.0 FORMULA_0010 0.0 65535.0000 /end CHARACTERISTIC
/begin CHARACTERISTIC K_ED_LANK2_OPENLOAD.P_CODE_SH_TO_UB "P-Code fuer die Art SH_TO_UB | EN: Fault code LANK2_OPENLOAD - OBD P-code reported for short to battery voltage" VALUE 0x71BA0 TKW_VV_VV_UW 100.0 FORMULA_0010 0.0 65535.0000 /end CHARACTERISTIC
/begin CHARACTERISTIC K_ED_LANK1_OBD_WE.P_CODE_SH_TO_UB "P-Code fuer die Art SH_TO_UB | EN: Fault code LANK1_OBD_WE - OBD P-code reported for short to battery voltage" VALUE 0x71BBA TKW_VV_VV_UW 100.0 FORMULA_0010 0.0 65535.0000 /end CHARACTERISTIC
/begin CHARACTERISTIC K_ED_LANK2_OBD_WE.P_CODE_SH_TO_UB "P-Code fuer die Art SH_TO_UB | EN: Fault code LANK2_OBD_WE - OBD P-code reported for short to battery voltage" VALUE 0x71BD4 TKW_VV_VV_UW 100.0 FORMULA_0010 0.0 65535.0000 /end CHARACTERISTIC
/begin CHARACTERISTIC K_ED_FST_GEBER_LI.P_CODE_SH_TO_UB "P-Code fuer die Art SH_TO_UB" VALUE 0x71CD8 TKW_VV_VV_UW 100.0 FORMULA_0010 0.0 65535.0000 /end CHARACTERISTIC
/begin CHARACTERISTIC K_ED_FST_GEBER_RE.P_CODE_SH_TO_UB "P-Code fuer die Art SH_TO_UB" VALUE 0x71CF2 TKW_VV_VV_UW 100.0 FORMULA_0010 0.0 65535.0000 /end CHARACTERISTIC
/begin CHARACTERISTIC K_ED_LANK1_OBD_SLOPE.P_CODE_SH_TO_UB "P-Code fuer die Art SH_TO_UB" VALUE 0x71D0C TKW_VV_VV_UW 100.0 FORMULA_0010 0.0 65535.0000 /end CHARACTERISTIC
/begin CHARACTERISTIC K_ED_LANK2_OBD_SLOPE.P_CODE_SH_TO_UB "P-Code fuer die Art SH_TO_UB" VALUE 0x71D26 TKW_VV_VV_UW 100.0 FORMULA_0010 0.0 65535.0000 /end CHARACTERISTIC
/begin CHARACTERISTIC K_ED_INDEX_204_INJ.P_CODE_SH_TO_UB "P-Code fuer die Art SH_TO_UB | EN: Fault code INDEX_204_INJ - OBD P-code reported for short to battery voltage" VALUE 0x71D8E TKW_VV_VV_UW 100.0 FORMULA_0010 0.0 65535.0000 /end CHARACTERISTIC
/begin CHARACTERISTIC K_ED_INDEX_205_INJ.P_CODE_SH_TO_UB "P-Code fuer die Art SH_TO_UB | EN: Fault code INDEX_205_INJ - OBD P-code reported for short to battery voltage" VALUE 0x71DA8 TKW_VV_VV_UW 100.0 FORMULA_0010 0.0 65535.0000 /end CHARACTERISTIC
/begin CHARACTERISTIC K_ED_INDEX_206_INJ.P_CODE_SH_TO_UB "P-Code fuer die Art SH_TO_UB | EN: Fault code INDEX_206_INJ - OBD P-code reported for short to battery voltage" VALUE 0x71DC2 TKW_VV_VV_UW 100.0 FORMULA_0010 0.0 65535.0000 /end CHARACTERISTIC
/begin CHARACTERISTIC K_ED_INDEX_207_INJ.P_CODE_SH_TO_UB "P-Code fuer die Art SH_TO_UB | EN: P-Code fuer die Art SH_TO_UB" VALUE 0x71DDC TKW_VV_VV_UW 100.0 FORMULA_0010 0.0 65535.0000 /end CHARACTERISTIC
/begin CHARACTERISTIC K_ED_INDEX_208_INJ.P_CODE_SH_TO_UB "P-Code fuer die Art SH_TO_UB | EN: P-Code fuer die Art SH_TO_UB" VALUE 0x71DF6 TKW_VV_VV_UW 100.0 FORMULA_0010 0.0 65535.0000 /end CHARACTERISTIC
/begin CHARACTERISTIC K_ED_INDEX_209_INJ.P_CODE_SH_TO_UB "P-Code fuer die Art SH_TO_UB" VALUE 0x71E10 TKW_VV_VV_UW 100.0 FORMULA_0010 0.0 65535.0000 /end CHARACTERISTIC
/begin CHARACTERISTIC K_ED_INDEX_210_INJ.P_CODE_SH_TO_UB "P-Code fuer die Art SH_TO_UB" VALUE 0x71E2A TKW_VV_VV_UW 100.0 FORMULA_0010 0.0 65535.0000 /end CHARACTERISTIC
/begin CHARACTERISTIC K_ED_INDEX_211_INJ.P_CODE_SH_TO_UB "P-Code fuer die Art SH_TO_UB | EN: P-Code fuer die Art SH_TO_UB" VALUE 0x71E44 TKW_VV_VV_UW 100.0 FORMULA_0010 0.0 65535.0000 /end CHARACTERISTIC
/begin CHARACTERISTIC K_ED_INDEX_212_INJ.P_CODE_SH_TO_UB "P-Code fuer die Art SH_TO_UB | EN: P-Code fuer die Art SH_TO_UB" VALUE 0x71E5E TKW_VV_VV_UW 100.0 FORMULA_0010 0.0 65535.0000 /end CHARACTERISTIC
/begin CHARACTERISTIC K_ED_INDEX_213_INJ.P_CODE_SH_TO_UB "P-Code fuer die Art SH_TO_UB" VALUE 0x71E78 TKW_VV_VV_UW 100.0 FORMULA_0010 0.0 65535.0000 /end CHARACTERISTIC
/begin CHARACTERISTIC K_ED_INDEX_214_INJ.P_CODE_SH_TO_UB "P-Code fuer die Art SH_TO_UB" VALUE 0x71E92 TKW_VV_VV_UW 100.0 FORMULA_0010 0.0 65535.0000 /end CHARACTERISTIC
/begin CHARACTERISTIC K_ED_INDEX_215_INJ.P_CODE_SH_TO_UB "P-Code fuer die Art SH_TO_UB | EN: P-Code fuer die Art SH_TO_UB" VALUE 0x71EAC TKW_VV_VV_UW 100.0 FORMULA_0010 0.0 65535.0000 /end CHARACTERISTIC
/begin CHARACTERISTIC K_ED_INDEX_216_INJ.P_CODE_SH_TO_UB "P-Code fuer die Art SH_TO_UB | EN: P-Code fuer die Art SH_TO_UB" VALUE 0x71EC6 TKW_VV_VV_UW 100.0 FORMULA_0010 0.0 65535.0000 /end CHARACTERISTIC
/begin CHARACTERISTIC K_ED_INDEX_217_INJ.P_CODE_SH_TO_UB "P-Code fuer die Art SH_TO_UB | EN: P-Code fuer die Art SH_TO_UB" VALUE 0x71EE0 TKW_VV_VV_UW 100.0 FORMULA_0010 0.0 65535.0000 /end CHARACTERISTIC
/begin CHARACTERISTIC K_ED_INDEX_218_INJ.P_CODE_SH_TO_UB "P-Code fuer die Art SH_TO_UB | EN: P-Code fuer die Art SH_TO_UB" VALUE 0x71EFA TKW_VV_VV_UW 100.0 FORMULA_0010 0.0 65535.0000 /end CHARACTERISTIC
/begin CHARACTERISTIC K_ED_INDEX_219_INJ.P_CODE_SH_TO_UB "P-Code fuer die Art SH_TO_UB | EN: P-Code fuer die Art SH_TO_UB" VALUE 0x71F14 TKW_VV_VV_UW 100.0 FORMULA_0010 0.0 65535.0000 /end CHARACTERISTIC
/begin CHARACTERISTIC K_ED_INDEX_220_INJ.P_CODE_SH_TO_UB "P-Code fuer die Art SH_TO_UB | EN: P-Code fuer die Art SH_TO_UB" VALUE 0x71F2E TKW_VV_VV_UW 100.0 FORMULA_0010 0.0 65535.0000 /end CHARACTERISTIC
/begin CHARACTERISTIC K_ED_INDEX_221_INJ.P_CODE_SH_TO_UB "P-Code fuer die Art SH_TO_UB | EN: P-Code fuer die Art SH_TO_UB" VALUE 0x71F48 TKW_VV_VV_UW 100.0 FORMULA_0010 0.0 65535.0000 /end CHARACTERISTIC
/begin CHARACTERISTIC K_ED_INDEX_222_INJ.P_CODE_SH_TO_UB "P-Code fuer die Art SH_TO_UB | EN: P-Code fuer die Art SH_TO_UB" VALUE 0x71F62 TKW_VV_VV_UW 100.0 FORMULA_0010 0.0 65535.0000 /end CHARACTERISTIC
/begin CHARACTERISTIC K_ED_INDEX_223_INJ.P_CODE_SH_TO_UB "P-Code fuer die Art SH_TO_UB | EN: P-Code fuer die Art SH_TO_UB" VALUE 0x71F7C TKW_VV_VV_UW 100.0 FORMULA_0010 0.0 65535.0000 /end CHARACTERISTIC
/begin CHARACTERISTIC K_ED_HFM1.P_CODE_SH_TO_GND "P-Code fuer die Art SH_TO_GND | EN: Fault code HFM1 - OBD P-code reported for short to ground" VALUE 0x7090C TKW_VV_VV_UW 100.0 FORMULA_0010 0.0 65535.0000 /end CHARACTERISTIC
/begin CHARACTERISTIC K_ED_HFM2.P_CODE_SH_TO_GND "P-Code fuer die Art SH_TO_GND | EN: Fault code HFM2 - OBD P-code reported for short to ground" VALUE 0x70926 TKW_VV_VV_UW 100.0 FORMULA_0010 0.0 65535.0000 /end CHARACTERISTIC
/begin CHARACTERISTIC K_ED_LAVK1.P_CODE_SH_TO_GND "P-Code fuer die Art SH_TO_GND | EN: Fault code LAVK1 - OBD P-code reported for short to ground" VALUE 0x70AE0 TKW_VV_VV_UW 100.0 FORMULA_0010 0.0 65535.0000 /end CHARACTERISTIC
/begin CHARACTERISTIC K_ED_LAVK1_OBD_PLAU.P_CODE_SH_TO_GND "P-Code fuer die Art SH_TO_GND | EN: Fault code LAVK1_OBD_PLAU - OBD P-code reported for short to ground" VALUE 0x70B14 TKW_VV_VV_UW 100.0 FORMULA_0010 0.0 65535.0000 /end CHARACTERISTIC
/begin CHARACTERISTIC K_ED_LAVK1_OBD_SA.P_CODE_SH_TO_GND "P-Code fuer die Art SH_TO_GND | EN: Fault code LAVK1_OBD_SA - OBD P-code reported for short to ground" VALUE 0x70B48 TKW_VV_VV_UW 100.0 FORMULA_0010 0.0 65535.0000 /end CHARACTERISTIC
/begin CHARACTERISTIC K_ED_LANK1.P_CODE_SH_TO_GND "P-Code fuer die Art SH_TO_GND | EN: Fault code LANK1 - OBD P-code reported for short to ground" VALUE 0x70B7C TKW_VV_VV_UW 100.0 FORMULA_0010 0.0 65535.0000 /end CHARACTERISTIC
/begin CHARACTERISTIC K_ED_LANK2.P_CODE_SH_TO_GND "P-Code fuer die Art SH_TO_GND | EN: Fault code LANK2 - OBD P-code reported for short to ground" VALUE 0x70B96 TKW_VV_VV_UW 100.0 FORMULA_0010 0.0 65535.0000 /end CHARACTERISTIC
/begin CHARACTERISTIC K_ED_FPLAU1.P_CODE_SH_TO_GND "P-Code fuer die Art SH_TO_GND | EN: Fault code FPLAU1 - OBD P-code reported for short to ground" VALUE 0x70CCE TKW_VV_VV_UW 100.0 FORMULA_0010 0.0 65535.0000 /end CHARACTERISTIC
/begin CHARACTERISTIC K_ED_FPLAU2.P_CODE_SH_TO_GND "P-Code fuer die Art SH_TO_GND | EN: Fault code FPLAU2 - OBD P-code reported for short to ground" VALUE 0x70CE8 TKW_VV_VV_UW 100.0 FORMULA_0010 0.0 65535.0000 /end CHARACTERISTIC
/begin CHARACTERISTIC K_ED_LANK1_OBD_S.P_CODE_SH_TO_GND "P-Code fuer die Art SH_TO_GND | EN: Fault code LANK1_OBD_S - OBD P-code reported for short to ground" VALUE 0x70D1C TKW_VV_VV_UW 100.0 FORMULA_0010 0.0 65535.0000 /end CHARACTERISTIC
/begin CHARACTERISTIC K_ED_LANK2_OBD_S.P_CODE_SH_TO_GND "P-Code fuer die Art SH_TO_GND | EN: Fault code LANK2_OBD_S - OBD P-code reported for short to ground" VALUE 0x70D36 TKW_VV_VV_UW 100.0 FORMULA_0010 0.0 65535.0000 /end CHARACTERISTIC
/begin CHARACTERISTIC K_ED_LAVK1_OBD_TL.P_CODE_SH_TO_GND "P-Code fuer die Art SH_TO_GND | EN: Fault code LAVK1_OBD_TL - OBD P-code reported for short to ground" VALUE 0x70D50 TKW_VV_VV_UW 100.0 FORMULA_0010 0.0 65535.0000 /end CHARACTERISTIC
/begin CHARACTERISTIC K_ED_LAVK1_DIAG.P_CODE_SH_TO_GND "P-Code fuer die Art SH_TO_GND | EN: Fault code LAVK1_DIAG - OBD P-code reported for short to ground" VALUE 0x70E88 TKW_VV_VV_UW 100.0 FORMULA_0010 0.0 65535.0000 /end CHARACTERISTIC
/begin CHARACTERISTIC K_ED_LAVK1_IA_OPENLOAD.P_CODE_SH_TO_GND "P-Code fuer die Art SH_TO_GND | EN: Fault code LAVK1_IA_OPENLOAD - OBD P-code reported for short to ground" VALUE 0x70EBC TKW_VV_VV_UW 100.0 FORMULA_0010 0.0 65535.0000 /end CHARACTERISTIC
/begin CHARACTERISTIC K_ED_LAVK1_IP_OPENLOAD.P_CODE_SH_TO_GND "P-Code fuer die Art SH_TO_GND | EN: Fault code LAVK1_IP_OPENLOAD - OBD P-code reported for short to ground" VALUE 0x70F58 TKW_VV_VV_UW 100.0 FORMULA_0010 0.0 65535.0000 /end CHARACTERISTIC
/begin CHARACTERISTIC K_ED_LAM1_REG.P_CODE_SH_TO_GND "P-Code fuer die Art SH_TO_GND | EN: Fault code LAM1_REG - OBD P-code reported for short to ground" VALUE 0x710AA TKW_VV_VV_UW 100.0 FORMULA_0010 0.0 65535.0000 /end CHARACTERISTIC
/begin CHARACTERISTIC K_ED_LAM2_REG.P_CODE_SH_TO_GND "P-Code fuer die Art SH_TO_GND | EN: Fault code LAM2_REG - OBD P-code reported for short to ground" VALUE 0x710C4 TKW_VV_VV_UW 100.0 FORMULA_0010 0.0 65535.0000 /end CHARACTERISTIC
/begin CHARACTERISTIC K_ED_LAVK1_OBD_DYN.P_CODE_SH_TO_GND "P-Code fuer die Art SH_TO_GND | EN: Fault code LAVK1_OBD_DYN - OBD P-code reported for short to ground" VALUE 0x712B2 TKW_VV_VV_UW 100.0 FORMULA_0010 0.0 65535.0000 /end CHARACTERISTIC
/begin CHARACTERISTIC K_ED_LAVK1_TRIM.P_CODE_SH_TO_GND "P-Code fuer die Art SH_TO_GND | EN: Fault code LAVK1_TRIM - OBD P-code reported for short to ground" VALUE 0x713D0 TKW_VV_VV_UW 100.0 FORMULA_0010 0.0 65535.0000 /end CHARACTERISTIC
/begin CHARACTERISTIC K_ED_KAT_OBD1.P_CODE_SH_TO_GND "P-Code fuer die Art SH_TO_GND | EN: Fault code KAT_OBD1 - OBD P-code reported for short to ground" VALUE 0x71522 TKW_VV_VV_UW 100.0 FORMULA_0010 0.0 65535.0000 /end CHARACTERISTIC
/begin CHARACTERISTIC K_ED_KAT_OBD2.P_CODE_SH_TO_GND "P-Code fuer die Art SH_TO_GND | EN: Fault code KAT_OBD2 - OBD P-code reported for short to ground" VALUE 0x7153C TKW_VV_VV_UW 100.0 FORMULA_0010 0.0 65535.0000 /end CHARACTERISTIC
/begin CHARACTERISTIC K_ED_FI_QLT.P_CODE_SH_TO_GND "P-Code fuer die Art SH_TO_GND | EN: Fault code FI_QLT - OBD P-code reported for short to ground" VALUE 0x715A4 TKW_VV_VV_UW 100.0 FORMULA_0010 0.0 65535.0000 /end CHARACTERISTIC
/begin CHARACTERISTIC K_ED_FI_PMBN.P_CODE_SH_TO_GND "P-Code fuer die Art SH_TO_GND | EN: Fault code FI_PMBN - OBD P-code reported for short to ground" VALUE 0x7160C TKW_VV_VV_UW 100.0 FORMULA_0010 0.0 65535.0000 /end CHARACTERISTIC
/begin CHARACTERISTIC K_ED_FI_PMRUHVERL.P_CODE_SH_TO_GND "P-Code fuer die Art SH_TO_GND | EN: Fault code FI_PMRUHVERL - OBD P-code reported for short to ground" VALUE 0x7172A TKW_VV_VV_UW 100.0 FORMULA_0010 0.0 65535.0000 /end CHARACTERISTIC
/begin CHARACTERISTIC K_ED_FI_TOENS.P_CODE_SH_TO_GND "P-Code fuer die Art SH_TO_GND | EN: Fault code FI_TOENS - OBD P-code reported for short to ground" VALUE 0x71744 TKW_VV_VV_UW 100.0 FORMULA_0010 0.0 65535.0000 /end CHARACTERISTIC
/begin CHARACTERISTIC K_ED_KW.P_CODE_SH_TO_GND "P-Code fuer die Art SH_TO_GND | EN: Fault code KW - OBD P-code reported for short to ground" VALUE 0x71862 TKW_VV_VV_UW 100.0 FORMULA_0010 0.0 65535.0000 /end CHARACTERISTIC
/begin CHARACTERISTIC K_ED_LA1_ADAPT.P_CODE_SH_TO_GND "P-Code fuer die Art SH_TO_GND | EN: Fault code LA1_ADAPT - OBD P-code reported for short to ground" VALUE 0x7187C TKW_VV_VV_UW 100.0 FORMULA_0010 0.0 65535.0000 /end CHARACTERISTIC
/begin CHARACTERISTIC K_ED_LA2_ADAPT.P_CODE_SH_TO_GND "P-Code fuer die Art SH_TO_GND | EN: Fault code LA2_ADAPT - OBD P-code reported for short to ground" VALUE 0x71896 TKW_VV_VV_UW 100.0 FORMULA_0010 0.0 65535.0000 /end CHARACTERISTIC
/begin CHARACTERISTIC K_ED_KGE1.P_CODE_SH_TO_GND "P-Code fuer die Art SH_TO_GND | EN: Fault code KGE1 - OBD P-code reported for short to ground" VALUE 0x718B0 TKW_VV_VV_UW 100.0 FORMULA_0010 0.0 65535.0000 /end CHARACTERISTIC
/begin CHARACTERISTIC K_ED_KGE2.P_CODE_SH_TO_GND "P-Code fuer die Art SH_TO_GND | EN: Fault code KGE2 - OBD P-code reported for short to ground" VALUE 0x718CA TKW_VV_VV_UW 100.0 FORMULA_0010 0.0 65535.0000 /end CHARACTERISTIC
/begin CHARACTERISTIC K_ED_FST.P_CODE_SH_TO_GND "P-Code fuer die Art SH_TO_GND | EN: Fault code FST - OBD P-code reported for short to ground" VALUE 0x718E4 TKW_VV_VV_UW 100.0 FORMULA_0010 0.0 65535.0000 /end CHARACTERISTIC
/begin CHARACTERISTIC K_ED_KSD1.P_CODE_SH_TO_GND "P-Code fuer die Art SH_TO_GND | EN: Fault code KSD1 - OBD P-code reported for short to ground" VALUE 0x71A1C TKW_VV_VV_UW 100.0 FORMULA_0010 0.0 65535.0000 /end CHARACTERISTIC
/begin CHARACTERISTIC K_ED_KSD2.P_CODE_SH_TO_GND "P-Code fuer die Art SH_TO_GND | EN: Fault code KSD2 - OBD P-code reported for short to ground" VALUE 0x71A36 TKW_VV_VV_UW 100.0 FORMULA_0010 0.0 65535.0000 /end CHARACTERISTIC
/begin CHARACTERISTIC K_ED_KATS_B1.P_CODE_SH_TO_GND "P-Code fuer die Art SH_TO_GND | EN: Fault code KATS_B1 - OBD P-code reported for short to ground" VALUE 0x71A50 TKW_VV_VV_UW 100.0 FORMULA_0010 0.0 65535.0000 /end CHARACTERISTIC
/begin CHARACTERISTIC K_ED_KATS_B2.P_CODE_SH_TO_GND "P-Code fuer die Art SH_TO_GND | EN: Fault code KATS_B2 - OBD P-code reported for short to ground" VALUE 0x71A6A TKW_VV_VV_UW 100.0 FORMULA_0010 0.0 65535.0000 /end CHARACTERISTIC
/begin CHARACTERISTIC K_ED_FST_GEBER.P_CODE_SH_TO_GND "P-Code fuer die Art SH_TO_GND | EN: Fault code FST_GEBER - OBD P-code reported for short to ground" VALUE 0x71AB8 TKW_VV_VV_UW 100.0 FORMULA_0010 0.0 65535.0000 /end CHARACTERISTIC
/begin CHARACTERISTIC K_ED_LA1_TRIM_AD.P_CODE_SH_TO_GND "P-Code fuer die Art SH_TO_GND | EN: Fault code LA1_TRIM_AD - OBD P-code reported for short to ground" VALUE 0x71B54 TKW_VV_VV_UW 100.0 FORMULA_0010 0.0 65535.0000 /end CHARACTERISTIC
/begin CHARACTERISTIC K_ED_LA2_TRIM_AD.P_CODE_SH_TO_GND "P-Code fuer die Art SH_TO_GND | EN: Fault code LA2_TRIM_AD - OBD P-code reported for short to ground" VALUE 0x71B6E TKW_VV_VV_UW 100.0 FORMULA_0010 0.0 65535.0000 /end CHARACTERISTIC
/begin CHARACTERISTIC K_ED_LANK1_OPENLOAD.P_CODE_SH_TO_GND "P-Code fuer die Art SH_TO_GND | EN: Fault code LANK1_OPENLOAD - OBD P-code reported for short to ground" VALUE 0x71B88 TKW_VV_VV_UW 100.0 FORMULA_0010 0.0 65535.0000 /end CHARACTERISTIC
/begin CHARACTERISTIC K_ED_LANK2_OPENLOAD.P_CODE_SH_TO_GND "P-Code fuer die Art SH_TO_GND | EN: Fault code LANK2_OPENLOAD - OBD P-code reported for short to ground" VALUE 0x71BA2 TKW_VV_VV_UW 100.0 FORMULA_0010 0.0 65535.0000 /end CHARACTERISTIC
/begin CHARACTERISTIC K_ED_LANK1_OBD_WE.P_CODE_SH_TO_GND "P-Code fuer die Art SH_TO_GND | EN: Fault code LANK1_OBD_WE - OBD P-code reported for short to ground" VALUE 0x71BBC TKW_VV_VV_UW 100.0 FORMULA_0010 0.0 65535.0000 /end CHARACTERISTIC
/begin CHARACTERISTIC K_ED_LANK2_OBD_WE.P_CODE_SH_TO_GND "P-Code fuer die Art SH_TO_GND | EN: Fault code LANK2_OBD_WE - OBD P-code reported for short to ground" VALUE 0x71BD6 TKW_VV_VV_UW 100.0 FORMULA_0010 0.0 65535.0000 /end CHARACTERISTIC
/begin CHARACTERISTIC K_ED_FST_GEBER_LI.P_CODE_SH_TO_GND "P-Code fuer die Art SH_TO_GND" VALUE 0x71CDA TKW_VV_VV_UW 100.0 FORMULA_0010 0.0 65535.0000 /end CHARACTERISTIC
/begin CHARACTERISTIC K_ED_FST_GEBER_RE.P_CODE_SH_TO_GND "P-Code fuer die Art SH_TO_GND" VALUE 0x71CF4 TKW_VV_VV_UW 100.0 FORMULA_0010 0.0 65535.0000 /end CHARACTERISTIC
/begin CHARACTERISTIC K_ED_LANK1_OBD_SLOPE.P_CODE_SH_TO_GND "P-Code fuer die Art SH_TO_GND" VALUE 0x71D0E TKW_VV_VV_UW 100.0 FORMULA_0010 0.0 65535.0000 /end CHARACTERISTIC
/begin CHARACTERISTIC K_ED_LANK2_OBD_SLOPE.P_CODE_SH_TO_GND "P-Code fuer die Art SH_TO_GND" VALUE 0x71D28 TKW_VV_VV_UW 100.0 FORMULA_0010 0.0 65535.0000 /end CHARACTERISTIC
/begin CHARACTERISTIC K_ED_INDEX_204_INJ.P_CODE_SH_TO_GND "P-Code fuer die Art SH_TO_GND | EN: Fault code INDEX_204_INJ - OBD P-code reported for short to ground" VALUE 0x71D90 TKW_VV_VV_UW 100.0 FORMULA_0010 0.0 65535.0000 /end CHARACTERISTIC
/begin CHARACTERISTIC K_ED_INDEX_205_INJ.P_CODE_SH_TO_GND "P-Code fuer die Art SH_TO_GND | EN: Fault code INDEX_205_INJ - OBD P-code reported for short to ground" VALUE 0x71DAA TKW_VV_VV_UW 100.0 FORMULA_0010 0.0 65535.0000 /end CHARACTERISTIC
/begin CHARACTERISTIC K_ED_INDEX_206_INJ.P_CODE_SH_TO_GND "P-Code fuer die Art SH_TO_GND | EN: Fault code INDEX_206_INJ - OBD P-code reported for short to ground" VALUE 0x71DC4 TKW_VV_VV_UW 100.0 FORMULA_0010 0.0 65535.0000 /end CHARACTERISTIC
/begin CHARACTERISTIC K_ED_INDEX_207_INJ.P_CODE_SH_TO_GND "P-Code fuer die Art SH_TO_GND | EN: P-Code fuer die Art SH_TO_GND" VALUE 0x71DDE TKW_VV_VV_UW 100.0 FORMULA_0010 0.0 65535.0000 /end CHARACTERISTIC
/begin CHARACTERISTIC K_ED_INDEX_208_INJ.P_CODE_SH_TO_GND "P-Code fuer die Art SH_TO_GND | EN: P-Code fuer die Art SH_TO_GND" VALUE 0x71DF8 TKW_VV_VV_UW 100.0 FORMULA_0010 0.0 65535.0000 /end CHARACTERISTIC
/begin CHARACTERISTIC K_ED_INDEX_209_INJ.P_CODE_SH_TO_GND "P-Code fuer die Art SH_TO_GND" VALUE 0x71E12 TKW_VV_VV_UW 100.0 FORMULA_0010 0.0 65535.0000 /end CHARACTERISTIC
/begin CHARACTERISTIC K_ED_INDEX_210_INJ.P_CODE_SH_TO_GND "P-Code fuer die Art SH_TO_GND" VALUE 0x71E2C TKW_VV_VV_UW 100.0 FORMULA_0010 0.0 65535.0000 /end CHARACTERISTIC
/begin CHARACTERISTIC K_ED_INDEX_211_INJ.P_CODE_SH_TO_GND "P-Code fuer die Art SH_TO_GND | EN: P-Code fuer die Art SH_TO_GND" VALUE 0x71E46 TKW_VV_VV_UW 100.0 FORMULA_0010 0.0 65535.0000 /end CHARACTERISTIC
/begin CHARACTERISTIC K_ED_INDEX_212_INJ.P_CODE_SH_TO_GND "P-Code fuer die Art SH_TO_GND | EN: P-Code fuer die Art SH_TO_GND" VALUE 0x71E60 TKW_VV_VV_UW 100.0 FORMULA_0010 0.0 65535.0000 /end CHARACTERISTIC
/begin CHARACTERISTIC K_ED_INDEX_213_INJ.P_CODE_SH_TO_GND "P-Code fuer die Art SH_TO_GND" VALUE 0x71E7A TKW_VV_VV_UW 100.0 FORMULA_0010 0.0 65535.0000 /end CHARACTERISTIC
/begin CHARACTERISTIC K_ED_INDEX_214_INJ.P_CODE_SH_TO_GND "P-Code fuer die Art SH_TO_GND" VALUE 0x71E94 TKW_VV_VV_UW 100.0 FORMULA_0010 0.0 65535.0000 /end CHARACTERISTIC
/begin CHARACTERISTIC K_ED_INDEX_215_INJ.P_CODE_SH_TO_GND "P-Code fuer die Art SH_TO_GND | EN: P-Code fuer die Art SH_TO_GND" VALUE 0x71EAE TKW_VV_VV_UW 100.0 FORMULA_0010 0.0 65535.0000 /end CHARACTERISTIC
/begin CHARACTERISTIC K_ED_INDEX_216_INJ.P_CODE_SH_TO_GND "P-Code fuer die Art SH_TO_GND | EN: P-Code fuer die Art SH_TO_GND" VALUE 0x71EC8 TKW_VV_VV_UW 100.0 FORMULA_0010 0.0 65535.0000 /end CHARACTERISTIC
/begin CHARACTERISTIC K_ED_INDEX_217_INJ.P_CODE_SH_TO_GND "P-Code fuer die Art SH_TO_GND | EN: P-Code fuer die Art SH_TO_GND" VALUE 0x71EE2 TKW_VV_VV_UW 100.0 FORMULA_0010 0.0 65535.0000 /end CHARACTERISTIC
/begin CHARACTERISTIC K_ED_INDEX_218_INJ.P_CODE_SH_TO_GND "P-Code fuer die Art SH_TO_GND | EN: P-Code fuer die Art SH_TO_GND" VALUE 0x71EFC TKW_VV_VV_UW 100.0 FORMULA_0010 0.0 65535.0000 /end CHARACTERISTIC
/begin CHARACTERISTIC K_ED_INDEX_219_INJ.P_CODE_SH_TO_GND "P-Code fuer die Art SH_TO_GND | EN: P-Code fuer die Art SH_TO_GND" VALUE 0x71F16 TKW_VV_VV_UW 100.0 FORMULA_0010 0.0 65535.0000 /end CHARACTERISTIC
/begin CHARACTERISTIC K_ED_INDEX_220_INJ.P_CODE_SH_TO_GND "P-Code fuer die Art SH_TO_GND | EN: P-Code fuer die Art SH_TO_GND" VALUE 0x71F30 TKW_VV_VV_UW 100.0 FORMULA_0010 0.0 65535.0000 /end CHARACTERISTIC
/begin CHARACTERISTIC K_ED_INDEX_221_INJ.P_CODE_SH_TO_GND "P-Code fuer die Art SH_TO_GND | EN: P-Code fuer die Art SH_TO_GND" VALUE 0x71F4A TKW_VV_VV_UW 100.0 FORMULA_0010 0.0 65535.0000 /end CHARACTERISTIC
/begin CHARACTERISTIC K_ED_INDEX_222_INJ.P_CODE_SH_TO_GND "P-Code fuer die Art SH_TO_GND | EN: P-Code fuer die Art SH_TO_GND" VALUE 0x71F64 TKW_VV_VV_UW 100.0 FORMULA_0010 0.0 65535.0000 /end CHARACTERISTIC
/begin CHARACTERISTIC K_ED_INDEX_223_INJ.P_CODE_SH_TO_GND "P-Code fuer die Art SH_TO_GND | EN: P-Code fuer die Art SH_TO_GND" VALUE 0x71F7E TKW_VV_VV_UW 100.0 FORMULA_0010 0.0 65535.0000 /end CHARACTERISTIC
/begin CHARACTERISTIC K_ED_HFM1.P_CODE_OPENLOAD "P-Code fuer die Art OPENLOAD | EN: Fault code HFM1 - OBD P-code reported for open circuit" VALUE 0x7090E TKW_VV_VV_UW 100.0 FORMULA_0010 0.0 65535.0000 /end CHARACTERISTIC
/begin CHARACTERISTIC K_ED_HFM2.P_CODE_OPENLOAD "P-Code fuer die Art OPENLOAD | EN: Fault code HFM2 - OBD P-code reported for open circuit" VALUE 0x70928 TKW_VV_VV_UW 100.0 FORMULA_0010 0.0 65535.0000 /end CHARACTERISTIC
/begin CHARACTERISTIC K_ED_LAVK1.P_CODE_OPENLOAD "P-Code fuer die Art OPENLOAD | EN: Fault code LAVK1 - OBD P-code reported for open circuit" VALUE 0x70AE2 TKW_VV_VV_UW 100.0 FORMULA_0010 0.0 65535.0000 /end CHARACTERISTIC
/begin CHARACTERISTIC K_ED_LAVK1_OBD_PLAU.P_CODE_OPENLOAD "P-Code fuer die Art OPENLOAD | EN: Fault code LAVK1_OBD_PLAU - OBD P-code reported for open circuit" VALUE 0x70B16 TKW_VV_VV_UW 100.0 FORMULA_0010 0.0 65535.0000 /end CHARACTERISTIC
/begin CHARACTERISTIC K_ED_LAVK1_OBD_SA.P_CODE_OPENLOAD "P-Code fuer die Art OPENLOAD | EN: Fault code LAVK1_OBD_SA - OBD P-code reported for open circuit" VALUE 0x70B4A TKW_VV_VV_UW 100.0 FORMULA_0010 0.0 65535.0000 /end CHARACTERISTIC
/begin CHARACTERISTIC K_ED_LANK1.P_CODE_OPENLOAD "P-Code fuer die Art OPENLOAD | EN: Fault code LANK1 - OBD P-code reported for open circuit" VALUE 0x70B7E TKW_VV_VV_UW 100.0 FORMULA_0010 0.0 65535.0000 /end CHARACTERISTIC
/begin CHARACTERISTIC K_ED_LANK2.P_CODE_OPENLOAD "P-Code fuer die Art OPENLOAD | EN: Fault code LANK2 - OBD P-code reported for open circuit" VALUE 0x70B98 TKW_VV_VV_UW 100.0 FORMULA_0010 0.0 65535.0000 /end CHARACTERISTIC
/begin CHARACTERISTIC K_ED_FPLAU1.P_CODE_OPENLOAD "P-Code fuer die Art OPENLOAD | EN: Fault code FPLAU1 - OBD P-code reported for open circuit" VALUE 0x70CD0 TKW_VV_VV_UW 100.0 FORMULA_0010 0.0 65535.0000 /end CHARACTERISTIC
/begin CHARACTERISTIC K_ED_FPLAU2.P_CODE_OPENLOAD "P-Code fuer die Art OPENLOAD | EN: Fault code FPLAU2 - OBD P-code reported for open circuit" VALUE 0x70CEA TKW_VV_VV_UW 100.0 FORMULA_0010 0.0 65535.0000 /end CHARACTERISTIC
/begin CHARACTERISTIC K_ED_LANK1_OBD_S.P_CODE_OPENLOAD "P-Code fuer die Art OPENLOAD | EN: Fault code LANK1_OBD_S - OBD P-code reported for open circuit" VALUE 0x70D1E TKW_VV_VV_UW 100.0 FORMULA_0010 0.0 65535.0000 /end CHARACTERISTIC
/begin CHARACTERISTIC K_ED_LANK2_OBD_S.P_CODE_OPENLOAD "P-Code fuer die Art OPENLOAD | EN: Fault code LANK2_OBD_S - OBD P-code reported for open circuit" VALUE 0x70D38 TKW_VV_VV_UW 100.0 FORMULA_0010 0.0 65535.0000 /end CHARACTERISTIC
/begin CHARACTERISTIC K_ED_LAVK1_OBD_TL.P_CODE_OPENLOAD "P-Code fuer die Art OPENLOAD | EN: Fault code LAVK1_OBD_TL - OBD P-code reported for open circuit" VALUE 0x70D52 TKW_VV_VV_UW 100.0 FORMULA_0010 0.0 65535.0000 /end CHARACTERISTIC
/begin CHARACTERISTIC K_ED_LAVK1_DIAG.P_CODE_OPENLOAD "P-Code fuer die Art OPENLOAD | EN: Fault code LAVK1_DIAG - OBD P-code reported for open circuit" VALUE 0x70E8A TKW_VV_VV_UW 100.0 FORMULA_0010 0.0 65535.0000 /end CHARACTERISTIC
/begin CHARACTERISTIC K_ED_LAVK1_IA_OPENLOAD.P_CODE_OPENLOAD "P-Code fuer die Art OPENLOAD | EN: Fault code LAVK1_IA_OPENLOAD - OBD P-code reported for open circuit" VALUE 0x70EBE TKW_VV_VV_UW 100.0 FORMULA_0010 0.0 65535.0000 /end CHARACTERISTIC
/begin CHARACTERISTIC K_ED_LAVK1_IP_OPENLOAD.P_CODE_OPENLOAD "P-Code fuer die Art OPENLOAD | EN: Fault code LAVK1_IP_OPENLOAD - OBD P-code reported for open circuit" VALUE 0x70F5A TKW_VV_VV_UW 100.0 FORMULA_0010 0.0 65535.0000 /end CHARACTERISTIC
/begin CHARACTERISTIC K_ED_LAM1_REG.P_CODE_OPENLOAD "P-Code fuer die Art OPENLOAD | EN: Fault code LAM1_REG - OBD P-code reported for open circuit" VALUE 0x710AC TKW_VV_VV_UW 100.0 FORMULA_0010 0.0 65535.0000 /end CHARACTERISTIC
/begin CHARACTERISTIC K_ED_LAM2_REG.P_CODE_OPENLOAD "P-Code fuer die Art OPENLOAD | EN: Fault code LAM2_REG - OBD P-code reported for open circuit" VALUE 0x710C6 TKW_VV_VV_UW 100.0 FORMULA_0010 0.0 65535.0000 /end CHARACTERISTIC
/begin CHARACTERISTIC K_ED_LAVK1_OBD_DYN.P_CODE_OPENLOAD "P-Code fuer die Art OPENLOAD | EN: Fault code LAVK1_OBD_DYN - OBD P-code reported for open circuit" VALUE 0x712B4 TKW_VV_VV_UW 100.0 FORMULA_0010 0.0 65535.0000 /end CHARACTERISTIC
/begin CHARACTERISTIC K_ED_LAVK1_TRIM.P_CODE_OPENLOAD "P-Code fuer die Art OPENLOAD | EN: Fault code LAVK1_TRIM - OBD P-code reported for open circuit" VALUE 0x713D2 TKW_VV_VV_UW 100.0 FORMULA_0010 0.0 65535.0000 /end CHARACTERISTIC
/begin CHARACTERISTIC K_ED_KAT_OBD1.P_CODE_OPENLOAD "P-Code fuer die Art OPENLOAD | EN: Fault code KAT_OBD1 - OBD P-code reported for open circuit" VALUE 0x71524 TKW_VV_VV_UW 100.0 FORMULA_0010 0.0 65535.0000 /end CHARACTERISTIC
/begin CHARACTERISTIC K_ED_KAT_OBD2.P_CODE_OPENLOAD "P-Code fuer die Art OPENLOAD | EN: Fault code KAT_OBD2 - OBD P-code reported for open circuit" VALUE 0x7153E TKW_VV_VV_UW 100.0 FORMULA_0010 0.0 65535.0000 /end CHARACTERISTIC
/begin CHARACTERISTIC K_ED_FI_QLT.P_CODE_OPENLOAD "P-Code fuer die Art OPENLOAD | EN: Fault code FI_QLT - OBD P-code reported for open circuit" VALUE 0x715A6 TKW_VV_VV_UW 100.0 FORMULA_0010 0.0 65535.0000 /end CHARACTERISTIC
/begin CHARACTERISTIC K_ED_FI_PMBN.P_CODE_OPENLOAD "P-Code fuer die Art OPENLOAD | EN: Fault code FI_PMBN - OBD P-code reported for open circuit" VALUE 0x7160E TKW_VV_VV_UW 100.0 FORMULA_0010 0.0 65535.0000 /end CHARACTERISTIC
/begin CHARACTERISTIC K_ED_FI_PMRUHVERL.P_CODE_OPENLOAD "P-Code fuer die Art OPENLOAD | EN: Fault code FI_PMRUHVERL - OBD P-code reported for open circuit" VALUE 0x7172C TKW_VV_VV_UW 100.0 FORMULA_0010 0.0 65535.0000 /end CHARACTERISTIC
/begin CHARACTERISTIC K_ED_FI_TOENS.P_CODE_OPENLOAD "P-Code fuer die Art OPENLOAD | EN: Fault code FI_TOENS - OBD P-code reported for open circuit" VALUE 0x71746 TKW_VV_VV_UW 100.0 FORMULA_0010 0.0 65535.0000 /end CHARACTERISTIC
/begin CHARACTERISTIC K_ED_KW.P_CODE_OPENLOAD "P-Code fuer die Art OPENLOAD | EN: Fault code KW - OBD P-code reported for open circuit" VALUE 0x71864 TKW_VV_VV_UW 100.0 FORMULA_0010 0.0 65535.0000 /end CHARACTERISTIC
/begin CHARACTERISTIC K_ED_LA1_ADAPT.P_CODE_OPENLOAD "P-Code fuer die Art OPENLOAD | EN: Fault code LA1_ADAPT - OBD P-code reported for open circuit" VALUE 0x7187E TKW_VV_VV_UW 100.0 FORMULA_0010 0.0 65535.0000 /end CHARACTERISTIC
/begin CHARACTERISTIC K_ED_LA2_ADAPT.P_CODE_OPENLOAD "P-Code fuer die Art OPENLOAD | EN: Fault code LA2_ADAPT - OBD P-code reported for open circuit" VALUE 0x71898 TKW_VV_VV_UW 100.0 FORMULA_0010 0.0 65535.0000 /end CHARACTERISTIC
/begin CHARACTERISTIC K_ED_KGE1.P_CODE_OPENLOAD "P-Code fuer die Art OPENLOAD | EN: Fault code KGE1 - OBD P-code reported for open circuit" VALUE 0x718B2 TKW_VV_VV_UW 100.0 FORMULA_0010 0.0 65535.0000 /end CHARACTERISTIC
/begin CHARACTERISTIC K_ED_KGE2.P_CODE_OPENLOAD "P-Code fuer die Art OPENLOAD | EN: Fault code KGE2 - OBD P-code reported for open circuit" VALUE 0x718CC TKW_VV_VV_UW 100.0 FORMULA_0010 0.0 65535.0000 /end CHARACTERISTIC
/begin CHARACTERISTIC K_ED_FST.P_CODE_OPENLOAD "P-Code fuer die Art OPENLOAD | EN: Fault code FST - OBD P-code reported for open circuit" VALUE 0x718E6 TKW_VV_VV_UW 100.0 FORMULA_0010 0.0 65535.0000 /end CHARACTERISTIC
/begin CHARACTERISTIC K_ED_KSD1.P_CODE_OPENLOAD "P-Code fuer die Art OPENLOAD | EN: Fault code KSD1 - OBD P-code reported for open circuit" VALUE 0x71A1E TKW_VV_VV_UW 100.0 FORMULA_0010 0.0 65535.0000 /end CHARACTERISTIC
/begin CHARACTERISTIC K_ED_KSD2.P_CODE_OPENLOAD "P-Code fuer die Art OPENLOAD | EN: Fault code KSD2 - OBD P-code reported for open circuit" VALUE 0x71A38 TKW_VV_VV_UW 100.0 FORMULA_0010 0.0 65535.0000 /end CHARACTERISTIC
/begin CHARACTERISTIC K_ED_KATS_B1.P_CODE_OPENLOAD "P-Code fuer die Art OPENLOAD | EN: Fault code KATS_B1 - OBD P-code reported for open circuit" VALUE 0x71A52 TKW_VV_VV_UW 100.0 FORMULA_0010 0.0 65535.0000 /end CHARACTERISTIC
/begin CHARACTERISTIC K_ED_KATS_B2.P_CODE_OPENLOAD "P-Code fuer die Art OPENLOAD | EN: Fault code KATS_B2 - OBD P-code reported for open circuit" VALUE 0x71A6C TKW_VV_VV_UW 100.0 FORMULA_0010 0.0 65535.0000 /end CHARACTERISTIC
/begin CHARACTERISTIC K_ED_FST_GEBER.P_CODE_OPENLOAD "P-Code fuer die Art OPENLOAD | EN: Fault code FST_GEBER - OBD P-code reported for open circuit" VALUE 0x71ABA TKW_VV_VV_UW 100.0 FORMULA_0010 0.0 65535.0000 /end CHARACTERISTIC
/begin CHARACTERISTIC K_ED_LA1_TRIM_AD.P_CODE_OPENLOAD "P-Code fuer die Art OPENLOAD | EN: Fault code LA1_TRIM_AD - OBD P-code reported for open circuit" VALUE 0x71B56 TKW_VV_VV_UW 100.0 FORMULA_0010 0.0 65535.0000 /end CHARACTERISTIC
/begin CHARACTERISTIC K_ED_LA2_TRIM_AD.P_CODE_OPENLOAD "P-Code fuer die Art OPENLOAD | EN: Fault code LA2_TRIM_AD - OBD P-code reported for open circuit" VALUE 0x71B70 TKW_VV_VV_UW 100.0 FORMULA_0010 0.0 65535.0000 /end CHARACTERISTIC
/begin CHARACTERISTIC K_ED_LANK1_OPENLOAD.P_CODE_OPENLOAD "P-Code fuer die Art OPENLOAD | EN: Fault code LANK1_OPENLOAD - OBD P-code reported for open circuit" VALUE 0x71B8A TKW_VV_VV_UW 100.0 FORMULA_0010 0.0 65535.0000 /end CHARACTERISTIC
/begin CHARACTERISTIC K_ED_LANK2_OPENLOAD.P_CODE_OPENLOAD "P-Code fuer die Art OPENLOAD | EN: Fault code LANK2_OPENLOAD - OBD P-code reported for open circuit" VALUE 0x71BA4 TKW_VV_VV_UW 100.0 FORMULA_0010 0.0 65535.0000 /end CHARACTERISTIC
/begin CHARACTERISTIC K_ED_LANK1_OBD_WE.P_CODE_OPENLOAD "P-Code fuer die Art OPENLOAD | EN: Fault code LANK1_OBD_WE - OBD P-code reported for open circuit" VALUE 0x71BBE TKW_VV_VV_UW 100.0 FORMULA_0010 0.0 65535.0000 /end CHARACTERISTIC
/begin CHARACTERISTIC K_ED_LANK2_OBD_WE.P_CODE_OPENLOAD "P-Code fuer die Art OPENLOAD | EN: Fault code LANK2_OBD_WE - OBD P-code reported for open circuit" VALUE 0x71BD8 TKW_VV_VV_UW 100.0 FORMULA_0010 0.0 65535.0000 /end CHARACTERISTIC
/begin CHARACTERISTIC K_ED_FST_GEBER_LI.P_CODE_OPENLOAD "P-Code fuer die Art OPENLOAD" VALUE 0x71CDC TKW_VV_VV_UW 100.0 FORMULA_0010 0.0 65535.0000 /end CHARACTERISTIC
/begin CHARACTERISTIC K_ED_FST_GEBER_RE.P_CODE_OPENLOAD "P-Code fuer die Art OPENLOAD" VALUE 0x71CF6 TKW_VV_VV_UW 100.0 FORMULA_0010 0.0 65535.0000 /end CHARACTERISTIC
/begin CHARACTERISTIC K_ED_LANK1_OBD_SLOPE.P_CODE_OPENLOAD "P-Code fuer die Art OPENLOAD" VALUE 0x71D10 TKW_VV_VV_UW 100.0 FORMULA_0010 0.0 65535.0000 /end CHARACTERISTIC
/begin CHARACTERISTIC K_ED_LANK2_OBD_SLOPE.P_CODE_OPENLOAD "P-Code fuer die Art OPENLOAD" VALUE 0x71D2A TKW_VV_VV_UW 100.0 FORMULA_0010 0.0 65535.0000 /end CHARACTERISTIC
/begin CHARACTERISTIC K_ED_INDEX_204_INJ.P_CODE_OPENLOAD "P-Code fuer die Art OPENLOAD | EN: Fault code INDEX_204_INJ - OBD P-code reported for open circuit" VALUE 0x71D92 TKW_VV_VV_UW 100.0 FORMULA_0010 0.0 65535.0000 /end CHARACTERISTIC
/begin CHARACTERISTIC K_ED_INDEX_205_INJ.P_CODE_OPENLOAD "P-Code fuer die Art OPENLOAD | EN: Fault code INDEX_205_INJ - OBD P-code reported for open circuit" VALUE 0x71DAC TKW_VV_VV_UW 100.0 FORMULA_0010 0.0 65535.0000 /end CHARACTERISTIC
/begin CHARACTERISTIC K_ED_INDEX_206_INJ.P_CODE_OPENLOAD "P-Code fuer die Art OPENLOAD | EN: Fault code INDEX_206_INJ - OBD P-code reported for open circuit" VALUE 0x71DC6 TKW_VV_VV_UW 100.0 FORMULA_0010 0.0 65535.0000 /end CHARACTERISTIC
/begin CHARACTERISTIC K_ED_INDEX_207_INJ.P_CODE_OPENLOAD "P-Code fuer die Art OPENLOAD | EN: P-Code fuer die Art OPENLOAD" VALUE 0x71DE0 TKW_VV_VV_UW 100.0 FORMULA_0010 0.0 65535.0000 /end CHARACTERISTIC
/begin CHARACTERISTIC K_ED_INDEX_208_INJ.P_CODE_OPENLOAD "P-Code fuer die Art OPENLOAD | EN: P-Code fuer die Art OPENLOAD" VALUE 0x71DFA TKW_VV_VV_UW 100.0 FORMULA_0010 0.0 65535.0000 /end CHARACTERISTIC
/begin CHARACTERISTIC K_ED_INDEX_209_INJ.P_CODE_OPENLOAD "P-Code fuer die Art OPENLOAD" VALUE 0x71E14 TKW_VV_VV_UW 100.0 FORMULA_0010 0.0 65535.0000 /end CHARACTERISTIC
/begin CHARACTERISTIC K_ED_INDEX_210_INJ.P_CODE_OPENLOAD "P-Code fuer die Art OPENLOAD" VALUE 0x71E2E TKW_VV_VV_UW 100.0 FORMULA_0010 0.0 65535.0000 /end CHARACTERISTIC
/begin CHARACTERISTIC K_ED_INDEX_211_INJ.P_CODE_OPENLOAD "P-Code fuer die Art OPENLOAD" VALUE 0x71E48 TKW_VV_VV_UW 100.0 FORMULA_0010 0.0 65535.0000 /end CHARACTERISTIC
/begin CHARACTERISTIC K_ED_INDEX_212_INJ.P_CODE_OPENLOAD "P-Code fuer die Art OPENLOAD | EN: P-Code fuer die Art OPENLOAD" VALUE 0x71E62 TKW_VV_VV_UW 100.0 FORMULA_0010 0.0 65535.0000 /end CHARACTERISTIC
/begin CHARACTERISTIC K_ED_INDEX_213_INJ.P_CODE_OPENLOAD "P-Code fuer die Art OPENLOAD" VALUE 0x71E7C TKW_VV_VV_UW 100.0 FORMULA_0010 0.0 65535.0000 /end CHARACTERISTIC
/begin CHARACTERISTIC K_ED_INDEX_214_INJ.P_CODE_OPENLOAD "P-Code fuer die Art OPENLOAD" VALUE 0x71E96 TKW_VV_VV_UW 100.0 FORMULA_0010 0.0 65535.0000 /end CHARACTERISTIC
/begin CHARACTERISTIC K_ED_INDEX_215_INJ.P_CODE_OPENLOAD "P-Code fuer die Art OPENLOAD" VALUE 0x71EB0 TKW_VV_VV_UW 100.0 FORMULA_0010 0.0 65535.0000 /end CHARACTERISTIC
/begin CHARACTERISTIC K_ED_INDEX_216_INJ.P_CODE_OPENLOAD "P-Code fuer die Art OPENLOAD | EN: P-Code fuer die Art OPENLOAD" VALUE 0x71ECA TKW_VV_VV_UW 100.0 FORMULA_0010 0.0 65535.0000 /end CHARACTERISTIC
/begin CHARACTERISTIC K_ED_INDEX_217_INJ.P_CODE_OPENLOAD "P-Code fuer die Art OPENLOAD | EN: P-Code fuer die Art OPENLOAD" VALUE 0x71EE4 TKW_VV_VV_UW 100.0 FORMULA_0010 0.0 65535.0000 /end CHARACTERISTIC
/begin CHARACTERISTIC K_ED_INDEX_218_INJ.P_CODE_OPENLOAD "P-Code fuer die Art OPENLOAD | EN: P-Code fuer die Art OPENLOAD" VALUE 0x71EFE TKW_VV_VV_UW 100.0 FORMULA_0010 0.0 65535.0000 /end CHARACTERISTIC
/begin CHARACTERISTIC K_ED_INDEX_219_INJ.P_CODE_OPENLOAD "P-Code fuer die Art OPENLOAD | EN: P-Code fuer die Art OPENLOAD" VALUE 0x71F18 TKW_VV_VV_UW 100.0 FORMULA_0010 0.0 65535.0000 /end CHARACTERISTIC
/begin CHARACTERISTIC K_ED_INDEX_220_INJ.P_CODE_OPENLOAD "P-Code fuer die Art OPENLOAD | EN: P-Code fuer die Art OPENLOAD" VALUE 0x71F32 TKW_VV_VV_UW 100.0 FORMULA_0010 0.0 65535.0000 /end CHARACTERISTIC
/begin CHARACTERISTIC K_ED_INDEX_221_INJ.P_CODE_OPENLOAD "P-Code fuer die Art OPENLOAD | EN: P-Code fuer die Art OPENLOAD" VALUE 0x71F4C TKW_VV_VV_UW 100.0 FORMULA_0010 0.0 65535.0000 /end CHARACTERISTIC
/begin CHARACTERISTIC K_ED_INDEX_222_INJ.P_CODE_OPENLOAD "P-Code fuer die Art OPENLOAD | EN: P-Code fuer die Art OPENLOAD" VALUE 0x71F66 TKW_VV_VV_UW 100.0 FORMULA_0010 0.0 65535.0000 /end CHARACTERISTIC
/begin CHARACTERISTIC K_ED_INDEX_223_INJ.P_CODE_OPENLOAD "P-Code fuer die Art OPENLOAD | EN: P-Code fuer die Art OPENLOAD" VALUE 0x71F80 TKW_VV_VV_UW 100.0 FORMULA_0010 0.0 65535.0000 /end CHARACTERISTIC
/begin CHARACTERISTIC K_ED_HFM1.P_CODE_UNPLAUSIBEL "P-Code fuer die Art UNPLAUSIBEL | EN: Fault code HFM1 - OBD P-code reported for implausible signal" VALUE 0x70910 TKW_VV_VV_UW 100.0 FORMULA_0010 0.0 65535.0000 /end CHARACTERISTIC
/begin CHARACTERISTIC K_ED_HFM2.P_CODE_UNPLAUSIBEL "P-Code fuer die Art UNPLAUSIBEL | EN: Fault code HFM2 - OBD P-code reported for implausible signal" VALUE 0x7092A TKW_VV_VV_UW 100.0 FORMULA_0010 0.0 65535.0000 /end CHARACTERISTIC
/begin CHARACTERISTIC K_ED_LAVK1.P_CODE_UNPLAUSIBEL "P-Code fuer die Art UNPLAUSIBEL | EN: Fault code LAVK1 - OBD P-code reported for implausible signal" VALUE 0x70AE4 TKW_VV_VV_UW 100.0 FORMULA_0010 0.0 65535.0000 /end CHARACTERISTIC
/begin CHARACTERISTIC K_ED_LAVK1_OBD_PLAU.P_CODE_UNPLAUSIBEL "P-Code fuer die Art UNPLAUSIBEL | EN: Fault code LAVK1_OBD_PLAU - OBD P-code reported for implausible signal" VALUE 0x70B18 TKW_VV_VV_UW 100.0 FORMULA_0010 0.0 65535.0000 /end CHARACTERISTIC
/begin CHARACTERISTIC K_ED_LAVK1_OBD_SA.P_CODE_UNPLAUSIBEL "P-Code fuer die Art UNPLAUSIBEL | EN: Fault code LAVK1_OBD_SA - OBD P-code reported for implausible signal" VALUE 0x70B4C TKW_VV_VV_UW 100.0 FORMULA_0010 0.0 65535.0000 /end CHARACTERISTIC
/begin CHARACTERISTIC K_ED_LANK1.P_CODE_UNPLAUSIBEL "P-Code fuer die Art UNPLAUSIBEL | EN: Fault code LANK1 - OBD P-code reported for implausible signal" VALUE 0x70B80 TKW_VV_VV_UW 100.0 FORMULA_0010 0.0 65535.0000 /end CHARACTERISTIC
/begin CHARACTERISTIC K_ED_LANK2.P_CODE_UNPLAUSIBEL "P-Code fuer die Art UNPLAUSIBEL | EN: Fault code LANK2 - OBD P-code reported for implausible signal" VALUE 0x70B9A TKW_VV_VV_UW 100.0 FORMULA_0010 0.0 65535.0000 /end CHARACTERISTIC
/begin CHARACTERISTIC K_ED_FPLAU1.P_CODE_UNPLAUSIBEL "P-Code fuer die Art UNPLAUSIBEL | EN: Fault code FPLAU1 - OBD P-code reported for implausible signal" VALUE 0x70CD2 TKW_VV_VV_UW 100.0 FORMULA_0010 0.0 65535.0000 /end CHARACTERISTIC
/begin CHARACTERISTIC K_ED_FPLAU2.P_CODE_UNPLAUSIBEL "P-Code fuer die Art UNPLAUSIBEL | EN: Fault code FPLAU2 - OBD P-code reported for implausible signal" VALUE 0x70CEC TKW_VV_VV_UW 100.0 FORMULA_0010 0.0 65535.0000 /end CHARACTERISTIC
/begin CHARACTERISTIC K_ED_LANK1_OBD_S.P_CODE_UNPLAUSIBEL "P-Code fuer die Art UNPLAUSIBEL | EN: Fault code LANK1_OBD_S - OBD P-code reported for implausible signal" VALUE 0x70D20 TKW_VV_VV_UW 100.0 FORMULA_0010 0.0 65535.0000 /end CHARACTERISTIC
/begin CHARACTERISTIC K_ED_LANK2_OBD_S.P_CODE_UNPLAUSIBEL "P-Code fuer die Art UNPLAUSIBEL | EN: Fault code LANK2_OBD_S - OBD P-code reported for implausible signal" VALUE 0x70D3A TKW_VV_VV_UW 100.0 FORMULA_0010 0.0 65535.0000 /end CHARACTERISTIC
/begin CHARACTERISTIC K_ED_LAVK1_OBD_TL.P_CODE_UNPLAUSIBEL "P-Code fuer die Art UNPLAUSIBEL | EN: Fault code LAVK1_OBD_TL - OBD P-code reported for implausible signal" VALUE 0x70D54 TKW_VV_VV_UW 100.0 FORMULA_0010 0.0 65535.0000 /end CHARACTERISTIC
/begin CHARACTERISTIC K_ED_LAVK1_DIAG.P_CODE_UNPLAUSIBEL "P-Code fuer die Art UNPLAUSIBEL | EN: Fault code LAVK1_DIAG - OBD P-code reported for implausible signal" VALUE 0x70E8C TKW_VV_VV_UW 100.0 FORMULA_0010 0.0 65535.0000 /end CHARACTERISTIC
/begin CHARACTERISTIC K_ED_LAVK1_IA_OPENLOAD.P_CODE_UNPLAUSIBEL "P-Code fuer die Art UNPLAUSIBEL | EN: Fault code LAVK1_IA_OPENLOAD - OBD P-code reported for implausible signal" VALUE 0x70EC0 TKW_VV_VV_UW 100.0 FORMULA_0010 0.0 65535.0000 /end CHARACTERISTIC
/begin CHARACTERISTIC K_ED_LAVK1_IP_OPENLOAD.P_CODE_UNPLAUSIBEL "P-Code fuer die Art UNPLAUSIBEL | EN: Fault code LAVK1_IP_OPENLOAD - OBD P-code reported for implausible signal" VALUE 0x70F5C TKW_VV_VV_UW 100.0 FORMULA_0010 0.0 65535.0000 /end CHARACTERISTIC
/begin CHARACTERISTIC K_ED_LAM1_REG.P_CODE_UNPLAUSIBEL "P-Code fuer die Art UNPLAUSIBEL | EN: Fault code LAM1_REG - OBD P-code reported for implausible signal" VALUE 0x710AE TKW_VV_VV_UW 100.0 FORMULA_0010 0.0 65535.0000 /end CHARACTERISTIC
/begin CHARACTERISTIC K_ED_LAM2_REG.P_CODE_UNPLAUSIBEL "P-Code fuer die Art UNPLAUSIBEL | EN: Fault code LAM2_REG - OBD P-code reported for implausible signal" VALUE 0x710C8 TKW_VV_VV_UW 100.0 FORMULA_0010 0.0 65535.0000 /end CHARACTERISTIC
/begin CHARACTERISTIC K_ED_LAVK1_OBD_DYN.P_CODE_UNPLAUSIBEL "P-Code fuer die Art UNPLAUSIBEL | EN: Fault code LAVK1_OBD_DYN - OBD P-code reported for implausible signal" VALUE 0x712B6 TKW_VV_VV_UW 100.0 FORMULA_0010 0.0 65535.0000 /end CHARACTERISTIC
/begin CHARACTERISTIC K_ED_LAVK1_TRIM.P_CODE_UNPLAUSIBEL "P-Code fuer die Art UNPLAUSIBEL | EN: Fault code LAVK1_TRIM - OBD P-code reported for implausible signal" VALUE 0x713D4 TKW_VV_VV_UW 100.0 FORMULA_0010 0.0 65535.0000 /end CHARACTERISTIC
/begin CHARACTERISTIC K_ED_KAT_OBD1.P_CODE_UNPLAUSIBEL "P-Code fuer die Art UNPLAUSIBEL | EN: Fault code KAT_OBD1 - OBD P-code reported for implausible signal" VALUE 0x71526 TKW_VV_VV_UW 100.0 FORMULA_0010 0.0 65535.0000 /end CHARACTERISTIC
/begin CHARACTERISTIC K_ED_KAT_OBD2.P_CODE_UNPLAUSIBEL "P-Code fuer die Art UNPLAUSIBEL | EN: Fault code KAT_OBD2 - OBD P-code reported for implausible signal" VALUE 0x71540 TKW_VV_VV_UW 100.0 FORMULA_0010 0.0 65535.0000 /end CHARACTERISTIC
/begin CHARACTERISTIC K_ED_FI_QLT.P_CODE_UNPLAUSIBEL "P-Code fuer die Art UNPLAUSIBEL | EN: Fault code FI_QLT - OBD P-code reported for implausible signal" VALUE 0x715A8 TKW_VV_VV_UW 100.0 FORMULA_0010 0.0 65535.0000 /end CHARACTERISTIC
/begin CHARACTERISTIC K_ED_FI_PMBN.P_CODE_UNPLAUSIBEL "P-Code fuer die Art UNPLAUSIBEL | EN: Fault code FI_PMBN - OBD P-code reported for implausible signal" VALUE 0x71610 TKW_VV_VV_UW 100.0 FORMULA_0010 0.0 65535.0000 /end CHARACTERISTIC
/begin CHARACTERISTIC K_ED_FI_PMRUHVERL.P_CODE_UNPLAUSIBEL "P-Code fuer die Art UNPLAUSIBEL | EN: Fault code FI_PMRUHVERL - OBD P-code reported for implausible signal" VALUE 0x7172E TKW_VV_VV_UW 100.0 FORMULA_0010 0.0 65535.0000 /end CHARACTERISTIC
/begin CHARACTERISTIC K_ED_FI_TOENS.P_CODE_UNPLAUSIBEL "P-Code fuer die Art UNPLAUSIBEL | EN: Fault code FI_TOENS - OBD P-code reported for implausible signal" VALUE 0x71748 TKW_VV_VV_UW 100.0 FORMULA_0010 0.0 65535.0000 /end CHARACTERISTIC
/begin CHARACTERISTIC K_ED_KW.P_CODE_UNPLAUSIBEL "P-Code fuer die Art UNPLAUSIBEL | EN: Fault code KW - OBD P-code reported for implausible signal" VALUE 0x71866 TKW_VV_VV_UW 100.0 FORMULA_0010 0.0 65535.0000 /end CHARACTERISTIC
/begin CHARACTERISTIC K_ED_LA1_ADAPT.P_CODE_UNPLAUSIBEL "P-Code fuer die Art UNPLAUSIBEL | EN: Fault code LA1_ADAPT - OBD P-code reported for implausible signal" VALUE 0x71880 TKW_VV_VV_UW 100.0 FORMULA_0010 0.0 65535.0000 /end CHARACTERISTIC
/begin CHARACTERISTIC K_ED_LA2_ADAPT.P_CODE_UNPLAUSIBEL "P-Code fuer die Art UNPLAUSIBEL | EN: Fault code LA2_ADAPT - OBD P-code reported for implausible signal" VALUE 0x7189A TKW_VV_VV_UW 100.0 FORMULA_0010 0.0 65535.0000 /end CHARACTERISTIC
/begin CHARACTERISTIC K_ED_KGE1.P_CODE_UNPLAUSIBEL "P-Code fuer die Art UNPLAUSIBEL | EN: Fault code KGE1 - OBD P-code reported for implausible signal" VALUE 0x718B4 TKW_VV_VV_UW 100.0 FORMULA_0010 0.0 65535.0000 /end CHARACTERISTIC
/begin CHARACTERISTIC K_ED_KGE2.P_CODE_UNPLAUSIBEL "P-Code fuer die Art UNPLAUSIBEL | EN: Fault code KGE2 - OBD P-code reported for implausible signal" VALUE 0x718CE TKW_VV_VV_UW 100.0 FORMULA_0010 0.0 65535.0000 /end CHARACTERISTIC
/begin CHARACTERISTIC K_ED_FST.P_CODE_UNPLAUSIBEL "P-Code fuer die Art UNPLAUSIBEL | EN: Fault code FST - OBD P-code reported for implausible signal" VALUE 0x718E8 TKW_VV_VV_UW 100.0 FORMULA_0010 0.0 65535.0000 /end CHARACTERISTIC
/begin CHARACTERISTIC K_ED_KSD1.P_CODE_UNPLAUSIBEL "P-Code fuer die Art UNPLAUSIBEL | EN: Fault code KSD1 - OBD P-code reported for implausible signal" VALUE 0x71A20 TKW_VV_VV_UW 100.0 FORMULA_0010 0.0 65535.0000 /end CHARACTERISTIC
/begin CHARACTERISTIC K_ED_KSD2.P_CODE_UNPLAUSIBEL "P-Code fuer die Art UNPLAUSIBEL | EN: Fault code KSD2 - OBD P-code reported for implausible signal" VALUE 0x71A3A TKW_VV_VV_UW 100.0 FORMULA_0010 0.0 65535.0000 /end CHARACTERISTIC
/begin CHARACTERISTIC K_ED_KATS_B1.P_CODE_UNPLAUSIBEL "P-Code fuer die Art UNPLAUSIBEL | EN: Fault code KATS_B1 - OBD P-code reported for implausible signal" VALUE 0x71A54 TKW_VV_VV_UW 100.0 FORMULA_0010 0.0 65535.0000 /end CHARACTERISTIC
/begin CHARACTERISTIC K_ED_KATS_B2.P_CODE_UNPLAUSIBEL "P-Code fuer die Art UNPLAUSIBEL | EN: Fault code KATS_B2 - OBD P-code reported for implausible signal" VALUE 0x71A6E TKW_VV_VV_UW 100.0 FORMULA_0010 0.0 65535.0000 /end CHARACTERISTIC
/begin CHARACTERISTIC K_ED_FST_GEBER.P_CODE_UNPLAUSIBEL "P-Code fuer die Art UNPLAUSIBEL | EN: Fault code FST_GEBER - OBD P-code reported for implausible signal" VALUE 0x71ABC TKW_VV_VV_UW 100.0 FORMULA_0010 0.0 65535.0000 /end CHARACTERISTIC
/begin CHARACTERISTIC K_ED_LA1_TRIM_AD.P_CODE_UNPLAUSIBEL "P-Code fuer die Art UNPLAUSIBEL | EN: Fault code LA1_TRIM_AD - OBD P-code reported for implausible signal" VALUE 0x71B58 TKW_VV_VV_UW 100.0 FORMULA_0010 0.0 65535.0000 /end CHARACTERISTIC
/begin CHARACTERISTIC K_ED_LA2_TRIM_AD.P_CODE_UNPLAUSIBEL "P-Code fuer die Art UNPLAUSIBEL | EN: Fault code LA2_TRIM_AD - OBD P-code reported for implausible signal" VALUE 0x71B72 TKW_VV_VV_UW 100.0 FORMULA_0010 0.0 65535.0000 /end CHARACTERISTIC
/begin CHARACTERISTIC K_ED_LANK1_OPENLOAD.P_CODE_UNPLAUSIBEL "P-Code fuer die Art UNPLAUSIBEL | EN: Fault code LANK1_OPENLOAD - OBD P-code reported for implausible signal" VALUE 0x71B8C TKW_VV_VV_UW 100.0 FORMULA_0010 0.0 65535.0000 /end CHARACTERISTIC
/begin CHARACTERISTIC K_ED_LANK2_OPENLOAD.P_CODE_UNPLAUSIBEL "P-Code fuer die Art UNPLAUSIBEL | EN: Fault code LANK2_OPENLOAD - OBD P-code reported for implausible signal" VALUE 0x71BA6 TKW_VV_VV_UW 100.0 FORMULA_0010 0.0 65535.0000 /end CHARACTERISTIC
/begin CHARACTERISTIC K_ED_LANK1_OBD_WE.P_CODE_UNPLAUSIBEL "P-Code fuer die Art UNPLAUSIBEL | EN: Fault code LANK1_OBD_WE - OBD P-code reported for implausible signal" VALUE 0x71BC0 TKW_VV_VV_UW 100.0 FORMULA_0010 0.0 65535.0000 /end CHARACTERISTIC
/begin CHARACTERISTIC K_ED_LANK2_OBD_WE.P_CODE_UNPLAUSIBEL "P-Code fuer die Art UNPLAUSIBEL | EN: Fault code LANK2_OBD_WE - OBD P-code reported for implausible signal" VALUE 0x71BDA TKW_VV_VV_UW 100.0 FORMULA_0010 0.0 65535.0000 /end CHARACTERISTIC
/begin CHARACTERISTIC K_ED_FST_GEBER_LI.P_CODE_UNPLAUSIBEL "P-Code fuer die Art UNPLAUSIBEL" VALUE 0x71CDE TKW_VV_VV_UW 100.0 FORMULA_0010 0.0 65535.0000 /end CHARACTERISTIC
/begin CHARACTERISTIC K_ED_FST_GEBER_RE.P_CODE_UNPLAUSIBEL "P-Code fuer die Art UNPLAUSIBEL" VALUE 0x71CF8 TKW_VV_VV_UW 100.0 FORMULA_0010 0.0 65535.0000 /end CHARACTERISTIC
/begin CHARACTERISTIC K_ED_LANK1_OBD_SLOPE.P_CODE_UNPLAUSIBEL "P-Code fuer die Art UNPLAUSIBEL" VALUE 0x71D12 TKW_VV_VV_UW 100.0 FORMULA_0010 0.0 65535.0000 /end CHARACTERISTIC
/begin CHARACTERISTIC K_ED_LANK2_OBD_SLOPE.P_CODE_UNPLAUSIBEL "P-Code fuer die Art UNPLAUSIBEL" VALUE 0x71D2C TKW_VV_VV_UW 100.0 FORMULA_0010 0.0 65535.0000 /end CHARACTERISTIC
/begin CHARACTERISTIC K_ED_INDEX_204_INJ.P_CODE_UNPLAUSIBEL "P-Code fuer die Art UNPLAUSIBEL | EN: Fault code INDEX_204_INJ - OBD P-code reported for implausible signal" VALUE 0x71D94 TKW_VV_VV_UW 100.0 FORMULA_0010 0.0 65535.0000 /end CHARACTERISTIC
/begin CHARACTERISTIC K_ED_INDEX_205_INJ.P_CODE_UNPLAUSIBEL "P-Code fuer die Art UNPLAUSIBEL | EN: Fault code INDEX_205_INJ - OBD P-code reported for implausible signal" VALUE 0x71DAE TKW_VV_VV_UW 100.0 FORMULA_0010 0.0 65535.0000 /end CHARACTERISTIC
/begin CHARACTERISTIC K_ED_INDEX_206_INJ.P_CODE_UNPLAUSIBEL "P-Code fuer die Art UNPLAUSIBEL | EN: Fault code INDEX_206_INJ - OBD P-code reported for implausible signal" VALUE 0x71DC8 TKW_VV_VV_UW 100.0 FORMULA_0010 0.0 65535.0000 /end CHARACTERISTIC
/begin CHARACTERISTIC K_ED_INDEX_207_INJ.P_CODE_UNPLAUSIBEL "P-Code fuer die Art UNPLAUSIBEL" VALUE 0x71DE2 TKW_VV_VV_UW 100.0 FORMULA_0010 0.0 65535.0000 /end CHARACTERISTIC
/begin CHARACTERISTIC K_ED_INDEX_208_INJ.P_CODE_UNPLAUSIBEL "P-Code fuer die Art UNPLAUSIBEL" VALUE 0x71DFC TKW_VV_VV_UW 100.0 FORMULA_0010 0.0 65535.0000 /end CHARACTERISTIC
/begin CHARACTERISTIC K_ED_INDEX_209_INJ.P_CODE_UNPLAUSIBEL "P-Code fuer die Art UNPLAUSIBEL" VALUE 0x71E16 TKW_VV_VV_UW 100.0 FORMULA_0010 0.0 65535.0000 /end CHARACTERISTIC
/begin CHARACTERISTIC K_ED_INDEX_210_INJ.P_CODE_UNPLAUSIBEL "P-Code fuer die Art UNPLAUSIBEL" VALUE 0x71E30 TKW_VV_VV_UW 100.0 FORMULA_0010 0.0 65535.0000 /end CHARACTERISTIC
/begin CHARACTERISTIC K_ED_INDEX_211_INJ.P_CODE_UNPLAUSIBEL "P-Code fuer die Art UNPLAUSIBEL" VALUE 0x71E4A TKW_VV_VV_UW 100.0 FORMULA_0010 0.0 65535.0000 /end CHARACTERISTIC
/begin CHARACTERISTIC K_ED_INDEX_212_INJ.P_CODE_UNPLAUSIBEL "P-Code fuer die Art UNPLAUSIBEL | EN: P-Code fuer die Art UNPLAUSIBEL" VALUE 0x71E64 TKW_VV_VV_UW 100.0 FORMULA_0010 0.0 65535.0000 /end CHARACTERISTIC
/begin CHARACTERISTIC K_ED_INDEX_213_INJ.P_CODE_UNPLAUSIBEL "P-Code fuer die Art UNPLAUSIBEL" VALUE 0x71E7E TKW_VV_VV_UW 100.0 FORMULA_0010 0.0 65535.0000 /end CHARACTERISTIC
/begin CHARACTERISTIC K_ED_INDEX_214_INJ.P_CODE_UNPLAUSIBEL "P-Code fuer die Art UNPLAUSIBEL" VALUE 0x71E98 TKW_VV_VV_UW 100.0 FORMULA_0010 0.0 65535.0000 /end CHARACTERISTIC
/begin CHARACTERISTIC K_ED_INDEX_215_INJ.P_CODE_UNPLAUSIBEL "P-Code fuer die Art UNPLAUSIBEL" VALUE 0x71EB2 TKW_VV_VV_UW 100.0 FORMULA_0010 0.0 65535.0000 /end CHARACTERISTIC
/begin CHARACTERISTIC K_ED_INDEX_216_INJ.P_CODE_UNPLAUSIBEL "P-Code fuer die Art UNPLAUSIBEL | EN: P-Code fuer die Art UNPLAUSIBEL" VALUE 0x71ECC TKW_VV_VV_UW 100.0 FORMULA_0010 0.0 65535.0000 /end CHARACTERISTIC
/begin CHARACTERISTIC K_ED_INDEX_217_INJ.P_CODE_UNPLAUSIBEL "P-Code fuer die Art UNPLAUSIBEL | EN: P-Code fuer die Art UNPLAUSIBEL" VALUE 0x71EE6 TKW_VV_VV_UW 100.0 FORMULA_0010 0.0 65535.0000 /end CHARACTERISTIC
/begin CHARACTERISTIC K_ED_INDEX_218_INJ.P_CODE_UNPLAUSIBEL "P-Code fuer die Art UNPLAUSIBEL | EN: P-Code fuer die Art UNPLAUSIBEL" VALUE 0x71F00 TKW_VV_VV_UW 100.0 FORMULA_0010 0.0 65535.0000 /end CHARACTERISTIC
/begin CHARACTERISTIC K_ED_INDEX_219_INJ.P_CODE_UNPLAUSIBEL "P-Code fuer die Art UNPLAUSIBEL | EN: P-Code fuer die Art UNPLAUSIBEL" VALUE 0x71F1A TKW_VV_VV_UW 100.0 FORMULA_0010 0.0 65535.0000 /end CHARACTERISTIC
/begin CHARACTERISTIC K_ED_INDEX_220_INJ.P_CODE_UNPLAUSIBEL "P-Code fuer die Art UNPLAUSIBEL | EN: P-Code fuer die Art UNPLAUSIBEL" VALUE 0x71F34 TKW_VV_VV_UW 100.0 FORMULA_0010 0.0 65535.0000 /end CHARACTERISTIC
/begin CHARACTERISTIC K_ED_INDEX_221_INJ.P_CODE_UNPLAUSIBEL "P-Code fuer die Art UNPLAUSIBEL | EN: P-Code fuer die Art UNPLAUSIBEL" VALUE 0x71F4E TKW_VV_VV_UW 100.0 FORMULA_0010 0.0 65535.0000 /end CHARACTERISTIC
/begin CHARACTERISTIC K_ED_INDEX_222_INJ.P_CODE_UNPLAUSIBEL "P-Code fuer die Art UNPLAUSIBEL" VALUE 0x71F68 TKW_VV_VV_UW 100.0 FORMULA_0010 0.0 65535.0000 /end CHARACTERISTIC
/begin CHARACTERISTIC K_ED_INDEX_223_INJ.P_CODE_UNPLAUSIBEL "P-Code fuer die Art UNPLAUSIBEL" VALUE 0x71F82 TKW_VV_VV_UW 100.0 FORMULA_0010 0.0 65535.0000 /end CHARACTERISTIC
/begin CHARACTERISTIC K_ED_HFM1.FEHLERSCHWELLE "Filterschwelle fuer Fehlereintrag | EN: Fault code HFM1 - debounce filter threshold for setting the fault" VALUE 0x70912 TKW_VV_VV_UB 100.0 FORMULA_0003 0.0 255.0000 /end CHARACTERISTIC
/begin CHARACTERISTIC K_ED_HFM2.FEHLERSCHWELLE "Filterschwelle fuer Fehlereintrag | EN: Fault code HFM2 - debounce filter threshold for setting the fault" VALUE 0x7092C TKW_VV_VV_UB 100.0 FORMULA_0003 0.0 255.0000 /end CHARACTERISTIC
/begin CHARACTERISTIC K_ED_LAVK1.FEHLERSCHWELLE "Filterschwelle fuer Fehlereintrag | EN: Fault code LAVK1 - debounce filter threshold for setting the fault" VALUE 0x70AE6 TKW_VV_VV_UB 100.0 FORMULA_0003 0.0 255.0000 /end CHARACTERISTIC
/begin CHARACTERISTIC K_ED_LAVK1_OBD_PLAU.FEHLERSCHWELLE "Filterschwelle fuer Fehlereintrag | EN: Fault code LAVK1_OBD_PLAU - debounce filter threshold for setting the fault" VALUE 0x70B1A TKW_VV_VV_UB 100.0 FORMULA_0003 0.0 255.0000 /end CHARACTERISTIC
/begin CHARACTERISTIC K_ED_LAVK1_OBD_SA.FEHLERSCHWELLE "Filterschwelle fuer Fehlereintrag | EN: Fault code LAVK1_OBD_SA - debounce filter threshold for setting the fault" VALUE 0x70B4E TKW_VV_VV_UB 100.0 FORMULA_0003 0.0 255.0000 /end CHARACTERISTIC
/begin CHARACTERISTIC K_ED_LANK1.FEHLERSCHWELLE "Filterschwelle fuer Fehlereintrag | EN: Fault code LANK1 - debounce filter threshold for setting the fault" VALUE 0x70B82 TKW_VV_VV_UB 100.0 FORMULA_0003 0.0 255.0000 /end CHARACTERISTIC
/begin CHARACTERISTIC K_ED_LANK2.FEHLERSCHWELLE "Filterschwelle fuer Fehlereintrag | EN: Fault code LANK2 - debounce filter threshold for setting the fault" VALUE 0x70B9C TKW_VV_VV_UB 100.0 FORMULA_0003 0.0 255.0000 /end CHARACTERISTIC
/begin CHARACTERISTIC K_ED_FPLAU1.FEHLERSCHWELLE "Filterschwelle fuer Fehlereintrag | EN: Fault code FPLAU1 - debounce filter threshold for setting the fault" VALUE 0x70CD4 TKW_VV_VV_UB 100.0 FORMULA_0003 0.0 255.0000 /end CHARACTERISTIC
/begin CHARACTERISTIC K_ED_FPLAU2.FEHLERSCHWELLE "Filterschwelle fuer Fehlereintrag | EN: Fault code FPLAU2 - debounce filter threshold for setting the fault" VALUE 0x70CEE TKW_VV_VV_UB 100.0 FORMULA_0003 0.0 255.0000 /end CHARACTERISTIC
/begin CHARACTERISTIC K_ED_LANK1_OBD_S.FEHLERSCHWELLE "Filterschwelle fuer Fehlereintrag | EN: Fault code LANK1_OBD_S - debounce filter threshold for setting the fault" VALUE 0x70D22 TKW_VV_VV_UB 100.0 FORMULA_0003 0.0 255.0000 /end CHARACTERISTIC
/begin CHARACTERISTIC K_ED_LANK2_OBD_S.FEHLERSCHWELLE "Filterschwelle fuer Fehlereintrag | EN: Fault code LANK2_OBD_S - debounce filter threshold for setting the fault" VALUE 0x70D3C TKW_VV_VV_UB 100.0 FORMULA_0003 0.0 255.0000 /end CHARACTERISTIC
/begin CHARACTERISTIC K_ED_LAVK1_OBD_TL.FEHLERSCHWELLE "Filterschwelle fuer Fehlereintrag | EN: Fault code LAVK1_OBD_TL - debounce filter threshold for setting the fault" VALUE 0x70D56 TKW_VV_VV_UB 100.0 FORMULA_0003 0.0 255.0000 /end CHARACTERISTIC
/begin CHARACTERISTIC K_ED_LAVK1_DIAG.FEHLERSCHWELLE "Filterschwelle fuer Fehlereintrag | EN: Fault code LAVK1_DIAG - debounce filter threshold for setting the fault" VALUE 0x70E8E TKW_VV_VV_UB 100.0 FORMULA_0003 0.0 255.0000 /end CHARACTERISTIC
/begin CHARACTERISTIC K_ED_LAVK1_IA_OPENLOAD.FEHLERSCHWELLE "Filterschwelle fuer Fehlereintrag | EN: Fault code LAVK1_IA_OPENLOAD - debounce filter threshold for setting the fault" VALUE 0x70EC2 TKW_VV_VV_UB 100.0 FORMULA_0003 0.0 255.0000 /end CHARACTERISTIC
/begin CHARACTERISTIC K_ED_LAVK1_UN_OPENLOAD.FEHLERSCHWELLE "Filterschwelle fuer Fehlereintrag | EN: Fault code LAVK1_UN_OPENLOAD - debounce filter threshold for setting the fault" VALUE 0x70F2A TKW_VV_VV_UB 100.0 FORMULA_0003 0.0 255.0000 /end CHARACTERISTIC
/begin CHARACTERISTIC K_ED_LAVK1_IP_OPENLOAD.FEHLERSCHWELLE "Filterschwelle fuer Fehlereintrag | EN: Fault code LAVK1_IP_OPENLOAD - debounce filter threshold for setting the fault" VALUE 0x70F5E TKW_VV_VV_UB 100.0 FORMULA_0003 0.0 255.0000 /end CHARACTERISTIC
/begin CHARACTERISTIC K_ED_LAM1_REG.FEHLERSCHWELLE "Filterschwelle fuer Fehlereintrag | EN: Fault code LAM1_REG - debounce filter threshold for setting the fault" VALUE 0x710B0 TKW_VV_VV_UB 100.0 FORMULA_0003 0.0 255.0000 /end CHARACTERISTIC
/begin CHARACTERISTIC K_ED_LAM2_REG.FEHLERSCHWELLE "Filterschwelle fuer Fehlereintrag | EN: Fault code LAM2_REG - debounce filter threshold for setting the fault" VALUE 0x710CA TKW_VV_VV_UB 100.0 FORMULA_0003 0.0 255.0000 /end CHARACTERISTIC
/begin CHARACTERISTIC K_ED_LAVK1_OBD_DYN.FEHLERSCHWELLE "Filterschwelle fuer Fehlereintrag | EN: Fault code LAVK1_OBD_DYN - debounce filter threshold for setting the fault" VALUE 0x712B8 TKW_VV_VV_UB 100.0 FORMULA_0003 0.0 255.0000 /end CHARACTERISTIC
/begin CHARACTERISTIC K_ED_LAVK1_TRIM.FEHLERSCHWELLE "Filterschwelle fuer Fehlereintrag | EN: Fault code LAVK1_TRIM - debounce filter threshold for setting the fault" VALUE 0x713D6 TKW_VV_VV_UB 100.0 FORMULA_0003 0.0 255.0000 /end CHARACTERISTIC
/begin CHARACTERISTIC K_ED_KAT_OBD1.FEHLERSCHWELLE "Filterschwelle fuer Fehlereintrag | EN: Fault code KAT_OBD1 - debounce filter threshold for setting the fault" VALUE 0x71528 TKW_VV_VV_UB 100.0 FORMULA_0003 0.0 255.0000 /end CHARACTERISTIC
/begin CHARACTERISTIC K_ED_KAT_OBD2.FEHLERSCHWELLE "Filterschwelle fuer Fehlereintrag | EN: Fault code KAT_OBD2 - debounce filter threshold for setting the fault" VALUE 0x71542 TKW_VV_VV_UB 100.0 FORMULA_0003 0.0 255.0000 /end CHARACTERISTIC
/begin CHARACTERISTIC K_ED_FI_QLT.FEHLERSCHWELLE "Filterschwelle fuer Fehlereintrag | EN: Fault code FI_QLT - debounce filter threshold for setting the fault" VALUE 0x715AA TKW_VV_VV_UB 100.0 FORMULA_0003 0.0 255.0000 /end CHARACTERISTIC
/begin CHARACTERISTIC K_ED_FI_PMBN.FEHLERSCHWELLE "Filterschwelle fuer Fehlereintrag | EN: Fault code FI_PMBN - debounce filter threshold for setting the fault" VALUE 0x71612 TKW_VV_VV_UB 100.0 FORMULA_0003 0.0 255.0000 /end CHARACTERISTIC
/begin CHARACTERISTIC K_ED_FI_PMRUHVERL.FEHLERSCHWELLE "Filterschwelle fuer Fehlereintrag | EN: Fault code FI_PMRUHVERL - debounce filter threshold for setting the fault" VALUE 0x71730 TKW_VV_VV_UB 100.0 FORMULA_0003 0.0 255.0000 /end CHARACTERISTIC
/begin CHARACTERISTIC K_ED_FI_TOENS.FEHLERSCHWELLE "Filterschwelle fuer Fehlereintrag | EN: Fault code FI_TOENS - debounce filter threshold for setting the fault" VALUE 0x7174A TKW_VV_VV_UB 100.0 FORMULA_0003 0.0 255.0000 /end CHARACTERISTIC
/begin CHARACTERISTIC K_ED_KW.FEHLERSCHWELLE "Filterschwelle fuer Fehlereintrag | EN: Fault code KW - debounce filter threshold for setting the fault" VALUE 0x71868 TKW_VV_VV_UB 100.0 FORMULA_0003 0.0 255.0000 /end CHARACTERISTIC
/begin CHARACTERISTIC K_ED_LA1_ADAPT.FEHLERSCHWELLE "Filterschwelle fuer Fehlereintrag | EN: Fault code LA1_ADAPT - debounce filter threshold for setting the fault" VALUE 0x71882 TKW_VV_VV_UB 100.0 FORMULA_0003 0.0 255.0000 /end CHARACTERISTIC
/begin CHARACTERISTIC K_ED_LA2_ADAPT.FEHLERSCHWELLE "Filterschwelle fuer Fehlereintrag | EN: Fault code LA2_ADAPT - debounce filter threshold for setting the fault" VALUE 0x7189C TKW_VV_VV_UB 100.0 FORMULA_0003 0.0 255.0000 /end CHARACTERISTIC
/begin CHARACTERISTIC K_ED_KGE1.FEHLERSCHWELLE "Filterschwelle fuer Fehlereintrag | EN: Fault code KGE1 - debounce filter threshold for setting the fault" VALUE 0x718B6 TKW_VV_VV_UB 100.0 FORMULA_0003 0.0 255.0000 /end CHARACTERISTIC
/begin CHARACTERISTIC K_ED_KGE2.FEHLERSCHWELLE "Filterschwelle fuer Fehlereintrag | EN: Fault code KGE2 - debounce filter threshold for setting the fault" VALUE 0x718D0 TKW_VV_VV_UB 100.0 FORMULA_0003 0.0 255.0000 /end CHARACTERISTIC
/begin CHARACTERISTIC K_ED_FST.FEHLERSCHWELLE "Filterschwelle fuer Fehlereintrag | EN: Fault code FST - debounce filter threshold for setting the fault" VALUE 0x718EA TKW_VV_VV_UB 100.0 FORMULA_0003 0.0 255.0000 /end CHARACTERISTIC
/begin CHARACTERISTIC K_ED_KSD1.FEHLERSCHWELLE "Filterschwelle fuer Fehlereintrag | EN: Fault code KSD1 - debounce filter threshold for setting the fault" VALUE 0x71A22 TKW_VV_VV_UB 100.0 FORMULA_0003 0.0 255.0000 /end CHARACTERISTIC
/begin CHARACTERISTIC K_ED_KSD2.FEHLERSCHWELLE "Filterschwelle fuer Fehlereintrag | EN: Fault code KSD2 - debounce filter threshold for setting the fault" VALUE 0x71A3C TKW_VV_VV_UB 100.0 FORMULA_0003 0.0 255.0000 /end CHARACTERISTIC
/begin CHARACTERISTIC K_ED_KATS_B1.FEHLERSCHWELLE "Filterschwelle fuer Fehlereintrag | EN: Fault code KATS_B1 - debounce filter threshold for setting the fault" VALUE 0x71A56 TKW_VV_VV_UB 100.0 FORMULA_0003 0.0 255.0000 /end CHARACTERISTIC
/begin CHARACTERISTIC K_ED_KATS_B2.FEHLERSCHWELLE "Filterschwelle fuer Fehlereintrag | EN: Fault code KATS_B2 - debounce filter threshold for setting the fault" VALUE 0x71A70 TKW_VV_VV_UB 100.0 FORMULA_0003 0.0 255.0000 /end CHARACTERISTIC
/begin CHARACTERISTIC K_ED_FST_GEBER.FEHLERSCHWELLE "Filterschwelle fuer Fehlereintrag | EN: Fault code FST_GEBER - debounce filter threshold for setting the fault" VALUE 0x71ABE TKW_VV_VV_UB 100.0 FORMULA_0003 0.0 255.0000 /end CHARACTERISTIC
/begin CHARACTERISTIC K_ED_LA1_TRIM_AD.FEHLERSCHWELLE "Filterschwelle fuer Fehlereintrag | EN: Fault code LA1_TRIM_AD - debounce filter threshold for setting the fault" VALUE 0x71B5A TKW_VV_VV_UB 100.0 FORMULA_0003 0.0 255.0000 /end CHARACTERISTIC
/begin CHARACTERISTIC K_ED_LA2_TRIM_AD.FEHLERSCHWELLE "Filterschwelle fuer Fehlereintrag | EN: Fault code LA2_TRIM_AD - debounce filter threshold for setting the fault" VALUE 0x71B74 TKW_VV_VV_UB 100.0 FORMULA_0003 0.0 255.0000 /end CHARACTERISTIC
/begin CHARACTERISTIC K_ED_LANK1_OPENLOAD.FEHLERSCHWELLE "Filterschwelle fuer Fehlereintrag | EN: Fault code LANK1_OPENLOAD - debounce filter threshold for setting the fault" VALUE 0x71B8E TKW_VV_VV_UB 100.0 FORMULA_0003 0.0 255.0000 /end CHARACTERISTIC
/begin CHARACTERISTIC K_ED_LANK2_OPENLOAD.FEHLERSCHWELLE "Filterschwelle fuer Fehlereintrag | EN: Fault code LANK2_OPENLOAD - debounce filter threshold for setting the fault" VALUE 0x71BA8 TKW_VV_VV_UB 100.0 FORMULA_0003 0.0 255.0000 /end CHARACTERISTIC
/begin CHARACTERISTIC K_ED_LANK1_OBD_WE.FEHLERSCHWELLE "Filterschwelle fuer Fehlereintrag | EN: Fault code LANK1_OBD_WE - debounce filter threshold for setting the fault" VALUE 0x71BC2 TKW_VV_VV_UB 100.0 FORMULA_0003 0.0 255.0000 /end CHARACTERISTIC
/begin CHARACTERISTIC K_ED_LANK2_OBD_WE.FEHLERSCHWELLE "Filterschwelle fuer Fehlereintrag | EN: Fault code LANK2_OBD_WE - debounce filter threshold for setting the fault" VALUE 0x71BDC TKW_VV_VV_UB 100.0 FORMULA_0003 0.0 255.0000 /end CHARACTERISTIC
/begin CHARACTERISTIC K_ED_FST_GEBER_LI.FEHLERSCHWELLE "Filterschwelle fuer Fehlereintrag" VALUE 0x71CE0 TKW_VV_VV_UB 100.0 FORMULA_0003 0.0 255.0000 /end CHARACTERISTIC
/begin CHARACTERISTIC K_ED_FST_GEBER_RE.FEHLERSCHWELLE "Filterschwelle fuer Fehlereintrag" VALUE 0x71CFA TKW_VV_VV_UB 100.0 FORMULA_0003 0.0 255.0000 /end CHARACTERISTIC
/begin CHARACTERISTIC K_ED_LANK1_OBD_SLOPE.FEHLERSCHWELLE "Filterschwelle fuer Fehlereintrag" VALUE 0x71D14 TKW_VV_VV_UB 100.0 FORMULA_0003 0.0 255.0000 /end CHARACTERISTIC
/begin CHARACTERISTIC K_ED_LANK2_OBD_SLOPE.FEHLERSCHWELLE "Filterschwelle fuer Fehlereintrag" VALUE 0x71D2E TKW_VV_VV_UB 100.0 FORMULA_0003 0.0 255.0000 /end CHARACTERISTIC
/begin CHARACTERISTIC K_ED_INDEX_204_INJ.FEHLERSCHWELLE "Filterschwelle fuer Fehlereintrag | EN: Fault code INDEX_204_INJ - debounce filter threshold for setting the fault" VALUE 0x71D96 TKW_VV_VV_UB 100.0 FORMULA_0003 0.0 255.0000 /end CHARACTERISTIC
/begin CHARACTERISTIC K_ED_INDEX_205_INJ.FEHLERSCHWELLE "Filterschwelle fuer Fehlereintrag | EN: Fault code INDEX_205_INJ - debounce filter threshold for setting the fault" VALUE 0x71DB0 TKW_VV_VV_UB 100.0 FORMULA_0003 0.0 255.0000 /end CHARACTERISTIC
/begin CHARACTERISTIC K_ED_INDEX_206_INJ.FEHLERSCHWELLE "Filterschwelle fuer Fehlereintrag | EN: Fault code INDEX_206_INJ - debounce filter threshold for setting the fault" VALUE 0x71DCA TKW_VV_VV_UB 100.0 FORMULA_0003 0.0 255.0000 /end CHARACTERISTIC
/begin CHARACTERISTIC K_ED_INDEX_207_INJ.FEHLERSCHWELLE "Filterschwelle fuer Fehlereintrag" VALUE 0x71DE4 TKW_VV_VV_UB 100.0 FORMULA_0003 0.0 255.0000 /end CHARACTERISTIC
/begin CHARACTERISTIC K_ED_INDEX_208_INJ.FEHLERSCHWELLE "Filterschwelle fuer Fehlereintrag" VALUE 0x71DFE TKW_VV_VV_UB 100.0 FORMULA_0003 0.0 255.0000 /end CHARACTERISTIC
/begin CHARACTERISTIC K_ED_INDEX_209_INJ.FEHLERSCHWELLE "Filterschwelle fuer Fehlereintrag" VALUE 0x71E18 TKW_VV_VV_UB 100.0 FORMULA_0003 0.0 255.0000 /end CHARACTERISTIC
/begin CHARACTERISTIC K_ED_INDEX_210_INJ.FEHLERSCHWELLE "Filterschwelle fuer Fehlereintrag" VALUE 0x71E32 TKW_VV_VV_UB 100.0 FORMULA_0003 0.0 255.0000 /end CHARACTERISTIC
/begin CHARACTERISTIC K_ED_INDEX_211_INJ.FEHLERSCHWELLE "Filterschwelle fuer Fehlereintrag | EN: Filterschwelle fuer Fehlereintrag" VALUE 0x71E4C TKW_VV_VV_UB 100.0 FORMULA_0003 0.0 255.0000 /end CHARACTERISTIC
/begin CHARACTERISTIC K_ED_INDEX_212_INJ.FEHLERSCHWELLE "Filterschwelle fuer Fehlereintrag | EN: Filterschwelle fuer Fehlereintrag" VALUE 0x71E66 TKW_VV_VV_UB 100.0 FORMULA_0003 0.0 255.0000 /end CHARACTERISTIC
/begin CHARACTERISTIC K_ED_INDEX_213_INJ.FEHLERSCHWELLE "Filterschwelle fuer Fehlereintrag" VALUE 0x71E80 TKW_VV_VV_UB 100.0 FORMULA_0003 0.0 255.0000 /end CHARACTERISTIC
/begin CHARACTERISTIC K_ED_INDEX_214_INJ.FEHLERSCHWELLE "Filterschwelle fuer Fehlereintrag" VALUE 0x71E9A TKW_VV_VV_UB 100.0 FORMULA_0003 0.0 255.0000 /end CHARACTERISTIC
/begin CHARACTERISTIC K_ED_INDEX_215_INJ.FEHLERSCHWELLE "Filterschwelle fuer Fehlereintrag" VALUE 0x71EB4 TKW_VV_VV_UB 100.0 FORMULA_0003 0.0 255.0000 /end CHARACTERISTIC
/begin CHARACTERISTIC K_ED_INDEX_216_INJ.FEHLERSCHWELLE "Filterschwelle fuer Fehlereintrag" VALUE 0x71ECE TKW_VV_VV_UB 100.0 FORMULA_0003 0.0 255.0000 /end CHARACTERISTIC
/begin CHARACTERISTIC K_ED_INDEX_217_INJ.FEHLERSCHWELLE "Filterschwelle fuer Fehlereintrag" VALUE 0x71EE8 TKW_VV_VV_UB 100.0 FORMULA_0003 0.0 255.0000 /end CHARACTERISTIC
/begin CHARACTERISTIC K_ED_INDEX_218_INJ.FEHLERSCHWELLE "Filterschwelle fuer Fehlereintrag" VALUE 0x71F02 TKW_VV_VV_UB 100.0 FORMULA_0003 0.0 255.0000 /end CHARACTERISTIC
/begin CHARACTERISTIC K_ED_INDEX_219_INJ.FEHLERSCHWELLE "Filterschwelle fuer Fehlereintrag" VALUE 0x71F1C TKW_VV_VV_UB 100.0 FORMULA_0003 0.0 255.0000 /end CHARACTERISTIC
/begin CHARACTERISTIC K_ED_INDEX_220_INJ.FEHLERSCHWELLE "Filterschwelle fuer Fehlereintrag" VALUE 0x71F36 TKW_VV_VV_UB 100.0 FORMULA_0003 0.0 255.0000 /end CHARACTERISTIC
/begin CHARACTERISTIC K_ED_INDEX_221_INJ.FEHLERSCHWELLE "Filterschwelle fuer Fehlereintrag" VALUE 0x71F50 TKW_VV_VV_UB 100.0 FORMULA_0003 0.0 255.0000 /end CHARACTERISTIC
/begin CHARACTERISTIC K_ED_INDEX_222_INJ.FEHLERSCHWELLE "Filterschwelle fuer Fehlereintrag" VALUE 0x71F6A TKW_VV_VV_UB 100.0 FORMULA_0003 0.0 255.0000 /end CHARACTERISTIC
/begin CHARACTERISTIC K_ED_INDEX_223_INJ.FEHLERSCHWELLE "Filterschwelle fuer Fehlereintrag" VALUE 0x71F84 TKW_VV_VV_UB 100.0 FORMULA_0003 0.0 255.0000 /end CHARACTERISTIC
/begin CHARACTERISTIC K_ED_HFM1.OK_SCHWELLE "Filterschwelle fuer Fehleraustrag | EN: Fault code HFM1 - debounce filter threshold for clearing (healing) the fault" VALUE 0x70913 TKW_VV_VV_UB 100.0 FORMULA_0003 0.0 255.0000 /end CHARACTERISTIC
/begin CHARACTERISTIC K_ED_HFM2.OK_SCHWELLE "Filterschwelle fuer Fehleraustrag | EN: Fault code HFM2 - debounce filter threshold for clearing (healing) the fault" VALUE 0x7092D TKW_VV_VV_UB 100.0 FORMULA_0003 0.0 255.0000 /end CHARACTERISTIC
/begin CHARACTERISTIC K_ED_LAVK1.OK_SCHWELLE "Filterschwelle fuer Fehleraustrag | EN: Fault code LAVK1 - debounce filter threshold for clearing (healing) the fault" VALUE 0x70AE7 TKW_VV_VV_UB 100.0 FORMULA_0003 0.0 255.0000 /end CHARACTERISTIC
/begin CHARACTERISTIC K_ED_LAVK1_OBD_PLAU.OK_SCHWELLE "Filterschwelle fuer Fehleraustrag | EN: Fault code LAVK1_OBD_PLAU - debounce filter threshold for clearing (healing) the fault" VALUE 0x70B1B TKW_VV_VV_UB 100.0 FORMULA_0003 0.0 255.0000 /end CHARACTERISTIC
/begin CHARACTERISTIC K_ED_LAVK1_OBD_SA.OK_SCHWELLE "Filterschwelle fuer Fehleraustrag | EN: Fault code LAVK1_OBD_SA - debounce filter threshold for clearing (healing) the fault" VALUE 0x70B4F TKW_VV_VV_UB 100.0 FORMULA_0003 0.0 255.0000 /end CHARACTERISTIC
/begin CHARACTERISTIC K_ED_LANK1.OK_SCHWELLE "Filterschwelle fuer Fehleraustrag | EN: Fault code LANK1 - debounce filter threshold for clearing (healing) the fault" VALUE 0x70B83 TKW_VV_VV_UB 100.0 FORMULA_0003 0.0 255.0000 /end CHARACTERISTIC
/begin CHARACTERISTIC K_ED_LANK2.OK_SCHWELLE "Filterschwelle fuer Fehleraustrag | EN: Fault code LANK2 - debounce filter threshold for clearing (healing) the fault" VALUE 0x70B9D TKW_VV_VV_UB 100.0 FORMULA_0003 0.0 255.0000 /end CHARACTERISTIC
/begin CHARACTERISTIC K_ED_FPLAU1.OK_SCHWELLE "Filterschwelle fuer Fehleraustrag | EN: Fault code FPLAU1 - debounce filter threshold for clearing (healing) the fault" VALUE 0x70CD5 TKW_VV_VV_UB 100.0 FORMULA_0003 0.0 255.0000 /end CHARACTERISTIC
/begin CHARACTERISTIC K_ED_FPLAU2.OK_SCHWELLE "Filterschwelle fuer Fehleraustrag | EN: Fault code FPLAU2 - debounce filter threshold for clearing (healing) the fault" VALUE 0x70CEF TKW_VV_VV_UB 100.0 FORMULA_0003 0.0 255.0000 /end CHARACTERISTIC
/begin CHARACTERISTIC K_ED_LANK1_OBD_S.OK_SCHWELLE "Filterschwelle fuer Fehleraustrag | EN: Fault code LANK1_OBD_S - debounce filter threshold for clearing (healing) the fault" VALUE 0x70D23 TKW_VV_VV_UB 100.0 FORMULA_0003 0.0 255.0000 /end CHARACTERISTIC
/begin CHARACTERISTIC K_ED_LANK2_OBD_S.OK_SCHWELLE "Filterschwelle fuer Fehleraustrag | EN: Fault code LANK2_OBD_S - debounce filter threshold for clearing (healing) the fault" VALUE 0x70D3D TKW_VV_VV_UB 100.0 FORMULA_0003 0.0 255.0000 /end CHARACTERISTIC
/begin CHARACTERISTIC K_ED_LAVK1_OBD_TL.OK_SCHWELLE "Filterschwelle fuer Fehleraustrag | EN: Fault code LAVK1_OBD_TL - debounce filter threshold for clearing (healing) the fault" VALUE 0x70D57 TKW_VV_VV_UB 100.0 FORMULA_0003 0.0 255.0000 /end CHARACTERISTIC
/begin CHARACTERISTIC K_ED_LAVK1_DIAG.OK_SCHWELLE "Filterschwelle fuer Fehleraustrag | EN: Fault code LAVK1_DIAG - debounce filter threshold for clearing (healing) the fault" VALUE 0x70E8F TKW_VV_VV_UB 100.0 FORMULA_0003 0.0 255.0000 /end CHARACTERISTIC
/begin CHARACTERISTIC K_ED_LAVK1_IA_OPENLOAD.OK_SCHWELLE "Filterschwelle fuer Fehleraustrag | EN: Fault code LAVK1_IA_OPENLOAD - debounce filter threshold for clearing (healing) the fault" VALUE 0x70EC3 TKW_VV_VV_UB 100.0 FORMULA_0003 0.0 255.0000 /end CHARACTERISTIC
/begin CHARACTERISTIC K_ED_LAVK1_IP_OPENLOAD.OK_SCHWELLE "Filterschwelle fuer Fehleraustrag | EN: Fault code LAVK1_IP_OPENLOAD - debounce filter threshold for clearing (healing) the fault" VALUE 0x70F5F TKW_VV_VV_UB 100.0 FORMULA_0003 0.0 255.0000 /end CHARACTERISTIC
/begin CHARACTERISTIC K_ED_LAM1_REG.OK_SCHWELLE "Filterschwelle fuer Fehleraustrag | EN: Fault code LAM1_REG - debounce filter threshold for clearing (healing) the fault" VALUE 0x710B1 TKW_VV_VV_UB 100.0 FORMULA_0003 0.0 255.0000 /end CHARACTERISTIC
/begin CHARACTERISTIC K_ED_LAM2_REG.OK_SCHWELLE "Filterschwelle fuer Fehleraustrag | EN: Fault code LAM2_REG - debounce filter threshold for clearing (healing) the fault" VALUE 0x710CB TKW_VV_VV_UB 100.0 FORMULA_0003 0.0 255.0000 /end CHARACTERISTIC
/begin CHARACTERISTIC K_ED_LAVK1_OBD_DYN.OK_SCHWELLE "Filterschwelle fuer Fehleraustrag | EN: Fault code LAVK1_OBD_DYN - debounce filter threshold for clearing (healing) the fault" VALUE 0x712B9 TKW_VV_VV_UB 100.0 FORMULA_0003 0.0 255.0000 /end CHARACTERISTIC
/begin CHARACTERISTIC K_ED_LAVK1_TRIM.OK_SCHWELLE "Filterschwelle fuer Fehleraustrag | EN: Fault code LAVK1_TRIM - debounce filter threshold for clearing (healing) the fault" VALUE 0x713D7 TKW_VV_VV_UB 100.0 FORMULA_0003 0.0 255.0000 /end CHARACTERISTIC
/begin CHARACTERISTIC K_ED_KAT_OBD1.OK_SCHWELLE "Filterschwelle fuer Fehleraustrag | EN: Fault code KAT_OBD1 - debounce filter threshold for clearing (healing) the fault" VALUE 0x71529 TKW_VV_VV_UB 100.0 FORMULA_0003 0.0 255.0000 /end CHARACTERISTIC
/begin CHARACTERISTIC K_ED_KAT_OBD2.OK_SCHWELLE "Filterschwelle fuer Fehleraustrag | EN: Fault code KAT_OBD2 - debounce filter threshold for clearing (healing) the fault" VALUE 0x71543 TKW_VV_VV_UB 100.0 FORMULA_0003 0.0 255.0000 /end CHARACTERISTIC
/begin CHARACTERISTIC K_ED_FI_QLT.OK_SCHWELLE "Filterschwelle fuer Fehleraustrag | EN: Fault code FI_QLT - debounce filter threshold for clearing (healing) the fault" VALUE 0x715AB TKW_VV_VV_UB 100.0 FORMULA_0003 0.0 255.0000 /end CHARACTERISTIC
/begin CHARACTERISTIC K_ED_FI_PMBN.OK_SCHWELLE "Filterschwelle fuer Fehleraustrag | EN: Fault code FI_PMBN - debounce filter threshold for clearing (healing) the fault" VALUE 0x71613 TKW_VV_VV_UB 100.0 FORMULA_0003 0.0 255.0000 /end CHARACTERISTIC
/begin CHARACTERISTIC K_ED_FI_PMRUHVERL.OK_SCHWELLE "Filterschwelle fuer Fehleraustrag | EN: Fault code FI_PMRUHVERL - debounce filter threshold for clearing (healing) the fault" VALUE 0x71731 TKW_VV_VV_UB 100.0 FORMULA_0003 0.0 255.0000 /end CHARACTERISTIC
/begin CHARACTERISTIC K_ED_FI_TOENS.OK_SCHWELLE "Filterschwelle fuer Fehleraustrag | EN: Fault code FI_TOENS - debounce filter threshold for clearing (healing) the fault" VALUE 0x7174B TKW_VV_VV_UB 100.0 FORMULA_0003 0.0 255.0000 /end CHARACTERISTIC
/begin CHARACTERISTIC K_ED_KW.OK_SCHWELLE "Filterschwelle fuer Fehleraustrag | EN: Fault code KW - debounce filter threshold for clearing (healing) the fault" VALUE 0x71869 TKW_VV_VV_UB 100.0 FORMULA_0003 0.0 255.0000 /end CHARACTERISTIC
/begin CHARACTERISTIC K_ED_LA1_ADAPT.OK_SCHWELLE "Filterschwelle fuer Fehleraustrag | EN: Fault code LA1_ADAPT - debounce filter threshold for clearing (healing) the fault" VALUE 0x71883 TKW_VV_VV_UB 100.0 FORMULA_0003 0.0 255.0000 /end CHARACTERISTIC
/begin CHARACTERISTIC K_ED_LA2_ADAPT.OK_SCHWELLE "Filterschwelle fuer Fehleraustrag | EN: Fault code LA2_ADAPT - debounce filter threshold for clearing (healing) the fault" VALUE 0x7189D TKW_VV_VV_UB 100.0 FORMULA_0003 0.0 255.0000 /end CHARACTERISTIC
/begin CHARACTERISTIC K_ED_KGE1.OK_SCHWELLE "Filterschwelle fuer Fehleraustrag | EN: Fault code KGE1 - debounce filter threshold for clearing (healing) the fault" VALUE 0x718B7 TKW_VV_VV_UB 100.0 FORMULA_0003 0.0 255.0000 /end CHARACTERISTIC
/begin CHARACTERISTIC K_ED_KGE2.OK_SCHWELLE "Filterschwelle fuer Fehleraustrag | EN: Fault code KGE2 - debounce filter threshold for clearing (healing) the fault" VALUE 0x718D1 TKW_VV_VV_UB 100.0 FORMULA_0003 0.0 255.0000 /end CHARACTERISTIC
/begin CHARACTERISTIC K_ED_FST.OK_SCHWELLE "Filterschwelle fuer Fehleraustrag | EN: Fault code FST - debounce filter threshold for clearing (healing) the fault" VALUE 0x718EB TKW_VV_VV_UB 100.0 FORMULA_0003 0.0 255.0000 /end CHARACTERISTIC
/begin CHARACTERISTIC K_ED_KSD1.OK_SCHWELLE "Filterschwelle fuer Fehleraustrag | EN: Fault code KSD1 - debounce filter threshold for clearing (healing) the fault" VALUE 0x71A23 TKW_VV_VV_UB 100.0 FORMULA_0003 0.0 255.0000 /end CHARACTERISTIC
/begin CHARACTERISTIC K_ED_KSD2.OK_SCHWELLE "Filterschwelle fuer Fehleraustrag | EN: Fault code KSD2 - debounce filter threshold for clearing (healing) the fault" VALUE 0x71A3D TKW_VV_VV_UB 100.0 FORMULA_0003 0.0 255.0000 /end CHARACTERISTIC
/begin CHARACTERISTIC K_ED_KATS_B1.OK_SCHWELLE "Filterschwelle fuer Fehleraustrag | EN: Fault code KATS_B1 - debounce filter threshold for clearing (healing) the fault" VALUE 0x71A57 TKW_VV_VV_UB 100.0 FORMULA_0003 0.0 255.0000 /end CHARACTERISTIC
/begin CHARACTERISTIC K_ED_KATS_B2.OK_SCHWELLE "Filterschwelle fuer Fehleraustrag | EN: Fault code KATS_B2 - debounce filter threshold for clearing (healing) the fault" VALUE 0x71A71 TKW_VV_VV_UB 100.0 FORMULA_0003 0.0 255.0000 /end CHARACTERISTIC
/begin CHARACTERISTIC K_ED_FST_GEBER.OK_SCHWELLE "Filterschwelle fuer Fehleraustrag | EN: Fault code FST_GEBER - debounce filter threshold for clearing (healing) the fault" VALUE 0x71ABF TKW_VV_VV_UB 100.0 FORMULA_0003 0.0 255.0000 /end CHARACTERISTIC
/begin CHARACTERISTIC K_ED_LA1_TRIM_AD.OK_SCHWELLE "Filterschwelle fuer Fehleraustrag | EN: Fault code LA1_TRIM_AD - debounce filter threshold for clearing (healing) the fault" VALUE 0x71B5B TKW_VV_VV_UB 100.0 FORMULA_0003 0.0 255.0000 /end CHARACTERISTIC
/begin CHARACTERISTIC K_ED_LA2_TRIM_AD.OK_SCHWELLE "Filterschwelle fuer Fehleraustrag | EN: Fault code LA2_TRIM_AD - debounce filter threshold for clearing (healing) the fault" VALUE 0x71B75 TKW_VV_VV_UB 100.0 FORMULA_0003 0.0 255.0000 /end CHARACTERISTIC
/begin CHARACTERISTIC K_ED_LANK1_OPENLOAD.OK_SCHWELLE "Filterschwelle fuer Fehleraustrag | EN: Fault code LANK1_OPENLOAD - debounce filter threshold for clearing (healing) the fault" VALUE 0x71B8F TKW_VV_VV_UB 100.0 FORMULA_0003 0.0 255.0000 /end CHARACTERISTIC
/begin CHARACTERISTIC K_ED_LANK2_OPENLOAD.OK_SCHWELLE "Filterschwelle fuer Fehleraustrag | EN: Fault code LANK2_OPENLOAD - debounce filter threshold for clearing (healing) the fault" VALUE 0x71BA9 TKW_VV_VV_UB 100.0 FORMULA_0003 0.0 255.0000 /end CHARACTERISTIC
/begin CHARACTERISTIC K_ED_LANK1_OBD_WE.OK_SCHWELLE "Filterschwelle fuer Fehleraustrag | EN: Fault code LANK1_OBD_WE - debounce filter threshold for clearing (healing) the fault" VALUE 0x71BC3 TKW_VV_VV_UB 100.0 FORMULA_0003 0.0 255.0000 /end CHARACTERISTIC
/begin CHARACTERISTIC K_ED_LANK2_OBD_WE.OK_SCHWELLE "Filterschwelle fuer Fehleraustrag | EN: Fault code LANK2_OBD_WE - debounce filter threshold for clearing (healing) the fault" VALUE 0x71BDD TKW_VV_VV_UB 100.0 FORMULA_0003 0.0 255.0000 /end CHARACTERISTIC
/begin CHARACTERISTIC K_ED_FST_GEBER_LI.OK_SCHWELLE "Filterschwelle fuer Fehleraustrag" VALUE 0x71CE1 TKW_VV_VV_UB 100.0 FORMULA_0003 0.0 255.0000 /end CHARACTERISTIC
/begin CHARACTERISTIC K_ED_FST_GEBER_RE.OK_SCHWELLE "Filterschwelle fuer Fehleraustrag" VALUE 0x71CFB TKW_VV_VV_UB 100.0 FORMULA_0003 0.0 255.0000 /end CHARACTERISTIC
/begin CHARACTERISTIC K_ED_LANK1_OBD_SLOPE.OK_SCHWELLE "Filterschwelle fuer Fehleraustrag" VALUE 0x71D15 TKW_VV_VV_UB 100.0 FORMULA_0003 0.0 255.0000 /end CHARACTERISTIC
/begin CHARACTERISTIC K_ED_LANK2_OBD_SLOPE.OK_SCHWELLE "Filterschwelle fuer Fehleraustrag" VALUE 0x71D2F TKW_VV_VV_UB 100.0 FORMULA_0003 0.0 255.0000 /end CHARACTERISTIC
/begin CHARACTERISTIC K_ED_INDEX_204_INJ.OK_SCHWELLE "Filterschwelle fuer Fehleraustrag | EN: Fault code INDEX_204_INJ - debounce filter threshold for clearing (healing) the fault" VALUE 0x71D97 TKW_VV_VV_UB 100.0 FORMULA_0003 0.0 255.0000 /end CHARACTERISTIC
/begin CHARACTERISTIC K_ED_INDEX_205_INJ.OK_SCHWELLE "Filterschwelle fuer Fehleraustrag | EN: Fault code INDEX_205_INJ - debounce filter threshold for clearing (healing) the fault" VALUE 0x71DB1 TKW_VV_VV_UB 100.0 FORMULA_0003 0.0 255.0000 /end CHARACTERISTIC
/begin CHARACTERISTIC K_ED_INDEX_206_INJ.OK_SCHWELLE "Filterschwelle fuer Fehleraustrag | EN: Fault code INDEX_206_INJ - debounce filter threshold for clearing (healing) the fault" VALUE 0x71DCB TKW_VV_VV_UB 100.0 FORMULA_0003 0.0 255.0000 /end CHARACTERISTIC
/begin CHARACTERISTIC K_ED_INDEX_207_INJ.OK_SCHWELLE "Filterschwelle fuer Fehleraustrag" VALUE 0x71DE5 TKW_VV_VV_UB 100.0 FORMULA_0003 0.0 255.0000 /end CHARACTERISTIC
/begin CHARACTERISTIC K_ED_INDEX_208_INJ.OK_SCHWELLE "Filterschwelle fuer Fehleraustrag" VALUE 0x71DFF TKW_VV_VV_UB 100.0 FORMULA_0003 0.0 255.0000 /end CHARACTERISTIC
/begin CHARACTERISTIC K_ED_INDEX_209_INJ.OK_SCHWELLE "Filterschwelle fuer Fehleraustrag" VALUE 0x71E19 TKW_VV_VV_UB 100.0 FORMULA_0003 0.0 255.0000 /end CHARACTERISTIC
/begin CHARACTERISTIC K_ED_INDEX_210_INJ.OK_SCHWELLE "Filterschwelle fuer Fehleraustrag" VALUE 0x71E33 TKW_VV_VV_UB 100.0 FORMULA_0003 0.0 255.0000 /end CHARACTERISTIC
/begin CHARACTERISTIC K_ED_INDEX_211_INJ.OK_SCHWELLE "Filterschwelle fuer Fehleraustrag | EN: Filterschwelle fuer Fehleraustrag" VALUE 0x71E4D TKW_VV_VV_UB 100.0 FORMULA_0003 0.0 255.0000 /end CHARACTERISTIC
/begin CHARACTERISTIC K_ED_INDEX_212_INJ.OK_SCHWELLE "Filterschwelle fuer Fehleraustrag | EN: Filterschwelle fuer Fehleraustrag" VALUE 0x71E67 TKW_VV_VV_UB 100.0 FORMULA_0003 0.0 255.0000 /end CHARACTERISTIC
/begin CHARACTERISTIC K_ED_INDEX_213_INJ.OK_SCHWELLE "Filterschwelle fuer Fehleraustrag" VALUE 0x71E81 TKW_VV_VV_UB 100.0 FORMULA_0003 0.0 255.0000 /end CHARACTERISTIC
/begin CHARACTERISTIC K_ED_INDEX_214_INJ.OK_SCHWELLE "Filterschwelle fuer Fehleraustrag" VALUE 0x71E9B TKW_VV_VV_UB 100.0 FORMULA_0003 0.0 255.0000 /end CHARACTERISTIC
/begin CHARACTERISTIC K_ED_INDEX_215_INJ.OK_SCHWELLE "Filterschwelle fuer Fehleraustrag" VALUE 0x71EB5 TKW_VV_VV_UB 100.0 FORMULA_0003 0.0 255.0000 /end CHARACTERISTIC
/begin CHARACTERISTIC K_ED_INDEX_216_INJ.OK_SCHWELLE "Filterschwelle fuer Fehleraustrag" VALUE 0x71ECF TKW_VV_VV_UB 100.0 FORMULA_0003 0.0 255.0000 /end CHARACTERISTIC
/begin CHARACTERISTIC K_ED_INDEX_217_INJ.OK_SCHWELLE "Filterschwelle fuer Fehleraustrag" VALUE 0x71EE9 TKW_VV_VV_UB 100.0 FORMULA_0003 0.0 255.0000 /end CHARACTERISTIC
/begin CHARACTERISTIC K_ED_INDEX_218_INJ.OK_SCHWELLE "Filterschwelle fuer Fehleraustrag" VALUE 0x71F03 TKW_VV_VV_UB 100.0 FORMULA_0003 0.0 255.0000 /end CHARACTERISTIC
/begin CHARACTERISTIC K_ED_INDEX_219_INJ.OK_SCHWELLE "Filterschwelle fuer Fehleraustrag" VALUE 0x71F1D TKW_VV_VV_UB 100.0 FORMULA_0003 0.0 255.0000 /end CHARACTERISTIC
/begin CHARACTERISTIC K_ED_INDEX_220_INJ.OK_SCHWELLE "Filterschwelle fuer Fehleraustrag" VALUE 0x71F37 TKW_VV_VV_UB 100.0 FORMULA_0003 0.0 255.0000 /end CHARACTERISTIC
/begin CHARACTERISTIC K_ED_INDEX_221_INJ.OK_SCHWELLE "Filterschwelle fuer Fehleraustrag" VALUE 0x71F51 TKW_VV_VV_UB 100.0 FORMULA_0003 0.0 255.0000 /end CHARACTERISTIC
/begin CHARACTERISTIC K_ED_INDEX_222_INJ.OK_SCHWELLE "Filterschwelle fuer Fehleraustrag" VALUE 0x71F6B TKW_VV_VV_UB 100.0 FORMULA_0003 0.0 255.0000 /end CHARACTERISTIC
/begin CHARACTERISTIC K_ED_INDEX_223_INJ.OK_SCHWELLE "Filterschwelle fuer Fehleraustrag" VALUE 0x71F85 TKW_VV_VV_UB 100.0 FORMULA_0003 0.0 255.0000 /end CHARACTERISTIC
/begin CHARACTERISTIC K_ED_HFM1.INC_VOR_EINTRAG "Filtererhoehung vorm Fehlerspeichereintrag | EN: Fault code HFM1 - debounce filter increment before fault-memory entry" VALUE 0x70914 TKW_VV_VV_UB 100.0 FORMULA_0003 0.0 255.0000 /end CHARACTERISTIC
/begin CHARACTERISTIC K_ED_HFM2.INC_VOR_EINTRAG "Filtererhoehung vorm Fehlerspeichereintrag | EN: Fault code HFM2 - debounce filter increment before fault-memory entry" VALUE 0x7092E TKW_VV_VV_UB 100.0 FORMULA_0003 0.0 255.0000 /end CHARACTERISTIC
/begin CHARACTERISTIC K_ED_LAVK1.INC_VOR_EINTRAG "Filtererhoehung vorm Fehlerspeichereintrag | EN: Fault code LAVK1 - debounce filter increment before fault-memory entry" VALUE 0x70AE8 TKW_VV_VV_UB 100.0 FORMULA_0003 0.0 255.0000 /end CHARACTERISTIC
/begin CHARACTERISTIC K_ED_LAVK1_OBD_PLAU.INC_VOR_EINTRAG "Filtererhoehung vorm Fehlerspeichereintrag | EN: Fault code LAVK1_OBD_PLAU - debounce filter increment before fault-memory entry" VALUE 0x70B1C TKW_VV_VV_UB 100.0 FORMULA_0003 0.0 255.0000 /end CHARACTERISTIC
/begin CHARACTERISTIC K_ED_LAVK1_OBD_SA.INC_VOR_EINTRAG "Filtererhoehung vorm Fehlerspeichereintrag | EN: Fault code LAVK1_OBD_SA - debounce filter increment before fault-memory entry" VALUE 0x70B50 TKW_VV_VV_UB 100.0 FORMULA_0003 0.0 255.0000 /end CHARACTERISTIC
/begin CHARACTERISTIC K_ED_LANK1.INC_VOR_EINTRAG "Filtererhoehung vorm Fehlerspeichereintrag | EN: Fault code LANK1 - debounce filter increment before fault-memory entry" VALUE 0x70B84 TKW_VV_VV_UB 100.0 FORMULA_0003 0.0 255.0000 /end CHARACTERISTIC
/begin CHARACTERISTIC K_ED_LANK2.INC_VOR_EINTRAG "Filtererhoehung vorm Fehlerspeichereintrag | EN: Fault code LANK2 - debounce filter increment before fault-memory entry" VALUE 0x70B9E TKW_VV_VV_UB 100.0 FORMULA_0003 0.0 255.0000 /end CHARACTERISTIC
/begin CHARACTERISTIC K_ED_FPLAU1.INC_VOR_EINTRAG "Filtererhoehung vorm Fehlerspeichereintrag | EN: Fault code FPLAU1 - debounce filter increment before fault-memory entry" VALUE 0x70CD6 TKW_VV_VV_UB 100.0 FORMULA_0003 0.0 255.0000 /end CHARACTERISTIC
/begin CHARACTERISTIC K_ED_FPLAU2.INC_VOR_EINTRAG "Filtererhoehung vorm Fehlerspeichereintrag | EN: Fault code FPLAU2 - debounce filter increment before fault-memory entry" VALUE 0x70CF0 TKW_VV_VV_UB 100.0 FORMULA_0003 0.0 255.0000 /end CHARACTERISTIC
/begin CHARACTERISTIC K_ED_LANK1_OBD_S.INC_VOR_EINTRAG "Filtererhoehung vorm Fehlerspeichereintrag | EN: Fault code LANK1_OBD_S - debounce filter increment before fault-memory entry" VALUE 0x70D24 TKW_VV_VV_UB 100.0 FORMULA_0003 0.0 255.0000 /end CHARACTERISTIC
/begin CHARACTERISTIC K_ED_LANK2_OBD_S.INC_VOR_EINTRAG "Filtererhoehung vorm Fehlerspeichereintrag | EN: Fault code LANK2_OBD_S - debounce filter increment before fault-memory entry" VALUE 0x70D3E TKW_VV_VV_UB 100.0 FORMULA_0003 0.0 255.0000 /end CHARACTERISTIC
/begin CHARACTERISTIC K_ED_LAVK1_OBD_TL.INC_VOR_EINTRAG "Filtererhoehung vorm Fehlerspeichereintrag | EN: Fault code LAVK1_OBD_TL - debounce filter increment before fault-memory entry" VALUE 0x70D58 TKW_VV_VV_UB 100.0 FORMULA_0003 0.0 255.0000 /end CHARACTERISTIC
/begin CHARACTERISTIC K_ED_LAVK1_DIAG.INC_VOR_EINTRAG "Filtererhoehung vorm Fehlerspeichereintrag | EN: Fault code LAVK1_DIAG - debounce filter increment before fault-memory entry" VALUE 0x70E90 TKW_VV_VV_UB 100.0 FORMULA_0003 0.0 255.0000 /end CHARACTERISTIC
/begin CHARACTERISTIC K_ED_LAVK1_IA_OPENLOAD.INC_VOR_EINTRAG "Filtererhoehung vorm Fehlerspeichereintrag | EN: Fault code LAVK1_IA_OPENLOAD - debounce filter increment before fault-memory entry" VALUE 0x70EC4 TKW_VV_VV_UB 100.0 FORMULA_0003 0.0 255.0000 /end CHARACTERISTIC
/begin CHARACTERISTIC K_ED_LAVK1_UN_OPENLOAD.INC_VOR_EINTRAG "Filtererhoehung vorm Fehlerspeichereintrag | EN: Fault code LAVK1_UN_OPENLOAD - debounce filter increment before fault-memory entry" VALUE 0x70F2C TKW_VV_VV_UB 100.0 FORMULA_0003 0.0 255.0000 /end CHARACTERISTIC
/begin CHARACTERISTIC K_ED_LAVK1_IP_OPENLOAD.INC_VOR_EINTRAG "Filtererhoehung vorm Fehlerspeichereintrag | EN: Fault code LAVK1_IP_OPENLOAD - debounce filter increment before fault-memory entry" VALUE 0x70F60 TKW_VV_VV_UB 100.0 FORMULA_0003 0.0 255.0000 /end CHARACTERISTIC
/begin CHARACTERISTIC K_ED_LAM1_REG.INC_VOR_EINTRAG "Filtererhoehung vorm Fehlerspeichereintrag | EN: Fault code LAM1_REG - debounce filter increment before fault-memory entry" VALUE 0x710B2 TKW_VV_VV_UB 100.0 FORMULA_0003 0.0 255.0000 /end CHARACTERISTIC
/begin CHARACTERISTIC K_ED_LAM2_REG.INC_VOR_EINTRAG "Filtererhoehung vorm Fehlerspeichereintrag | EN: Fault code LAM2_REG - debounce filter increment before fault-memory entry" VALUE 0x710CC TKW_VV_VV_UB 100.0 FORMULA_0003 0.0 255.0000 /end CHARACTERISTIC
/begin CHARACTERISTIC K_ED_LAVK1_OBD_DYN.INC_VOR_EINTRAG "Filtererhoehung vorm Fehlerspeichereintrag | EN: Fault code LAVK1_OBD_DYN - debounce filter increment before fault-memory entry" VALUE 0x712BA TKW_VV_VV_UB 100.0 FORMULA_0003 0.0 255.0000 /end CHARACTERISTIC
/begin CHARACTERISTIC K_ED_LAVK1_TRIM.INC_VOR_EINTRAG "Filtererhoehung vorm Fehlerspeichereintrag | EN: Fault code LAVK1_TRIM - debounce filter increment before fault-memory entry" VALUE 0x713D8 TKW_VV_VV_UB 100.0 FORMULA_0003 0.0 255.0000 /end CHARACTERISTIC
/begin CHARACTERISTIC K_ED_KAT_OBD1.INC_VOR_EINTRAG "Filtererhoehung vorm Fehlerspeichereintrag | EN: Fault code KAT_OBD1 - debounce filter increment before fault-memory entry" VALUE 0x7152A TKW_VV_VV_UB 100.0 FORMULA_0003 0.0 255.0000 /end CHARACTERISTIC
/begin CHARACTERISTIC K_ED_KAT_OBD2.INC_VOR_EINTRAG "Filtererhoehung vorm Fehlerspeichereintrag | EN: Fault code KAT_OBD2 - debounce filter increment before fault-memory entry" VALUE 0x71544 TKW_VV_VV_UB 100.0 FORMULA_0003 0.0 255.0000 /end CHARACTERISTIC
/begin CHARACTERISTIC K_ED_FI_QLT.INC_VOR_EINTRAG "Filtererhoehung vorm Fehlerspeichereintrag | EN: Fault code FI_QLT - debounce filter increment before fault-memory entry" VALUE 0x715AC TKW_VV_VV_UB 100.0 FORMULA_0003 0.0 255.0000 /end CHARACTERISTIC
/begin CHARACTERISTIC K_ED_FI_PMBN.INC_VOR_EINTRAG "Filtererhoehung vorm Fehlerspeichereintrag | EN: Fault code FI_PMBN - debounce filter increment before fault-memory entry" VALUE 0x71614 TKW_VV_VV_UB 100.0 FORMULA_0003 0.0 255.0000 /end CHARACTERISTIC
/begin CHARACTERISTIC K_ED_FI_PMRUHVERL.INC_VOR_EINTRAG "Filtererhoehung vorm Fehlerspeichereintrag | EN: Fault code FI_PMRUHVERL - debounce filter increment before fault-memory entry" VALUE 0x71732 TKW_VV_VV_UB 100.0 FORMULA_0003 0.0 255.0000 /end CHARACTERISTIC
/begin CHARACTERISTIC K_ED_FI_TOENS.INC_VOR_EINTRAG "Filtererhoehung vorm Fehlerspeichereintrag | EN: Fault code FI_TOENS - debounce filter increment before fault-memory entry" VALUE 0x7174C TKW_VV_VV_UB 100.0 FORMULA_0003 0.0 255.0000 /end CHARACTERISTIC
/begin CHARACTERISTIC K_ED_KW.INC_VOR_EINTRAG "Filtererhoehung vorm Fehlerspeichereintrag | EN: Fault code KW - debounce filter increment before fault-memory entry" VALUE 0x7186A TKW_VV_VV_UB 100.0 FORMULA_0003 0.0 255.0000 /end CHARACTERISTIC
/begin CHARACTERISTIC K_ED_LA1_ADAPT.INC_VOR_EINTRAG "Filtererhoehung vorm Fehlerspeichereintrag | EN: Fault code LA1_ADAPT - debounce filter increment before fault-memory entry" VALUE 0x71884 TKW_VV_VV_UB 100.0 FORMULA_0003 0.0 255.0000 /end CHARACTERISTIC
/begin CHARACTERISTIC K_ED_LA2_ADAPT.INC_VOR_EINTRAG "Filtererhoehung vorm Fehlerspeichereintrag | EN: Fault code LA2_ADAPT - debounce filter increment before fault-memory entry" VALUE 0x7189E TKW_VV_VV_UB 100.0 FORMULA_0003 0.0 255.0000 /end CHARACTERISTIC
/begin CHARACTERISTIC K_ED_KGE1.INC_VOR_EINTRAG "Filtererhoehung vorm Fehlerspeichereintrag | EN: Fault code KGE1 - debounce filter increment before fault-memory entry" VALUE 0x718B8 TKW_VV_VV_UB 100.0 FORMULA_0003 0.0 255.0000 /end CHARACTERISTIC
/begin CHARACTERISTIC K_ED_KGE2.INC_VOR_EINTRAG "Filtererhoehung vorm Fehlerspeichereintrag | EN: Fault code KGE2 - debounce filter increment before fault-memory entry" VALUE 0x718D2 TKW_VV_VV_UB 100.0 FORMULA_0003 0.0 255.0000 /end CHARACTERISTIC
/begin CHARACTERISTIC K_ED_FST.INC_VOR_EINTRAG "Filtererhoehung vorm Fehlerspeichereintrag | EN: Fault code FST - debounce filter increment before fault-memory entry" VALUE 0x718EC TKW_VV_VV_UB 100.0 FORMULA_0003 0.0 255.0000 /end CHARACTERISTIC
/begin CHARACTERISTIC K_ED_KSD1.INC_VOR_EINTRAG "Filtererhoehung vorm Fehlerspeichereintrag | EN: Fault code KSD1 - debounce filter increment before fault-memory entry" VALUE 0x71A24 TKW_VV_VV_UB 100.0 FORMULA_0003 0.0 255.0000 /end CHARACTERISTIC
/begin CHARACTERISTIC K_ED_KSD2.INC_VOR_EINTRAG "Filtererhoehung vorm Fehlerspeichereintrag | EN: Fault code KSD2 - debounce filter increment before fault-memory entry" VALUE 0x71A3E TKW_VV_VV_UB 100.0 FORMULA_0003 0.0 255.0000 /end CHARACTERISTIC
/begin CHARACTERISTIC K_ED_KATS_B1.INC_VOR_EINTRAG "Filtererhoehung vorm Fehlerspeichereintrag | EN: Fault code KATS_B1 - debounce filter increment before fault-memory entry" VALUE 0x71A58 TKW_VV_VV_UB 100.0 FORMULA_0003 0.0 255.0000 /end CHARACTERISTIC
/begin CHARACTERISTIC K_ED_KATS_B2.INC_VOR_EINTRAG "Filtererhoehung vorm Fehlerspeichereintrag | EN: Fault code KATS_B2 - debounce filter increment before fault-memory entry" VALUE 0x71A72 TKW_VV_VV_UB 100.0 FORMULA_0003 0.0 255.0000 /end CHARACTERISTIC
/begin CHARACTERISTIC K_ED_FST_GEBER.INC_VOR_EINTRAG "Filtererhoehung vorm Fehlerspeichereintrag | EN: Fault code FST_GEBER - debounce filter increment before fault-memory entry" VALUE 0x71AC0 TKW_VV_VV_UB 100.0 FORMULA_0003 0.0 255.0000 /end CHARACTERISTIC
/begin CHARACTERISTIC K_ED_LA1_TRIM_AD.INC_VOR_EINTRAG "Filtererhoehung vorm Fehlerspeichereintrag | EN: Fault code LA1_TRIM_AD - debounce filter increment before fault-memory entry" VALUE 0x71B5C TKW_VV_VV_UB 100.0 FORMULA_0003 0.0 255.0000 /end CHARACTERISTIC
/begin CHARACTERISTIC K_ED_LA2_TRIM_AD.INC_VOR_EINTRAG "Filtererhoehung vorm Fehlerspeichereintrag | EN: Fault code LA2_TRIM_AD - debounce filter increment before fault-memory entry" VALUE 0x71B76 TKW_VV_VV_UB 100.0 FORMULA_0003 0.0 255.0000 /end CHARACTERISTIC
/begin CHARACTERISTIC K_ED_LANK1_OPENLOAD.INC_VOR_EINTRAG "Filtererhoehung vorm Fehlerspeichereintrag | EN: Fault code LANK1_OPENLOAD - debounce filter increment before fault-memory entry" VALUE 0x71B90 TKW_VV_VV_UB 100.0 FORMULA_0003 0.0 255.0000 /end CHARACTERISTIC
/begin CHARACTERISTIC K_ED_LANK2_OPENLOAD.INC_VOR_EINTRAG "Filtererhoehung vorm Fehlerspeichereintrag | EN: Fault code LANK2_OPENLOAD - debounce filter increment before fault-memory entry" VALUE 0x71BAA TKW_VV_VV_UB 100.0 FORMULA_0003 0.0 255.0000 /end CHARACTERISTIC
/begin CHARACTERISTIC K_ED_LANK1_OBD_WE.INC_VOR_EINTRAG "Filtererhoehung vorm Fehlerspeichereintrag | EN: Fault code LANK1_OBD_WE - debounce filter increment before fault-memory entry" VALUE 0x71BC4 TKW_VV_VV_UB 100.0 FORMULA_0003 0.0 255.0000 /end CHARACTERISTIC
/begin CHARACTERISTIC K_ED_LANK2_OBD_WE.INC_VOR_EINTRAG "Filtererhoehung vorm Fehlerspeichereintrag | EN: Fault code LANK2_OBD_WE - debounce filter increment before fault-memory entry" VALUE 0x71BDE TKW_VV_VV_UB 100.0 FORMULA_0003 0.0 255.0000 /end CHARACTERISTIC
/begin CHARACTERISTIC K_ED_FST_GEBER_LI.INC_VOR_EINTRAG "Filtererhoehung vorm Fehlerspeichereintrag" VALUE 0x71CE2 TKW_VV_VV_UB 100.0 FORMULA_0003 0.0 255.0000 /end CHARACTERISTIC
/begin CHARACTERISTIC K_ED_FST_GEBER_RE.INC_VOR_EINTRAG "Filtererhoehung vorm Fehlerspeichereintrag" VALUE 0x71CFC TKW_VV_VV_UB 100.0 FORMULA_0003 0.0 255.0000 /end CHARACTERISTIC
/begin CHARACTERISTIC K_ED_LANK1_OBD_SLOPE.INC_VOR_EINTRAG "Filtererhoehung vorm Fehlerspeichereintrag" VALUE 0x71D16 TKW_VV_VV_UB 100.0 FORMULA_0003 0.0 255.0000 /end CHARACTERISTIC
/begin CHARACTERISTIC K_ED_LANK2_OBD_SLOPE.INC_VOR_EINTRAG "Filtererhoehung vorm Fehlerspeichereintrag" VALUE 0x71D30 TKW_VV_VV_UB 100.0 FORMULA_0003 0.0 255.0000 /end CHARACTERISTIC
/begin CHARACTERISTIC K_ED_INDEX_204_INJ.INC_VOR_EINTRAG "Filtererhoehung vorm Fehlerspeichereintrag | EN: Fault code INDEX_204_INJ - debounce filter increment before fault-memory entry" VALUE 0x71D98 TKW_VV_VV_UB 100.0 FORMULA_0003 0.0 255.0000 /end CHARACTERISTIC
/begin CHARACTERISTIC K_ED_INDEX_205_INJ.INC_VOR_EINTRAG "Filtererhoehung vorm Fehlerspeichereintrag | EN: Fault code INDEX_205_INJ - debounce filter increment before fault-memory entry" VALUE 0x71DB2 TKW_VV_VV_UB 100.0 FORMULA_0003 0.0 255.0000 /end CHARACTERISTIC
/begin CHARACTERISTIC K_ED_INDEX_206_INJ.INC_VOR_EINTRAG "Filtererhoehung vorm Fehlerspeichereintrag | EN: Fault code INDEX_206_INJ - debounce filter increment before fault-memory entry" VALUE 0x71DCC TKW_VV_VV_UB 100.0 FORMULA_0003 0.0 255.0000 /end CHARACTERISTIC
/begin CHARACTERISTIC K_ED_INDEX_207_INJ.INC_VOR_EINTRAG "Filtererhoehung vorm Fehlerspeichereintrag" VALUE 0x71DE6 TKW_VV_VV_UB 100.0 FORMULA_0003 0.0 255.0000 /end CHARACTERISTIC
/begin CHARACTERISTIC K_ED_INDEX_208_INJ.INC_VOR_EINTRAG "Filtererhoehung vorm Fehlerspeichereintrag" VALUE 0x71E00 TKW_VV_VV_UB 100.0 FORMULA_0003 0.0 255.0000 /end CHARACTERISTIC
/begin CHARACTERISTIC K_ED_INDEX_209_INJ.INC_VOR_EINTRAG "Filtererhoehung vorm Fehlerspeichereintrag" VALUE 0x71E1A TKW_VV_VV_UB 100.0 FORMULA_0003 0.0 255.0000 /end CHARACTERISTIC
/begin CHARACTERISTIC K_ED_INDEX_210_INJ.INC_VOR_EINTRAG "Filtererhoehung vorm Fehlerspeichereintrag" VALUE 0x71E34 TKW_VV_VV_UB 100.0 FORMULA_0003 0.0 255.0000 /end CHARACTERISTIC
/begin CHARACTERISTIC K_ED_INDEX_211_INJ.INC_VOR_EINTRAG "Filtererhoehung vorm Fehlerspeichereintrag | EN: Filtererhoehung vorm Fehlerspeichereintrag" VALUE 0x71E4E TKW_VV_VV_UB 100.0 FORMULA_0003 0.0 255.0000 /end CHARACTERISTIC
/begin CHARACTERISTIC K_ED_INDEX_212_INJ.INC_VOR_EINTRAG "Filtererhoehung vorm Fehlerspeichereintrag | EN: Filtererhoehung vorm Fehlerspeichereintrag" VALUE 0x71E68 TKW_VV_VV_UB 100.0 FORMULA_0003 0.0 255.0000 /end CHARACTERISTIC
/begin CHARACTERISTIC K_ED_INDEX_213_INJ.INC_VOR_EINTRAG "Filtererhoehung vorm Fehlerspeichereintrag" VALUE 0x71E82 TKW_VV_VV_UB 100.0 FORMULA_0003 0.0 255.0000 /end CHARACTERISTIC
/begin CHARACTERISTIC K_ED_INDEX_214_INJ.INC_VOR_EINTRAG "Filtererhoehung vorm Fehlerspeichereintrag" VALUE 0x71E9C TKW_VV_VV_UB 100.0 FORMULA_0003 0.0 255.0000 /end CHARACTERISTIC
/begin CHARACTERISTIC K_ED_INDEX_215_INJ.INC_VOR_EINTRAG "Filtererhoehung vorm Fehlerspeichereintrag" VALUE 0x71EB6 TKW_VV_VV_UB 100.0 FORMULA_0003 0.0 255.0000 /end CHARACTERISTIC
/begin CHARACTERISTIC K_ED_INDEX_216_INJ.INC_VOR_EINTRAG "Filtererhoehung vorm Fehlerspeichereintrag" VALUE 0x71ED0 TKW_VV_VV_UB 100.0 FORMULA_0003 0.0 255.0000 /end CHARACTERISTIC
/begin CHARACTERISTIC K_ED_INDEX_217_INJ.INC_VOR_EINTRAG "Filtererhoehung vorm Fehlerspeichereintrag" VALUE 0x71EEA TKW_VV_VV_UB 100.0 FORMULA_0003 0.0 255.0000 /end CHARACTERISTIC
/begin CHARACTERISTIC K_ED_INDEX_218_INJ.INC_VOR_EINTRAG "Filtererhoehung vorm Fehlerspeichereintrag" VALUE 0x71F04 TKW_VV_VV_UB 100.0 FORMULA_0003 0.0 255.0000 /end CHARACTERISTIC
/begin CHARACTERISTIC K_ED_INDEX_219_INJ.INC_VOR_EINTRAG "Filtererhoehung vorm Fehlerspeichereintrag" VALUE 0x71F1E TKW_VV_VV_UB 100.0 FORMULA_0003 0.0 255.0000 /end CHARACTERISTIC
/begin CHARACTERISTIC K_ED_INDEX_220_INJ.INC_VOR_EINTRAG "Filtererhoehung vorm Fehlerspeichereintrag" VALUE 0x71F38 TKW_VV_VV_UB 100.0 FORMULA_0003 0.0 255.0000 /end CHARACTERISTIC
/begin CHARACTERISTIC K_ED_INDEX_221_INJ.INC_VOR_EINTRAG "Filtererhoehung vorm Fehlerspeichereintrag" VALUE 0x71F52 TKW_VV_VV_UB 100.0 FORMULA_0003 0.0 255.0000 /end CHARACTERISTIC
/begin CHARACTERISTIC K_ED_INDEX_222_INJ.INC_VOR_EINTRAG "Filtererhoehung vorm Fehlerspeichereintrag" VALUE 0x71F6C TKW_VV_VV_UB 100.0 FORMULA_0003 0.0 255.0000 /end CHARACTERISTIC
/begin CHARACTERISTIC K_ED_INDEX_223_INJ.INC_VOR_EINTRAG "Filtererhoehung vorm Fehlerspeichereintrag" VALUE 0x71F86 TKW_VV_VV_UB 100.0 FORMULA_0003 0.0 255.0000 /end CHARACTERISTIC
/begin CHARACTERISTIC K_ED_HFM1.DEC_VOR_EINTRAG "Filterverringerung vorm Fehlerspeichereintrag | EN: Fault code HFM1 - debounce filter decrement before fault-memory entry" VALUE 0x70915 TKW_VV_VV_UB 100.0 FORMULA_0003 0.0 255.0000 /end CHARACTERISTIC
/begin CHARACTERISTIC K_ED_HFM2.DEC_VOR_EINTRAG "Filterverringerung vorm Fehlerspeichereintrag | EN: Fault code HFM2 - debounce filter decrement before fault-memory entry" VALUE 0x7092F TKW_VV_VV_UB 100.0 FORMULA_0003 0.0 255.0000 /end CHARACTERISTIC
/begin CHARACTERISTIC K_ED_LAVK1.DEC_VOR_EINTRAG "Filterverringerung vorm Fehlerspeichereintrag | EN: Fault code LAVK1 - debounce filter decrement before fault-memory entry" VALUE 0x70AE9 TKW_VV_VV_UB 100.0 FORMULA_0003 0.0 255.0000 /end CHARACTERISTIC
/begin CHARACTERISTIC K_ED_LAVK1_OBD_PLAU.DEC_VOR_EINTRAG "Filterverringerung vorm Fehlerspeichereintrag | EN: Fault code LAVK1_OBD_PLAU - debounce filter decrement before fault-memory entry" VALUE 0x70B1D TKW_VV_VV_UB 100.0 FORMULA_0003 0.0 255.0000 /end CHARACTERISTIC
/begin CHARACTERISTIC K_ED_LAVK1_OBD_SA.DEC_VOR_EINTRAG "Filterverringerung vorm Fehlerspeichereintrag | EN: Fault code LAVK1_OBD_SA - debounce filter decrement before fault-memory entry" VALUE 0x70B51 TKW_VV_VV_UB 100.0 FORMULA_0003 0.0 255.0000 /end CHARACTERISTIC
/begin CHARACTERISTIC K_ED_LANK1.DEC_VOR_EINTRAG "Filterverringerung vorm Fehlerspeichereintrag | EN: Fault code LANK1 - debounce filter decrement before fault-memory entry" VALUE 0x70B85 TKW_VV_VV_UB 100.0 FORMULA_0003 0.0 255.0000 /end CHARACTERISTIC
/begin CHARACTERISTIC K_ED_LANK2.DEC_VOR_EINTRAG "Filterverringerung vorm Fehlerspeichereintrag | EN: Fault code LANK2 - debounce filter decrement before fault-memory entry" VALUE 0x70B9F TKW_VV_VV_UB 100.0 FORMULA_0003 0.0 255.0000 /end CHARACTERISTIC
/begin CHARACTERISTIC K_ED_FPLAU1.DEC_VOR_EINTRAG "Filterverringerung vorm Fehlerspeichereintrag | EN: Fault code FPLAU1 - debounce filter decrement before fault-memory entry" VALUE 0x70CD7 TKW_VV_VV_UB 100.0 FORMULA_0003 0.0 255.0000 /end CHARACTERISTIC
/begin CHARACTERISTIC K_ED_FPLAU2.DEC_VOR_EINTRAG "Filterverringerung vorm Fehlerspeichereintrag | EN: Fault code FPLAU2 - debounce filter decrement before fault-memory entry" VALUE 0x70CF1 TKW_VV_VV_UB 100.0 FORMULA_0003 0.0 255.0000 /end CHARACTERISTIC
/begin CHARACTERISTIC K_ED_LANK1_OBD_S.DEC_VOR_EINTRAG "Filterverringerung vorm Fehlerspeichereintrag | EN: Fault code LANK1_OBD_S - debounce filter decrement before fault-memory entry" VALUE 0x70D25 TKW_VV_VV_UB 100.0 FORMULA_0003 0.0 255.0000 /end CHARACTERISTIC
/begin CHARACTERISTIC K_ED_LANK2_OBD_S.DEC_VOR_EINTRAG "Filterverringerung vorm Fehlerspeichereintrag | EN: Fault code LANK2_OBD_S - debounce filter decrement before fault-memory entry" VALUE 0x70D3F TKW_VV_VV_UB 100.0 FORMULA_0003 0.0 255.0000 /end CHARACTERISTIC
/begin CHARACTERISTIC K_ED_LAVK1_OBD_TL.DEC_VOR_EINTRAG "Filterverringerung vorm Fehlerspeichereintrag | EN: Fault code LAVK1_OBD_TL - debounce filter decrement before fault-memory entry" VALUE 0x70D59 TKW_VV_VV_UB 100.0 FORMULA_0003 0.0 255.0000 /end CHARACTERISTIC
/begin CHARACTERISTIC K_ED_LAVK1_DIAG.DEC_VOR_EINTRAG "Filterverringerung vorm Fehlerspeichereintrag | EN: Fault code LAVK1_DIAG - debounce filter decrement before fault-memory entry" VALUE 0x70E91 TKW_VV_VV_UB 100.0 FORMULA_0003 0.0 255.0000 /end CHARACTERISTIC
/begin CHARACTERISTIC K_ED_LAVK1_IA_OPENLOAD.DEC_VOR_EINTRAG "Filterverringerung vorm Fehlerspeichereintrag | EN: Fault code LAVK1_IA_OPENLOAD - debounce filter decrement before fault-memory entry" VALUE 0x70EC5 TKW_VV_VV_UB 100.0 FORMULA_0003 0.0 255.0000 /end CHARACTERISTIC
/begin CHARACTERISTIC K_ED_LAVK1_UN_OPENLOAD.DEC_VOR_EINTRAG "Filterverringerung vorm Fehlerspeichereintrag | EN: Fault code LAVK1_UN_OPENLOAD - debounce filter decrement before fault-memory entry" VALUE 0x70F2D TKW_VV_VV_UB 100.0 FORMULA_0003 0.0 255.0000 /end CHARACTERISTIC
/begin CHARACTERISTIC K_ED_LAVK1_IP_OPENLOAD.DEC_VOR_EINTRAG "Filterverringerung vorm Fehlerspeichereintrag | EN: Fault code LAVK1_IP_OPENLOAD - debounce filter decrement before fault-memory entry" VALUE 0x70F61 TKW_VV_VV_UB 100.0 FORMULA_0003 0.0 255.0000 /end CHARACTERISTIC
/begin CHARACTERISTIC K_ED_LAM1_REG.DEC_VOR_EINTRAG "Filterverringerung vorm Fehlerspeichereintrag | EN: Fault code LAM1_REG - debounce filter decrement before fault-memory entry" VALUE 0x710B3 TKW_VV_VV_UB 100.0 FORMULA_0003 0.0 255.0000 /end CHARACTERISTIC
/begin CHARACTERISTIC K_ED_LAM2_REG.DEC_VOR_EINTRAG "Filterverringerung vorm Fehlerspeichereintrag | EN: Fault code LAM2_REG - debounce filter decrement before fault-memory entry" VALUE 0x710CD TKW_VV_VV_UB 100.0 FORMULA_0003 0.0 255.0000 /end CHARACTERISTIC
/begin CHARACTERISTIC K_ED_LAVK1_OBD_DYN.DEC_VOR_EINTRAG "Filterverringerung vorm Fehlerspeichereintrag | EN: Fault code LAVK1_OBD_DYN - debounce filter decrement before fault-memory entry" VALUE 0x712BB TKW_VV_VV_UB 100.0 FORMULA_0003 0.0 255.0000 /end CHARACTERISTIC
/begin CHARACTERISTIC K_ED_LAVK1_TRIM.DEC_VOR_EINTRAG "Filterverringerung vorm Fehlerspeichereintrag | EN: Fault code LAVK1_TRIM - debounce filter decrement before fault-memory entry" VALUE 0x713D9 TKW_VV_VV_UB 100.0 FORMULA_0003 0.0 255.0000 /end CHARACTERISTIC
/begin CHARACTERISTIC K_ED_KAT_OBD1.DEC_VOR_EINTRAG "Filterverringerung vorm Fehlerspeichereintrag | EN: Fault code KAT_OBD1 - debounce filter decrement before fault-memory entry" VALUE 0x7152B TKW_VV_VV_UB 100.0 FORMULA_0003 0.0 255.0000 /end CHARACTERISTIC
/begin CHARACTERISTIC K_ED_KAT_OBD2.DEC_VOR_EINTRAG "Filterverringerung vorm Fehlerspeichereintrag | EN: Fault code KAT_OBD2 - debounce filter decrement before fault-memory entry" VALUE 0x71545 TKW_VV_VV_UB 100.0 FORMULA_0003 0.0 255.0000 /end CHARACTERISTIC
/begin CHARACTERISTIC K_ED_FI_QLT.DEC_VOR_EINTRAG "Filterverringerung vorm Fehlerspeichereintrag | EN: Fault code FI_QLT - debounce filter decrement before fault-memory entry" VALUE 0x715AD TKW_VV_VV_UB 100.0 FORMULA_0003 0.0 255.0000 /end CHARACTERISTIC
/begin CHARACTERISTIC K_ED_FI_PMBN.DEC_VOR_EINTRAG "Filterverringerung vorm Fehlerspeichereintrag | EN: Fault code FI_PMBN - debounce filter decrement before fault-memory entry" VALUE 0x71615 TKW_VV_VV_UB 100.0 FORMULA_0003 0.0 255.0000 /end CHARACTERISTIC
/begin CHARACTERISTIC K_ED_FI_PMRUHVERL.DEC_VOR_EINTRAG "Filterverringerung vorm Fehlerspeichereintrag | EN: Fault code FI_PMRUHVERL - debounce filter decrement before fault-memory entry" VALUE 0x71733 TKW_VV_VV_UB 100.0 FORMULA_0003 0.0 255.0000 /end CHARACTERISTIC
/begin CHARACTERISTIC K_ED_FI_TOENS.DEC_VOR_EINTRAG "Filterverringerung vorm Fehlerspeichereintrag | EN: Fault code FI_TOENS - debounce filter decrement before fault-memory entry" VALUE 0x7174D TKW_VV_VV_UB 100.0 FORMULA_0003 0.0 255.0000 /end CHARACTERISTIC
/begin CHARACTERISTIC K_ED_KW.DEC_VOR_EINTRAG "Filterverringerung vorm Fehlerspeichereintrag | EN: Fault code KW - debounce filter decrement before fault-memory entry" VALUE 0x7186B TKW_VV_VV_UB 100.0 FORMULA_0003 0.0 255.0000 /end CHARACTERISTIC
/begin CHARACTERISTIC K_ED_LA1_ADAPT.DEC_VOR_EINTRAG "Filterverringerung vorm Fehlerspeichereintrag | EN: Fault code LA1_ADAPT - debounce filter decrement before fault-memory entry" VALUE 0x71885 TKW_VV_VV_UB 100.0 FORMULA_0003 0.0 255.0000 /end CHARACTERISTIC
/begin CHARACTERISTIC K_ED_LA2_ADAPT.DEC_VOR_EINTRAG "Filterverringerung vorm Fehlerspeichereintrag | EN: Fault code LA2_ADAPT - debounce filter decrement before fault-memory entry" VALUE 0x7189F TKW_VV_VV_UB 100.0 FORMULA_0003 0.0 255.0000 /end CHARACTERISTIC
/begin CHARACTERISTIC K_ED_KGE1.DEC_VOR_EINTRAG "Filterverringerung vorm Fehlerspeichereintrag | EN: Fault code KGE1 - debounce filter decrement before fault-memory entry" VALUE 0x718B9 TKW_VV_VV_UB 100.0 FORMULA_0003 0.0 255.0000 /end CHARACTERISTIC
/begin CHARACTERISTIC K_ED_KGE2.DEC_VOR_EINTRAG "Filterverringerung vorm Fehlerspeichereintrag | EN: Fault code KGE2 - debounce filter decrement before fault-memory entry" VALUE 0x718D3 TKW_VV_VV_UB 100.0 FORMULA_0003 0.0 255.0000 /end CHARACTERISTIC
/begin CHARACTERISTIC K_ED_FST.DEC_VOR_EINTRAG "Filterverringerung vorm Fehlerspeichereintrag | EN: Fault code FST - debounce filter decrement before fault-memory entry" VALUE 0x718ED TKW_VV_VV_UB 100.0 FORMULA_0003 0.0 255.0000 /end CHARACTERISTIC
/begin CHARACTERISTIC K_ED_KSD1.DEC_VOR_EINTRAG "Filterverringerung vorm Fehlerspeichereintrag | EN: Fault code KSD1 - debounce filter decrement before fault-memory entry" VALUE 0x71A25 TKW_VV_VV_UB 100.0 FORMULA_0003 0.0 255.0000 /end CHARACTERISTIC
/begin CHARACTERISTIC K_ED_KSD2.DEC_VOR_EINTRAG "Filterverringerung vorm Fehlerspeichereintrag | EN: Fault code KSD2 - debounce filter decrement before fault-memory entry" VALUE 0x71A3F TKW_VV_VV_UB 100.0 FORMULA_0003 0.0 255.0000 /end CHARACTERISTIC
/begin CHARACTERISTIC K_ED_KATS_B1.DEC_VOR_EINTRAG "Filterverringerung vorm Fehlerspeichereintrag | EN: Fault code KATS_B1 - debounce filter decrement before fault-memory entry" VALUE 0x71A59 TKW_VV_VV_UB 100.0 FORMULA_0003 0.0 255.0000 /end CHARACTERISTIC
/begin CHARACTERISTIC K_ED_KATS_B2.DEC_VOR_EINTRAG "Filterverringerung vorm Fehlerspeichereintrag | EN: Fault code KATS_B2 - debounce filter decrement before fault-memory entry" VALUE 0x71A73 TKW_VV_VV_UB 100.0 FORMULA_0003 0.0 255.0000 /end CHARACTERISTIC
/begin CHARACTERISTIC K_ED_FST_GEBER.DEC_VOR_EINTRAG "Filterverringerung vorm Fehlerspeichereintrag | EN: Fault code FST_GEBER - debounce filter decrement before fault-memory entry" VALUE 0x71AC1 TKW_VV_VV_UB 100.0 FORMULA_0003 0.0 255.0000 /end CHARACTERISTIC
/begin CHARACTERISTIC K_ED_LA1_TRIM_AD.DEC_VOR_EINTRAG "Filterverringerung vorm Fehlerspeichereintrag | EN: Fault code LA1_TRIM_AD - debounce filter decrement before fault-memory entry" VALUE 0x71B5D TKW_VV_VV_UB 100.0 FORMULA_0003 0.0 255.0000 /end CHARACTERISTIC
/begin CHARACTERISTIC K_ED_LA2_TRIM_AD.DEC_VOR_EINTRAG "Filterverringerung vorm Fehlerspeichereintrag | EN: Fault code LA2_TRIM_AD - debounce filter decrement before fault-memory entry" VALUE 0x71B77 TKW_VV_VV_UB 100.0 FORMULA_0003 0.0 255.0000 /end CHARACTERISTIC
/begin CHARACTERISTIC K_ED_LANK1_OPENLOAD.DEC_VOR_EINTRAG "Filterverringerung vorm Fehlerspeichereintrag | EN: Fault code LANK1_OPENLOAD - debounce filter decrement before fault-memory entry" VALUE 0x71B91 TKW_VV_VV_UB 100.0 FORMULA_0003 0.0 255.0000 /end CHARACTERISTIC
/begin CHARACTERISTIC K_ED_LANK2_OPENLOAD.DEC_VOR_EINTRAG "Filterverringerung vorm Fehlerspeichereintrag | EN: Fault code LANK2_OPENLOAD - debounce filter decrement before fault-memory entry" VALUE 0x71BAB TKW_VV_VV_UB 100.0 FORMULA_0003 0.0 255.0000 /end CHARACTERISTIC
/begin CHARACTERISTIC K_ED_LANK1_OBD_WE.DEC_VOR_EINTRAG "Filterverringerung vorm Fehlerspeichereintrag | EN: Fault code LANK1_OBD_WE - debounce filter decrement before fault-memory entry" VALUE 0x71BC5 TKW_VV_VV_UB 100.0 FORMULA_0003 0.0 255.0000 /end CHARACTERISTIC
/begin CHARACTERISTIC K_ED_LANK2_OBD_WE.DEC_VOR_EINTRAG "Filterverringerung vorm Fehlerspeichereintrag | EN: Fault code LANK2_OBD_WE - debounce filter decrement before fault-memory entry" VALUE 0x71BDF TKW_VV_VV_UB 100.0 FORMULA_0003 0.0 255.0000 /end CHARACTERISTIC
/begin CHARACTERISTIC K_ED_FST_GEBER_LI.DEC_VOR_EINTRAG "Filterverringerung vorm Fehlerspeichereintrag" VALUE 0x71CE3 TKW_VV_VV_UB 100.0 FORMULA_0003 0.0 255.0000 /end CHARACTERISTIC
/begin CHARACTERISTIC K_ED_FST_GEBER_RE.DEC_VOR_EINTRAG "Filterverringerung vorm Fehlerspeichereintrag" VALUE 0x71CFD TKW_VV_VV_UB 100.0 FORMULA_0003 0.0 255.0000 /end CHARACTERISTIC
/begin CHARACTERISTIC K_ED_LANK1_OBD_SLOPE.DEC_VOR_EINTRAG "Filterverringerung vorm Fehlerspeichereintrag" VALUE 0x71D17 TKW_VV_VV_UB 100.0 FORMULA_0003 0.0 255.0000 /end CHARACTERISTIC
/begin CHARACTERISTIC K_ED_LANK2_OBD_SLOPE.DEC_VOR_EINTRAG "Filterverringerung vorm Fehlerspeichereintrag" VALUE 0x71D31 TKW_VV_VV_UB 100.0 FORMULA_0003 0.0 255.0000 /end CHARACTERISTIC
/begin CHARACTERISTIC K_ED_INDEX_204_INJ.DEC_VOR_EINTRAG "Filterverringerung vorm Fehlerspeichereintrag | EN: Fault code INDEX_204_INJ - debounce filter decrement before fault-memory entry" VALUE 0x71D99 TKW_VV_VV_UB 100.0 FORMULA_0003 0.0 255.0000 /end CHARACTERISTIC
/begin CHARACTERISTIC K_ED_INDEX_205_INJ.DEC_VOR_EINTRAG "Filterverringerung vorm Fehlerspeichereintrag | EN: Fault code INDEX_205_INJ - debounce filter decrement before fault-memory entry" VALUE 0x71DB3 TKW_VV_VV_UB 100.0 FORMULA_0003 0.0 255.0000 /end CHARACTERISTIC
/begin CHARACTERISTIC K_ED_INDEX_206_INJ.DEC_VOR_EINTRAG "Filterverringerung vorm Fehlerspeichereintrag | EN: Fault code INDEX_206_INJ - debounce filter decrement before fault-memory entry" VALUE 0x71DCD TKW_VV_VV_UB 100.0 FORMULA_0003 0.0 255.0000 /end CHARACTERISTIC
/begin CHARACTERISTIC K_ED_INDEX_207_INJ.DEC_VOR_EINTRAG "Filterverringerung vorm Fehlerspeichereintrag" VALUE 0x71DE7 TKW_VV_VV_UB 100.0 FORMULA_0003 0.0 255.0000 /end CHARACTERISTIC
/begin CHARACTERISTIC K_ED_INDEX_208_INJ.DEC_VOR_EINTRAG "Filterverringerung vorm Fehlerspeichereintrag" VALUE 0x71E01 TKW_VV_VV_UB 100.0 FORMULA_0003 0.0 255.0000 /end CHARACTERISTIC
/begin CHARACTERISTIC K_ED_INDEX_209_INJ.DEC_VOR_EINTRAG "Filterverringerung vorm Fehlerspeichereintrag" VALUE 0x71E1B TKW_VV_VV_UB 100.0 FORMULA_0003 0.0 255.0000 /end CHARACTERISTIC
/begin CHARACTERISTIC K_ED_INDEX_210_INJ.DEC_VOR_EINTRAG "Filterverringerung vorm Fehlerspeichereintrag" VALUE 0x71E35 TKW_VV_VV_UB 100.0 FORMULA_0003 0.0 255.0000 /end CHARACTERISTIC
/begin CHARACTERISTIC K_ED_INDEX_211_INJ.DEC_VOR_EINTRAG "Filterverringerung vorm Fehlerspeichereintrag | EN: Filterverringerung vorm Fehlerspeichereintrag" VALUE 0x71E4F TKW_VV_VV_UB 100.0 FORMULA_0003 0.0 255.0000 /end CHARACTERISTIC
/begin CHARACTERISTIC K_ED_INDEX_212_INJ.DEC_VOR_EINTRAG "Filterverringerung vorm Fehlerspeichereintrag" VALUE 0x71E69 TKW_VV_VV_UB 100.0 FORMULA_0003 0.0 255.0000 /end CHARACTERISTIC
/begin CHARACTERISTIC K_ED_INDEX_213_INJ.DEC_VOR_EINTRAG "Filterverringerung vorm Fehlerspeichereintrag" VALUE 0x71E83 TKW_VV_VV_UB 100.0 FORMULA_0003 0.0 255.0000 /end CHARACTERISTIC
/begin CHARACTERISTIC K_ED_INDEX_214_INJ.DEC_VOR_EINTRAG "Filterverringerung vorm Fehlerspeichereintrag" VALUE 0x71E9D TKW_VV_VV_UB 100.0 FORMULA_0003 0.0 255.0000 /end CHARACTERISTIC
/begin CHARACTERISTIC K_ED_INDEX_215_INJ.DEC_VOR_EINTRAG "Filterverringerung vorm Fehlerspeichereintrag" VALUE 0x71EB7 TKW_VV_VV_UB 100.0 FORMULA_0003 0.0 255.0000 /end CHARACTERISTIC
/begin CHARACTERISTIC K_ED_INDEX_216_INJ.DEC_VOR_EINTRAG "Filterverringerung vorm Fehlerspeichereintrag" VALUE 0x71ED1 TKW_VV_VV_UB 100.0 FORMULA_0003 0.0 255.0000 /end CHARACTERISTIC
/begin CHARACTERISTIC K_ED_INDEX_217_INJ.DEC_VOR_EINTRAG "Filterverringerung vorm Fehlerspeichereintrag" VALUE 0x71EEB TKW_VV_VV_UB 100.0 FORMULA_0003 0.0 255.0000 /end CHARACTERISTIC
/begin CHARACTERISTIC K_ED_INDEX_218_INJ.DEC_VOR_EINTRAG "Filterverringerung vorm Fehlerspeichereintrag" VALUE 0x71F05 TKW_VV_VV_UB 100.0 FORMULA_0003 0.0 255.0000 /end CHARACTERISTIC
/begin CHARACTERISTIC K_ED_INDEX_219_INJ.DEC_VOR_EINTRAG "Filterverringerung vorm Fehlerspeichereintrag" VALUE 0x71F1F TKW_VV_VV_UB 100.0 FORMULA_0003 0.0 255.0000 /end CHARACTERISTIC
/begin CHARACTERISTIC K_ED_INDEX_220_INJ.DEC_VOR_EINTRAG "Filterverringerung vorm Fehlerspeichereintrag" VALUE 0x71F39 TKW_VV_VV_UB 100.0 FORMULA_0003 0.0 255.0000 /end CHARACTERISTIC
/begin CHARACTERISTIC K_ED_INDEX_221_INJ.DEC_VOR_EINTRAG "Filterverringerung vorm Fehlerspeichereintrag" VALUE 0x71F53 TKW_VV_VV_UB 100.0 FORMULA_0003 0.0 255.0000 /end CHARACTERISTIC
/begin CHARACTERISTIC K_ED_INDEX_222_INJ.DEC_VOR_EINTRAG "Filterverringerung vorm Fehlerspeichereintrag" VALUE 0x71F6D TKW_VV_VV_UB 100.0 FORMULA_0003 0.0 255.0000 /end CHARACTERISTIC
/begin CHARACTERISTIC K_ED_INDEX_223_INJ.DEC_VOR_EINTRAG "Filterverringerung vorm Fehlerspeichereintrag" VALUE 0x71F87 TKW_VV_VV_UB 100.0 FORMULA_0003 0.0 255.0000 /end CHARACTERISTIC
/begin CHARACTERISTIC K_ED_HFM1.INC_NACH_EINTRAG "Filtererhoehung nach Fehlerspeichereintrag | EN: Fault code HFM1 - debounce filter increment after fault-memory entry" VALUE 0x70916 TKW_VV_VV_UB 100.0 FORMULA_0003 0.0 255.0000 /end CHARACTERISTIC
/begin CHARACTERISTIC K_ED_HFM2.INC_NACH_EINTRAG "Filtererhoehung nach Fehlerspeichereintrag | EN: Fault code HFM2 - debounce filter increment after fault-memory entry" VALUE 0x70930 TKW_VV_VV_UB 100.0 FORMULA_0003 0.0 255.0000 /end CHARACTERISTIC
/begin CHARACTERISTIC K_ED_LAVK1.INC_NACH_EINTRAG "Filtererhoehung nach Fehlerspeichereintrag | EN: Fault code LAVK1 - debounce filter increment after fault-memory entry" VALUE 0x70AEA TKW_VV_VV_UB 100.0 FORMULA_0003 0.0 255.0000 /end CHARACTERISTIC
/begin CHARACTERISTIC K_ED_LAVK1_OBD_PLAU.INC_NACH_EINTRAG "Filtererhoehung nach Fehlerspeichereintrag | EN: Fault code LAVK1_OBD_PLAU - debounce filter increment after fault-memory entry" VALUE 0x70B1E TKW_VV_VV_UB 100.0 FORMULA_0003 0.0 255.0000 /end CHARACTERISTIC
/begin CHARACTERISTIC K_ED_LAVK1_OBD_SA.INC_NACH_EINTRAG "Filtererhoehung nach Fehlerspeichereintrag | EN: Fault code LAVK1_OBD_SA - debounce filter increment after fault-memory entry" VALUE 0x70B52 TKW_VV_VV_UB 100.0 FORMULA_0003 0.0 255.0000 /end CHARACTERISTIC
/begin CHARACTERISTIC K_ED_LANK1.INC_NACH_EINTRAG "Filtererhoehung nach Fehlerspeichereintrag | EN: Fault code LANK1 - debounce filter increment after fault-memory entry" VALUE 0x70B86 TKW_VV_VV_UB 100.0 FORMULA_0003 0.0 255.0000 /end CHARACTERISTIC
/begin CHARACTERISTIC K_ED_LANK2.INC_NACH_EINTRAG "Filtererhoehung nach Fehlerspeichereintrag | EN: Fault code LANK2 - debounce filter increment after fault-memory entry" VALUE 0x70BA0 TKW_VV_VV_UB 100.0 FORMULA_0003 0.0 255.0000 /end CHARACTERISTIC
/begin CHARACTERISTIC K_ED_FPLAU1.INC_NACH_EINTRAG "Filtererhoehung nach Fehlerspeichereintrag | EN: Fault code FPLAU1 - debounce filter increment after fault-memory entry" VALUE 0x70CD8 TKW_VV_VV_UB 100.0 FORMULA_0003 0.0 255.0000 /end CHARACTERISTIC
/begin CHARACTERISTIC K_ED_FPLAU2.INC_NACH_EINTRAG "Filtererhoehung nach Fehlerspeichereintrag | EN: Fault code FPLAU2 - debounce filter increment after fault-memory entry" VALUE 0x70CF2 TKW_VV_VV_UB 100.0 FORMULA_0003 0.0 255.0000 /end CHARACTERISTIC
/begin CHARACTERISTIC K_ED_LANK1_OBD_S.INC_NACH_EINTRAG "Filtererhoehung nach Fehlerspeichereintrag | EN: Fault code LANK1_OBD_S - debounce filter increment after fault-memory entry" VALUE 0x70D26 TKW_VV_VV_UB 100.0 FORMULA_0003 0.0 255.0000 /end CHARACTERISTIC
/begin CHARACTERISTIC K_ED_LANK2_OBD_S.INC_NACH_EINTRAG "Filtererhoehung nach Fehlerspeichereintrag | EN: Fault code LANK2_OBD_S - debounce filter increment after fault-memory entry" VALUE 0x70D40 TKW_VV_VV_UB 100.0 FORMULA_0003 0.0 255.0000 /end CHARACTERISTIC
/begin CHARACTERISTIC K_ED_LAVK1_OBD_TL.INC_NACH_EINTRAG "Filtererhoehung nach Fehlerspeichereintrag | EN: Fault code LAVK1_OBD_TL - debounce filter increment after fault-memory entry" VALUE 0x70D5A TKW_VV_VV_UB 100.0 FORMULA_0003 0.0 255.0000 /end CHARACTERISTIC
/begin CHARACTERISTIC K_ED_LAVK1_DIAG.INC_NACH_EINTRAG "Filtererhoehung nach Fehlerspeichereintrag | EN: Fault code LAVK1_DIAG - debounce filter increment after fault-memory entry" VALUE 0x70E92 TKW_VV_VV_UB 100.0 FORMULA_0003 0.0 255.0000 /end CHARACTERISTIC
/begin CHARACTERISTIC K_ED_LAVK1_IA_OPENLOAD.INC_NACH_EINTRAG "Filtererhoehung nach Fehlerspeichereintrag | EN: Fault code LAVK1_IA_OPENLOAD - debounce filter increment after fault-memory entry" VALUE 0x70EC6 TKW_VV_VV_UB 100.0 FORMULA_0003 0.0 255.0000 /end CHARACTERISTIC
/begin CHARACTERISTIC K_ED_LAVK1_UN_OPENLOAD.INC_NACH_EINTRAG "Filtererhoehung nach Fehlerspeichereintrag | EN: Fault code LAVK1_UN_OPENLOAD - debounce filter increment after fault-memory entry" VALUE 0x70F2E TKW_VV_VV_UB 100.0 FORMULA_0003 0.0 255.0000 /end CHARACTERISTIC
/begin CHARACTERISTIC K_ED_LAVK1_IP_OPENLOAD.INC_NACH_EINTRAG "Filtererhoehung nach Fehlerspeichereintrag | EN: Fault code LAVK1_IP_OPENLOAD - debounce filter increment after fault-memory entry" VALUE 0x70F62 TKW_VV_VV_UB 100.0 FORMULA_0003 0.0 255.0000 /end CHARACTERISTIC
/begin CHARACTERISTIC K_ED_LAM1_REG.INC_NACH_EINTRAG "Filtererhoehung nach Fehlerspeichereintrag | EN: Fault code LAM1_REG - debounce filter increment after fault-memory entry" VALUE 0x710B4 TKW_VV_VV_UB 100.0 FORMULA_0003 0.0 255.0000 /end CHARACTERISTIC
/begin CHARACTERISTIC K_ED_LAM2_REG.INC_NACH_EINTRAG "Filtererhoehung nach Fehlerspeichereintrag | EN: Fault code LAM2_REG - debounce filter increment after fault-memory entry" VALUE 0x710CE TKW_VV_VV_UB 100.0 FORMULA_0003 0.0 255.0000 /end CHARACTERISTIC
/begin CHARACTERISTIC K_ED_LAVK1_OBD_DYN.INC_NACH_EINTRAG "Filtererhoehung nach Fehlerspeichereintrag | EN: Fault code LAVK1_OBD_DYN - debounce filter increment after fault-memory entry" VALUE 0x712BC TKW_VV_VV_UB 100.0 FORMULA_0003 0.0 255.0000 /end CHARACTERISTIC
/begin CHARACTERISTIC K_ED_LAVK1_TRIM.INC_NACH_EINTRAG "Filtererhoehung nach Fehlerspeichereintrag | EN: Fault code LAVK1_TRIM - debounce filter increment after fault-memory entry" VALUE 0x713DA TKW_VV_VV_UB 100.0 FORMULA_0003 0.0 255.0000 /end CHARACTERISTIC
/begin CHARACTERISTIC K_ED_KAT_OBD1.INC_NACH_EINTRAG "Filtererhoehung nach Fehlerspeichereintrag | EN: Fault code KAT_OBD1 - debounce filter increment after fault-memory entry" VALUE 0x7152C TKW_VV_VV_UB 100.0 FORMULA_0003 0.0 255.0000 /end CHARACTERISTIC
/begin CHARACTERISTIC K_ED_KAT_OBD2.INC_NACH_EINTRAG "Filtererhoehung nach Fehlerspeichereintrag | EN: Fault code KAT_OBD2 - debounce filter increment after fault-memory entry" VALUE 0x71546 TKW_VV_VV_UB 100.0 FORMULA_0003 0.0 255.0000 /end CHARACTERISTIC
/begin CHARACTERISTIC K_ED_FI_QLT.INC_NACH_EINTRAG "Filtererhoehung nach Fehlerspeichereintrag | EN: Fault code FI_QLT - debounce filter increment after fault-memory entry" VALUE 0x715AE TKW_VV_VV_UB 100.0 FORMULA_0003 0.0 255.0000 /end CHARACTERISTIC
/begin CHARACTERISTIC K_ED_FI_PMBN.INC_NACH_EINTRAG "Filtererhoehung nach Fehlerspeichereintrag | EN: Fault code FI_PMBN - debounce filter increment after fault-memory entry" VALUE 0x71616 TKW_VV_VV_UB 100.0 FORMULA_0003 0.0 255.0000 /end CHARACTERISTIC
/begin CHARACTERISTIC K_ED_FI_PMRUHVERL.INC_NACH_EINTRAG "Filtererhoehung nach Fehlerspeichereintrag | EN: Fault code FI_PMRUHVERL - debounce filter increment after fault-memory entry" VALUE 0x71734 TKW_VV_VV_UB 100.0 FORMULA_0003 0.0 255.0000 /end CHARACTERISTIC
/begin CHARACTERISTIC K_ED_FI_TOENS.INC_NACH_EINTRAG "Filtererhoehung nach Fehlerspeichereintrag | EN: Fault code FI_TOENS - debounce filter increment after fault-memory entry" VALUE 0x7174E TKW_VV_VV_UB 100.0 FORMULA_0003 0.0 255.0000 /end CHARACTERISTIC
/begin CHARACTERISTIC K_ED_KW.INC_NACH_EINTRAG "Filtererhoehung nach Fehlerspeichereintrag | EN: Fault code KW - debounce filter increment after fault-memory entry" VALUE 0x7186C TKW_VV_VV_UB 100.0 FORMULA_0003 0.0 255.0000 /end CHARACTERISTIC
/begin CHARACTERISTIC K_ED_LA1_ADAPT.INC_NACH_EINTRAG "Filtererhoehung nach Fehlerspeichereintrag | EN: Fault code LA1_ADAPT - debounce filter increment after fault-memory entry" VALUE 0x71886 TKW_VV_VV_UB 100.0 FORMULA_0003 0.0 255.0000 /end CHARACTERISTIC
/begin CHARACTERISTIC K_ED_LA2_ADAPT.INC_NACH_EINTRAG "Filtererhoehung nach Fehlerspeichereintrag | EN: Fault code LA2_ADAPT - debounce filter increment after fault-memory entry" VALUE 0x718A0 TKW_VV_VV_UB 100.0 FORMULA_0003 0.0 255.0000 /end CHARACTERISTIC
/begin CHARACTERISTIC K_ED_KGE1.INC_NACH_EINTRAG "Filtererhoehung nach Fehlerspeichereintrag | EN: Fault code KGE1 - debounce filter increment after fault-memory entry" VALUE 0x718BA TKW_VV_VV_UB 100.0 FORMULA_0003 0.0 255.0000 /end CHARACTERISTIC
/begin CHARACTERISTIC K_ED_KGE2.INC_NACH_EINTRAG "Filtererhoehung nach Fehlerspeichereintrag | EN: Fault code KGE2 - debounce filter increment after fault-memory entry" VALUE 0x718D4 TKW_VV_VV_UB 100.0 FORMULA_0003 0.0 255.0000 /end CHARACTERISTIC
/begin CHARACTERISTIC K_ED_FST.INC_NACH_EINTRAG "Filtererhoehung nach Fehlerspeichereintrag | EN: Fault code FST - debounce filter increment after fault-memory entry" VALUE 0x718EE TKW_VV_VV_UB 100.0 FORMULA_0003 0.0 255.0000 /end CHARACTERISTIC
/begin CHARACTERISTIC K_ED_KSD1.INC_NACH_EINTRAG "Filtererhoehung nach Fehlerspeichereintrag | EN: Fault code KSD1 - debounce filter increment after fault-memory entry" VALUE 0x71A26 TKW_VV_VV_UB 100.0 FORMULA_0003 0.0 255.0000 /end CHARACTERISTIC
/begin CHARACTERISTIC K_ED_KSD2.INC_NACH_EINTRAG "Filtererhoehung nach Fehlerspeichereintrag | EN: Fault code KSD2 - debounce filter increment after fault-memory entry" VALUE 0x71A40 TKW_VV_VV_UB 100.0 FORMULA_0003 0.0 255.0000 /end CHARACTERISTIC
/begin CHARACTERISTIC K_ED_KATS_B1.INC_NACH_EINTRAG "Filtererhoehung nach Fehlerspeichereintrag | EN: Fault code KATS_B1 - debounce filter increment after fault-memory entry" VALUE 0x71A5A TKW_VV_VV_UB 100.0 FORMULA_0003 0.0 255.0000 /end CHARACTERISTIC
/begin CHARACTERISTIC K_ED_KATS_B2.INC_NACH_EINTRAG "Filtererhoehung nach Fehlerspeichereintrag | EN: Fault code KATS_B2 - debounce filter increment after fault-memory entry" VALUE 0x71A74 TKW_VV_VV_UB 100.0 FORMULA_0003 0.0 255.0000 /end CHARACTERISTIC
/begin CHARACTERISTIC K_ED_FST_GEBER.INC_NACH_EINTRAG "Filtererhoehung nach Fehlerspeichereintrag | EN: Fault code FST_GEBER - debounce filter increment after fault-memory entry" VALUE 0x71AC2 TKW_VV_VV_UB 100.0 FORMULA_0003 0.0 255.0000 /end CHARACTERISTIC
/begin CHARACTERISTIC K_ED_LA1_TRIM_AD.INC_NACH_EINTRAG "Filtererhoehung nach Fehlerspeichereintrag | EN: Fault code LA1_TRIM_AD - debounce filter increment after fault-memory entry" VALUE 0x71B5E TKW_VV_VV_UB 100.0 FORMULA_0003 0.0 255.0000 /end CHARACTERISTIC
/begin CHARACTERISTIC K_ED_LA2_TRIM_AD.INC_NACH_EINTRAG "Filtererhoehung nach Fehlerspeichereintrag | EN: Fault code LA2_TRIM_AD - debounce filter increment after fault-memory entry" VALUE 0x71B78 TKW_VV_VV_UB 100.0 FORMULA_0003 0.0 255.0000 /end CHARACTERISTIC
/begin CHARACTERISTIC K_ED_LANK1_OPENLOAD.INC_NACH_EINTRAG "Filtererhoehung nach Fehlerspeichereintrag | EN: Fault code LANK1_OPENLOAD - debounce filter increment after fault-memory entry" VALUE 0x71B92 TKW_VV_VV_UB 100.0 FORMULA_0003 0.0 255.0000 /end CHARACTERISTIC
/begin CHARACTERISTIC K_ED_LANK2_OPENLOAD.INC_NACH_EINTRAG "Filtererhoehung nach Fehlerspeichereintrag | EN: Fault code LANK2_OPENLOAD - debounce filter increment after fault-memory entry" VALUE 0x71BAC TKW_VV_VV_UB 100.0 FORMULA_0003 0.0 255.0000 /end CHARACTERISTIC
/begin CHARACTERISTIC K_ED_LANK1_OBD_WE.INC_NACH_EINTRAG "Filtererhoehung nach Fehlerspeichereintrag | EN: Fault code LANK1_OBD_WE - debounce filter increment after fault-memory entry" VALUE 0x71BC6 TKW_VV_VV_UB 100.0 FORMULA_0003 0.0 255.0000 /end CHARACTERISTIC
/begin CHARACTERISTIC K_ED_LANK2_OBD_WE.INC_NACH_EINTRAG "Filtererhoehung nach Fehlerspeichereintrag | EN: Fault code LANK2_OBD_WE - debounce filter increment after fault-memory entry" VALUE 0x71BE0 TKW_VV_VV_UB 100.0 FORMULA_0003 0.0 255.0000 /end CHARACTERISTIC
/begin CHARACTERISTIC K_ED_FST_GEBER_LI.INC_NACH_EINTRAG "Filtererhoehung nach Fehlerspeichereintrag" VALUE 0x71CE4 TKW_VV_VV_UB 100.0 FORMULA_0003 0.0 255.0000 /end CHARACTERISTIC
/begin CHARACTERISTIC K_ED_FST_GEBER_RE.INC_NACH_EINTRAG "Filtererhoehung nach Fehlerspeichereintrag" VALUE 0x71CFE TKW_VV_VV_UB 100.0 FORMULA_0003 0.0 255.0000 /end CHARACTERISTIC
/begin CHARACTERISTIC K_ED_LANK1_OBD_SLOPE.INC_NACH_EINTRAG "Filtererhoehung nach Fehlerspeichereintrag" VALUE 0x71D18 TKW_VV_VV_UB 100.0 FORMULA_0003 0.0 255.0000 /end CHARACTERISTIC
/begin CHARACTERISTIC K_ED_LANK2_OBD_SLOPE.INC_NACH_EINTRAG "Filtererhoehung nach Fehlerspeichereintrag" VALUE 0x71D32 TKW_VV_VV_UB 100.0 FORMULA_0003 0.0 255.0000 /end CHARACTERISTIC
/begin CHARACTERISTIC K_ED_INDEX_204_INJ.INC_NACH_EINTRAG "Filtererhoehung nach Fehlerspeichereintrag | EN: Fault code INDEX_204_INJ - debounce filter increment after fault-memory entry" VALUE 0x71D9A TKW_VV_VV_UB 100.0 FORMULA_0003 0.0 255.0000 /end CHARACTERISTIC
/begin CHARACTERISTIC K_ED_INDEX_205_INJ.INC_NACH_EINTRAG "Filtererhoehung nach Fehlerspeichereintrag | EN: Fault code INDEX_205_INJ - debounce filter increment after fault-memory entry" VALUE 0x71DB4 TKW_VV_VV_UB 100.0 FORMULA_0003 0.0 255.0000 /end CHARACTERISTIC
/begin CHARACTERISTIC K_ED_INDEX_206_INJ.INC_NACH_EINTRAG "Filtererhoehung nach Fehlerspeichereintrag | EN: Fault code INDEX_206_INJ - debounce filter increment after fault-memory entry" VALUE 0x71DCE TKW_VV_VV_UB 100.0 FORMULA_0003 0.0 255.0000 /end CHARACTERISTIC
/begin CHARACTERISTIC K_ED_INDEX_207_INJ.INC_NACH_EINTRAG "Filtererhoehung nach Fehlerspeichereintrag" VALUE 0x71DE8 TKW_VV_VV_UB 100.0 FORMULA_0003 0.0 255.0000 /end CHARACTERISTIC
/begin CHARACTERISTIC K_ED_INDEX_208_INJ.INC_NACH_EINTRAG "Filtererhoehung nach Fehlerspeichereintrag" VALUE 0x71E02 TKW_VV_VV_UB 100.0 FORMULA_0003 0.0 255.0000 /end CHARACTERISTIC
/begin CHARACTERISTIC K_ED_INDEX_209_INJ.INC_NACH_EINTRAG "Filtererhoehung nach Fehlerspeichereintrag" VALUE 0x71E1C TKW_VV_VV_UB 100.0 FORMULA_0003 0.0 255.0000 /end CHARACTERISTIC
/begin CHARACTERISTIC K_ED_INDEX_210_INJ.INC_NACH_EINTRAG "Filtererhoehung nach Fehlerspeichereintrag" VALUE 0x71E36 TKW_VV_VV_UB 100.0 FORMULA_0003 0.0 255.0000 /end CHARACTERISTIC
/begin CHARACTERISTIC K_ED_INDEX_211_INJ.INC_NACH_EINTRAG "Filtererhoehung nach Fehlerspeichereintrag | EN: Filtererhoehung nach Fehlerspeichereintrag" VALUE 0x71E50 TKW_VV_VV_UB 100.0 FORMULA_0003 0.0 255.0000 /end CHARACTERISTIC
/begin CHARACTERISTIC K_ED_INDEX_212_INJ.INC_NACH_EINTRAG "Filtererhoehung nach Fehlerspeichereintrag" VALUE 0x71E6A TKW_VV_VV_UB 100.0 FORMULA_0003 0.0 255.0000 /end CHARACTERISTIC
/begin CHARACTERISTIC K_ED_INDEX_213_INJ.INC_NACH_EINTRAG "Filtererhoehung nach Fehlerspeichereintrag" VALUE 0x71E84 TKW_VV_VV_UB 100.0 FORMULA_0003 0.0 255.0000 /end CHARACTERISTIC
/begin CHARACTERISTIC K_ED_INDEX_214_INJ.INC_NACH_EINTRAG "Filtererhoehung nach Fehlerspeichereintrag" VALUE 0x71E9E TKW_VV_VV_UB 100.0 FORMULA_0003 0.0 255.0000 /end CHARACTERISTIC
/begin CHARACTERISTIC K_ED_INDEX_215_INJ.INC_NACH_EINTRAG "Filtererhoehung nach Fehlerspeichereintrag" VALUE 0x71EB8 TKW_VV_VV_UB 100.0 FORMULA_0003 0.0 255.0000 /end CHARACTERISTIC
/begin CHARACTERISTIC K_ED_INDEX_216_INJ.INC_NACH_EINTRAG "Filtererhoehung nach Fehlerspeichereintrag" VALUE 0x71ED2 TKW_VV_VV_UB 100.0 FORMULA_0003 0.0 255.0000 /end CHARACTERISTIC
/begin CHARACTERISTIC K_ED_INDEX_217_INJ.INC_NACH_EINTRAG "Filtererhoehung nach Fehlerspeichereintrag" VALUE 0x71EEC TKW_VV_VV_UB 100.0 FORMULA_0003 0.0 255.0000 /end CHARACTERISTIC
/begin CHARACTERISTIC K_ED_INDEX_218_INJ.INC_NACH_EINTRAG "Filtererhoehung nach Fehlerspeichereintrag" VALUE 0x71F06 TKW_VV_VV_UB 100.0 FORMULA_0003 0.0 255.0000 /end CHARACTERISTIC
/begin CHARACTERISTIC K_ED_INDEX_219_INJ.INC_NACH_EINTRAG "Filtererhoehung nach Fehlerspeichereintrag" VALUE 0x71F20 TKW_VV_VV_UB 100.0 FORMULA_0003 0.0 255.0000 /end CHARACTERISTIC
/begin CHARACTERISTIC K_ED_INDEX_220_INJ.INC_NACH_EINTRAG "Filtererhoehung nach Fehlerspeichereintrag" VALUE 0x71F3A TKW_VV_VV_UB 100.0 FORMULA_0003 0.0 255.0000 /end CHARACTERISTIC
/begin CHARACTERISTIC K_ED_INDEX_221_INJ.INC_NACH_EINTRAG "Filtererhoehung nach Fehlerspeichereintrag" VALUE 0x71F54 TKW_VV_VV_UB 100.0 FORMULA_0003 0.0 255.0000 /end CHARACTERISTIC
/begin CHARACTERISTIC K_ED_INDEX_222_INJ.INC_NACH_EINTRAG "Filtererhoehung nach Fehlerspeichereintrag" VALUE 0x71F6E TKW_VV_VV_UB 100.0 FORMULA_0003 0.0 255.0000 /end CHARACTERISTIC
/begin CHARACTERISTIC K_ED_INDEX_223_INJ.INC_NACH_EINTRAG "Filtererhoehung nach Fehlerspeichereintrag" VALUE 0x71F88 TKW_VV_VV_UB 100.0 FORMULA_0003 0.0 255.0000 /end CHARACTERISTIC
/begin CHARACTERISTIC K_ED_HFM1.DEC_NACH_EINTRAG "Filterverringerung nach Fehlerspeichereintrag | EN: Fault code HFM1 - debounce filter decrement after fault-memory entry" VALUE 0x70917 TKW_VV_VV_UB 100.0 FORMULA_0003 0.0 255.0000 /end CHARACTERISTIC
/begin CHARACTERISTIC K_ED_HFM2.DEC_NACH_EINTRAG "Filterverringerung nach Fehlerspeichereintrag | EN: Fault code HFM2 - debounce filter decrement after fault-memory entry" VALUE 0x70931 TKW_VV_VV_UB 100.0 FORMULA_0003 0.0 255.0000 /end CHARACTERISTIC
/begin CHARACTERISTIC K_ED_LAVK1.DEC_NACH_EINTRAG "Filterverringerung nach Fehlerspeichereintrag | EN: Fault code LAVK1 - debounce filter decrement after fault-memory entry" VALUE 0x70AEB TKW_VV_VV_UB 100.0 FORMULA_0003 0.0 255.0000 /end CHARACTERISTIC
/begin CHARACTERISTIC K_ED_LAVK1_OBD_PLAU.DEC_NACH_EINTRAG "Filterverringerung nach Fehlerspeichereintrag | EN: Fault code LAVK1_OBD_PLAU - debounce filter decrement after fault-memory entry" VALUE 0x70B1F TKW_VV_VV_UB 100.0 FORMULA_0003 0.0 255.0000 /end CHARACTERISTIC
/begin CHARACTERISTIC K_ED_LAVK1_OBD_SA.DEC_NACH_EINTRAG "Filterverringerung nach Fehlerspeichereintrag | EN: Fault code LAVK1_OBD_SA - debounce filter decrement after fault-memory entry" VALUE 0x70B53 TKW_VV_VV_UB 100.0 FORMULA_0003 0.0 255.0000 /end CHARACTERISTIC
/begin CHARACTERISTIC K_ED_LANK1.DEC_NACH_EINTRAG "Filterverringerung nach Fehlerspeichereintrag | EN: Fault code LANK1 - debounce filter decrement after fault-memory entry" VALUE 0x70B87 TKW_VV_VV_UB 100.0 FORMULA_0003 0.0 255.0000 /end CHARACTERISTIC
/begin CHARACTERISTIC K_ED_LANK2.DEC_NACH_EINTRAG "Filterverringerung nach Fehlerspeichereintrag | EN: Fault code LANK2 - debounce filter decrement after fault-memory entry" VALUE 0x70BA1 TKW_VV_VV_UB 100.0 FORMULA_0003 0.0 255.0000 /end CHARACTERISTIC
/begin CHARACTERISTIC K_ED_FPLAU1.DEC_NACH_EINTRAG "Filterverringerung nach Fehlerspeichereintrag | EN: Fault code FPLAU1 - debounce filter decrement after fault-memory entry" VALUE 0x70CD9 TKW_VV_VV_UB 100.0 FORMULA_0003 0.0 255.0000 /end CHARACTERISTIC
/begin CHARACTERISTIC K_ED_FPLAU2.DEC_NACH_EINTRAG "Filterverringerung nach Fehlerspeichereintrag | EN: Fault code FPLAU2 - debounce filter decrement after fault-memory entry" VALUE 0x70CF3 TKW_VV_VV_UB 100.0 FORMULA_0003 0.0 255.0000 /end CHARACTERISTIC
/begin CHARACTERISTIC K_ED_LANK1_OBD_S.DEC_NACH_EINTRAG "Filterverringerung nach Fehlerspeichereintrag | EN: Fault code LANK1_OBD_S - debounce filter decrement after fault-memory entry" VALUE 0x70D27 TKW_VV_VV_UB 100.0 FORMULA_0003 0.0 255.0000 /end CHARACTERISTIC
/begin CHARACTERISTIC K_ED_LANK2_OBD_S.DEC_NACH_EINTRAG "Filterverringerung nach Fehlerspeichereintrag | EN: Fault code LANK2_OBD_S - debounce filter decrement after fault-memory entry" VALUE 0x70D41 TKW_VV_VV_UB 100.0 FORMULA_0003 0.0 255.0000 /end CHARACTERISTIC
/begin CHARACTERISTIC K_ED_LAVK1_OBD_TL.DEC_NACH_EINTRAG "Filterverringerung nach Fehlerspeichereintrag | EN: Fault code LAVK1_OBD_TL - debounce filter decrement after fault-memory entry" VALUE 0x70D5B TKW_VV_VV_UB 100.0 FORMULA_0003 0.0 255.0000 /end CHARACTERISTIC
/begin CHARACTERISTIC K_ED_LAVK1_DIAG.DEC_NACH_EINTRAG "Filterverringerung nach Fehlerspeichereintrag | EN: Fault code LAVK1_DIAG - debounce filter decrement after fault-memory entry" VALUE 0x70E93 TKW_VV_VV_UB 100.0 FORMULA_0003 0.0 255.0000 /end CHARACTERISTIC
/begin CHARACTERISTIC K_ED_LAVK1_IA_OPENLOAD.DEC_NACH_EINTRAG "Filterverringerung nach Fehlerspeichereintrag | EN: Fault code LAVK1_IA_OPENLOAD - debounce filter decrement after fault-memory entry" VALUE 0x70EC7 TKW_VV_VV_UB 100.0 FORMULA_0003 0.0 255.0000 /end CHARACTERISTIC
/begin CHARACTERISTIC K_ED_LAVK1_UN_OPENLOAD.DEC_NACH_EINTRAG "Filterverringerung nach Fehlerspeichereintrag | EN: Fault code LAVK1_UN_OPENLOAD - debounce filter decrement after fault-memory entry" VALUE 0x70F2F TKW_VV_VV_UB 100.0 FORMULA_0003 0.0 255.0000 /end CHARACTERISTIC
/begin CHARACTERISTIC K_ED_LAVK1_IP_OPENLOAD.DEC_NACH_EINTRAG "Filterverringerung nach Fehlerspeichereintrag | EN: Fault code LAVK1_IP_OPENLOAD - debounce filter decrement after fault-memory entry" VALUE 0x70F63 TKW_VV_VV_UB 100.0 FORMULA_0003 0.0 255.0000 /end CHARACTERISTIC
/begin CHARACTERISTIC K_ED_LAM1_REG.DEC_NACH_EINTRAG "Filterverringerung nach Fehlerspeichereintrag | EN: Fault code LAM1_REG - debounce filter decrement after fault-memory entry" VALUE 0x710B5 TKW_VV_VV_UB 100.0 FORMULA_0003 0.0 255.0000 /end CHARACTERISTIC
/begin CHARACTERISTIC K_ED_LAM2_REG.DEC_NACH_EINTRAG "Filterverringerung nach Fehlerspeichereintrag | EN: Fault code LAM2_REG - debounce filter decrement after fault-memory entry" VALUE 0x710CF TKW_VV_VV_UB 100.0 FORMULA_0003 0.0 255.0000 /end CHARACTERISTIC
/begin CHARACTERISTIC K_ED_LAVK1_OBD_DYN.DEC_NACH_EINTRAG "Filterverringerung nach Fehlerspeichereintrag | EN: Fault code LAVK1_OBD_DYN - debounce filter decrement after fault-memory entry" VALUE 0x712BD TKW_VV_VV_UB 100.0 FORMULA_0003 0.0 255.0000 /end CHARACTERISTIC
/begin CHARACTERISTIC K_ED_LAVK1_TRIM.DEC_NACH_EINTRAG "Filterverringerung nach Fehlerspeichereintrag | EN: Fault code LAVK1_TRIM - debounce filter decrement after fault-memory entry" VALUE 0x713DB TKW_VV_VV_UB 100.0 FORMULA_0003 0.0 255.0000 /end CHARACTERISTIC
/begin CHARACTERISTIC K_ED_KAT_OBD1.DEC_NACH_EINTRAG "Filterverringerung nach Fehlerspeichereintrag | EN: Fault code KAT_OBD1 - debounce filter decrement after fault-memory entry" VALUE 0x7152D TKW_VV_VV_UB 100.0 FORMULA_0003 0.0 255.0000 /end CHARACTERISTIC
/begin CHARACTERISTIC K_ED_KAT_OBD2.DEC_NACH_EINTRAG "Filterverringerung nach Fehlerspeichereintrag | EN: Fault code KAT_OBD2 - debounce filter decrement after fault-memory entry" VALUE 0x71547 TKW_VV_VV_UB 100.0 FORMULA_0003 0.0 255.0000 /end CHARACTERISTIC
/begin CHARACTERISTIC K_ED_FI_QLT.DEC_NACH_EINTRAG "Filterverringerung nach Fehlerspeichereintrag | EN: Fault code FI_QLT - debounce filter decrement after fault-memory entry" VALUE 0x715AF TKW_VV_VV_UB 100.0 FORMULA_0003 0.0 255.0000 /end CHARACTERISTIC
/begin CHARACTERISTIC K_ED_FI_PMBN.DEC_NACH_EINTRAG "Filterverringerung nach Fehlerspeichereintrag | EN: Fault code FI_PMBN - debounce filter decrement after fault-memory entry" VALUE 0x71617 TKW_VV_VV_UB 100.0 FORMULA_0003 0.0 255.0000 /end CHARACTERISTIC
/begin CHARACTERISTIC K_ED_FI_PMRUHVERL.DEC_NACH_EINTRAG "Filterverringerung nach Fehlerspeichereintrag | EN: Fault code FI_PMRUHVERL - debounce filter decrement after fault-memory entry" VALUE 0x71735 TKW_VV_VV_UB 100.0 FORMULA_0003 0.0 255.0000 /end CHARACTERISTIC
/begin CHARACTERISTIC K_ED_FI_TOENS.DEC_NACH_EINTRAG "Filterverringerung nach Fehlerspeichereintrag | EN: Fault code FI_TOENS - debounce filter decrement after fault-memory entry" VALUE 0x7174F TKW_VV_VV_UB 100.0 FORMULA_0003 0.0 255.0000 /end CHARACTERISTIC
/begin CHARACTERISTIC K_ED_KW.DEC_NACH_EINTRAG "Filterverringerung nach Fehlerspeichereintrag | EN: Fault code KW - debounce filter decrement after fault-memory entry" VALUE 0x7186D TKW_VV_VV_UB 100.0 FORMULA_0003 0.0 255.0000 /end CHARACTERISTIC
/begin CHARACTERISTIC K_ED_LA1_ADAPT.DEC_NACH_EINTRAG "Filterverringerung nach Fehlerspeichereintrag | EN: Fault code LA1_ADAPT - debounce filter decrement after fault-memory entry" VALUE 0x71887 TKW_VV_VV_UB 100.0 FORMULA_0003 0.0 255.0000 /end CHARACTERISTIC
/begin CHARACTERISTIC K_ED_LA2_ADAPT.DEC_NACH_EINTRAG "Filterverringerung nach Fehlerspeichereintrag | EN: Fault code LA2_ADAPT - debounce filter decrement after fault-memory entry" VALUE 0x718A1 TKW_VV_VV_UB 100.0 FORMULA_0003 0.0 255.0000 /end CHARACTERISTIC
/begin CHARACTERISTIC K_ED_KGE1.DEC_NACH_EINTRAG "Filterverringerung nach Fehlerspeichereintrag | EN: Fault code KGE1 - debounce filter decrement after fault-memory entry" VALUE 0x718BB TKW_VV_VV_UB 100.0 FORMULA_0003 0.0 255.0000 /end CHARACTERISTIC
/begin CHARACTERISTIC K_ED_KGE2.DEC_NACH_EINTRAG "Filterverringerung nach Fehlerspeichereintrag | EN: Fault code KGE2 - debounce filter decrement after fault-memory entry" VALUE 0x718D5 TKW_VV_VV_UB 100.0 FORMULA_0003 0.0 255.0000 /end CHARACTERISTIC
/begin CHARACTERISTIC K_ED_FST.DEC_NACH_EINTRAG "Filterverringerung nach Fehlerspeichereintrag | EN: Fault code FST - debounce filter decrement after fault-memory entry" VALUE 0x718EF TKW_VV_VV_UB 100.0 FORMULA_0003 0.0 255.0000 /end CHARACTERISTIC
/begin CHARACTERISTIC K_ED_KSD1.DEC_NACH_EINTRAG "Filterverringerung nach Fehlerspeichereintrag | EN: Fault code KSD1 - debounce filter decrement after fault-memory entry" VALUE 0x71A27 TKW_VV_VV_UB 100.0 FORMULA_0003 0.0 255.0000 /end CHARACTERISTIC
/begin CHARACTERISTIC K_ED_KSD2.DEC_NACH_EINTRAG "Filterverringerung nach Fehlerspeichereintrag | EN: Fault code KSD2 - debounce filter decrement after fault-memory entry" VALUE 0x71A41 TKW_VV_VV_UB 100.0 FORMULA_0003 0.0 255.0000 /end CHARACTERISTIC
/begin CHARACTERISTIC K_ED_KATS_B1.DEC_NACH_EINTRAG "Filterverringerung nach Fehlerspeichereintrag | EN: Fault code KATS_B1 - debounce filter decrement after fault-memory entry" VALUE 0x71A5B TKW_VV_VV_UB 100.0 FORMULA_0003 0.0 255.0000 /end CHARACTERISTIC
/begin CHARACTERISTIC K_ED_KATS_B2.DEC_NACH_EINTRAG "Filterverringerung nach Fehlerspeichereintrag | EN: Fault code KATS_B2 - debounce filter decrement after fault-memory entry" VALUE 0x71A75 TKW_VV_VV_UB 100.0 FORMULA_0003 0.0 255.0000 /end CHARACTERISTIC
/begin CHARACTERISTIC K_ED_FST_GEBER.DEC_NACH_EINTRAG "Filterverringerung nach Fehlerspeichereintrag | EN: Fault code FST_GEBER - debounce filter decrement after fault-memory entry" VALUE 0x71AC3 TKW_VV_VV_UB 100.0 FORMULA_0003 0.0 255.0000 /end CHARACTERISTIC
/begin CHARACTERISTIC K_ED_LA1_TRIM_AD.DEC_NACH_EINTRAG "Filterverringerung nach Fehlerspeichereintrag | EN: Fault code LA1_TRIM_AD - debounce filter decrement after fault-memory entry" VALUE 0x71B5F TKW_VV_VV_UB 100.0 FORMULA_0003 0.0 255.0000 /end CHARACTERISTIC
/begin CHARACTERISTIC K_ED_LA2_TRIM_AD.DEC_NACH_EINTRAG "Filterverringerung nach Fehlerspeichereintrag | EN: Fault code LA2_TRIM_AD - debounce filter decrement after fault-memory entry" VALUE 0x71B79 TKW_VV_VV_UB 100.0 FORMULA_0003 0.0 255.0000 /end CHARACTERISTIC
/begin CHARACTERISTIC K_ED_LANK1_OPENLOAD.DEC_NACH_EINTRAG "Filterverringerung nach Fehlerspeichereintrag | EN: Fault code LANK1_OPENLOAD - debounce filter decrement after fault-memory entry" VALUE 0x71B93 TKW_VV_VV_UB 100.0 FORMULA_0003 0.0 255.0000 /end CHARACTERISTIC
/begin CHARACTERISTIC K_ED_LANK2_OPENLOAD.DEC_NACH_EINTRAG "Filterverringerung nach Fehlerspeichereintrag | EN: Fault code LANK2_OPENLOAD - debounce filter decrement after fault-memory entry" VALUE 0x71BAD TKW_VV_VV_UB 100.0 FORMULA_0003 0.0 255.0000 /end CHARACTERISTIC
/begin CHARACTERISTIC K_ED_LANK1_OBD_WE.DEC_NACH_EINTRAG "Filterverringerung nach Fehlerspeichereintrag | EN: Fault code LANK1_OBD_WE - debounce filter decrement after fault-memory entry" VALUE 0x71BC7 TKW_VV_VV_UB 100.0 FORMULA_0003 0.0 255.0000 /end CHARACTERISTIC
/begin CHARACTERISTIC K_ED_LANK2_OBD_WE.DEC_NACH_EINTRAG "Filterverringerung nach Fehlerspeichereintrag | EN: Fault code LANK2_OBD_WE - debounce filter decrement after fault-memory entry" VALUE 0x71BE1 TKW_VV_VV_UB 100.0 FORMULA_0003 0.0 255.0000 /end CHARACTERISTIC
/begin CHARACTERISTIC K_ED_FST_GEBER_LI.DEC_NACH_EINTRAG "Filterverringerung nach Fehlerspeichereintrag" VALUE 0x71CE5 TKW_VV_VV_UB 100.0 FORMULA_0003 0.0 255.0000 /end CHARACTERISTIC
/begin CHARACTERISTIC K_ED_FST_GEBER_RE.DEC_NACH_EINTRAG "Filterverringerung nach Fehlerspeichereintrag" VALUE 0x71CFF TKW_VV_VV_UB 100.0 FORMULA_0003 0.0 255.0000 /end CHARACTERISTIC
/begin CHARACTERISTIC K_ED_LANK1_OBD_SLOPE.DEC_NACH_EINTRAG "Filterverringerung nach Fehlerspeichereintrag" VALUE 0x71D19 TKW_VV_VV_UB 100.0 FORMULA_0003 0.0 255.0000 /end CHARACTERISTIC
/begin CHARACTERISTIC K_ED_LANK2_OBD_SLOPE.DEC_NACH_EINTRAG "Filterverringerung nach Fehlerspeichereintrag" VALUE 0x71D33 TKW_VV_VV_UB 100.0 FORMULA_0003 0.0 255.0000 /end CHARACTERISTIC
/begin CHARACTERISTIC K_ED_INDEX_204_INJ.DEC_NACH_EINTRAG "Filterverringerung nach Fehlerspeichereintrag | EN: Fault code INDEX_204_INJ - debounce filter decrement after fault-memory entry" VALUE 0x71D9B TKW_VV_VV_UB 100.0 FORMULA_0003 0.0 255.0000 /end CHARACTERISTIC
/begin CHARACTERISTIC K_ED_INDEX_205_INJ.DEC_NACH_EINTRAG "Filterverringerung nach Fehlerspeichereintrag | EN: Fault code INDEX_205_INJ - debounce filter decrement after fault-memory entry" VALUE 0x71DB5 TKW_VV_VV_UB 100.0 FORMULA_0003 0.0 255.0000 /end CHARACTERISTIC
/begin CHARACTERISTIC K_ED_INDEX_206_INJ.DEC_NACH_EINTRAG "Filterverringerung nach Fehlerspeichereintrag | EN: Fault code INDEX_206_INJ - debounce filter decrement after fault-memory entry" VALUE 0x71DCF TKW_VV_VV_UB 100.0 FORMULA_0003 0.0 255.0000 /end CHARACTERISTIC
/begin CHARACTERISTIC K_ED_INDEX_207_INJ.DEC_NACH_EINTRAG "Filterverringerung nach Fehlerspeichereintrag" VALUE 0x71DE9 TKW_VV_VV_UB 100.0 FORMULA_0003 0.0 255.0000 /end CHARACTERISTIC
/begin CHARACTERISTIC K_ED_INDEX_208_INJ.DEC_NACH_EINTRAG "Filterverringerung nach Fehlerspeichereintrag" VALUE 0x71E03 TKW_VV_VV_UB 100.0 FORMULA_0003 0.0 255.0000 /end CHARACTERISTIC
/begin CHARACTERISTIC K_ED_INDEX_209_INJ.DEC_NACH_EINTRAG "Filterverringerung nach Fehlerspeichereintrag" VALUE 0x71E1D TKW_VV_VV_UB 100.0 FORMULA_0003 0.0 255.0000 /end CHARACTERISTIC
/begin CHARACTERISTIC K_ED_INDEX_210_INJ.DEC_NACH_EINTRAG "Filterverringerung nach Fehlerspeichereintrag" VALUE 0x71E37 TKW_VV_VV_UB 100.0 FORMULA_0003 0.0 255.0000 /end CHARACTERISTIC
/begin CHARACTERISTIC K_ED_INDEX_211_INJ.DEC_NACH_EINTRAG "Filterverringerung nach Fehlerspeichereintrag | EN: Filterverringerung nach Fehlerspeichereintrag" VALUE 0x71E51 TKW_VV_VV_UB 100.0 FORMULA_0003 0.0 255.0000 /end CHARACTERISTIC
/begin CHARACTERISTIC K_ED_INDEX_212_INJ.DEC_NACH_EINTRAG "Filterverringerung nach Fehlerspeichereintrag" VALUE 0x71E6B TKW_VV_VV_UB 100.0 FORMULA_0003 0.0 255.0000 /end CHARACTERISTIC
/begin CHARACTERISTIC K_ED_INDEX_213_INJ.DEC_NACH_EINTRAG "Filterverringerung nach Fehlerspeichereintrag" VALUE 0x71E85 TKW_VV_VV_UB 100.0 FORMULA_0003 0.0 255.0000 /end CHARACTERISTIC
/begin CHARACTERISTIC K_ED_INDEX_214_INJ.DEC_NACH_EINTRAG "Filterverringerung nach Fehlerspeichereintrag" VALUE 0x71E9F TKW_VV_VV_UB 100.0 FORMULA_0003 0.0 255.0000 /end CHARACTERISTIC
/begin CHARACTERISTIC K_ED_INDEX_215_INJ.DEC_NACH_EINTRAG "Filterverringerung nach Fehlerspeichereintrag" VALUE 0x71EB9 TKW_VV_VV_UB 100.0 FORMULA_0003 0.0 255.0000 /end CHARACTERISTIC
/begin CHARACTERISTIC K_ED_INDEX_216_INJ.DEC_NACH_EINTRAG "Filterverringerung nach Fehlerspeichereintrag" VALUE 0x71ED3 TKW_VV_VV_UB 100.0 FORMULA_0003 0.0 255.0000 /end CHARACTERISTIC
/begin CHARACTERISTIC K_ED_INDEX_217_INJ.DEC_NACH_EINTRAG "Filterverringerung nach Fehlerspeichereintrag" VALUE 0x71EED TKW_VV_VV_UB 100.0 FORMULA_0003 0.0 255.0000 /end CHARACTERISTIC
/begin CHARACTERISTIC K_ED_INDEX_218_INJ.DEC_NACH_EINTRAG "Filterverringerung nach Fehlerspeichereintrag" VALUE 0x71F07 TKW_VV_VV_UB 100.0 FORMULA_0003 0.0 255.0000 /end CHARACTERISTIC
/begin CHARACTERISTIC K_ED_INDEX_219_INJ.DEC_NACH_EINTRAG "Filterverringerung nach Fehlerspeichereintrag" VALUE 0x71F21 TKW_VV_VV_UB 100.0 FORMULA_0003 0.0 255.0000 /end CHARACTERISTIC
/begin CHARACTERISTIC K_ED_INDEX_220_INJ.DEC_NACH_EINTRAG "Filterverringerung nach Fehlerspeichereintrag" VALUE 0x71F3B TKW_VV_VV_UB 100.0 FORMULA_0003 0.0 255.0000 /end CHARACTERISTIC
/begin CHARACTERISTIC K_ED_INDEX_221_INJ.DEC_NACH_EINTRAG "Filterverringerung nach Fehlerspeichereintrag" VALUE 0x71F55 TKW_VV_VV_UB 100.0 FORMULA_0003 0.0 255.0000 /end CHARACTERISTIC
/begin CHARACTERISTIC K_ED_INDEX_222_INJ.DEC_NACH_EINTRAG "Filterverringerung nach Fehlerspeichereintrag" VALUE 0x71F6F TKW_VV_VV_UB 100.0 FORMULA_0003 0.0 255.0000 /end CHARACTERISTIC
/begin CHARACTERISTIC K_ED_INDEX_223_INJ.DEC_NACH_EINTRAG "Filterverringerung nach Fehlerspeichereintrag" VALUE 0x71F89 TKW_VV_VV_UB 100.0 FORMULA_0003 0.0 255.0000 /end CHARACTERISTIC
/begin CHARACTERISTIC K_ED_HFM1.KLASSENINDEX "Auswahl der Fehlerklasse | EN: Fault code HFM1 - fault class selection (lamp / warning behaviour)" VALUE 0x70918 TKW_VV_VV_UB 100.0 FORMULA_0003 0.0 8.0000 /end CHARACTERISTIC
/begin CHARACTERISTIC K_ED_HFM2.KLASSENINDEX "Auswahl der Fehlerklasse | EN: Fault code HFM2 - fault class selection (lamp / warning behaviour)" VALUE 0x70932 TKW_VV_VV_UB 100.0 FORMULA_0003 0.0 8.0000 /end CHARACTERISTIC
/begin CHARACTERISTIC K_ED_LAVK1.KLASSENINDEX "Auswahl der Fehlerklasse | EN: Fault code LAVK1 - fault class selection (lamp / warning behaviour)" VALUE 0x70AEC TKW_VV_VV_UB 100.0 FORMULA_0003 0.0 8.0000 /end CHARACTERISTIC
/begin CHARACTERISTIC K_ED_LAVK1_OBD_PLAU.KLASSENINDEX "Auswahl der Fehlerklasse | EN: Fault code LAVK1_OBD_PLAU - fault class selection (lamp / warning behaviour)" VALUE 0x70B20 TKW_VV_VV_UB 100.0 FORMULA_0003 0.0 8.0000 /end CHARACTERISTIC
/begin CHARACTERISTIC K_ED_LAVK1_OBD_SA.KLASSENINDEX "Auswahl der Fehlerklasse | EN: Fault code LAVK1_OBD_SA - fault class selection (lamp / warning behaviour)" VALUE 0x70B54 TKW_VV_VV_UB 100.0 FORMULA_0003 0.0 8.0000 /end CHARACTERISTIC
/begin CHARACTERISTIC K_ED_LANK1.KLASSENINDEX "Auswahl der Fehlerklasse | EN: Fault code LANK1 - fault class selection (lamp / warning behaviour)" VALUE 0x70B88 TKW_VV_VV_UB 100.0 FORMULA_0003 0.0 8.0000 /end CHARACTERISTIC
/begin CHARACTERISTIC K_ED_LANK2.KLASSENINDEX "Auswahl der Fehlerklasse | EN: Fault code LANK2 - fault class selection (lamp / warning behaviour)" VALUE 0x70BA2 TKW_VV_VV_UB 100.0 FORMULA_0003 0.0 8.0000 /end CHARACTERISTIC
/begin CHARACTERISTIC K_ED_FPLAU1.KLASSENINDEX "Auswahl der Fehlerklasse | EN: Fault code FPLAU1 - fault class selection (lamp / warning behaviour)" VALUE 0x70CDA TKW_VV_VV_UB 100.0 FORMULA_0003 0.0 8.0000 /end CHARACTERISTIC
/begin CHARACTERISTIC K_ED_FPLAU2.KLASSENINDEX "Auswahl der Fehlerklasse | EN: Fault code FPLAU2 - fault class selection (lamp / warning behaviour)" VALUE 0x70CF4 TKW_VV_VV_UB 100.0 FORMULA_0003 0.0 8.0000 /end CHARACTERISTIC
/begin CHARACTERISTIC K_ED_LANK1_OBD_S.KLASSENINDEX "Auswahl der Fehlerklasse | EN: Fault code LANK1_OBD_S - fault class selection (lamp / warning behaviour)" VALUE 0x70D28 TKW_VV_VV_UB 100.0 FORMULA_0003 0.0 8.0000 /end CHARACTERISTIC
/begin CHARACTERISTIC K_ED_LANK2_OBD_S.KLASSENINDEX "Auswahl der Fehlerklasse | EN: Fault code LANK2_OBD_S - fault class selection (lamp / warning behaviour)" VALUE 0x70D42 TKW_VV_VV_UB 100.0 FORMULA_0003 0.0 8.0000 /end CHARACTERISTIC
/begin CHARACTERISTIC K_ED_LAVK1_OBD_TL.KLASSENINDEX "Auswahl der Fehlerklasse | EN: Fault code LAVK1_OBD_TL - fault class selection (lamp / warning behaviour)" VALUE 0x70D5C TKW_VV_VV_UB 100.0 FORMULA_0003 0.0 8.0000 /end CHARACTERISTIC
/begin CHARACTERISTIC K_ED_LAVK1_DIAG.KLASSENINDEX "Auswahl der Fehlerklasse | EN: Fault code LAVK1_DIAG - fault class selection (lamp / warning behaviour)" VALUE 0x70E94 TKW_VV_VV_UB 100.0 FORMULA_0003 0.0 8.0000 /end CHARACTERISTIC
/begin CHARACTERISTIC K_ED_LAVK1_IA_OPENLOAD.KLASSENINDEX "Auswahl der Fehlerklasse | EN: Fault code LAVK1_IA_OPENLOAD - fault class selection (lamp / warning behaviour)" VALUE 0x70EC8 TKW_VV_VV_UB 100.0 FORMULA_0003 0.0 8.0000 /end CHARACTERISTIC
/begin CHARACTERISTIC K_ED_LAVK1_UN_OPENLOAD.KLASSENINDEX "Auswahl der Fehlerklasse | EN: Fault code LAVK1_UN_OPENLOAD - fault class selection (lamp / warning behaviour)" VALUE 0x70F30 TKW_VV_VV_UB 100.0 FORMULA_0003 0.0 8.0000 /end CHARACTERISTIC
/begin CHARACTERISTIC K_ED_LAVK1_IP_OPENLOAD.KLASSENINDEX "Auswahl der Fehlerklasse | EN: Fault code LAVK1_IP_OPENLOAD - fault class selection (lamp / warning behaviour)" VALUE 0x70F64 TKW_VV_VV_UB 100.0 FORMULA_0003 0.0 8.0000 /end CHARACTERISTIC
/begin CHARACTERISTIC K_ED_LAM1_REG.KLASSENINDEX "Auswahl der Fehlerklasse | EN: Fault code LAM1_REG - fault class selection (lamp / warning behaviour)" VALUE 0x710B6 TKW_VV_VV_UB 100.0 FORMULA_0003 0.0 8.0000 /end CHARACTERISTIC
/begin CHARACTERISTIC K_ED_LAM2_REG.KLASSENINDEX "Auswahl der Fehlerklasse | EN: Fault code LAM2_REG - fault class selection (lamp / warning behaviour)" VALUE 0x710D0 TKW_VV_VV_UB 100.0 FORMULA_0003 0.0 8.0000 /end CHARACTERISTIC
/begin CHARACTERISTIC K_ED_LAVK1_OBD_DYN.KLASSENINDEX "Auswahl der Fehlerklasse | EN: Fault code LAVK1_OBD_DYN - fault class selection (lamp / warning behaviour)" VALUE 0x712BE TKW_VV_VV_UB 100.0 FORMULA_0003 0.0 8.0000 /end CHARACTERISTIC
/begin CHARACTERISTIC K_ED_LAVK1_TRIM.KLASSENINDEX "Auswahl der Fehlerklasse | EN: Fault code LAVK1_TRIM - fault class selection (lamp / warning behaviour)" VALUE 0x713DC TKW_VV_VV_UB 100.0 FORMULA_0003 0.0 8.0000 /end CHARACTERISTIC
/begin CHARACTERISTIC K_ED_KAT_OBD1.KLASSENINDEX "Auswahl der Fehlerklasse | EN: Fault code KAT_OBD1 - fault class selection (lamp / warning behaviour)" VALUE 0x7152E TKW_VV_VV_UB 100.0 FORMULA_0003 0.0 8.0000 /end CHARACTERISTIC
/begin CHARACTERISTIC K_ED_KAT_OBD2.KLASSENINDEX "Auswahl der Fehlerklasse | EN: Fault code KAT_OBD2 - fault class selection (lamp / warning behaviour)" VALUE 0x71548 TKW_VV_VV_UB 100.0 FORMULA_0003 0.0 8.0000 /end CHARACTERISTIC
/begin CHARACTERISTIC K_ED_FI_QLT.KLASSENINDEX "Auswahl der Fehlerklasse | EN: Fault code FI_QLT - fault class selection (lamp / warning behaviour)" VALUE 0x715B0 TKW_VV_VV_UB 100.0 FORMULA_0003 0.0 8.0000 /end CHARACTERISTIC
/begin CHARACTERISTIC K_ED_FI_PMBN.KLASSENINDEX "Auswahl der Fehlerklasse | EN: Fault code FI_PMBN - fault class selection (lamp / warning behaviour)" VALUE 0x71618 TKW_VV_VV_UB 100.0 FORMULA_0003 0.0 8.0000 /end CHARACTERISTIC
/begin CHARACTERISTIC K_ED_FI_PMRUHVERL.KLASSENINDEX "Auswahl der Fehlerklasse | EN: Fault code FI_PMRUHVERL - fault class selection (lamp / warning behaviour)" VALUE 0x71736 TKW_VV_VV_UB 100.0 FORMULA_0003 0.0 8.0000 /end CHARACTERISTIC
/begin CHARACTERISTIC K_ED_FI_TOENS.KLASSENINDEX "Auswahl der Fehlerklasse | EN: Fault code FI_TOENS - fault class selection (lamp / warning behaviour)" VALUE 0x71750 TKW_VV_VV_UB 100.0 FORMULA_0003 0.0 8.0000 /end CHARACTERISTIC
/begin CHARACTERISTIC K_ED_KW.KLASSENINDEX "Auswahl der Fehlerklasse | EN: Fault code KW - fault class selection (lamp / warning behaviour)" VALUE 0x7186E TKW_VV_VV_UB 100.0 FORMULA_0003 0.0 8.0000 /end CHARACTERISTIC
/begin CHARACTERISTIC K_ED_LA1_ADAPT.KLASSENINDEX "Auswahl der Fehlerklasse | EN: Fault code LA1_ADAPT - fault class selection (lamp / warning behaviour)" VALUE 0x71888 TKW_VV_VV_UB 100.0 FORMULA_0003 0.0 8.0000 /end CHARACTERISTIC
/begin CHARACTERISTIC K_ED_LA2_ADAPT.KLASSENINDEX "Auswahl der Fehlerklasse | EN: Fault code LA2_ADAPT - fault class selection (lamp / warning behaviour)" VALUE 0x718A2 TKW_VV_VV_UB 100.0 FORMULA_0003 0.0 8.0000 /end CHARACTERISTIC
/begin CHARACTERISTIC K_ED_KGE1.KLASSENINDEX "Auswahl der Fehlerklasse | EN: Fault code KGE1 - fault class selection (lamp / warning behaviour)" VALUE 0x718BC TKW_VV_VV_UB 100.0 FORMULA_0003 0.0 8.0000 /end CHARACTERISTIC
/begin CHARACTERISTIC K_ED_KGE2.KLASSENINDEX "Auswahl der Fehlerklasse | EN: Fault code KGE2 - fault class selection (lamp / warning behaviour)" VALUE 0x718D6 TKW_VV_VV_UB 100.0 FORMULA_0003 0.0 8.0000 /end CHARACTERISTIC
/begin CHARACTERISTIC K_ED_FST.KLASSENINDEX "Auswahl der Fehlerklasse | EN: Fault code FST - fault class selection (lamp / warning behaviour)" VALUE 0x718F0 TKW_VV_VV_UB 100.0 FORMULA_0003 0.0 8.0000 /end CHARACTERISTIC
/begin CHARACTERISTIC K_ED_KSD1.KLASSENINDEX "Auswahl der Fehlerklasse | EN: Fault code KSD1 - fault class selection (lamp / warning behaviour)" VALUE 0x71A28 TKW_VV_VV_UB 100.0 FORMULA_0003 0.0 8.0000 /end CHARACTERISTIC
/begin CHARACTERISTIC K_ED_KSD2.KLASSENINDEX "Auswahl der Fehlerklasse | EN: Fault code KSD2 - fault class selection (lamp / warning behaviour)" VALUE 0x71A42 TKW_VV_VV_UB 100.0 FORMULA_0003 0.0 8.0000 /end CHARACTERISTIC
/begin CHARACTERISTIC K_ED_KATS_B1.KLASSENINDEX "Auswahl der Fehlerklasse | EN: Fault code KATS_B1 - fault class selection (lamp / warning behaviour)" VALUE 0x71A5C TKW_VV_VV_UB 100.0 FORMULA_0003 0.0 8.0000 /end CHARACTERISTIC
/begin CHARACTERISTIC K_ED_KATS_B2.KLASSENINDEX "Auswahl der Fehlerklasse | EN: Fault code KATS_B2 - fault class selection (lamp / warning behaviour)" VALUE 0x71A76 TKW_VV_VV_UB 100.0 FORMULA_0003 0.0 8.0000 /end CHARACTERISTIC
/begin CHARACTERISTIC K_ED_FST_GEBER.KLASSENINDEX "Auswahl der Fehlerklasse | EN: Fault code FST_GEBER - fault class selection (lamp / warning behaviour)" VALUE 0x71AC4 TKW_VV_VV_UB 100.0 FORMULA_0003 0.0 8.0000 /end CHARACTERISTIC
/begin CHARACTERISTIC K_ED_LA1_TRIM_AD.KLASSENINDEX "Auswahl der Fehlerklasse | EN: Fault code LA1_TRIM_AD - fault class selection (lamp / warning behaviour)" VALUE 0x71B60 TKW_VV_VV_UB 100.0 FORMULA_0003 0.0 8.0000 /end CHARACTERISTIC
/begin CHARACTERISTIC K_ED_LA2_TRIM_AD.KLASSENINDEX "Auswahl der Fehlerklasse | EN: Fault code LA2_TRIM_AD - fault class selection (lamp / warning behaviour)" VALUE 0x71B7A TKW_VV_VV_UB 100.0 FORMULA_0003 0.0 8.0000 /end CHARACTERISTIC
/begin CHARACTERISTIC K_ED_LANK1_OPENLOAD.KLASSENINDEX "Auswahl der Fehlerklasse | EN: Fault code LANK1_OPENLOAD - fault class selection (lamp / warning behaviour)" VALUE 0x71B94 TKW_VV_VV_UB 100.0 FORMULA_0003 0.0 8.0000 /end CHARACTERISTIC
/begin CHARACTERISTIC K_ED_LANK2_OPENLOAD.KLASSENINDEX "Auswahl der Fehlerklasse | EN: Fault code LANK2_OPENLOAD - fault class selection (lamp / warning behaviour)" VALUE 0x71BAE TKW_VV_VV_UB 100.0 FORMULA_0003 0.0 8.0000 /end CHARACTERISTIC
/begin CHARACTERISTIC K_ED_LANK1_OBD_WE.KLASSENINDEX "Auswahl der Fehlerklasse | EN: Fault code LANK1_OBD_WE - fault class selection (lamp / warning behaviour)" VALUE 0x71BC8 TKW_VV_VV_UB 100.0 FORMULA_0003 0.0 8.0000 /end CHARACTERISTIC
/begin CHARACTERISTIC K_ED_LANK2_OBD_WE.KLASSENINDEX "Auswahl der Fehlerklasse | EN: Fault code LANK2_OBD_WE - fault class selection (lamp / warning behaviour)" VALUE 0x71BE2 TKW_VV_VV_UB 100.0 FORMULA_0003 0.0 8.0000 /end CHARACTERISTIC
/begin CHARACTERISTIC K_ED_FST_GEBER_LI.KLASSENINDEX "Auswahl der Fehlerklasse" VALUE 0x71CE6 TKW_VV_VV_UB 100.0 FORMULA_0003 0.0 8.0000 /end CHARACTERISTIC
/begin CHARACTERISTIC K_ED_FST_GEBER_RE.KLASSENINDEX "Auswahl der Fehlerklasse" VALUE 0x71D00 TKW_VV_VV_UB 100.0 FORMULA_0003 0.0 8.0000 /end CHARACTERISTIC
/begin CHARACTERISTIC K_ED_LANK1_OBD_SLOPE.KLASSENINDEX "Auswahl der Fehlerklasse" VALUE 0x71D1A TKW_VV_VV_UB 100.0 FORMULA_0003 0.0 8.0000 /end CHARACTERISTIC
/begin CHARACTERISTIC K_ED_LANK2_OBD_SLOPE.KLASSENINDEX "Auswahl der Fehlerklasse" VALUE 0x71D34 TKW_VV_VV_UB 100.0 FORMULA_0003 0.0 8.0000 /end CHARACTERISTIC
/begin CHARACTERISTIC K_ED_INDEX_204_INJ.KLASSENINDEX "Auswahl der Fehlerklasse | EN: Fault code INDEX_204_INJ - fault class selection (lamp / warning behaviour)" VALUE 0x71D9C TKW_VV_VV_UB 100.0 FORMULA_0003 0.0 8.0000 /end CHARACTERISTIC
/begin CHARACTERISTIC K_ED_INDEX_205_INJ.KLASSENINDEX "Auswahl der Fehlerklasse | EN: Fault code INDEX_205_INJ - fault class selection (lamp / warning behaviour)" VALUE 0x71DB6 TKW_VV_VV_UB 100.0 FORMULA_0003 0.0 8.0000 /end CHARACTERISTIC
/begin CHARACTERISTIC K_ED_INDEX_206_INJ.KLASSENINDEX "Auswahl der Fehlerklasse | EN: Fault code INDEX_206_INJ - fault class selection (lamp / warning behaviour)" VALUE 0x71DD0 TKW_VV_VV_UB 100.0 FORMULA_0003 0.0 8.0000 /end CHARACTERISTIC
/begin CHARACTERISTIC K_ED_INDEX_207_INJ.KLASSENINDEX "Auswahl der Fehlerklasse" VALUE 0x71DEA TKW_VV_VV_UB 100.0 FORMULA_0003 0.0 8.0000 /end CHARACTERISTIC
/begin CHARACTERISTIC K_ED_INDEX_208_INJ.KLASSENINDEX "Auswahl der Fehlerklasse" VALUE 0x71E04 TKW_VV_VV_UB 100.0 FORMULA_0003 0.0 8.0000 /end CHARACTERISTIC
/begin CHARACTERISTIC K_ED_INDEX_209_INJ.KLASSENINDEX "Auswahl der Fehlerklasse" VALUE 0x71E1E TKW_VV_VV_UB 100.0 FORMULA_0003 0.0 8.0000 /end CHARACTERISTIC
/begin CHARACTERISTIC K_ED_INDEX_210_INJ.KLASSENINDEX "Auswahl der Fehlerklasse" VALUE 0x71E38 TKW_VV_VV_UB 100.0 FORMULA_0003 0.0 8.0000 /end CHARACTERISTIC
/begin CHARACTERISTIC K_ED_INDEX_211_INJ.KLASSENINDEX "Auswahl der Fehlerklasse" VALUE 0x71E52 TKW_VV_VV_UB 100.0 FORMULA_0003 0.0 8.0000 /end CHARACTERISTIC
/begin CHARACTERISTIC K_ED_INDEX_212_INJ.KLASSENINDEX "Auswahl der Fehlerklasse" VALUE 0x71E6C TKW_VV_VV_UB 100.0 FORMULA_0003 0.0 8.0000 /end CHARACTERISTIC
/begin CHARACTERISTIC K_ED_INDEX_213_INJ.KLASSENINDEX "Auswahl der Fehlerklasse" VALUE 0x71E86 TKW_VV_VV_UB 100.0 FORMULA_0003 0.0 8.0000 /end CHARACTERISTIC
/begin CHARACTERISTIC K_ED_INDEX_214_INJ.KLASSENINDEX "Auswahl der Fehlerklasse" VALUE 0x71EA0 TKW_VV_VV_UB 100.0 FORMULA_0003 0.0 8.0000 /end CHARACTERISTIC
/begin CHARACTERISTIC K_ED_INDEX_215_INJ.KLASSENINDEX "Auswahl der Fehlerklasse" VALUE 0x71EBA TKW_VV_VV_UB 100.0 FORMULA_0003 0.0 8.0000 /end CHARACTERISTIC
/begin CHARACTERISTIC K_ED_INDEX_216_INJ.KLASSENINDEX "Auswahl der Fehlerklasse | EN: Auswahl der Fehlerklasse" VALUE 0x71ED4 TKW_VV_VV_UB 100.0 FORMULA_0003 0.0 8.0000 /end CHARACTERISTIC
/begin CHARACTERISTIC K_ED_INDEX_217_INJ.KLASSENINDEX "Auswahl der Fehlerklasse | EN: Auswahl der Fehlerklasse" VALUE 0x71EEE TKW_VV_VV_UB 100.0 FORMULA_0003 0.0 8.0000 /end CHARACTERISTIC
/begin CHARACTERISTIC K_ED_INDEX_218_INJ.KLASSENINDEX "Auswahl der Fehlerklasse | EN: Auswahl der Fehlerklasse" VALUE 0x71F08 TKW_VV_VV_UB 100.0 FORMULA_0003 0.0 8.0000 /end CHARACTERISTIC
/begin CHARACTERISTIC K_ED_INDEX_219_INJ.KLASSENINDEX "Auswahl der Fehlerklasse | EN: Auswahl der Fehlerklasse" VALUE 0x71F22 TKW_VV_VV_UB 100.0 FORMULA_0003 0.0 8.0000 /end CHARACTERISTIC
/begin CHARACTERISTIC K_ED_INDEX_220_INJ.KLASSENINDEX "Auswahl der Fehlerklasse | EN: Auswahl der Fehlerklasse" VALUE 0x71F3C TKW_VV_VV_UB 100.0 FORMULA_0003 0.0 8.0000 /end CHARACTERISTIC
/begin CHARACTERISTIC K_ED_INDEX_221_INJ.KLASSENINDEX "Auswahl der Fehlerklasse" VALUE 0x71F56 TKW_VV_VV_UB 100.0 FORMULA_0003 0.0 8.0000 /end CHARACTERISTIC
/begin CHARACTERISTIC K_ED_INDEX_222_INJ.KLASSENINDEX "Auswahl der Fehlerklasse" VALUE 0x71F70 TKW_VV_VV_UB 100.0 FORMULA_0003 0.0 8.0000 /end CHARACTERISTIC
/begin CHARACTERISTIC K_ED_INDEX_223_INJ.KLASSENINDEX "Auswahl der Fehlerklasse" VALUE 0x71F8A TKW_VV_VV_UB 100.0 FORMULA_0003 0.0 8.0000 /end CHARACTERISTIC
/begin FUNCTION Eigendiagnose ""
 /begin DEF_CHARACTERISTIC K_ED_FI_PMBN.DEC_NACH_EINTRAG K_ED_FI_PMBN.DEC_VOR_EINTRAG K_ED_FI_PMBN.FEHLERSCHWELLE K_ED_FI_PMBN.INC_NACH_EINTRAG K_ED_FI_PMBN.INC_VOR_EINTRAG K_ED_FI_PMBN.KLASSENINDEX K_ED_FI_PMBN.OK_SCHWELLE K_ED_FI_PMBN.P_CODE_OPENLOAD K_ED_FI_PMBN.P_CODE_SH_TO_GND K_ED_FI_PMBN.P_CODE_SH_TO_UB K_ED_FI_PMBN.P_CODE_UNPLAUSIBEL K_ED_FI_PMRUHVERL.DEC_NACH_EINTRAG K_ED_FI_PMRUHVERL.DEC_VOR_EINTRAG K_ED_FI_PMRUHVERL.FEHLERSCHWELLE K_ED_FI_PMRUHVERL.INC_NACH_EINTRAG K_ED_FI_PMRUHVERL.INC_VOR_EINTRAG K_ED_FI_PMRUHVERL.KLASSENINDEX K_ED_FI_PMRUHVERL.OK_SCHWELLE K_ED_FI_PMRUHVERL.P_CODE_OPENLOAD K_ED_FI_PMRUHVERL.P_CODE_SH_TO_GND K_ED_FI_PMRUHVERL.P_CODE_SH_TO_UB K_ED_FI_PMRUHVERL.P_CODE_UNPLAUSIBEL K_ED_FI_QLT.DEC_NACH_EINTRAG K_ED_FI_QLT.DEC_VOR_EINTRAG K_ED_FI_QLT.FEHLERSCHWELLE K_ED_FI_QLT.INC_NACH_EINTRAG K_ED_FI_QLT.INC_VOR_EINTRAG K_ED_FI_QLT.KLASSENINDEX K_ED_FI_QLT.OK_SCHWELLE K_ED_FI_QLT.P_CODE_OPENLOAD K_ED_FI_QLT.P_CODE_SH_TO_GND K_ED_FI_QLT.P_CODE_SH_TO_UB K_ED_FI_QLT.P_CODE_UNPLAUSIBEL K_ED_FI_TOENS.DEC_NACH_EINTRAG K_ED_FI_TOENS.DEC_VOR_EINTRAG K_ED_FI_TOENS.FEHLERSCHWELLE K_ED_FI_TOENS.INC_NACH_EINTRAG K_ED_FI_TOENS.INC_VOR_EINTRAG K_ED_FI_TOENS.KLASSENINDEX K_ED_FI_TOENS.OK_SCHWELLE K_ED_FI_TOENS.P_CODE_OPENLOAD K_ED_FI_TOENS.P_CODE_SH_TO_GND K_ED_FI_TOENS.P_CODE_SH_TO_UB K_ED_FI_TOENS.P_CODE_UNPLAUSIBEL K_ED_FPLAU1.DEC_NACH_EINTRAG K_ED_FPLAU1.DEC_VOR_EINTRAG K_ED_FPLAU1.FEHLERSCHWELLE K_ED_FPLAU1.INC_NACH_EINTRAG K_ED_FPLAU1.INC_VOR_EINTRAG K_ED_FPLAU1.KLASSENINDEX K_ED_FPLAU1.OK_SCHWELLE K_ED_FPLAU1.P_CODE_OPENLOAD K_ED_FPLAU1.P_CODE_SH_TO_GND K_ED_FPLAU1.P_CODE_SH_TO_UB K_ED_FPLAU1.P_CODE_UNPLAUSIBEL K_ED_FPLAU2.DEC_NACH_EINTRAG K_ED_FPLAU2.DEC_VOR_EINTRAG K_ED_FPLAU2.FEHLERSCHWELLE K_ED_FPLAU2.INC_NACH_EINTRAG K_ED_FPLAU2.INC_VOR_EINTRAG K_ED_FPLAU2.KLASSENINDEX K_ED_FPLAU2.OK_SCHWELLE K_ED_FPLAU2.P_CODE_OPENLOAD K_ED_FPLAU2.P_CODE_SH_TO_GND K_ED_FPLAU2.P_CODE_SH_TO_UB K_ED_FPLAU2.P_CODE_UNPLAUSIBEL K_ED_FST.DEC_NACH_EINTRAG K_ED_FST.DEC_VOR_EINTRAG K_ED_FST.FEHLERSCHWELLE K_ED_FST.INC_NACH_EINTRAG K_ED_FST.INC_VOR_EINTRAG K_ED_FST.KLASSENINDEX K_ED_FST.OK_SCHWELLE K_ED_FST.P_CODE_OPENLOAD K_ED_FST.P_CODE_SH_TO_GND K_ED_FST.P_CODE_SH_TO_UB K_ED_FST.P_CODE_UNPLAUSIBEL K_ED_FST_GEBER.DEC_NACH_EINTRAG K_ED_FST_GEBER.DEC_VOR_EINTRAG K_ED_FST_GEBER.FEHLERSCHWELLE K_ED_FST_GEBER.INC_NACH_EINTRAG K_ED_FST_GEBER.INC_VOR_EINTRAG K_ED_FST_GEBER.KLASSENINDEX K_ED_FST_GEBER.OK_SCHWELLE K_ED_FST_GEBER.P_CODE_OPENLOAD K_ED_FST_GEBER.P_CODE_SH_TO_GND K_ED_FST_GEBER.P_CODE_SH_TO_UB K_ED_FST_GEBER.P_CODE_UNPLAUSIBEL K_ED_FST_GEBER_LI.DEC_NACH_EINTRAG K_ED_FST_GEBER_LI.DEC_VOR_EINTRAG K_ED_FST_GEBER_LI.FEHLERSCHWELLE K_ED_FST_GEBER_LI.INC_NACH_EINTRAG K_ED_FST_GEBER_LI.INC_VOR_EINTRAG K_ED_FST_GEBER_LI.KLASSENINDEX K_ED_FST_GEBER_LI.OK_SCHWELLE K_ED_FST_GEBER_LI.P_CODE_OPENLOAD K_ED_FST_GEBER_LI.P_CODE_SH_TO_GND K_ED_FST_GEBER_LI.P_CODE_SH_TO_UB K_ED_FST_GEBER_LI.P_CODE_UNPLAUSIBEL K_ED_FST_GEBER_RE.DEC_NACH_EINTRAG K_ED_FST_GEBER_RE.DEC_VOR_EINTRAG K_ED_FST_GEBER_RE.FEHLERSCHWELLE K_ED_FST_GEBER_RE.INC_NACH_EINTRAG K_ED_FST_GEBER_RE.INC_VOR_EINTRAG K_ED_FST_GEBER_RE.KLASSENINDEX K_ED_FST_GEBER_RE.OK_SCHWELLE K_ED_FST_GEBER_RE.P_CODE_OPENLOAD K_ED_FST_GEBER_RE.P_CODE_SH_TO_GND K_ED_FST_GEBER_RE.P_CODE_SH_TO_UB K_ED_FST_GEBER_RE.P_CODE_UNPLAUSIBEL K_ED_FST_MAX K_ED_HFM1.DEC_NACH_EINTRAG K_ED_HFM1.DEC_VOR_EINTRAG K_ED_HFM1.FEHLERSCHWELLE K_ED_HFM1.INC_NACH_EINTRAG K_ED_HFM1.INC_VOR_EINTRAG K_ED_HFM1.KLASSENINDEX K_ED_HFM1.OK_SCHWELLE K_ED_HFM1.P_CODE_OPENLOAD K_ED_HFM1.P_CODE_SH_TO_GND K_ED_HFM1.P_CODE_SH_TO_UB K_ED_HFM1.P_CODE_UNPLAUSIBEL K_ED_HFM2.DEC_NACH_EINTRAG K_ED_HFM2.DEC_VOR_EINTRAG K_ED_HFM2.FEHLERSCHWELLE K_ED_HFM2.INC_NACH_EINTRAG K_ED_HFM2.INC_VOR_EINTRAG K_ED_HFM2.KLASSENINDEX K_ED_HFM2.OK_SCHWELLE K_ED_HFM2.P_CODE_OPENLOAD K_ED_HFM2.P_CODE_SH_TO_GND K_ED_HFM2.P_CODE_SH_TO_UB K_ED_HFM2.P_CODE_UNPLAUSIBEL K_ED_INDEX_204_INJ.DEC_NACH_EINTRAG K_ED_INDEX_204_INJ.DEC_VOR_EINTRAG K_ED_INDEX_204_INJ.FEHLERSCHWELLE K_ED_INDEX_204_INJ.INC_NACH_EINTRAG K_ED_INDEX_204_INJ.INC_VOR_EINTRAG K_ED_INDEX_204_INJ.KLASSENINDEX K_ED_INDEX_204_INJ.OK_SCHWELLE K_ED_INDEX_204_INJ.P_CODE_OPENLOAD K_ED_INDEX_204_INJ.P_CODE_SH_TO_GND K_ED_INDEX_204_INJ.P_CODE_SH_TO_UB K_ED_INDEX_204_INJ.P_CODE_UNPLAUSIBEL K_ED_INDEX_205_INJ.DEC_NACH_EINTRAG K_ED_INDEX_205_INJ.DEC_VOR_EINTRAG K_ED_INDEX_205_INJ.FEHLERSCHWELLE K_ED_INDEX_205_INJ.INC_NACH_EINTRAG K_ED_INDEX_205_INJ.INC_VOR_EINTRAG K_ED_INDEX_205_INJ.KLASSENINDEX K_ED_INDEX_205_INJ.OK_SCHWELLE K_ED_INDEX_205_INJ.P_CODE_OPENLOAD K_ED_INDEX_205_INJ.P_CODE_SH_TO_GND K_ED_INDEX_205_INJ.P_CODE_SH_TO_UB K_ED_INDEX_205_INJ.P_CODE_UNPLAUSIBEL K_ED_INDEX_206_INJ.DEC_NACH_EINTRAG K_ED_INDEX_206_INJ.DEC_VOR_EINTRAG K_ED_INDEX_206_INJ.FEHLERSCHWELLE K_ED_INDEX_206_INJ.INC_NACH_EINTRAG K_ED_INDEX_206_INJ.INC_VOR_EINTRAG K_ED_INDEX_206_INJ.KLASSENINDEX K_ED_INDEX_206_INJ.OK_SCHWELLE K_ED_INDEX_206_INJ.P_CODE_OPENLOAD K_ED_INDEX_206_INJ.P_CODE_SH_TO_GND K_ED_INDEX_206_INJ.P_CODE_SH_TO_UB K_ED_INDEX_206_INJ.P_CODE_UNPLAUSIBEL K_ED_INDEX_207_INJ.DEC_NACH_EINTRAG K_ED_INDEX_207_INJ.DEC_VOR_EINTRAG K_ED_INDEX_207_INJ.FEHLERSCHWELLE K_ED_INDEX_207_INJ.INC_NACH_EINTRAG K_ED_INDEX_207_INJ.INC_VOR_EINTRAG K_ED_INDEX_207_INJ.KLASSENINDEX K_ED_INDEX_207_INJ.OK_SCHWELLE K_ED_INDEX_207_INJ.P_CODE_OPENLOAD K_ED_INDEX_207_INJ.P_CODE_SH_TO_GND K_ED_INDEX_207_INJ.P_CODE_SH_TO_UB K_ED_INDEX_207_INJ.P_CODE_UNPLAUSIBEL K_ED_INDEX_208_INJ.DEC_NACH_EINTRAG K_ED_INDEX_208_INJ.DEC_VOR_EINTRAG K_ED_INDEX_208_INJ.FEHLERSCHWELLE K_ED_INDEX_208_INJ.INC_NACH_EINTRAG K_ED_INDEX_208_INJ.INC_VOR_EINTRAG K_ED_INDEX_208_INJ.KLASSENINDEX K_ED_INDEX_208_INJ.OK_SCHWELLE K_ED_INDEX_208_INJ.P_CODE_OPENLOAD K_ED_INDEX_208_INJ.P_CODE_SH_TO_GND K_ED_INDEX_208_INJ.P_CODE_SH_TO_UB K_ED_INDEX_208_INJ.P_CODE_UNPLAUSIBEL K_ED_INDEX_209_INJ.DEC_NACH_EINTRAG K_ED_INDEX_209_INJ.DEC_VOR_EINTRAG K_ED_INDEX_209_INJ.FEHLERSCHWELLE K_ED_INDEX_209_INJ.INC_NACH_EINTRAG K_ED_INDEX_209_INJ.INC_VOR_EINTRAG K_ED_INDEX_209_INJ.KLASSENINDEX K_ED_INDEX_209_INJ.OK_SCHWELLE K_ED_INDEX_209_INJ.P_CODE_OPENLOAD K_ED_INDEX_209_INJ.P_CODE_SH_TO_GND K_ED_INDEX_209_INJ.P_CODE_SH_TO_UB K_ED_INDEX_209_INJ.P_CODE_UNPLAUSIBEL K_ED_INDEX_210_INJ.DEC_NACH_EINTRAG K_ED_INDEX_210_INJ.DEC_VOR_EINTRAG K_ED_INDEX_210_INJ.FEHLERSCHWELLE K_ED_INDEX_210_INJ.INC_NACH_EINTRAG K_ED_INDEX_210_INJ.INC_VOR_EINTRAG K_ED_INDEX_210_INJ.KLASSENINDEX K_ED_INDEX_210_INJ.OK_SCHWELLE K_ED_INDEX_210_INJ.P_CODE_OPENLOAD K_ED_INDEX_210_INJ.P_CODE_SH_TO_GND K_ED_INDEX_210_INJ.P_CODE_SH_TO_UB K_ED_INDEX_210_INJ.P_CODE_UNPLAUSIBEL K_ED_INDEX_211_INJ.DEC_NACH_EINTRAG K_ED_INDEX_211_INJ.DEC_VOR_EINTRAG K_ED_INDEX_211_INJ.FEHLERSCHWELLE K_ED_INDEX_211_INJ.INC_NACH_EINTRAG K_ED_INDEX_211_INJ.INC_VOR_EINTRAG K_ED_INDEX_211_INJ.KLASSENINDEX K_ED_INDEX_211_INJ.OK_SCHWELLE K_ED_INDEX_211_INJ.P_CODE_OPENLOAD K_ED_INDEX_211_INJ.P_CODE_SH_TO_GND K_ED_INDEX_211_INJ.P_CODE_SH_TO_UB K_ED_INDEX_211_INJ.P_CODE_UNPLAUSIBEL K_ED_INDEX_212_INJ.DEC_NACH_EINTRAG K_ED_INDEX_212_INJ.DEC_VOR_EINTRAG K_ED_INDEX_212_INJ.FEHLERSCHWELLE K_ED_INDEX_212_INJ.INC_NACH_EINTRAG K_ED_INDEX_212_INJ.INC_VOR_EINTRAG K_ED_INDEX_212_INJ.KLASSENINDEX K_ED_INDEX_212_INJ.OK_SCHWELLE K_ED_INDEX_212_INJ.P_CODE_OPENLOAD K_ED_INDEX_212_INJ.P_CODE_SH_TO_GND K_ED_INDEX_212_INJ.P_CODE_SH_TO_UB K_ED_INDEX_212_INJ.P_CODE_UNPLAUSIBEL K_ED_INDEX_213_INJ.DEC_NACH_EINTRAG K_ED_INDEX_213_INJ.DEC_VOR_EINTRAG K_ED_INDEX_213_INJ.FEHLERSCHWELLE K_ED_INDEX_213_INJ.INC_NACH_EINTRAG K_ED_INDEX_213_INJ.INC_VOR_EINTRAG K_ED_INDEX_213_INJ.KLASSENINDEX K_ED_INDEX_213_INJ.OK_SCHWELLE K_ED_INDEX_213_INJ.P_CODE_OPENLOAD K_ED_INDEX_213_INJ.P_CODE_SH_TO_GND K_ED_INDEX_213_INJ.P_CODE_SH_TO_UB K_ED_INDEX_213_INJ.P_CODE_UNPLAUSIBEL K_ED_INDEX_214_INJ.DEC_NACH_EINTRAG K_ED_INDEX_214_INJ.DEC_VOR_EINTRAG K_ED_INDEX_214_INJ.FEHLERSCHWELLE K_ED_INDEX_214_INJ.INC_NACH_EINTRAG K_ED_INDEX_214_INJ.INC_VOR_EINTRAG K_ED_INDEX_214_INJ.KLASSENINDEX K_ED_INDEX_214_INJ.OK_SCHWELLE K_ED_INDEX_214_INJ.P_CODE_OPENLOAD K_ED_INDEX_214_INJ.P_CODE_SH_TO_GND K_ED_INDEX_214_INJ.P_CODE_SH_TO_UB K_ED_INDEX_214_INJ.P_CODE_UNPLAUSIBEL K_ED_INDEX_215_INJ.DEC_NACH_EINTRAG K_ED_INDEX_215_INJ.DEC_VOR_EINTRAG K_ED_INDEX_215_INJ.FEHLERSCHWELLE K_ED_INDEX_215_INJ.INC_NACH_EINTRAG K_ED_INDEX_215_INJ.INC_VOR_EINTRAG K_ED_INDEX_215_INJ.KLASSENINDEX K_ED_INDEX_215_INJ.OK_SCHWELLE K_ED_INDEX_215_INJ.P_CODE_OPENLOAD K_ED_INDEX_215_INJ.P_CODE_SH_TO_GND K_ED_INDEX_215_INJ.P_CODE_SH_TO_UB K_ED_INDEX_215_INJ.P_CODE_UNPLAUSIBEL K_ED_INDEX_216_INJ.DEC_NACH_EINTRAG K_ED_INDEX_216_INJ.DEC_VOR_EINTRAG K_ED_INDEX_216_INJ.FEHLERSCHWELLE K_ED_INDEX_216_INJ.INC_NACH_EINTRAG K_ED_INDEX_216_INJ.INC_VOR_EINTRAG K_ED_INDEX_216_INJ.KLASSENINDEX K_ED_INDEX_216_INJ.OK_SCHWELLE K_ED_INDEX_216_INJ.P_CODE_OPENLOAD K_ED_INDEX_216_INJ.P_CODE_SH_TO_GND K_ED_INDEX_216_INJ.P_CODE_SH_TO_UB K_ED_INDEX_216_INJ.P_CODE_UNPLAUSIBEL K_ED_INDEX_217_INJ.DEC_NACH_EINTRAG K_ED_INDEX_217_INJ.DEC_VOR_EINTRAG K_ED_INDEX_217_INJ.FEHLERSCHWELLE K_ED_INDEX_217_INJ.INC_NACH_EINTRAG K_ED_INDEX_217_INJ.INC_VOR_EINTRAG K_ED_INDEX_217_INJ.KLASSENINDEX K_ED_INDEX_217_INJ.OK_SCHWELLE K_ED_INDEX_217_INJ.P_CODE_OPENLOAD K_ED_INDEX_217_INJ.P_CODE_SH_TO_GND K_ED_INDEX_217_INJ.P_CODE_SH_TO_UB K_ED_INDEX_217_INJ.P_CODE_UNPLAUSIBEL K_ED_INDEX_218_INJ.DEC_NACH_EINTRAG K_ED_INDEX_218_INJ.DEC_VOR_EINTRAG K_ED_INDEX_218_INJ.FEHLERSCHWELLE K_ED_INDEX_218_INJ.INC_NACH_EINTRAG K_ED_INDEX_218_INJ.INC_VOR_EINTRAG K_ED_INDEX_218_INJ.KLASSENINDEX K_ED_INDEX_218_INJ.OK_SCHWELLE K_ED_INDEX_218_INJ.P_CODE_OPENLOAD K_ED_INDEX_218_INJ.P_CODE_SH_TO_GND K_ED_INDEX_218_INJ.P_CODE_SH_TO_UB K_ED_INDEX_218_INJ.P_CODE_UNPLAUSIBEL K_ED_INDEX_219_INJ.DEC_NACH_EINTRAG K_ED_INDEX_219_INJ.DEC_VOR_EINTRAG K_ED_INDEX_219_INJ.FEHLERSCHWELLE K_ED_INDEX_219_INJ.INC_NACH_EINTRAG K_ED_INDEX_219_INJ.INC_VOR_EINTRAG K_ED_INDEX_219_INJ.KLASSENINDEX K_ED_INDEX_219_INJ.OK_SCHWELLE K_ED_INDEX_219_INJ.P_CODE_OPENLOAD K_ED_INDEX_219_INJ.P_CODE_SH_TO_GND K_ED_INDEX_219_INJ.P_CODE_SH_TO_UB K_ED_INDEX_219_INJ.P_CODE_UNPLAUSIBEL K_ED_INDEX_220_INJ.DEC_NACH_EINTRAG K_ED_INDEX_220_INJ.DEC_VOR_EINTRAG K_ED_INDEX_220_INJ.FEHLERSCHWELLE K_ED_INDEX_220_INJ.INC_NACH_EINTRAG K_ED_INDEX_220_INJ.INC_VOR_EINTRAG K_ED_INDEX_220_INJ.KLASSENINDEX K_ED_INDEX_220_INJ.OK_SCHWELLE K_ED_INDEX_220_INJ.P_CODE_OPENLOAD K_ED_INDEX_220_INJ.P_CODE_SH_TO_GND K_ED_INDEX_220_INJ.P_CODE_SH_TO_UB K_ED_INDEX_220_INJ.P_CODE_UNPLAUSIBEL K_ED_INDEX_221_INJ.DEC_NACH_EINTRAG K_ED_INDEX_221_INJ.DEC_VOR_EINTRAG K_ED_INDEX_221_INJ.FEHLERSCHWELLE K_ED_INDEX_221_INJ.INC_NACH_EINTRAG K_ED_INDEX_221_INJ.INC_VOR_EINTRAG K_ED_INDEX_221_INJ.KLASSENINDEX K_ED_INDEX_221_INJ.OK_SCHWELLE K_ED_INDEX_221_INJ.P_CODE_OPENLOAD K_ED_INDEX_221_INJ.P_CODE_SH_TO_GND K_ED_INDEX_221_INJ.P_CODE_SH_TO_UB K_ED_INDEX_221_INJ.P_CODE_UNPLAUSIBEL K_ED_INDEX_222_INJ.DEC_NACH_EINTRAG K_ED_INDEX_222_INJ.DEC_VOR_EINTRAG K_ED_INDEX_222_INJ.FEHLERSCHWELLE K_ED_INDEX_222_INJ.INC_NACH_EINTRAG K_ED_INDEX_222_INJ.INC_VOR_EINTRAG K_ED_INDEX_222_INJ.KLASSENINDEX K_ED_INDEX_222_INJ.OK_SCHWELLE K_ED_INDEX_222_INJ.P_CODE_OPENLOAD K_ED_INDEX_222_INJ.P_CODE_SH_TO_GND K_ED_INDEX_222_INJ.P_CODE_SH_TO_UB K_ED_INDEX_222_INJ.P_CODE_UNPLAUSIBEL K_ED_INDEX_223_INJ.DEC_NACH_EINTRAG K_ED_INDEX_223_INJ.DEC_VOR_EINTRAG K_ED_INDEX_223_INJ.FEHLERSCHWELLE K_ED_INDEX_223_INJ.INC_NACH_EINTRAG K_ED_INDEX_223_INJ.INC_VOR_EINTRAG K_ED_INDEX_223_INJ.KLASSENINDEX K_ED_INDEX_223_INJ.OK_SCHWELLE K_ED_INDEX_223_INJ.P_CODE_OPENLOAD K_ED_INDEX_223_INJ.P_CODE_SH_TO_GND K_ED_INDEX_223_INJ.P_CODE_SH_TO_UB K_ED_INDEX_223_INJ.P_CODE_UNPLAUSIBEL K_ED_KATS_B1.DEC_NACH_EINTRAG K_ED_KATS_B1.DEC_VOR_EINTRAG K_ED_KATS_B1.FEHLERSCHWELLE K_ED_KATS_B1.INC_NACH_EINTRAG K_ED_KATS_B1.INC_VOR_EINTRAG K_ED_KATS_B1.KLASSENINDEX K_ED_KATS_B1.OK_SCHWELLE K_ED_KATS_B1.P_CODE_OPENLOAD K_ED_KATS_B1.P_CODE_SH_TO_GND K_ED_KATS_B1.P_CODE_SH_TO_UB K_ED_KATS_B1.P_CODE_UNPLAUSIBEL K_ED_KATS_B2.DEC_NACH_EINTRAG K_ED_KATS_B2.DEC_VOR_EINTRAG K_ED_KATS_B2.FEHLERSCHWELLE K_ED_KATS_B2.INC_NACH_EINTRAG K_ED_KATS_B2.INC_VOR_EINTRAG K_ED_KATS_B2.KLASSENINDEX K_ED_KATS_B2.OK_SCHWELLE K_ED_KATS_B2.P_CODE_OPENLOAD K_ED_KATS_B2.P_CODE_SH_TO_GND K_ED_KATS_B2.P_CODE_SH_TO_UB K_ED_KATS_B2.P_CODE_UNPLAUSIBEL K_ED_KAT_OBD1.DEC_NACH_EINTRAG K_ED_KAT_OBD1.DEC_VOR_EINTRAG K_ED_KAT_OBD1.FEHLERSCHWELLE K_ED_KAT_OBD1.INC_NACH_EINTRAG K_ED_KAT_OBD1.INC_VOR_EINTRAG K_ED_KAT_OBD1.KLASSENINDEX K_ED_KAT_OBD1.OK_SCHWELLE K_ED_KAT_OBD1.P_CODE_OPENLOAD K_ED_KAT_OBD1.P_CODE_SH_TO_GND K_ED_KAT_OBD1.P_CODE_SH_TO_UB K_ED_KAT_OBD1.P_CODE_UNPLAUSIBEL K_ED_KAT_OBD2.DEC_NACH_EINTRAG K_ED_KAT_OBD2.DEC_VOR_EINTRAG K_ED_KAT_OBD2.FEHLERSCHWELLE K_ED_KAT_OBD2.INC_NACH_EINTRAG K_ED_KAT_OBD2.INC_VOR_EINTRAG K_ED_KAT_OBD2.KLASSENINDEX K_ED_KAT_OBD2.OK_SCHWELLE K_ED_KAT_OBD2.P_CODE_OPENLOAD K_ED_KAT_OBD2.P_CODE_SH_TO_GND K_ED_KAT_OBD2.P_CODE_SH_TO_UB K_ED_KAT_OBD2.P_CODE_UNPLAUSIBEL K_ED_KGE1.DEC_NACH_EINTRAG K_ED_KGE1.DEC_VOR_EINTRAG K_ED_KGE1.FEHLERSCHWELLE K_ED_KGE1.INC_NACH_EINTRAG K_ED_KGE1.INC_VOR_EINTRAG K_ED_KGE1.KLASSENINDEX K_ED_KGE1.OK_SCHWELLE K_ED_KGE1.P_CODE_OPENLOAD K_ED_KGE1.P_CODE_SH_TO_GND K_ED_KGE1.P_CODE_SH_TO_UB K_ED_KGE1.P_CODE_UNPLAUSIBEL K_ED_KGE2.DEC_NACH_EINTRAG K_ED_KGE2.DEC_VOR_EINTRAG K_ED_KGE2.FEHLERSCHWELLE K_ED_KGE2.INC_NACH_EINTRAG K_ED_KGE2.INC_VOR_EINTRAG K_ED_KGE2.KLASSENINDEX K_ED_KGE2.OK_SCHWELLE K_ED_KGE2.P_CODE_OPENLOAD K_ED_KGE2.P_CODE_SH_TO_GND K_ED_KGE2.P_CODE_SH_TO_UB K_ED_KGE2.P_CODE_UNPLAUSIBEL K_ED_KSD1.DEC_NACH_EINTRAG K_ED_KSD1.DEC_VOR_EINTRAG K_ED_KSD1.FEHLERSCHWELLE K_ED_KSD1.INC_NACH_EINTRAG K_ED_KSD1.INC_VOR_EINTRAG K_ED_KSD1.KLASSENINDEX K_ED_KSD1.OK_SCHWELLE K_ED_KSD1.P_CODE_OPENLOAD K_ED_KSD1.P_CODE_SH_TO_GND K_ED_KSD1.P_CODE_SH_TO_UB K_ED_KSD1.P_CODE_UNPLAUSIBEL K_ED_KSD2.DEC_NACH_EINTRAG K_ED_KSD2.DEC_VOR_EINTRAG K_ED_KSD2.FEHLERSCHWELLE K_ED_KSD2.INC_NACH_EINTRAG K_ED_KSD2.INC_VOR_EINTRAG K_ED_KSD2.KLASSENINDEX K_ED_KSD2.OK_SCHWELLE K_ED_KSD2.P_CODE_OPENLOAD K_ED_KSD2.P_CODE_SH_TO_GND K_ED_KSD2.P_CODE_SH_TO_UB K_ED_KSD2.P_CODE_UNPLAUSIBEL K_ED_KW.DEC_NACH_EINTRAG K_ED_KW.DEC_VOR_EINTRAG K_ED_KW.FEHLERSCHWELLE K_ED_KW.INC_NACH_EINTRAG K_ED_KW.INC_VOR_EINTRAG K_ED_KW.KLASSENINDEX K_ED_KW.OK_SCHWELLE K_ED_KW.P_CODE_OPENLOAD K_ED_KW.P_CODE_SH_TO_GND K_ED_KW.P_CODE_SH_TO_UB K_ED_KW.P_CODE_UNPLAUSIBEL K_ED_LA1_ADAPT.DEC_NACH_EINTRAG K_ED_LA1_ADAPT.DEC_VOR_EINTRAG K_ED_LA1_ADAPT.FEHLERSCHWELLE K_ED_LA1_ADAPT.INC_NACH_EINTRAG K_ED_LA1_ADAPT.INC_VOR_EINTRAG K_ED_LA1_ADAPT.KLASSENINDEX K_ED_LA1_ADAPT.OK_SCHWELLE K_ED_LA1_ADAPT.P_CODE_OPENLOAD K_ED_LA1_ADAPT.P_CODE_SH_TO_GND K_ED_LA1_ADAPT.P_CODE_SH_TO_UB K_ED_LA1_ADAPT.P_CODE_UNPLAUSIBEL K_ED_LA1_TRIM_AD.DEC_NACH_EINTRAG K_ED_LA1_TRIM_AD.DEC_VOR_EINTRAG K_ED_LA1_TRIM_AD.FEHLERSCHWELLE K_ED_LA1_TRIM_AD.INC_NACH_EINTRAG K_ED_LA1_TRIM_AD.INC_VOR_EINTRAG K_ED_LA1_TRIM_AD.KLASSENINDEX K_ED_LA1_TRIM_AD.OK_SCHWELLE K_ED_LA1_TRIM_AD.P_CODE_OPENLOAD K_ED_LA1_TRIM_AD.P_CODE_SH_TO_GND K_ED_LA1_TRIM_AD.P_CODE_SH_TO_UB K_ED_LA1_TRIM_AD.P_CODE_UNPLAUSIBEL K_ED_LA2_ADAPT.DEC_NACH_EINTRAG K_ED_LA2_ADAPT.DEC_VOR_EINTRAG K_ED_LA2_ADAPT.FEHLERSCHWELLE K_ED_LA2_ADAPT.INC_NACH_EINTRAG K_ED_LA2_ADAPT.INC_VOR_EINTRAG K_ED_LA2_ADAPT.KLASSENINDEX K_ED_LA2_ADAPT.OK_SCHWELLE K_ED_LA2_ADAPT.P_CODE_OPENLOAD K_ED_LA2_ADAPT.P_CODE_SH_TO_GND K_ED_LA2_ADAPT.P_CODE_SH_TO_UB K_ED_LA2_ADAPT.P_CODE_UNPLAUSIBEL K_ED_LA2_TRIM_AD.DEC_NACH_EINTRAG K_ED_LA2_TRIM_AD.DEC_VOR_EINTRAG K_ED_LA2_TRIM_AD.FEHLERSCHWELLE K_ED_LA2_TRIM_AD.INC_NACH_EINTRAG K_ED_LA2_TRIM_AD.INC_VOR_EINTRAG K_ED_LA2_TRIM_AD.KLASSENINDEX K_ED_LA2_TRIM_AD.OK_SCHWELLE K_ED_LA2_TRIM_AD.P_CODE_OPENLOAD K_ED_LA2_TRIM_AD.P_CODE_SH_TO_GND K_ED_LA2_TRIM_AD.P_CODE_SH_TO_UB K_ED_LA2_TRIM_AD.P_CODE_UNPLAUSIBEL K_ED_LAM1_REG.DEC_NACH_EINTRAG K_ED_LAM1_REG.DEC_VOR_EINTRAG K_ED_LAM1_REG.FEHLERSCHWELLE K_ED_LAM1_REG.INC_NACH_EINTRAG K_ED_LAM1_REG.INC_VOR_EINTRAG K_ED_LAM1_REG.KLASSENINDEX K_ED_LAM1_REG.OK_SCHWELLE K_ED_LAM1_REG.P_CODE_OPENLOAD K_ED_LAM1_REG.P_CODE_SH_TO_GND K_ED_LAM1_REG.P_CODE_SH_TO_UB K_ED_LAM1_REG.P_CODE_UNPLAUSIBEL K_ED_LAM2_REG.DEC_NACH_EINTRAG K_ED_LAM2_REG.DEC_VOR_EINTRAG K_ED_LAM2_REG.FEHLERSCHWELLE K_ED_LAM2_REG.INC_NACH_EINTRAG K_ED_LAM2_REG.INC_VOR_EINTRAG K_ED_LAM2_REG.KLASSENINDEX K_ED_LAM2_REG.OK_SCHWELLE K_ED_LAM2_REG.P_CODE_OPENLOAD K_ED_LAM2_REG.P_CODE_SH_TO_GND K_ED_LAM2_REG.P_CODE_SH_TO_UB K_ED_LAM2_REG.P_CODE_UNPLAUSIBEL K_ED_LANK1.DEC_NACH_EINTRAG K_ED_LANK1.DEC_VOR_EINTRAG K_ED_LANK1.FEHLERSCHWELLE K_ED_LANK1.INC_NACH_EINTRAG K_ED_LANK1.INC_VOR_EINTRAG K_ED_LANK1.KLASSENINDEX K_ED_LANK1.OK_SCHWELLE K_ED_LANK1.P_CODE_OPENLOAD K_ED_LANK1.P_CODE_SH_TO_GND K_ED_LANK1.P_CODE_SH_TO_UB K_ED_LANK1.P_CODE_UNPLAUSIBEL K_ED_LANK1_OBD_S.DEC_NACH_EINTRAG K_ED_LANK1_OBD_S.DEC_VOR_EINTRAG K_ED_LANK1_OBD_S.FEHLERSCHWELLE K_ED_LANK1_OBD_S.INC_NACH_EINTRAG K_ED_LANK1_OBD_S.INC_VOR_EINTRAG K_ED_LANK1_OBD_S.KLASSENINDEX K_ED_LANK1_OBD_S.OK_SCHWELLE K_ED_LANK1_OBD_S.P_CODE_OPENLOAD K_ED_LANK1_OBD_S.P_CODE_SH_TO_GND K_ED_LANK1_OBD_S.P_CODE_SH_TO_UB K_ED_LANK1_OBD_S.P_CODE_UNPLAUSIBEL K_ED_LANK1_OBD_SLOPE.DEC_NACH_EINTRAG K_ED_LANK1_OBD_SLOPE.DEC_VOR_EINTRAG K_ED_LANK1_OBD_SLOPE.FEHLERSCHWELLE K_ED_LANK1_OBD_SLOPE.INC_NACH_EINTRAG K_ED_LANK1_OBD_SLOPE.INC_VOR_EINTRAG K_ED_LANK1_OBD_SLOPE.KLASSENINDEX K_ED_LANK1_OBD_SLOPE.OK_SCHWELLE K_ED_LANK1_OBD_SLOPE.P_CODE_OPENLOAD K_ED_LANK1_OBD_SLOPE.P_CODE_SH_TO_GND K_ED_LANK1_OBD_SLOPE.P_CODE_SH_TO_UB K_ED_LANK1_OBD_SLOPE.P_CODE_UNPLAUSIBEL K_ED_LANK1_OBD_WE.DEC_NACH_EINTRAG K_ED_LANK1_OBD_WE.DEC_VOR_EINTRAG K_ED_LANK1_OBD_WE.FEHLERSCHWELLE K_ED_LANK1_OBD_WE.INC_NACH_EINTRAG K_ED_LANK1_OBD_WE.INC_VOR_EINTRAG K_ED_LANK1_OBD_WE.KLASSENINDEX K_ED_LANK1_OBD_WE.OK_SCHWELLE K_ED_LANK1_OBD_WE.P_CODE_OPENLOAD K_ED_LANK1_OBD_WE.P_CODE_SH_TO_GND K_ED_LANK1_OBD_WE.P_CODE_SH_TO_UB K_ED_LANK1_OBD_WE.P_CODE_UNPLAUSIBEL K_ED_LANK1_OPENLOAD.DEC_NACH_EINTRAG K_ED_LANK1_OPENLOAD.DEC_VOR_EINTRAG K_ED_LANK1_OPENLOAD.FEHLERSCHWELLE K_ED_LANK1_OPENLOAD.INC_NACH_EINTRAG K_ED_LANK1_OPENLOAD.INC_VOR_EINTRAG K_ED_LANK1_OPENLOAD.KLASSENINDEX K_ED_LANK1_OPENLOAD.OK_SCHWELLE K_ED_LANK1_OPENLOAD.P_CODE_OPENLOAD K_ED_LANK1_OPENLOAD.P_CODE_SH_TO_GND K_ED_LANK1_OPENLOAD.P_CODE_SH_TO_UB K_ED_LANK1_OPENLOAD.P_CODE_UNPLAUSIBEL K_ED_LANK2.DEC_NACH_EINTRAG K_ED_LANK2.DEC_VOR_EINTRAG K_ED_LANK2.FEHLERSCHWELLE K_ED_LANK2.INC_NACH_EINTRAG K_ED_LANK2.INC_VOR_EINTRAG K_ED_LANK2.KLASSENINDEX K_ED_LANK2.OK_SCHWELLE K_ED_LANK2.P_CODE_OPENLOAD K_ED_LANK2.P_CODE_SH_TO_GND K_ED_LANK2.P_CODE_SH_TO_UB K_ED_LANK2.P_CODE_UNPLAUSIBEL K_ED_LANK2_OBD_S.DEC_NACH_EINTRAG K_ED_LANK2_OBD_S.DEC_VOR_EINTRAG K_ED_LANK2_OBD_S.FEHLERSCHWELLE K_ED_LANK2_OBD_S.INC_NACH_EINTRAG K_ED_LANK2_OBD_S.INC_VOR_EINTRAG K_ED_LANK2_OBD_S.KLASSENINDEX K_ED_LANK2_OBD_S.OK_SCHWELLE K_ED_LANK2_OBD_S.P_CODE_OPENLOAD K_ED_LANK2_OBD_S.P_CODE_SH_TO_GND K_ED_LANK2_OBD_S.P_CODE_SH_TO_UB K_ED_LANK2_OBD_S.P_CODE_UNPLAUSIBEL K_ED_LANK2_OBD_SLOPE.DEC_NACH_EINTRAG K_ED_LANK2_OBD_SLOPE.DEC_VOR_EINTRAG K_ED_LANK2_OBD_SLOPE.FEHLERSCHWELLE K_ED_LANK2_OBD_SLOPE.INC_NACH_EINTRAG K_ED_LANK2_OBD_SLOPE.INC_VOR_EINTRAG K_ED_LANK2_OBD_SLOPE.KLASSENINDEX K_ED_LANK2_OBD_SLOPE.OK_SCHWELLE K_ED_LANK2_OBD_SLOPE.P_CODE_OPENLOAD K_ED_LANK2_OBD_SLOPE.P_CODE_SH_TO_GND K_ED_LANK2_OBD_SLOPE.P_CODE_SH_TO_UB K_ED_LANK2_OBD_SLOPE.P_CODE_UNPLAUSIBEL K_ED_LANK2_OBD_WE.DEC_NACH_EINTRAG K_ED_LANK2_OBD_WE.DEC_VOR_EINTRAG K_ED_LANK2_OBD_WE.FEHLERSCHWELLE K_ED_LANK2_OBD_WE.INC_NACH_EINTRAG K_ED_LANK2_OBD_WE.INC_VOR_EINTRAG K_ED_LANK2_OBD_WE.KLASSENINDEX K_ED_LANK2_OBD_WE.OK_SCHWELLE K_ED_LANK2_OBD_WE.P_CODE_OPENLOAD K_ED_LANK2_OBD_WE.P_CODE_SH_TO_GND K_ED_LANK2_OBD_WE.P_CODE_SH_TO_UB K_ED_LANK2_OBD_WE.P_CODE_UNPLAUSIBEL K_ED_LANK2_OPENLOAD.DEC_NACH_EINTRAG K_ED_LANK2_OPENLOAD.DEC_VOR_EINTRAG K_ED_LANK2_OPENLOAD.FEHLERSCHWELLE K_ED_LANK2_OPENLOAD.INC_NACH_EINTRAG K_ED_LANK2_OPENLOAD.INC_VOR_EINTRAG K_ED_LANK2_OPENLOAD.KLASSENINDEX K_ED_LANK2_OPENLOAD.OK_SCHWELLE K_ED_LANK2_OPENLOAD.P_CODE_OPENLOAD K_ED_LANK2_OPENLOAD.P_CODE_SH_TO_GND K_ED_LANK2_OPENLOAD.P_CODE_SH_TO_UB K_ED_LANK2_OPENLOAD.P_CODE_UNPLAUSIBEL K_ED_LAVK1.DEC_NACH_EINTRAG K_ED_LAVK1.DEC_VOR_EINTRAG K_ED_LAVK1.FEHLERSCHWELLE K_ED_LAVK1.INC_NACH_EINTRAG K_ED_LAVK1.INC_VOR_EINTRAG K_ED_LAVK1.KLASSENINDEX K_ED_LAVK1.OK_SCHWELLE K_ED_LAVK1.P_CODE_OPENLOAD K_ED_LAVK1.P_CODE_SH_TO_GND K_ED_LAVK1.P_CODE_SH_TO_UB K_ED_LAVK1.P_CODE_UNPLAUSIBEL K_ED_LAVK1_DIAG.DEC_NACH_EINTRAG K_ED_LAVK1_DIAG.DEC_VOR_EINTRAG K_ED_LAVK1_DIAG.FEHLERSCHWELLE K_ED_LAVK1_DIAG.INC_NACH_EINTRAG K_ED_LAVK1_DIAG.INC_VOR_EINTRAG K_ED_LAVK1_DIAG.KLASSENINDEX K_ED_LAVK1_DIAG.OK_SCHWELLE K_ED_LAVK1_DIAG.P_CODE_OPENLOAD K_ED_LAVK1_DIAG.P_CODE_SH_TO_GND K_ED_LAVK1_DIAG.P_CODE_SH_TO_UB K_ED_LAVK1_DIAG.P_CODE_UNPLAUSIBEL K_ED_LAVK1_IA_OPENLOAD.DEC_NACH_EINTRAG K_ED_LAVK1_IA_OPENLOAD.DEC_VOR_EINTRAG K_ED_LAVK1_IA_OPENLOAD.FEHLERSCHWELLE K_ED_LAVK1_IA_OPENLOAD.INC_NACH_EINTRAG K_ED_LAVK1_IA_OPENLOAD.INC_VOR_EINTRAG K_ED_LAVK1_IA_OPENLOAD.KLASSENINDEX K_ED_LAVK1_IA_OPENLOAD.OK_SCHWELLE K_ED_LAVK1_IA_OPENLOAD.P_CODE_OPENLOAD K_ED_LAVK1_IA_OPENLOAD.P_CODE_SH_TO_GND K_ED_LAVK1_IA_OPENLOAD.P_CODE_SH_TO_UB K_ED_LAVK1_IA_OPENLOAD.P_CODE_UNPLAUSIBEL K_ED_LAVK1_IP_OPENLOAD.DEC_NACH_EINTRAG K_ED_LAVK1_IP_OPENLOAD.DEC_VOR_EINTRAG K_ED_LAVK1_IP_OPENLOAD.FEHLERSCHWELLE K_ED_LAVK1_IP_OPENLOAD.INC_NACH_EINTRAG K_ED_LAVK1_IP_OPENLOAD.INC_VOR_EINTRAG K_ED_LAVK1_IP_OPENLOAD.KLASSENINDEX K_ED_LAVK1_IP_OPENLOAD.OK_SCHWELLE K_ED_LAVK1_IP_OPENLOAD.P_CODE_OPENLOAD K_ED_LAVK1_IP_OPENLOAD.P_CODE_SH_TO_GND K_ED_LAVK1_IP_OPENLOAD.P_CODE_SH_TO_UB K_ED_LAVK1_IP_OPENLOAD.P_CODE_UNPLAUSIBEL K_ED_LAVK1_OBD_DYN.DEC_NACH_EINTRAG K_ED_LAVK1_OBD_DYN.DEC_VOR_EINTRAG K_ED_LAVK1_OBD_DYN.FEHLERSCHWELLE K_ED_LAVK1_OBD_DYN.INC_NACH_EINTRAG K_ED_LAVK1_OBD_DYN.INC_VOR_EINTRAG K_ED_LAVK1_OBD_DYN.KLASSENINDEX K_ED_LAVK1_OBD_DYN.OK_SCHWELLE K_ED_LAVK1_OBD_DYN.P_CODE_OPENLOAD K_ED_LAVK1_OBD_DYN.P_CODE_SH_TO_GND K_ED_LAVK1_OBD_DYN.P_CODE_SH_TO_UB K_ED_LAVK1_OBD_DYN.P_CODE_UNPLAUSIBEL K_ED_LAVK1_OBD_PLAU.DEC_NACH_EINTRAG K_ED_LAVK1_OBD_PLAU.DEC_VOR_EINTRAG K_ED_LAVK1_OBD_PLAU.FEHLERSCHWELLE K_ED_LAVK1_OBD_PLAU.INC_NACH_EINTRAG K_ED_LAVK1_OBD_PLAU.INC_VOR_EINTRAG K_ED_LAVK1_OBD_PLAU.KLASSENINDEX K_ED_LAVK1_OBD_PLAU.OK_SCHWELLE K_ED_LAVK1_OBD_PLAU.P_CODE_OPENLOAD K_ED_LAVK1_OBD_PLAU.P_CODE_SH_TO_GND K_ED_LAVK1_OBD_PLAU.P_CODE_SH_TO_UB K_ED_LAVK1_OBD_PLAU.P_CODE_UNPLAUSIBEL K_ED_LAVK1_OBD_SA.DEC_NACH_EINTRAG K_ED_LAVK1_OBD_SA.DEC_VOR_EINTRAG K_ED_LAVK1_OBD_SA.FEHLERSCHWELLE K_ED_LAVK1_OBD_SA.INC_NACH_EINTRAG K_ED_LAVK1_OBD_SA.INC_VOR_EINTRAG K_ED_LAVK1_OBD_SA.KLASSENINDEX K_ED_LAVK1_OBD_SA.OK_SCHWELLE K_ED_LAVK1_OBD_SA.P_CODE_OPENLOAD K_ED_LAVK1_OBD_SA.P_CODE_SH_TO_GND K_ED_LAVK1_OBD_SA.P_CODE_SH_TO_UB K_ED_LAVK1_OBD_SA.P_CODE_UNPLAUSIBEL K_ED_LAVK1_OBD_TL.DEC_NACH_EINTRAG K_ED_LAVK1_OBD_TL.DEC_VOR_EINTRAG K_ED_LAVK1_OBD_TL.FEHLERSCHWELLE K_ED_LAVK1_OBD_TL.INC_NACH_EINTRAG K_ED_LAVK1_OBD_TL.INC_VOR_EINTRAG K_ED_LAVK1_OBD_TL.KLASSENINDEX K_ED_LAVK1_OBD_TL.OK_SCHWELLE K_ED_LAVK1_OBD_TL.P_CODE_OPENLOAD K_ED_LAVK1_OBD_TL.P_CODE_SH_TO_GND K_ED_LAVK1_OBD_TL.P_CODE_SH_TO_UB K_ED_LAVK1_OBD_TL.P_CODE_UNPLAUSIBEL K_ED_LAVK1_TRIM.DEC_NACH_EINTRAG K_ED_LAVK1_TRIM.DEC_VOR_EINTRAG K_ED_LAVK1_TRIM.FEHLERSCHWELLE K_ED_LAVK1_TRIM.INC_NACH_EINTRAG K_ED_LAVK1_TRIM.INC_VOR_EINTRAG K_ED_LAVK1_TRIM.KLASSENINDEX K_ED_LAVK1_TRIM.OK_SCHWELLE K_ED_LAVK1_TRIM.P_CODE_OPENLOAD K_ED_LAVK1_TRIM.P_CODE_SH_TO_GND K_ED_LAVK1_TRIM.P_CODE_SH_TO_UB K_ED_LAVK1_TRIM.P_CODE_UNPLAUSIBEL K_ED_LAVK1_UN_OPENLOAD.DEC_NACH_EINTRAG K_ED_LAVK1_UN_OPENLOAD.DEC_VOR_EINTRAG K_ED_LAVK1_UN_OPENLOAD.FEHLERSCHWELLE K_ED_LAVK1_UN_OPENLOAD.INC_NACH_EINTRAG K_ED_LAVK1_UN_OPENLOAD.INC_VOR_EINTRAG K_ED_LAVK1_UN_OPENLOAD.KLASSENINDEX /end DEF_CHARACTERISTIC
/end FUNCTION
/begin RECORD_LAYOUT TKW_VV_VV_UB FNC_VALUES 1 UBYTE COLUMN_DIR DIRECT /end RECORD_LAYOUT
/begin RECORD_LAYOUT TKW_VV_VV_UW FNC_VALUES 1 UWORD COLUMN_DIR DIRECT /end RECORD_LAYOUT
/end MODULE
/end PROJECT
