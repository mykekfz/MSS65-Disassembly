/begin PROJECT MSS65-inj-V452 "MSS65 INJ - V452.01-B204.00, data set 0569Q60Z160E"
/begin HEADER "" VERSION "V452.01-B204.00" /end HEADER
/begin MODULE _MSS65-inj "MSS65 INJ - V452.01-B204.00, calibration xxxxxxxx"
/begin MOD_COMMON "" BYTE_ORDER MSB_FIRST /* Default byteorder (Motorola) */ /end MOD_COMMON
/* Formel fuer 1:1-Wiedergabe ohne Einheit */
/begin COMPU_METHOD FORMULA_USER1 "FORMULA_USER1" RAT_FUNC "%7.0" "-" COEFFS 0 1 0 0 0 1 /end COMPU_METHOD
/begin COMPU_METHOD DEFAULT_FORMULA "DEFAULT_FORMULA" RAT_FUNC "%7.0" "" COEFFS 0 1 0 0 0 1 /end COMPU_METHOD
/* ------------------ Abschnitt erzeugt aus adapt_common.dat ------------------ */
/begin COMPU_METHOD FORMULA_0000 "FORMULA_0000" RAT_FUNC "%7.0" "-" COEFFS 0 1 0 0 0 1 /end COMPU_METHOD
/begin COMPU_METHOD FORMULA_0001 "FORMULA_0001" RAT_FUNC "%6.1" "%" COEFFS 0 10 0 0 0 1 /end COMPU_METHOD
/begin COMPU_METHOD FORMULA_0002 "FORMULA_0002" TAB_VERB "%3.0" "-" COMPU_TAB_REF FORMULA_0002_VTAB /end COMPU_METHOD
/begin COMPU_VTAB FORMULA_0002_VTAB "FORMULA_0002_VTAB" TAB_VERB 4 0 "in Ordnung" 128 "queue full" 64 "queue fehler" 32 "IRQ illegal" DEFAULT_VALUE "undefiniert" /end COMPU_VTAB
/begin COMPU_METHOD FORMULA_0003 "FORMULA_0003" RAT_FUNC "%3.0" "-" COEFFS 0 1 0 0 0 1 /end COMPU_METHOD
/begin COMPU_METHOD FORMULA_0006 "FORMULA_0006" RAT_FUNC "%5.0" "Upm" COEFFS 0 1 0 0 0 1 /end COMPU_METHOD
/begin COMPU_METHOD FORMULA_0007 "FORMULA_0007" RAT_FUNC "%8.3" "-" COEFFS 0 10000 0 0 0 1 /end COMPU_METHOD
/begin COMPU_METHOD FORMULA_0008 "FORMULA_0008" RAT_FUNC "%6.1" "V" COEFFS 0 10 0 0 0 1 /end COMPU_METHOD
/begin COMPU_METHOD FORMULA_0009 "FORMULA_0009" RAT_FUNC "%6.1" "Nm" COEFFS 0 10 0 0 0 1 /end COMPU_METHOD
/begin COMPU_METHOD FORMULA_0010 "FORMULA_0010" RAT_FUNC "%5.0" "-" COEFFS 0 1 0 0 0 1 /end COMPU_METHOD
/begin COMPU_METHOD FORMULA_0021 "FORMULA_0021" RAT_FUNC "%7.2" "s" COEFFS 0 100 0 0 0 1 /end COMPU_METHOD
/begin COMPU_METHOD FORMULA_0022 "FORMULA_0022" RAT_FUNC "%7.2" "%" COEFFS 0 100 0 0 0 1 /end COMPU_METHOD
/* ------------------ Abschnitt erzeugt aus adapt_glob.dat ------------------ */
/begin COMPU_METHOD FORMULA_0023 "FORMULA_0023" RAT_FUNC "%6.1" "�C" COEFFS 0 10 2732 0 0 1 /end COMPU_METHOD
/begin COMPU_METHOD FORMULA_0024 "FORMULA_0024" RAT_FUNC "%9.4" "-" COEFFS 0 32768 0 0 0 1 /end COMPU_METHOD
/begin COMPU_METHOD FORMULA_0025 "FORMULA_0025" RAT_FUNC "%8.3" "-" COEFFS 0 16384 0 0 0 1 /end COMPU_METHOD
/begin COMPU_METHOD FORMULA_0032 "FORMULA_0032" RAT_FUNC "%3.0" "%" COEFFS 0 1 0 0 0 1 /end COMPU_METHOD
/begin COMPU_METHOD FORMULA_0033 "FORMULA_0033" RAT_FUNC "%5.2" "-" COEFFS 0 1 0 0 0 1 /end COMPU_METHOD
/begin COMPU_METHOD FORMULA_0073 "FORMULA_0073" RAT_FUNC "%6.1" "s" COEFFS 0 10 0 0 0 1 /end COMPU_METHOD
/begin COMPU_METHOD FORMULA_0075 "FORMULA_0075" RAT_FUNC "%8.3" "-" COEFFS 0 1024 0 0 0 1 /end COMPU_METHOD
/begin COMPU_METHOD FORMULA_0077 "FORMULA_0077" RAT_FUNC "%6.1" "mbar" COEFFS 0 16 0 0 0 1 /end COMPU_METHOD
/begin COMPU_METHOD FORMULA_0078 "FORMULA_0078" RAT_FUNC "%6.1" "km/h" COEFFS 0 16 0 0 0 1 /end COMPU_METHOD
/* ------------------ Abschnitt erzeugt aus glob.dat ------------------ */
/begin COMPU_METHOD FORMULA_0083 "FORMULA_0083" RAT_FUNC "%7.2" "-" COEFFS 0 1 0 0 0 1 /end COMPU_METHOD
/begin COMPU_METHOD FORMULA_0107 "FORMULA_0107" TAB_VERB "%7.2" "-" COMPU_TAB_REF FORMULA_0107_VTAB /end COMPU_METHOD
/begin COMPU_VTAB FORMULA_0107_VTAB "FORMULA_0107_VTAB" TAB_VERB 1 0 "inaktiv" DEFAULT_VALUE "aktiv" /end COMPU_VTAB
/begin COMPU_METHOD FORMULA_0109 "FORMULA_0109" RAT_FUNC "%7.2" "-" COEFFS 0 10000 0 0 0 1 /end COMPU_METHOD
/begin COMPU_METHOD FORMULA_0111 "FORMULA_0111" RAT_FUNC "%6.1" "�KW" COEFFS 0 10 0 0 0 1 /end COMPU_METHOD
/begin COMPU_METHOD FORMULA_0112 "FORMULA_0112" RAT_FUNC "%6.1" "kg/h" COEFFS 0 10 0 0 0 1 /end COMPU_METHOD
/begin COMPU_METHOD FORMULA_0113 "FORMULA_0113" RAT_FUNC "%6.1" "mg/asp" COEFFS 0 10 0 0 0 1 /end COMPU_METHOD
/begin COMPU_METHOD FORMULA_0114 "FORMULA_0114" RAT_FUNC "%5.0" "Upm/s" COEFFS 0 1 0 0 0 1 /end COMPU_METHOD
/begin COMPU_METHOD FORMULA_0117 "FORMULA_0117" RAT_FUNC "%7.2" "s" COEFFS 0 200 0 0 0 1 /end COMPU_METHOD
/begin COMPU_METHOD FORMULA_0123 "FORMULA_0123" RAT_FUNC "%5.0" "digit" COEFFS 0 1 0 0 0 1 /end COMPU_METHOD
/begin COMPU_METHOD FORMULA_0204 "FORMULA_0204" RAT_FUNC "%8.3" "100/10ms" COEFFS 0 100 0 0 0 1 /end COMPU_METHOD
/begin COMPU_METHOD FORMULA_0228 "FORMULA_0228" TAB_VERB "%5.2" "-" COMPU_TAB_REF FORMULA_0228_VTAB /end COMPU_METHOD
/begin COMPU_VTAB FORMULA_0228_VTAB "FORMULA_0228_VTAB" TAB_VERB 16 0 "O.K." 1 "SH_TO_UB" 2 "SH_TO_GND" 3 "UB+GND" 4 "OPENLOAD" 5 "UB+OL" 6 "GND+OL" 7 "UB+GND+OL" 8 "UNPLAUSI" 9 "UB+UP" 10 "GND+UP" 11 "UB+GND+UP" 12 "OL+UP" 13 "UB+OL+UP" 14 "GND+OL+UP" 15 "UB+GND+OL+UP" /end COMPU_VTAB
/begin COMPU_METHOD FORMULA_0295 "FORMULA_0295" RAT_FUNC "%9.4" "-" COEFFS 0 16384 0 0 0 1 /end COMPU_METHOD
/* ------------------ Abschnitt erzeugt aus qadc.dat ------------------ */
/begin COMPU_METHOD FORMULA_0354 "FORMULA_0354" TAB_VERB "%5.2" "-" COMPU_TAB_REF FORMULA_0354_VTAB /end COMPU_METHOD
/begin COMPU_VTAB FORMULA_0354_VTAB "FORMULA_0354_VTAB" TAB_VERB 3 0 "OK" 1 "QADCA NIO" 2 "QADCB NIO" DEFAULT_VALUE "undef" /end COMPU_VTAB
/* ------------------ Abschnitt erzeugt aus spi.dat ------------------ */
/begin COMPU_METHOD FORMULA_0370 "FORMULA_0370" TAB_VERB "%3.0" "-" COMPU_TAB_REF FORMULA_0370_VTAB /end COMPU_METHOD
/begin COMPU_VTAB FORMULA_0370_VTAB "FORMULA_0370_VTAB" TAB_VERB 2 0 "frei" 128 "Belegt" DEFAULT_VALUE "undefiniert" /end COMPU_VTAB
/begin COMPU_METHOD FORMULA_0531 "FORMULA_0531" RAT_FUNC "%8.3" "mg/ASP" COEFFS 0 64 0 0 0 1 /end COMPU_METHOD
/begin COMPU_METHOD FORMULA_0532 "FORMULA_0532" RAT_FUNC "%5.0" "mV" COEFFS 0 1024 0 0 0 5000 /end COMPU_METHOD
/begin COMPU_METHOD FORMULA_0556 "FORMULA_0556" RAT_FUNC "%9.4" "-" COEFFS 0 10000 0 0 0 1 /end COMPU_METHOD
/* ------------------ Abschnitt erzeugt aus diag_tr.dat ------------------ */
/begin COMPU_METHOD FORMULA_0634 "FORMULA_0634" TAB_VERB "%5.2" "-" COMPU_TAB_REF FORMULA_0634_VTAB /end COMPU_METHOD
/begin COMPU_VTAB FORMULA_0634_VTAB "FORMULA_0634_VTAB" TAB_VERB 4 0 "Aus" 1 "readDummy" 2 "An" 4 "Stop" DEFAULT_VALUE "undef" /end COMPU_VTAB
/begin COMPU_METHOD FORMULA_0651 "FORMULA_0651" RAT_FUNC "%6.3" "s" COEFFS 0 0 1.28 0 1 0 /end COMPU_METHOD
/begin COMPU_METHOD FORMULA_0664 "FORMULA_0664" RAT_FUNC "%5.2" "s" COEFFS 0 0 2.56 0 1 0 /end COMPU_METHOD
/* ------------------ Abschnitt erzeugt aus fplau.dat ------------------ */
/begin COMPU_METHOD FORMULA_0686 "FORMULA_0686" TAB_VERB "%9.2" "-" COMPU_TAB_REF FORMULA_0686_VTAB /end COMPU_METHOD
/begin COMPU_VTAB FORMULA_0686_VTAB "FORMULA_0686_VTAB" TAB_VERB 1 0 "diag. laeuft" DEFAULT_VALUE "diag. inaktive" /end COMPU_VTAB
/begin COMPU_METHOD FORMULA_0687 "FORMULA_0687" TAB_VERB "%9.2" "-" COMPU_TAB_REF FORMULA_0687_VTAB /end COMPU_METHOD
/begin COMPU_VTAB FORMULA_0687_VTAB "FORMULA_0687_VTAB" TAB_VERB 1 0 "ok" DEFAULT_VALUE "nok" /end COMPU_VTAB
/begin COMPU_METHOD FORMULA_0688 "FORMULA_0688" TAB_VERB "%9.2" "-" COMPU_TAB_REF FORMULA_0688_VTAB /end COMPU_METHOD
/begin COMPU_VTAB FORMULA_0688_VTAB "FORMULA_0688_VTAB" TAB_VERB 1 0 "ok" DEFAULT_VALUE "nok" /end COMPU_VTAB
/begin COMPU_METHOD FORMULA_0689 "FORMULA_0689" TAB_VERB "%9.2" "-" COMPU_TAB_REF FORMULA_0689_VTAB /end COMPU_METHOD
/begin COMPU_VTAB FORMULA_0689_VTAB "FORMULA_0689_VTAB" TAB_VERB 1 0 "ok" DEFAULT_VALUE "nok" /end COMPU_VTAB
/begin COMPU_METHOD FORMULA_0690 "FORMULA_0690" TAB_VERB "%9.2" "-" COMPU_TAB_REF FORMULA_0690_VTAB /end COMPU_METHOD
/begin COMPU_VTAB FORMULA_0690_VTAB "FORMULA_0690_VTAB" TAB_VERB 1 0 "ok" DEFAULT_VALUE "nok" /end COMPU_VTAB
/begin COMPU_METHOD FORMULA_0691 "FORMULA_0691" TAB_VERB "%9.2" "-" COMPU_TAB_REF FORMULA_0691_VTAB /end COMPU_METHOD
/begin COMPU_VTAB FORMULA_0691_VTAB "FORMULA_0691_VTAB" TAB_VERB 1 0 "ok" DEFAULT_VALUE "nok" /end COMPU_VTAB
/begin COMPU_METHOD FORMULA_0692 "FORMULA_0692" TAB_VERB "%9.2" "-" COMPU_TAB_REF FORMULA_0692_VTAB /end COMPU_METHOD
/begin COMPU_VTAB FORMULA_0692_VTAB "FORMULA_0692_VTAB" TAB_VERB 1 0 "ok" DEFAULT_VALUE "nok" /end COMPU_VTAB
/begin COMPU_METHOD FORMULA_0693 "FORMULA_0693" TAB_VERB "%9.2" "-" COMPU_TAB_REF FORMULA_0693_VTAB /end COMPU_METHOD
/begin COMPU_VTAB FORMULA_0693_VTAB "FORMULA_0693_VTAB" TAB_VERB 1 0 "ok" DEFAULT_VALUE "nok" /end COMPU_VTAB
/begin COMPU_METHOD FORMULA_0694 "FORMULA_0694" TAB_VERB "%9.2" "-" COMPU_TAB_REF FORMULA_0694_VTAB /end COMPU_METHOD
/begin COMPU_VTAB FORMULA_0694_VTAB "FORMULA_0694_VTAB" TAB_VERB 1 0 "ok" DEFAULT_VALUE "nok" /end COMPU_VTAB
/begin COMPU_METHOD FORMULA_0695 "FORMULA_0695" TAB_VERB "%9.2" "-" COMPU_TAB_REF FORMULA_0695_VTAB /end COMPU_METHOD
/begin COMPU_VTAB FORMULA_0695_VTAB "FORMULA_0695_VTAB" TAB_VERB 1 0 "ok" DEFAULT_VALUE "nok" /end COMPU_VTAB
/begin COMPU_METHOD FORMULA_0696 "FORMULA_0696" TAB_VERB "%9.2" "-" COMPU_TAB_REF FORMULA_0696_VTAB /end COMPU_METHOD
/begin COMPU_VTAB FORMULA_0696_VTAB "FORMULA_0696_VTAB" TAB_VERB 1 0 "ok" DEFAULT_VALUE "nok" /end COMPU_VTAB
/begin COMPU_METHOD FORMULA_0697 "FORMULA_0697" TAB_VERB "%9.2" "-" COMPU_TAB_REF FORMULA_0697_VTAB /end COMPU_METHOD
/begin COMPU_VTAB FORMULA_0697_VTAB "FORMULA_0697_VTAB" TAB_VERB 1 0 "ok" DEFAULT_VALUE "nok" /end COMPU_VTAB
/begin COMPU_METHOD FORMULA_0698 "FORMULA_0698" TAB_VERB "%9.2" "-" COMPU_TAB_REF FORMULA_0698_VTAB /end COMPU_METHOD
/begin COMPU_VTAB FORMULA_0698_VTAB "FORMULA_0698_VTAB" TAB_VERB 1 0 "ok" DEFAULT_VALUE "nok" /end COMPU_VTAB
/begin COMPU_METHOD FORMULA_0699 "FORMULA_0699" TAB_VERB "%9.2" "-" COMPU_TAB_REF FORMULA_0699_VTAB /end COMPU_METHOD
/begin COMPU_VTAB FORMULA_0699_VTAB "FORMULA_0699_VTAB" TAB_VERB 1 0 "ok" DEFAULT_VALUE "nok" /end COMPU_VTAB
/begin COMPU_METHOD FORMULA_0700 "FORMULA_0700" TAB_VERB "%9.2" "-" COMPU_TAB_REF FORMULA_0700_VTAB /end COMPU_METHOD
/begin COMPU_VTAB FORMULA_0700_VTAB "FORMULA_0700_VTAB" TAB_VERB 1 0 "ok" DEFAULT_VALUE "nok" /end COMPU_VTAB
/begin COMPU_METHOD FORMULA_0701 "FORMULA_0701" TAB_VERB "%9.2" "-" COMPU_TAB_REF FORMULA_0701_VTAB /end COMPU_METHOD
/begin COMPU_VTAB FORMULA_0701_VTAB "FORMULA_0701_VTAB" TAB_VERB 1 0 "ok" DEFAULT_VALUE "nok" /end COMPU_VTAB
/begin COMPU_METHOD FORMULA_0702 "FORMULA_0702" TAB_VERB "%9.2" "-" COMPU_TAB_REF FORMULA_0702_VTAB /end COMPU_METHOD
/begin COMPU_VTAB FORMULA_0702_VTAB "FORMULA_0702_VTAB" TAB_VERB 1 0 "ok" DEFAULT_VALUE "nok" /end COMPU_VTAB
/begin COMPU_METHOD FORMULA_0703 "FORMULA_0703" TAB_VERB "%9.2" "-" COMPU_TAB_REF FORMULA_0703_VTAB /end COMPU_METHOD
/begin COMPU_VTAB FORMULA_0703_VTAB "FORMULA_0703_VTAB" TAB_VERB 1 0 "ok" DEFAULT_VALUE "nok" /end COMPU_VTAB
/begin COMPU_METHOD FORMULA_0704 "FORMULA_0704" TAB_VERB "%9.2" "-" COMPU_TAB_REF FORMULA_0704_VTAB /end COMPU_METHOD
/begin COMPU_VTAB FORMULA_0704_VTAB "FORMULA_0704_VTAB" TAB_VERB 1 0 "ok" DEFAULT_VALUE "nok" /end COMPU_VTAB
/begin COMPU_METHOD FORMULA_0705 "FORMULA_0705" TAB_VERB "%9.2" "-" COMPU_TAB_REF FORMULA_0705_VTAB /end COMPU_METHOD
/begin COMPU_VTAB FORMULA_0705_VTAB "FORMULA_0705_VTAB" TAB_VERB 1 0 "ok" DEFAULT_VALUE "nok" /end COMPU_VTAB
/begin COMPU_METHOD FORMULA_0706 "FORMULA_0706" TAB_VERB "%9.2" "-" COMPU_TAB_REF FORMULA_0706_VTAB /end COMPU_METHOD
/begin COMPU_VTAB FORMULA_0706_VTAB "FORMULA_0706_VTAB" TAB_VERB 1 0 "ok" DEFAULT_VALUE "nok" /end COMPU_VTAB
/begin COMPU_METHOD FORMULA_0707 "FORMULA_0707" TAB_VERB "%9.2" "-" COMPU_TAB_REF FORMULA_0707_VTAB /end COMPU_METHOD
/begin COMPU_VTAB FORMULA_0707_VTAB "FORMULA_0707_VTAB" TAB_VERB 1 0 "ok" DEFAULT_VALUE "nok" /end COMPU_VTAB
/begin COMPU_METHOD FORMULA_0708 "FORMULA_0708" TAB_VERB "%9.2" "-" COMPU_TAB_REF FORMULA_0708_VTAB /end COMPU_METHOD
/begin COMPU_VTAB FORMULA_0708_VTAB "FORMULA_0708_VTAB" TAB_VERB 1 0 "ok" DEFAULT_VALUE "nok" /end COMPU_VTAB
/begin COMPU_METHOD FORMULA_0709 "FORMULA_0709" RAT_FUNC "%6.1" "%" COEFFS 0 100 0 0 0 1 /end COMPU_METHOD
/begin COMPU_METHOD FORMULA_0710 "FORMULA_0710" TAB_VERB "%5.2" "-" COMPU_TAB_REF FORMULA_0710_VTAB /end COMPU_METHOD
/begin COMPU_VTAB FORMULA_0710_VTAB "FORMULA_0710_VTAB" TAB_VERB 5 0 "Inaktiv" 1 "Aktiv OK" 2 "Fehler" 4 "Fehler CNT" 8 "ED Eintrag" DEFAULT_VALUE "ugnueltig" /end COMPU_VTAB
/begin COMPU_METHOD FORMULA_0711 "FORMULA_0711" TAB_VERB "%5.2" "-" COMPU_TAB_REF FORMULA_0711_VTAB /end COMPU_METHOD
/begin COMPU_VTAB FORMULA_0711_VTAB "FORMULA_0711_VTAB" TAB_VERB 6 0 "Inaktiv" 1 "Aktiv OK" 2 "Fehler" 4 "Fehler CNT" 8 "ED Eintrag" 16 "TE sperrt" DEFAULT_VALUE "ugnueltig" /end COMPU_VTAB
/begin COMPU_METHOD FORMULA_0712 "FORMULA_0712" TAB_VERB "%5.2" "-" COMPU_TAB_REF FORMULA_0712_VTAB /end COMPU_METHOD
/begin COMPU_VTAB FORMULA_0712_VTAB "FORMULA_0712_VTAB" TAB_VERB 3 0 "Inaktiv" 1 "Aktiv" 2 "Aktiv Test" DEFAULT_VALUE "ungueltig" /end COMPU_VTAB
/begin COMPU_METHOD FORMULA_0718 "FORMULA_0718" RAT_FUNC "%5.2" "s" COEFFS 0 0 256 0 1 0 /end COMPU_METHOD
/begin COMPU_METHOD FORMULA_0752 "FORMULA_0752" RAT_FUNC "%7.2" "mg" COEFFS 0 64 0 0 0 1 /end COMPU_METHOD
/begin COMPU_METHOD FORMULA_0798 "FORMULA_0798" TAB_VERB "%7.2" "-" COMPU_TAB_REF FORMULA_0798_VTAB /end COMPU_METHOD
/begin COMPU_VTAB FORMULA_0798_VTAB "FORMULA_0798_VTAB" TAB_VERB 2 0 "inaktiv" 1 "aktiv" /end COMPU_VTAB
/begin COMPU_METHOD FORMULA_0852 "FORMULA_0852" TAB_VERB "%7.2" "-" COMPU_TAB_REF FORMULA_0852_VTAB /end COMPU_METHOD
/begin COMPU_VTAB FORMULA_0852_VTAB "FORMULA_0852_VTAB" TAB_VERB 1 0 "inaktiv" DEFAULT_VALUE "aktiv" /end COMPU_VTAB
/* ------------------ Abschnitt erzeugt aus la_trim.dat ------------------ */
/begin COMPU_METHOD FORMULA_0895 "FORMULA_0895" TAB_VERB "%7.2" "-" COMPU_TAB_REF FORMULA_0895_VTAB /end COMPU_METHOD
/begin COMPU_VTAB FORMULA_0895_VTAB "FORMULA_0895_VTAB" TAB_VERB 1 0 "inaktiv" DEFAULT_VALUE "aktiv" /end COMPU_VTAB
/begin COMPU_METHOD FORMULA_0896 "FORMULA_0896" TAB_VERB "%7.2" "-" COMPU_TAB_REF FORMULA_0896_VTAB /end COMPU_METHOD
/begin COMPU_VTAB FORMULA_0896_VTAB "FORMULA_0896_VTAB" TAB_VERB 1 0 "verletzt" DEFAULT_VALUE "i.O." /end COMPU_VTAB
/begin COMPU_METHOD FORMULA_0897 "FORMULA_0897" TAB_VERB "%7.2" "-" COMPU_TAB_REF FORMULA_0897_VTAB /end COMPU_METHOD
/begin COMPU_VTAB FORMULA_0897_VTAB "FORMULA_0897_VTAB" TAB_VERB 1 0 "nein" DEFAULT_VALUE "ja" /end COMPU_VTAB
/begin COMPU_METHOD FORMULA_0898 "FORMULA_0898" TAB_VERB "%7.2" "-" COMPU_TAB_REF FORMULA_0898_VTAB /end COMPU_METHOD
/begin COMPU_VTAB FORMULA_0898_VTAB "FORMULA_0898_VTAB" TAB_VERB 1 0 "nein" DEFAULT_VALUE "ja" /end COMPU_VTAB
/begin COMPU_METHOD FORMULA_0899 "FORMULA_0899" TAB_VERB "%7.2" "-" COMPU_TAB_REF FORMULA_0899_VTAB /end COMPU_METHOD
/begin COMPU_VTAB FORMULA_0899_VTAB "FORMULA_0899_VTAB" TAB_VERB 1 0 "n.i.O." DEFAULT_VALUE "i.O." /end COMPU_VTAB
/begin COMPU_METHOD FORMULA_0900 "FORMULA_0900" TAB_VERB "%7.2" "-" COMPU_TAB_REF FORMULA_0900_VTAB /end COMPU_METHOD
/begin COMPU_VTAB FORMULA_0900_VTAB "FORMULA_0900_VTAB" TAB_VERB 1 0 "n.i.O." DEFAULT_VALUE "i.O." /end COMPU_VTAB
/begin COMPU_METHOD FORMULA_0901 "FORMULA_0901" TAB_VERB "%7.2" "-" COMPU_TAB_REF FORMULA_0901_VTAB /end COMPU_METHOD
/begin COMPU_VTAB FORMULA_0901_VTAB "FORMULA_0901_VTAB" TAB_VERB 1 0 "aktiv" DEFAULT_VALUE "inaktiv" /end COMPU_VTAB
/begin COMPU_METHOD FORMULA_0902 "FORMULA_0902" TAB_VERB "%7.2" "-" COMPU_TAB_REF FORMULA_0902_VTAB /end COMPU_METHOD
/begin COMPU_VTAB FORMULA_0902_VTAB "FORMULA_0902_VTAB" TAB_VERB 1 0 "aktiv" DEFAULT_VALUE "inaktiv" /end COMPU_VTAB
/begin COMPU_METHOD FORMULA_0903 "FORMULA_0903" TAB_VERB "%7.2" "-" COMPU_TAB_REF FORMULA_0903_VTAB /end COMPU_METHOD
/begin COMPU_VTAB FORMULA_0903_VTAB "FORMULA_0903_VTAB" TAB_VERB 1 0 "aktiv" DEFAULT_VALUE "inaktiv" /end COMPU_VTAB
/begin COMPU_METHOD FORMULA_0904 "FORMULA_0904" TAB_VERB "%7.2" "-" COMPU_TAB_REF FORMULA_0904_VTAB /end COMPU_METHOD
/begin COMPU_VTAB FORMULA_0904_VTAB "FORMULA_0904_VTAB" TAB_VERB 1 0 "aktiv" DEFAULT_VALUE "inaktiv" /end COMPU_VTAB
/begin COMPU_METHOD FORMULA_0905 "FORMULA_0905" TAB_VERB "%7.2" "-" COMPU_TAB_REF FORMULA_0905_VTAB /end COMPU_METHOD
/begin COMPU_VTAB FORMULA_0905_VTAB "FORMULA_0905_VTAB" TAB_VERB 1 0 "aktiv" DEFAULT_VALUE "inaktiv" /end COMPU_VTAB
/begin COMPU_METHOD FORMULA_0906 "FORMULA_0906" TAB_VERB "%7.2" "-" COMPU_TAB_REF FORMULA_0906_VTAB /end COMPU_METHOD
/begin COMPU_VTAB FORMULA_0906_VTAB "FORMULA_0906_VTAB" TAB_VERB 1 0 "n.i.O." DEFAULT_VALUE "i.O." /end COMPU_VTAB
/begin COMPU_METHOD FORMULA_0907 "FORMULA_0907" TAB_VERB "%7.2" "-" COMPU_TAB_REF FORMULA_0907_VTAB /end COMPU_METHOD
/begin COMPU_VTAB FORMULA_0907_VTAB "FORMULA_0907_VTAB" TAB_VERB 1 0 "vorhanden" DEFAULT_VALUE "nicht vorhanden" /end COMPU_VTAB
/begin COMPU_METHOD FORMULA_0908 "FORMULA_0908" TAB_VERB "%7.2" "-" COMPU_TAB_REF FORMULA_0908_VTAB /end COMPU_METHOD
/begin COMPU_VTAB FORMULA_0908_VTAB "FORMULA_0908_VTAB" TAB_VERB 1 0 "aktiv" DEFAULT_VALUE "inaktiv" /end COMPU_VTAB
/begin COMPU_METHOD FORMULA_0909 "FORMULA_0909" TAB_VERB "%7.2" "-" COMPU_TAB_REF FORMULA_0909_VTAB /end COMPU_METHOD
/begin COMPU_VTAB FORMULA_0909_VTAB "FORMULA_0909_VTAB" TAB_VERB 1 0 "Verletzung" DEFAULT_VALUE "i.O." /end COMPU_VTAB
/begin COMPU_METHOD FORMULA_0910 "FORMULA_0910" TAB_VERB "%7.2" "-" COMPU_TAB_REF FORMULA_0910_VTAB /end COMPU_METHOD
/begin COMPU_VTAB FORMULA_0910_VTAB "FORMULA_0910_VTAB" TAB_VERB 1 0 "-" DEFAULT_VALUE "P-Anteil" /end COMPU_VTAB
/begin COMPU_METHOD FORMULA_0911 "FORMULA_0911" TAB_VERB "%7.2" "-" COMPU_TAB_REF FORMULA_0911_VTAB /end COMPU_METHOD
/begin COMPU_VTAB FORMULA_0911_VTAB "FORMULA_0911_VTAB" TAB_VERB 1 0 "-" DEFAULT_VALUE "abgeregelt" /end COMPU_VTAB
/begin COMPU_METHOD FORMULA_0912 "FORMULA_0912" TAB_VERB "%7.2" "-" COMPU_TAB_REF FORMULA_0912_VTAB /end COMPU_METHOD
/begin COMPU_VTAB FORMULA_0912_VTAB "FORMULA_0912_VTAB" TAB_VERB 1 0 "-" DEFAULT_VALUE "I-Anteil auf I-GMW" /end COMPU_VTAB
/begin COMPU_METHOD FORMULA_0913 "FORMULA_0913" TAB_VERB "%7.2" "-" COMPU_TAB_REF FORMULA_0913_VTAB /end COMPU_METHOD
/begin COMPU_VTAB FORMULA_0913_VTAB "FORMULA_0913_VTAB" TAB_VERB 1 0 "-" DEFAULT_VALUE "O2-Beladung" /end COMPU_VTAB
/begin COMPU_METHOD FORMULA_0914 "FORMULA_0914" TAB_VERB "%7.2" "-" COMPU_TAB_REF FORMULA_0914_VTAB /end COMPU_METHOD
/begin COMPU_VTAB FORMULA_0914_VTAB "FORMULA_0914_VTAB" TAB_VERB 1 0 "-" DEFAULT_VALUE "I-MAX" /end COMPU_VTAB
/begin COMPU_METHOD FORMULA_0915 "FORMULA_0915" TAB_VERB "%7.2" "-" COMPU_TAB_REF FORMULA_0915_VTAB /end COMPU_METHOD
/begin COMPU_VTAB FORMULA_0915_VTAB "FORMULA_0915_VTAB" TAB_VERB 1 0 "-" DEFAULT_VALUE "I-MIN" /end COMPU_VTAB
/begin COMPU_METHOD FORMULA_0916 "FORMULA_0916" TAB_VERB "%7.2" "-" COMPU_TAB_REF FORMULA_0916_VTAB /end COMPU_METHOD
/begin COMPU_VTAB FORMULA_0916_VTAB "FORMULA_0916_VTAB" TAB_VERB 1 0 "-" DEFAULT_VALUE "AD-Wert" /end COMPU_VTAB
/begin COMPU_METHOD FORMULA_0917 "FORMULA_0917" TAB_VERB "%7.2" "-" COMPU_TAB_REF FORMULA_0917_VTAB /end COMPU_METHOD
/begin COMPU_VTAB FORMULA_0917_VTAB "FORMULA_0917_VTAB" TAB_VERB 1 0 "-" DEFAULT_VALUE "AD-MAX" /end COMPU_VTAB
/begin COMPU_METHOD FORMULA_0918 "FORMULA_0918" TAB_VERB "%7.2" "-" COMPU_TAB_REF FORMULA_0918_VTAB /end COMPU_METHOD
/begin COMPU_VTAB FORMULA_0918_VTAB "FORMULA_0918_VTAB" TAB_VERB 1 0 "-" DEFAULT_VALUE "AD-MIN" /end COMPU_VTAB
/begin COMPU_METHOD FORMULA_0919 "FORMULA_0919" RAT_FUNC "%7.2" "10exp-3 -/mV" COEFFS 0 80 0 0 0 1 /end COMPU_METHOD
/begin COMPU_METHOD FORMULA_0920 "FORMULA_0920" RAT_FUNC "%10.3" "-/s" COEFFS 0 16384 0 0 0 1 /end COMPU_METHOD
/begin COMPU_METHOD FORMULA_0921 "FORMULA_0921" TAB_VERB "%7.2" "-" COMPU_TAB_REF FORMULA_0921_VTAB /end COMPU_METHOD
/begin COMPU_VTAB FORMULA_0921_VTAB "FORMULA_0921_VTAB" TAB_VERB 1 0 "-" DEFAULT_VALUE "M-Verdacht" /end COMPU_VTAB
/begin COMPU_METHOD FORMULA_0922 "FORMULA_0922" TAB_VERB "%7.2" "-" COMPU_TAB_REF FORMULA_0922_VTAB /end COMPU_METHOD
/begin COMPU_VTAB FORMULA_0922_VTAB "FORMULA_0922_VTAB" TAB_VERB 1 0 "-" DEFAULT_VALUE "F-Verdacht" /end COMPU_VTAB
/begin COMPU_METHOD FORMULA_0923 "FORMULA_0923" TAB_VERB "%7.2" "-" COMPU_TAB_REF FORMULA_0923_VTAB /end COMPU_METHOD
/begin COMPU_VTAB FORMULA_0923_VTAB "FORMULA_0923_VTAB" TAB_VERB 3 0 "inaktiv" 1 "aktiv" 2 "RESET" /end COMPU_VTAB
/begin COMPU_METHOD FORMULA_0924 "FORMULA_0924" TAB_VERB "%7.2" "-" COMPU_TAB_REF FORMULA_0924_VTAB /end COMPU_METHOD
/begin COMPU_VTAB FORMULA_0924_VTAB "FORMULA_0924_VTAB" TAB_VERB 6 0 "AUS" 1 "P-Anteil" 2 "I-Anteil" 6 "I-Anteil+MW-Begr." 14 "I-Anteil+MW-Begr.+Adapt." 15 "komplett" /end COMPU_VTAB
/begin COMPU_METHOD FORMULA_0925 "FORMULA_0925" RAT_FUNC "%7.2" "s" COEFFS 0 1 0 0 0 1 /end COMPU_METHOD
/begin COMPU_METHOD FORMULA_0926 "FORMULA_0926" RAT_FUNC "%5.0" "mV/10msec" COEFFS 0 1024 0 0 0 5000 /end COMPU_METHOD
/begin COMPU_METHOD FORMULA_0927 "FORMULA_0927" RAT_FUNC "%7.2" "-" COEFFS 0 1024 0 0 0 1 /end COMPU_METHOD
/* ------------------ Abschnitt erzeugt aus pabg.dat ------------------ */
/begin COMPU_METHOD FORMULA_1032 "FORMULA_1032" RAT_FUNC "%7.2" "s" COEFFS 0 0 25.6 0 1 0 /end COMPU_METHOD
/* ------------------ Abschnitt erzeugt aus qadc_conf.dat ------------------ */
/begin COMPU_METHOD FORMULA_1064 "FORMULA_1064" RAT_FUNC "%3.0" "z/asp" COEFFS 0 1 0 0 0 1 /end COMPU_METHOD
/* ------------------ Abschnitt erzeugt aus rf_e2.dat ------------------ */
/begin COMPU_METHOD FORMULA_1074 "FORMULA_1074" TAB_VERB "%5.2" "-" COMPU_TAB_REF FORMULA_1074_VTAB /end COMPU_METHOD
/begin COMPU_VTAB FORMULA_1074_VTAB "FORMULA_1074_VTAB" TAB_VERB 2 0 "RF_DYN aus" 1 "RF_DYN ein" /end COMPU_VTAB
/* ------------------ Abschnitt erzeugt aus rps.dat ------------------ */
/begin COMPU_METHOD FORMULA_1079 "FORMULA_1079" TAB_VERB "%7.2" "-" COMPU_TAB_REF FORMULA_1079_VTAB /end COMPU_METHOD
/begin COMPU_VTAB FORMULA_1079_VTAB "FORMULA_1079_VTAB" TAB_VERB 3 1 "Regler-RESET" 2 "Regler aktiv" 4 "Regler inaktiv" /end COMPU_VTAB
/begin COMPU_METHOD FORMULA_1080 "FORMULA_1080" TAB_VERB "%7.2" "-" COMPU_TAB_REF FORMULA_1080_VTAB /end COMPU_METHOD
/begin COMPU_VTAB FORMULA_1080_VTAB "FORMULA_1080_VTAB" TAB_VERB 5 1 "LAA-RESET" 2 "LAA-AUS" 4 "LAA-F" 8 "LAA-TE-F" 16 "LAA-OFFS" /end COMPU_VTAB
/begin COMPU_METHOD FORMULA_1081 "FORMULA_1081" TAB_VERB "%5.2" "-" COMPU_TAB_REF FORMULA_1081_VTAB /end COMPU_METHOD
/begin COMPU_VTAB FORMULA_1081_VTAB "FORMULA_1081_VTAB" TAB_VERB 2 0 "kein Fehler" 1 "PKS-Fehler" /end COMPU_VTAB
/begin COMPU_METHOD FORMULA_1082 "FORMULA_1082" RAT_FUNC "%6.1" "Hz" COEFFS 0 10 0 0 0 1 /end COMPU_METHOD
/begin COMPU_METHOD FORMULA_1083 "FORMULA_1083" TAB_VERB "%5.2" "-" COMPU_TAB_REF FORMULA_1083_VTAB /end COMPU_METHOD
/begin COMPU_VTAB FORMULA_1083_VTAB "FORMULA_1083_VTAB" TAB_VERB 19 0 "Inaktiv" 1 "Wandfilm" 2 "Lambdaregler" 3 "Lambdaadaption" 4 "Restgas" 5 "Abgasgegendruck" 6 "Ansauglufttemp" 7 "Fahrerwunsch" 8 "Leerlaufregler" 9 "Ionenstrom" 10 "Aussetzer" 11 "Vanoskatheizen" 12 "Motortemperatur" 13 "Kraftstoffdruck" 14 "Lastschlag" 15 "Zylindergleichst." 16 "Tankentlueftung" 17 "Aut. KF-Bedatung" 18 "Riemenstarter" DEFAULT_VALUE "undef" /end COMPU_VTAB
/* ------------------ Abschnitt erzeugt aus spgr.dat ------------------ */
/begin COMPU_METHOD FORMULA_1125 "FORMULA_1125" RAT_FUNC "%3.0" "kHz" COEFFS 0 0 10000000 0 714 0 /end COMPU_METHOD
/begin COMPU_METHOD FORMULA_1126 "FORMULA_1126" RAT_FUNC "%5.0" "kHz" COEFFS 0 0 10000000 0 714 0 /end COMPU_METHOD
/* ------------------ Abschnitt erzeugt aus qadc.dat ------------------ */
/begin MEASUREMENT qadc_check_ccw_st "CCW Check Status" UBYTE FORMULA_0354 0 0 0.0 255.0 ECU_ADDRESS 0x3FCE3C /end MEASUREMENT
/begin MEASUREMENT qadc_err_cnt "CCW Check Fehlerzaehler" UBYTE FORMULA_0033 0 0 0.0 255.0000 ECU_ADDRESS 0x3FCE3D /end MEASUREMENT
/begin MEASUREMENT qadc_check_ccw_adr "CCW Check Adresse des Fehlers" UBYTE FORMULA_0033 0 0 0.0 255.0000 ECU_ADDRESS 0x3FCE3E /end MEASUREMENT
/* ------------------ Abschnitt erzeugt aus spi.dat ------------------ */
/begin MEASUREMENT spim_errorcounter "Fehlerzaehler der Spi" UBYTE FORMULA_0003 0 0 0.0 255.0000 ECU_ADDRESS 0x3FD088 /end MEASUREMENT
/begin MEASUREMENT spim_reqcounter "Anzahl der Auftraege in der Queue" UBYTE FORMULA_0003 0 0 0.0 255.0000 ECU_ADDRESS 0x3FD089 /end MEASUREMENT
/begin MEASUREMENT spim_status "Statusvariable der SPI" UBYTE FORMULA_0370 0 0 0.0 255.0 ECU_ADDRESS 0x3FD08A /end MEASUREMENT
/begin MEASUREMENT spim_errorcode "Statusvariable der SPI" UBYTE FORMULA_0002 0 0 0.0 255.0 ECU_ADDRESS 0x3FD08B /end MEASUREMENT
/* ------------------ Abschnitt erzeugt aus diag_tr.dat ------------------ */
/begin CHARACTERISTIC K_DIAG_TR_MAX_ERR "erlaubte Fehler bis zum Eintrag als SG-Interner | EN: Permitted faults before entry as ECU-internal" VALUE 0x707A0 TKW_VV_VV_UB 100.0 FORMULA_0003 0.0 255.0000 /end CHARACTERISTIC
/begin MEASUREMENT diag_tr_atic35_tx_cnt "Checkbyte fuer die Queue" UBYTE FORMULA_0033 0 0 0.0 255.0000 ECU_ADDRESS 0x3FBEB0 /end MEASUREMENT
/begin MEASUREMENT diag_tr_atic35_error "Error Zaheler Atic35" UBYTE FORMULA_0033 0 0 0.0 255.0000 ECU_ADDRESS 0x3FBEB1 /end MEASUREMENT
/begin MEASUREMENT diag_tr_atic39_tx_cnt "Checkbyte fuer die Queue" UBYTE FORMULA_0033 0 0 0.0 255.0000 ECU_ADDRESS 0x3FBEB2 /end MEASUREMENT
/begin MEASUREMENT diag_tr_atic39_error "Error Zaheler Atic39" UBYTE FORMULA_0033 0 0 0.0 255.0000 ECU_ADDRESS 0x3FBEB3 /end MEASUREMENT
/begin MEASUREMENT diag_st_atic39_nn "Diagnosestatus ATIC39 Treiber Queue INJ" UBYTE FORMULA_0228 0 0 0.0 15.0 ECU_ADDRESS 0x3FBEB4 BIT_MASK 0xF /end MEASUREMENT
/begin MEASUREMENT diag_st_atic39_LHV1 "Diagnosestatus ATIC39 Treiber Queue INJ" UBYTE FORMULA_0228 0 0 0.0 15.0 ECU_ADDRESS 0x3FBEB5 BIT_MASK 0xF /end MEASUREMENT
/begin MEASUREMENT diag_st_atic39_LHV1_ "Diagnosestatus ATIC39 Treiber Queue INJ" UBYTE FORMULA_0228 0 0 0.0 15.0 ECU_ADDRESS 0x3FBEB6 BIT_MASK 0xF /end MEASUREMENT
/begin MEASUREMENT diag_st_atic39_EV1 "Diagnosestatus ATIC39 Treiber Queue INJ" UBYTE FORMULA_0228 0 0 0.0 15.0 ECU_ADDRESS 0x3FBEB7 BIT_MASK 0xF /end MEASUREMENT
/begin MEASUREMENT diag_st_atic39_EV2 "Diagnosestatus ATIC39 Treiber Queue INJ" UBYTE FORMULA_0228 0 0 0.0 15.0 ECU_ADDRESS 0x3FBEB8 BIT_MASK 0xF /end MEASUREMENT
/begin MEASUREMENT diag_st_atic39_EV3 "Diagnosestatus ATIC39 Treiber Queue INJ" UBYTE FORMULA_0228 0 0 0.0 15.0 ECU_ADDRESS 0x3FBEB9 BIT_MASK 0xF /end MEASUREMENT
/begin MEASUREMENT diag_st_atic39_EV4 "Diagnosestatus ATIC39 Treiber Queue INJ" UBYTE FORMULA_0228 0 0 0.0 15.0 ECU_ADDRESS 0x3FBEBA BIT_MASK 0xF /end MEASUREMENT
/begin MEASUREMENT diag_st_atic39_EV5 "Diagnosestatus ATIC39 Treiber Queue INJ" UBYTE FORMULA_0228 0 0 0.0 15.0 ECU_ADDRESS 0x3FBEBB BIT_MASK 0xF /end MEASUREMENT
/begin MEASUREMENT diag_st_atic39_EV6 "Diagnosestatus ATIC39 Treiber Queue INJ" UBYTE FORMULA_0228 0 0 0.0 15.0 ECU_ADDRESS 0x3FBEBC BIT_MASK 0xF /end MEASUREMENT
/begin MEASUREMENT diag_st_atic39_IGC1 "Diagnosestatus ATIC39 Treiber Queue INJ" UBYTE FORMULA_0228 0 0 0.0 15.0 ECU_ADDRESS 0x3FBEBD BIT_MASK 0xF /end MEASUREMENT
/begin MEASUREMENT diag_st_atic39_IGC2 "Diagnosestatus ATIC39 Treiber Queue INJ" UBYTE FORMULA_0228 0 0 0.0 15.0 ECU_ADDRESS 0x3FBEBE BIT_MASK 0xF /end MEASUREMENT
/begin MEASUREMENT diag_st_atic39_IGC3 "Diagnosestatus ATIC39 Treiber Queue INJ" UBYTE FORMULA_0228 0 0 0.0 15.0 ECU_ADDRESS 0x3FBEBF BIT_MASK 0xF /end MEASUREMENT
/begin MEASUREMENT diag_st_atic39_IGC4 "Diagnosestatus ATIC39 Treiber Queue INJ" UBYTE FORMULA_0228 0 0 0.0 15.0 ECU_ADDRESS 0x3FBEC0 BIT_MASK 0xF /end MEASUREMENT
/begin MEASUREMENT diag_st_atic39_DMTLH "Diagnosestatus ATIC39 Treiber Queue INJ" UBYTE FORMULA_0228 0 0 0.0 15.0 ECU_ADDRESS 0x3FBEC1 BIT_MASK 0xF /end MEASUREMENT
/begin MEASUREMENT diag_st_atic39_IGC11 "Diagnosestatus ATIC39 Treiber Queue INJ" UBYTE FORMULA_0228 0 0 0.0 15.0 ECU_ADDRESS 0x3FBEC2 BIT_MASK 0xF /end MEASUREMENT
/begin MEASUREMENT diag_st_atic39_DMTLV "Diagnosestatus ATIC39 Treiber Queue INJ" UBYTE FORMULA_0228 0 0 0.0 15.0 ECU_ADDRESS 0x3FBEC3 BIT_MASK 0xF /end MEASUREMENT
/begin MEASUREMENT diag_st_atic39_IGC5 "Diagnosestatus ATIC39 Treiber Queue INJ" UBYTE FORMULA_0228 0 0 0.0 15.0 ECU_ADDRESS 0x3FBEC4 BIT_MASK 0xF /end MEASUREMENT
/begin MEASUREMENT diag_st_atic39_LHV2 "Diagnosestatus ATIC39 Treiber Queue INJ" UBYTE FORMULA_0228 0 0 0.0 15.0 ECU_ADDRESS 0x3FBEC5 BIT_MASK 0xF /end MEASUREMENT
/begin MEASUREMENT diag_st_atic39_LHV2_ "Diagnosestatus ATIC39 Treiber Queue INJ" UBYTE FORMULA_0228 0 0 0.0 15.0 ECU_ADDRESS 0x3FBEC6 BIT_MASK 0xF /end MEASUREMENT
/begin MEASUREMENT diag_st_atic39_EV7 "Diagnosestatus ATIC39 Treiber Queue INJ" UBYTE FORMULA_0228 0 0 0.0 15.0 ECU_ADDRESS 0x3FBEC7 BIT_MASK 0xF /end MEASUREMENT
/begin MEASUREMENT diag_st_atic39_EV8 "Diagnosestatus ATIC39 Treiber Queue INJ" UBYTE FORMULA_0228 0 0 0.0 15.0 ECU_ADDRESS 0x3FBEC8 BIT_MASK 0xF /end MEASUREMENT
/begin MEASUREMENT diag_st_atic39_EV9 "Diagnosestatus ATIC39 Treiber Queue INJ" UBYTE FORMULA_0228 0 0 0.0 15.0 ECU_ADDRESS 0x3FBEC9 BIT_MASK 0xF /end MEASUREMENT
/begin MEASUREMENT diag_st_atic39_EV10 "Diagnosestatus ATIC39 Treiber Queue INJ" UBYTE FORMULA_0228 0 0 0.0 15.0 ECU_ADDRESS 0x3FBECA BIT_MASK 0xF /end MEASUREMENT
/begin MEASUREMENT diag_st_atic39_ELUP1 "Diagnosestatus ATIC39 Treiber Queue INJ" UBYTE FORMULA_0228 0 0 0.0 15.0 ECU_ADDRESS 0x3FBECB BIT_MASK 0xF /end MEASUREMENT
/begin MEASUREMENT diag_st_atic39_ELUP2 "Diagnosestatus ATIC39 Treiber Queue INJ" UBYTE FORMULA_0228 0 0 0.0 15.0 ECU_ADDRESS 0x3FBECC BIT_MASK 0xF /end MEASUREMENT
/begin MEASUREMENT diag_st_atic39_IGC6 "Diagnosestatus ATIC39 Treiber Queue INJ" UBYTE FORMULA_0228 0 0 0.0 15.0 ECU_ADDRESS 0x3FBECD BIT_MASK 0xF /end MEASUREMENT
/begin MEASUREMENT diag_st_atic39_IGC7 "Diagnosestatus ATIC39 Treiber Queue INJ" UBYTE FORMULA_0228 0 0 0.0 15.0 ECU_ADDRESS 0x3FBECE BIT_MASK 0xF /end MEASUREMENT
/begin MEASUREMENT diag_st_atic39_IGC8 "Diagnosestatus ATIC39 Treiber Queue INJ" UBYTE FORMULA_0228 0 0 0.0 15.0 ECU_ADDRESS 0x3FBECF BIT_MASK 0xF /end MEASUREMENT
/begin MEASUREMENT diag_st_atic39_IGC9 "Diagnosestatus ATIC39 Treiber Queue INJ" UBYTE FORMULA_0228 0 0 0.0 15.0 ECU_ADDRESS 0x3FBED0 BIT_MASK 0xF /end MEASUREMENT
/begin MEASUREMENT diag_st_atic39_RLEKP "Diagnosestatus ATIC39 Treiber Queue INJ" UBYTE FORMULA_0228 0 0 0.0 15.0 ECU_ADDRESS 0x3FBED1 BIT_MASK 0xF /end MEASUREMENT
/begin MEASUREMENT diag_st_atic39_IGC12 "Diagnosestatus ATIC39 Treiber Queue INJ" UBYTE FORMULA_0228 0 0 0.0 15.0 ECU_ADDRESS 0x3FBED2 BIT_MASK 0xF /end MEASUREMENT
/begin MEASUREMENT diag_st_atic39_SSP "Diagnosestatus ATIC39 Treiber Queue INJ" UBYTE FORMULA_0228 0 0 0.0 15.0 ECU_ADDRESS 0x3FBED3 BIT_MASK 0xF /end MEASUREMENT
/begin MEASUREMENT diag_st_atic39_IGC10 "Diagnosestatus ATIC39 Treiber Queue INJ" UBYTE FORMULA_0228 0 0 0.0 15.0 ECU_ADDRESS 0x3FBED4 BIT_MASK 0xF /end MEASUREMENT
/begin MEASUREMENT diag_st_atic39_LHN1 "Diagnosestatus ATIC39 Treiber Queue INJ" UBYTE FORMULA_0228 0 0 0.0 15.0 ECU_ADDRESS 0x3FBED5 BIT_MASK 0xF /end MEASUREMENT
/begin MEASUREMENT diag_st_atic39_LHN2 "Diagnosestatus ATIC39 Treiber Queue INJ" UBYTE FORMULA_0228 0 0 0.0 15.0 ECU_ADDRESS 0x3FBED6 BIT_MASK 0xF /end MEASUREMENT
/begin MEASUREMENT diag_st_atic39_TEV1 "Diagnosestatus ATIC39 Treiber Queue INJ" UBYTE FORMULA_0228 0 0 0.0 15.0 ECU_ADDRESS 0x3FBED7 BIT_MASK 0xF /end MEASUREMENT
/begin MEASUREMENT diag_st_atic39_TEV2 "Diagnosestatus ATIC39 Treiber Queue INJ" UBYTE FORMULA_0228 0 0 0.0 15.0 ECU_ADDRESS 0x3FBED8 BIT_MASK 0xF /end MEASUREMENT
/begin MEASUREMENT diag_st_atic39_SLV "Diagnosestatus ATIC39 Treiber Queue INJ" UBYTE FORMULA_0228 0 0 0.0 15.0 ECU_ADDRESS 0x3FBED9 BIT_MASK 0xF /end MEASUREMENT
/begin MEASUREMENT diag_st_atic39_SLV_ "Diagnosestatus ATIC39 Treiber Queue INJ" UBYTE FORMULA_0228 0 0 0.0 15.0 ECU_ADDRESS 0x3FBEDA BIT_MASK 0xF /end MEASUREMENT
/begin MEASUREMENT diag_st_atic39_LLFSO "Diagnosestatus ATIC39 Treiber Queue INJ" UBYTE FORMULA_0228 0 0 0.0 15.0 ECU_ADDRESS 0x3FBEDB BIT_MASK 0xF /end MEASUREMENT
/begin MEASUREMENT diag_st_atic39_LLFSS "Diagnosestatus ATIC39 Treiber Queue INJ" UBYTE FORMULA_0228 0 0 0.0 15.0 ECU_ADDRESS 0x3FBEDC BIT_MASK 0xF /end MEASUREMENT
/begin MEASUREMENT diag_st_atic39_EBOXL "Diagnosestatus ATIC39 Treiber Queue INJ" UBYTE FORMULA_0228 0 0 0.0 15.0 ECU_ADDRESS 0x3FBEDD BIT_MASK 0xF /end MEASUREMENT
/begin MEASUREMENT diag_st_atic39_RLU87 "Diagnosestatus ATIC39 Treiber Queue INJ" UBYTE FORMULA_0228 0 0 0.0 15.0 ECU_ADDRESS 0x3FBEDE BIT_MASK 0xF /end MEASUREMENT
/begin MEASUREMENT diag_st_atic39_DK1_ENABLE "Diagnosestatus ATIC39 Treiber Queue INJ" UBYTE FORMULA_0228 0 0 0.0 15.0 ECU_ADDRESS 0x3FBEDF BIT_MASK 0xF /end MEASUREMENT
/begin MEASUREMENT diag_st_atic39_DK2_ENABLE "Diagnosestatus ATIC39 Treiber Queue INJ" UBYTE FORMULA_0228 0 0 0.0 15.0 ECU_ADDRESS 0x3FBEE0 BIT_MASK 0xF /end MEASUREMENT
/begin MEASUREMENT diag_st_atic39_RLSTART "Diagnosestatus ATIC39 Treiber Queue INJ" UBYTE FORMULA_0228 0 0 0.0 15.0 ECU_ADDRESS 0x3FBEE1 BIT_MASK 0xF /end MEASUREMENT
/begin MEASUREMENT diag_st_atic39_RLSLP "Diagnosestatus ATIC39 Treiber Queue INJ" UBYTE FORMULA_0228 0 0 0.0 15.0 ECU_ADDRESS 0x3FBEE2 BIT_MASK 0xF /end MEASUREMENT
/begin MEASUREMENT diag_st_atic39_ELUE "Diagnosestatus ATIC39 Treiber Queue INJ" UBYTE FORMULA_0228 0 0 0.0 15.0 ECU_ADDRESS 0x3FBEE3 BIT_MASK 0xF /end MEASUREMENT
/begin MEASUREMENT diag_st_atic39_DMTLP "Diagnosestatus ATIC39 Treiber Queue INJ" UBYTE FORMULA_0228 0 0 0.0 15.0 ECU_ADDRESS 0x3FBEE4 BIT_MASK 0xF /end MEASUREMENT
/begin MEASUREMENT diag_st_atic35_nn "Diagnosestatus ATIC35 Treiber Queue INJ" UBYTE FORMULA_0228 0 0 0.0 15.0 ECU_ADDRESS 0x3FBEE5 BIT_MASK 0xF /end MEASUREMENT
/begin MEASUREMENT diag_st_atic35_NWE1 "Diagnosestatus ATIC35 Treiber Queue INJ" UBYTE FORMULA_0228 0 0 0.0 15.0 ECU_ADDRESS 0x3FBEE6 BIT_MASK 0xF /end MEASUREMENT
/begin MEASUREMENT diag_st_atic35_NWA1 "Diagnosestatus ATIC35 Treiber Queue INJ" UBYTE FORMULA_0228 0 0 0.0 15.0 ECU_ADDRESS 0x3FBEE7 BIT_MASK 0xF /end MEASUREMENT
/begin MEASUREMENT diag_st_atic35_VANOSDSV "Diagnosestatus ATIC35 Treiber Queue INJ" UBYTE FORMULA_0228 0 0 0.0 15.0 ECU_ADDRESS 0x3FBEE8 BIT_MASK 0xF /end MEASUREMENT
/begin MEASUREMENT diag_st_atic35_AKL "Diagnosestatus ATIC35 Treiber Queue INJ" UBYTE FORMULA_0228 0 0 0.0 15.0 ECU_ADDRESS 0x3FBEE9 BIT_MASK 0xF /end MEASUREMENT
/begin MEASUREMENT diag_st_atic35_NWE2 "Diagnosestatus ATIC35 Treiber Queue INJ" UBYTE FORMULA_0228 0 0 0.0 15.0 ECU_ADDRESS 0x3FBEEA BIT_MASK 0xF /end MEASUREMENT
/begin MEASUREMENT diag_st_atic35_NWA2 "Diagnosestatus ATIC35 Treiber Queue INJ" UBYTE FORMULA_0228 0 0 0.0 15.0 ECU_ADDRESS 0x3FBEEB BIT_MASK 0xF /end MEASUREMENT
/begin MEASUREMENT diag_st_atic35_EVAP2 "Diagnosestatus ATIC35 Treiber Queue INJ" UBYTE FORMULA_0228 0 0 0.0 15.0 ECU_ADDRESS 0x3FBEEC BIT_MASK 0xF /end MEASUREMENT
/begin MEASUREMENT diag_st_atic35_SERVO_EVAP1 "Diagnosestatus ATIC35 Treiber Queue INJ" UBYTE FORMULA_0228 0 0 0.0 15.0 ECU_ADDRESS 0x3FBEED BIT_MASK 0xF /end MEASUREMENT
/begin MEASUREMENT diag_st_atic35_EKP "Diagnosestatus ATIC35 Treiber Queue INJ" UBYTE FORMULA_0228 0 0 0.0 15.0 ECU_ADDRESS 0x3FBEEE BIT_MASK 0xF /end MEASUREMENT
/begin MEASUREMENT diag_st_atic35_TD "Diagnosestatus ATIC35 Treiber Queue INJ" UBYTE FORMULA_0228 0 0 0.0 15.0 ECU_ADDRESS 0x3FBEEF BIT_MASK 0xF /end MEASUREMENT
/begin MEASUREMENT diag_st_atic35_SPORTLED "Diagnosestatus ATIC35 Treiber Queue INJ" UBYTE FORMULA_0228 0 0 0.0 15.0 ECU_ADDRESS 0x3FBEF0 BIT_MASK 0xF /end MEASUREMENT
/begin MEASUREMENT diag_st_atic35_KLIMA "Diagnosestatus ATIC35 Treiber Queue INJ" UBYTE FORMULA_0228 0 0 0.0 15.0 ECU_ADDRESS 0x3FBEF1 BIT_MASK 0xF /end MEASUREMENT
/begin MEASUREMENT diag_tr_atic39_st "Diagnosetreiberstatus" UBYTE FORMULA_0634 0 0 0.0 255.0 ECU_ADDRESS 0x3FBEF2 /end MEASUREMENT
/begin MEASUREMENT diag_tr_atic35_st "Diagnosetreiberstatus" UBYTE FORMULA_0634 0 0 0.0 255.0 ECU_ADDRESS 0x3FBEF3 /end MEASUREMENT
/* ------------------ Abschnitt erzeugt aus fplau.dat ------------------ */
/begin CHARACTERISTIC K_FPLAU_OBD_CFG "Freigabe Bit f�r die Plausibilit�tsdiagnose | EN: Enable bit for the plausibility diagnosis" VALUE 0x7215E TKW_VV_VV_UB 100.0 FORMULA_0712 0.0 255.0 /end CHARACTERISTIC
/begin CHARACTERISTIC K_FPLAU_OBD_TMOT_MIN "K�hlwassertemperaturschwelle zum Aktiveren der Diagnose " VALUE 0x72160 TKW_VV_VV_SW 100.0 FORMULA_0023 -50.0000 170.0000 FORMAT "%4.1" /end CHARACTERISTIC
/begin CHARACTERISTIC K_FPLAU_OBD_T_MIN "Diagnose Sperrzeit nach Motor Start | EN: Diagnose Sperrzeit nach Motor Start" VALUE 0x72162 TKW_VV_VV_UW 100.0 FORMULA_0073 0.0 6553.5000 FORMAT "%4.1" /end CHARACTERISTIC
/begin CHARACTERISTIC K_FPLAU_OBD_N_MIN "Minimale Motordrehzahl zum Aktiveren der Diagnose | EN: Minimale Motordrehzahl zum Aktiveren der Diagnose" VALUE 0x72164 TKW_VV_VV_SW 100.0 FORMULA_0006 0.0 10000.0000 /end CHARACTERISTIC
/begin CHARACTERISTIC K_FPLAU_OBD_N_MAX "Maximale Motordrehzahl zum Aktiveren der Diagnose | EN: Maximale Motordrehzahl  zum Aktiveren der Diagnose" VALUE 0x72166 TKW_VV_VV_SW 100.0 FORMULA_0006 0.0 10000.0000 /end CHARACTERISTIC
/begin CHARACTERISTIC K_FPLAU_OBD_T_MAX "Maximale Zeit, in der die Abweichung anliegen muss, bis ein Fehler eingetragen wird | EN: Maximale Zeit, in der die Abwe i- chung anliegen muss, bis ein Fehler eingetragen wird" VALUE 0x72168 TKW_VV_VV_UW 100.0 FORMULA_0073 0.0 6553.5000 FORMAT "%4.1" /end CHARACTERISTIC
/begin CHARACTERISTIC K_FPLAU_OBD_T_DELTA "Zeit nach der die Diagnose als IO betrachtet wird | EN: Zeit nach der die Diagnose als IO betrachtet wird Luftmassenmesser/ Saugrohrdrucksensor Plausibilitä" VALUE 0x7216A TKW_VV_VV_UW 100.0 FORMULA_0073 0.0 6553.5000 FORMAT "%4.1" /end CHARACTERISTIC
/begin CHARACTERISTIC K_FPLAU_HFM_OBD_CNT "Fehlerschwelle, wenn �berschritten erfolgt ein Fehlereintrag | EN: Fehlerschwelle, wenn ï¿½berschritten erfolgt ein Fehlereintrag" VALUE 0x7216C TKW_VV_VV_UB 100.0 FORMULA_0003 0.0 255.0000 /end CHARACTERISTIC
/begin CHARACTERISTIC K_FPLAU_LAM_OBD_CNT "Fehlerschwelle, wenn �berschritten erfolgt ein Fehlereintrag | EN: Fehlerschwelle, wenn überschri t-ten erfolgt ein Fehlereintrag" VALUE 0x7216D TKW_VV_VV_UB 100.0 FORMULA_0003 0.0 255.0000 /end CHARACTERISTIC
/begin CHARACTERISTIC K_FPLAU_AQ_OBD_CNT "Fehlerschwelle, wenn �berschritten erfolgt ein Fehlereintrag | EN: Fehlerschwelle, wenn überschri t-ten erfolgt ein Fehlereintrag" VALUE 0x7216E TKW_VV_VV_UB 100.0 FORMULA_0003 0.0 255.0000 /end CHARACTERISTIC
/begin CHARACTERISTIC K_FPLAU_OBD_DYN_DELTA_RF "Dynamikschwelle RF | EN: Dynamikschwelle RF" VALUE 0x72170 TKW_VV_VV_SW 100.0 FORMULA_0007 0.0 2.0000 FORMAT "%6.3" /end CHARACTERISTIC
/begin CHARACTERISTIC K_FPLAU_OBD_DYN_RF_T "Zeit nach Dynamikabbruch durch rf, bevor die Diagnose weiterlaeuft | EN: Zeit nach Dynamikabbruch durch rf, bevor die Diagnose weiterlaeuft" VALUE 0x72172 TKW_VV_VV_UW 100.0 FORMULA_0021 0.0 655.0000 FORMAT "%5.2" /end CHARACTERISTIC
/begin CHARACTERISTIC K_FPLAU_OBD_ML_MIN "Minimale Luftmasse zum Aktiveren der Diagnose" VALUE 0x72174 TKW_VV_VV_SW 100.0 FORMULA_0112 -100.0000 1400.0000 FORMAT "%4.1" /end CHARACTERISTIC
/begin CHARACTERISTIC K_FPLAU_OBD_ML_MAX "Maximale Luftmasse zum Aktiveren der Diagnose | EN: Maximale Luftmasse zum Aktiv e-ren der Diagnose" VALUE 0x72176 TKW_VV_VV_SW 100.0 FORMULA_0112 -100.0000 1400.0000 FORMAT "%4.1" /end CHARACTERISTIC
/begin CHARACTERISTIC K_FPLAU_OBD_FR_ADAP_F "Aufweitungsfaktor wenn FR noch nicht eingeregelt" VALUE 0x72178 TKW_VV_VV_UW 100.0 FORMULA_0075 0.0 4.0000 FORMAT "%6.3" /end CHARACTERISTIC
/begin CHARACTERISTIC K_FPLAU_OBD_KH_F "Aufweitungsfaktor bei KH" VALUE 0x7217A TKW_VV_VV_UW 100.0 FORMULA_0075 0.0 4.0000 FORMAT "%6.3" /end CHARACTERISTIC
/begin CHARACTERISTIC K_FPLAU_OBD_TMOT_CSS "Temperaturschwelle CSS TMOT" VALUE 0x7217C TKW_VV_VV_SW 100.0 FORMULA_0023 -50.0000 150.0000 FORMAT "%4.1" /end CHARACTERISTIC
/begin CHARACTERISTIC K_FPLAU_OBD_PUMG_CSS "PUMG Schwelle fuer CSS" VALUE 0x7217E TKW_VV_VV_SW 100.0 FORMULA_0077 400.0000 1200.0000 FORMAT "%4.1" /end CHARACTERISTIC
/begin CHARACTERISTIC KF_FPLAU_OBD_HFM_DELTA_ML_MAX "Max. erlaubte Abweichung | EN: Maximum permitted deviation" MAP 0x72180 TKF_SW_SW_SW 100.0 FORMULA_0709 -200.0000 255.0000 /begin AXIS_DESCR STD_AXIS n FORMULA_0006 8 0.0 10000.0000 /end AXIS_DESCR /begin AXIS_DESCR STD_AXIS rf_m FORMULA_0007 8 0.0 2.0000 FORMAT "%6.3" /end AXIS_DESCR FORMAT "%4.1" /end CHARACTERISTIC
/begin CHARACTERISTIC KF_FPLAU_OBD_AQ_DELTA_ML_MAX "Max. erlaubte Abweichung | EN: Maximum permitted deviation" MAP 0x72222 TKF_SW_SW_SW 100.0 FORMULA_0709 -200.0000 255.0000 /begin AXIS_DESCR STD_AXIS n FORMULA_0006 8 0.0 10000.0000 /end AXIS_DESCR /begin AXIS_DESCR STD_AXIS rf_m FORMULA_0007 8 0.0 2.0000 FORMAT "%6.3" /end AXIS_DESCR FORMAT "%4.1" /end CHARACTERISTIC
/begin CHARACTERISTIC KF_FPLAU_OBD_LAM_DELTA_ML_MAX "Max. erlaubte Abweichung" MAP 0x722C4 TKF_SW_SW_SW 100.0 FORMULA_0709 -200.0000 255.0000 /begin AXIS_DESCR STD_AXIS n FORMULA_0006 3 0.0 10000.0000 /end AXIS_DESCR /begin AXIS_DESCR STD_AXIS rf_m FORMULA_0007 8 0.0 2.0000 FORMAT "%6.3" /end AXIS_DESCR FORMAT "%4.1" /end CHARACTERISTIC
/begin MEASUREMENT fplau_st_b1 "FPLAUSI Diagnose" ULONG FORMULA_0686 0 0 0.0 4294967295.0 ECU_ADDRESS 0x3FBFB8 /end MEASUREMENT
/begin MEASUREMENT fplau_st_b2 "FPLAUSI Diagnose" ULONG FORMULA_0686 0 0 0.0 4294967295.0 ECU_ADDRESS 0x3FBFBC /end MEASUREMENT
/begin MEASUREMENT fplau_st_tmot_b1 "tmot ueber Schwelle" ULONG FORMULA_0687 0 0 0.0 4294967295.0 ECU_ADDRESS 0x3FBFB8 BIT_MASK 0x1 /end MEASUREMENT
/begin MEASUREMENT fplau_st_tmot_b2 "tmot ueber Schwelle" ULONG FORMULA_0687 0 0 0.0 4294967295.0 ECU_ADDRESS 0x3FBFBC BIT_MASK 0x1 /end MEASUREMENT
/begin MEASUREMENT fplau_st_rfdyn_b1 "RF Dynamik nicht aktive" ULONG FORMULA_0688 0 0 0.0 4294967295.0 ECU_ADDRESS 0x3FBFB8 BIT_MASK 0x2 /end MEASUREMENT
/begin MEASUREMENT fplau_st_rfdyn_b2 "RF Dynamik nicht aktive" ULONG FORMULA_0688 0 0 0.0 4294967295.0 ECU_ADDRESS 0x3FBFBC BIT_MASK 0x2 /end MEASUREMENT
/begin MEASUREMENT fplau_st_ndyn_b1 "N-Dynamik nicht aktive" ULONG FORMULA_0689 0 0 0.0 4294967295.0 ECU_ADDRESS 0x3FBFB8 BIT_MASK 0x4 /end MEASUREMENT
/begin MEASUREMENT fplau_st_ndyn_b2 "N-Dynamik nicht aktive" ULONG FORMULA_0689 0 0 0.0 4294967295.0 ECU_ADDRESS 0x3FBFBC BIT_MASK 0x4 /end MEASUREMENT
/begin MEASUREMENT fplau_st_time_ml_b1 "time_ml ueber Schwelle" ULONG FORMULA_0690 0 0 0.0 4294967295.0 ECU_ADDRESS 0x3FBFB8 BIT_MASK 0x8 /end MEASUREMENT
/begin MEASUREMENT fplau_st_time_ml_b2 "time_ml ueber Schwelle" ULONG FORMULA_0690 0 0 0.0 4294967295.0 ECU_ADDRESS 0x3FBFBC BIT_MASK 0x8 /end MEASUREMENT
/begin MEASUREMENT fplau_st_n_min_b1 "n < Schwelle" ULONG FORMULA_0691 0 0 0.0 4294967295.0 ECU_ADDRESS 0x3FBFB8 BIT_MASK 0x10 /end MEASUREMENT
/begin MEASUREMENT fplau_st_n_min_b2 "n < Schwelle" ULONG FORMULA_0691 0 0 0.0 4294967295.0 ECU_ADDRESS 0x3FBFBC BIT_MASK 0x10 /end MEASUREMENT
/begin MEASUREMENT fplau_st_n_max_b1 "n > Schwelle" ULONG FORMULA_0692 0 0 0.0 4294967295.0 ECU_ADDRESS 0x3FBFB8 BIT_MASK 0x20 /end MEASUREMENT
/begin MEASUREMENT fplau_st_n_max_b2 "n > Schwelle" ULONG FORMULA_0692 0 0 0.0 4294967295.0 ECU_ADDRESS 0x3FBFBC BIT_MASK 0x20 /end MEASUREMENT
/begin MEASUREMENT fplau_st_obd_mw_min_b1 "fplau_ml_obd_mw2 > Min Schwelle" ULONG FORMULA_0693 0 0 0.0 4294967295.0 ECU_ADDRESS 0x3FBFB8 BIT_MASK 0x40 /end MEASUREMENT
/begin MEASUREMENT fplau_st_obd_mw_min_b2 "fplau_ml_obd_mw2 > Min Schwelle" ULONG FORMULA_0693 0 0 0.0 4294967295.0 ECU_ADDRESS 0x3FBFBC BIT_MASK 0x40 /end MEASUREMENT
/begin MEASUREMENT fplau_st_obd_mw_max_b1 "fplau_ml_obd_mw2 < Max Schwelle" ULONG FORMULA_0694 0 0 0.0 4294967295.0 ECU_ADDRESS 0x3FBFB8 BIT_MASK 0x80 /end MEASUREMENT
/begin MEASUREMENT fplau_st_obd_mw_max_b2 "fplau_ml_obd_mw2 < Max Schwelle" ULONG FORMULA_0694 0 0 0.0 4294967295.0 ECU_ADDRESS 0x3FBFBC BIT_MASK 0x80 /end MEASUREMENT
/begin MEASUREMENT fplau_st_hfm_b1 "HFM  I.O." ULONG FORMULA_0695 0 0 0.0 4294967295.0 ECU_ADDRESS 0x3FBFB8 BIT_MASK 0x100 /end MEASUREMENT
/begin MEASUREMENT fplau_st_hfm_b2 "HFM  I.O." ULONG FORMULA_0695 0 0 0.0 4294967295.0 ECU_ADDRESS 0x3FBFBC BIT_MASK 0x100 /end MEASUREMENT
/begin MEASUREMENT fplau_st_lam_b1 "LAMBDA  I.O." ULONG FORMULA_0696 0 0 0.0 4294967295.0 ECU_ADDRESS 0x3FBFB8 BIT_MASK 0x200 /end MEASUREMENT
/begin MEASUREMENT fplau_st_lam_b2 "LAMBDA  I.O." ULONG FORMULA_0696 0 0 0.0 4294967295.0 ECU_ADDRESS 0x3FBFBC BIT_MASK 0x200 /end MEASUREMENT
/begin MEASUREMENT fplau_st_egas_wdk_b1 "EGAS WDK I.O." ULONG FORMULA_0697 0 0 0.0 4294967295.0 ECU_ADDRESS 0x3FBFB8 BIT_MASK 0x400 /end MEASUREMENT
/begin MEASUREMENT fplau_st_egas_wdk_b2 "EGAS WDK I.O." ULONG FORMULA_0697 0 0 0.0 4294967295.0 ECU_ADDRESS 0x3FBFBC BIT_MASK 0x400 /end MEASUREMENT
/begin MEASUREMENT fplau_st_egas_dk_b1 "EGAS DK I.O." ULONG FORMULA_0698 0 0 0.0 4294967295.0 ECU_ADDRESS 0x3FBFB8 BIT_MASK 0x800 /end MEASUREMENT
/begin MEASUREMENT fplau_st_egas_dk_b2 "EGAS DK I.O." ULONG FORMULA_0698 0 0 0.0 4294967295.0 ECU_ADDRESS 0x3FBFBC BIT_MASK 0x800 /end MEASUREMENT
/begin MEASUREMENT fplau_st_vanos_b1 "VANOS I.O." ULONG FORMULA_0699 0 0 0.0 4294967295.0 ECU_ADDRESS 0x3FBFB8 BIT_MASK 0x1000 /end MEASUREMENT
/begin MEASUREMENT fplau_st_vanos_b2 "VANOS I.O." ULONG FORMULA_0699 0 0 0.0 4294967295.0 ECU_ADDRESS 0x3FBFBC BIT_MASK 0x1000 /end MEASUREMENT
/begin MEASUREMENT fplau_st_lls_b1 "LLS I.O." ULONG FORMULA_0700 0 0 0.0 4294967295.0 ECU_ADDRESS 0x3FBFB8 BIT_MASK 0x2000 /end MEASUREMENT
/begin MEASUREMENT fplau_st_lls_b2 "LLS I.O." ULONG FORMULA_0700 0 0 0.0 4294967295.0 ECU_ADDRESS 0x3FBFBC BIT_MASK 0x2000 /end MEASUREMENT
/begin MEASUREMENT fplau_st_pumg_b1 "pumg I.O." ULONG FORMULA_0701 0 0 0.0 4294967295.0 ECU_ADDRESS 0x3FBFB8 BIT_MASK 0x4000 /end MEASUREMENT
/begin MEASUREMENT fplau_st_pumg_b2 "pumg I.O." ULONG FORMULA_0701 0 0 0.0 4294967295.0 ECU_ADDRESS 0x3FBFBC BIT_MASK 0x4000 /end MEASUREMENT
/begin MEASUREMENT fplau_st_tan_b1 "tan I.O." ULONG FORMULA_0702 0 0 0.0 4294967295.0 ECU_ADDRESS 0x3FBFB8 BIT_MASK 0x8000 /end MEASUREMENT
/begin MEASUREMENT fplau_st_tan_b2 "tan I.O." ULONG FORMULA_0702 0 0 0.0 4294967295.0 ECU_ADDRESS 0x3FBFBC BIT_MASK 0x8000 /end MEASUREMENT
/begin MEASUREMENT fplau_st_sa_b1 "kein SA" ULONG FORMULA_0703 0 0 0.0 4294967295.0 ECU_ADDRESS 0x3FBFB8 BIT_MASK 0x10000 /end MEASUREMENT
/begin MEASUREMENT fplau_st_sa_b2 "kein SA" ULONG FORMULA_0703 0 0 0.0 4294967295.0 ECU_ADDRESS 0x3FBFBC BIT_MASK 0x10000 /end MEASUREMENT
/begin MEASUREMENT fplau_st_diagk_b1 "K_FPLAU_OBD_CFG -> aus" ULONG FORMULA_0704 0 0 0.0 4294967295.0 ECU_ADDRESS 0x3FBFB8 BIT_MASK 0x40000 /end MEASUREMENT
/begin MEASUREMENT fplau_st_diagk_b2 "K_FPLAU_OBD_CFG -> aus" ULONG FORMULA_0704 0 0 0.0 4294967295.0 ECU_ADDRESS 0x3FBFBC BIT_MASK 0x40000 /end MEASUREMENT
/begin MEASUREMENT fplau_st_css_b1 "keine ColdStartStrategie aktive" ULONG FORMULA_0705 0 0 0.0 4294967295.0 ECU_ADDRESS 0x3FBFB8 BIT_MASK 0x80000 /end MEASUREMENT
/begin MEASUREMENT fplau_st_css_b2 "keine ColdStartStrategie aktive" ULONG FORMULA_0705 0 0 0.0 4294967295.0 ECU_ADDRESS 0x3FBFBC BIT_MASK 0x80000 /end MEASUREMENT
/begin MEASUREMENT fplau_st_zyl_off_b1 "keine Zylinderausblendung" ULONG FORMULA_0706 0 0 0.0 4294967295.0 ECU_ADDRESS 0x3FBFB8 BIT_MASK 0x100000 /end MEASUREMENT
/begin MEASUREMENT fplau_st_zyl_off_b2 "keine Zylinderausblendung" ULONG FORMULA_0706 0 0 0.0 4294967295.0 ECU_ADDRESS 0x3FBFBC BIT_MASK 0x100000 /end MEASUREMENT
/begin MEASUREMENT fplau_st_wdk_adapt_b1 "WDK Adaption" ULONG FORMULA_0707 0 0 0.0 4294967295.0 ECU_ADDRESS 0x3FBFB8 BIT_MASK 0x200000 /end MEASUREMENT
/begin MEASUREMENT fplau_st_wdk_adapt_b2 "WDK Adaption" ULONG FORMULA_0707 0 0 0.0 4294967295.0 ECU_ADDRESS 0x3FBFBC BIT_MASK 0x200000 /end MEASUREMENT
/begin MEASUREMENT fplau_st_van_begr_b1 "Vanosbegrenzung aktive" ULONG FORMULA_0708 0 0 0.0 4294967295.0 ECU_ADDRESS 0x3FBFB8 BIT_MASK 0x400000 /end MEASUREMENT
/begin MEASUREMENT fplau_st_van_begr_b2 "Vanosbegrenzung aktive" ULONG FORMULA_0708 0 0 0.0 4294967295.0 ECU_ADDRESS 0x3FBFBC BIT_MASK 0x400000 /end MEASUREMENT
/begin MEASUREMENT fplau_hfm_obd_b1.abw "Prozentuale Abweichung des Luftmassenwertes vom MW" SWORD FORMULA_0709 0 0 -200.0000 200.0000 ECU_ADDRESS 0x3FBFC2 /end MEASUREMENT
/begin MEASUREMENT fplau_hfm_obd_b2.abw "Prozentuale Abweichung des Luftmassenwertes vom MW" SWORD FORMULA_0709 0 0 -200.0000 200.0000 ECU_ADDRESS 0x3FBFCC /end MEASUREMENT
/begin MEASUREMENT fplau_hfm_obd_b1.cnt "Fehlerz�hler Diagnose negativ" UWORD FORMULA_0010 0 0 0.0 65535.0000 ECU_ADDRESS 0x3FBFC4 /end MEASUREMENT
/begin MEASUREMENT fplau_hfm_obd_b2.cnt "Fehlerz�hler Diagnose negativ" UWORD FORMULA_0010 0 0 0.0 65535.0000 ECU_ADDRESS 0x3FBFCE /end MEASUREMENT
/begin MEASUREMENT fplau_hfm_obd_b1.t "Zeit seit aktueller Diagnosezyklus negativ" UWORD FORMULA_0073 0 0 0.0 6553.5000 ECU_ADDRESS 0x3FBFC6 /end MEASUREMENT
/begin MEASUREMENT fplau_hfm_obd_b2.t "Zeit seit aktueller Diagnosezyklus negativ" UWORD FORMULA_0073 0 0 0.0 6553.5000 ECU_ADDRESS 0x3FBFD0 /end MEASUREMENT
/begin MEASUREMENT fplau_hfm_obd_b1.st "Fuellungsplausibilitaets Statusbyte" UBYTE FORMULA_0710 0 0 0.0 255.0 ECU_ADDRESS 0x3FBFC8 /end MEASUREMENT
/begin MEASUREMENT fplau_hfm_obd_b2.st "Fuellungsplausibilitaets Statusbyte" UBYTE FORMULA_0710 0 0 0.0 255.0 ECU_ADDRESS 0x3FBFD2 /end MEASUREMENT
/begin MEASUREMENT fplau_lam_obd_b1.abw "Prozentuale Abweichung des Luftmassenwertes vom MW" SWORD FORMULA_0709 0 0 -200.0000 200.0000 ECU_ADDRESS 0x3FBFD6 /end MEASUREMENT
/begin MEASUREMENT fplau_lam_obd_b2.abw "Prozentuale Abweichung des Luftmassenwertes vom MW" SWORD FORMULA_0709 0 0 -200.0000 200.0000 ECU_ADDRESS 0x3FBFE0 /end MEASUREMENT
/begin MEASUREMENT fplau_lam_obd_b1.cnt "Fehlerz�hler Diagnose negativ" UWORD FORMULA_0010 0 0 0.0 65535.0000 ECU_ADDRESS 0x3FBFD8 /end MEASUREMENT
/begin MEASUREMENT fplau_lam_obd_b2.cnt "Fehlerz�hler Diagnose negativ" UWORD FORMULA_0010 0 0 0.0 65535.0000 ECU_ADDRESS 0x3FBFE2 /end MEASUREMENT
/begin MEASUREMENT fplau_lam_obd_b1.t "Zeit seit aktueller Diagnosezyklus negativ" UWORD FORMULA_0073 0 0 0.0 6553.5000 ECU_ADDRESS 0x3FBFDA /end MEASUREMENT
/begin MEASUREMENT fplau_lam_obd_b2.t "Zeit seit aktueller Diagnosezyklus negativ" UWORD FORMULA_0073 0 0 0.0 6553.5000 ECU_ADDRESS 0x3FBFE4 /end MEASUREMENT
/begin MEASUREMENT fplau_lam_obd_b1.st "Fuellungsplausibilitaets Statusbyte" UBYTE FORMULA_0711 0 0 0.0 255.0 ECU_ADDRESS 0x3FBFDC /end MEASUREMENT
/begin MEASUREMENT fplau_lam_obd_b2.st "Fuellungsplausibilitaets Statusbyte" UBYTE FORMULA_0711 0 0 0.0 255.0 ECU_ADDRESS 0x3FBFE6 /end MEASUREMENT
/begin MEASUREMENT fplau_aq_obd_b1.abw "Prozentuale Abweichung des Luftmassenwertes vom MW" SWORD FORMULA_0709 0 0 -200.0000 200.0000 ECU_ADDRESS 0x3FBFEA /end MEASUREMENT
/begin MEASUREMENT fplau_aq_obd_b2.abw "Prozentuale Abweichung des Luftmassenwertes vom MW" SWORD FORMULA_0709 0 0 -200.0000 200.0000 ECU_ADDRESS 0x3FBFF4 /end MEASUREMENT
/begin MEASUREMENT fplau_aq_obd_b1.cnt "Fehlerz�hler Diagnose negativ" UWORD FORMULA_0010 0 0 0.0 65535.0000 ECU_ADDRESS 0x3FBFEC /end MEASUREMENT
/begin MEASUREMENT fplau_aq_obd_b2.cnt "Fehlerz�hler Diagnose negativ" UWORD FORMULA_0010 0 0 0.0 65535.0000 ECU_ADDRESS 0x3FBFF6 /end MEASUREMENT
/begin MEASUREMENT fplau_aq_obd_b1.t "Zeit seit aktueller Diagnosezyklus negativ" UWORD FORMULA_0073 0 0 0.0 6553.5000 ECU_ADDRESS 0x3FBFEE /end MEASUREMENT
/begin MEASUREMENT fplau_aq_obd_b2.t "Zeit seit aktueller Diagnosezyklus negativ" UWORD FORMULA_0073 0 0 0.0 6553.5000 ECU_ADDRESS 0x3FBFF8 /end MEASUREMENT
/begin MEASUREMENT fplau_aq_obd_b1.st "Fuellungsplausibilitaets Statusbyte" UBYTE FORMULA_0710 0 0 0.0 255.0 ECU_ADDRESS 0x3FBFF0 /end MEASUREMENT
/begin MEASUREMENT fplau_aq_obd_b2.st "Fuellungsplausibilitaets Statusbyte" UBYTE FORMULA_0710 0 0 0.0 255.0 ECU_ADDRESS 0x3FBFFA /end MEASUREMENT
/begin MEASUREMENT fplau_ml_obd_mw3_b1 "OBD ist doof!!!!" SWORD FORMULA_0112 0 0 -100.0000 1400.0000 ECU_ADDRESS 0x3FBFFC /end MEASUREMENT
/begin MEASUREMENT fplau_ml_obd_mw3_b2 "OBD ist doof!!!!" SWORD FORMULA_0112 0 0 -100.0000 1400.0000 ECU_ADDRESS 0x3FBFFE /end MEASUREMENT
/begin MEASUREMENT fplau_ml_obd_mw2_b1 "Mittelwert2 (IO-Quellen)" SWORD FORMULA_0112 0 0 -100.0000 1400.0000 ECU_ADDRESS 0x3FC000 /end MEASUREMENT
/begin MEASUREMENT fplau_ml_obd_mw2_b2 "Mittelwert2 (IO-Quellen)" SWORD FORMULA_0112 0 0 -100.0000 1400.0000 ECU_ADDRESS 0x3FC002 /end MEASUREMENT
/begin MEASUREMENT fplau_obd_t_delta_b1 "Zeit seit der die Diangose positiv lauft" UWORD FORMULA_0073 0 0 0.0 6553.5000 ECU_ADDRESS 0x3FC004 /end MEASUREMENT
/begin MEASUREMENT fplau_obd_t_delta_b2 "Zeit seit der die Diangose positiv lauft" UWORD FORMULA_0073 0 0 0.0 6553.5000 ECU_ADDRESS 0x3FC006 /end MEASUREMENT
/* ------------------ Abschnitt erzeugt aus la_trim.dat ------------------ */
/begin CHARACTERISTIC K_LA_TRIM_CFG "Freigabe Trimmregelung | EN: 0x0 inaktiv 0x1 aktiv 0x2 RESET Freigabe Trimmregelung" VALUE 0x72ED6 TKW_VV_VV_UW 100.0 FORMULA_0923 0.0 1.0 FORMAT "%5.2" /end CHARACTERISTIC
/begin CHARACTERISTIC K_LA_TRIM_FKT_CFG "Auswahl Trimmregelung-Fkt. | EN: Selection of trim-control function" VALUE 0x72ED8 TKW_VV_VV_UW 100.0 FORMULA_0924 1.0 16.0 BIT_MASK 0xF FORMAT "%5.2" /end CHARACTERISTIC
/begin CHARACTERISTIC K_LA_TRIM_DIAG_CFG "Freigabe Trimmregelungsdiagnose | EN: 0 inaktiv 1 aktiv Freigabe Trimmregelungsdiagnose" VALUE 0x72EDA TKW_VV_VV_UW 100.0 FORMULA_0798 0.0 1.0 FORMAT "%5.2" /end CHARACTERISTIC
/begin CHARACTERISTIC K_LA_TRIM_RF_HYS "Hsysterese f. relative F�llung - LA-TRIM | EN: Hsysterese f. relative Füllung - LA-TRIM" VALUE 0x72EDC TKW_VV_VV_SW 100.0 FORMULA_0007 0.0 2.0000 FORMAT "%6.3" /end CHARACTERISTIC
/begin CHARACTERISTIC K_LA_TRIM_TABG_NKAT "min. NKAT-Abgastemperatur | EN: min. NKAT-Abgastemperatur" VALUE 0x72EDE TKW_VV_VV_SW 100.0 FORMULA_0023 -50.0000 1250.0000 FORMAT "%4.1" /end CHARACTERISTIC
/begin CHARACTERISTIC K_LA_TRIM_TE_C_AKF_MAX "max. Konzentration aus AKF | EN: max. Konzentration aus AKF" VALUE 0x72EE0 TKW_VV_VV_UW 100.0 FORMULA_0556 0.0 2.0000 FORMAT "%7.4" /end CHARACTERISTIC
/begin CHARACTERISTIC K_LA_TRIM_LAA_F_TE "max. TE-Offset auf LAA-Faktor" VALUE 0x72EE2 TKW_VV_VV_SW 100.0 FORMULA_0024 -1.0000 0.9999 FORMAT "%7.4" /end CHARACTERISTIC
/begin CHARACTERISTIC K_LA_TRIM_P_MAX "max. P-Anteil der Trimmregelung | EN: -2p     max. P-Anteil der Trimmregelung" VALUE 0x72EE4 TKW_VV_VV_SW 100.0 FORMULA_0025 -2.0000 1.9990 FORMAT "%6.3" /end CHARACTERISTIC
/begin CHARACTERISTIC K_LA_TRIM_P_MIN "min. P-Anteil der Trimmregelung | EN: -2p     min. P-Anteil der Trimmregelung" VALUE 0x72EE6 TKW_VV_VV_SW 100.0 FORMULA_0025 -2.0000 1.9990 FORMAT "%6.3" /end CHARACTERISTIC
/begin CHARACTERISTIC K_LA_TRIM_US_EINGER "Hys.-Spannung f. I-Regler-STOP | EN: Hys.-Spannung f. I-Regler-STOP" VALUE 0x72EE8 TKW_VV_VV_UW 100.0 FORMULA_0532 0.0 1200.0000 /end CHARACTERISTIC
/begin CHARACTERISTIC K_LA_TRIM_US_EINGESCHW "Hys.-Sp.-Erkennung Signal eingeschw. | EN: Hysteresis voltage detection, signal settled [mV]" VALUE 0x72EEA TKW_VV_VV_UW 100.0 FORMULA_0532 0.0 1200.0000 /end CHARACTERISTIC
/begin CHARACTERISTIC K_LA_TRIM_US_O2_MAX "Hysterese f. Freigabe O2-Beladung (obere Schwelle) | EN: Hysterese f. Freigabe O2-Beladung (obere Schwelle)" VALUE 0x72EEC TKW_VV_VV_UW 100.0 FORMULA_0532 0.0 1200.0000 /end CHARACTERISTIC
/begin CHARACTERISTIC K_LA_TRIM_US_O2_MIN "Hysterese f. Freigabe O2-Beladung (untere Schwelle) | EN: Hysterese f. Freigabe O2-Beladung (untere Schwelle)" VALUE 0x72EEE TKW_VV_VV_UW 100.0 FORMULA_0532 0.0 1200.0000 /end CHARACTERISTIC
/begin CHARACTERISTIC K_LA_TRIM_DYN_DELTA_RF "RF-Delta fur Freigabe Trimmregelung | EN: RF-Delta fur Freigabe Trimmregelung" VALUE 0x72EF0 TKW_VV_VV_SW 100.0 FORMULA_0007 0.0 2.0000 FORMAT "%6.3" /end CHARACTERISTIC
/begin CHARACTERISTIC K_LA_TRIM_DYN_RF_T "Sperrzeit f�r Trimmregelung nach rf-Dynamik | EN: Sperrzeit für Trimmregelung nach rf-Dynamik" VALUE 0x72EF2 TKW_VV_VV_UW 100.0 FORMULA_0021 0.0 655.0000 FORMAT "%5.2" /end CHARACTERISTIC
/begin CHARACTERISTIC K_LA_TRIM_I_GMW_DLY "Verz.-Zeit nach Eintitt ins I-GMW-Band | EN: Delay time after entering the integral mean-value band [s]" VALUE 0x72EF4 TKW_VV_VV_UW 100.0 FORMULA_0925 0.0 65535.0000 FORMAT "%5.2" /end CHARACTERISTIC
/begin CHARACTERISTIC K_LA_TRIM_DYN_T "Verz.-Zeit nach begr. Dyn | EN: Verz.-Zeit nach begr. Dyn" VALUE 0x72EF6 TKW_VV_VV_UW 100.0 FORMULA_0021 0.0 655.3500 FORMAT "%5.2" /end CHARACTERISTIC
/begin CHARACTERISTIC K_LA_TRIM_DLY_T "Verz.-Zeit nach Abbruch Trimmregelung | EN: Verz.-Zeit nach Abbruch Trimmregelung" VALUE 0x72EF8 TKW_VV_VV_UW 100.0 FORMULA_0021 0.0 655.3500 FORMAT "%5.2" /end CHARACTERISTIC
/begin CHARACTERISTIC K_LA_TRIM_I_MAX "max. I-Anteil der Trimmregelung | EN: -2p     max. I-Anteil der Trimmregelung" VALUE 0x72EFA TKW_VV_VV_SW 100.0 FORMULA_0025 -2.0000 1.9990 FORMAT "%6.3" /end CHARACTERISTIC
/begin CHARACTERISTIC K_LA_TRIM_I_MIN "min. I-Anteil der Trimmregelung | EN: -2p     min. I-Anteil der Trimmregelung" VALUE 0x72EFC TKW_VV_VV_SW 100.0 FORMULA_0025 -2.0000 1.9990 FORMAT "%6.3" /end CHARACTERISTIC
/begin CHARACTERISTIC K_LA_TRIM_I_GMW_MAX "max. gemittelter I-Anteil der Trimmregelung | EN: Maximum averaged integral share of trim control" VALUE 0x72EFE TKW_VV_VV_SW 100.0 FORMULA_0025 -2.0000 1.9990 FORMAT "%6.3" /end CHARACTERISTIC
/begin CHARACTERISTIC K_LA_TRIM_I_GMW_MIN "min. gemittelter I-Anteil der Trimmregelung | EN: Minimum averaged integral share of trim control" VALUE 0x72F00 TKW_VV_VV_SW 100.0 FORMULA_0025 -2.0000 1.9990 FORMAT "%6.3" /end CHARACTERISTIC
/begin CHARACTERISTIC K_LA_TRIM_I_AD_MAX "max. I-Adaptionsanteil | EN: -2p     max. I-Adaptionsanteil" VALUE 0x72F02 TKW_VV_VV_SW 100.0 FORMULA_0025 -2.0000 1.9990 FORMAT "%6.3" /end CHARACTERISTIC
/begin CHARACTERISTIC K_LA_TRIM_I_AD_MIN "min. I-Adaptionsanteil | EN: -2p     min. I-Adaptionsanteil" VALUE 0x72F04 TKW_VV_VV_SW 100.0 FORMULA_0025 -2.0000 1.9990 FORMAT "%6.3" /end CHARACTERISTIC
/begin CHARACTERISTIC K_LA_TRIM_US_SOLL_GRAD "AEBG. d. SOLL-Spannung | EN: AEBG. d. SOLL-Spannung" VALUE 0x72F06 TKW_VV_VV_UW 100.0 FORMULA_0926 0.0 1200.0000 /end CHARACTERISTIC
/begin CHARACTERISTIC K_LA_TRIM_I_GMW_TAU "Zeitkonstante gem. I-Anteil | EN: Time constant, averaged integral share [s]" VALUE 0x72F08 TKW_VV_VV_UB 100.0 FORMULA_0718 1.0040 256.0000 /end CHARACTERISTIC
/begin CHARACTERISTIC K_LA_TRIM_I_AD_F "Uebernahme I-Anteil in AD-Wert | EN: Uebernahme I-Anteil in AD-Wert" VALUE 0x72F0A TKW_VV_VV_UW 100.0 FORMULA_0001 0.0 100.0000 FORMAT "%4.1" /end CHARACTERISTIC
/begin CHARACTERISTIC K_LA_TRIM_P_ANZ_MAX "max. Anzahl der P-Anteil Triggerungen | EN: max. Anzahl der P-Anteil Triggerungen" VALUE 0x72F0C TKW_VV_VV_UW 100.0 FORMULA_0010 0.0 65535.0000 /end CHARACTERISTIC
/begin CHARACTERISTIC K_LA_TRIM_I_US_DELTA_MIN "OFFSET fuer min. Schwelle d. I-Anteil Ermittlung" VALUE 0x72F0E TKW_VV_VV_UW 100.0 FORMULA_0532 0.0 1200.0000 /end CHARACTERISTIC
/begin CHARACTERISTIC K_LA_TRIM_I_US_DELTA_MAX "OFFSET fuer max. Schwelle d. I-Anteil Ermittlung" VALUE 0x72F10 TKW_VV_VV_UW 100.0 FORMULA_0532 0.0 1200.0000 /end CHARACTERISTIC
/begin CHARACTERISTIC K_LA_TRIM_P_US_OFFSET "OFFSET fuer Verhinderung P-Anteil Toggeln | EN: OFFSET fuer Verhinderung P-Anteil Toggeln" VALUE 0x72F12 TKW_VV_VV_UW 100.0 FORMULA_0532 0.0 1200.0000 /end CHARACTERISTIC
/begin CHARACTERISTIC K_LA_TRIM_DIAG_P_SCHW "Anzahl P-Anteil-Fkt.-Durchlaeufe  | EN: Anzahl P-Anteil-Fkt.-Durchlaeufe" VALUE 0x72F14 TKW_VV_VV_UW 100.0 FORMULA_0010 0.0 65535.0000 /end CHARACTERISTIC
/begin CHARACTERISTIC K_LA_TRIM_DIAG_I_MIN_SCHW "Schwelle f. Anzahl I-Anteil min. Begrenzung | EN: Schwelle f. Anzahl I-Anteil min. Begrenzung" VALUE 0x72F16 TKW_VV_VV_UW 100.0 FORMULA_0010 0.0 65535.0000 /end CHARACTERISTIC
/begin CHARACTERISTIC K_LA_TRIM_DIAG_I_MAX_SCHW "Schwelle f. Anzahl I-Anteil max. Begrenzung | EN: Schwelle f. Anzahl I-Anteil max. Begrenzung" VALUE 0x72F18 TKW_VV_VV_UW 100.0 FORMULA_0010 0.0 65535.0000 /end CHARACTERISTIC
/begin CHARACTERISTIC K_LA_TRIM_DIAG_I_ED_F "Aufweitungsfaktor auf d. I-Anteils-Bereichsgrenzen | EN: Aufweitungsfaktor auf d. I-Anteils-Bereichsgrenzen" VALUE 0x72F1A TKW_VV_VV_UW 100.0 FORMULA_0075 0.0 4.0000 FORMAT "%6.3" /end CHARACTERISTIC
/begin CHARACTERISTIC K_LA_TRIM_TAN_MIN "min. TAN-Schwelle | EN: min. TAN-Schwelle" VALUE 0x72F1C TKW_VV_VV_SW 100.0 FORMULA_0023 -50.0000 170.0000 FORMAT "%4.1" /end CHARACTERISTIC
/begin CHARACTERISTIC K_LA_TRIM_TAN_MAX "max. TAN-Schwelle | EN: max. TAN-Schwelle" VALUE 0x72F1E TKW_VV_VV_SW 100.0 FORMULA_0023 -50.0000 170.0000 FORMAT "%4.1" /end CHARACTERISTIC
/begin CHARACTERISTIC K_LA_TRIM_V_SCHWELLE "max. Geschwindigkeitsschwelle | EN: max. Geschwindigkeitsschwelle" VALUE 0x72F20 TKW_VV_VV_SW 100.0 FORMULA_0078 -80.0000 360.0000 FORMAT "%4.1" /end CHARACTERISTIC
/begin CHARACTERISTIC K_LA_TRIM_DIAG_I_AD_F "Aufweitungsfaktor auf d. I-Adaptionss-Bereichsgrenzen | EN: Aufweitungsfaktor auf d. I-Adaptionss-Bereichsgrenzen" VALUE 0x72F22 TKW_VV_VV_UW 100.0 FORMULA_0075 0.0 4.0000 FORMAT "%6.3" /end CHARACTERISTIC
/begin CHARACTERISTIC K_LA_TRIM_DIAG_I_AD_MIN_SCHW "Schwelle f. Anzahl I-Adaption min. Begrenzung | EN: Schwelle f. Anzahl I-Adaption min. Begrenzung" VALUE 0x72F24 TKW_VV_VV_UW 100.0 FORMULA_0010 0.0 65535.0000 /end CHARACTERISTIC
/begin CHARACTERISTIC K_LA_TRIM_DIAG_I_AD_MAX_SCHW "Schwelle f. Anzahl I-Adaption max. Begrenzung | EN: Schwelle f. Anzahl I-Adaption max. Begrenzung" VALUE 0x72F26 TKW_VV_VV_UW 100.0 FORMULA_0010 0.0 65535.0000 /end CHARACTERISTIC
/begin CHARACTERISTIC K_LA_TRIM_DIAG_I_T "min. Zeit fuer Anschlag d. I-Aneiles | EN: min. Zeit fuer Anschlag d. I-Aneiles" VALUE 0x72F28 TKW_VV_VV_UW 100.0 FORMULA_0021 0.0 655.3500 FORMAT "%5.2" /end CHARACTERISTIC
/begin CHARACTERISTIC K_LA_TRIM_LAM_DELTA_MAX "LA-Regelabweichung - Freigabe Trimmregelung | EN: LA-Regelabweichung - Freigabe Trimmregelung" VALUE 0x72F2A TKW_VV_VV_SW 100.0 FORMULA_0025 -2.0000 1.9999 FORMAT "%6.3" /end CHARACTERISTIC
/begin CHARACTERISTIC K_LA_TRIM_I_AD_MCS "I-Adaptionsanteil - MCS-Popel-Groesse fuer CFG-RESET | EN: -2p I-Adaptionsanteil - MCS- Popel-Groesse fuer CFG- RESET" VALUE 0x72F2C TKW_VV_VV_SW 100.0 FORMULA_0025 -2.0000 1.9990 FORMAT "%6.3" /end CHARACTERISTIC
/begin CHARACTERISTIC KL_LA_TRIM_I_FAK_OBD "Faktor I-Anteil aus KAT-Alterung | EN: Factor on integral share from catalyst ageing" CURVE 0x72F2E TKL_UW_VV_UW 100.0 FORMULA_0075 0.0 4.0000
 /begin AXIS_DESCR STD_AXIS kat_obd_wert FORMULA_0025 8 0.0 3.9990 FORMAT "%6.3" /end AXIS_DESCR
 FORMAT "%6.3" /end CHARACTERISTIC
/begin CHARACTERISTIC KL_LA_TRIM_P_FAK_OBD "Faktor P-Anteil aus KAT-Alterung | EN: Factor on P share from catalyst ageing" CURVE 0x72F50 TKL_UW_VV_UW 100.0 FORMULA_0075 0.0 4.0000
 /begin AXIS_DESCR STD_AXIS kat_obd_wert FORMULA_0025 8 0.0 3.9990 FORMAT "%6.3" /end AXIS_DESCR
 FORMAT "%6.3" /end CHARACTERISTIC
/begin CHARACTERISTIC KL_LA_TRIM_RF_MIN "min. relative F�llung - LA-TRIM | EN: Minimum relative charge - lambda trim" CURVE 0x72F72 TKL_SW_VV_SW 100.0 FORMULA_0007 0.0 2.0000 /begin AXIS_DESCR STD_AXIS n FORMULA_0006 8 0.0 10000.0000 /end AXIS_DESCR FORMAT "%6.3" /end CHARACTERISTIC
/begin CHARACTERISTIC KL_LA_TRIM_RF_MAX "max. relative F�llung - LA-TRIM | EN: Max. relative charge - lambda trim" CURVE 0x72F94 TKL_SW_VV_SW 100.0 FORMULA_0007 0.0 2.0000 /begin AXIS_DESCR STD_AXIS n FORMULA_0006 8 0.0 10000.0000 /end AXIS_DESCR FORMAT "%6.3" /end CHARACTERISTIC
/begin CHARACTERISTIC KL_LA_TRIM_I_GMW_RF_MIN "min. relative F�llung - Mittelwert I-Anteil | EN: Min. relative charge - I-share mean value" CURVE 0x72FB6 TKL_SW_VV_SW 100.0 FORMULA_0007 0.0 2.0000 /begin AXIS_DESCR STD_AXIS n FORMULA_0006 8 0.0 10000.0000 /end AXIS_DESCR FORMAT "%6.3" /end CHARACTERISTIC
/begin CHARACTERISTIC KL_LA_TRIM_I_GMW_RF_MAX "max. relative F�llung - Mittelwert I-Anteil | EN: Max. relative charge - I-share mean value" CURVE 0x72FD8 TKL_SW_VV_SW 100.0 FORMULA_0007 0.0 2.0000 /begin AXIS_DESCR STD_AXIS n FORMULA_0006 8 0.0 10000.0000 /end AXIS_DESCR FORMAT "%6.3" /end CHARACTERISTIC
/begin CHARACTERISTIC KF_LA_TRIM_USN_SOLL "NKAT-Sollspannung - Trimmregelung | EN: Post-cat target voltage, trim control" MAP 0x72FFA TKF_SW_SW_UW 100.0 FORMULA_0532 0.0 1200.0000 /begin AXIS_DESCR STD_AXIS n FORMULA_0006 8 0.0 10000.0000 /end AXIS_DESCR /begin AXIS_DESCR STD_AXIS rf FORMULA_0007 8 0.0 2.0000 FORMAT "%6.3" /end AXIS_DESCR /end CHARACTERISTIC
/begin CHARACTERISTIC KF_LA_TRIM_P "P-Anteil - Trimmregelung | EN: P share - trim control" MAP 0x7309C TKF_SW_SW_UW 100.0 FORMULA_0025 0.0 3.9990 /begin AXIS_DESCR STD_AXIS n FORMULA_0006 8 0.0 10000.0000 /end AXIS_DESCR /begin AXIS_DESCR STD_AXIS rf FORMULA_0007 8 0.0 2.0000 FORMAT "%6.3" /end AXIS_DESCR FORMAT "%6.3" /end CHARACTERISTIC
/begin CHARACTERISTIC KF_LA_TRIM_I "I-Anteil - Trimmregelung | EN: Integral share - trim control" MAP 0x7313E TKF_SW_SW_UW 100.0 FORMULA_0919 0.0 819.0000 /begin AXIS_DESCR STD_AXIS n FORMULA_0006 8 0.0 10000.0000 /end AXIS_DESCR /begin AXIS_DESCR STD_AXIS rf FORMULA_0007 8 0.0 2.0000 FORMAT "%6.3" /end AXIS_DESCR FORMAT "%5.2" /end CHARACTERISTIC
/begin CHARACTERISTIC KF_LA_TRIM_P_DLY "Haltezeit f�r P-Anteil | EN: Hold time for P share" MAP 0x731E0 TKF_SW_SW_UW 100.0 FORMULA_0021 0.0 655.3500 /begin AXIS_DESCR STD_AXIS n FORMULA_0006 8 0.0 10000.0000 /end AXIS_DESCR /begin AXIS_DESCR STD_AXIS rf FORMULA_0007 8 0.0 2.0000 FORMAT "%6.3" /end AXIS_DESCR FORMAT "%5.2" /end CHARACTERISTIC
/begin CHARACTERISTIC KF_LA_TRIM_P_WAIT "Warteezeit f�r weiteren P-Anteil | EN: Wait time for further P share" MAP 0x73282 TKF_SW_SW_UW 100.0 FORMULA_0021 0.0 655.3500 /begin AXIS_DESCR STD_AXIS n FORMULA_0006 8 0.0 10000.0000 /end AXIS_DESCR /begin AXIS_DESCR STD_AXIS rf FORMULA_0007 8 0.0 2.0000 FORMAT "%6.3" /end AXIS_DESCR FORMAT "%5.2" /end CHARACTERISTIC
/begin CHARACTERISTIC KF_LA_TRIM_I_DLY "Haltezeit f�r I-Anteil | EN: Hold time for integral share" MAP 0x73324 TKF_SW_SW_UW 100.0 FORMULA_0021 0.0 655.3500 /begin AXIS_DESCR STD_AXIS n FORMULA_0006 8 0.0 10000.0000 /end AXIS_DESCR /begin AXIS_DESCR STD_AXIS rf FORMULA_0007 8 0.0 2.0000 FORMAT "%6.3" /end AXIS_DESCR FORMAT "%5.2" /end CHARACTERISTIC
/begin CHARACTERISTIC KF_LA_TRIM_P_ABR "Abregelungszeit P-Anteil | EN: Ramp-down time, P share" MAP 0x733C6 TKF_SW_SW_UW 100.0 FORMULA_0021 0.0 655.3500 /begin AXIS_DESCR STD_AXIS n FORMULA_0006 8 0.0 10000.0000 /end AXIS_DESCR /begin AXIS_DESCR STD_AXIS rf FORMULA_0007 8 0.0 2.0000 FORMAT "%6.3" /end AXIS_DESCR FORMAT "%5.2" /end CHARACTERISTIC
/begin CHARACTERISTIC KF_LA_TRIM_AD_WICHT "Wichtungsfaktor auf lam_trim_ad | EN: Weighting factor on lam_trim_ad" MAP 0x73468 TKF_SW_SW_UW 100.0 FORMULA_0927 0.0 10.0000 /begin AXIS_DESCR STD_AXIS n FORMULA_0006 8 0.0 10000.0000 /end AXIS_DESCR /begin AXIS_DESCR STD_AXIS rf FORMULA_0007 8 0.0 2.0000 FORMAT "%6.3" /end AXIS_DESCR FORMAT "%5.2" /end CHARACTERISTIC
/begin CHARACTERISTIC KF_LA_TRIM_I_GMW_WICHT "Wichtungsfaktor auf lam_trim_i_gmw" MAP 0x7350A TKF_SW_SW_UW 100.0 FORMULA_0927 0.0 10.0000 /begin AXIS_DESCR STD_AXIS n FORMULA_0006 8 0.0 10000.0000 /end AXIS_DESCR /begin AXIS_DESCR STD_AXIS rf FORMULA_0007 8 0.0 2.0000 FORMAT "%6.3" /end AXIS_DESCR FORMAT "%5.2" /end CHARACTERISTIC
/begin MEASUREMENT la_trim_st_b1 "LA-Trimmregelung-Status" UWORD FORMULA_0083 0 0 0.0 65535.0000 ECU_ADDRESS 0x3FC3C8 /end MEASUREMENT
/begin MEASUREMENT la_trim_st_b2 "LA-Trimmregelung-Status" UWORD FORMULA_0083 0 0 0.0 65535.0000 ECU_ADDRESS 0x3FC3CA /end MEASUREMENT
/begin MEASUREMENT la_trim_st_cfg_b1 "Allgemeine Freigabe" UWORD FORMULA_0895 0 0 0.0 65535.0 ECU_ADDRESS 0x3FC3C8 BIT_MASK 0x1 /end MEASUREMENT
/begin MEASUREMENT la_trim_st_cfg_b2 "Allgemeine Freigabe" UWORD FORMULA_0895 0 0 0.0 65535.0 ECU_ADDRESS 0x3FC3CA BIT_MASK 0x1 /end MEASUREMENT
/begin MEASUREMENT la_trim_st_rf_b1 "RF-Schwellen" UWORD FORMULA_0896 0 0 0.0 65535.0 ECU_ADDRESS 0x3FC3C8 BIT_MASK 0x4 /end MEASUREMENT
/begin MEASUREMENT la_trim_st_rf_b2 "RF-Schwellen" UWORD FORMULA_0896 0 0 0.0 65535.0 ECU_ADDRESS 0x3FC3CA BIT_MASK 0x4 /end MEASUREMENT
/begin MEASUREMENT la_trim_st_soll_norm_b1 "LAM-SOLL-NORM & LA-Regler" UWORD FORMULA_0897 0 0 0.0 65535.0 ECU_ADDRESS 0x3FC3C8 BIT_MASK 0x8 /end MEASUREMENT
/begin MEASUREMENT la_trim_st_soll_norm_b2 "LAM-SOLL-NORM & LA-Regler" UWORD FORMULA_0897 0 0 0.0 65535.0 ECU_ADDRESS 0x3FC3CA BIT_MASK 0x8 /end MEASUREMENT
/begin MEASUREMENT la_trim_st_nkat_verf_b1 "NKAT-Sonden Verfuegbarkeit" UWORD FORMULA_0898 0 0 0.0 65535.0 ECU_ADDRESS 0x3FC3C8 BIT_MASK 0x10 /end MEASUREMENT
/begin MEASUREMENT la_trim_st_nkat_verf_b2 "NKAT-Sonden Verfuegbarkeit" UWORD FORMULA_0898 0 0 0.0 65535.0 ECU_ADDRESS 0x3FC3CA BIT_MASK 0x10 /end MEASUREMENT
/begin MEASUREMENT la_trim_st_temperatur_b1 "Abgastemp./Ansaugtemp.Schwellen" UWORD FORMULA_0899 0 0 0.0 65535.0 ECU_ADDRESS 0x3FC3C8 BIT_MASK 0x20 /end MEASUREMENT
/begin MEASUREMENT la_trim_st_temperatur_b2 "Abgastemp./Ansaugtemp.Schwellen" UWORD FORMULA_0899 0 0 0.0 65535.0 ECU_ADDRESS 0x3FC3CA BIT_MASK 0x20 /end MEASUREMENT
/begin MEASUREMENT la_trim_st_te_b1 "TE-AKF-Beladung/TEFC aktiv" UWORD FORMULA_0900 0 0 0.0 65535.0 ECU_ADDRESS 0x3FC3C8 BIT_MASK 0x40 /end MEASUREMENT
/begin MEASUREMENT la_trim_st_te_b2 "TE-AKF-Beladung/TEFC aktiv" UWORD FORMULA_0900 0 0 0.0 65535.0 ECU_ADDRESS 0x3FC3CA BIT_MASK 0x40 /end MEASUREMENT
/begin MEASUREMENT la_trim_st_puls_ausr_b1 "KAT-Ausraeumen aktiv" UWORD FORMULA_0901 0 0 0.0 65535.0 ECU_ADDRESS 0x3FC3C8 BIT_MASK 0x80 /end MEASUREMENT
/begin MEASUREMENT la_trim_st_puls_ausr_b2 "KAT-Ausraeumen aktiv" UWORD FORMULA_0901 0 0 0.0 65535.0 ECU_ADDRESS 0x3FC3CA BIT_MASK 0x80 /end MEASUREMENT
/begin MEASUREMENT la_trim_st_kats_b1 "KAT-Schutz" UWORD FORMULA_0902 0 0 0.0 65535.0 ECU_ADDRESS 0x3FC3C8 BIT_MASK 0x100 /end MEASUREMENT
/begin MEASUREMENT la_trim_st_kats_b2 "KAT-Schutz" UWORD FORMULA_0902 0 0 0.0 65535.0 ECU_ADDRESS 0x3FC3CA BIT_MASK 0x100 /end MEASUREMENT
/begin MEASUREMENT la_trim_st_kh_b1 "KAT-Heizen" UWORD FORMULA_0903 0 0 0.0 65535.0 ECU_ADDRESS 0x3FC3C8 BIT_MASK 0x200 /end MEASUREMENT
/begin MEASUREMENT la_trim_st_kh_b2 "KAT-Heizen" UWORD FORMULA_0903 0 0 0.0 65535.0 ECU_ADDRESS 0x3FC3CA BIT_MASK 0x200 /end MEASUREMENT
/begin MEASUREMENT la_trim_st_slp_b1 "Sekundaerluftbetrieb" UWORD FORMULA_0904 0 0 0.0 65535.0 ECU_ADDRESS 0x3FC3C8 BIT_MASK 0x400 /end MEASUREMENT
/begin MEASUREMENT la_trim_st_slp_b2 "Sekundaerluftbetrieb" UWORD FORMULA_0904 0 0 0.0 65535.0 ECU_ADDRESS 0x3FC3CA BIT_MASK 0x400 /end MEASUREMENT
/begin MEASUREMENT la_trim_st_sk_b1 "SK-Manger" UWORD FORMULA_0905 0 0 0.0 65535.0 ECU_ADDRESS 0x3FC3C8 BIT_MASK 0x800 /end MEASUREMENT
/begin MEASUREMENT la_trim_st_sk_b2 "SK-Manger" UWORD FORMULA_0905 0 0 0.0 65535.0 ECU_ADDRESS 0x3FC3CA BIT_MASK 0x800 /end MEASUREMENT
/begin MEASUREMENT la_trim_st_laa_lim_b1 "Kraftstoffsystem" UWORD FORMULA_0906 0 0 0.0 65535.0 ECU_ADDRESS 0x3FC3C8 BIT_MASK 0x1000 /end MEASUREMENT
/begin MEASUREMENT la_trim_st_laa_lim_b2 "Kraftstoffsystem" UWORD FORMULA_0906 0 0 0.0 65535.0 ECU_ADDRESS 0x3FC3CA BIT_MASK 0x1000 /end MEASUREMENT
/begin MEASUREMENT la_trim_st_error_b1 "Fehlerbedingungen" UWORD FORMULA_0907 0 0 0.0 65535.0 ECU_ADDRESS 0x3FC3C8 BIT_MASK 0x2000 /end MEASUREMENT
/begin MEASUREMENT la_trim_st_error_b2 "Fehlerbedingungen" UWORD FORMULA_0907 0 0 0.0 65535.0 ECU_ADDRESS 0x3FC3CA BIT_MASK 0x2000 /end MEASUREMENT
/begin MEASUREMENT la_trim_st_soll_add_b1 "LAM-SOLL Aktivitaeten" UWORD FORMULA_0908 0 0 0.0 65535.0 ECU_ADDRESS 0x3FC3C8 BIT_MASK 0x4000 /end MEASUREMENT
/begin MEASUREMENT la_trim_st_soll_add_b2 "LAM-SOLL Aktivitaeten" UWORD FORMULA_0908 0 0 0.0 65535.0 ECU_ADDRESS 0x3FC3CA BIT_MASK 0x4000 /end MEASUREMENT
/begin MEASUREMENT la_trim_st_v_b1 "V-Schwelle" UWORD FORMULA_0909 0 0 0.0 65535.0 ECU_ADDRESS 0x3FC3C8 BIT_MASK 0x8000 /end MEASUREMENT
/begin MEASUREMENT la_trim_st_v_b2 "V-Schwelle" UWORD FORMULA_0909 0 0 0.0 65535.0 ECU_ADDRESS 0x3FC3CA BIT_MASK 0x8000 /end MEASUREMENT
/begin MEASUREMENT la_trim_zust_b1 "LA-Trimmregelung-interner Zustand" UWORD FORMULA_0083 0 0 0.0 65535.0000 ECU_ADDRESS 0x3FC3CC /end MEASUREMENT
/begin MEASUREMENT la_trim_zust_b2 "LA-Trimmregelung-interner Zustand" UWORD FORMULA_0083 0 0 0.0 65535.0000 ECU_ADDRESS 0x3FC3CE /end MEASUREMENT
/begin MEASUREMENT la_trim_zust_p_b1 "P-Anteil Ermittlung abgeschlossen" UWORD FORMULA_0910 0 0 0.0 65535.0 ECU_ADDRESS 0x3FC3CC BIT_MASK 0x1 /end MEASUREMENT
/begin MEASUREMENT la_trim_zust_p_b2 "P-Anteil Ermittlung abgeschlossen" UWORD FORMULA_0910 0 0 0.0 65535.0 ECU_ADDRESS 0x3FC3CE BIT_MASK 0x1 /end MEASUREMENT
/begin MEASUREMENT la_trim_zust_i_b1 "I-Anteil-Verzoegerungzeit" UWORD FORMULA_0852 0 0 0.0 65535.0 ECU_ADDRESS 0x3FC3CC BIT_MASK 0x2 /end MEASUREMENT
/begin MEASUREMENT la_trim_zust_i_b2 "I-Anteil-Verzoegerungzeit" UWORD FORMULA_0852 0 0 0.0 65535.0 ECU_ADDRESS 0x3FC3CE BIT_MASK 0x2 /end MEASUREMENT
/begin MEASUREMENT la_trim_zust_p_abger_b1 "P-Anteil ist abgeregelt" UWORD FORMULA_0911 0 0 0.0 65535.0 ECU_ADDRESS 0x3FC3CC BIT_MASK 0x4 /end MEASUREMENT
/begin MEASUREMENT la_trim_zust_p_abger_b2 "P-Anteil ist abgeregelt" UWORD FORMULA_0911 0 0 0.0 65535.0 ECU_ADDRESS 0x3FC3CE BIT_MASK 0x4 /end MEASUREMENT
/begin MEASUREMENT la_trim_zust_i_init_gmw_b1 "I-Anteil vorbelegen" UWORD FORMULA_0912 0 0 0.0 65535.0 ECU_ADDRESS 0x3FC3CC BIT_MASK 0x8 /end MEASUREMENT
/begin MEASUREMENT la_trim_zust_i_init_gmw_b2 "I-Anteil vorbelegen" UWORD FORMULA_0912 0 0 0.0 65535.0 ECU_ADDRESS 0x3FC3CE BIT_MASK 0x8 /end MEASUREMENT
/begin MEASUREMENT la_trim_zust_us_o2_b1 "O2-Beladung freigeben - ueber Trimmregelung" UWORD FORMULA_0913 0 0 0.0 65535.0 ECU_ADDRESS 0x3FC3CC BIT_MASK 0x10 /end MEASUREMENT
/begin MEASUREMENT la_trim_zust_us_o2_b2 "O2-Beladung freigeben - ueber Trimmregelung" UWORD FORMULA_0913 0 0 0.0 65535.0 ECU_ADDRESS 0x3FC3CE BIT_MASK 0x10 /end MEASUREMENT
/begin MEASUREMENT la_trim_zust_i_max_b1 "Diagnose I-Anteil - MAX-Begrenzung" UWORD FORMULA_0914 0 0 0.0 65535.0 ECU_ADDRESS 0x3FC3CC BIT_MASK 0x20 /end MEASUREMENT
/begin MEASUREMENT la_trim_zust_i_max_b2 "Diagnose I-Anteil - MAX-Begrenzung" UWORD FORMULA_0914 0 0 0.0 65535.0 ECU_ADDRESS 0x3FC3CE BIT_MASK 0x20 /end MEASUREMENT
/begin MEASUREMENT la_trim_zust_i_min_b1 "Diagnose I-Anteil - MIN-Begrenzung" UWORD FORMULA_0915 0 0 0.0 65535.0 ECU_ADDRESS 0x3FC3CC BIT_MASK 0x40 /end MEASUREMENT
/begin MEASUREMENT la_trim_zust_i_min_b2 "Diagnose I-Anteil - MIN-Begrenzung" UWORD FORMULA_0915 0 0 0.0 65535.0 ECU_ADDRESS 0x3FC3CE BIT_MASK 0x40 /end MEASUREMENT
/begin MEASUREMENT la_trim_zust_ad_erm_b1 "AD-Wert Ermittlung" UWORD FORMULA_0916 0 0 0.0 65535.0 ECU_ADDRESS 0x3FC3CC BIT_MASK 0x80 /end MEASUREMENT
/begin MEASUREMENT la_trim_zust_ad_erm_b2 "AD-Wert Ermittlung" UWORD FORMULA_0916 0 0 0.0 65535.0 ECU_ADDRESS 0x3FC3CE BIT_MASK 0x80 /end MEASUREMENT
/begin MEASUREMENT la_trim_zust_i_ad_max_b1 "AD-Anteil - MAX-Begrenzung" UWORD FORMULA_0917 0 0 0.0 65535.0 ECU_ADDRESS 0x3FC3CC BIT_MASK 0x100 /end MEASUREMENT
/begin MEASUREMENT la_trim_zust_i_ad_max_b2 "AD-Anteil - MAX-Begrenzung" UWORD FORMULA_0917 0 0 0.0 65535.0 ECU_ADDRESS 0x3FC3CE BIT_MASK 0x100 /end MEASUREMENT
/begin MEASUREMENT la_trim_zust_i_ad_min_b1 "AD-Anteil - MIN-Begrenzung" UWORD FORMULA_0918 0 0 0.0 65535.0 ECU_ADDRESS 0x3FC3CC BIT_MASK 0x200 /end MEASUREMENT
/begin MEASUREMENT la_trim_zust_i_ad_min_b2 "AD-Anteil - MIN-Begrenzung" UWORD FORMULA_0918 0 0 0.0 65535.0 ECU_ADDRESS 0x3FC3CE BIT_MASK 0x200 /end MEASUREMENT
/begin MEASUREMENT la_trim_zust_i_gmw_aktiv_b1 "Ermittlung GMW-I-Anteil" UWORD FORMULA_0107 0 0 0.0 65535.0 ECU_ADDRESS 0x3FC3CC BIT_MASK 0x400 /end MEASUREMENT
/begin MEASUREMENT la_trim_zust_i_gmw_aktiv_b2 "Ermittlung GMW-I-Anteil" UWORD FORMULA_0107 0 0 0.0 65535.0 ECU_ADDRESS 0x3FC3CE BIT_MASK 0x400 /end MEASUREMENT
/begin MEASUREMENT la_trim_usn_soll_b1 "SOLL-NKAT-Spannung" UWORD FORMULA_0532 0 0 0.0 1200.0000 ECU_ADDRESS 0x3FC3D0 /end MEASUREMENT
/begin MEASUREMENT la_trim_usn_soll_b2 "SOLL-NKAT-Spannung" UWORD FORMULA_0532 0 0 0.0 1200.0000 ECU_ADDRESS 0x3FC3D2 /end MEASUREMENT
/begin MEASUREMENT la_trim_us_diff_b1 "Diff. NKAT-Spannung IST zu SOLL" SWORD FORMULA_0532 0 0 0.0 1200.0000 ECU_ADDRESS 0x3FC3D4 /end MEASUREMENT
/begin MEASUREMENT la_trim_us_diff_b2 "Diff. NKAT-Spannung IST zu SOLL" SWORD FORMULA_0532 0 0 0.0 1200.0000 ECU_ADDRESS 0x3FC3D6 /end MEASUREMENT
/begin MEASUREMENT la_trim_usn_aebg_b1 "aebg. SOLL-NKAT-Spannung" UWORD FORMULA_0532 0 0 0.0 1200.0000 ECU_ADDRESS 0x3FC3D8 /end MEASUREMENT
/begin MEASUREMENT la_trim_usn_aebg_b2 "aebg. SOLL-NKAT-Spannung" UWORD FORMULA_0532 0 0 0.0 1200.0000 ECU_ADDRESS 0x3FC3DA /end MEASUREMENT
/begin MEASUREMENT la_trim_p_fak_obd_b1 "Faktor P-Anteil aus KAT-Alterung" UWORD FORMULA_0075 0 0 0.0 4.0000 ECU_ADDRESS 0x3FC3DC /end MEASUREMENT
/begin MEASUREMENT la_trim_p_fak_obd_b2 "Faktor P-Anteil aus KAT-Alterung" UWORD FORMULA_0075 0 0 0.0 4.0000 ECU_ADDRESS 0x3FC3DE /end MEASUREMENT
/begin MEASUREMENT la_trim_p_anz_b1 "Anzahl der P-Anteil Triggerungen" UWORD FORMULA_0010 0 0 0.0 65535.0000 ECU_ADDRESS 0x3FC3E0 /end MEASUREMENT
/begin MEASUREMENT la_trim_p_anz_b2 "Anzahl der P-Anteil Triggerungen" UWORD FORMULA_0010 0 0 0.0 65535.0000 ECU_ADDRESS 0x3FC3E2 /end MEASUREMENT
/begin MEASUREMENT la_trim_p_f_b1 "P-Anteil - Trimmregelung" UWORD FORMULA_0025 0 0 0.0 0.5000 ECU_ADDRESS 0x3FC3E4 /end MEASUREMENT
/begin MEASUREMENT la_trim_p_f_b2 "P-Anteil - Trimmregelung" UWORD FORMULA_0025 0 0 0.0 0.5000 ECU_ADDRESS 0x3FC3E6 /end MEASUREMENT
/begin MEASUREMENT la_trim_i_f_b1 "I-Anteil - Trimmregelung" UWORD FORMULA_0919 0 0 0.0 819.0000 ECU_ADDRESS 0x3FC3E8 /end MEASUREMENT
/begin MEASUREMENT la_trim_i_f_b2 "I-Anteil - Trimmregelung" UWORD FORMULA_0919 0 0 0.0 819.0000 ECU_ADDRESS 0x3FC3EA /end MEASUREMENT
/begin MEASUREMENT la_trim_i_inc_b1 "Integratorwert auf wirkenden I-Anteil" SWORD FORMULA_0295 0 0 -2.0000 1.9990 ECU_ADDRESS 0x3FC3EC /end MEASUREMENT
/begin MEASUREMENT la_trim_i_inc_b2 "Integratorwert auf wirkenden I-Anteil" SWORD FORMULA_0295 0 0 -2.0000 1.9990 ECU_ADDRESS 0x3FC3EE /end MEASUREMENT
/begin MEASUREMENT la_trim_p_b1 "wirkender P-Anteil" SWORD FORMULA_0025 0 0 -2.0000 1.9990 ECU_ADDRESS 0x3FC3F0 /end MEASUREMENT
/begin MEASUREMENT la_trim_p_b2 "wirkender P-Anteil" SWORD FORMULA_0025 0 0 -2.0000 1.9990 ECU_ADDRESS 0x3FC3F2 /end MEASUREMENT
/begin MEASUREMENT la_trim_i_b1 "wirkender I-Anteil" SWORD FORMULA_0025 0 0 -2.0000 1.9990 ECU_ADDRESS 0x3FC3F4 /end MEASUREMENT
/begin MEASUREMENT la_trim_i_b2 "wirkender I-Anteil" SWORD FORMULA_0025 0 0 -2.0000 1.9990 ECU_ADDRESS 0x3FC3F6 /end MEASUREMENT
/begin MEASUREMENT la_trim_i_gmw_b1 "wirkender I-Anteil - gemittelt" SWORD FORMULA_0025 0 0 -2.0000 1.9990 ECU_ADDRESS 0x3FC3F8 /end MEASUREMENT
/begin MEASUREMENT la_trim_i_gmw_b2 "wirkender I-Anteil - gemittelt" SWORD FORMULA_0025 0 0 -2.0000 1.9990 ECU_ADDRESS 0x3FC3FA /end MEASUREMENT
/begin MEASUREMENT la_trim_lam_soll_b1 "LAM-SOLL-OFFSET der Trimmregelung" SWORD FORMULA_0025 0 0 -2.0000 1.9990 ECU_ADDRESS 0x3FC3FC /end MEASUREMENT
/begin MEASUREMENT la_trim_lam_soll_b2 "LAM-SOLL-OFFSET der Trimmregelung" SWORD FORMULA_0025 0 0 -2.0000 1.9990 ECU_ADDRESS 0x3FC3FE /end MEASUREMENT
/begin MEASUREMENT la_trim_i_fak_obd_b1 "Faktor I-Anteil aus KAT-Alterung" UWORD FORMULA_0075 0 0 0.0 4.0000 ECU_ADDRESS 0x3FC400 /end MEASUREMENT
/begin MEASUREMENT la_trim_i_fak_obd_b2 "Faktor I-Anteil aus KAT-Alterung" UWORD FORMULA_0075 0 0 0.0 4.0000 ECU_ADDRESS 0x3FC402 /end MEASUREMENT
/begin MEASUREMENT la_trim_p_dly_b1 "Haltezeit f�r P-Anteil" UWORD FORMULA_0021 0 0 0.0 655.3500 ECU_ADDRESS 0x3FC404 /end MEASUREMENT
/begin MEASUREMENT la_trim_p_dly_b2 "Haltezeit f�r P-Anteil" UWORD FORMULA_0021 0 0 0.0 655.3500 ECU_ADDRESS 0x3FC406 /end MEASUREMENT
/begin MEASUREMENT la_trim_p_wait_b1 "Wartezeit f�r weiteren P-Anteil" UWORD FORMULA_0021 0 0 0.0 655.3500 ECU_ADDRESS 0x3FC408 /end MEASUREMENT
/begin MEASUREMENT la_trim_p_wait_b2 "Wartezeit f�r weiteren P-Anteil" UWORD FORMULA_0021 0 0 0.0 655.3500 ECU_ADDRESS 0x3FC40A /end MEASUREMENT
/begin MEASUREMENT la_trim_i_dly_b1 "Haltezeit f�r I-Anteil" UWORD FORMULA_0021 0 0 0.0 655.3500 ECU_ADDRESS 0x3FC40C /end MEASUREMENT
/begin MEASUREMENT la_trim_i_dly_b2 "Haltezeit f�r I-Anteil" UWORD FORMULA_0021 0 0 0.0 655.3500 ECU_ADDRESS 0x3FC40E /end MEASUREMENT
/begin MEASUREMENT la_trim_p_abr_b1 "Abregelungszeit P-Anteil" UWORD FORMULA_0021 0 0 0.0 655.3500 ECU_ADDRESS 0x3FC410 /end MEASUREMENT
/begin MEASUREMENT la_trim_p_abr_b2 "Abregelungszeit P-Anteil" UWORD FORMULA_0021 0 0 0.0 655.3500 ECU_ADDRESS 0x3FC412 /end MEASUREMENT
/begin MEASUREMENT la_trim_p_dez_b1 "Abregelungswert P-Anteil" SLONG FORMULA_0920 0 0 0.0 3.9990 ECU_ADDRESS 0x3FC414 /end MEASUREMENT
/begin MEASUREMENT la_trim_p_dez_b2 "Abregelungswert P-Anteil" SLONG FORMULA_0920 0 0 0.0 3.9990 ECU_ADDRESS 0x3FC418 /end MEASUREMENT
/begin MEASUREMENT la_trim_diag_p_cnt_b1 "Anzahl P-Anteil-Fkt.-Durchlaeufe " UWORD FORMULA_0010 0 0 0.0 65535.0000 ECU_ADDRESS 0x3FC41C /end MEASUREMENT
/begin MEASUREMENT la_trim_diag_p_cnt_b2 "Anzahl P-Anteil-Fkt.-Durchlaeufe " UWORD FORMULA_0010 0 0 0.0 65535.0000 ECU_ADDRESS 0x3FC41E /end MEASUREMENT
/begin MEASUREMENT la_trim_diag_i_ed_f_b1 "Aufweitungsfaktor auf d. I-Anteils-Bereichsgrenzen" UWORD FORMULA_0075 0 0 0.0 4.0000 ECU_ADDRESS 0x3FC420 /end MEASUREMENT
/begin MEASUREMENT la_trim_diag_i_ed_f_b2 "Aufweitungsfaktor auf d. I-Anteils-Bereichsgrenzen" UWORD FORMULA_0075 0 0 0.0 4.0000 ECU_ADDRESS 0x3FC422 /end MEASUREMENT
/begin MEASUREMENT la_trim_diag_i_min_cnt_b1 "Anzahl I-Anteil min. Begrenzung" UWORD FORMULA_0010 0 0 0.0 65535.0000 ECU_ADDRESS 0x3FC424 /end MEASUREMENT
/begin MEASUREMENT la_trim_diag_i_min_cnt_b2 "Anzahl I-Anteil min. Begrenzung" UWORD FORMULA_0010 0 0 0.0 65535.0000 ECU_ADDRESS 0x3FC426 /end MEASUREMENT
/begin MEASUREMENT la_trim_diag_i_max_cnt_b1 "Anzahl I-Anteil max. Begrenzung" UWORD FORMULA_0010 0 0 0.0 65535.0000 ECU_ADDRESS 0x3FC428 /end MEASUREMENT
/begin MEASUREMENT la_trim_diag_i_max_cnt_b2 "Anzahl I-Anteil max. Begrenzung" UWORD FORMULA_0010 0 0 0.0 65535.0000 ECU_ADDRESS 0x3FC42A /end MEASUREMENT
/begin MEASUREMENT la_trim_diag_st_b1 "LA-Trimmregelung-Diagnose" UWORD FORMULA_0083 0 0 0.0 65535.0000 ECU_ADDRESS 0x3FC42C /end MEASUREMENT
/begin MEASUREMENT la_trim_diag_st_b2 "LA-Trimmregelung-Diagnose" UWORD FORMULA_0083 0 0 0.0 65535.0000 ECU_ADDRESS 0x3FC42E /end MEASUREMENT
/begin MEASUREMENT la_trim_diag_m_b1 "Mager-Verdacht" UWORD FORMULA_0921 0 0 0.0 65535.0 ECU_ADDRESS 0x3FC42C BIT_MASK 0x1 /end MEASUREMENT
/begin MEASUREMENT la_trim_diag_m_b2 "Mager-Verdacht" UWORD FORMULA_0921 0 0 0.0 65535.0 ECU_ADDRESS 0x3FC42E BIT_MASK 0x1 /end MEASUREMENT
/begin MEASUREMENT la_trim_diag_f_b1 "Fett-Verdacht" UWORD FORMULA_0922 0 0 0.0 65535.0 ECU_ADDRESS 0x3FC42C BIT_MASK 0x2 /end MEASUREMENT
/begin MEASUREMENT la_trim_diag_f_b2 "Fett-Verdacht" UWORD FORMULA_0922 0 0 0.0 65535.0 ECU_ADDRESS 0x3FC42E BIT_MASK 0x2 /end MEASUREMENT
/begin MEASUREMENT la_trim_diag_i_ad_f_b1 "Aufweitungsfaktor auf d. I-Adaptions-Bereichsgrenzen" UWORD FORMULA_0075 0 0 0.0 4.0000 ECU_ADDRESS 0x3FC430 /end MEASUREMENT
/begin MEASUREMENT la_trim_diag_i_ad_f_b2 "Aufweitungsfaktor auf d. I-Adaptions-Bereichsgrenzen" UWORD FORMULA_0075 0 0 0.0 4.0000 ECU_ADDRESS 0x3FC432 /end MEASUREMENT
/begin MEASUREMENT la_trim_diag_i_ad_min_cnt_b1 "Anzahl I-Adaption min. Begrenzung" UWORD FORMULA_0010 0 0 0.0 65535.0000 ECU_ADDRESS 0x3FC434 /end MEASUREMENT
/begin MEASUREMENT la_trim_diag_i_ad_min_cnt_b2 "Anzahl I-Adaption min. Begrenzung" UWORD FORMULA_0010 0 0 0.0 65535.0000 ECU_ADDRESS 0x3FC436 /end MEASUREMENT
/begin MEASUREMENT la_trim_diag_i_ad_max_cnt_b1 "Anzahl I-Adaption max. Begrenzung" UWORD FORMULA_0010 0 0 0.0 65535.0000 ECU_ADDRESS 0x3FC438 /end MEASUREMENT
/begin MEASUREMENT la_trim_diag_i_ad_max_cnt_b2 "Anzahl I-Adaption max. Begrenzung" UWORD FORMULA_0010 0 0 0.0 65535.0000 ECU_ADDRESS 0x3FC43A /end MEASUREMENT
/* ------------------ Abschnitt erzeugt aus pabg.dat ------------------ */
/begin CHARACTERISTIC K_PABG_STAT_TAU "Filterzeitkonstante PABG | EN: Filter time constant, exhaust back-pressure [s]" VALUE 0x75510 TKW_VV_VV_UB 100.0 FORMULA_0664 0.0101 2.5600 /end CHARACTERISTIC
/begin CHARACTERISTIC KL_PABG_STAT_ML "Grundkennfeld relativer PABG | EN: Base map, relative exhaust back-pressure" CURVE 0x75512 TKL_SW_VV_SW 100.0 FORMULA_0077 0.0 1500.0000
 /begin AXIS_DESCR STD_AXIS ml FORMULA_0112 8 -100.0000 1400.0000 FORMAT "%4.1" /end AXIS_DESCR
 FORMAT "%4.1" /end CHARACTERISTIC
/begin MEASUREMENT pabg_b1 "Abgasgegendruck gesamt" SWORD FORMULA_0077 0 0 500.0000 2000.0000 ECU_ADDRESS 0x3FCC4C /end MEASUREMENT
/begin MEASUREMENT pabg_b2 "Abgasgegendruck gesamt" SWORD FORMULA_0077 0 0 500.0000 2000.0000 ECU_ADDRESS 0x3FCC56 /end MEASUREMENT
/begin MEASUREMENT pabg_b1.stat_roh "Abgasgegendruck ungefiltert" SWORD FORMULA_0077 0 0 500.0000 2000.0000 ECU_ADDRESS 0x3FCC4E /end MEASUREMENT
/begin MEASUREMENT pabg_b2.stat_roh "Abgasgegendruck ungefiltert" SWORD FORMULA_0077 0 0 500.0000 2000.0000 ECU_ADDRESS 0x3FCC58 /end MEASUREMENT
/begin MEASUREMENT pabg_b1.dif "Diff. Abgasgegendruck zur PUMG" SWORD FORMULA_0077 0 0 500.0000 2000.0000 ECU_ADDRESS 0x3FCC50 /end MEASUREMENT
/begin MEASUREMENT pabg_b2.dif "Diff. Abgasgegendruck zur PUMG" SWORD FORMULA_0077 0 0 500.0000 2000.0000 ECU_ADDRESS 0x3FCC5A /end MEASUREMENT
/begin MEASUREMENT pabg_b1.tau "Filtertaukonstante" UWORD FORMULA_1032 0 0 0.1000 25.6000 ECU_ADDRESS 0x3FCC52 /end MEASUREMENT
/begin MEASUREMENT pabg_b2.tau "Filtertaukonstante" UWORD FORMULA_1032 0 0 0.1000 25.6000 ECU_ADDRESS 0x3FCC5C /end MEASUREMENT
/begin MEASUREMENT pabg_b1.pabg_10ms "Abgasgegendruck mit 10ms Filter berechnet" SWORD FORMULA_0077 0 0 500.0000 2000.0000 ECU_ADDRESS 0x3FCC54 /end MEASUREMENT
/begin MEASUREMENT pabg_b2.pabg_10ms "Abgasgegendruck mit 10ms Filter berechnet" SWORD FORMULA_0077 0 0 500.0000 2000.0000 ECU_ADDRESS 0x3FCC5E /end MEASUREMENT
/begin MEASUREMENT pabg_m "Mittelwert Abgasgegendruck" SWORD FORMULA_0077 0 0 500.0000 2000.0000 ECU_ADDRESS 0x3FCC60 /end MEASUREMENT
/* ------------------ Abschnitt erzeugt aus qadc_conf.dat ------------------ */
/begin MEASUREMENT qadc_hfm_last_samples_1of2_ "Letzten Werte bei der Auswertung" UWORD FORMULA_0010 0 0 0.0 65535.0000 ECU_ADDRESS 0x3FCE40 /end MEASUREMENT
/begin MEASUREMENT qadc_hfm_last_samples_2of2_ "Letzten Werte bei der Auswertung" UWORD FORMULA_0010 0 0 0.0 65535.0000 ECU_ADDRESS 0x3FCE42 /end MEASUREMENT
/begin MEASUREMENT qadc_lavk_last_samples_1of2_ "Letzten Werte bei der Auswertung" UWORD FORMULA_0010 0 0 0.0 65535.0000 ECU_ADDRESS 0x3FCE44 /end MEASUREMENT
/begin MEASUREMENT qadc_lavk_last_samples_2of2_ "Letzten Werte bei der Auswertung" UWORD FORMULA_0010 0 0 0.0 65535.0000 ECU_ADDRESS 0x3FCE46 /end MEASUREMENT
/begin MEASUREMENT qadc_hfm_cwp_alt "Conversion Pointer bei letzter Auswertung" SWORD FORMULA_0010 0 0 -32768.0000 32767.0000 ECU_ADDRESS 0x3FCE48 /end MEASUREMENT
/begin MEASUREMENT qadc_lavk_cwp_alt "Conversion Pointer bei letzter Auswertung" SWORD FORMULA_0010 0 0 -32768.0000 32767.0000 ECU_ADDRESS 0x3FCE4A /end MEASUREMENT
/begin MEASUREMENT qadc_sync_hfm_zz_upd "Zahnzaehler bei letztem sync queue update HFM" UBYTE FORMULA_1064 0 0 0.0 119.0000 ECU_ADDRESS 0x3FCE4C /end MEASUREMENT
/begin MEASUREMENT qadc_lavk_wrp "Write Pointer in der Qadc-Queue" UBYTE FORMULA_0003 0 0 0.0 255.0000 ECU_ADDRESS 0x3FCE4D /end MEASUREMENT
/begin MEASUREMENT qadc_lavk_anz_b1 "Anzahl der Aufaddierten AD-Werte" UBYTE FORMULA_0003 0 0 0.0 255.0000 ECU_ADDRESS 0x3FCE4E /end MEASUREMENT
/begin MEASUREMENT qadc_lavk_anz_b2 "Anzahl der Aufaddierten AD-Werte" UBYTE FORMULA_0003 0 0 0.0 255.0000 ECU_ADDRESS 0x3FCE4F /end MEASUREMENT
/begin MEASUREMENT qadc_lavk_sum_b1 "Summe der AD-Werte" ULONG FORMULA_0000 0 0 0.0 4294967295.0000 ECU_ADDRESS 0x3FCE50 /end MEASUREMENT
/begin MEASUREMENT qadc_lavk_sum_b2 "Summe der AD-Werte" ULONG FORMULA_0000 0 0 0.0 4294967295.0000 ECU_ADDRESS 0x3FCE54 /end MEASUREMENT
/begin MEASUREMENT qadc_lavk_anz_read "Anzahl der LAVK Samples in der Queue" UWORD FORMULA_0083 0 0 0.0 65535.0000 ECU_ADDRESS 0x3FCE58 /end MEASUREMENT
/begin MEASUREMENT qadc_hfm_ovr_error_cnt "HFM Overflow error in QADC queue" UWORD FORMULA_0010 0 0 0.0 65535.0000 ECU_ADDRESS 0x3FCE5A /end MEASUREMENT
/begin MEASUREMENT qadc_lavk_ovr_error_cnt "HFM Overflow error in QADC queue" UWORD FORMULA_0010 0 0 0.0 65535.0000 ECU_ADDRESS 0x3FCE5C /end MEASUREMENT
/begin MEASUREMENT qadc_hfm_no_sample_cnt "Zaehler wieoft die Qadc Auswertfunktion ohne Werte " UWORD FORMULA_0010 0 0 0.0 65535.0000 ECU_ADDRESS 0x3FCE5E /end MEASUREMENT
/begin MEASUREMENT qadc_lavk_no_sample_cnt "Zaehler wieoft die Qadc Auswertfunktion ohne Werte " UWORD FORMULA_0010 0 0 0.0 65535.0000 ECU_ADDRESS 0x3FCE60 /end MEASUREMENT
/begin MEASUREMENT qadc_hfm_anz_read "Anzahl der HFM Samples in der Queue" UWORD FORMULA_0083 0 0 0.0 65535.0000 ECU_ADDRESS 0x3FCE62 /end MEASUREMENT
/begin MEASUREMENT qadc_lsv_h_st "Status Handshake fuer LSV_H Messung" UBYTE FORMULA_0033 0 0 0.0 255.0000 ECU_ADDRESS 0x3FCE64 /end MEASUREMENT
/begin MEASUREMENT qadca_unerlaubter_irq "IRQ Error qadc (nicht erlaubter IRQ)" UBYTE FORMULA_0033 0 0 0.0 255.0000 ECU_ADDRESS 0x3FCE65 /end MEASUREMENT
/* ------------------ Abschnitt erzeugt aus rf_e2.dat ------------------ */
/begin CHARACTERISTIC K_RF_E2_T_MAX "Maximale Fehlerzeit Last fuer Ebene 2." VALUE 0x795A4 TKW_VV_VV_UW 100.0 FORMULA_0021 0.0 655.0000 FORMAT "%5.2" /end CHARACTERISTIC
/begin CHARACTERISTIC K_RF_E2_DYN_TAU "Filterkonstante fuer rf_e2_dyn" VALUE 0x795A6 TKW_VV_VV_UB 100.0 FORMULA_0664 0.0101 2.5600 /end CHARACTERISTIC
/begin CHARACTERISTIC K_RF_E2_DYN_T "Zeit nach Dynamikabbruch durch rf" VALUE 0x795A8 TKW_VV_VV_UW 100.0 FORMULA_0021 0.0 655.0000 FORMAT "%5.2" /end CHARACTERISTIC
/begin CHARACTERISTIC K_RF_E2_DYN_DELTA "Dynamikschwelle RF" VALUE 0x795AA TKW_VV_VV_SW 100.0 FORMULA_0007 0.0 2.0000 FORMAT "%6.3" /end CHARACTERISTIC
/begin CHARACTERISTIC K_RF_E2_HFM_TAU "Tau fuer RF-E2 Filterung" VALUE 0x795AC TKW_VV_VV_UB 100.0 FORMULA_0651 0.0051 1.2800 /end CHARACTERISTIC
/begin CHARACTERISTIC KL_RF_E2_HFM_AD "Kennlinie HFM Ebene 2" CURVE 0x795AE TKL_SW_VV_SW 100.0 FORMULA_0112 -100.0000 1400.0000 /begin AXIS_DESCR STD_AXIS hfm_5ms_ad_b1 FORMULA_0123 11 0.0 1023.0000 /end AXIS_DESCR FORMAT "%4.1" /end CHARACTERISTIC
/begin CHARACTERISTIC KL_RF_E2_PUMG_KORR "Korrekturfaktor in Abh. vom Luftdruck | EN: Correction factor depending on air pressure" CURVE 0x795DC TKL_SW_VV_SW 100.0 FORMULA_0075 -4.0000 4.0000
 /begin AXIS_DESCR STD_AXIS pumg FORMULA_0077 8 400.0000 1200.0000 FORMAT "%4.1" /end AXIS_DESCR
 FORMAT "%6.3" /end CHARACTERISTIC
/begin CHARACTERISTIC KL_RF_E2_TAN_KORR "-" CURVE 0x795FE TKL_SW_VV_UW 100.0 FORMULA_0075 0.0 4.0000
 /begin AXIS_DESCR STD_AXIS temperatur FORMULA_0023 8 -50.0000 170.0000 FORMAT "%4.1" /end AXIS_DESCR
 FORMAT "%6.3" /end CHARACTERISTIC
/begin CHARACTERISTIC KF_RF_E2_MAX "Max. erlaubte Abweichung" MAP 0x79620 TKF_SW_SW_SW 100.0 FORMULA_0709 -200.0000 255.0000 /begin AXIS_DESCR STD_AXIS n FORMULA_0006 6 0.0 10000.0000 /end AXIS_DESCR /begin AXIS_DESCR STD_AXIS rf_b1 FORMULA_0007 8 0.0 2.0000 FORMAT "%6.3" /end AXIS_DESCR FORMAT "%4.1" /end CHARACTERISTIC
/begin MEASUREMENT rf_e2_ml_b1 "Luftmassenstrom aus HFM Ebene2" SWORD FORMULA_0112 0 0 -100.0000 1400.0000 ECU_ADDRESS 0x3FD7F0 /end MEASUREMENT
/begin MEASUREMENT rf_e2_ml_b2 "Luftmassenstrom aus HFM Ebene2" SWORD FORMULA_0112 0 0 -100.0000 1400.0000 ECU_ADDRESS 0x3FD7F2 /end MEASUREMENT
/begin MEASUREMENT rf_e2_abw_b1 "Abweichung RF-Ebene2 in Prozent" SWORD FORMULA_0022 0 0 0.0 200.0000 ECU_ADDRESS 0x3FD7F4 /end MEASUREMENT
/begin MEASUREMENT rf_e2_abw_b2 "Abweichung RF-Ebene2 in Prozent" SWORD FORMULA_0022 0 0 0.0 200.0000 ECU_ADDRESS 0x3FD7F6 /end MEASUREMENT
/begin MEASUREMENT rf_e2_berech_1of2_ "relative Fuellung aus Ebene 2" SWORD FORMULA_0007 0 0 0.0 2.0000 ECU_ADDRESS 0x3FD7F8 /end MEASUREMENT
/begin MEASUREMENT rf_e2_berech_2of2_ "relative Fuellung aus Ebene 2" SWORD FORMULA_0007 0 0 0.0 2.0000 ECU_ADDRESS 0x3FD7FA /end MEASUREMENT
/begin MEASUREMENT rf_e2_t_b1 "Fehlerzeit rf fuer Ebene 2." UWORD FORMULA_0021 0 0 0.0 655.0000 ECU_ADDRESS 0x3FD7FC /end MEASUREMENT
/begin MEASUREMENT rf_e2_t_b2 "Fehlerzeit rf fuer Ebene 2." UWORD FORMULA_0021 0 0 0.0 655.0000 ECU_ADDRESS 0x3FD7FE /end MEASUREMENT
/begin MEASUREMENT rf_e2_dyn_st "Statusbyte fuer rf Dynamik" UBYTE FORMULA_1074 0 0 0.0 255.0 ECU_ADDRESS 0x3FD800 BIT_MASK 0x1 /end MEASUREMENT
/begin MEASUREMENT rf_e2_dyn "PT1 gefilterter Wert fuer dir rf Dynamik Erkennung" SWORD FORMULA_0007 0 0 0.0 2.0000 ECU_ADDRESS 0x3FD802 /end MEASUREMENT
/begin MEASUREMENT rf_e2_dyn_delta "Delta gefiltert zum ungefiltertem" SWORD FORMULA_0204 0 0 -200.0000 200.0000 ECU_ADDRESS 0x3FD804 /end MEASUREMENT
/* ------------------ Abschnitt erzeugt aus rps.dat ------------------ */
/begin CHARACTERISTIC K_RPS_CFG "Auswahl RPS-Modell" VALUE 0x76632 TKW_VV_VV_UB 100.0 FORMULA_1083 0.0 255.0 /end CHARACTERISTIC
/begin MEASUREMENT rps_zust_allg_1of2_ "Allg. Zustand" UBYTE FORMULA_0003 0 0 0.0 255.0000 ECU_ADDRESS 0x3FCEF0 /end MEASUREMENT
/begin MEASUREMENT rps_zust_allg_2of2_ "Allg. Zustand" UBYTE FORMULA_0003 0 0 0.0 255.0000 ECU_ADDRESS 0x3FCEF1 /end MEASUREMENT
/begin MEASUREMENT rps_tan_zust "Status tan-RPS" UBYTE FORMULA_0003 0 0 0.0 255.0000 ECU_ADDRESS 0x3FCEF2 /end MEASUREMENT
/begin MEASUREMENT rps_tan "tan-RPS" SWORD FORMULA_0023 0 0 -50.0000 170.0000 ECU_ADDRESS 0x3FCEF4 /end MEASUREMENT
/begin MEASUREMENT rps_wf_mks_1of10_ "RPS-MKS aus Wandfilmmodell" SWORD FORMULA_0752 0 0 -512.0000 511.0000 ECU_ADDRESS 0x3FCEF6 /end MEASUREMENT
/begin MEASUREMENT rps_wf_mks_2of10_ "RPS-MKS aus Wandfilmmodell" SWORD FORMULA_0752 0 0 -512.0000 511.0000 ECU_ADDRESS 0x3FCEF8 /end MEASUREMENT
/begin MEASUREMENT rps_wf_mks_3of10_ "RPS-MKS aus Wandfilmmodell" SWORD FORMULA_0752 0 0 -512.0000 511.0000 ECU_ADDRESS 0x3FCEFA /end MEASUREMENT
/begin MEASUREMENT rps_wf_mks_4of10_ "RPS-MKS aus Wandfilmmodell" SWORD FORMULA_0752 0 0 -512.0000 511.0000 ECU_ADDRESS 0x3FCEFC /end MEASUREMENT
/begin MEASUREMENT rps_wf_mks_5of10_ "RPS-MKS aus Wandfilmmodell" SWORD FORMULA_0752 0 0 -512.0000 511.0000 ECU_ADDRESS 0x3FCEFE /end MEASUREMENT
/begin MEASUREMENT rps_wf_mks_6of10_ "RPS-MKS aus Wandfilmmodell" SWORD FORMULA_0752 0 0 -512.0000 511.0000 ECU_ADDRESS 0x3FCF00 /end MEASUREMENT
/begin MEASUREMENT rps_wf_mks_7of10_ "RPS-MKS aus Wandfilmmodell" SWORD FORMULA_0752 0 0 -512.0000 511.0000 ECU_ADDRESS 0x3FCF02 /end MEASUREMENT
/begin MEASUREMENT rps_wf_mks_8of10_ "RPS-MKS aus Wandfilmmodell" SWORD FORMULA_0752 0 0 -512.0000 511.0000 ECU_ADDRESS 0x3FCF04 /end MEASUREMENT
/begin MEASUREMENT rps_wf_mks_9of10_ "RPS-MKS aus Wandfilmmodell" SWORD FORMULA_0752 0 0 -512.0000 511.0000 ECU_ADDRESS 0x3FCF06 /end MEASUREMENT
/begin MEASUREMENT rps_wf_mks_10of10_ "RPS-MKS aus Wandfilmmodell" SWORD FORMULA_0752 0 0 -512.0000 511.0000 ECU_ADDRESS 0x3FCF08 /end MEASUREMENT
/begin MEASUREMENT rps_wf_st "RPS-WF-Aktiv-Status" UWORD FORMULA_0083 0 0 0.0 65535.0000 ECU_ADDRESS 0x3FCF0A /end MEASUREMENT
/begin MEASUREMENT rps_lam_reg_st_1of2_ "RPS-LA-Regler-Status" UWORD FORMULA_1079 0 0 0.0 65535.0 ECU_ADDRESS 0x3FCF0C BIT_MASK 0x7 /end MEASUREMENT
/begin MEASUREMENT rps_lam_reg_st_2of2_ "RPS-LA-Regler-Status" UWORD FORMULA_1079 0 0 0.0 65535.0 ECU_ADDRESS 0x3FCF0E BIT_MASK 0x7 /end MEASUREMENT
/begin MEASUREMENT rps_lam_reg_f_1of2_ "RPS-Regeleingriff" UWORD FORMULA_0024 0 0 0.0 1.9990 ECU_ADDRESS 0x3FCF10 /end MEASUREMENT
/begin MEASUREMENT rps_lam_reg_f_2of2_ "RPS-Regeleingriff" UWORD FORMULA_0024 0 0 0.0 1.9990 ECU_ADDRESS 0x3FCF12 /end MEASUREMENT
/begin MEASUREMENT rps_lam_delta_lim_1of2_ "RPS-begrenzte Regelabweichung" SWORD FORMULA_0025 0 0 -2.0000 1.9999 ECU_ADDRESS 0x3FCF14 /end MEASUREMENT
/begin MEASUREMENT rps_lam_delta_lim_2of2_ "RPS-begrenzte Regelabweichung" SWORD FORMULA_0025 0 0 -2.0000 1.9999 ECU_ADDRESS 0x3FCF16 /end MEASUREMENT
/begin MEASUREMENT rps_laa_st_1of2_ "RPS-LA-Adaption-Status" UWORD FORMULA_1080 0 0 0.0 65535.0 ECU_ADDRESS 0x3FCF18 BIT_MASK 0x1F /end MEASUREMENT
/begin MEASUREMENT rps_laa_st_2of2_ "RPS-LA-Adaption-Status" UWORD FORMULA_1080 0 0 0.0 65535.0 ECU_ADDRESS 0x3FCF1A BIT_MASK 0x1F /end MEASUREMENT
/begin MEASUREMENT rps_laa_f_1of2_ "RPS-Faktor-Lambdaadaption" UWORD FORMULA_0024 0 0 0.0 1.9990 ECU_ADDRESS 0x3FCF1C /end MEASUREMENT
/begin MEASUREMENT rps_laa_f_2of2_ "RPS-Faktor-Lambdaadaption" UWORD FORMULA_0024 0 0 0.0 1.9990 ECU_ADDRESS 0x3FCF1E /end MEASUREMENT
/begin MEASUREMENT rps_laa_offs_1of2_ "RPS-Offset-Lambdaadaption" SWORD FORMULA_0531 0 0 -512.0000 511.0000 ECU_ADDRESS 0x3FCF20 /end MEASUREMENT
/begin MEASUREMENT rps_laa_offs_2of2_ "RPS-Offset-Lambdaadaption" SWORD FORMULA_0531 0 0 -512.0000 511.0000 ECU_ADDRESS 0x3FCF22 /end MEASUREMENT
/begin MEASUREMENT rps_van_kh_st "RPS-Status Vanoskath" UWORD FORMULA_0010 0 0 0.0 65535.0000 ECU_ADDRESS 0x3FCF24 /end MEASUREMENT
/begin MEASUREMENT rps_van_soll_kh_off_1of4_ "RPS-Vanosoffset KH" SWORD FORMULA_0111 0 0 50.0000 160.0000 ECU_ADDRESS 0x3FCF26 /end MEASUREMENT
/begin MEASUREMENT rps_van_soll_kh_off_2of4_ "RPS-Vanosoffset KH" SWORD FORMULA_0111 0 0 50.0000 160.0000 ECU_ADDRESS 0x3FCF28 /end MEASUREMENT
/begin MEASUREMENT rps_van_soll_kh_off_3of4_ "RPS-Vanosoffset KH" SWORD FORMULA_0111 0 0 50.0000 160.0000 ECU_ADDRESS 0x3FCF2A /end MEASUREMENT
/begin MEASUREMENT rps_van_soll_kh_off_4of4_ "RPS-Vanosoffset KH" SWORD FORMULA_0111 0 0 50.0000 160.0000 ECU_ADDRESS 0x3FCF2C /end MEASUREMENT
/begin MEASUREMENT rps_tmot "RPS-Motortemperatur" SWORD FORMULA_0023 0 0 -50.0000 170.0000 ECU_ADDRESS 0x3FCF2E /end MEASUREMENT
/begin MEASUREMENT rps_pks_st "RPS-PKS-Status" UBYTE FORMULA_1081 0 0 0.0 255.0 ECU_ADDRESS 0x3FCF30 /end MEASUREMENT
/begin MEASUREMENT rps_rg_1of2_.m_av "RPS-RG �ber Auslass" SWORD FORMULA_0109 0 0 -0.5000 0.5000 ECU_ADDRESS 0x3FCF32 /end MEASUREMENT
/begin MEASUREMENT rps_rg_2of2_.m_av "RPS-RG �ber Auslass" SWORD FORMULA_0109 0 0 -0.5000 0.5000 ECU_ADDRESS 0x3FCF3E /end MEASUREMENT
/begin MEASUREMENT rps_rg_1of2_.m_tot "RPS-RG im Totvolumen" SWORD FORMULA_0109 0 0 -0.5000 0.5000 ECU_ADDRESS 0x3FCF34 /end MEASUREMENT
/begin MEASUREMENT rps_rg_2of2_.m_tot "RPS-RG im Totvolumen" SWORD FORMULA_0109 0 0 -0.5000 0.5000 ECU_ADDRESS 0x3FCF40 /end MEASUREMENT
/begin MEASUREMENT rps_rg_1of2_.m_mod "RPS-RG gesamt" SWORD FORMULA_0109 0 0 -0.5000 0.5000 ECU_ADDRESS 0x3FCF36 /end MEASUREMENT
/begin MEASUREMENT rps_rg_2of2_.m_mod "RPS-RG gesamt" SWORD FORMULA_0109 0 0 -0.5000 0.5000 ECU_ADDRESS 0x3FCF42 /end MEASUREMENT
/begin MEASUREMENT rps_rg_1of2_.myzl_ges_psau "RPS-mzyl aus psau" SWORD FORMULA_0113 0 0 -500.0000 1500.0000 ECU_ADDRESS 0x3FCF38 /end MEASUREMENT
/begin MEASUREMENT rps_rg_2of2_.myzl_ges_psau "RPS-mzyl aus psau" SWORD FORMULA_0113 0 0 -500.0000 1500.0000 ECU_ADDRESS 0x3FCF44 /end MEASUREMENT
/begin MEASUREMENT rps_rg_1of2_.m_ev "RPS-RG �ber Einlass" SWORD FORMULA_0109 0 0 -0.5000 0.5000 ECU_ADDRESS 0x3FCF3A /end MEASUREMENT
/begin MEASUREMENT rps_rg_2of2_.m_ev "RPS-RG �ber Einlass" SWORD FORMULA_0109 0 0 -0.5000 0.5000 ECU_ADDRESS 0x3FCF46 /end MEASUREMENT
/begin MEASUREMENT rps_rg_1of2_.mdt_av "RPS-RGstrom �ber Auslass" SWORD FORMULA_0112 0 0 -100.0000 1400.0000 ECU_ADDRESS 0x3FCF3C /end MEASUREMENT
/begin MEASUREMENT rps_rg_2of2_.mdt_av "RPS-RGstrom �ber Auslass" SWORD FORMULA_0112 0 0 -100.0000 1400.0000 ECU_ADDRESS 0x3FCF48 /end MEASUREMENT
/begin MEASUREMENT rps_zgla_f_zyl_1of10_ "RPS-ZGLA Faktor" UWORD FORMULA_0024 0 0 0.0 1.9999 ECU_ADDRESS 0x3FCF4A /end MEASUREMENT
/begin MEASUREMENT rps_zgla_f_zyl_2of10_ "RPS-ZGLA Faktor" UWORD FORMULA_0024 0 0 0.0 1.9999 ECU_ADDRESS 0x3FCF4C /end MEASUREMENT
/begin MEASUREMENT rps_zgla_f_zyl_3of10_ "RPS-ZGLA Faktor" UWORD FORMULA_0024 0 0 0.0 1.9999 ECU_ADDRESS 0x3FCF4E /end MEASUREMENT
/begin MEASUREMENT rps_zgla_f_zyl_4of10_ "RPS-ZGLA Faktor" UWORD FORMULA_0024 0 0 0.0 1.9999 ECU_ADDRESS 0x3FCF50 /end MEASUREMENT
/begin MEASUREMENT rps_zgla_f_zyl_5of10_ "RPS-ZGLA Faktor" UWORD FORMULA_0024 0 0 0.0 1.9999 ECU_ADDRESS 0x3FCF52 /end MEASUREMENT
/begin MEASUREMENT rps_zgla_f_zyl_6of10_ "RPS-ZGLA Faktor" UWORD FORMULA_0024 0 0 0.0 1.9999 ECU_ADDRESS 0x3FCF54 /end MEASUREMENT
/begin MEASUREMENT rps_zgla_f_zyl_7of10_ "RPS-ZGLA Faktor" UWORD FORMULA_0024 0 0 0.0 1.9999 ECU_ADDRESS 0x3FCF56 /end MEASUREMENT
/begin MEASUREMENT rps_zgla_f_zyl_8of10_ "RPS-ZGLA Faktor" UWORD FORMULA_0024 0 0 0.0 1.9999 ECU_ADDRESS 0x3FCF58 /end MEASUREMENT
/begin MEASUREMENT rps_zgla_f_zyl_9of10_ "RPS-ZGLA Faktor" UWORD FORMULA_0024 0 0 0.0 1.9999 ECU_ADDRESS 0x3FCF5A /end MEASUREMENT
/begin MEASUREMENT rps_zgla_f_zyl_10of10_ "RPS-ZGLA Faktor" UWORD FORMULA_0024 0 0 0.0 1.9999 ECU_ADDRESS 0x3FCF5C /end MEASUREMENT
/begin MEASUREMENT rps_zgla_st "RPS-ZGLA Status" UWORD FORMULA_0010 0 0 0.0 65535.0000 ECU_ADDRESS 0x3FCF5E /end MEASUREMENT
/begin MEASUREMENT rps_zgla_offs_zyl_1of10_ "RPS-ZGLA Offset" SWORD FORMULA_0531 0 0 -512.0000 511.0000 ECU_ADDRESS 0x3FCF60 /end MEASUREMENT
/begin MEASUREMENT rps_zgla_offs_zyl_2of10_ "RPS-ZGLA Offset" SWORD FORMULA_0531 0 0 -512.0000 511.0000 ECU_ADDRESS 0x3FCF62 /end MEASUREMENT
/begin MEASUREMENT rps_zgla_offs_zyl_3of10_ "RPS-ZGLA Offset" SWORD FORMULA_0531 0 0 -512.0000 511.0000 ECU_ADDRESS 0x3FCF64 /end MEASUREMENT
/begin MEASUREMENT rps_zgla_offs_zyl_4of10_ "RPS-ZGLA Offset" SWORD FORMULA_0531 0 0 -512.0000 511.0000 ECU_ADDRESS 0x3FCF66 /end MEASUREMENT
/begin MEASUREMENT rps_zgla_offs_zyl_5of10_ "RPS-ZGLA Offset" SWORD FORMULA_0531 0 0 -512.0000 511.0000 ECU_ADDRESS 0x3FCF68 /end MEASUREMENT
/begin MEASUREMENT rps_zgla_offs_zyl_6of10_ "RPS-ZGLA Offset" SWORD FORMULA_0531 0 0 -512.0000 511.0000 ECU_ADDRESS 0x3FCF6A /end MEASUREMENT
/begin MEASUREMENT rps_zgla_offs_zyl_7of10_ "RPS-ZGLA Offset" SWORD FORMULA_0531 0 0 -512.0000 511.0000 ECU_ADDRESS 0x3FCF6C /end MEASUREMENT
/begin MEASUREMENT rps_zgla_offs_zyl_8of10_ "RPS-ZGLA Offset" SWORD FORMULA_0531 0 0 -512.0000 511.0000 ECU_ADDRESS 0x3FCF6E /end MEASUREMENT
/begin MEASUREMENT rps_zgla_offs_zyl_9of10_ "RPS-ZGLA Offset" SWORD FORMULA_0531 0 0 -512.0000 511.0000 ECU_ADDRESS 0x3FCF70 /end MEASUREMENT
/begin MEASUREMENT rps_zgla_offs_zyl_10of10_ "RPS-ZGLA Offset" SWORD FORMULA_0531 0 0 -512.0000 511.0000 ECU_ADDRESS 0x3FCF72 /end MEASUREMENT
/begin MEASUREMENT rps_te_st "RPS-TE Status" UWORD FORMULA_0010 0 0 0.0 65535.0000 ECU_ADDRESS 0x3FCF74 /end MEASUREMENT
/begin MEASUREMENT rps_tetv_freq "RPS-TE Frequenz Ventil" UWORD FORMULA_1082 0 0 10.0000 50.0000 ECU_ADDRESS 0x3FCF76 /end MEASUREMENT
/begin MEASUREMENT rps_tetv_mks_zyl_1of2_ "RPS-TE Kraftstoffmasse" SWORD FORMULA_0752 0 0 -512.0000 511.0000 ECU_ADDRESS 0x3FCF78 /end MEASUREMENT
/begin MEASUREMENT rps_tetv_mks_zyl_2of2_ "RPS-TE Kraftstoffmasse" SWORD FORMULA_0752 0 0 -512.0000 511.0000 ECU_ADDRESS 0x3FCF7A /end MEASUREMENT
/begin MEASUREMENT rps_tetv_soll_1of2_ "RPS-TE Kraftstoffmasse" UWORD FORMULA_0001 0 0 0.0 100.0000 ECU_ADDRESS 0x3FCF7C /end MEASUREMENT
/begin MEASUREMENT rps_tetv_soll_2of2_ "RPS-TE Kraftstoffmasse" UWORD FORMULA_0001 0 0 0.0 100.0000 ECU_ADDRESS 0x3FCF7E /end MEASUREMENT
/begin MEASUREMENT rps_lam_soll_offs_1of2_ "RPS-Solllambda" SWORD FORMULA_0025 0 0 -0.5000 0.5000 ECU_ADDRESS 0x3FCF80 /end MEASUREMENT
/begin MEASUREMENT rps_lam_soll_offs_2of2_ "RPS-Solllambda" SWORD FORMULA_0025 0 0 -0.5000 0.5000 ECU_ADDRESS 0x3FCF82 /end MEASUREMENT
/begin MEASUREMENT rps_msa_elu_pwm "geforderte E-Luefterdrehzahl" UBYTE FORMULA_0032 0 0 0.0 100.0000 ECU_ADDRESS 0x3FCF84 /end MEASUREMENT
/* ------------------ Abschnitt erzeugt aus sa_we.dat ------------------ */
/begin CHARACTERISTIC K_SA_MD_FW_REL_MIN "relatvie Momenentenschwelle Zugbetr. in Schubbetrieb direkt | EN: relatvie Momenentenschwelle Zugbetr. in Schubbetrieb direkt" VALUE 0x76634 TKW_VV_VV_SW 100.0 FORMULA_0001 0.0 100.0000 FORMAT "%4.1" /end CHARACTERISTIC
/begin CHARACTERISTIC K_SA_MD_HYS "absolute Drehmomenthyst. fuer Erkennung SA | EN: absolute Drehm omenthyst. fuer Erkennung SA" VALUE 0x76636 TKW_VV_VV_SW 100.0 FORMULA_0001 0.0 100.0000 FORMAT "%4.1" /end CHARACTERISTIC
/begin CHARACTERISTIC K_SA_MD_IND_NE_MAX "max. ind. Motormoment nach Eingriff fuer direkten Ueberg. nach SA | EN: max. ind. Motormoment nach Eingriff fuer dire kten Ueberg. nach SA" VALUE 0x76638 TKW_VV_VV_SW 100.0 FORMULA_0009 -100.0000 1000.0000 FORMAT "%4.1" /end CHARACTERISTIC
/begin CHARACTERISTIC K_SA_MD_IND_NE_MIN "absolute md-Schwelle fuer Aktivierung der SA | EN: absolute md -Schwelle fuer Aktivierung der SA" VALUE 0x7663A TKW_VV_VV_SW 100.0 FORMULA_0009 -100.0000 1000.0000 FORMAT "%4.1" /end CHARACTERISTIC
/begin CHARACTERISTIC K_SA_TKAT_MIN "minimale Katalysatortemp. fuer Freigabe SA | EN: minimale Kataly satortemp. fuer Freigabe SA" VALUE 0x7663C TKW_VV_VV_SW 100.0 FORMULA_0023 -1000.0000 1000.0000 FORMAT "%4.1" /end CHARACTERISTIC
/begin CHARACTERISTIC K_SA_WE_MD_HYS "absolute md-Schwelle fuer Erkennung WE | EN: absolute md -Schwelle fuer Erkennung WE" VALUE 0x7663E TKW_VV_VV_SW 100.0 FORMULA_0001 0.0 100.0000 FORMAT "%4.1" /end CHARACTERISTIC
/begin CHARACTERISTIC K_SA_N_HYS "allg. Hyst. SA-Drehzahl | EN: allg. Hyst. SA-Drehzahl" VALUE 0x76640 TKW_VV_VV_SW 100.0 FORMULA_0006 0.0 10000.0000 /end CHARACTERISTIC
/begin CHARACTERISTIC K_SA_TZ_MIN_HYS "Hysterese f�r tzmin | EN: Hysterese für tzmin" VALUE 0x76642 TKW_VV_VV_SW 100.0 FORMULA_0111 -50.0000 60.0000 FORMAT "%4.1" /end CHARACTERISTIC
/begin CHARACTERISTIC K_SA_MSR_SPERRZEIT "Hysterese f�r tzmin | EN: Hysterese für tzmin" VALUE 0x76644 TKW_VV_VV_UW 100.0 FORMULA_0117 0.0 325.0000 FORMAT "%5.2" /end CHARACTERISTIC
/begin CHARACTERISTIC KL_SA_N_GANG "gangabhaengiger Offset fuer WE-drehzalberechnung | EN: gangabhaengiger Offset fuer WE -drehzalberechnung" CURVE 0x76646 TKL_SW_VV_SW 100.0 FORMULA_0006 0.0 10000.0000 /begin AXIS_DESCR STD_AXIS gang FORMULA_0010 10 -1.0000 10.0000 /end AXIS_DESCR /end CHARACTERISTIC
/begin CHARACTERISTIC KL_SA_N_TMOT "tmot abhaeng. Offset fuer WA-berechnung | EN: Engine-temperature-dependent offset for resume calculation" CURVE 0x76670 TKL_SW_VV_SW 100.0 FORMULA_0006 0.0 10000.0000
 /begin AXIS_DESCR STD_AXIS tmot FORMULA_0023 4 -50.0000 170.0000 FORMAT "%4.1" /end AXIS_DESCR
/end CHARACTERISTIC
/begin CHARACTERISTIC KL_SA_N_DYN "Drehzalgradientenabhae. Offset fuer WA-Drezahlberechnung | EN: Engine-speed-gradient-dependent offset for overrun-resume speed calculation" CURVE 0x76682 TKL_SW_VV_SW 100.0 FORMULA_0006 0.0 10000.0000 /begin AXIS_DESCR STD_AXIS dn FORMULA_0114 4 -10000.0000 10000.0000 /end AXIS_DESCR /end CHARACTERISTIC
/begin CHARACTERISTIC KL_SA_N_HYS_GANG "gangabh. Hyst. SA-Drehzahl | EN: Gear-dependent hysteresis of fuel cut-off speed" CURVE 0x76694 TKL_SW_VV_SW 100.0 FORMULA_0006 0.0 10000.0000 /begin AXIS_DESCR STD_AXIS gang FORMULA_0010 10 -1.0000 10.0000 /end AXIS_DESCR /end CHARACTERISTIC
/begin CHARACTERISTIC KF_SA_T_TRIG_MAX "Saugrohrdruckdelta | EN: Intake manifold pressure delta (dwell time)" MAP 0x766BE TKF_SW_SW_UW 100.0 FORMULA_0117 0.0 325.0000
 /begin AXIS_DESCR STD_AXIS tmot_loc FORMULA_0023 4 -50.0000 170.0000 FORMAT "%4.1" /end AXIS_DESCR
 /begin AXIS_DESCR STD_AXIS n FORMULA_0006 6 0.0 10000.0000 /end AXIS_DESCR
 FORMAT "%5.2" /end CHARACTERISTIC
/begin MEASUREMENT sa_n "Drehzahlschwelle fuer Schubabschalten" SWORD FORMULA_0006 0 0 0.0 10000.0000 ECU_ADDRESS 0x3FCFAC /end MEASUREMENT
/begin MEASUREMENT sa_t_sa_trig "Verweilzeit im Zustand SA-Trigger" UWORD FORMULA_0117 0 0 0.0 325.0000 ECU_ADDRESS 0x3FCFAE /end MEASUREMENT
/begin MEASUREMENT sa_t_sa_trig_max "Maximale Verweilzeit im Zustand SA-Trigger" UWORD FORMULA_0117 0 0 0.0 325.0000 ECU_ADDRESS 0x3FCFB0 /end MEASUREMENT
/begin MEASUREMENT sa_msr_t_sperre "MSR Sperrzeit fuer SA" UWORD FORMULA_0117 0 0 0.0 325.0000 ECU_ADDRESS 0x3FCFB2 /end MEASUREMENT
/* ------------------ Abschnitt erzeugt aus spgr.dat ------------------ */
/begin CHARACTERISTIC KL_SPGR_FREQ "Spannungesregler Switchingfreq | EN: Voltage regulator switching frequency" CURVE 0x76CEE TKL_SW_VV_UW 100.0 FORMULA_1126 228.0000 700.0000
 /begin AXIS_DESCR STD_AXIS temperatur FORMULA_0023 2 -50.0000 170.0000 FORMAT "%4.1" /end AXIS_DESCR
/end CHARACTERISTIC
/begin MEASUREMENT spgr_freq "" UBYTE FORMULA_1125 0 0 228.0000 700.0000 ECU_ADDRESS 0x3FD087 /end MEASUREMENT
/* ------------------ Abschnitt erzeugt aus stat_data.dat ------------------ */
/begin CHARACTERISTIC KL_STAT_DATA_N "Kennlinie Drehzahl n fuer Statistik | EN: Curve: engine speed for statistics" CURVE 0x76D14 TKL_SW_VV_SW 100.0 FORMULA_0010 0.0 7.0000 /begin AXIS_DESCR STD_AXIS n FORMULA_0006 8 0.0 10000.0000 /end AXIS_DESCR /end CHARACTERISTIC
/begin CHARACTERISTIC KL_STAT_DATA_RF "Kennlinie relative Fuellung rf fuer Statistik | EN: Curve: relative charge for statistics" CURVE 0x76D36 TKL_SW_VV_SW 100.0 FORMULA_0010 0.0 6.0000 /begin AXIS_DESCR STD_AXIS rf_m FORMULA_0007 7 0.0 2.0000 FORMAT "%6.3" /end AXIS_DESCR /end CHARACTERISTIC
/begin CHARACTERISTIC KL_STAT_DATA_TMOT "Kennlinie Motor-Temperatur tmot fuer Statistik | EN: Curve: engine temperature for statistics" CURVE 0x76D54 TKL_SW_VV_SW 100.0 FORMULA_0010 0.0 7.0000
 /begin AXIS_DESCR STD_AXIS tmot FORMULA_0023 8 -50.0000 170.0000 FORMAT "%4.1" /end AXIS_DESCR
/end CHARACTERISTIC
/begin CHARACTERISTIC KL_STAT_DATA_TOEL "KL Oel-Temperatur toel am Oelfilterkopf fuer Statistik | EN: Curve: oil temperature at oil filter head for statistics" CURVE 0x76D76 TKL_SW_VV_SW 100.0 FORMULA_0010 0.0 7.0000
 /begin AXIS_DESCR STD_AXIS toel FORMULA_0023 8 -50.0000 170.0000 FORMAT "%4.1" /end AXIS_DESCR
/end CHARACTERISTIC
/begin CHARACTERISTIC KL_STAT_DATA_TDME "Kennlinie ECU-Temperatur tdme fuer Statistik | EN: Curve: ECU temperature for statistics" CURVE 0x76D98 TKL_SW_VV_SW 100.0 FORMULA_0010 0.0 7.0000
 /begin AXIS_DESCR STD_AXIS tdme FORMULA_0023 8 -50.0000 170.0000 FORMAT "%4.1" /end AXIS_DESCR
/end CHARACTERISTIC
/begin MEASUREMENT stat_data_reset "Freigabe zum Loeschen von n/rf per CBS-Reset" UBYTE FORMULA_0003 0 0 0.0 255.0000 ECU_ADDRESS 0x3FD0C2 /end MEASUREMENT
/* ------------------ Abschnitt erzeugt aus td_diag.dat ------------------ */
/begin CHARACTERISTIC K_TD_DIAG_CFG "Aktivierung der Fehlerarten. | EN: Aktivierung der Fehlerarten." VALUE 0x76E50 TKW_VV_VV_UB 100.0 FORMULA_0228 0.0 15.0 BIT_MASK 0xF /end CHARACTERISTIC
/begin FUNCTION diag_tr "" /begin DEF_CHARACTERISTIC K_DIAG_TR_MAX_ERR K_TD_DIAG_CFG /end DEF_CHARACTERISTIC /begin REF_CHARACTERISTIC /end REF_CHARACTERISTIC /begin IN_MEASUREMENT /end IN_MEASUREMENT
 /begin OUT_MEASUREMENT diag_st_atic35_AKL diag_st_atic35_EKP diag_st_atic35_EVAP2 diag_st_atic35_KLIMA diag_st_atic35_NWA1 diag_st_atic35_NWA2 diag_st_atic35_NWE1 diag_st_atic35_NWE2 diag_st_atic35_SERVO_EVAP1 diag_st_atic35_SPORTLED diag_st_atic35_TD diag_st_atic35_VANOSDSV diag_st_atic35_nn diag_st_atic39_DK1_ENABLE diag_st_atic39_DK2_ENABLE diag_st_atic39_DMTLH diag_st_atic39_DMTLP diag_st_atic39_DMTLV diag_st_atic39_EBOXL diag_st_atic39_ELUE diag_st_atic39_ELUP1 diag_st_atic39_ELUP2 diag_st_atic39_EV1 diag_st_atic39_EV10 diag_st_atic39_EV2 diag_st_atic39_EV3 diag_st_atic39_EV4 diag_st_atic39_EV5 diag_st_atic39_EV6 diag_st_atic39_EV7 diag_st_atic39_EV8 diag_st_atic39_EV9 diag_st_atic39_IGC1 diag_st_atic39_IGC10 diag_st_atic39_IGC11 diag_st_atic39_IGC12 diag_st_atic39_IGC2 diag_st_atic39_IGC3 diag_st_atic39_IGC4 diag_st_atic39_IGC5 diag_st_atic39_IGC6 diag_st_atic39_IGC7 diag_st_atic39_IGC8 diag_st_atic39_IGC9 diag_st_atic39_LHN1 diag_st_atic39_LHN2 diag_st_atic39_LHV1 diag_st_atic39_LHV1_ diag_st_atic39_LHV2 diag_st_atic39_LHV2_ diag_st_atic39_LLFSO diag_st_atic39_LLFSS diag_st_atic39_RLEKP diag_st_atic39_RLSLP diag_st_atic39_RLSTART diag_st_atic39_RLU87 diag_st_atic39_SLV diag_st_atic39_SLV_ diag_st_atic39_SSP diag_st_atic39_TEV1 diag_st_atic39_TEV2 diag_st_atic39_nn diag_tr_atic35_error diag_tr_atic35_st diag_tr_atic35_tx_cnt diag_tr_atic39_error diag_tr_atic39_st diag_tr_atic39_tx_cnt /end OUT_MEASUREMENT
/end FUNCTION
/begin FUNCTION fplau ""
 /begin DEF_CHARACTERISTIC KF_FPLAU_OBD_AQ_DELTA_ML_MAX KF_FPLAU_OBD_HFM_DELTA_ML_MAX KF_FPLAU_OBD_LAM_DELTA_ML_MAX K_FPLAU_AQ_OBD_CNT K_FPLAU_HFM_OBD_CNT K_FPLAU_LAM_OBD_CNT K_FPLAU_OBD_CFG K_FPLAU_OBD_DYN_DELTA_RF K_FPLAU_OBD_DYN_RF_T K_FPLAU_OBD_FR_ADAP_F K_FPLAU_OBD_KH_F K_FPLAU_OBD_ML_MAX K_FPLAU_OBD_ML_MIN K_FPLAU_OBD_N_MAX K_FPLAU_OBD_N_MIN K_FPLAU_OBD_PUMG_CSS K_FPLAU_OBD_TMOT_CSS K_FPLAU_OBD_TMOT_MIN K_FPLAU_OBD_T_DELTA K_FPLAU_OBD_T_MAX K_FPLAU_OBD_T_MIN /end DEF_CHARACTERISTIC
 /begin REF_CHARACTERISTIC /end REF_CHARACTERISTIC
 /begin IN_MEASUREMENT /end IN_MEASUREMENT
 /begin OUT_MEASUREMENT fplau_aq_obd_b1.abw fplau_aq_obd_b1.cnt fplau_aq_obd_b1.st fplau_aq_obd_b1.t fplau_aq_obd_b2.abw fplau_aq_obd_b2.cnt fplau_aq_obd_b2.st fplau_aq_obd_b2.t fplau_hfm_obd_b1.abw fplau_hfm_obd_b1.cnt fplau_hfm_obd_b1.st fplau_hfm_obd_b1.t fplau_hfm_obd_b2.abw fplau_hfm_obd_b2.cnt fplau_hfm_obd_b2.st fplau_hfm_obd_b2.t fplau_lam_obd_b1.abw fplau_lam_obd_b1.cnt fplau_lam_obd_b1.st fplau_lam_obd_b1.t fplau_lam_obd_b2.abw fplau_lam_obd_b2.cnt fplau_lam_obd_b2.st fplau_lam_obd_b2.t fplau_ml_obd_mw2_b1 fplau_ml_obd_mw2_b2 fplau_ml_obd_mw3_b1 fplau_ml_obd_mw3_b2 fplau_obd_t_delta_b1 fplau_obd_t_delta_b2 fplau_st_b1 fplau_st_b2 fplau_st_css_b1 fplau_st_css_b2 fplau_st_diagk_b1 fplau_st_diagk_b2 fplau_st_egas_dk_b1 fplau_st_egas_dk_b2 fplau_st_egas_wdk_b1 fplau_st_egas_wdk_b2 fplau_st_hfm_b1 fplau_st_hfm_b2 fplau_st_lam_b1 fplau_st_lam_b2 fplau_st_lls_b1 fplau_st_lls_b2 fplau_st_n_max_b1 fplau_st_n_max_b2 fplau_st_n_min_b1 fplau_st_n_min_b2 fplau_st_ndyn_b1 fplau_st_ndyn_b2 fplau_st_obd_mw_max_b1 fplau_st_obd_mw_max_b2 fplau_st_obd_mw_min_b1 fplau_st_obd_mw_min_b2 fplau_st_pumg_b1 fplau_st_pumg_b2 fplau_st_rfdyn_b1 fplau_st_rfdyn_b2 fplau_st_sa_b1 fplau_st_sa_b2 fplau_st_tan_b1 fplau_st_tan_b2 fplau_st_time_ml_b1 fplau_st_time_ml_b2 fplau_st_tmot_b1 fplau_st_tmot_b2 fplau_st_van_begr_b1 fplau_st_van_begr_b2 fplau_st_vanos_b1 fplau_st_vanos_b2 fplau_st_wdk_adapt_b1 fplau_st_wdk_adapt_b2 fplau_st_zyl_off_b1 fplau_st_zyl_off_b2 /end OUT_MEASUREMENT
/end FUNCTION
/begin FUNCTION kl87 "" /begin DEF_CHARACTERISTIC /end DEF_CHARACTERISTIC /begin REF_CHARACTERISTIC /end REF_CHARACTERISTIC /begin IN_MEASUREMENT /end IN_MEASUREMENT /begin OUT_MEASUREMENT /end OUT_MEASUREMENT /end FUNCTION
/begin FUNCTION kwp_fetrawe "" /begin DEF_CHARACTERISTIC /end DEF_CHARACTERISTIC /begin REF_CHARACTERISTIC /end REF_CHARACTERISTIC /begin IN_MEASUREMENT /end IN_MEASUREMENT /begin OUT_MEASUREMENT /end OUT_MEASUREMENT /end FUNCTION
/begin FUNCTION la_TRIM ""
 /begin DEF_CHARACTERISTIC KF_LA_TRIM_AD_WICHT KF_LA_TRIM_I KF_LA_TRIM_I_DLY KF_LA_TRIM_I_GMW_WICHT KF_LA_TRIM_P KF_LA_TRIM_P_ABR KF_LA_TRIM_P_DLY KF_LA_TRIM_P_WAIT KF_LA_TRIM_USN_SOLL KL_LA_TRIM_I_FAK_OBD KL_LA_TRIM_I_GMW_RF_MAX KL_LA_TRIM_I_GMW_RF_MIN KL_LA_TRIM_P_FAK_OBD KL_LA_TRIM_RF_MAX KL_LA_TRIM_RF_MIN K_LA_TRIM_CFG K_LA_TRIM_DIAG_CFG K_LA_TRIM_DIAG_I_AD_F K_LA_TRIM_DIAG_I_AD_MAX_SCHW K_LA_TRIM_DIAG_I_AD_MIN_SCHW K_LA_TRIM_DIAG_I_ED_F K_LA_TRIM_DIAG_I_MAX_SCHW K_LA_TRIM_DIAG_I_MIN_SCHW K_LA_TRIM_DIAG_I_T K_LA_TRIM_DIAG_P_SCHW K_LA_TRIM_DLY_T K_LA_TRIM_DYN_DELTA_RF K_LA_TRIM_DYN_RF_T K_LA_TRIM_DYN_T K_LA_TRIM_FKT_CFG K_LA_TRIM_I_AD_F K_LA_TRIM_I_AD_MAX K_LA_TRIM_I_AD_MCS K_LA_TRIM_I_AD_MIN K_LA_TRIM_I_GMW_DLY K_LA_TRIM_I_GMW_MAX K_LA_TRIM_I_GMW_MIN K_LA_TRIM_I_GMW_TAU K_LA_TRIM_I_MAX K_LA_TRIM_I_MIN K_LA_TRIM_I_US_DELTA_MAX K_LA_TRIM_I_US_DELTA_MIN K_LA_TRIM_LAA_F_TE K_LA_TRIM_LAM_DELTA_MAX K_LA_TRIM_P_ANZ_MAX K_LA_TRIM_P_MAX K_LA_TRIM_P_MIN K_LA_TRIM_P_US_OFFSET K_LA_TRIM_RF_HYS K_LA_TRIM_TABG_NKAT K_LA_TRIM_TAN_MAX K_LA_TRIM_TAN_MIN K_LA_TRIM_TE_C_AKF_MAX K_LA_TRIM_US_EINGER K_LA_TRIM_US_EINGESCHW K_LA_TRIM_US_O2_MAX K_LA_TRIM_US_O2_MIN K_LA_TRIM_US_SOLL_GRAD K_LA_TRIM_V_SCHWELLE /end DEF_CHARACTERISTIC
 /begin REF_CHARACTERISTIC /end REF_CHARACTERISTIC
 /begin IN_MEASUREMENT /end IN_MEASUREMENT
 /begin OUT_MEASUREMENT la_trim_diag_f_b1 la_trim_diag_f_b2 la_trim_diag_i_ad_f_b1 la_trim_diag_i_ad_f_b2 la_trim_diag_i_ad_max_cnt_b1 la_trim_diag_i_ad_max_cnt_b2 la_trim_diag_i_ad_min_cnt_b1 la_trim_diag_i_ad_min_cnt_b2 la_trim_diag_i_ed_f_b1 la_trim_diag_i_ed_f_b2 la_trim_diag_i_max_cnt_b1 la_trim_diag_i_max_cnt_b2 la_trim_diag_i_min_cnt_b1 la_trim_diag_i_min_cnt_b2 la_trim_diag_m_b1 la_trim_diag_m_b2 la_trim_diag_p_cnt_b1 la_trim_diag_p_cnt_b2 la_trim_diag_st_b1 la_trim_diag_st_b2 la_trim_i_b1 la_trim_i_b2 la_trim_i_dly_b1 la_trim_i_dly_b2 la_trim_i_f_b1 la_trim_i_f_b2 la_trim_i_fak_obd_b1 la_trim_i_fak_obd_b2 la_trim_i_gmw_b1 la_trim_i_gmw_b2 la_trim_i_inc_b1 la_trim_i_inc_b2 la_trim_lam_soll_b1 la_trim_lam_soll_b2 la_trim_p_abr_b1 la_trim_p_abr_b2 la_trim_p_anz_b1 la_trim_p_anz_b2 la_trim_p_b1 la_trim_p_b2 la_trim_p_dez_b1 la_trim_p_dez_b2 la_trim_p_dly_b1 la_trim_p_dly_b2 la_trim_p_f_b1 la_trim_p_f_b2 la_trim_p_fak_obd_b1 la_trim_p_fak_obd_b2 la_trim_p_wait_b1 la_trim_p_wait_b2 la_trim_st_b1 la_trim_st_b2 la_trim_st_cfg_b1 la_trim_st_cfg_b2 la_trim_st_error_b1 la_trim_st_error_b2 la_trim_st_kats_b1 la_trim_st_kats_b2 la_trim_st_kh_b1 la_trim_st_kh_b2 la_trim_st_laa_lim_b1 la_trim_st_laa_lim_b2 la_trim_st_nkat_verf_b1 la_trim_st_nkat_verf_b2 la_trim_st_puls_ausr_b1 la_trim_st_puls_ausr_b2 la_trim_st_rf_b1 la_trim_st_rf_b2 la_trim_st_sk_b1 la_trim_st_sk_b2 la_trim_st_slp_b1 la_trim_st_slp_b2 la_trim_st_soll_add_b1 la_trim_st_soll_add_b2 la_trim_st_soll_norm_b1 la_trim_st_soll_norm_b2 la_trim_st_te_b1 la_trim_st_te_b2 la_trim_st_temperatur_b1 la_trim_st_temperatur_b2 la_trim_st_v_b1 la_trim_st_v_b2 la_trim_us_diff_b1 la_trim_us_diff_b2 la_trim_usn_aebg_b1 la_trim_usn_aebg_b2 la_trim_usn_soll_b1 la_trim_usn_soll_b2 la_trim_zust_ad_erm_b1 la_trim_zust_ad_erm_b2 la_trim_zust_b1 la_trim_zust_b2 la_trim_zust_i_ad_max_b1 la_trim_zust_i_ad_max_b2 la_trim_zust_i_ad_min_b1 la_trim_zust_i_ad_min_b2 la_trim_zust_i_b1 la_trim_zust_i_b2 la_trim_zust_i_gmw_aktiv_b1 la_trim_zust_i_gmw_aktiv_b2 la_trim_zust_i_init_gmw_b1 la_trim_zust_i_init_gmw_b2 la_trim_zust_i_max_b1 la_trim_zust_i_max_b2 la_trim_zust_i_min_b1 la_trim_zust_i_min_b2 la_trim_zust_p_abger_b1 la_trim_zust_p_abger_b2 la_trim_zust_p_b1 la_trim_zust_p_b2 la_trim_zust_us_o2_b1 la_trim_zust_us_o2_b2 /end OUT_MEASUREMENT
/end FUNCTION
/begin FUNCTION pabg "" /begin DEF_CHARACTERISTIC KL_PABG_STAT_ML K_PABG_STAT_TAU /end DEF_CHARACTERISTIC /begin REF_CHARACTERISTIC /end REF_CHARACTERISTIC /begin IN_MEASUREMENT /end IN_MEASUREMENT
 /begin OUT_MEASUREMENT pabg_b1 pabg_b1.dif pabg_b1.pabg_10ms pabg_b1.stat_roh pabg_b1.tau pabg_b2 pabg_b2.dif pabg_b2.pabg_10ms pabg_b2.stat_roh pabg_b2.tau pabg_m /end OUT_MEASUREMENT
/end FUNCTION
/begin FUNCTION qadc_conf "" /begin DEF_CHARACTERISTIC /end DEF_CHARACTERISTIC /begin REF_CHARACTERISTIC /end REF_CHARACTERISTIC /begin IN_MEASUREMENT /end IN_MEASUREMENT
 /begin OUT_MEASUREMENT qadc_check_ccw_adr qadc_check_ccw_st qadc_err_cnt qadc_hfm_anz_read qadc_hfm_cwp_alt qadc_hfm_last_samples_1of2_ qadc_hfm_last_samples_2of2_ qadc_hfm_no_sample_cnt qadc_hfm_ovr_error_cnt qadc_lavk_anz_b1 qadc_lavk_anz_b2 qadc_lavk_anz_read qadc_lavk_cwp_alt qadc_lavk_last_samples_1of2_ qadc_lavk_last_samples_2of2_ qadc_lavk_no_sample_cnt qadc_lavk_ovr_error_cnt qadc_lavk_sum_b1 qadc_lavk_sum_b2 qadc_lavk_wrp qadc_lsv_h_st qadc_sync_hfm_zz_upd qadca_unerlaubter_irq /end OUT_MEASUREMENT
/end FUNCTION
/begin FUNCTION rf_e2 ""
 /begin DEF_CHARACTERISTIC KF_RF_E2_MAX KL_RF_E2_HFM_AD KL_RF_E2_PUMG_KORR KL_RF_E2_TAN_KORR K_RF_E2_DYN_DELTA K_RF_E2_DYN_T K_RF_E2_DYN_TAU K_RF_E2_HFM_TAU K_RF_E2_T_MAX /end DEF_CHARACTERISTIC
 /begin REF_CHARACTERISTIC /end REF_CHARACTERISTIC
 /begin IN_MEASUREMENT /end IN_MEASUREMENT
 /begin OUT_MEASUREMENT rf_e2_abw_b1 rf_e2_abw_b2 rf_e2_berech_1of2_ rf_e2_berech_2of2_ rf_e2_dyn rf_e2_dyn_delta rf_e2_dyn_st rf_e2_ml_b1 rf_e2_ml_b2 rf_e2_t_b1 rf_e2_t_b2 /end OUT_MEASUREMENT
/end FUNCTION
/begin FUNCTION rps "" /begin DEF_CHARACTERISTIC K_RPS_CFG /end DEF_CHARACTERISTIC /begin REF_CHARACTERISTIC /end REF_CHARACTERISTIC /begin IN_MEASUREMENT /end IN_MEASUREMENT
 /begin OUT_MEASUREMENT rps_laa_f_1of2_ rps_laa_f_2of2_ rps_laa_offs_1of2_ rps_laa_offs_2of2_ rps_laa_st_1of2_ rps_laa_st_2of2_ rps_lam_delta_lim_1of2_ rps_lam_delta_lim_2of2_ rps_lam_reg_f_1of2_ rps_lam_reg_f_2of2_ rps_lam_reg_st_1of2_ rps_lam_reg_st_2of2_ rps_lam_soll_offs_1of2_ rps_lam_soll_offs_2of2_ rps_msa_elu_pwm rps_pks_st rps_rg_1of2_.m_av rps_rg_1of2_.m_ev rps_rg_1of2_.m_mod rps_rg_1of2_.m_tot rps_rg_1of2_.mdt_av rps_rg_1of2_.myzl_ges_psau rps_rg_2of2_.m_av rps_rg_2of2_.m_ev rps_rg_2of2_.m_mod rps_rg_2of2_.m_tot rps_rg_2of2_.mdt_av rps_rg_2of2_.myzl_ges_psau rps_tan rps_tan_zust rps_te_st rps_tetv_freq rps_tetv_mks_zyl_1of2_ rps_tetv_mks_zyl_2of2_ rps_tetv_soll_1of2_ rps_tetv_soll_2of2_ rps_tmot rps_van_kh_st rps_van_soll_kh_off_1of4_ rps_van_soll_kh_off_2of4_ rps_van_soll_kh_off_3of4_ rps_van_soll_kh_off_4of4_ rps_wf_mks_10of10_ rps_wf_mks_1of10_ rps_wf_mks_2of10_ rps_wf_mks_3of10_ rps_wf_mks_4of10_ rps_wf_mks_5of10_ rps_wf_mks_6of10_ rps_wf_mks_7of10_ rps_wf_mks_8of10_ rps_wf_mks_9of10_ rps_wf_st rps_zgla_f_zyl_10of10_ rps_zgla_f_zyl_1of10_ rps_zgla_f_zyl_2of10_ rps_zgla_f_zyl_3of10_ rps_zgla_f_zyl_4of10_ rps_zgla_f_zyl_5of10_ rps_zgla_f_zyl_6of10_ rps_zgla_f_zyl_7of10_ rps_zgla_f_zyl_8of10_ rps_zgla_f_zyl_9of10_ rps_zgla_offs_zyl_10of10_ rps_zgla_offs_zyl_1of10_ rps_zgla_offs_zyl_2of10_ rps_zgla_offs_zyl_3of10_ rps_zgla_offs_zyl_4of10_ rps_zgla_offs_zyl_5of10_ rps_zgla_offs_zyl_6of10_ rps_zgla_offs_zyl_7of10_ rps_zgla_offs_zyl_8of10_ rps_zgla_offs_zyl_9of10_ rps_zgla_st rps_zust_allg_1of2_ rps_zust_allg_2of2_ /end OUT_MEASUREMENT
/end FUNCTION
/begin FUNCTION sa_we ""
 /begin DEF_CHARACTERISTIC KF_SA_T_TRIG_MAX KL_SA_N_DYN KL_SA_N_GANG KL_SA_N_HYS_GANG KL_SA_N_TMOT K_SA_MD_FW_REL_MIN K_SA_MD_HYS K_SA_MD_IND_NE_MAX K_SA_MD_IND_NE_MIN K_SA_MSR_SPERRZEIT K_SA_N_HYS K_SA_TKAT_MIN K_SA_TZ_MIN_HYS K_SA_WE_MD_HYS /end DEF_CHARACTERISTIC
 /begin REF_CHARACTERISTIC /end REF_CHARACTERISTIC
 /begin IN_MEASUREMENT /end IN_MEASUREMENT
 /begin OUT_MEASUREMENT sa_msr_t_sperre sa_n sa_t_sa_trig sa_t_sa_trig_max /end OUT_MEASUREMENT
/end FUNCTION
/begin FUNCTION spgr "" /begin DEF_CHARACTERISTIC KL_SPGR_FREQ /end DEF_CHARACTERISTIC /begin REF_CHARACTERISTIC /end REF_CHARACTERISTIC /begin IN_MEASUREMENT /end IN_MEASUREMENT /begin OUT_MEASUREMENT spgr_freq /end OUT_MEASUREMENT /end FUNCTION
/begin FUNCTION spi "" /begin DEF_CHARACTERISTIC /end DEF_CHARACTERISTIC /begin REF_CHARACTERISTIC /end REF_CHARACTERISTIC /begin IN_MEASUREMENT /end IN_MEASUREMENT
 /begin OUT_MEASUREMENT spim_errorcode spim_errorcounter spim_reqcounter spim_status /end OUT_MEASUREMENT
/end FUNCTION
/begin FUNCTION stat_data ""
 /begin DEF_CHARACTERISTIC KL_STAT_DATA_N KL_STAT_DATA_RF KL_STAT_DATA_TDME KL_STAT_DATA_TMOT KL_STAT_DATA_TOEL /end DEF_CHARACTERISTIC
 /begin REF_CHARACTERISTIC /end REF_CHARACTERISTIC
 /begin IN_MEASUREMENT /end IN_MEASUREMENT
 /begin OUT_MEASUREMENT stat_data_reset /end OUT_MEASUREMENT
/end FUNCTION
/begin FUNCTION sw_confg_exd "" /begin DEF_CHARACTERISTIC /end DEF_CHARACTERISTIC /begin REF_CHARACTERISTIC /end REF_CHARACTERISTIC /begin IN_MEASUREMENT /end IN_MEASUREMENT /begin OUT_MEASUREMENT /end OUT_MEASUREMENT /end FUNCTION
/begin RECORD_LAYOUT TKW_VV_VV_UB FNC_VALUES 1 UBYTE COLUMN_DIR DIRECT /end RECORD_LAYOUT
/begin RECORD_LAYOUT TKW_VV_VV_UW FNC_VALUES 1 UWORD COLUMN_DIR DIRECT /end RECORD_LAYOUT
/begin RECORD_LAYOUT TKW_VV_VV_SW FNC_VALUES 1 SWORD COLUMN_DIR DIRECT /end RECORD_LAYOUT
/begin RECORD_LAYOUT TKL_UW_VV_UW NO_AXIS_PTS_X 1 UBYTE RESERVED 2 BYTE AXIS_PTS_X 3 UWORD INDEX_INCR DIRECT FNC_VALUES 4 UWORD COLUMN_DIR DIRECT /end RECORD_LAYOUT
/begin RECORD_LAYOUT TKL_SW_VV_UW NO_AXIS_PTS_X 1 UBYTE RESERVED 2 BYTE AXIS_PTS_X 3 SWORD INDEX_INCR DIRECT FNC_VALUES 4 UWORD COLUMN_DIR DIRECT /end RECORD_LAYOUT
/begin RECORD_LAYOUT TKL_SW_VV_SW NO_AXIS_PTS_X 1 UBYTE RESERVED 2 BYTE AXIS_PTS_X 3 SWORD INDEX_INCR DIRECT FNC_VALUES 4 SWORD COLUMN_DIR DIRECT /end RECORD_LAYOUT
/begin RECORD_LAYOUT TKF_SW_SW_UW NO_AXIS_PTS_X 1 UBYTE NO_AXIS_PTS_Y 2 UBYTE AXIS_PTS_X 3 SWORD INDEX_INCR DIRECT AXIS_PTS_Y 4 SWORD INDEX_INCR DIRECT FNC_VALUES 5 UWORD COLUMN_DIR DIRECT /end RECORD_LAYOUT
/begin RECORD_LAYOUT TKF_SW_SW_SW NO_AXIS_PTS_X 1 UBYTE NO_AXIS_PTS_Y 2 UBYTE AXIS_PTS_X 3 SWORD INDEX_INCR DIRECT AXIS_PTS_Y 4 SWORD INDEX_INCR DIRECT FNC_VALUES 5 SWORD COLUMN_DIR DIRECT /end RECORD_LAYOUT
/* ---- V452-specific parameters (names assigned during V452 reverse engineering) ---- */
/begin CHARACTERISTIC KL_PKSR_QSSP_UB_F "[V452-new, name assigned] Factor on SSP volume flow over battery voltage U_KL87 (fn 0x55B8C: KF_PKSR_PSOLL_QSOLL_TV result x curve /1024 -> RAM 0x3FCCB4)" CURVE 0x75702 TKL_SW_VV_SW 32.0 FORMULA_0075 0.0 31.999 /begin AXIS_DESCR STD_AXIS ub FORMULA_0008 4 0.0 3276.7 /end AXIS_DESCR /end CHARACTERISTIC
/* ---- added 04.11.2026: further code-read calibration ---- */
/begin CHARACTERISTIC UNK_SK_SELFTEST_KL_068B0 "Safety-concept lookup self-test reference table (fixed test vectors from ROM). Not tuning data - DO NOT MODIFY. [Added V452 04.11.2026]" CURVE 0x768B0 TKL_SW_VV_SW 32767.0 FORMULA_USER1 -32768.0 32767.0
 /begin AXIS_DESCR STD_AXIS NO_INPUT_QUANTITY FORMULA_USER1 5 -32768.0 32767.0 /end AXIS_DESCR
/end CHARACTERISTIC
/begin CHARACTERISTIC UNK_SK_SELFTEST_KF_068C6 "Safety-concept lookup self-test reference table (fixed test vectors from ROM). Not tuning data - DO NOT MODIFY. [Added V452 04.11.2026]" MAP 0x768C6 TKF_SW_SW_SW 32767.0 FORMULA_USER1 -32768.0 32767.0
 /begin AXIS_DESCR STD_AXIS NO_INPUT_QUANTITY FORMULA_USER1 4 -32768.0 32767.0 /end AXIS_DESCR
 /begin AXIS_DESCR STD_AXIS NO_INPUT_QUANTITY FORMULA_USER1 4 -32768.0 32767.0 /end AXIS_DESCR
/end CHARACTERISTIC
/begin CHARACTERISTIC UNK_SK_SELFTEST_KF_068F8 "Safety-concept lookup self-test reference table (fixed test vectors from ROM). Not tuning data - DO NOT MODIFY. [Added V452 04.11.2026]" MAP 0x768F8 TKF_SW_SW_SW 32767.0 FORMULA_USER1 -32768.0 32767.0
 /begin AXIS_DESCR STD_AXIS NO_INPUT_QUANTITY FORMULA_USER1 4 -32768.0 32767.0 /end AXIS_DESCR
 /begin AXIS_DESCR STD_AXIS NO_INPUT_QUANTITY FORMULA_USER1 4 -32768.0 32767.0 /end AXIS_DESCR
/end CHARACTERISTIC
/begin CHARACTERISTIC UNK_RD_INJ_0958E "[Added 04.11.2026] Unidentified - engine-state monitoring (code 0x124A70/0x1241B8, fault paths 0x88/0x89): counter limit, fault path 0x88 (raw 20)" VALUE 0x7958E TKW_VV_VV_UB 255.0 FORMULA_USER1 0.0 255.0 FORMAT "%6.0" /end CHARACTERISTIC
/begin CHARACTERISTIC UNK_RD_INJ_09590 "[Added 04.11.2026] Unidentified - engine-state monitoring (code 0x124A70/0x1241B8, fault paths 0x88/0x89): engine speed threshold (raw 1500 rpm)" VALUE 0x79590 TKW_VV_VV_SW 32767.0 FORMULA_USER1 -32768.0 32767.0 FORMAT "%6.0" /end CHARACTERISTIC
/begin CHARACTERISTIC UNK_RD_INJ_09592 "[Added 04.11.2026] Unidentified - engine-state monitoring (code 0x124A70/0x1241B8, fault paths 0x88/0x89): engine speed threshold (raw 2000 rpm)" VALUE 0x79592 TKW_VV_VV_SW 32767.0 FORMULA_USER1 -32768.0 32767.0 FORMAT "%6.0" /end CHARACTERISTIC
/begin CHARACTERISTIC UNK_RD_INJ_09594 "[Added 04.11.2026] Unidentified - engine-state monitoring (code 0x124A70/0x1241B8, fault paths 0x88/0x89): counter limit (raw 5)" VALUE 0x79594 TKW_VV_VV_UB 255.0 FORMULA_USER1 0.0 255.0 FORMAT "%6.0" /end CHARACTERISTIC
/begin CHARACTERISTIC UNK_RD_INJ_09595 "[Added 04.11.2026] Unidentified - engine-state monitoring (code 0x124A70/0x1241B8, fault paths 0x88/0x89): counter limit (raw 100)" VALUE 0x79595 TKW_VV_VV_UB 255.0 FORMULA_USER1 0.0 255.0 FORMAT "%6.0" /end CHARACTERISTIC
/end MODULE
/end PROJECT
