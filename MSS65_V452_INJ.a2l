/* ------------------------------------------------------------------
MSS65 INJ A2L - Calibration B584696 (V452.01-B204.00, data set 0569Q60Z160E)
Created by ZiMMie for the M5Board and Nam3Forum communities.
This project exists to make this information freely available to
everyone: to share the work, encourage collaboration, and let others
learn from it, use it and add their own knowledge.
The reference material is based on publicly available program data.
The V452 program was disassembled and analysed to place and verify the
definitions for this calibration.
This is a community effort, and every contribution matters.
Corrections, additional findings, technical knowledge and general
feedback are all very welcome. The more knowledge is shared and the
more people work together, the more can be achieved.
Completely free to use and share.
------------------------------------------------------------------ */
/* Technical notes - V452 definitions.
Calibration addresses remapped by structural + code alignment against the V452 full read (04.11.2026).
Calibration layout: 0x75702-0x75713 holds the V452-specific curve KL_PKSR_QSSP_UB_F.
English text (EN:) taken from the MSS60 V762 definition where the name matches.
RAM measurements: 98.7% of code-accessed addresses confirmed in V452; blocks marked "V452 CHECK" are not valid. */
/begin PROJECT MSS65-inj-V452 "MSS65 INJ - V452.01-B204.00, data set 0569Q60Z160E"
/begin HEADER "" VERSION "V452.01-B204.00" /end HEADER
/begin MODULE _MSS65-inj "MSS65 INJ - V452.01-B204.00, calibration xxxxxxxx"
/begin MOD_COMMON "" BYTE_ORDER MSB_FIRST /* Default byteorder (Motorola) */ /end MOD_COMMON
/begin MOD_PAR "" VERSION "ccp 2.1" ADDR_EPK 0x00070289 EPK "V452" SUPPLIER "" CUSTOMER "" CUSTOMER_NO "" USER "" ECU "MSS65-INJ" /* Description of memory-segments. There has to be a CODE and DATA-Segment to */ /* support the generation of valid flashable HEX-Files */
 /begin MEMORY_SEGMENT CODESEG1 "Program" CODE FLASH INTERN 0x10000 0x60000 -1 -1 -1 -1 -1 /end MEMORY_SEGMENT
 /begin MEMORY_SEGMENT CODESEG2 "Program" CODE FLASH EXTERN 0x450000 0x1B0000 -1 -1 -1 -1 -1 /end MEMORY_SEGMENT
 /begin MEMORY_SEGMENT DATASEG1 "Appl.-DATA" DATA FLASH /* Memorytype; RAM wird nicht unterst�tzt */ INTERN 0x70000 0x10000 -1 -1 -1 -1 -1 /end MEMORY_SEGMENT
 /begin MEMORY_SEGMENT /* The new keyword MEMORY_SEGMENT */ VARSEG "Variablen" VARIABLES RAM INTERN 0x3F8000 0x8000 -1 -1 -1 -1 -1 /end MEMORY_SEGMENT
 /begin CALIBRATION_METHOD "DSERAP" /* Name of Method */ 1 /* Version No. */
  /begin CALIBRATION_HANDLE 0x70000 /* Begin of Calibration-Data */ 0xFFFC /* Length of Calibration-Data */ /end CALIBRATION_HANDLE
 /end CALIBRATION_METHOD
/end MOD_PAR
/begin IF_DATA ASAP1B_CCP /* spezific definition for CCP */ /* schnelle zeitsynchrone DAQ-Liste */
 /begin SOURCE "5 ms" 3 /* Basic Scale Unit: 3 -> 1ms */ 5 /* Rate: 5 * 1ms = 5ms */
  /begin QP_BLOB /* The QP-BLOB specifies the behavior of*/ 0 LENGTH 20 CAN_ID_FIXED 0x510 RASTER 0 FIRST_PID 0 /end QP_BLOB
 /end SOURCE
 /* langsame zeitsynchrone DAQ-Liste */
 /begin SOURCE "100 ms" 5 /* Basic Scale Unit: 5 -> 100ms */ 1 /* Rate: 1 * 100ms = 100ms */
  /begin QP_BLOB /* The QP-BLOB specifies the behavior of*/ 1 LENGTH 10 CAN_ID_FIXED 0x511 RASTER 1 FIRST_PID 20 /end QP_BLOB
 /end SOURCE
 /* winkelsynchrone DAQ-Liste */
 /begin SOURCE "segment-synchron" 103 /* Basic Scale Unit: 103 -> Segment */ 1 /* Rate: 1 * Seg = Seg */
  /begin QP_BLOB /* The QP-BLOB specify the behavior of */ 2 LENGTH 10 CAN_ID_FIXED 0x512 RASTER 2 /* noch pruefen!!!! p_wax */ FIRST_PID 30 /end QP_BLOB
 /end SOURCE
 /begin RASTER "5ms-Task" "5ms" 0 3 /* Scaling Unit: 3 = 1 msec */ 5 /* Rate in Scaling Unit: 5 */ /end RASTER
 /begin RASTER "100ms-Task" "100ms" 1 5 /* Scaling Unit: 5 = 100 msec */ 1 /* Rate in Scaling Unit: 1 */ /end RASTER
 /begin RASTER "sync-Task" "sync" 2 103 /* Scaling Unit: 103 = cylinder segment */ 1 /* Rate in Scaling Unit: 1 */ /end RASTER
 /begin TP_BLOB /* This BLOB describes all parameters */ /* that are necessary for CAN-timing and*/ /* ECU-calibration-technics */ 0x0201 /* CCP-Version V2.1 => 0x0201 */ 0x0202 /* BLOB-Version V2.2 => 0x0202 */ 0x500 /* CAN-ID CCP -> ECU */ 0x501 /* CAN-ID ECU -> CCP */ 0x1234 /* ECU CCP-Address */ 1 /* Byte-order: 1 - High-Byte-First (MOT)*/ /* 2 - Low-Byte-First(INTEL)*/
  /begin CAN_PARAM /* Interface CAN-Conrtoller settings */ 0x01f4 /* CAN-Baudrate in kBd: 0x01F4 = 500 kBd*/ 0x41 /* Bittimingregister BTR0: 0x41 */ 0x25 /* Bittimingregister BTR1: 0x25 */ /end CAN_PARAM
  BAUDRATE 500000 /* Baud rate */ SAMPLE_POINT 66 /* Sampling Point of time in percent */ SAMPLE_RATE 1 /* number of samples per bit */ STORE_SUPPORTED /* ECU supports the Store function */ RESUME_SUPPORTED /* ECU supports the Resume function */
  /begin CHECKSUM_PARAM 0x8009 /* Auswahl Checksum-Funktionen */ 0xFFFC /* Max. Blocklaenge */ CHECKSUM_CALCULATION ACTIVE_PAGE /* akt. Seite berechnen */ /end CHECKSUM_PARAM
  /begin DEFINED_PAGES /* Description of the memory-page */ 1 /* Logical-page-number */ "Workingpage" /* Name of page */ 0x0000 /* Address-Extension */ /* (only low-byte sgnificant) */ 0xc70000 /* Address of Memorypage */ 0x10000 /* Memorysize */ RAM FLASH_BACK /* feature available to flash back the RAM memory page */ DEFAULT /* Page is standard (fallback mode) */ RAM_INIT_BY_ECU /* Initialisationmethode: die ECU initialisiert die WP eigenstaendig */ /* INCA vermeidet mit dieser Einstellung das Senden des MOVE-Commands */ /* beim CCP-Session-Login. */ /end DEFINED_PAGES
  /begin DEFINED_PAGES /* Description of the memory-page */ 2 /* Logical-page-number */ "Referenzpage" /* Name of page */ 0x0000 /* Address-Extension */ /* (only low-byte sgnificant) */ 0x70000 /* Address of Memorypage */ 0x10000 /* Memorysize */ FLASH RAM_INIT_BY_ECU /* Initialisationmethode: die ECU initialisiert die WP eigenstaendig */ /* INCA vermeidet mit dieser Einstellung das Senden des MOVE-Commands */ /* beim CCP-Session-Login. */ /end DEFINED_PAGES
  OPTIONAL_CMD 0x0C /* GetSessionStatus */ OPTIONAL_CMD 0x0D /* SetSessionStatus */ OPTIONAL_CMD 0x0E /* BuildChecksum */ OPTIONAL_CMD 0x09 /* GetCalPage */ OPTIONAL_CMD 0x10 /* Clear Memory */ OPTIONAL_CMD 0x11 /* SelectCalPage */ OPTIONAL_CMD 0x12 /* GetSeed */ OPTIONAL_CMD 0x13 /* Unlock */ OPTIONAL_CMD 0x18 /* Programm */ OPTIONAL_CMD 0x19 /* Move */ OPTIONAL_CMD 0x22 /* Programm6 */ OPTIONAL_CMD 0x23 /* Download6 */ /end TP_BLOB
/end IF_DATA
/begin IF_DATA ASAP1B_KWP2000
 /begin SOURCE "timeslot" 0 0 QP_BLOB 0 BLOCKMODE 0xf0 0 20 /end SOURCE
 /begin TP_BLOB 0x0100 /* blob Version */ 0x11 /* ECU address on k line */ 0xF1 /* required tester address */ WuP /* stimulation mode of ECU: WuP */ MSB_FIRST /* byte order in measurements and characteristics */ 1 /* 1: 1st startDiagnosticSession without baudrate switch */ 0x00000 /* Project base address (PBA) */ /*SERAM SERAM_A SERAM_U SERAM_O SERAM_E Flash addr RAM addr Data rd code ver Code read Load mode*/ SERAM 0x60100 0x60100 0x6FAFF 0x6FAFF 0 0 1 0 0 1
  /begin CHECKSUM 0x010201 /* check sum type qualifier (see table) */ 1 /* 1: check sum calculation only on active page */ 1 /* No of local routine for check sum */ RequestRoutineResults /* result of checksum routine delivered by */ RNC_RESULT 0x23 /* only at 'RequestRoutineResults': */ /* result codes, that sign 'calculation in progress' */ /end CHECKSUM
  /begin FLASH_COPY TOOLFLASHBACK /* ECU mode for copying RAM into Flash */ 3 /* No of local routine for copy Flash to RAM */ RequestRoutineResults /* result of copy routine delivered by */ RAM_InitByECU /* ECU mode for copying Flash into RAM */ 0x86 /* diagnostic mode for copy RAM to Flash */ COPY_FRAME 1 /* list of page frames to be copied */ RNC_RESULT 0x23 0xfb 0xfc /* only at 'RequestRoutineResults': */ /* result codes, that sign 'copy in progress' */ /* COPY_PARA */ /* list of add. parameters for local routine */ /end FLASH_COPY
  /*Baudrate switch: BaudRate DiagMode i,k for ECU baudrate*/ /* BAUD_DEF 250000 0x86 0xA7 */ /* BAUD_DEF 125000 0x86 0x87 */ /* BAUD_DEF 111111 0x86 0x84 */ /* BAUD_DEF 55555 0x86 0x64 */ /* BAUD_DEF 10400 0x86 0x14 */ /*Timing parameter: p1Max p2Min p2Max p3Min p3Max p4Min */ /*Timing parameter: p1Max p2Min p2Max p3Min p3Max p4Min */ /* TIME_DEF 1 0 50 0 500 0 */ /* TIME_DEF 2 0 50 0 500 0 */ /* TIME_DEF 5 1 100 1 500 0 */ /* TIME_DEF 10 1 500 2 1000 1 */ TIME_DEF 20 2 25 28 250 0 /end TP_BLOB
/end IF_DATA
/begin IF_DATA EDIC_ISO_DS2 "V1.0" 0x12 25 1 SUPP_SERVICE READMEM SUPP_SERVICE WRITEMEM SUPP_SERVICE ACK TELDATA 0x9E /end IF_DATA
/* ------------------ Abschnitt erzeugt aus adapt_common.dat ------------------ */
/begin COMPU_METHOD FORMULA_0000 "FORMULA_0000" RAT_FUNC "%7.0" "-" COEFFS 0 1 0 0 0 1 /end COMPU_METHOD
/begin COMPU_METHOD FORMULA_0001 "FORMULA_0001" RAT_FUNC "%6.1" "%" COEFFS 0 10 0 0 0 1 /end COMPU_METHOD
/begin COMPU_METHOD FORMULA_0002 "FORMULA_0002" TAB_VERB "%3.0" "-" COMPU_TAB_REF FORMULA_0002_VTAB /end COMPU_METHOD
/begin COMPU_VTAB FORMULA_0002_VTAB "FORMULA_0002_VTAB" TAB_VERB 4 0 "in Ordnung" 128 "queue full" 64 "queue fehler" 32 "IRQ illegal" DEFAULT_VALUE "undefiniert" /end COMPU_VTAB
/begin COMPU_METHOD FORMULA_0003 "FORMULA_0003" RAT_FUNC "%3.0" "-" COEFFS 0 1 0 0 0 1 /end COMPU_METHOD
/begin COMPU_METHOD FORMULA_0004 "FORMULA_0004" TAB_VERB "%5.2" "-" COMPU_TAB_REF FORMULA_0004_VTAB /end COMPU_METHOD
/begin COMPU_VTAB FORMULA_0004_VTAB "FORMULA_0004_VTAB" TAB_VERB 9 0 "OK" 1 "NR CS0" 2 "NR CS1" 4 "NR CS2" 8 "NR CS3" 16 "CNT CS0" 17 "CNT CS1" 18 "CNT CS2" 20 "CNT CS3" /end COMPU_VTAB
/begin COMPU_METHOD FORMULA_0005 "FORMULA_0005" TAB_VERB "%5.2" "-" COMPU_TAB_REF FORMULA_0005_VTAB /end COMPU_METHOD
/begin COMPU_VTAB FORMULA_0005_VTAB "FORMULA_0005_VTAB" TAB_VERB 7 0 "OK" 1 "Seg-Kanal" 2 "5ms-Kanal" 4 "10ms-Kanal" 8 "100ms-Kanal" 16 "bgnd-Kanal" 32 "kwp-Kanal" DEFAULT_VALUE "ungueltig" /end COMPU_VTAB
/begin COMPU_METHOD FORMULA_0006 "FORMULA_0006" RAT_FUNC "%5.0" "Upm" COEFFS 0 1 0 0 0 1 /end COMPU_METHOD
/begin COMPU_METHOD FORMULA_0007 "FORMULA_0007" RAT_FUNC "%8.3" "-" COEFFS 0 10000 0 0 0 1 /end COMPU_METHOD
/begin COMPU_METHOD FORMULA_0008 "FORMULA_0008" RAT_FUNC "%6.1" "V" COEFFS 0 10 0 0 0 1 /end COMPU_METHOD
/begin COMPU_METHOD FORMULA_0009 "FORMULA_0009" RAT_FUNC "%6.1" "Nm" COEFFS 0 10 0 0 0 1 /end COMPU_METHOD
/begin COMPU_METHOD FORMULA_0010 "FORMULA_0010" RAT_FUNC "%5.0" "-" COEFFS 0 1 0 0 0 1 /end COMPU_METHOD
/begin COMPU_METHOD FORMULA_0011 "FORMULA_0011" TAB_VERB "%5.0" "-" COMPU_TAB_REF FORMULA_0011_VTAB /end COMPU_METHOD
/begin COMPU_VTAB FORMULA_0011_VTAB "FORMULA_0011_VTAB" TAB_VERB 15 0 "kein Fehler" 1 "Egasueberwachung" 2 "Momentenueberwachung" 4 "Einspritzueberwachung" 8 "SMG-Ueberwachung" 16 "Systemfehler" 32 "Stackueberwachung" 64 "Resetanzahl" 128 "Gemischfehler" 256 "Klopfregelung" 512 "CRC-Check" 1024 "Taskueberwachung" 2048 "Prozessueberwachung" 4096 "Pedalwertgeber" 8192 "Mastervac" DEFAULT_VALUE "undef" /end COMPU_VTAB
/begin COMPU_METHOD FORMULA_0012 "FORMULA_0012" TAB_VERB "%3.0" "-" COMPU_TAB_REF FORMULA_0012_VTAB /end COMPU_METHOD
/begin COMPU_VTAB FORMULA_0012_VTAB "FORMULA_0012_VTAB" TAB_VERB 1 0 "iO" DEFAULT_VALUE "Fehler" /end COMPU_VTAB
/begin COMPU_METHOD FORMULA_0013 "FORMULA_0013" TAB_VERB "%3.0" "-" COMPU_TAB_REF FORMULA_0013_VTAB /end COMPU_METHOD
/begin COMPU_VTAB FORMULA_0013_VTAB "FORMULA_0013_VTAB" TAB_VERB 5 0 "CRC iO" 1 "D-Fehler" 2 "P-Fehler" 3 "PD-Fehler" 4 "B-Fehler" DEFAULT_VALUE "Mehrfachfehler" /end COMPU_VTAB
/begin COMPU_METHOD FORMULA_0014 "FORMULA_0014" TAB_VERB "%3.0" "-" COMPU_TAB_REF FORMULA_0014_VTAB /end COMPU_METHOD
/begin COMPU_VTAB FORMULA_0014_VTAB "FORMULA_0014_VTAB" TAB_VERB 5 0 "OK" 3 "ID" 4 "Limit" 11 "Overrun" 14 "Stack" /end COMPU_VTAB
/begin COMPU_METHOD FORMULA_0015 "FORMULA_0015" TAB_VERB "%5.0" "-" COMPU_TAB_REF FORMULA_0015_VTAB /end COMPU_METHOD
/begin COMPU_VTAB FORMULA_0015_VTAB "FORMULA_0015_VTAB" TAB_VERB 6 512 "MCI" 768 "DataAcc" 1024 "IntrAcc" 1536 "Align" 1792 "PrgExc" 8192 "NMI" /end COMPU_VTAB
/begin COMPU_METHOD FORMULA_0016 "FORMULA_0016" TAB_VERB "%3.0" "-" COMPU_TAB_REF FORMULA_0016_VTAB /end COMPU_METHOD
/begin COMPU_VTAB FORMULA_0016_VTAB "FORMULA_0016_VTAB" TAB_VERB 13 0 "ini" 1 "1st edge" 2 "second edge" 3 "wait teeth" 4 "search gap" 5 "1st missing required" 6 "last tooth until gap" 7 "1st missing tooth" 8 "2nd missing tooth" 9 "1st tooth after gap" 10 "2nd tooth after gap" 11 "tooth 2..56, 62..116" 12 "gap required" DEFAULT_VALUE "undefined" /end COMPU_VTAB
/begin COMPU_METHOD FORMULA_0017 "FORMULA_0017" RAT_FUNC "%9.2" "ms" COEFFS 0 7000 0 0 0 1 /end COMPU_METHOD
/begin COMPU_METHOD FORMULA_0018 "FORMULA_0018" RAT_FUNC "%5.0" "us" COEFFS 0 1 0 0 0 1 /end COMPU_METHOD
/begin COMPU_METHOD FORMULA_0019 "FORMULA_0019" TAB_VERB "%7.2" "-" COMPU_TAB_REF FORMULA_0019_VTAB /end COMPU_METHOD
/begin COMPU_VTAB FORMULA_0019_VTAB "FORMULA_0019_VTAB" TAB_VERB 13 1 "Motor steht" 2 "Motor presync" 4 "Start" 8 "LLOKS" 16 "LLMKS" 32 "TL" 64 "VL" 128 "SA" 256 "NL" 512 "Abgew." 1024 "Kl15 aus" 2048 "Wakeup" 4096 "Schub" DEFAULT_VALUE "undefiniert" /end COMPU_VTAB
/begin COMPU_METHOD FORMULA_0020 "FORMULA_0020" RAT_FUNC "%5.0" "qmm/s" COEFFS 0 1 0 0 0 20 /end COMPU_METHOD
/begin COMPU_METHOD FORMULA_0021 "FORMULA_0021" RAT_FUNC "%7.2" "s" COEFFS 0 100 0 0 0 1 /end COMPU_METHOD
/begin COMPU_METHOD FORMULA_0022 "FORMULA_0022" RAT_FUNC "%7.2" "%" COEFFS 0 100 0 0 0 1 /end COMPU_METHOD
/* ------------------ Abschnitt erzeugt aus adapt_glob.dat ------------------ */
/begin COMPU_METHOD FORMULA_0023 "FORMULA_0023" RAT_FUNC "%6.1" "�C" COEFFS 0 10 2732 0 0 1 /end COMPU_METHOD
/begin COMPU_METHOD FORMULA_0024 "FORMULA_0024" RAT_FUNC "%9.4" "-" COEFFS 0 32768 0 0 0 1 /end COMPU_METHOD
/begin COMPU_METHOD FORMULA_0025 "FORMULA_0025" RAT_FUNC "%8.3" "-" COEFFS 0 16384 0 0 0 1 /end COMPU_METHOD
/begin COMPU_METHOD FORMULA_0026 "FORMULA_0026" TAB_VERB "%3.0" "-" COMPU_TAB_REF FORMULA_0026_VTAB /end COMPU_METHOD
/begin COMPU_VTAB FORMULA_0026_VTAB "FORMULA_0026_VTAB" TAB_VERB 4 0 "off" 1 "Fertigungsmode" 2 "Transportmode" 4 "Werkstattmode" DEFAULT_VALUE "off" /end COMPU_VTAB
/begin COMPU_METHOD FORMULA_0027 "FORMULA_0027" RAT_FUNC "%7.0" "km" COEFFS 0 1 0 0 0 1 /end COMPU_METHOD
/begin COMPU_METHOD FORMULA_0028 "FORMULA_0028" TAB_VERB "%3.0" "-" COMPU_TAB_REF FORMULA_0028_VTAB /end COMPU_METHOD
/begin COMPU_VTAB FORMULA_0028_VTAB "FORMULA_0028_VTAB" TAB_VERB 7 0 "kein Land" 1 "ECE" 2 "US" 3 "D" 4 "GB" 5 "J" 255 "ungueltig" /end COMPU_VTAB
/begin COMPU_METHOD FORMULA_0029 "FORMULA_0029" TAB_VERB "%3.0" "-" COMPU_TAB_REF FORMULA_0029_VTAB /end COMPU_METHOD
/begin COMPU_VTAB FORMULA_0029_VTAB "FORMULA_0029_VTAB" TAB_VERB 9 0 "keine Angabe" 4 "E60" 5 "E61" 6 "E63" 7 "E64" 8 "E90" 13 "E91" 14 "E92" 15 "E93" DEFAULT_VALUE "ungueltig" /end COMPU_VTAB
/begin COMPU_METHOD FORMULA_0030 "FORMULA_0030" TAB_VERB "%3.0" "-" COMPU_TAB_REF FORMULA_0030_VTAB /end COMPU_METHOD
/begin COMPU_VTAB FORMULA_0030_VTAB "FORMULA_0030_VTAB" TAB_VERB 3 0 "v_max 250" 1 "reserviert" 2 "v_max angehoben" DEFAULT_VALUE "undef" /end COMPU_VTAB
/begin COMPU_METHOD FORMULA_0031 "FORMULA_0031" TAB_VERB "%3.0" "-" COMPU_TAB_REF FORMULA_0031_VTAB /end COMPU_METHOD
/begin COMPU_VTAB FORMULA_0031_VTAB "FORMULA_0031_VTAB" TAB_VERB 5 0 "HS" 1 "Automat" 2 "Steptronic" 3 "SMG" 15 "ungueltig" /end COMPU_VTAB
/begin COMPU_METHOD FORMULA_0032 "FORMULA_0032" RAT_FUNC "%3.0" "%" COEFFS 0 1 0 0 0 1 /end COMPU_METHOD
/begin COMPU_METHOD FORMULA_0033 "FORMULA_0033" RAT_FUNC "%5.2" "-" COEFFS 0 1 0 0 0 1 /end COMPU_METHOD
/begin COMPU_METHOD FORMULA_0034 "FORMULA_0034" TAB_VERB "%5.2" "-" COMPU_TAB_REF FORMULA_0034_VTAB /end COMPU_METHOD
/begin COMPU_VTAB FORMULA_0034_VTAB "FORMULA_0034_VTAB" TAB_VERB 1 0 "erfuellt" DEFAULT_VALUE "offen" /end COMPU_VTAB
/begin COMPU_METHOD FORMULA_0035 "FORMULA_0035" TAB_VERB "%5.2" "-" COMPU_TAB_REF FORMULA_0035_VTAB /end COMPU_METHOD
/begin COMPU_VTAB FORMULA_0035_VTAB "FORMULA_0035_VTAB" TAB_VERB 1 0 "erfuellt" DEFAULT_VALUE "offen" /end COMPU_VTAB
/begin COMPU_METHOD FORMULA_0036 "FORMULA_0036" TAB_VERB "%5.2" "-" COMPU_TAB_REF FORMULA_0036_VTAB /end COMPU_METHOD
/begin COMPU_VTAB FORMULA_0036_VTAB "FORMULA_0036_VTAB" TAB_VERB 1 0 "erfuellt" DEFAULT_VALUE "offen" /end COMPU_VTAB
/begin COMPU_METHOD FORMULA_0037 "FORMULA_0037" TAB_VERB "%5.2" "-" COMPU_TAB_REF FORMULA_0037_VTAB /end COMPU_METHOD
/begin COMPU_VTAB FORMULA_0037_VTAB "FORMULA_0037_VTAB" TAB_VERB 1 0 "erfuellt" DEFAULT_VALUE "offen" /end COMPU_VTAB
/begin COMPU_METHOD FORMULA_0038 "FORMULA_0038" TAB_VERB "%5.2" "-" COMPU_TAB_REF FORMULA_0038_VTAB /end COMPU_METHOD
/begin COMPU_VTAB FORMULA_0038_VTAB "FORMULA_0038_VTAB" TAB_VERB 1 0 "erfuellt" DEFAULT_VALUE "offen" /end COMPU_VTAB
/begin COMPU_METHOD FORMULA_0062 "FORMULA_0062" RAT_FUNC "%5.0" "s" COEFFS 0 1 0 0 0 1 /end COMPU_METHOD
/begin COMPU_METHOD FORMULA_0073 "FORMULA_0073" RAT_FUNC "%6.1" "s" COEFFS 0 10 0 0 0 1 /end COMPU_METHOD
/begin COMPU_METHOD FORMULA_0075 "FORMULA_0075" RAT_FUNC "%8.3" "-" COEFFS 0 1024 0 0 0 1 /end COMPU_METHOD
/begin COMPU_METHOD FORMULA_0076 "FORMULA_0076" RAT_FUNC "%6.1" "Kelvin" COEFFS 0 10 0 0 0 1 /end COMPU_METHOD
/begin COMPU_METHOD FORMULA_0077 "FORMULA_0077" RAT_FUNC "%6.1" "mbar" COEFFS 0 16 0 0 0 1 /end COMPU_METHOD
/begin COMPU_METHOD FORMULA_0078 "FORMULA_0078" RAT_FUNC "%6.1" "km/h" COEFFS 0 16 0 0 0 1 /end COMPU_METHOD
/* ------------------ Abschnitt erzeugt aus glob.dat ------------------ */
/begin COMPU_METHOD FORMULA_0083 "FORMULA_0083" RAT_FUNC "%7.2" "-" COEFFS 0 1 0 0 0 1 /end COMPU_METHOD
/begin COMPU_METHOD FORMULA_0111 "FORMULA_0111" RAT_FUNC "%6.1" "�KW" COEFFS 0 10 0 0 0 1 /end COMPU_METHOD
/begin COMPU_METHOD FORMULA_0112 "FORMULA_0112" RAT_FUNC "%6.1" "kg/h" COEFFS 0 10 0 0 0 1 /end COMPU_METHOD
/begin COMPU_METHOD FORMULA_0114 "FORMULA_0114" RAT_FUNC "%5.0" "Upm/s" COEFFS 0 1 0 0 0 1 /end COMPU_METHOD
/begin COMPU_METHOD FORMULA_0118 "FORMULA_0118" RAT_FUNC "%8.3" "bar" COEFFS 0 1000 0 0 0 1 /end COMPU_METHOD
/begin COMPU_METHOD FORMULA_0132 "FORMULA_0132" RAT_FUNC "%7.2" "m/(s*s)" COEFFS 0 40 0 0 0 1 /end COMPU_METHOD
/begin COMPU_METHOD FORMULA_0149 "FORMULA_0149" RAT_FUNC "%9.2" "min" COEFFS 0 60 0 0 0 1 /end COMPU_METHOD
/begin COMPU_METHOD FORMULA_0152 "FORMULA_0152" RAT_FUNC "%9.2" "s" COEFFS 0 100 0 0 0 1 /end COMPU_METHOD
/begin COMPU_METHOD FORMULA_0207 "FORMULA_0207" RAT_FUNC "%5.0" "Tage" COEFFS 0 1 0 0 0 1 /end COMPU_METHOD
/begin COMPU_METHOD FORMULA_0216 "FORMULA_0216" TAB_VERB "%5.2" "-" COMPU_TAB_REF FORMULA_0216_VTAB /end COMPU_METHOD
/begin COMPU_VTAB FORMULA_0216_VTAB "FORMULA_0216_VTAB" TAB_VERB 2 0 "nein" 1 "ja" /end COMPU_VTAB
/begin COMPU_METHOD FORMULA_0217 "FORMULA_0217" TAB_VERB "%5.2" "-" COMPU_TAB_REF FORMULA_0217_VTAB /end COMPU_METHOD
/begin COMPU_VTAB FORMULA_0217_VTAB "FORMULA_0217_VTAB" TAB_VERB 2 0 "nein" 1 "ja" /end COMPU_VTAB
/begin COMPU_METHOD FORMULA_0218 "FORMULA_0218" TAB_VERB "%5.2" "-" COMPU_TAB_REF FORMULA_0218_VTAB /end COMPU_METHOD
/begin COMPU_VTAB FORMULA_0218_VTAB "FORMULA_0218_VTAB" TAB_VERB 2 0 "nein" 1 "ja" /end COMPU_VTAB
/begin COMPU_METHOD FORMULA_0219 "FORMULA_0219" TAB_VERB "%5.2" "-" COMPU_TAB_REF FORMULA_0219_VTAB /end COMPU_METHOD
/begin COMPU_VTAB FORMULA_0219_VTAB "FORMULA_0219_VTAB" TAB_VERB 2 0 "nein" 1 "ja" /end COMPU_VTAB
/begin COMPU_METHOD FORMULA_0223 "FORMULA_0223" TAB_VERB "%5.2" "-" COMPU_TAB_REF FORMULA_0223_VTAB /end COMPU_METHOD
/begin COMPU_VTAB FORMULA_0223_VTAB "FORMULA_0223_VTAB" TAB_VERB 2 0 "nein" 1 "ja" /end COMPU_VTAB
/begin COMPU_METHOD FORMULA_0233 "FORMULA_0233" TAB_VERB "%3.0" "-" COMPU_TAB_REF FORMULA_0233_VTAB /end COMPU_METHOD
/begin COMPU_VTAB FORMULA_0233_VTAB "FORMULA_0233_VTAB" TAB_VERB 4 0 "k. Aenderung" 1 "Aus" 2 "Ein" 4 "Sport" DEFAULT_VALUE "undef" /end COMPU_VTAB
/begin COMPU_METHOD FORMULA_0234 "FORMULA_0234" TAB_VERB "%3.0" "-" COMPU_TAB_REF FORMULA_0234_VTAB /end COMPU_METHOD
/begin COMPU_VTAB FORMULA_0234_VTAB "FORMULA_0234_VTAB" TAB_VERB 3 0 "k. Aenderung" 1 "Automat" 2 "Sequentiell" DEFAULT_VALUE "undef" /end COMPU_VTAB
/begin COMPU_METHOD FORMULA_0235 "FORMULA_0235" TAB_VERB "%3.0" "-" COMPU_TAB_REF FORMULA_0235_VTAB /end COMPU_METHOD
/begin COMPU_VTAB FORMULA_0235_VTAB "FORMULA_0235_VTAB" TAB_VERB 1 0 "k. Aenderung" /end COMPU_VTAB
/begin COMPU_METHOD FORMULA_0236 "FORMULA_0236" TAB_VERB "%3.0" "-" COMPU_TAB_REF FORMULA_0236_VTAB /end COMPU_METHOD
/begin COMPU_VTAB FORMULA_0236_VTAB "FORMULA_0236_VTAB" TAB_VERB 4 0 "k. Aenderung" 1 "Komfort" 2 "Normal" 3 "Sport" DEFAULT_VALUE "undef" /end COMPU_VTAB
/begin COMPU_METHOD FORMULA_0237 "FORMULA_0237" TAB_VERB "%3.0" "-" COMPU_TAB_REF FORMULA_0237_VTAB /end COMPU_METHOD
/begin COMPU_VTAB FORMULA_0237_VTAB "FORMULA_0237_VTAB" TAB_VERB 4 0 "k. Aenderung" 1 "KL1" 2 "KL2" 3 "KL3" DEFAULT_VALUE "undef" /end COMPU_VTAB
/begin COMPU_METHOD FORMULA_0238 "FORMULA_0238" TAB_VERB "%3.0" "-" COMPU_TAB_REF FORMULA_0238_VTAB /end COMPU_METHOD
/begin COMPU_VTAB FORMULA_0238_VTAB "FORMULA_0238_VTAB" TAB_VERB 2 0 "k. Aenderung" 1 "M-Cfg" DEFAULT_VALUE "undef" /end COMPU_VTAB
/begin COMPU_METHOD FORMULA_0239 "FORMULA_0239" TAB_VERB "%3.0" "-" COMPU_TAB_REF FORMULA_0239_VTAB /end COMPU_METHOD
/begin COMPU_VTAB FORMULA_0239_VTAB "FORMULA_0239_VTAB" TAB_VERB 2 0 "nicht angehoben" 1 "angehoben" DEFAULT_VALUE "undef" /end COMPU_VTAB
/begin COMPU_METHOD FORMULA_0309 "FORMULA_0309" TAB_VERB "%5.2" "-" COMPU_TAB_REF FORMULA_0309_VTAB /end COMPU_METHOD
/begin COMPU_VTAB FORMULA_0309_VTAB "FORMULA_0309_VTAB" TAB_VERB 6 0 "Inaktiv" 1 "Abregeln" 2 "Schalten" 3 "Aufregeln" 4 "Ende" 15 "Error" /end COMPU_VTAB
/begin COMPU_METHOD FORMULA_0318 "FORMULA_0318" RAT_FUNC "%3.0" ".Gang" COEFFS 0 1 0 0 0 1 /end COMPU_METHOD
/begin COMPU_METHOD FORMULA_0403 "FORMULA_0403" RAT_FUNC "%3.0" "-" COEFFS 0 -1 1 0 0 -1 /end COMPU_METHOD
/* ------------------ Abschnitt erzeugt aus version.dat ------------------ */
/begin COMPU_METHOD FORMULA_0414 "FORMULA_0414" TAB_VERB "%3.0" "-" COMPU_TAB_REF FORMULA_0414_VTAB /end COMPU_METHOD
/begin COMPU_VTAB FORMULA_0414_VTAB "FORMULA_0414_VTAB" TAB_VERB 63 45 "-" 48 "0" 49 "1" 50 "2" 51 "3" 52 "4" 53 "5" 54 "6" 55 "7" 56 "8" 57 "9" 65 "A" 66 "B" 67 "C" 68 "D" 69 "E" 70 "F" 71 "G" 72 "H" 73 "I" 74 "J" 75 "K" 76 "L" 77 "M" 78 "N" 79 "O" 80 "P" 81 "Q" 82 "R" 83 "S" 84 "T" 85 "U" 86 "V" 87 "W" 88 "X" 89 "Y" 90 "Z" 97 "a" 98 "b" 99 "c" 100 "d" 101 "e" 102 "f" 103 "g" 104 "h" 105 "i" 106 "j" 107 "k" 108 "l" 109 "m" 110 "n" 111 "o" 112 "p" 113 "q" 114 "r" 115 "s" 116 "t" 117 "u" 118 "v" 119 "w" 120 "x" 121 "y" 122 "z" DEFAULT_VALUE "DEZ" /end COMPU_VTAB
/begin COMPU_METHOD FORMULA_0426 "FORMULA_0426" RAT_FUNC "%5.0" "�C" COEFFS 0 10 0 0 0 1 /end COMPU_METHOD
/* ------------------ Abschnitt erzeugt aus ozbg.dat ------------------ */
/begin COMPU_METHOD FORMULA_0428 "FORMULA_0428" RAT_FUNC "%6.1" "km" COEFFS 0 1 0 0 0 10 /end COMPU_METHOD
/begin COMPU_METHOD FORMULA_0429 "FORMULA_0429" RAT_FUNC "%3.0" "km" COEFFS 0 1 0 0 0 1000 /end COMPU_METHOD
/begin COMPU_METHOD FORMULA_0431 "FORMULA_0431" RAT_FUNC "%5.2" "mm" COEFFS 0 256 0 0 0 75 /end COMPU_METHOD
/* ------------------ Abschnitt erzeugt aus oznivdl.dat ------------------ */
/begin COMPU_METHOD FORMULA_0436 "FORMULA_0436" RAT_FUNC "%5.2" "Liter" COEFFS 0 10 0 0 0 1 /end COMPU_METHOD
/begin COMPU_METHOD FORMULA_0438 "FORMULA_0438" RAT_FUNC "%7.2" "min" COEFFS 0 1 0 0 0 1 /end COMPU_METHOD
/begin COMPU_METHOD FORMULA_0446 "FORMULA_0446" RAT_FUNC "%4.1" "-" COEFFS 0 4 0 0 0 1 /end COMPU_METHOD
/begin COMPU_METHOD FORMULA_0449 "FORMULA_0449" RAT_FUNC "%7.2" "mm" COEFFS 0 256 0 0 0 75 /end COMPU_METHOD
/* ------------------ Abschnitt erzeugt aus ozrestkm.dat ------------------ */
/begin COMPU_METHOD FORMULA_0451 "FORMULA_0451" RAT_FUNC "%4.1" "-" COEFFS 0 100 0 0 0 1 /end COMPU_METHOD
/begin COMPU_METHOD FORMULA_0453 "FORMULA_0453" RAT_FUNC "%9.4" "-" COEFFS 0 1024 0 0 0 1 /end COMPU_METHOD
/begin COMPU_METHOD FORMULA_0462 "FORMULA_0462" RAT_FUNC "%8.3" "V" COEFFS 0 10 0 0 0 1 /end COMPU_METHOD
/* ------------------ Abschnitt erzeugt aus dibs.dat ------------------ */
/begin COMPU_METHOD FORMULA_0483 "FORMULA_0483" RAT_FUNC "%4.1" "-" COEFFS 0 1 0 0 0 1 /end COMPU_METHOD
/* ------------------ Abschnitt erzeugt aus adapt.dat ------------------ */
/begin COMPU_METHOD FORMULA_0513 "FORMULA_0513" TAB_VERB "%3.0" "-" COMPU_TAB_REF FORMULA_0513_VTAB /end COMPU_METHOD
/begin COMPU_VTAB FORMULA_0513_VTAB "FORMULA_0513_VTAB" TAB_VERB 2 0 "ausgeschaltet" 1 "Einschalten" DEFAULT_VALUE "undef" /end COMPU_VTAB
/begin COMPU_METHOD FORMULA_0514 "FORMULA_0514" TAB_VERB "%7.0" "-" COMPU_TAB_REF FORMULA_0514_VTAB /end COMPU_METHOD
/begin COMPU_VTAB FORMULA_0514_VTAB "FORMULA_0514_VTAB" TAB_VERB 2 0 "aus" 1 "ein" /end COMPU_VTAB
/begin COMPU_METHOD FORMULA_0515 "FORMULA_0515" TAB_VERB "%7.0" "-" COMPU_TAB_REF FORMULA_0515_VTAB /end COMPU_METHOD
/begin COMPU_VTAB FORMULA_0515_VTAB "FORMULA_0515_VTAB" TAB_VERB 2 0 "aus" 1 "ein" /end COMPU_VTAB
/begin COMPU_METHOD FORMULA_0516 "FORMULA_0516" TAB_VERB "%7.0" "-" COMPU_TAB_REF FORMULA_0516_VTAB /end COMPU_METHOD
/begin COMPU_VTAB FORMULA_0516_VTAB "FORMULA_0516_VTAB" TAB_VERB 2 0 "aus" 1 "ein" /end COMPU_VTAB
/begin COMPU_METHOD FORMULA_0517 "FORMULA_0517" TAB_VERB "%7.0" "-" COMPU_TAB_REF FORMULA_0517_VTAB /end COMPU_METHOD
/begin COMPU_VTAB FORMULA_0517_VTAB "FORMULA_0517_VTAB" TAB_VERB 2 0 "aus" 1 "ein" /end COMPU_VTAB
/begin COMPU_METHOD FORMULA_0518 "FORMULA_0518" TAB_VERB "%7.0" "-" COMPU_TAB_REF FORMULA_0518_VTAB /end COMPU_METHOD
/begin COMPU_VTAB FORMULA_0518_VTAB "FORMULA_0518_VTAB" TAB_VERB 2 0 "aus" 1 "ein" /end COMPU_VTAB
/begin COMPU_METHOD FORMULA_0519 "FORMULA_0519" TAB_VERB "%7.0" "-" COMPU_TAB_REF FORMULA_0519_VTAB /end COMPU_METHOD
/begin COMPU_VTAB FORMULA_0519_VTAB "FORMULA_0519_VTAB" TAB_VERB 2 0 "aus" 1 "ein" /end COMPU_VTAB
/begin COMPU_METHOD FORMULA_0520 "FORMULA_0520" TAB_VERB "%7.0" "-" COMPU_TAB_REF FORMULA_0520_VTAB /end COMPU_METHOD
/begin COMPU_VTAB FORMULA_0520_VTAB "FORMULA_0520_VTAB" TAB_VERB 2 0 "aus" 1 "ein" /end COMPU_VTAB
/begin COMPU_METHOD FORMULA_0521 "FORMULA_0521" TAB_VERB "%7.0" "-" COMPU_TAB_REF FORMULA_0521_VTAB /end COMPU_METHOD
/begin COMPU_VTAB FORMULA_0521_VTAB "FORMULA_0521_VTAB" TAB_VERB 2 0 "aus" 1 "ein" /end COMPU_VTAB
/begin COMPU_METHOD FORMULA_0522 "FORMULA_0522" TAB_VERB "%7.0" "-" COMPU_TAB_REF FORMULA_0522_VTAB /end COMPU_METHOD
/begin COMPU_VTAB FORMULA_0522_VTAB "FORMULA_0522_VTAB" TAB_VERB 2 0 "aus" 1 "ein" /end COMPU_VTAB
/begin COMPU_METHOD FORMULA_0523 "FORMULA_0523" TAB_VERB "%7.0" "-" COMPU_TAB_REF FORMULA_0523_VTAB /end COMPU_METHOD
/begin COMPU_VTAB FORMULA_0523_VTAB "FORMULA_0523_VTAB" TAB_VERB 2 0 "aus" 1 "ein" /end COMPU_VTAB
/begin COMPU_METHOD FORMULA_0524 "FORMULA_0524" TAB_VERB "%7.0" "-" COMPU_TAB_REF FORMULA_0524_VTAB /end COMPU_METHOD
/begin COMPU_VTAB FORMULA_0524_VTAB "FORMULA_0524_VTAB" TAB_VERB 2 0 "aus" 1 "ein" /end COMPU_VTAB
/begin COMPU_METHOD FORMULA_0525 "FORMULA_0525" TAB_VERB "%7.0" "-" COMPU_TAB_REF FORMULA_0525_VTAB /end COMPU_METHOD
/begin COMPU_VTAB FORMULA_0525_VTAB "FORMULA_0525_VTAB" TAB_VERB 2 0 "aus" 1 "ein" /end COMPU_VTAB
/begin COMPU_METHOD FORMULA_0526 "FORMULA_0526" TAB_VERB "%7.0" "-" COMPU_TAB_REF FORMULA_0526_VTAB /end COMPU_METHOD
/begin COMPU_VTAB FORMULA_0526_VTAB "FORMULA_0526_VTAB" TAB_VERB 2 0 "aus" 1 "ein" /end COMPU_VTAB
/begin COMPU_METHOD FORMULA_0527 "FORMULA_0527" TAB_VERB "%3.0" "-" COMPU_TAB_REF FORMULA_0527_VTAB /end COMPU_METHOD
/begin COMPU_VTAB FORMULA_0527_VTAB "FORMULA_0527_VTAB" TAB_VERB 2 0 "Langztwert nach CBS-RESET" 1 "noch kein Langztwert nach CBS-RESET" /end COMPU_VTAB
/begin COMPU_METHOD FORMULA_0528 "FORMULA_0528" TAB_VERB "%5.2" "-" COMPU_TAB_REF FORMULA_0528_VTAB /end COMPU_METHOD
/begin COMPU_VTAB FORMULA_0528_VTAB "FORMULA_0528_VTAB" TAB_VERB 4 0 "keine Messg. erwuenscht" 1 "Kurzzeitmessg. laeuft" 2 "Kurzzeitmessg. erfolgr." 3 "Kurzzeitmessg. abgebr." /end COMPU_VTAB
/begin COMPU_METHOD FORMULA_0529 "FORMULA_0529" RAT_FUNC "%7.2" "mg" COEFFS 0 4 0 0 0 1 /end COMPU_METHOD
/begin COMPU_METHOD FORMULA_0530 "FORMULA_0530" RAT_FUNC "%7.2" "mg" COEFFS 0 32 0 0 0 1 /end COMPU_METHOD
/begin COMPU_METHOD FORMULA_0531 "FORMULA_0531" RAT_FUNC "%8.3" "mg/ASP" COEFFS 0 64 0 0 0 1 /end COMPU_METHOD
/begin COMPU_METHOD FORMULA_0532 "FORMULA_0532" RAT_FUNC "%5.0" "mV" COEFFS 0 1024 0 0 0 5000 /end COMPU_METHOD
/begin COMPU_METHOD FORMULA_0533 "FORMULA_0533" TAB_VERB "%7.2" "-" COMPU_TAB_REF FORMULA_0533_VTAB /end COMPU_METHOD
/begin COMPU_VTAB FORMULA_0533_VTAB "FORMULA_0533_VTAB" TAB_VERB 1 0 "Messung gesperrt" DEFAULT_VALUE "Messung freigegeben" /end COMPU_VTAB
/begin COMPU_METHOD FORMULA_0534 "FORMULA_0534" TAB_VERB "%7.2" "-" COMPU_TAB_REF FORMULA_0534_VTAB /end COMPU_METHOD
/begin COMPU_VTAB FORMULA_0534_VTAB "FORMULA_0534_VTAB" TAB_VERB 1 0 "Diag. inaktiv" DEFAULT_VALUE "Diag. aktiv" /end COMPU_VTAB
/begin COMPU_METHOD FORMULA_0535 "FORMULA_0535" TAB_VERB "%7.2" "-" COMPU_TAB_REF FORMULA_0535_VTAB /end COMPU_METHOD
/begin COMPU_VTAB FORMULA_0535_VTAB "FORMULA_0535_VTAB" TAB_VERB 1 0 "INIT-Wert" DEFAULT_VALUE "gelernter Wert" /end COMPU_VTAB
/begin COMPU_METHOD FORMULA_0536 "FORMULA_0536" TAB_VERB "%7.2" "-" COMPU_TAB_REF FORMULA_0536_VTAB /end COMPU_METHOD
/begin COMPU_VTAB FORMULA_0536_VTAB "FORMULA_0536_VTAB" TAB_VERB 1 0 "i.O." DEFAULT_VALUE "SH_TO_X_SPERREN" /end COMPU_VTAB
/begin COMPU_METHOD FORMULA_0537 "FORMULA_0537" RAT_FUNC "%6.1" "Ohm" COEFFS 0 10 0 0 0 1 /end COMPU_METHOD
/begin COMPU_METHOD FORMULA_0538 "FORMULA_0538" RAT_FUNC "%5.0" "ms" COEFFS 0 1 0 0 0 10 /end COMPU_METHOD
/begin COMPU_METHOD FORMULA_0539 "FORMULA_0539" RAT_FUNC "%5.0" "ms" COEFFS 0 1 0 0 0 100 /end COMPU_METHOD
/begin COMPU_METHOD FORMULA_0540 "FORMULA_0540" RAT_FUNC "%7.0" "s" COEFFS 0 1 0 0 0 1 /end COMPU_METHOD
/begin COMPU_METHOD FORMULA_0541 "FORMULA_0541" RAT_FUNC "%5.0" "%" COEFFS 0 1 0 0 0 1 /end COMPU_METHOD
/begin COMPU_METHOD FORMULA_0542 "FORMULA_0542" TAB_VERB "%5.2" "-" COMPU_TAB_REF FORMULA_0542_VTAB /end COMPU_METHOD
/begin COMPU_VTAB FORMULA_0542_VTAB "FORMULA_0542_VTAB" TAB_VERB 3 0 "Vorlauf gesperrt" 1 "mit Vorlauf" 2 "Vorl init" /end COMPU_VTAB
/begin COMPU_METHOD FORMULA_0543 "FORMULA_0543" RAT_FUNC "%3.0" "Diags" COEFFS 0 1 0 0 0 1 /end COMPU_METHOD
/begin COMPU_METHOD FORMULA_0544 "FORMULA_0544" RAT_FUNC "%5.0" "Diags" COEFFS 0 1 0 0 0 1 /end COMPU_METHOD
/begin COMPU_METHOD FORMULA_0545 "FORMULA_0545" TAB_VERB "%5.2" "-" COMPU_TAB_REF FORMULA_0545_VTAB /end COMPU_METHOD
/begin COMPU_VTAB FORMULA_0545_VTAB "FORMULA_0545_VTAB" TAB_VERB 2 0 "nein" 1 "ja" /end COMPU_VTAB
/begin COMPU_METHOD FORMULA_0546 "FORMULA_0546" TAB_VERB "%5.2" "-" COMPU_TAB_REF FORMULA_0546_VTAB /end COMPU_METHOD
/begin COMPU_VTAB FORMULA_0546_VTAB "FORMULA_0546_VTAB" TAB_VERB 2 0 "nein" 1 "ja" /end COMPU_VTAB
/begin COMPU_METHOD FORMULA_0547 "FORMULA_0547" TAB_VERB "%5.2" "-" COMPU_TAB_REF FORMULA_0547_VTAB /end COMPU_METHOD
/begin COMPU_VTAB FORMULA_0547_VTAB "FORMULA_0547_VTAB" TAB_VERB 2 0 "nein" 1 "ja" /end COMPU_VTAB
/begin COMPU_METHOD FORMULA_0548 "FORMULA_0548" TAB_VERB "%5.2" "-" COMPU_TAB_REF FORMULA_0548_VTAB /end COMPU_METHOD
/begin COMPU_VTAB FORMULA_0548_VTAB "FORMULA_0548_VTAB" TAB_VERB 2 0 "nein" 1 "ja" /end COMPU_VTAB
/begin COMPU_METHOD FORMULA_0549 "FORMULA_0549" TAB_VERB "%5.2" "-" COMPU_TAB_REF FORMULA_0549_VTAB /end COMPU_METHOD
/begin COMPU_VTAB FORMULA_0549_VTAB "FORMULA_0549_VTAB" TAB_VERB 2 0 "nein" 1 "ja" /end COMPU_VTAB
/begin COMPU_METHOD FORMULA_0550 "FORMULA_0550" TAB_VERB "%5.2" "-" COMPU_TAB_REF FORMULA_0550_VTAB /end COMPU_METHOD
/begin COMPU_VTAB FORMULA_0550_VTAB "FORMULA_0550_VTAB" TAB_VERB 2 0 "nein" 1 "ja" /end COMPU_VTAB
/begin COMPU_METHOD FORMULA_0551 "FORMULA_0551" RAT_FUNC "%7.2" "mA" COEFFS 0 1 0 0 0 0.00225 /end COMPU_METHOD
/begin COMPU_METHOD FORMULA_0552 "FORMULA_0552" RAT_FUNC "%7.2" "uA" COEFFS 0 65536 0 0 0 9 /end COMPU_METHOD
/begin COMPU_METHOD FORMULA_0553 "FORMULA_0553" RAT_FUNC "%5.0" "min" COEFFS 0 1 0 0 0 1 /end COMPU_METHOD
/begin COMPU_METHOD FORMULA_0554 "FORMULA_0554" TAB_VERB "%5.2" "-" COMPU_TAB_REF FORMULA_0554_VTAB /end COMPU_METHOD
/begin COMPU_VTAB FORMULA_0554_VTAB "FORMULA_0554_VTAB" TAB_VERB 51 0 "AUS" 1 "BEREIT" 2 "WAIT_KLA" 3 "WAIT_V" 4 "WAIT_N" 5 "WAIT_UB" 6 "WAIT_PMIN" 7 "WAIT_TEMP" 8 "WAIT_FST" 9 "WAIT_TEV" 10 "WAIT_EXD" 11 "WAIT_FEHLER_LOESCH" 12 "WAIT_VENTIL" 13 "WAIT_AY" 14 "WAIT_FEUCHT" 20 "START" 21 "REFDIA1" 22 "VENTIL_CHK" 23 "DECKELDIA" 24 "GROBLECKDIA" 25 "FEINLECKDIA" 26 "DECKEL_REFDIA2" 27 "GROB_REFDIA2" 28 "FEIN_REFDIA2" 29 "VENTIL_CHK2" 32 "DECKEL_DICHT" 33 "GROB_DICHT" 34 "FEIN_DICHT" 35 "DECKELLECK" 36 "GROBLECK" 37 "FEINLECK" 40 "ABBRUCH_UB_DIFF" 41 "ABBRUCH_I_REF_DIFF" 42 "ABBRUCH_TEV" 43 "ABBRUCH_KL15" 44 "ABBRUCH_N" 45 "ABBRUCH_V" 46 "ABBRUCH_KS" 47 "ABBRUCH_EXD" 48 "ABBRUCH_REF_ZU_GROSS" 49 "ABBRUCH_REF_ZU_KLEIN" 50 "ABBRUCH_VERSTOPFT" 51 "ABBRUCH_NACHTANK" 52 "ABBRUCH_TANKDECKEL" 53 "ABBRUCH_AIRBAG" 54 "ABBRUCH_I_REF_1/2" 55 "ABBRUCH_DI2" 56 "ABBRUCH_AY" 57 "ABBRUCH_I_REF2_DIFF" 58 "ABBRUCH_UB_MIN" 59 "ABBRUCH_POWER_DOWN" DEFAULT_VALUE "undef" /end COMPU_VTAB
/begin COMPU_METHOD FORMULA_0555 "FORMULA_0555" RAT_FUNC "%8.3" "%" COEFFS 0 32768 0 0 0 100 /end COMPU_METHOD
/begin COMPU_METHOD FORMULA_0556 "FORMULA_0556" RAT_FUNC "%9.4" "-" COEFFS 0 10000 0 0 0 1 /end COMPU_METHOD
/begin COMPU_METHOD FORMULA_0557 "FORMULA_0557" RAT_FUNC "%4.1" "l" COEFFS 0 2 0 0 0 1 /end COMPU_METHOD
/begin COMPU_METHOD FORMULA_0558 "FORMULA_0558" RAT_FUNC "%6.3" "l" COEFFS 0 512 0 0 0 1 /end COMPU_METHOD
/begin COMPU_METHOD FORMULA_0559 "FORMULA_0559" RAT_FUNC "%8.3" "L" COEFFS 0 1 0 0 0 0.001024 /end COMPU_METHOD
/begin COMPU_METHOD FORMULA_0560 "FORMULA_0560" TAB_VERB "%5.2" "-" COMPU_TAB_REF FORMULA_0560_VTAB /end COMPU_METHOD
/begin COMPU_VTAB FORMULA_0560_VTAB "FORMULA_0560_VTAB" TAB_VERB 4 0 "kein ELU erkannt" 1 "600W" 2 "850W" 128 "TEMIC 850W invers" DEFAULT_VALUE "undefiniert" /end COMPU_VTAB
/begin COMPU_METHOD FORMULA_0561 "FORMULA_0561" RAT_FUNC "%8.3" "kg/h" COEFFS 0 1000 0 0 0 1 /end COMPU_METHOD
/begin COMPU_METHOD FORMULA_0562 "FORMULA_0562" RAT_FUNC "%6.1" "kg*5ms/h" COEFFS 0 10 0 0 0 1 /end COMPU_METHOD
/begin COMPU_METHOD FORMULA_0563 "FORMULA_0563" TAB_VERB "%7.2" "-" COMPU_TAB_REF FORMULA_0563_VTAB /end COMPU_METHOD
/begin COMPU_VTAB FORMULA_0563_VTAB "FORMULA_0563_VTAB" TAB_VERB 1 0 "erfuellt" DEFAULT_VALUE "offen" /end COMPU_VTAB
/begin COMPU_METHOD FORMULA_0564 "FORMULA_0564" TAB_VERB "%7.2" "-" COMPU_TAB_REF FORMULA_0564_VTAB /end COMPU_METHOD
/begin COMPU_VTAB FORMULA_0564_VTAB "FORMULA_0564_VTAB" TAB_VERB 1 0 "erfuellt" DEFAULT_VALUE "offen" /end COMPU_VTAB
/begin COMPU_METHOD FORMULA_0565 "FORMULA_0565" TAB_VERB "%7.2" "-" COMPU_TAB_REF FORMULA_0565_VTAB /end COMPU_METHOD
/begin COMPU_VTAB FORMULA_0565_VTAB "FORMULA_0565_VTAB" TAB_VERB 1 0 "erfuellt" DEFAULT_VALUE "offen" /end COMPU_VTAB
/begin COMPU_METHOD FORMULA_0566 "FORMULA_0566" TAB_VERB "%7.2" "-" COMPU_TAB_REF FORMULA_0566_VTAB /end COMPU_METHOD
/begin COMPU_VTAB FORMULA_0566_VTAB "FORMULA_0566_VTAB" TAB_VERB 1 0 "erfuellt" DEFAULT_VALUE "offen" /end COMPU_VTAB
/begin COMPU_METHOD FORMULA_0567 "FORMULA_0567" TAB_VERB "%7.2" "-" COMPU_TAB_REF FORMULA_0567_VTAB /end COMPU_METHOD
/begin COMPU_VTAB FORMULA_0567_VTAB "FORMULA_0567_VTAB" TAB_VERB 1 0 "erfuellt" DEFAULT_VALUE "offen" /end COMPU_VTAB
/begin COMPU_METHOD FORMULA_0568 "FORMULA_0568" TAB_VERB "%7.2" "-" COMPU_TAB_REF FORMULA_0568_VTAB /end COMPU_METHOD
/begin COMPU_VTAB FORMULA_0568_VTAB "FORMULA_0568_VTAB" TAB_VERB 1 0 "erfuellt" DEFAULT_VALUE "offen" /end COMPU_VTAB
/begin COMPU_METHOD FORMULA_0569 "FORMULA_0569" TAB_VERB "%7.2" "-" COMPU_TAB_REF FORMULA_0569_VTAB /end COMPU_METHOD
/begin COMPU_VTAB FORMULA_0569_VTAB "FORMULA_0569_VTAB" TAB_VERB 1 0 "erfuellt" DEFAULT_VALUE "offen" /end COMPU_VTAB
/begin COMPU_METHOD FORMULA_0570 "FORMULA_0570" TAB_VERB "%7.2" "-" COMPU_TAB_REF FORMULA_0570_VTAB /end COMPU_METHOD
/begin COMPU_VTAB FORMULA_0570_VTAB "FORMULA_0570_VTAB" TAB_VERB 1 0 "erfuellt" DEFAULT_VALUE "offen" /end COMPU_VTAB
/begin COMPU_METHOD FORMULA_0571 "FORMULA_0571" TAB_VERB "%7.2" "-" COMPU_TAB_REF FORMULA_0571_VTAB /end COMPU_METHOD
/begin COMPU_VTAB FORMULA_0571_VTAB "FORMULA_0571_VTAB" TAB_VERB 1 0 "erfuellt" DEFAULT_VALUE "offen" /end COMPU_VTAB
/begin COMPU_METHOD FORMULA_0572 "FORMULA_0572" TAB_VERB "%5.2" "-" COMPU_TAB_REF FORMULA_0572_VTAB /end COMPU_METHOD
/begin COMPU_VTAB FORMULA_0572_VTAB "FORMULA_0572_VTAB" TAB_VERB 9 0 "Initialisierung" 1 "Rangecheck geheilt" 2 "n.i.O. Zyklusvergleich" 4 "i.O. Zyklusvergleich" 8 "i.O. Modellcheck" 16 "n.i.O. Rangecheck" 32 "n.i.O. Gradientenueberwachung" 64 "n.i.O. Modellcheck" 128 "Diagnose gesperrt" DEFAULT_VALUE "undef" /end COMPU_VTAB
/begin COMPU_METHOD FORMULA_0573 "FORMULA_0573" RAT_FUNC "%7.2" "-*s" COEFFS 0 16384 0 0 0 1 /end COMPU_METHOD
/begin COMPU_METHOD FORMULA_0574 "FORMULA_0574" TAB_VERB "%7.2" "-" COMPU_TAB_REF FORMULA_0574_VTAB /end COMPU_METHOD
/begin COMPU_VTAB FORMULA_0574_VTAB "FORMULA_0574_VTAB" TAB_VERB 1 317 "aktiv" DEFAULT_VALUE "nicht aktiv" /end COMPU_VTAB
/begin COMPU_METHOD FORMULA_0575 "FORMULA_0575" TAB_VERB "%5.2" "-" COMPU_TAB_REF FORMULA_0575_VTAB /end COMPU_METHOD
/begin COMPU_VTAB FORMULA_0575_VTAB "FORMULA_0575_VTAB" TAB_VERB 3 0 "inaktive" 1 "einfangen" 2 "eingeregelt" DEFAULT_VALUE "ungueltig" /end COMPU_VTAB
/* ------------------ Abschnitt erzeugt aus adapt_wichtig.dat ------------------ */
/begin COMPU_METHOD FORMULA_0576 "FORMULA_0576" RAT_FUNC "%7.0" "mal" COEFFS 0 1 0 0 0 1 /end COMPU_METHOD
/begin COMPU_METHOD FORMULA_0577 "FORMULA_0577" RAT_FUNC "%5.0" "bytes" COEFFS 0 1 0 0 0 4 /end COMPU_METHOD
/begin COMPU_METHOD FORMULA_0578 "FORMULA_0578" RAT_FUNC "%5.0" "VERS" COEFFS 0 1 0 0 0 1 /end COMPU_METHOD
/begin COMPU_METHOD FORMULA_0579 "FORMULA_0579" TAB_VERB "%3.0" "-" COMPU_TAB_REF FORMULA_0579_VTAB /end COMPU_METHOD
/begin COMPU_VTAB FORMULA_0579_VTAB "FORMULA_0579_VTAB" TAB_VERB 2 0 "Einfahrint. abgeschl." 1 "Einfahrint. aktiv" DEFAULT_VALUE "undef" /end COMPU_VTAB
/* ------------------ Abschnitt erzeugt aus ag_ti.dat ------------------ */
/begin COMPU_METHOD FORMULA_0580 "FORMULA_0580" TAB_VERB "%3.0" "-" COMPU_TAB_REF FORMULA_0580_VTAB /end COMPU_METHOD
/begin COMPU_VTAB FORMULA_0580_VTAB "FORMULA_0580_VTAB" TAB_VERB 5 0 "Inaktiv" 1 "Key" 5 "Aktiv" 8 "Fehler" 9 "Beendet" DEFAULT_VALUE "undefined" /end COMPU_VTAB
/begin COMPU_METHOD FORMULA_0581 "FORMULA_0581" TAB_VERB "%3.0" "-" COMPU_TAB_REF FORMULA_0581_VTAB /end COMPU_METHOD
/begin COMPU_VTAB FORMULA_0581_VTAB "FORMULA_0581_VTAB" TAB_VERB 4 0 "Aus" 1 "Statisch" 2 "Sequentiell" 3 "Sporadisch" DEFAULT_VALUE "undefined" /end COMPU_VTAB
/begin COMPU_METHOD FORMULA_0582 "FORMULA_0582" TAB_VERB "%5.0" "-" COMPU_TAB_REF FORMULA_0582_VTAB /end COMPU_METHOD
/begin COMPU_VTAB FORMULA_0582_VTAB "FORMULA_0582_VTAB" TAB_VERB 1 0 "keine Ausblendung." DEFAULT_VALUE "Ausblendungen aktiv." /end COMPU_VTAB
/begin COMPU_METHOD FORMULA_0583 "FORMULA_0583" TAB_VERB "%5.0" "-" COMPU_TAB_REF FORMULA_0583_VTAB /end COMPU_METHOD
/begin COMPU_VTAB FORMULA_0583_VTAB "FORMULA_0583_VTAB" TAB_VERB 1 0 "Zyl. 1 an." DEFAULT_VALUE "Zyl. 1 aus." /end COMPU_VTAB
/begin COMPU_METHOD FORMULA_0584 "FORMULA_0584" TAB_VERB "%5.0" "-" COMPU_TAB_REF FORMULA_0584_VTAB /end COMPU_METHOD
/begin COMPU_VTAB FORMULA_0584_VTAB "FORMULA_0584_VTAB" TAB_VERB 1 0 "Zyl. 2 an." DEFAULT_VALUE "Zyl. 2 aus." /end COMPU_VTAB
/begin COMPU_METHOD FORMULA_0585 "FORMULA_0585" TAB_VERB "%5.0" "-" COMPU_TAB_REF FORMULA_0585_VTAB /end COMPU_METHOD
/begin COMPU_VTAB FORMULA_0585_VTAB "FORMULA_0585_VTAB" TAB_VERB 1 0 "Zyl. 3 an." DEFAULT_VALUE "Zyl. 3 aus." /end COMPU_VTAB
/begin COMPU_METHOD FORMULA_0586 "FORMULA_0586" TAB_VERB "%5.0" "-" COMPU_TAB_REF FORMULA_0586_VTAB /end COMPU_METHOD
/begin COMPU_VTAB FORMULA_0586_VTAB "FORMULA_0586_VTAB" TAB_VERB 1 0 "Zyl. 4 an." DEFAULT_VALUE "Zyl. 4 aus." /end COMPU_VTAB
/begin COMPU_METHOD FORMULA_0587 "FORMULA_0587" TAB_VERB "%5.0" "-" COMPU_TAB_REF FORMULA_0587_VTAB /end COMPU_METHOD
/begin COMPU_VTAB FORMULA_0587_VTAB "FORMULA_0587_VTAB" TAB_VERB 1 0 "Zyl. 5 an." DEFAULT_VALUE "Zyl. 5 aus." /end COMPU_VTAB
/begin COMPU_METHOD FORMULA_0588 "FORMULA_0588" TAB_VERB "%5.0" "-" COMPU_TAB_REF FORMULA_0588_VTAB /end COMPU_METHOD
/begin COMPU_VTAB FORMULA_0588_VTAB "FORMULA_0588_VTAB" TAB_VERB 1 0 "Zyl. 6 an." DEFAULT_VALUE "Zyl. 6 aus." /end COMPU_VTAB
/begin COMPU_METHOD FORMULA_0589 "FORMULA_0589" TAB_VERB "%5.0" "-" COMPU_TAB_REF FORMULA_0589_VTAB /end COMPU_METHOD
/begin COMPU_VTAB FORMULA_0589_VTAB "FORMULA_0589_VTAB" TAB_VERB 1 0 "Zyl. 7 an." DEFAULT_VALUE "Zyl. 7 aus." /end COMPU_VTAB
/begin COMPU_METHOD FORMULA_0590 "FORMULA_0590" TAB_VERB "%5.0" "-" COMPU_TAB_REF FORMULA_0590_VTAB /end COMPU_METHOD
/begin COMPU_VTAB FORMULA_0590_VTAB "FORMULA_0590_VTAB" TAB_VERB 1 0 "Zyl. 8 an." DEFAULT_VALUE "Zyl. 8 aus." /end COMPU_VTAB
/begin COMPU_METHOD FORMULA_0591 "FORMULA_0591" TAB_VERB "%5.0" "-" COMPU_TAB_REF FORMULA_0591_VTAB /end COMPU_METHOD
/begin COMPU_VTAB FORMULA_0591_VTAB "FORMULA_0591_VTAB" TAB_VERB 1 0 "Zyl. 9 an." DEFAULT_VALUE "Zyl. 9 aus." /end COMPU_VTAB
/begin COMPU_METHOD FORMULA_0592 "FORMULA_0592" TAB_VERB "%5.0" "-" COMPU_TAB_REF FORMULA_0592_VTAB /end COMPU_METHOD
/begin COMPU_VTAB FORMULA_0592_VTAB "FORMULA_0592_VTAB" TAB_VERB 1 0 "Zyl. 10 an." DEFAULT_VALUE "Zyl. 10 aus." /end COMPU_VTAB
/* ------------------ Abschnitt erzeugt aus ascet_interf.dat ------------------ */
/begin COMPU_METHOD FORMULA_0593 "FORMULA_0593" RAT_FUNC "%3.0" "m/s*s" COEFFS 0 4 0 0 0 1 /end COMPU_METHOD
/begin COMPU_METHOD FORMULA_0594 "FORMULA_0594" TAB_VERB "%5.2" "-" COMPU_TAB_REF FORMULA_0594_VTAB /end COMPU_METHOD
/begin COMPU_VTAB FORMULA_0594_VTAB "FORMULA_0594_VTAB" TAB_VERB 2 0 "FALSE" 1 "TRUE" /end COMPU_VTAB
/begin COMPU_METHOD FORMULA_0595 "FORMULA_0595" RAT_FUNC "%5.0" "-" COEFFS 0 1 0 0 0 10 /end COMPU_METHOD
/begin COMPU_METHOD FORMULA_0596 "FORMULA_0596" TAB_VERB "%5.2" "%" COMPU_TAB_REF FORMULA_0596_VTAB /end COMPU_METHOD
/begin COMPU_VTAB FORMULA_0596_VTAB "FORMULA_0596_VTAB" TAB_VERB 4 0 "<50" 1 "50..<75" 2 "75..<100" 3 "100" /end COMPU_VTAB
/begin COMPU_METHOD FORMULA_0597 "FORMULA_0597" TAB_VERB "%5.2" "-" COMPU_TAB_REF FORMULA_0597_VTAB /end COMPU_METHOD
/begin COMPU_VTAB FORMULA_0597_VTAB "FORMULA_0597_VTAB" TAB_VERB 9 12 "zu wenig" 25 "Minimum" 38 "Min-OK" 53 "OK" 69 "OK-Max" 85 "Max" 95 "Ueberfuellt" 120 "-.-" 121 "Uhr" DEFAULT_VALUE "undef." /end COMPU_VTAB
/begin COMPU_METHOD FORMULA_0598 "FORMULA_0598" RAT_FUNC "%5.2" "Liter" COEFFS 0 10 100 0 0 1 /end COMPU_METHOD
/begin COMPU_METHOD FORMULA_0599 "FORMULA_0599" TAB_VERB "%5.2" "-" COMPU_TAB_REF FORMULA_0599_VTAB /end COMPU_METHOD
/begin COMPU_VTAB FORMULA_0599_VTAB "FORMULA_0599_VTAB" TAB_VERB 3 0 "BSD1_alt" 1 "BSD1_plus" 2 "BSD2" DEFAULT_VALUE "undef." /end COMPU_VTAB
/begin COMPU_METHOD FORMULA_0600 "FORMULA_0600" RAT_FUNC "%7.2" "min" COEFFS 0 60 0 0 0 1 /end COMPU_METHOD
/begin COMPU_METHOD FORMULA_0601 "FORMULA_0601" RAT_FUNC "%7.2" "Liter" COEFFS 0 1000 0 0 0 1 /end COMPU_METHOD
/begin COMPU_METHOD FORMULA_0602 "FORMULA_0602" TAB_VERB "%7.2" "-" COMPU_TAB_REF FORMULA_0602_VTAB /end COMPU_METHOD
/begin COMPU_VTAB FORMULA_0602_VTAB "FORMULA_0602_VTAB" TAB_VERB 15 0 "keine Test-CC/CBS-Meldung raus" 1 "CC Motoroel nachfuellen" 2 "CC Motoroel unter min" 3 "CC Motoroelsensor gestoert" 4 "CC Motoroel ueberhitzt" 5 "CC Motoroeldruck zu niedrig" 6 "CC Batterie wird nicht geladen" 7 "CC Batterieentladung zu hoch" 8 "CC Batterie stark entladen" 9 "CC Batterieueberwachung ausgef." 10 "CC Batterie pruefen" 11 "CC Batteriekontakte pruefen" 12 "CC Batterie entl. Verbr.abschaltung" 13 "CBS Oel Verfbkt. und Restlauflstg." 14 "CBS Oel Prognoseinterv. u. Zieltermin" /end COMPU_VTAB
/begin COMPU_METHOD FORMULA_0603 "FORMULA_0603" RAT_FUNC "%5.2" "-" COEFFS 0 10 0 0 0 1 /end COMPU_METHOD
/begin COMPU_METHOD FORMULA_0604 "FORMULA_0604" RAT_FUNC "%5.2" "%" COEFFS 0 10 0 0 0 125 /end COMPU_METHOD
/begin COMPU_METHOD FORMULA_0605 "FORMULA_0605" RAT_FUNC "%7.2" "Kelvin" COEFFS 0 1 0 0 0 1 /end COMPU_METHOD
/begin COMPU_METHOD FORMULA_0606 "FORMULA_0606" RAT_FUNC "%7.2" "mm" COEFFS 0 337 0 0 0 100 /end COMPU_METHOD
/* ------------------ Abschnitt erzeugt aus adapt_common.dat ------------------ */
/begin MEASUREMENT crc32_prog_carb_nv "Programm-CRC fuer Mode 9" ULONG FORMULA_0000 0 0 0.0 4294967295.0000 ECU_ADDRESS 0x3F9760 /end MEASUREMENT
/begin MEASUREMENT crc32_data_carb_nv "Daten-CRC fuer Mode 9" ULONG FORMULA_0000 0 0 0.0 4294967295.0000 ECU_ADDRESS 0x3F9764 /end MEASUREMENT
/begin MEASUREMENT ram_chk_err_adr_nv "Fehleradresse vom RamCheck" ULONG FORMULA_0000 0 0 0.0 4294967295.0000 ECU_ADDRESS 0x3F9768 /end MEASUREMENT
/begin MEASUREMENT sys_zust_cpu_last_max_nv "Maximale CPU Last" UWORD FORMULA_0001 0 0 0.0 100.0000 ECU_ADDRESS 0x3F976C /end MEASUREMENT
/begin MEASUREMENT spim_errorcode_reinit_nv "Errorcode weswegen ein SPI-Reinit ausgefuehrt wurde" UBYTE FORMULA_0002 0 0 0.0 255.0 ECU_ADDRESS 0x3F976E /end MEASUREMENT
/begin MEASUREMENT spim_error_reinit_ctr_nv "SPI-reinits durch Fehlverhalten" UBYTE FORMULA_0003 0 0 0.0 255.0000 ECU_ADDRESS 0x3F976F /end MEASUREMENT
/begin MEASUREMENT spim_chain_error_nv "SPI Chains Fehler" UBYTE FORMULA_0004 0 0 0.0 255.0 ECU_ADDRESS 0x3F9770 /end MEASUREMENT
/begin MEASUREMENT ipk_sync_errorcount_nv "Fehlerzaehler fuer Sync-Timeout" UBYTE FORMULA_0003 0 0 0.0 255.0000 ECU_ADDRESS 0x3F9771 /end MEASUREMENT
/begin MEASUREMENT ipk_sync_error_st_nv "IPK Sync Error im Hochlauf" UBYTE FORMULA_0005 0 0 0.0 255.0 ECU_ADDRESS 0x3F9772 /end MEASUREMENT
/begin MEASUREMENT sk_ff.n "Drehzahl" SWORD FORMULA_0006 0 0 0.0 10000.0000 ECU_ADDRESS 0x3F9774 /end MEASUREMENT
/begin MEASUREMENT sk_ff.rf_m "Fuellung" SWORD FORMULA_0007 0 0 0.0 2.0000 ECU_ADDRESS 0x3F9776 /end MEASUREMENT
/begin MEASUREMENT sk_ff.ub "Spannung" SWORD FORMULA_0008 0 0 0.0 28.0000 ECU_ADDRESS 0x3F9778 /end MEASUREMENT
/begin MEASUREMENT sk_ff.kupp_wunsch_ges "Wunschmoment" SWORD FORMULA_0009 0 0 -100.0000 1000.0000 ECU_ADDRESS 0x3F977A /end MEASUREMENT
/begin MEASUREMENT sk_ff.kupp_ist "Istmoment" SWORD FORMULA_0009 0 0 -100.0000 1000.0000 ECU_ADDRESS 0x3F977C /end MEASUREMENT
/begin MEASUREMENT sk_ff.pwg_soll "Pedalwert" SWORD FORMULA_0001 0 0 -10.0000 120.0000 ECU_ADDRESS 0x3F977E /end MEASUREMENT
/begin MEASUREMENT sk_ff.fail_st_zyl "Ausblender" UWORD FORMULA_0010 0 0 0.0 65535.0000 ECU_ADDRESS 0x3F9780 /end MEASUREMENT
/begin MEASUREMENT sk_ff.ursache "Ursache fuer SK-Eingriff" UWORD FORMULA_0011 0 0 0.0 65535.0 ECU_ADDRESS 0x3F9782 /end MEASUREMENT
/begin MEASUREMENT sk_ff.egas_sk_mode "SK-Mode Egas" UBYTE FORMULA_0012 0 0 0.0 255.0 ECU_ADDRESS 0x3F9784 /end MEASUREMENT
/begin MEASUREMENT sk_ff.md_sk_mode "SK-Mode Momentenmanager" UBYTE FORMULA_0012 0 0 0.0 255.0 ECU_ADDRESS 0x3F9785 /end MEASUREMENT
/begin MEASUREMENT sk_ff.smg_sk_mode "SK-Mode SMG" UBYTE FORMULA_0012 0 0 0.0 255.0 ECU_ADDRESS 0x3F9786 /end MEASUREMENT
/begin MEASUREMENT sk_ff.crc32_result "CRC-Fehler" UBYTE FORMULA_0013 0 0 0.0 255.0 ECU_ADDRESS 0x3F9787 /end MEASUREMENT
/begin MEASUREMENT sk_ff.os_err_cnt "OS-Err: Summe" UBYTE FORMULA_0003 0 0 0.0 255.0000 ECU_ADDRESS 0x3F9788 /end MEASUREMENT
/begin MEASUREMENT sk_ff.os_err_type "Fehlertyp" UBYTE FORMULA_0014 0 0 0.0 255.0 ECU_ADDRESS 0x3F9789 /end MEASUREMENT
/begin MEASUREMENT sk_ff.reset_cnt "Resetzaehler" UBYTE FORMULA_0003 0 0 0.0 255.0000 ECU_ADDRESS 0x3F978A /end MEASUREMENT
/begin MEASUREMENT sk_ff.stufe "SK-Stufe" UBYTE FORMULA_0003 0 0 0.0 255.0000 ECU_ADDRESS 0x3F978B /end MEASUREMENT
/begin MEASUREMENT sk_ff.os_err_addr "OS-Err: Adresse" ULONG FORMULA_0000 0 0 0.0 4294967295.0000 ECU_ADDRESS 0x3F978C /end MEASUREMENT
/begin MEASUREMENT sk_ff.proz_err "Prozess-Fehler" UWORD FORMULA_0010 0 0 0.0 65535.0000 ECU_ADDRESS 0x3F9790 /end MEASUREMENT
/begin MEASUREMENT sk_ff.task_err "Task-Fehler" UWORD FORMULA_0010 0 0 0.0 65535.0000 ECU_ADDRESS 0x3F9792 /end MEASUREMENT
/begin MEASUREMENT tpu_kw_irq_info_cnt_nv_a "Anzahl Infointerrupts (+/- ein Zahn)." UBYTE FORMULA_0003 0 0 0.0 255.0000 ECU_ADDRESS 0x3F9794 /end MEASUREMENT
/begin MEASUREMENT tpu_kw_irq_info_cnt_nv_b "Anzahl Infointerrupts (+/- ein Zahn)." UBYTE FORMULA_0003 0 0 0.0 255.0000 ECU_ADDRESS 0x3F9795 /end MEASUREMENT
/begin MEASUREMENT pctrl_task_err_nv "Fehler Taskueberwachung" UBYTE FORMULA_0003 0 0 0.0 255.0000 ECU_ADDRESS 0x3F9796 /end MEASUREMENT
/begin MEASUREMENT pctrl_proz_err_nv "Fehler Prozessueberwachung" UWORD FORMULA_0010 0 0 0.0 65535.0000 ECU_ADDRESS 0x3F9798 /end MEASUREMENT
/begin MEASUREMENT sys_exc_vec_nv "Exception-Vector" UWORD FORMULA_0015 0 0 0.0 65535.0 ECU_ADDRESS 0x3F979A /end MEASUREMENT
/begin MEASUREMENT sys_exc_lr_nv "Exception-Linkregister" ULONG FORMULA_0000 0 0 0.0 4294967295.0000 ECU_ADDRESS 0x3F979C /end MEASUREMENT
/begin MEASUREMENT sys_exc_addr_nv "Exception-Adresse" ULONG FORMULA_0000 0 0 0.0 4294967295.0000 ECU_ADDRESS 0x3F97A0 /end MEASUREMENT
/begin MEASUREMENT sys_rsr_cnt_nv.ehrs "ExtHardReset" UBYTE FORMULA_0003 0 0 0.0 255.0000 ECU_ADDRESS 0x3F97A4 /end MEASUREMENT
/begin MEASUREMENT sys_rsr_cnt_nv.esrs "ExtSoftReset" UBYTE FORMULA_0003 0 0 0.0 255.0000 ECU_ADDRESS 0x3F97A5 /end MEASUREMENT
/begin MEASUREMENT sys_rsr_cnt_nv.llrs "LossOfClockReset" UBYTE FORMULA_0003 0 0 0.0 255.0000 ECU_ADDRESS 0x3F97A6 /end MEASUREMENT
/begin MEASUREMENT sys_rsr_cnt_nv.swrs "WatchdogReset" UBYTE FORMULA_0003 0 0 0.0 255.0000 ECU_ADDRESS 0x3F97A7 /end MEASUREMENT
/begin MEASUREMENT sys_rsr_cnt_nv.csrs "ChkstopReset" UBYTE FORMULA_0003 0 0 0.0 255.0000 ECU_ADDRESS 0x3F97A8 /end MEASUREMENT
/begin MEASUREMENT sys_rsr_cnt_nv.dbhrs "DebugHardReset" UBYTE FORMULA_0003 0 0 0.0 255.0000 ECU_ADDRESS 0x3F97A9 /end MEASUREMENT
/begin MEASUREMENT sys_rsr_cnt_nv.dbsrs "DebugSoftReset" UBYTE FORMULA_0003 0 0 0.0 255.0000 ECU_ADDRESS 0x3F97AA /end MEASUREMENT
/begin MEASUREMENT sys_rsr_cnt_nv.jtrs "JTAGReset" UBYTE FORMULA_0003 0 0 0.0 255.0000 ECU_ADDRESS 0x3F97AB /end MEASUREMENT
/begin MEASUREMENT sys_rsr_cnt_nv.ocrs "OnChipReset" UBYTE FORMULA_0003 0 0 0.0 255.0000 ECU_ADDRESS 0x3F97AC /end MEASUREMENT
/begin MEASUREMENT sys_rsr_cnt_nv.ilbc "IllegalBitChangeReset" UBYTE FORMULA_0003 0 0 0.0 255.0000 ECU_ADDRESS 0x3F97AD /end MEASUREMENT
/begin MEASUREMENT sys_rsr_cnt_nv.gpor "GlitchPowerOnReset" UBYTE FORMULA_0003 0 0 0.0 255.0000 ECU_ADDRESS 0x3F97AE /end MEASUREMENT
/begin MEASUREMENT sys_rsr_cnt_nv.ghrst "GlitchHPinReset" UBYTE FORMULA_0003 0 0 0.0 255.0000 ECU_ADDRESS 0x3F97AF /end MEASUREMENT
/begin MEASUREMENT sys_rsr_cnt_nv.gsrst "GlitchSPinReset" UBYTE FORMULA_0003 0 0 0.0 255.0000 ECU_ADDRESS 0x3F97B0 /end MEASUREMENT
/begin MEASUREMENT ccp_retry_cnt_nv "Download Retryzaehler" UWORD FORMULA_0010 0 0 0.0 65535.0000 ECU_ADDRESS 0x3F97B2 /end MEASUREMENT
/begin MEASUREMENT tpu_kw_err_ff_a.state "Zustand der TPU" UBYTE FORMULA_0016 0 0 0.0 255.0 ECU_ADDRESS 0x3F97B4 /end MEASUREMENT
/begin MEASUREMENT tpu_kw_err_ff_b.state "Zustand der TPU" UBYTE FORMULA_0016 0 0 0.0 255.0 ECU_ADDRESS 0x3F97CC /end MEASUREMENT
/begin MEASUREMENT tpu_kw_err_ff_a.tooth "Abrisszahn" UBYTE FORMULA_0003 0 0 0.0 255.0000 ECU_ADDRESS 0x3F97B5 /end MEASUREMENT
/begin MEASUREMENT tpu_kw_err_ff_b.tooth "Abrisszahn" UBYTE FORMULA_0003 0 0 0.0 255.0000 ECU_ADDRESS 0x3F97CD /end MEASUREMENT
/begin MEASUREMENT tpu_kw_err_ff_a.irq "Interruptarten" UBYTE FORMULA_0003 0 0 0.0 255.0000 ECU_ADDRESS 0x3F97B6 /end MEASUREMENT
/begin MEASUREMENT tpu_kw_err_ff_b.irq "Interruptarten" UBYTE FORMULA_0003 0 0 0.0 255.0000 ECU_ADDRESS 0x3F97CE /end MEASUREMENT
/begin MEASUREMENT tpu_kw_err_ff_a.cnt "Abrisszaehler" UBYTE FORMULA_0003 0 0 0.0 255.0000 ECU_ADDRESS 0x3F97B7 /end MEASUREMENT
/begin MEASUREMENT tpu_kw_err_ff_b.cnt "Abrisszaehler" UBYTE FORMULA_0003 0 0 0.0 255.0000 ECU_ADDRESS 0x3F97CF /end MEASUREMENT
/begin MEASUREMENT tpu_kw_err_ff_a.n "Abrissdrehzahl" SWORD FORMULA_0006 0 0 0.0 10000.0000 ECU_ADDRESS 0x3F97B8 /end MEASUREMENT
/begin MEASUREMENT tpu_kw_err_ff_b.n "Abrissdrehzahl" SWORD FORMULA_0006 0 0 0.0 10000.0000 ECU_ADDRESS 0x3F97D0 /end MEASUREMENT
/begin MEASUREMENT tpu_kw_err_ff_a.n_zahn "Abrisszahndrehzahl" SWORD FORMULA_0006 0 0 0.0 10000.0000 ECU_ADDRESS 0x3F97BA /end MEASUREMENT
/begin MEASUREMENT tpu_kw_err_ff_b.n_zahn "Abrisszahndrehzahl" SWORD FORMULA_0006 0 0 0.0 10000.0000 ECU_ADDRESS 0x3F97D2 /end MEASUREMENT
/begin MEASUREMENT tpu_kw_err_ff_a.prev_period "vorletzte Zahnperiode" ULONG FORMULA_0017 0 0 0.0 2396.7450 ECU_ADDRESS 0x3F97BC /end MEASUREMENT
/begin MEASUREMENT tpu_kw_err_ff_b.prev_period "vorletzte Zahnperiode" ULONG FORMULA_0017 0 0 0.0 2396.7450 ECU_ADDRESS 0x3F97D4 /end MEASUREMENT
/begin MEASUREMENT tpu_kw_err_ff_a.last_period "letzte Zahnperiode" ULONG FORMULA_0017 0 0 0.0 2396.7450 ECU_ADDRESS 0x3F97C0 /end MEASUREMENT
/begin MEASUREMENT tpu_kw_err_ff_b.last_period "letzte Zahnperiode" ULONG FORMULA_0017 0 0 0.0 2396.7450 ECU_ADDRESS 0x3F97D8 /end MEASUREMENT
/begin MEASUREMENT tpu_kw_err_ff_a.event_time "letzte Ereigniszeit" ULONG FORMULA_0017 0 0 0.0 2396.7450 ECU_ADDRESS 0x3F97C4 /end MEASUREMENT
/begin MEASUREMENT tpu_kw_err_ff_b.event_time "letzte Ereigniszeit" ULONG FORMULA_0017 0 0 0.0 2396.7450 ECU_ADDRESS 0x3F97DC /end MEASUREMENT
/begin MEASUREMENT tpu_kw_err_ff_a.tooth_time "letzte Zahnzeit" ULONG FORMULA_0017 0 0 0.0 2396.7450 ECU_ADDRESS 0x3F97C8 /end MEASUREMENT
/begin MEASUREMENT tpu_kw_err_ff_b.tooth_time "letzte Zahnzeit" ULONG FORMULA_0017 0 0 0.0 2396.7450 ECU_ADDRESS 0x3F97E0 /end MEASUREMENT
/begin MEASUREMENT os_err_ff.ptr "Zeiger auf Ringspeicher" ULONG FORMULA_0000 0 0 0.0 4294967295.0000 ECU_ADDRESS 0x3F97E4 /end MEASUREMENT
/begin MEASUREMENT os_err_ff.addr_0 "Adresse wo letzte Exception her kam" ULONG FORMULA_0000 0 0 0.0 4294967295.0000 ECU_ADDRESS 0x3F97E8 /end MEASUREMENT
/begin MEASUREMENT os_err_ff.addr_1 "Adresse wo letzte Exception her kam" ULONG FORMULA_0000 0 0 0.0 4294967295.0000 ECU_ADDRESS 0x3F97EC /end MEASUREMENT
/begin MEASUREMENT os_err_ff.addr_2 "Adresse wo letzte Exception her kam" ULONG FORMULA_0000 0 0 0.0 4294967295.0000 ECU_ADDRESS 0x3F97F0 /end MEASUREMENT
/begin MEASUREMENT os_err_ff.addr_3 "Adresse wo letzte Exception her kam" ULONG FORMULA_0000 0 0 0.0 4294967295.0000 ECU_ADDRESS 0x3F97F4 /end MEASUREMENT
/begin MEASUREMENT os_err_ff.addr_4 "Adresse wo letzte Exception her kam" ULONG FORMULA_0000 0 0 0.0 4294967295.0000 ECU_ADDRESS 0x3F97F8 /end MEASUREMENT
/begin MEASUREMENT os_err_ff.addr_5 "Adresse wo letzte Exception her kam" ULONG FORMULA_0000 0 0 0.0 4294967295.0000 ECU_ADDRESS 0x3F97FC /end MEASUREMENT
/begin MEASUREMENT os_err_ff.addr_6 "Adresse wo letzte Exception her kam" ULONG FORMULA_0000 0 0 0.0 4294967295.0000 ECU_ADDRESS 0x3F9800 /end MEASUREMENT
/begin MEASUREMENT os_err_ff.addr_7 "Adresse wo letzte Exception her kam" ULONG FORMULA_0000 0 0 0.0 4294967295.0000 ECU_ADDRESS 0x3F9804 /end MEASUREMENT
/begin MEASUREMENT os_proz_ff.mtime "Maximale Prozess Zeit" UWORD FORMULA_0018 0 0 0.0 65535.0000 ECU_ADDRESS 0x3F9808 /end MEASUREMENT
/begin MEASUREMENT os_proz_ff.mtime_pid "PID des Prozesses mit max Zeit" UWORD FORMULA_0010 0 0 0.0 65535.0000 ECU_ADDRESS 0x3F980A /end MEASUREMENT
/begin MEASUREMENT os_proz_ff.n "Motordrehzahl" SWORD FORMULA_0006 0 0 0.0 10000.0000 ECU_ADDRESS 0x3F980C /end MEASUREMENT
/begin MEASUREMENT os_proz_ff.rf "relative Fuellung Mittel zwischen Bank 1 und 2" SWORD FORMULA_0007 0 0 0.0 2.0000 ECU_ADDRESS 0x3F980E /end MEASUREMENT
/begin MEASUREMENT os_proz_ff.zustand_motor "Betriebszustand der Motorsteuerung" UWORD FORMULA_0019 0 0 0.0 65535.0 ECU_ADDRESS 0x3F9810 /end MEASUREMENT
/begin MEASUREMENT os_proz_ff.aq_soll_grad "Gradient AQ-Soll von Bank1" SWORD FORMULA_0020 0 0 -30000.0000 30000.0000 ECU_ADDRESS 0x3F9812 /end MEASUREMENT
/begin MEASUREMENT os_proz_ff.time_ml "Motor laeuft Zeit" UWORD FORMULA_0021 0 0 0.0 655.0000 ECU_ADDRESS 0x3F9814 /end MEASUREMENT
/begin MEASUREMENT os_proz_irq_ff.mtime "Maximale Prozess Zeit" UWORD FORMULA_0018 0 0 0.0 65535.0000 ECU_ADDRESS 0x3F9816 /end MEASUREMENT
/begin MEASUREMENT os_proz_irq_ff.mtime_pid "PID des Prozesses mit max Zeit" UWORD FORMULA_0010 0 0 0.0 65535.0000 ECU_ADDRESS 0x3F9818 /end MEASUREMENT
/begin MEASUREMENT os_proz_irq_ff.n "Motordrehzahl" SWORD FORMULA_0006 0 0 0.0 10000.0000 ECU_ADDRESS 0x3F981A /end MEASUREMENT
/begin MEASUREMENT os_proz_irq_ff.rf "relative Fuellung Mittel zwischen Bank 1 und 2" SWORD FORMULA_0007 0 0 0.0 2.0000 ECU_ADDRESS 0x3F981C /end MEASUREMENT
/begin MEASUREMENT os_proz_irq_ff.zustand_motor "Betriebszustand der Motorsteuerung" UWORD FORMULA_0019 0 0 0.0 65535.0 ECU_ADDRESS 0x3F981E /end MEASUREMENT
/begin MEASUREMENT os_proz_irq_ff.aq_soll_grad "Gradient AQ-Soll von Bank1" SWORD FORMULA_0020 0 0 -30000.0000 30000.0000 ECU_ADDRESS 0x3F9820 /end MEASUREMENT
/begin MEASUREMENT os_proz_irq_ff.time_ml "Motor laeuft Zeit" UWORD FORMULA_0021 0 0 0.0 655.0000 ECU_ADDRESS 0x3F9822 /end MEASUREMENT
/begin MEASUREMENT os_proz_irq_last_nv_1of10_ "CPU Last fuer diesen IRQ" UWORD FORMULA_0022 0 0 0.0 655.3500 ECU_ADDRESS 0x3F9824 /end MEASUREMENT
/begin MEASUREMENT os_proz_irq_last_nv_2of10_ "CPU Last fuer diesen IRQ" UWORD FORMULA_0022 0 0 0.0 655.3500 ECU_ADDRESS 0x3F9826 /end MEASUREMENT
/begin MEASUREMENT os_proz_irq_last_nv_3of10_ "CPU Last fuer diesen IRQ" UWORD FORMULA_0022 0 0 0.0 655.3500 ECU_ADDRESS 0x3F9828 /end MEASUREMENT
/begin MEASUREMENT os_proz_irq_last_nv_4of10_ "CPU Last fuer diesen IRQ" UWORD FORMULA_0022 0 0 0.0 655.3500 ECU_ADDRESS 0x3F982A /end MEASUREMENT
/begin MEASUREMENT os_proz_irq_last_nv_5of10_ "CPU Last fuer diesen IRQ" UWORD FORMULA_0022 0 0 0.0 655.3500 ECU_ADDRESS 0x3F982C /end MEASUREMENT
/begin MEASUREMENT os_proz_irq_last_nv_6of10_ "CPU Last fuer diesen IRQ" UWORD FORMULA_0022 0 0 0.0 655.3500 ECU_ADDRESS 0x3F982E /end MEASUREMENT
/begin MEASUREMENT os_proz_irq_last_nv_7of10_ "CPU Last fuer diesen IRQ" UWORD FORMULA_0022 0 0 0.0 655.3500 ECU_ADDRESS 0x3F9830 /end MEASUREMENT
/begin MEASUREMENT os_proz_irq_last_nv_8of10_ "CPU Last fuer diesen IRQ" UWORD FORMULA_0022 0 0 0.0 655.3500 ECU_ADDRESS 0x3F9832 /end MEASUREMENT
/begin MEASUREMENT os_proz_irq_last_nv_9of10_ "CPU Last fuer diesen IRQ" UWORD FORMULA_0022 0 0 0.0 655.3500 ECU_ADDRESS 0x3F9834 /end MEASUREMENT
/begin MEASUREMENT os_proz_irq_last_nv_10of10_ "CPU Last fuer diesen IRQ" UWORD FORMULA_0022 0 0 0.0 655.3500 ECU_ADDRESS 0x3F9836 /end MEASUREMENT
/* ------------------ Abschnitt erzeugt aus adapt_glob.dat ------------------ */
/begin MEASUREMENT toel_wanne "Oeltemperatur am QLT (Oelwanne)" SWORD FORMULA_0023 0 0 -50.0000 170.0000 ECU_ADDRESS 0x3F8980 /end MEASUREMENT
/begin MEASUREMENT laa_f_ber_nv_b1 "Faktor-Lambdaadaption ohne TE" UWORD FORMULA_0024 0 0 0.0 1.9990 ECU_ADDRESS 0x3F8982 /end MEASUREMENT
/begin MEASUREMENT laa_f_ber_nv_b2 "Faktor-Lambdaadaption ohne TE" UWORD FORMULA_0024 0 0 0.0 1.9990 ECU_ADDRESS 0x3F8984 /end MEASUREMENT
/begin MEASUREMENT kat_obd_wert_nv_b1 "gem., gewichtete Abweichung z. MW" UWORD FORMULA_0025 0 0 0.0 3.9990 ECU_ADDRESS 0x3F8986 /end MEASUREMENT
/begin MEASUREMENT kat_obd_wert_nv_b2 "gem., gewichtete Abweichung z. MW" UWORD FORMULA_0025 0 0 0.0 3.9990 ECU_ADDRESS 0x3F8988 /end MEASUREMENT
/begin MEASUREMENT kat_obd_wert_gesamt_nv "Gesamtsystemdiagnosewert" UWORD FORMULA_0025 0 0 0.0 3.9990 ECU_ADDRESS 0x3F898A /end MEASUREMENT
/begin MEASUREMENT kwp_fetrawe_st "" UBYTE FORMULA_0026 0 0 0.0 255.0 ECU_ADDRESS 0x3F898C /end MEASUREMENT
/begin MEASUREMENT ed_fsp_inj_fehlerzaehler_nv "Zaehler zum Fehlersortieren" UWORD FORMULA_0010 0 0 0.0 65535.0000 ECU_ADDRESS 0x3F898E /end MEASUREMENT
/begin MEASUREMENT can_km_stand_nv "Kilometerstand" ULONG FORMULA_0027 0 0 0.0 16777214.0000 ECU_ADDRESS 0x3F8990 /end MEASUREMENT
/begin MEASUREMENT can_fzgtyp_land_nv "Laendervariante" UBYTE FORMULA_0028 0 0 0.0 255.0 ECU_ADDRESS 0x3F8994 /end MEASUREMENT
/begin MEASUREMENT can_fzgtyp_veh_nv "Fahrzeugvariante" UBYTE FORMULA_0029 0 0 0.0 255.0 ECU_ADDRESS 0x3F8995 /end MEASUREMENT
/begin MEASUREMENT can_fzgtyp_clas_pwr_nv "Variante v_max-Anhebung" UBYTE FORMULA_0030 0 0 0.0 255.0 ECU_ADDRESS 0x3F8996 /end MEASUREMENT
/begin MEASUREMENT can_fzgtyp_grb_nv "Getriebevariante" UBYTE FORMULA_0031 0 0 0.0 255.0 ECU_ADDRESS 0x3F8997 /end MEASUREMENT
/begin MEASUREMENT elu_nl_nv "PWM-Signal der letzten ELU-Nachlaufanforderung" UBYTE FORMULA_0032 0 0 0.0 255.0000 ECU_ADDRESS 0x3F8998 /end MEASUREMENT
/begin MEASUREMENT tmot_abstell_nv "Abstelltemperatur des Motors" SWORD FORMULA_0023 0 0 -50.0000 170.0000 ECU_ADDRESS 0x3F869C /end MEASUREMENT
/begin MEASUREMENT ed_css_st_ign_nv "CSS-Status der Funktionen" UBYTE FORMULA_0033 0 0 0.0 255.0000 ECU_ADDRESS 0x3F869E /end MEASUREMENT
/begin MEASUREMENT ed_css_st_ign_nv_auss "Aussetzer" UBYTE FORMULA_0034 0 0 0.0 255.0 ECU_ADDRESS 0x3F869E BIT_MASK 0x1 /end MEASUREMENT
/begin MEASUREMENT ed_css_st_ign_nv_pwg "Pedalwertgeber" UBYTE FORMULA_0035 0 0 0.0 255.0 ECU_ADDRESS 0x3F869E BIT_MASK 0x2 /end MEASUREMENT
/begin MEASUREMENT ed_css_st_ign_nv_tmot "Motortemperatur" UBYTE FORMULA_0036 0 0 0.0 255.0 ECU_ADDRESS 0x3F869E BIT_MASK 0x4 /end MEASUREMENT
/begin MEASUREMENT ed_css_st_ign_nv_lls "Leerlaufsteller" UBYTE FORMULA_0037 0 0 0.0 255.0 ECU_ADDRESS 0x3F869E BIT_MASK 0x8 /end MEASUREMENT
/begin MEASUREMENT ed_css_st_ign_nv_dk "Drosselklappe" UBYTE FORMULA_0038 0 0 0.0 255.0 ECU_ADDRESS 0x3F869E BIT_MASK 0x10 /end MEASUREMENT
/* ------------------ Abschnitt erzeugt aus adapt.dat ------------------ */
/begin MEASUREMENT Bsd_error_cnt_nv_1of9_ "BSD Error Counter." UWORD FORMULA_0010 0 0 0.0 65535.0000 ECU_ADDRESS 0x3FA798 /end MEASUREMENT
/begin MEASUREMENT Bsd_error_cnt_nv_2of9_ "BSD Error Counter." UWORD FORMULA_0010 0 0 0.0 65535.0000 ECU_ADDRESS 0x3FA79A /end MEASUREMENT
/begin MEASUREMENT Bsd_error_cnt_nv_3of9_ "BSD Error Counter." UWORD FORMULA_0010 0 0 0.0 65535.0000 ECU_ADDRESS 0x3FA79C /end MEASUREMENT
/begin MEASUREMENT Bsd_error_cnt_nv_4of9_ "BSD Error Counter." UWORD FORMULA_0010 0 0 0.0 65535.0000 ECU_ADDRESS 0x3FA79E /end MEASUREMENT
/begin MEASUREMENT Bsd_error_cnt_nv_5of9_ "BSD Error Counter." UWORD FORMULA_0010 0 0 0.0 65535.0000 ECU_ADDRESS 0x3FA7A0 /end MEASUREMENT
/begin MEASUREMENT Bsd_error_cnt_nv_6of9_ "BSD Error Counter." UWORD FORMULA_0010 0 0 0.0 65535.0000 ECU_ADDRESS 0x3FA7A2 /end MEASUREMENT
/begin MEASUREMENT Bsd_error_cnt_nv_7of9_ "BSD Error Counter." UWORD FORMULA_0010 0 0 0.0 65535.0000 ECU_ADDRESS 0x3FA7A4 /end MEASUREMENT
/begin MEASUREMENT Bsd_error_cnt_nv_8of9_ "BSD Error Counter." UWORD FORMULA_0010 0 0 0.0 65535.0000 ECU_ADDRESS 0x3FA7A6 /end MEASUREMENT
/begin MEASUREMENT Bsd_error_cnt_nv_9of9_ "BSD Error Counter." UWORD FORMULA_0010 0 0 0.0 65535.0000 ECU_ADDRESS 0x3FA7A8 /end MEASUREMENT
/begin MEASUREMENT Oz_krzmsg_can_kombi_BC "Oel-Kurzzeitmessung" UBYTE FORMULA_0513 0 0 0.0 255.0 ECU_ADDRESS 0x3FA7AA /end MEASUREMENT
/begin MEASUREMENT can_standverb "Standverbraucher" ULONG FORMULA_0000 0 0 0.0 4294967295.0000 ECU_ADDRESS 0x3FA7AC /end MEASUREMENT
/begin MEASUREMENT can_standverb_anh "StdVerb Anhaenger" ULONG FORMULA_0514 0 0 0.0 4294967295.0 ECU_ADDRESS 0x3FA7AC BIT_MASK 0x1 /end MEASUREMENT
/begin MEASUREMENT can_standverb_nmi "StdVerb NMI" ULONG FORMULA_0515 0 0 0.0 4294967295.0 ECU_ADDRESS 0x3FA7AC BIT_MASK 0x2 /end MEASUREMENT
/begin MEASUREMENT can_standverb_dwa "StdVerb DWA" ULONG FORMULA_0516 0 0 0.0 4294967295.0 ECU_ADDRESS 0x3FA7AC BIT_MASK 0x4 /end MEASUREMENT
/begin MEASUREMENT can_standverb_licht "StdVerb Licht" ULONG FORMULA_0517 0 0 0.0 4294967295.0 ECU_ADDRESS 0x3FA7AC BIT_MASK 0x8 /end MEASUREMENT
/begin MEASUREMENT can_standverb_sh "StdVerb Standheizung" ULONG FORMULA_0518 0 0 0.0 4294967295.0 ECU_ADDRESS 0x3FA7AC BIT_MASK 0x10 /end MEASUREMENT
/begin MEASUREMENT can_standverb_sl "StdVerb Standl�fter" ULONG FORMULA_0519 0 0 0.0 4294967295.0 ECU_ADDRESS 0x3FA7AC BIT_MASK 0x20 /end MEASUREMENT
/begin MEASUREMENT can_standverb_getr "StdVerb Getriebe" ULONG FORMULA_0520 0 0 0.0 4294967295.0 ECU_ADDRESS 0x3FA7AC BIT_MASK 0x40 /end MEASUREMENT
/begin MEASUREMENT can_standverb_rw "StdVerb Restw�rme" ULONG FORMULA_0521 0 0 0.0 4294967295.0 ECU_ADDRESS 0x3FA7AC BIT_MASK 0x80 /end MEASUREMENT
/begin MEASUREMENT can_standverb_tece "StdVerb Telefon ECE" ULONG FORMULA_0522 0 0 0.0 4294967295.0 ECU_ADDRESS 0x3FA7AC BIT_MASK 0x100 /end MEASUREMENT
/begin MEASUREMENT can_standverb_tus "StdVerb Telefon US" ULONG FORMULA_0523 0 0 0.0 4294967295.0 ECU_ADDRESS 0x3FA7AC BIT_MASK 0x200 /end MEASUREMENT
/begin MEASUREMENT can_standverb_skl "StdVerb Standklima" ULONG FORMULA_0524 0 0 0.0 4294967295.0 ECU_ADDRESS 0x3FA7AC BIT_MASK 0x400 /end MEASUREMENT
/begin MEASUREMENT can_standverb_apu "StdVerb APU" ULONG FORMULA_0525 0 0 0.0 4294967295.0 ECU_ADDRESS 0x3FA7AC BIT_MASK 0x800 /end MEASUREMENT
/begin MEASUREMENT can_standverb_fsh "StdVerb Frontscheibenheizung" ULONG FORMULA_0526 0 0 0.0 4294967295.0 ECU_ADDRESS 0x3FA7AC BIT_MASK 0x1000 /end MEASUREMENT
/begin MEASUREMENT hdw_z1_nv "HDW" UBYTE FORMULA_0003 0 0 0.0 255.0000 ECU_ADDRESS 0x3FA7B0 /end MEASUREMENT
/begin MEASUREMENT Oz_lgztwert_cbs_reset_st "Erkennung 1. Langztwert nach CBS-Reset" UBYTE FORMULA_0527 0 0 0.0 255.0 ECU_ADDRESS 0x3FA7B1 BIT_MASK 0x1 /end MEASUREMENT
/begin MEASUREMENT Oz_krzmsg_ctr "Zeitmesser fuer Kurzzeitmessung" UWORD FORMULA_0073 0 0 0.0 6553.5000 ECU_ADDRESS 0x3FA7B2 /end MEASUREMENT
/begin MEASUREMENT Oz_krzmsg_st "Kurzzeitmessung aktiv/inaktiv" UBYTE FORMULA_0528 0 0 0.0 2.0 ECU_ADDRESS 0x3FA7B4 /end MEASUREMENT
/begin MEASUREMENT psau_adapt_nv_b1 "Adaptionswert zur PSAU1 im GLOBbereich" SWORD FORMULA_0077 0 0 -100.0000 200.0000 ECU_ADDRESS 0x3FA7B6 /end MEASUREMENT
/begin MEASUREMENT psau_adapt_nv_b2 "Adaptionswert zur PSAU1 im GLOBbereich" SWORD FORMULA_0077 0 0 -100.0000 200.0000 ECU_ADDRESS 0x3FA7B8 /end MEASUREMENT
/begin MEASUREMENT ti_mks_ns_ist_abstell_b1 "bereits eingetragener Nachstartmasse" UWORD FORMULA_0529 0 0 0.0 16383.7500 ECU_ADDRESS 0x3FA7BA /end MEASUREMENT
/begin MEASUREMENT ti_mks_ns_ist_abstell_b2 "bereits eingetragener Nachstartmasse" UWORD FORMULA_0529 0 0 0.0 16383.7500 ECU_ADDRESS 0x3FA7BC /end MEASUREMENT
/begin MEASUREMENT wf_ist_zyl1 "Wandfilmistmenge" UWORD FORMULA_0530 0 0 0.0 2000.0000 ECU_ADDRESS 0x3FA7BE /end MEASUREMENT
/begin MEASUREMENT wf_ist_zyl2 "Wandfilmistmenge" UWORD FORMULA_0530 0 0 0.0 2000.0000 ECU_ADDRESS 0x3FA7C0 /end MEASUREMENT
/begin MEASUREMENT wf_ist_zyl3 "Wandfilmistmenge" UWORD FORMULA_0530 0 0 0.0 2000.0000 ECU_ADDRESS 0x3FA7C2 /end MEASUREMENT
/begin MEASUREMENT wf_ist_zyl4 "Wandfilmistmenge" UWORD FORMULA_0530 0 0 0.0 2000.0000 ECU_ADDRESS 0x3FA7C4 /end MEASUREMENT
/begin MEASUREMENT wf_ist_zyl5 "Wandfilmistmenge" UWORD FORMULA_0530 0 0 0.0 2000.0000 ECU_ADDRESS 0x3FA7C6 /end MEASUREMENT
/begin MEASUREMENT wf_ist_zyl6 "Wandfilmistmenge" UWORD FORMULA_0530 0 0 0.0 2000.0000 ECU_ADDRESS 0x3FA7C8 /end MEASUREMENT
/begin MEASUREMENT wf_ist_zyl7 "Wandfilmistmenge" UWORD FORMULA_0530 0 0 0.0 2000.0000 ECU_ADDRESS 0x3FA7CA /end MEASUREMENT
/begin MEASUREMENT wf_ist_zyl8 "Wandfilmistmenge" UWORD FORMULA_0530 0 0 0.0 2000.0000 ECU_ADDRESS 0x3FA7CC /end MEASUREMENT
/begin MEASUREMENT wf_ist_zyl9 "Wandfilmistmenge" UWORD FORMULA_0530 0 0 0.0 2000.0000 ECU_ADDRESS 0x3FA7CE /end MEASUREMENT
/begin MEASUREMENT wf_ist_zyl10 "Wandfilmistmenge" UWORD FORMULA_0530 0 0 0.0 2000.0000 ECU_ADDRESS 0x3FA7D0 /end MEASUREMENT
/begin MEASUREMENT laa_offs_nv_b1 "Offset-Lambdaadaption" SWORD FORMULA_0531 0 0 -512.0000 511.0000 ECU_ADDRESS 0x3FA7D2 /end MEASUREMENT
/begin MEASUREMENT laa_offs_nv_b2 "Offset-Lambdaadaption" SWORD FORMULA_0531 0 0 -512.0000 511.0000 ECU_ADDRESS 0x3FA7D4 /end MEASUREMENT
/begin MEASUREMENT lavk_ad_gain_b1 "Faktor-Sondenadaption" UWORD FORMULA_0075 0 0 0.0 4.0000 ECU_ADDRESS 0x3FA7D6 /end MEASUREMENT
/begin MEASUREMENT lavk_ad_gain_b2 "Faktor-Sondenadaption" UWORD FORMULA_0075 0 0 0.0 4.0000 ECU_ADDRESS 0x3FA7D8 /end MEASUREMENT
/begin MEASUREMENT lavk_ad_offs_b1 "Offset-Sondenadaption" SWORD FORMULA_0532 0 0 -5000.0000 5000.0000 ECU_ADDRESS 0x3FA7DA /end MEASUREMENT
/begin MEASUREMENT lavk_ad_offs_b2 "Offset-Sondenadaption" SWORD FORMULA_0532 0 0 -5000.0000 5000.0000 ECU_ADDRESS 0x3FA7DC /end MEASUREMENT
/begin MEASUREMENT lavk_obd_dyn_wert_nv_b1 "Diagnosewert" UWORD FORMULA_0025 0 0 0.0 3.9990 ECU_ADDRESS 0x3FA7DE /end MEASUREMENT
/begin MEASUREMENT lavk_obd_dyn_wert_nv_b2 "Diagnosewert" UWORD FORMULA_0025 0 0 0.0 3.9990 ECU_ADDRESS 0x3FA7E0 /end MEASUREMENT
/begin MEASUREMENT lavk_obd_dyn_wert_gesamt_nv "Gesamt-Diagnosewert" UWORD FORMULA_0025 0 0 0.0 3.9990 ECU_ADDRESS 0x3FA7E2 /end MEASUREMENT
/begin MEASUREMENT lavk_obd_dyn_wert_min_nv_b1 "min. Diagnosewert ueber alle Diag.Durchlaeufe" UWORD FORMULA_0025 0 0 0.0 3.9990 ECU_ADDRESS 0x3FA7E4 /end MEASUREMENT
/begin MEASUREMENT lavk_obd_dyn_wert_min_nv_b2 "min. Diagnosewert ueber alle Diag.Durchlaeufe" UWORD FORMULA_0025 0 0 0.0 3.9990 ECU_ADDRESS 0x3FA7E6 /end MEASUREMENT
/begin MEASUREMENT lshvk_r_ad_gain_b1 "Faktor-Sonden-Ri-Adaption" UWORD FORMULA_0075 0 0 0.0 4.0000 ECU_ADDRESS 0x3FA7E8 /end MEASUREMENT
/begin MEASUREMENT lshvk_r_ad_gain_b2 "Faktor-Sonden-Ri-Adaption" UWORD FORMULA_0075 0 0 0.0 4.0000 ECU_ADDRESS 0x3FA7EA /end MEASUREMENT
/begin MEASUREMENT lshvk_diag_st_nv_b1 "VKAT-LSH-Diag.-Status" UWORD FORMULA_0083 0 0 0.0 65535.0000 ECU_ADDRESS 0x3FA7EC /end MEASUREMENT
/begin MEASUREMENT lshvk_diag_st_nv_b2 "VKAT-LSH-Diag.-Status" UWORD FORMULA_0083 0 0 0.0 65535.0000 ECU_ADDRESS 0x3FA7EE /end MEASUREMENT
/begin MEASUREMENT lshvk_diag_aktiv_b1 "VKAT-LSH-Diag-AKTIV" UWORD FORMULA_0533 0 0 0.0 65535.0 ECU_ADDRESS 0x3FA7EC BIT_MASK 0x1 /end MEASUREMENT
/begin MEASUREMENT lshvk_diag_aktiv_b2 "VKAT-LSH-Diag-AKTIV" UWORD FORMULA_0533 0 0 0.0 65535.0 ECU_ADDRESS 0x3FA7EE BIT_MASK 0x1 /end MEASUREMENT
/begin MEASUREMENT lshvk_diag_info_b1 "VKAT-LSH-Diag-INFO" UWORD FORMULA_0534 0 0 0.0 65535.0 ECU_ADDRESS 0x3FA7EC BIT_MASK 0x2 /end MEASUREMENT
/begin MEASUREMENT lshvk_diag_info_b2 "VKAT-LSH-Diag-INFO" UWORD FORMULA_0534 0 0 0.0 65535.0 ECU_ADDRESS 0x3FA7EE BIT_MASK 0x2 /end MEASUREMENT
/begin MEASUREMENT lshvk_diag_r_adaption_b1 "gueltige LSHVK-R-Adaption" UWORD FORMULA_0535 0 0 0.0 65535.0 ECU_ADDRESS 0x3FA7EC BIT_MASK 0x4 /end MEASUREMENT
/begin MEASUREMENT lshvk_diag_r_adaption_b2 "gueltige LSHVK-R-Adaption" UWORD FORMULA_0535 0 0 0.0 65535.0 ECU_ADDRESS 0x3FA7EE BIT_MASK 0x4 /end MEASUREMENT
/begin MEASUREMENT lshvk_diag_sh_to_x_sperren_b1 "VKAT-LSH-Einschalten aufgrund elektr. Diag. sperren" UWORD FORMULA_0536 0 0 0.0 65535.0 ECU_ADDRESS 0x3FA7EC BIT_MASK 0x8 /end MEASUREMENT
/begin MEASUREMENT lshvk_diag_sh_to_x_sperren_b2 "VKAT-LSH-Einschalten aufgrund elektr. Diag. sperren" UWORD FORMULA_0536 0 0 0.0 65535.0 ECU_ADDRESS 0x3FA7EE BIT_MASK 0x8 /end MEASUREMENT
/begin MEASUREMENT lshvk_r_ad_offs_b1 "Offset-Sonden-Ri-Adaption" SWORD FORMULA_0532 0 0 -5000.0000 5000.0000 ECU_ADDRESS 0x3FA7F0 /end MEASUREMENT
/begin MEASUREMENT lshvk_r_ad_offs_b2 "Offset-Sonden-Ri-Adaption" SWORD FORMULA_0532 0 0 -5000.0000 5000.0000 ECU_ADDRESS 0x3FA7F2 /end MEASUREMENT
/begin MEASUREMENT lshvk_diag_r_adapt_b1 "adaptierter Heizerwiderstand VKAT" UWORD FORMULA_0537 0 0 0.0 100.0000 ECU_ADDRESS 0x3FA7F4 /end MEASUREMENT
/begin MEASUREMENT lshvk_diag_r_adapt_b2 "adaptierter Heizerwiderstand VKAT" UWORD FORMULA_0537 0 0 0.0 100.0000 ECU_ADDRESS 0x3FA7F6 /end MEASUREMENT
/begin MEASUREMENT lshvk_diag_r_gmw_nv_b1 "gem. Heizerwiderstand VKAT" UWORD FORMULA_0537 0 0 0.0 100.0000 ECU_ADDRESS 0x3FA7F8 /end MEASUREMENT
/begin MEASUREMENT lshvk_diag_r_gmw_nv_b2 "gem. Heizerwiderstand VKAT" UWORD FORMULA_0537 0 0 0.0 100.0000 ECU_ADDRESS 0x3FA7FA /end MEASUREMENT
/begin MEASUREMENT lshnk_diag_r_gmw_nv_b1 "gem. Heizerwiderstand NKAT" UWORD FORMULA_0537 0 0 0.0 100.0000 ECU_ADDRESS 0x3FA7FC /end MEASUREMENT
/begin MEASUREMENT lshnk_diag_r_gmw_nv_b2 "gem. Heizerwiderstand NKAT" UWORD FORMULA_0537 0 0 0.0 100.0000 ECU_ADDRESS 0x3FA7FE /end MEASUREMENT
/begin MEASUREMENT la_trim_i_ad_nv_b1 "wirkender I-Anteil - adaptiert" SWORD FORMULA_0025 0 0 -2.0000 1.9990 ECU_ADDRESS 0x3FA800 /end MEASUREMENT
/begin MEASUREMENT la_trim_i_ad_nv_b2 "wirkender I-Anteil - adaptiert" SWORD FORMULA_0025 0 0 -2.0000 1.9990 ECU_ADDRESS 0x3FA802 /end MEASUREMENT
/begin MEASUREMENT lank_obd_s_us_max_nv_b1 "max. NKAT-Sondensignal bei NKAT-VL-Diag." UWORD FORMULA_0532 0 0 0.0 1200.0000 ECU_ADDRESS 0x3FA804 /end MEASUREMENT
/begin MEASUREMENT lank_obd_s_us_max_nv_b2 "max. NKAT-Sondensignal bei NKAT-VL-Diag." UWORD FORMULA_0532 0 0 0.0 1200.0000 ECU_ADDRESS 0x3FA806 /end MEASUREMENT
/begin MEASUREMENT lank_obd_s_us_min_nv_b1 "min. NKAT-Sondensignal bei NKAT-SA-Diag." UWORD FORMULA_0532 0 0 0.0 1200.0000 ECU_ADDRESS 0x3FA808 /end MEASUREMENT
/begin MEASUREMENT lank_obd_s_us_min_nv_b2 "min. NKAT-Sondensignal bei NKAT-SA-Diag." UWORD FORMULA_0532 0 0 0.0 1200.0000 ECU_ADDRESS 0x3FA80A /end MEASUREMENT
/begin MEASUREMENT lank_obd_slope_t_max_nv_b1 "max. Mittelwert de. SLOPE-Zeiten - SA-Diagnose" UWORD FORMULA_0538 0 0 0.0 655350.0000 ECU_ADDRESS 0x3FA80C /end MEASUREMENT
/begin MEASUREMENT lank_obd_slope_t_max_nv_b2 "max. Mittelwert de. SLOPE-Zeiten - SA-Diagnose" UWORD FORMULA_0538 0 0 0.0 655350.0000 ECU_ADDRESS 0x3FA80E /end MEASUREMENT
/begin MEASUREMENT lank_obd_slope_t_min_nv_b1 "min. Mittelwert de. SLOPE-Zeiten - SA-Diagnose" UWORD FORMULA_0538 0 0 0.0 655350.0000 ECU_ADDRESS 0x3FA810 /end MEASUREMENT
/begin MEASUREMENT lank_obd_slope_t_min_nv_b2 "min. Mittelwert de. SLOPE-Zeiten - SA-Diagnose" UWORD FORMULA_0538 0 0 0.0 655350.0000 ECU_ADDRESS 0x3FA812 /end MEASUREMENT
/begin MEASUREMENT lank_obd_slope_t_mw_mode_nv_b1 "SLOPE-Zeit fuer MODE5/6" UWORD FORMULA_0538 0 0 0.0 655350.0000 ECU_ADDRESS 0x3FA814 /end MEASUREMENT
/begin MEASUREMENT lank_obd_slope_t_mw_mode_nv_b2 "SLOPE-Zeit fuer MODE5/6" UWORD FORMULA_0538 0 0 0.0 655350.0000 ECU_ADDRESS 0x3FA816 /end MEASUREMENT
/begin MEASUREMENT lank_obd_s_sa_t_nv_b1 "Abfallszeit des NKAT-Signals in SA f. MODE 6" UWORD FORMULA_0539 0 0 0.0 6553500.0000 ECU_ADDRESS 0x3FA818 /end MEASUREMENT
/begin MEASUREMENT lank_obd_s_sa_t_nv_b2 "Abfallszeit des NKAT-Signals in SA f. MODE 6" UWORD FORMULA_0539 0 0 0.0 6553500.0000 ECU_ADDRESS 0x3FA81A /end MEASUREMENT
/begin MEASUREMENT ksd_obd_oel_sperr_nv "Zaehler - Erkennung auf Oelverduennung" UBYTE FORMULA_0003 0 0 0.0 255.0000 ECU_ADDRESS 0x3FA81C /end MEASUREMENT
/begin MEASUREMENT ksd_obd_ll_max_nv_b1 "Triggerzaehler - max. Ueberschreitung im LL" UBYTE FORMULA_0003 0 0 0.0 255.0000 ECU_ADDRESS 0x3FA81D /end MEASUREMENT
/begin MEASUREMENT ksd_obd_ll_max_nv_b2 "Triggerzaehler - max. Ueberschreitung im LL" UBYTE FORMULA_0003 0 0 0.0 255.0000 ECU_ADDRESS 0x3FA81E /end MEASUREMENT
/begin MEASUREMENT ksd_obd_ll_min_nv_b1 "Triggerzaehler - min. Ueberschreitung im LL" UBYTE FORMULA_0003 0 0 0.0 255.0000 ECU_ADDRESS 0x3FA81F /end MEASUREMENT
/begin MEASUREMENT ksd_obd_ll_min_nv_b2 "Triggerzaehler - min. Ueberschreitung im LL" UBYTE FORMULA_0003 0 0 0.0 255.0000 ECU_ADDRESS 0x3FA820 /end MEASUREMENT
/begin MEASUREMENT ksd_obd_tl_max_nv_b1 "Triggerzaehler - max. Ueberschreitung im TL" UBYTE FORMULA_0003 0 0 0.0 255.0000 ECU_ADDRESS 0x3FA821 /end MEASUREMENT
/begin MEASUREMENT ksd_obd_tl_max_nv_b2 "Triggerzaehler - max. Ueberschreitung im TL" UBYTE FORMULA_0003 0 0 0.0 255.0000 ECU_ADDRESS 0x3FA822 /end MEASUREMENT
/begin MEASUREMENT ksd_obd_tl_min_nv_b1 "Triggerzaehler - min. Ueberschreitung im TL" UBYTE FORMULA_0003 0 0 0.0 255.0000 ECU_ADDRESS 0x3FA823 /end MEASUREMENT
/begin MEASUREMENT ksd_obd_tl_min_nv_b2 "Triggerzaehler - min. Ueberschreitung im TL" UBYTE FORMULA_0003 0 0 0.0 255.0000 ECU_ADDRESS 0x3FA824 /end MEASUREMENT
/begin MEASUREMENT zgla_f_1of2_1of5_ "Adaptionsfaktor - Zylindergleichstellung" UWORD FORMULA_0024 0 0 0.0 1.9990 ECU_ADDRESS 0x3FA826 /end MEASUREMENT
/begin MEASUREMENT zgla_f_1of2_2of5_ "Adaptionsfaktor - Zylindergleichstellung" UWORD FORMULA_0024 0 0 0.0 1.9990 ECU_ADDRESS 0x3FA828 /end MEASUREMENT
/begin MEASUREMENT zgla_f_1of2_3of5_ "Adaptionsfaktor - Zylindergleichstellung" UWORD FORMULA_0024 0 0 0.0 1.9990 ECU_ADDRESS 0x3FA82A /end MEASUREMENT
/begin MEASUREMENT zgla_f_1of2_4of5_ "Adaptionsfaktor - Zylindergleichstellung" UWORD FORMULA_0024 0 0 0.0 1.9990 ECU_ADDRESS 0x3FA82C /end MEASUREMENT
/begin MEASUREMENT zgla_f_1of2_5of5_ "Adaptionsfaktor - Zylindergleichstellung" UWORD FORMULA_0024 0 0 0.0 1.9990 ECU_ADDRESS 0x3FA82E /end MEASUREMENT
/begin MEASUREMENT zgla_f_2of2_1of5_ "Adaptionsfaktor - Zylindergleichstellung" UWORD FORMULA_0024 0 0 0.0 1.9990 ECU_ADDRESS 0x3FA830 /end MEASUREMENT
/begin MEASUREMENT zgla_f_2of2_2of5_ "Adaptionsfaktor - Zylindergleichstellung" UWORD FORMULA_0024 0 0 0.0 1.9990 ECU_ADDRESS 0x3FA832 /end MEASUREMENT
/begin MEASUREMENT zgla_f_2of2_3of5_ "Adaptionsfaktor - Zylindergleichstellung" UWORD FORMULA_0024 0 0 0.0 1.9990 ECU_ADDRESS 0x3FA834 /end MEASUREMENT
/begin MEASUREMENT zgla_f_2of2_4of5_ "Adaptionsfaktor - Zylindergleichstellung" UWORD FORMULA_0024 0 0 0.0 1.9990 ECU_ADDRESS 0x3FA836 /end MEASUREMENT
/begin MEASUREMENT zgla_f_2of2_5of5_ "Adaptionsfaktor - Zylindergleichstellung" UWORD FORMULA_0024 0 0 0.0 1.9990 ECU_ADDRESS 0x3FA838 /end MEASUREMENT
/begin MEASUREMENT t_mot_steht_1s_nv "Zeitpunkt sei dem Motor steht" ULONG FORMULA_0540 0 0 0.0 4294967295.0000 ECU_ADDRESS 0x3FA83C /end MEASUREMENT
/begin MEASUREMENT slp_t_aus_nv "Auschalt-SLP rel. Zeit" ULONG FORMULA_0149 0 0 0.0 71582788.2500 ECU_ADDRESS 0x3FA840 /end MEASUREMENT
/begin MEASUREMENT pks_obd_abw "Kraftstoffdruck Ist-Soll Verhaeltniss" SWORD FORMULA_0541 0 0 -1000.0000 1000.0000 ECU_ADDRESS 0x3FA844 /end MEASUREMENT
/begin MEASUREMENT van_ist_anschl_E1 "gemessene Spreizung am Anschlag" SWORD FORMULA_0111 0 0 50.0000 160.0000 ECU_ADDRESS 0x3FA846 /end MEASUREMENT
/begin MEASUREMENT van_ist_anschl_A1 "gemessene Spreizung am Anschlag" SWORD FORMULA_0111 0 0 50.0000 160.0000 ECU_ADDRESS 0x3FA848 /end MEASUREMENT
/begin MEASUREMENT van_ist_anschl_E2 "gemessene Spreizung am Anschlag" SWORD FORMULA_0111 0 0 50.0000 160.0000 ECU_ADDRESS 0x3FA84A /end MEASUREMENT
/begin MEASUREMENT van_ist_anschl_A2 "gemessene Spreizung am Anschlag" SWORD FORMULA_0111 0 0 50.0000 160.0000 ECU_ADDRESS 0x3FA84C /end MEASUREMENT
/begin MEASUREMENT van_guete_E1 "Ventil-Guete gefilt., n.v." UWORD FORMULA_0024 0 0 0.0 1.9999 ECU_ADDRESS 0x3FA84E /end MEASUREMENT
/begin MEASUREMENT van_guete_A1 "Ventil-Guete gefilt., n.v." UWORD FORMULA_0024 0 0 0.0 1.9999 ECU_ADDRESS 0x3FA850 /end MEASUREMENT
/begin MEASUREMENT van_guete_E2 "Ventil-Guete gefilt., n.v." UWORD FORMULA_0024 0 0 0.0 1.9999 ECU_ADDRESS 0x3FA852 /end MEASUREMENT
/begin MEASUREMENT van_guete_A2 "Ventil-Guete gefilt., n.v." UWORD FORMULA_0024 0 0 0.0 1.9999 ECU_ADDRESS 0x3FA854 /end MEASUREMENT
/begin MEASUREMENT van_guete_min_nv_E1 "minimale Ventil-Guete, n.v." UWORD FORMULA_0024 0 0 0.0 1.9999 ECU_ADDRESS 0x3FA856 /end MEASUREMENT
/begin MEASUREMENT van_guete_min_nv_A1 "minimale Ventil-Guete, n.v." UWORD FORMULA_0024 0 0 0.0 1.9999 ECU_ADDRESS 0x3FA858 /end MEASUREMENT
/begin MEASUREMENT van_guete_min_nv_E2 "minimale Ventil-Guete, n.v." UWORD FORMULA_0024 0 0 0.0 1.9999 ECU_ADDRESS 0x3FA85A /end MEASUREMENT
/begin MEASUREMENT van_guete_min_nv_A2 "minimale Ventil-Guete, n.v." UWORD FORMULA_0024 0 0 0.0 1.9999 ECU_ADDRESS 0x3FA85C /end MEASUREMENT
/begin MEASUREMENT B_VAN_ANSCHL_OK_E1 "Anschlag bei max Spreizung gueltig" UBYTE FORMULA_0216 0 0 0.0 255.0 ECU_ADDRESS 0x3FA85E BIT_MASK 0x1 /end MEASUREMENT
/begin MEASUREMENT B_VAN_ANSCHL_OK_A1 "Anschlag bei max Spreizung gueltig" UBYTE FORMULA_0217 0 0 0.0 255.0 ECU_ADDRESS 0x3FA85E BIT_MASK 0x2 /end MEASUREMENT
/begin MEASUREMENT B_VAN_ANSCHL_OK_E2 "Anschlag bei max Spreizung gueltig" UBYTE FORMULA_0218 0 0 0.0 255.0 ECU_ADDRESS 0x3FA85E BIT_MASK 0x4 /end MEASUREMENT
/begin MEASUREMENT B_VAN_ANSCHL_OK_A2 "Anschlag bei max Spreizung gueltig" UBYTE FORMULA_0219 0 0 0.0 255.0 ECU_ADDRESS 0x3FA85E BIT_MASK 0x8 /end MEASUREMENT
/begin MEASUREMENT van_st_anschl "Status VanosAnschlag gueltig" UBYTE FORMULA_0003 0 0 0.0 255.0000 ECU_ADDRESS 0x3FA85E /end MEASUREMENT
/begin MEASUREMENT nw_fehlerzaehler_nv "Anzahl Rueckschaltungen in 360� Mode" UBYTE FORMULA_0003 0 0 0.0 255.0000 ECU_ADDRESS 0x3FA85F /end MEASUREMENT
/begin MEASUREMENT pksr_st_nv "pksr Status Adaption" UBYTE FORMULA_0542 0 0 0.0 255.0 ECU_ADDRESS 0x3FA860 /end MEASUREMENT
/begin MEASUREMENT dmtl_abbr_fein "Anzahl abgebrochene Feindiags" UBYTE FORMULA_0543 0 0 0.0 255.0000 ECU_ADDRESS 0x3FA861 /end MEASUREMENT
/begin MEASUREMENT dmtl_abbr_ub "Anzahl Abbrueche wegen Spannung" UBYTE FORMULA_0543 0 0 0.0 255.0000 ECU_ADDRESS 0x3FA862 /end MEASUREMENT
/begin MEASUREMENT dmtl_abbr_feucht_mil "Anzahl Feuchteabbrueche fuer MIL" UBYTE FORMULA_0543 0 0 0.0 255.0000 ECU_ADDRESS 0x3FA863 /end MEASUREMENT
/begin MEASUREMENT dmtl_anz_deckel_leck "Anzahl erkannter Deckellecks" UBYTE FORMULA_0543 0 0 0.0 255.0000 ECU_ADDRESS 0x3FA864 /end MEASUREMENT
/begin MEASUREMENT dmtl_anz_dia_deckel "Anzahl durchgelaufene Deckeldiagnosen" UWORD FORMULA_0544 0 0 0.0 65535.0000 ECU_ADDRESS 0x3FA866 /end MEASUREMENT
/begin MEASUREMENT dmtl_anz_dia_grob "Anzahl durchgelaufene Grobleckdiagnosen" UWORD FORMULA_0544 0 0 0.0 65535.0000 ECU_ADDRESS 0x3FA868 /end MEASUREMENT
/begin MEASUREMENT dmtl_anz_dia_fein "Anzahl durchgelaufene Feinleckdiagnosen" UWORD FORMULA_0544 0 0 0.0 65535.0000 ECU_ADDRESS 0x3FA86A /end MEASUREMENT
/begin MEASUREMENT dmtl_anz_fahrten "Anzahl der langen Fahrten" UBYTE FORMULA_0003 0 0 0.0 255.0000 ECU_ADDRESS 0x3FA86C /end MEASUREMENT
/begin MEASUREMENT B_DMTL_DECKEL_GEPRUEFT "Deckel nach Betankung geprueft" UBYTE FORMULA_0216 0 0 0.0 255.0 ECU_ADDRESS 0x3FA86D BIT_MASK 0x1 /end MEASUREMENT
/begin MEASUREMENT B_DMTL_ABBRUCH_BETANK "Abbruch wegen starken Stromanstieg" UBYTE FORMULA_0545 0 0 0.0 255.0 ECU_ADDRESS 0x3FA86D BIT_MASK 0x2 /end MEASUREMENT
/begin MEASUREMENT B_DMTL_FST_GESTIEGEN "Nachtanken wurde erkannt" UBYTE FORMULA_0546 0 0 0.0 255.0 ECU_ADDRESS 0x3FA86D BIT_MASK 0x4 /end MEASUREMENT
/begin MEASUREMENT B_DMTL_GROB_VERMUT "Grobleck wegen Betankung?" UBYTE FORMULA_0547 0 0 0.0 255.0 ECU_ADDRESS 0x3FA86D BIT_MASK 0x8 /end MEASUREMENT
/begin MEASUREMENT B_DMTL_GROBLECK_1 "1x Grobleck Vermutung bestaetigt" UBYTE FORMULA_0548 0 0 0.0 255.0 ECU_ADDRESS 0x3FA86D BIT_MASK 0x10 /end MEASUREMENT
/begin MEASUREMENT B_DMTL_GROBLECK_2 "2x Grobleck Vermutung bestaetigt" UBYTE FORMULA_0549 0 0 0.0 255.0 ECU_ADDRESS 0x3FA86D BIT_MASK 0x20 /end MEASUREMENT
/begin MEASUREMENT B_DMTL_ABBRUCH_FEUCHT "Abbruch wg. Stromschwankung" UBYTE FORMULA_0550 0 0 0.0 255.0 ECU_ADDRESS 0x3FA86D BIT_MASK 0x40 /end MEASUREMENT
/begin MEASUREMENT B_DMTL_STANDZEIT "Standzeit fuer Diagnose erfuellt" UBYTE FORMULA_0223 0 0 0.0 255.0 ECU_ADDRESS 0x3FA86D BIT_MASK 0x80 /end MEASUREMENT
/begin MEASUREMENT dmtl_flags_nv "Flags der DMTL" UBYTE FORMULA_0003 0 0 0.0 255.0000 ECU_ADDRESS 0x3FA86D /end MEASUREMENT
/begin MEASUREMENT B_DMTL_DECKEL_DICHT "Deckel dicht bestaetigt durch Grobleckdia" UBYTE FORMULA_0216 0 0 0.0 255.0 ECU_ADDRESS 0x3FA86E BIT_MASK 0x1 /end MEASUREMENT
/begin MEASUREMENT dmtl_flags_nv2 "Flags der DMTL" UBYTE FORMULA_0003 0 0 0.0 255.0000 ECU_ADDRESS 0x3FA86E /end MEASUREMENT
/begin MEASUREMENT dmtl_grob_ohne_fein "Anzahl Grobleckdiags. ohne Feindiag" UBYTE FORMULA_0543 0 0 0.0 255.0000 ECU_ADDRESS 0x3FA86F /end MEASUREMENT
/begin MEASUREMENT dmtl_i_filt "DMTL Strom korrigiert und gefiltert" UWORD FORMULA_0551 0 0 0.0 147.4537 ECU_ADDRESS 0x3FA870 /end MEASUREMENT
/begin MEASUREMENT dmtl_i_filt.rest "DMTL Strom korr. Filter-Rest" UWORD FORMULA_0552 0 0 0.0 8.9998 ECU_ADDRESS 0x3FA872 /end MEASUREMENT
/begin MEASUREMENT dmtl_i_min "DMTL Strom minimal" UWORD FORMULA_0551 0 0 0.0 147.4537 ECU_ADDRESS 0x3FA874 /end MEASUREMENT
/begin MEASUREMENT dmtl_i_ref "DMTL Strom Referenzleck" UWORD FORMULA_0551 0 0 0.0 147.4537 ECU_ADDRESS 0x3FA876 /end MEASUREMENT
/begin MEASUREMENT dmtl_t_abstell "DMTL Abstellzeit" UWORD FORMULA_0553 0 0 0.0 65535.0000 ECU_ADDRESS 0x3FA878 /end MEASUREMENT
/begin MEASUREMENT dmtl_t_mess "DMTL aktuelle Me�dauer" UWORD FORMULA_0073 0 0 0.0 6553.5000 ECU_ADDRESS 0x3FA87A /end MEASUREMENT
/begin MEASUREMENT dmtl_crb_cid "" UBYTE FORMULA_0003 0 0 0.0 255.0000 ECU_ADDRESS 0x3FA87C /end MEASUREMENT
/begin MEASUREMENT dmtl_st_nv "Betriebszustand nichtfluechtig gespeichert" UBYTE FORMULA_0554 0 0 0.0 255.0 ECU_ADDRESS 0x3FA87D /end MEASUREMENT
/begin MEASUREMENT dmtl_crb_mess "Strom Diagnosemodul Tankleck" UWORD FORMULA_0551 0 0 0.0 147.4537 ECU_ADDRESS 0x3FA87E /end MEASUREMENT
/begin MEASUREMENT dmtl_crb_grenze "Strom Diagnosemodul Tankleck" UWORD FORMULA_0551 0 0 0.0 147.4537 ECU_ADDRESS 0x3FA880 /end MEASUREMENT
/begin MEASUREMENT dmtl_m6_fein_mess_nv "MODE6 DMTL Feinleck Messwert" UWORD FORMULA_0551 0 0 0.0 147.4537 ECU_ADDRESS 0x3FA882 /end MEASUREMENT
/begin MEASUREMENT dmtl_m6_fein_grenze_nv "MODE6 DMTL Feinleck Mindeststrom" UWORD FORMULA_0551 0 0 0.0 147.4537 ECU_ADDRESS 0x3FA884 /end MEASUREMENT
/begin MEASUREMENT dmtl_m6_grob_mess_nv "MODE6 DMTL Grobleck Messwert" UWORD FORMULA_0551 0 0 0.0 147.4537 ECU_ADDRESS 0x3FA886 /end MEASUREMENT
/begin MEASUREMENT dmtl_m6_grob_grenze_nv "MODE6 DMTL Grobleck Mindeststrom" UWORD FORMULA_0551 0 0 0.0 147.4537 ECU_ADDRESS 0x3FA888 /end MEASUREMENT
/begin MEASUREMENT te_obd_crb_cid_b1 "" UBYTE FORMULA_0003 0 0 0.0 255.0000 ECU_ADDRESS 0x3FA88A /end MEASUREMENT
/begin MEASUREMENT te_obd_crb_cid_b2 "" UBYTE FORMULA_0003 0 0 0.0 255.0000 ECU_ADDRESS 0x3FA88B /end MEASUREMENT
/begin MEASUREMENT te_obd_crb_mess_b1 "Prozent" SWORD FORMULA_0022 0 0 -200.0000 200.0000 ECU_ADDRESS 0x3FA88C /end MEASUREMENT
/begin MEASUREMENT te_obd_crb_mess_b2 "Prozent" SWORD FORMULA_0022 0 0 -200.0000 200.0000 ECU_ADDRESS 0x3FA88E /end MEASUREMENT
/begin MEASUREMENT te_obd_crb_grenze_b1 "Prozent" SWORD FORMULA_0022 0 0 -200.0000 200.0000 ECU_ADDRESS 0x3FA890 /end MEASUREMENT
/begin MEASUREMENT te_obd_crb_grenze_b2 "Prozent" SWORD FORMULA_0022 0 0 -200.0000 200.0000 ECU_ADDRESS 0x3FA892 /end MEASUREMENT
/begin MEASUREMENT te_obd_m6_lam_mess_nv "MODE6 TE LAM-Messwert" UWORD FORMULA_0025 0 0 0.0 3.9990 ECU_ADDRESS 0x3FA894 /end MEASUREMENT
/begin MEASUREMENT te_obd_m6_ll_mess_nv "MODE6 TE LL-Messwert" UWORD FORMULA_0022 0 0 0.0 200.0000 ECU_ADDRESS 0x3FA896 /end MEASUREMENT
/begin MEASUREMENT te_obd_m6_auss_mess_nv "MODE6 TE AUSS-Messwert" SWORD FORMULA_0022 0 0 -200.0000 200.0000 ECU_ADDRESS 0x3FA898 /end MEASUREMENT
/begin MEASUREMENT pksr_adap_off_roh_nv "Adaptionsoffset roh PKSR " SWORD FORMULA_0555 0 0 -100.0000 99.9900 ECU_ADDRESS 0x3FA89A /end MEASUREMENT
/begin MEASUREMENT pksr_adap_fak_nv "Adaptionsfaktor PKSR " UWORD FORMULA_0556 0 0 0.0 6.0000 ECU_ADDRESS 0x3FA89C /end MEASUREMENT
/begin MEASUREMENT fst_max_nv "Fuellstand zu Beginn der Diagnose" UBYTE FORMULA_0557 0 0 0.0 127.5000 ECU_ADDRESS 0x3FA89E /end MEASUREMENT
/begin MEASUREMENT fst_min_nv "Min. Fuellstand, fuer Nachtankerkennung" UBYTE FORMULA_0557 0 0 0.0 127.5000 ECU_ADDRESS 0x3FA89F /end MEASUREMENT
/begin MEASUREMENT fst_rechts "gefilterter Geberwert rechts" UBYTE FORMULA_0557 0 0 0.0 127.5000 ECU_ADDRESS 0x3FA8A0 /end MEASUREMENT
/begin MEASUREMENT fst_rechts.rest "Filter Rest Geberwert rechts" UBYTE FORMULA_0558 0 0 0.0 0.4980 ECU_ADDRESS 0x3FA8A1 /end MEASUREMENT
/begin MEASUREMENT fst_verbr_nv "Verbrauchter Kraftstoff" UWORD FORMULA_0559 0 0 0.0 67.1078 ECU_ADDRESS 0x3FA8A2 /end MEASUREMENT
/begin MEASUREMENT kwp_ps_teststamp_1of3_ "" UBYTE FORMULA_0003 0 0 0.0 255.0000 ECU_ADDRESS 0x3FA8A4 /end MEASUREMENT
/begin MEASUREMENT kwp_ps_teststamp_2of3_ "" UBYTE FORMULA_0003 0 0 0.0 255.0000 ECU_ADDRESS 0x3FA8A5 /end MEASUREMENT
/begin MEASUREMENT kwp_ps_teststamp_3of3_ "" UBYTE FORMULA_0003 0 0 0.0 255.0000 ECU_ADDRESS 0x3FA8A6 /end MEASUREMENT
/begin MEASUREMENT tksm_off_nv "Temperaturdifferenz TKS Modell zu ungefiltert." SWORD FORMULA_0076 0 0 -1000.0000 1000.0000 ECU_ADDRESS 0x3FA8A8 /end MEASUREMENT
/begin MEASUREMENT tksm_mr_off_nv "Temperaturdifferenz Motorraum zu TMOT." SWORD FORMULA_0076 0 0 -1000.0000 1000.0000 ECU_ADDRESS 0x3FA8AA /end MEASUREMENT
/begin MEASUREMENT tanzyl_off_nv "Temperaturdifferenz TANZYL Modell zu ungefiltert." SWORD FORMULA_0076 0 0 -1000.0000 1000.0000 ECU_ADDRESS 0x3FA8AC /end MEASUREMENT
/begin MEASUREMENT tanzyl_mr_off_nv "Temperaturdifferenz Motorraum zu TMOT." SWORD FORMULA_0076 0 0 -1000.0000 1000.0000 ECU_ADDRESS 0x3FA8AE /end MEASUREMENT
/begin MEASUREMENT tpu_kw_n_drop_ff.state "Zustand der TPU" UBYTE FORMULA_0016 0 0 0.0 255.0 ECU_ADDRESS 0x3FA8B0 /end MEASUREMENT
/begin MEASUREMENT tpu_kw_n_drop_ff.tooth "Abrisszahn" UBYTE FORMULA_0003 0 0 0.0 255.0000 ECU_ADDRESS 0x3FA8B1 /end MEASUREMENT
/begin MEASUREMENT tpu_kw_n_drop_ff.irq "Interruptarten" UBYTE FORMULA_0003 0 0 0.0 255.0000 ECU_ADDRESS 0x3FA8B2 /end MEASUREMENT
/begin MEASUREMENT tpu_kw_n_drop_ff.cnt "Abrisszaehler" UBYTE FORMULA_0003 0 0 0.0 255.0000 ECU_ADDRESS 0x3FA8B3 /end MEASUREMENT
/begin MEASUREMENT tpu_kw_n_drop_ff.n "Abrissdrehzahl" SWORD FORMULA_0006 0 0 0.0 10000.0000 ECU_ADDRESS 0x3FA8B4 /end MEASUREMENT
/begin MEASUREMENT tpu_kw_n_drop_ff.n_zahn "Abrisszahndrehzahl" SWORD FORMULA_0006 0 0 0.0 10000.0000 ECU_ADDRESS 0x3FA8B6 /end MEASUREMENT
/begin MEASUREMENT tpu_kw_n_drop_ff.prev_period "vorletzte Zahnperiode" ULONG FORMULA_0017 0 0 0.0 2396.7450 ECU_ADDRESS 0x3FA8B8 /end MEASUREMENT
/begin MEASUREMENT tpu_kw_n_drop_ff.last_period "letzte Zahnperiode" ULONG FORMULA_0017 0 0 0.0 2396.7450 ECU_ADDRESS 0x3FA8BC /end MEASUREMENT
/begin MEASUREMENT tpu_kw_n_drop_ff.event_time "letzte Ereigniszeit" ULONG FORMULA_0017 0 0 0.0 2396.7450 ECU_ADDRESS 0x3FA8C0 /end MEASUREMENT
/begin MEASUREMENT tpu_kw_n_drop_ff.tooth_time "letzte Zahnzeit" ULONG FORMULA_0017 0 0 0.0 2396.7450 ECU_ADDRESS 0x3FA8C4 /end MEASUREMENT
/begin MEASUREMENT elu_typ_nv "verbauter E-Luefter-Typ" UBYTE FORMULA_0560 0 0 0.0 255.0 ECU_ADDRESS 0x3FA8C8 /end MEASUREMENT
/begin MEASUREMENT slp_time_on_nv "Laufzeit der SLP" UWORD FORMULA_0073 0 0 0.0 6553.5000 ECU_ADDRESS 0x3FA8CA /end MEASUREMENT
/begin MEASUREMENT sls_obdh_mdf_max_intg_norm_nv "Norm. MDF Max-Integral der Soll/-Istabweichung" SWORD FORMULA_0561 0 0 -32.7670 32.7670 ECU_ADDRESS 0x3FA8CC /end MEASUREMENT
/begin MEASUREMENT sls_obdh_mdf_min_intg_norm_nv "Norm. MDF Min-Integral der Soll/-Istabweichung" SWORD FORMULA_0561 0 0 -32.7670 32.7670 ECU_ADDRESS 0x3FA8CE /end MEASUREMENT
/begin MEASUREMENT pumg_obd_abstell_nv "Umgebungsdruck beim Abstellen" SWORD FORMULA_0077 0 0 400.0000 1200.0000 ECU_ADDRESS 0x3FA8D0 /end MEASUREMENT
/begin MEASUREMENT kge_ml_intg_min_nv_1of2_ "Minwert Luftmassenstrom-Integral" UWORD FORMULA_0562 0 0 0.0 6553.5000 ECU_ADDRESS 0x3FA8D2 /end MEASUREMENT
/begin MEASUREMENT kge_ml_intg_min_nv_2of2_ "Minwert Luftmassenstrom-Integral" UWORD FORMULA_0562 0 0 0.0 6553.5000 ECU_ADDRESS 0x3FA8D4 /end MEASUREMENT
/begin MEASUREMENT kge_ml_mw_intg_min_nv_1of2_ "Minwert MW Luftmassenstrom-Integral" UWORD FORMULA_0562 0 0 0.0 6553.5000 ECU_ADDRESS 0x3FA8D6 /end MEASUREMENT
/begin MEASUREMENT kge_ml_mw_intg_min_nv_2of2_ "Minwert MW Luftmassenstrom-Integral" UWORD FORMULA_0562 0 0 0.0 6553.5000 ECU_ADDRESS 0x3FA8D8 /end MEASUREMENT
/begin MEASUREMENT ed_rbm_ignition_count_nv "Motorstartzaehler" UWORD FORMULA_0010 0 0 0.0 65535.0000 ECU_ADDRESS 0x3FA8DA /end MEASUREMENT
/begin MEASUREMENT ed_rbm_general_dcy_nv "General Denominator" UWORD FORMULA_0010 0 0 0.0 65535.0000 ECU_ADDRESS 0x3FA8DC /end MEASUREMENT
/begin MEASUREMENT ed_rbm_css_denominator_nv "CSS Denominator" UWORD FORMULA_0010 0 0 0.0 65535.0000 ECU_ADDRESS 0x3FA8DE /end MEASUREMENT
/begin MEASUREMENT ed_rbm_css_numerator_nv "CSS Numerator" UWORD FORMULA_0010 0 0 0.0 65535.0000 ECU_ADDRESS 0x3FA8E0 /end MEASUREMENT
/begin MEASUREMENT ed_css_st_inj_nv "CSS-Status der Funktionen" UWORD FORMULA_0083 0 0 0.0 65535.0000 ECU_ADDRESS 0x3FA8E2 /end MEASUREMENT
/begin MEASUREMENT ed_css_st_inj_nv_sls "Sekundaerluft" UWORD FORMULA_0563 0 0 0.0 65535.0 ECU_ADDRESS 0x3FA8E2 BIT_MASK 0x1 /end MEASUREMENT
/begin MEASUREMENT ed_css_st_inj_nv_ti "Einspritzung" UWORD FORMULA_0564 0 0 0.0 65535.0 ECU_ADDRESS 0x3FA8E2 BIT_MASK 0x2 /end MEASUREMENT
/begin MEASUREMENT ed_css_st_inj_nv_kds "Kraftstoffsystem" UWORD FORMULA_0565 0 0 0.0 65535.0 ECU_ADDRESS 0x3FA8E2 BIT_MASK 0x4 /end MEASUREMENT
/begin MEASUREMENT ed_css_st_inj_nv_hfm "Luftmassenmesser" UWORD FORMULA_0566 0 0 0.0 65535.0 ECU_ADDRESS 0x3FA8E2 BIT_MASK 0x8 /end MEASUREMENT
/begin MEASUREMENT ed_css_st_inj_nv_fplau "Fuellungsplausi" UWORD FORMULA_0567 0 0 0.0 65535.0 ECU_ADDRESS 0x3FA8E2 BIT_MASK 0x10 /end MEASUREMENT
/begin MEASUREMENT ed_css_st_inj_nv_kw "Kurbelwelle" UWORD FORMULA_0568 0 0 0.0 65535.0 ECU_ADDRESS 0x3FA8E2 BIT_MASK 0x20 /end MEASUREMENT
/begin MEASUREMENT ed_css_st_inj_nv_van "Vanos" UWORD FORMULA_0569 0 0 0.0 65535.0 ECU_ADDRESS 0x3FA8E2 BIT_MASK 0x40 /end MEASUREMENT
/begin MEASUREMENT ed_css_st_inj_nv_pt_can "Powertrain CAN" UWORD FORMULA_0570 0 0 0.0 65535.0 ECU_ADDRESS 0x3FA8E2 BIT_MASK 0x80 /end MEASUREMENT
/begin MEASUREMENT ed_css_st_inj_nv_elup "Elektrische Unterdruckpumpe" UWORD FORMULA_0571 0 0 0.0 65535.0 ECU_ADDRESS 0x3FA8E2 BIT_MASK 0x100 /end MEASUREMENT
/begin MEASUREMENT ed_wuc_counter_nv "Anzahl Warmupcycle seit FSP-Loeschen" UBYTE FORMULA_0003 0 0 0.0 255.0000 ECU_ADDRESS 0x3FA8E4 /end MEASUREMENT
/begin MEASUREMENT ed_fsp_del_km_stand_nv "Kilometerstand FSP-Loeschen" ULONG FORMULA_0027 0 0 0.0 16777214.0000 ECU_ADDRESS 0x3FA8E8 /end MEASUREMENT
/begin MEASUREMENT kat_obd_wert_max_nv_b1 "max. KAT-Diag. Wert ueber alle Diagnosen" UWORD FORMULA_0025 0 0 0.0 3.9990 ECU_ADDRESS 0x3FA8EC /end MEASUREMENT
/begin MEASUREMENT kat_obd_wert_max_nv_b2 "max. KAT-Diag. Wert ueber alle Diagnosen" UWORD FORMULA_0025 0 0 0.0 3.9990 ECU_ADDRESS 0x3FA8EE /end MEASUREMENT
/begin MEASUREMENT pumg_obd_st_nv "OBD-Status pumg" UBYTE FORMULA_0572 0 0 0.0 255.0 ECU_ADDRESS 0x3FA8F0 /end MEASUREMENT
/begin MEASUREMENT pumg_obd_start_nv "pumg waehrend des Motorstart" SWORD FORMULA_0077 0 0 400.0000 1200.0000 ECU_ADDRESS 0x3FA8F2 /end MEASUREMENT
/begin MEASUREMENT sls_obdh_lam_intg_norm_nv "Normiertes Lam-Integral der Soll/-Istabweichung" SWORD FORMULA_0573 0 0 -1.9000 1.9000 ECU_ADDRESS 0x3FA8F4 /end MEASUREMENT
/begin MEASUREMENT sls_obdh_mdf_max_intg_norm_ph_nv "Peakhold des norm. MDF Max-Integral der Soll/-Istabweichung" SWORD FORMULA_0561 0 0 -32.7670 32.7670 ECU_ADDRESS 0x3FA8F6 /end MEASUREMENT
/begin MEASUREMENT sls_obdh_mdf_min_intg_norm_ph_nv "Peakhold des norm. MDF Min-Integral der Soll/-Istabweichung" SWORD FORMULA_0561 0 0 -32.7670 32.7670 ECU_ADDRESS 0x3FA8F8 /end MEASUREMENT
/begin MEASUREMENT sls_obdh_lam_intg_norm_maxph_nv "Max. Peakhold norm. Lam-Integral der Soll/-Istabweichung" SWORD FORMULA_0573 0 0 -1.9000 1.9000 ECU_ADDRESS 0x3FA8FA /end MEASUREMENT
/begin MEASUREMENT sls_obdh_lam_intg_norm_minph_nv "Min. Peakhold Norm. Lam-Integral der Soll/-Istabweichung" SWORD FORMULA_0573 0 0 -1.9000 1.9000 ECU_ADDRESS 0x3FA8FC /end MEASUREMENT
/begin MEASUREMENT kats_nkat_t_nv_1of2_ "Zeit im Katschutz wegen Nkat-Tempereratur(Sensor)" UWORD FORMULA_0073 0 0 0.0 6553.5000 ECU_ADDRESS 0x3FA8FE /end MEASUREMENT
/begin MEASUREMENT kats_nkat_t_nv_2of2_ "Zeit im Katschutz wegen Nkat-Tempereratur(Sensor)" UWORD FORMULA_0073 0 0 0.0 6553.5000 ECU_ADDRESS 0x3FA900 /end MEASUREMENT
/begin MEASUREMENT kats_mdl_t_nv_1of2_ "Zeit im Katschutz wegen Modelltempereratur(Sensor)" UWORD FORMULA_0073 0 0 0.0 6553.5000 ECU_ADDRESS 0x3FA902 /end MEASUREMENT
/begin MEASUREMENT kats_mdl_t_nv_2of2_ "Zeit im Katschutz wegen Modelltempereratur(Sensor)" UWORD FORMULA_0073 0 0 0.0 6553.5000 ECU_ADDRESS 0x3FA904 /end MEASUREMENT
/begin MEASUREMENT kats_vkat_t_nv_1of2_ "Zeit im Katschutz wegen Vkat-Tempereratur(Sensor)" UWORD FORMULA_0073 0 0 0.0 6553.5000 ECU_ADDRESS 0x3FA906 /end MEASUREMENT
/begin MEASUREMENT kats_vkat_t_nv_2of2_ "Zeit im Katschutz wegen Vkat-Tempereratur(Sensor)" UWORD FORMULA_0073 0 0 0.0 6553.5000 ECU_ADDRESS 0x3FA908 /end MEASUREMENT
/begin MEASUREMENT lam_reg_ff_lam_ist_mw_b1 "FF-Mittelwert IST-Lambda" UWORD FORMULA_0025 0 0 0.0 3.9990 ECU_ADDRESS 0x3FA90A /end MEASUREMENT
/begin MEASUREMENT lam_reg_ff_lam_ist_mw_b2 "FF-Mittelwert IST-Lambda" UWORD FORMULA_0025 0 0 0.0 3.9990 ECU_ADDRESS 0x3FA90C /end MEASUREMENT
/begin MEASUREMENT lam_reg_ff_lam_soll_b1 "FF-ausgegebenes SOLL-Lambda" UWORD FORMULA_0025 0 0 0.0 3.9990 ECU_ADDRESS 0x3FA90E /end MEASUREMENT
/begin MEASUREMENT lam_reg_ff_lam_soll_b2 "FF-ausgegebenes SOLL-Lambda" UWORD FORMULA_0025 0 0 0.0 3.9990 ECU_ADDRESS 0x3FA910 /end MEASUREMENT
/begin MEASUREMENT lam_reg_ff_lam_reg_f_b1 "FF-Regeleingriff" UWORD FORMULA_0024 0 0 0.0 1.9990 ECU_ADDRESS 0x3FA912 /end MEASUREMENT
/begin MEASUREMENT lam_reg_ff_lam_reg_f_b2 "FF-Regeleingriff" UWORD FORMULA_0024 0 0 0.0 1.9990 ECU_ADDRESS 0x3FA914 /end MEASUREMENT
/begin MEASUREMENT lam_reg_ff_te_tv_b1 "FF-auszugebendes TE-Tastverhaeltnis" UWORD FORMULA_0001 0 0 0.0 100.0000 ECU_ADDRESS 0x3FA916 /end MEASUREMENT
/begin MEASUREMENT lam_reg_ff_te_tv_b2 "FF-auszugebendes TE-Tastverhaeltnis" UWORD FORMULA_0001 0 0 0.0 100.0000 ECU_ADDRESS 0x3FA918 /end MEASUREMENT
/begin MEASUREMENT lam_reg_ff_te_c_akf "FF-Konzentration - AKF" UWORD FORMULA_0556 0 0 0.0 2.0000 ECU_ADDRESS 0x3FA91A /end MEASUREMENT
/begin MEASUREMENT lam_reg_ff_n "FF-lam_reg n" SWORD FORMULA_0006 0 0 0.0 10000.0000 ECU_ADDRESS 0x3FA91C /end MEASUREMENT
/begin MEASUREMENT lam_reg_ff_rf_b1 "FF-Lam_reg relative Fuellung" SWORD FORMULA_0007 0 0 0.0 2.0000 ECU_ADDRESS 0x3FA91E /end MEASUREMENT
/begin MEASUREMENT lam_reg_ff_rf_b2 "FF-Lam_reg relative Fuellung" SWORD FORMULA_0007 0 0 0.0 2.0000 ECU_ADDRESS 0x3FA920 /end MEASUREMENT
/begin MEASUREMENT lam_reg_ff_ml_b1 "FF-Lam_reg Luftmassenstrom" SWORD FORMULA_0112 0 0 -100.0000 1400.0000 ECU_ADDRESS 0x3FA922 /end MEASUREMENT
/begin MEASUREMENT lam_reg_ff_ml_b2 "FF-Lam_reg Luftmassenstrom" SWORD FORMULA_0112 0 0 -100.0000 1400.0000 ECU_ADDRESS 0x3FA924 /end MEASUREMENT
/begin MEASUREMENT lam_reg_ff_ml_hfm_b1 "FF-Lam_reg Luftmassenstrom aus HFM" SWORD FORMULA_0112 0 0 -100.0000 1400.0000 ECU_ADDRESS 0x3FA926 /end MEASUREMENT
/begin MEASUREMENT lam_reg_ff_ml_hfm_b2 "FF-Lam_reg Luftmassenstrom aus HFM" SWORD FORMULA_0112 0 0 -100.0000 1400.0000 ECU_ADDRESS 0x3FA928 /end MEASUREMENT
/begin MEASUREMENT lam_reg_ff_laa_offs_b1 "FF-lam_reg Offset-Lambdaadaption" SWORD FORMULA_0531 0 0 -512.0000 511.0000 ECU_ADDRESS 0x3FA92A /end MEASUREMENT
/begin MEASUREMENT lam_reg_ff_laa_offs_b2 "FF-lam_reg Offset-Lambdaadaption" SWORD FORMULA_0531 0 0 -512.0000 511.0000 ECU_ADDRESS 0x3FA92C /end MEASUREMENT
/begin MEASUREMENT lam_reg_ff_laa_f_b1 "FF-lam_reg Faktor-Lambdaadaption" UWORD FORMULA_0024 0 0 0.0 1.9990 ECU_ADDRESS 0x3FA92E /end MEASUREMENT
/begin MEASUREMENT lam_reg_ff_laa_f_b2 "FF-lam_reg Faktor-Lambdaadaption" UWORD FORMULA_0024 0 0 0.0 1.9990 ECU_ADDRESS 0x3FA930 /end MEASUREMENT
/begin MEASUREMENT lam_reg_ff_laa_f_ber_b1 "FF-lam_reg Faktor-Lambdaadaption ohne TE" UWORD FORMULA_0024 0 0 0.0 1.9990 ECU_ADDRESS 0x3FA932 /end MEASUREMENT
/begin MEASUREMENT lam_reg_ff_laa_f_ber_b2 "FF-lam_reg Faktor-Lambdaadaption ohne TE" UWORD FORMULA_0024 0 0 0.0 1.9990 ECU_ADDRESS 0x3FA934 /end MEASUREMENT
/begin MEASUREMENT lam_reg_ff_zustand_motor "FF-lam_reg Betriebszustand der Motorsteuerung" UWORD FORMULA_0019 0 0 0.0 65535.0 ECU_ADDRESS 0x3FA936 /end MEASUREMENT
/begin MEASUREMENT lam_reg_ff_tmot "FF-lam_reg Motortemperatur-Kuehlwasser" SWORD FORMULA_0023 0 0 -50.0000 170.0000 ECU_ADDRESS 0x3FA938 /end MEASUREMENT
/begin MEASUREMENT lam_reg_ff_tan_mw "FF-lam_reg Mittelwert der Ansauglufttemperatur" SWORD FORMULA_0023 0 0 -50.0000 170.0000 ECU_ADDRESS 0x3FA93A /end MEASUREMENT
/begin MEASUREMENT lam_reg_ff_pumg "FF-lam_reg Gefilterter Messwert" SWORD FORMULA_0077 0 0 400.0000 1200.0000 ECU_ADDRESS 0x3FA93C /end MEASUREMENT
/begin MEASUREMENT lam_reg_ff_ub "FF-lam_reg Spannungswert U_KL87" SWORD FORMULA_0008 0 0 0.0 28.0000 ECU_ADDRESS 0x3FA93E /end MEASUREMENT
/begin MEASUREMENT lam_reg_ff_kh_st "FF-lam_reg Katheizstatus Aktiv bzw. Inaktiv" UWORD FORMULA_0574 0 0 0.0 65535.0 ECU_ADDRESS 0x3FA940 BIT_MASK 0x13D /end MEASUREMENT
/begin MEASUREMENT lam_reg_ff_kats_st_1of2_ "FF-lam_reg Katschutz-Status" UBYTE FORMULA_0575 0 0 0.0 255.0 ECU_ADDRESS 0x3FA942 /end MEASUREMENT
/begin MEASUREMENT lam_reg_ff_kats_st_2of2_ "FF-lam_reg Katschutz-Status" UBYTE FORMULA_0575 0 0 0.0 255.0 ECU_ADDRESS 0x3FA943 /end MEASUREMENT
/begin MEASUREMENT lam_reg_ff_v_vorne "FF-lam_reg v-Vorderachse" SWORD FORMULA_0078 0 0 -80.0000 360.0000 ECU_ADDRESS 0x3FA944 /end MEASUREMENT
/begin MEASUREMENT lam_reg_ff_egas_ist_dk_1of2_ "FF-lam_reg Istwert (CAN)" SWORD FORMULA_0001 0 0 -10.0000 120.0000 ECU_ADDRESS 0x3FA946 /end MEASUREMENT
/begin MEASUREMENT lam_reg_ff_egas_ist_dk_2of2_ "FF-lam_reg Istwert (CAN)" SWORD FORMULA_0001 0 0 -10.0000 120.0000 ECU_ADDRESS 0x3FA948 /end MEASUREMENT
/begin MEASUREMENT lam_reg_ff_egas_ist_lls_1of2_ "FF-lam_reg Istwert (CAN)" SWORD FORMULA_0001 0 0 -10.0000 120.0000 ECU_ADDRESS 0x3FA94A /end MEASUREMENT
/begin MEASUREMENT lam_reg_ff_egas_ist_lls_2of2_ "FF-lam_reg Istwert (CAN)" SWORD FORMULA_0001 0 0 -10.0000 120.0000 ECU_ADDRESS 0x3FA94C /end MEASUREMENT
/begin MEASUREMENT lam_reg_ff_pks_rel "FF-lam_reg Kraftstoffdruck, relativ" SWORD FORMULA_0118 0 0 0.0 10.0000 ECU_ADDRESS 0x3FA94E /end MEASUREMENT
/begin MEASUREMENT lam_reg_ff_hfm_ml_5ms_1of2_ "FF-lam_reg Luftmassenstrom aus HFM" SWORD FORMULA_0112 0 0 -100.0000 1400.0000 ECU_ADDRESS 0x3FA950 /end MEASUREMENT
/begin MEASUREMENT lam_reg_ff_hfm_ml_5ms_2of2_ "FF-lam_reg Luftmassenstrom aus HFM" SWORD FORMULA_0112 0 0 -100.0000 1400.0000 ECU_ADDRESS 0x3FA952 /end MEASUREMENT
/begin MEASUREMENT lam_reg_ff_fr_reg_out_1of2_ "FF-lam_reg Korrekturfaktor FR-Regler" UWORD FORMULA_0024 0 0 0.5000 1.5000 ECU_ADDRESS 0x3FA954 /end MEASUREMENT
/begin MEASUREMENT lam_reg_ff_fr_reg_out_2of2_ "FF-lam_reg Korrekturfaktor FR-Regler" UWORD FORMULA_0024 0 0 0.5000 1.5000 ECU_ADDRESS 0x3FA956 /end MEASUREMENT
/begin MEASUREMENT lam_reg_ff_egas_soll_dk_1of2_ "FF-lam_reg DK-Sollwert" SWORD FORMULA_0001 0 0 -10.0000 120.0000 ECU_ADDRESS 0x3FA958 /end MEASUREMENT
/begin MEASUREMENT lam_reg_ff_egas_soll_dk_2of2_ "FF-lam_reg DK-Sollwert" SWORD FORMULA_0001 0 0 -10.0000 120.0000 ECU_ADDRESS 0x3FA95A /end MEASUREMENT
/begin MEASUREMENT lam_reg_ff_egas_soll_lls_1of2_ "FF-lam_reg LLS-Sollwert" SWORD FORMULA_0001 0 0 -10.0000 120.0000 ECU_ADDRESS 0x3FA95C /end MEASUREMENT
/begin MEASUREMENT lam_reg_ff_egas_soll_lls_2of2_ "FF-lam_reg LLS-Sollwert" SWORD FORMULA_0001 0 0 -10.0000 120.0000 ECU_ADDRESS 0x3FA95E /end MEASUREMENT
/* ------------------ Abschnitt erzeugt aus adapt_wichtig.dat ------------------ */
/begin MEASUREMENT eeprom_crc_wichtig_nv "Lebensdauer Adaptionsdaten" ULONG FORMULA_0000 0 0 0.0 4294967295.0000 ECU_ADDRESS 0x3F9464 /end MEASUREMENT
/begin MEASUREMENT eeprom_anzahl_schreiben_nv "Anzahl der Schreibvorgaenge ins Flash" ULONG FORMULA_0576 0 0 0.0 4294967295.0000 ECU_ADDRESS 0x3F9468 /end MEASUREMENT
/begin MEASUREMENT eeprom_datenlaenge_wichtig_nv "Anzahl der Datenbytes" UWORD FORMULA_0577 0 0 0.0 262140.0000 ECU_ADDRESS 0x3F946C /end MEASUREMENT
/begin MEASUREMENT eeprom_version_prog_nv "Programmversion beim Abspeichern" UWORD FORMULA_0578 0 0 0.0 65535.0000 ECU_ADDRESS 0x3F946E /end MEASUREMENT
/begin MEASUREMENT eeprom_crc_nv "Standstabile Adaptionsdaten" ULONG FORMULA_0000 0 0 0.0 4294967295.0000 ECU_ADDRESS 0x3F9470 /end MEASUREMENT
/begin MEASUREMENT eeprom_datenlaenge_nv "Anzahl der Datenbytes" UWORD FORMULA_0577 0 0 0.0 262140.0000 ECU_ADDRESS 0x3F9474 /end MEASUREMENT
/begin MEASUREMENT eeprom_date_1of9_ "Erstelldatum beim Abspeichern" UBYTE FORMULA_0414 0 0 0.0 255.0 ECU_ADDRESS 0x3F9476 /end MEASUREMENT
/begin MEASUREMENT eeprom_date_2of9_ "Erstelldatum beim Abspeichern" UBYTE FORMULA_0414 0 0 0.0 255.0 ECU_ADDRESS 0x3F9477 /end MEASUREMENT
/begin MEASUREMENT eeprom_date_3of9_ "Erstelldatum beim Abspeichern" UBYTE FORMULA_0414 0 0 0.0 255.0 ECU_ADDRESS 0x3F9478 /end MEASUREMENT
/begin MEASUREMENT eeprom_date_4of9_ "Erstelldatum beim Abspeichern" UBYTE FORMULA_0414 0 0 0.0 255.0 ECU_ADDRESS 0x3F9479 /end MEASUREMENT
/begin MEASUREMENT eeprom_date_5of9_ "Erstelldatum beim Abspeichern" UBYTE FORMULA_0414 0 0 0.0 255.0 ECU_ADDRESS 0x3F947A /end MEASUREMENT
/begin MEASUREMENT eeprom_date_6of9_ "Erstelldatum beim Abspeichern" UBYTE FORMULA_0414 0 0 0.0 255.0 ECU_ADDRESS 0x3F947B /end MEASUREMENT
/begin MEASUREMENT eeprom_date_7of9_ "Erstelldatum beim Abspeichern" UBYTE FORMULA_0414 0 0 0.0 255.0 ECU_ADDRESS 0x3F947C /end MEASUREMENT
/begin MEASUREMENT eeprom_date_8of9_ "Erstelldatum beim Abspeichern" UBYTE FORMULA_0414 0 0 0.0 255.0 ECU_ADDRESS 0x3F947D /end MEASUREMENT
/begin MEASUREMENT eeprom_date_9of9_ "Erstelldatum beim Abspeichern" UBYTE FORMULA_0414 0 0 0.0 255.0 ECU_ADDRESS 0x3F947E /end MEASUREMENT
/begin MEASUREMENT eeprom_time_1of6_ "Erstellzeit beim Abspeichern" UBYTE FORMULA_0414 0 0 0.0 255.0 ECU_ADDRESS 0x3F947F /end MEASUREMENT
/begin MEASUREMENT eeprom_time_2of6_ "Erstellzeit beim Abspeichern" UBYTE FORMULA_0414 0 0 0.0 255.0 ECU_ADDRESS 0x3F9480 /end MEASUREMENT
/begin MEASUREMENT eeprom_time_3of6_ "Erstellzeit beim Abspeichern" UBYTE FORMULA_0414 0 0 0.0 255.0 ECU_ADDRESS 0x3F9481 /end MEASUREMENT
/begin MEASUREMENT eeprom_time_4of6_ "Erstellzeit beim Abspeichern" UBYTE FORMULA_0414 0 0 0.0 255.0 ECU_ADDRESS 0x3F9482 /end MEASUREMENT
/begin MEASUREMENT eeprom_time_5of6_ "Erstellzeit beim Abspeichern" UBYTE FORMULA_0414 0 0 0.0 255.0 ECU_ADDRESS 0x3F9483 /end MEASUREMENT
/begin MEASUREMENT eeprom_time_6of6_ "Erstellzeit beim Abspeichern" UBYTE FORMULA_0414 0 0 0.0 255.0 ECU_ADDRESS 0x3F9484 /end MEASUREMENT
/begin MEASUREMENT hdw_1_nv "HDW" ULONG FORMULA_0000 0 0 0.0 4294967295.0000 ECU_ADDRESS 0x3F9488 /end MEASUREMENT
/begin MEASUREMENT hdw_2_nv "HDW" ULONG FORMULA_0000 0 0 0.0 4294967295.0000 ECU_ADDRESS 0x3F948C /end MEASUREMENT
/begin MEASUREMENT hdw_3_nv "HDW" ULONG FORMULA_0000 0 0 0.0 4294967295.0000 ECU_ADDRESS 0x3F9490 /end MEASUREMENT
/begin MEASUREMENT time_bz_nv "Betriebszeit der DME" ULONG FORMULA_0540 0 0 0.0 4294967295.0000 ECU_ADDRESS 0x3F9494 /end MEASUREMENT
/begin MEASUREMENT v_max_ff_v_max "Maximalgeschwindigkeit" SWORD FORMULA_0078 0 0 -80.0000 360.0000 ECU_ADDRESS 0x3F9498 /end MEASUREMENT
/begin MEASUREMENT v_max_ff_v_max_schw "Abregelgeschwindigkeit" SWORD FORMULA_0078 0 0 -80.0000 360.0000 ECU_ADDRESS 0x3F949A /end MEASUREMENT
/begin MEASUREMENT v_max_ff_v_hinten "mittl. Hinterachsgeschw." SWORD FORMULA_0078 0 0 -80.0000 360.0000 ECU_ADDRESS 0x3F949C /end MEASUREMENT
/begin MEASUREMENT v_max_ff_v_direkt "direkt ermittelte Fzgeschw." SWORD FORMULA_0078 0 0 -80.0000 360.0000 ECU_ADDRESS 0x3F949E /end MEASUREMENT
/begin MEASUREMENT v_max_ff_km_stand "Kilometerstand" ULONG FORMULA_0027 0 0 0.0 16777214.0000 ECU_ADDRESS 0x3F94A0 /end MEASUREMENT
/begin MEASUREMENT v_max_ff_n "Motordrehzahl" SWORD FORMULA_0006 0 0 0.0 10000.0000 ECU_ADDRESS 0x3F94A4 /end MEASUREMENT
/begin MEASUREMENT v_max_ff_md_fahrer "Fahrerwunschmoment" SWORD FORMULA_0009 0 0 -100.0000 1000.0000 ECU_ADDRESS 0x3F94A6 /end MEASUREMENT
/begin MEASUREMENT v_max_ff_md_ist "Kupplungs-Istmoment" SWORD FORMULA_0009 0 0 -100.0000 1000.0000 ECU_ADDRESS 0x3F94A8 /end MEASUREMENT
/begin MEASUREMENT v_max_ff_gang "Istgang" SBYTE FORMULA_0318 0 0 -1.0000 10.0000 ECU_ADDRESS 0x3F94AA /end MEASUREMENT
/begin MEASUREMENT v_max_ff_v_max_st "Status Maximalgeschwindigkeit" UBYTE FORMULA_0003 0 0 0.0 255.0000 ECU_ADDRESS 0x3F94AB /end MEASUREMENT
/begin MEASUREMENT n_max_ff_anzahl "Anzahl der Begrenzungsphasen" UWORD FORMULA_0010 0 0 0.0 65535.0000 ECU_ADDRESS 0x3F94AC /end MEASUREMENT
/begin MEASUREMENT n_max_ff_nmax "Erreichte Maximaldrehzahl" SWORD FORMULA_0006 0 0 0.0 10000.0000 ECU_ADDRESS 0x3F94AE /end MEASUREMENT
/begin MEASUREMENT n_max_ff_n_grad "Gradient" SWORD FORMULA_0114 0 0 -10000.0000 10000.0000 ECU_ADDRESS 0x3F94B0 /end MEASUREMENT
/begin MEASUREMENT n_max_ff_n_vanos "Referenzdrehzahl aus Vanos" SWORD FORMULA_0006 0 0 0.0 10000.0000 ECU_ADDRESS 0x3F94B2 /end MEASUREMENT
/begin MEASUREMENT n_max_ff_n_getriebe "Getriebeeingangsdrehzahl" SWORD FORMULA_0006 0 0 0.0 10000.0000 ECU_ADDRESS 0x3F94B4 /end MEASUREMENT
/begin MEASUREMENT n_max_ff_nbegr_egas "Begrenzerdrehzahl fuer Md-Eingrif" SWORD FORMULA_0006 0 0 0.0 10000.0000 ECU_ADDRESS 0x3F94B6 /end MEASUREMENT
/begin MEASUREMENT n_max_ff_nbegr_ti "Begrenzerdrehzahl fuer Ti-Eingrif" SWORD FORMULA_0006 0 0 0.0 10000.0000 ECU_ADDRESS 0x3F94B8 /end MEASUREMENT
/begin MEASUREMENT n_max_ff_tsum_egas "Summenzeit oberhalb nbegr_egas" UWORD FORMULA_0021 0 0 0.0 655.0000 ECU_ADDRESS 0x3F94BA /end MEASUREMENT
/begin MEASUREMENT n_max_ff_tsum_ti "Summenzeit oberhalb nbegr_ti" UWORD FORMULA_0021 0 0 0.0 655.0000 ECU_ADDRESS 0x3F94BC /end MEASUREMENT
/begin MEASUREMENT n_max_ff_t_nbegr_egas "Einzelzeit oberhalb nbegr_egas" UWORD FORMULA_0021 0 0 0.0 655.0000 ECU_ADDRESS 0x3F94BE /end MEASUREMENT
/begin MEASUREMENT n_max_ff_v_hinten "mittlere Geschwindigkeit hinten" SWORD FORMULA_0078 0 0 -80.0000 360.0000 ECU_ADDRESS 0x3F94C0 /end MEASUREMENT
/begin MEASUREMENT n_max_ff_pwg "Fahrpedalstellung" SWORD FORMULA_0001 0 0 -10.0000 120.0000 ECU_ADDRESS 0x3F94C2 /end MEASUREMENT
/begin MEASUREMENT n_max_ff_km_stand "Kilometerstand" ULONG FORMULA_0027 0 0 0.0 16777214.0000 ECU_ADDRESS 0x3F94C4 /end MEASUREMENT
/begin MEASUREMENT n_max_ff_ml "Luftmasse" SWORD FORMULA_0112 0 0 -100.0000 1400.0000 ECU_ADDRESS 0x3F94C8 /end MEASUREMENT
/begin MEASUREMENT n_max_ff_md_fahrer "Fahrerwunschmoment" SWORD FORMULA_0009 0 0 -100.0000 1000.0000 ECU_ADDRESS 0x3F94CA /end MEASUREMENT
/begin MEASUREMENT n_max_ff_md_wunsch "resultierendes Kupplungs-Wunschmoment" SWORD FORMULA_0009 0 0 -100.0000 1000.0000 ECU_ADDRESS 0x3F94CC /end MEASUREMENT
/begin MEASUREMENT n_max_ff_md_ist "Kupplungs-Istmoment" SWORD FORMULA_0009 0 0 -100.0000 1000.0000 ECU_ADDRESS 0x3F94CE /end MEASUREMENT
/begin MEASUREMENT n_max_ff_tmot "Kuehlwassertemperatur" SWORD FORMULA_0023 0 0 -50.0000 170.0000 ECU_ADDRESS 0x3F94D0 /end MEASUREMENT
/begin MEASUREMENT n_max_ff_toel "Oeltemperatur" SWORD FORMULA_0023 0 0 -50.0000 170.0000 ECU_ADDRESS 0x3F94D2 /end MEASUREMENT
/begin MEASUREMENT n_max_ff_schalter_inj "Schalterstatus Inj" UWORD FORMULA_0010 0 0 0.0 65535.0000 ECU_ADDRESS 0x3F94D4 /end MEASUREMENT
/begin MEASUREMENT n_max_ff_zustand_motor "Betriebszustand" UWORD FORMULA_0019 0 0 0.0 65535.0 ECU_ADDRESS 0x3F94D6 /end MEASUREMENT
/begin MEASUREMENT n_max_ff_gang "Gang" SBYTE FORMULA_0318 0 0 -1.0000 10.0000 ECU_ADDRESS 0x3F94D8 /end MEASUREMENT
/begin MEASUREMENT n_max_ff_smg_st "DME-Status" UBYTE FORMULA_0309 0 0 0.0 255.0 ECU_ADDRESS 0x3F94D9 /end MEASUREMENT
/begin MEASUREMENT can_st_empf_nv "Empfangsstatus NV" UBYTE FORMULA_0003 0 0 0.0 255.0000 ECU_ADDRESS 0x3F94DA /end MEASUREMENT
/begin MEASUREMENT stat_data_tdme_nv_1of8_ "tdme-Statistik ueber ECU-life-time" ULONG FORMULA_0540 0 0 0.0 4294967295.0000 ECU_ADDRESS 0x3F94DC /end MEASUREMENT
/begin MEASUREMENT stat_data_tdme_nv_2of8_ "tdme-Statistik ueber ECU-life-time" ULONG FORMULA_0540 0 0 0.0 4294967295.0000 ECU_ADDRESS 0x3F94E0 /end MEASUREMENT
/begin MEASUREMENT stat_data_tdme_nv_3of8_ "tdme-Statistik ueber ECU-life-time" ULONG FORMULA_0540 0 0 0.0 4294967295.0000 ECU_ADDRESS 0x3F94E4 /end MEASUREMENT
/begin MEASUREMENT stat_data_tdme_nv_4of8_ "tdme-Statistik ueber ECU-life-time" ULONG FORMULA_0540 0 0 0.0 4294967295.0000 ECU_ADDRESS 0x3F94E8 /end MEASUREMENT
/begin MEASUREMENT stat_data_tdme_nv_5of8_ "tdme-Statistik ueber ECU-life-time" ULONG FORMULA_0540 0 0 0.0 4294967295.0000 ECU_ADDRESS 0x3F94EC /end MEASUREMENT
/begin MEASUREMENT stat_data_tdme_nv_6of8_ "tdme-Statistik ueber ECU-life-time" ULONG FORMULA_0540 0 0 0.0 4294967295.0000 ECU_ADDRESS 0x3F94F0 /end MEASUREMENT
/begin MEASUREMENT stat_data_tdme_nv_7of8_ "tdme-Statistik ueber ECU-life-time" ULONG FORMULA_0540 0 0 0.0 4294967295.0000 ECU_ADDRESS 0x3F94F4 /end MEASUREMENT
/begin MEASUREMENT stat_data_tdme_nv_8of8_ "tdme-Statistik ueber ECU-life-time" ULONG FORMULA_0540 0 0 0.0 4294967295.0000 ECU_ADDRESS 0x3F94F8 /end MEASUREMENT
/begin MEASUREMENT stat_data_tmot_nv_1of8_ "tmot-Statistik ueber Motorlaufzeit" ULONG FORMULA_0540 0 0 0.0 4294967295.0000 ECU_ADDRESS 0x3F94FC /end MEASUREMENT
/begin MEASUREMENT stat_data_tmot_nv_2of8_ "tmot-Statistik ueber Motorlaufzeit" ULONG FORMULA_0540 0 0 0.0 4294967295.0000 ECU_ADDRESS 0x3F9500 /end MEASUREMENT
/begin MEASUREMENT stat_data_tmot_nv_3of8_ "tmot-Statistik ueber Motorlaufzeit" ULONG FORMULA_0540 0 0 0.0 4294967295.0000 ECU_ADDRESS 0x3F9504 /end MEASUREMENT
/begin MEASUREMENT stat_data_tmot_nv_4of8_ "tmot-Statistik ueber Motorlaufzeit" ULONG FORMULA_0540 0 0 0.0 4294967295.0000 ECU_ADDRESS 0x3F9508 /end MEASUREMENT
/begin MEASUREMENT stat_data_tmot_nv_5of8_ "tmot-Statistik ueber Motorlaufzeit" ULONG FORMULA_0540 0 0 0.0 4294967295.0000 ECU_ADDRESS 0x3F950C /end MEASUREMENT
/begin MEASUREMENT stat_data_tmot_nv_6of8_ "tmot-Statistik ueber Motorlaufzeit" ULONG FORMULA_0540 0 0 0.0 4294967295.0000 ECU_ADDRESS 0x3F9510 /end MEASUREMENT
/begin MEASUREMENT stat_data_tmot_nv_7of8_ "tmot-Statistik ueber Motorlaufzeit" ULONG FORMULA_0540 0 0 0.0 4294967295.0000 ECU_ADDRESS 0x3F9514 /end MEASUREMENT
/begin MEASUREMENT stat_data_tmot_nv_8of8_ "tmot-Statistik ueber Motorlaufzeit" ULONG FORMULA_0540 0 0 0.0 4294967295.0000 ECU_ADDRESS 0x3F9518 /end MEASUREMENT
/begin MEASUREMENT stat_data_toel_nv_1of8_ "toel-Statistik ueber Motorlaufzeit" ULONG FORMULA_0540 0 0 0.0 4294967295.0000 ECU_ADDRESS 0x3F951C /end MEASUREMENT
/begin MEASUREMENT stat_data_toel_nv_2of8_ "toel-Statistik ueber Motorlaufzeit" ULONG FORMULA_0540 0 0 0.0 4294967295.0000 ECU_ADDRESS 0x3F9520 /end MEASUREMENT
/begin MEASUREMENT stat_data_toel_nv_3of8_ "toel-Statistik ueber Motorlaufzeit" ULONG FORMULA_0540 0 0 0.0 4294967295.0000 ECU_ADDRESS 0x3F9524 /end MEASUREMENT
/begin MEASUREMENT stat_data_toel_nv_4of8_ "toel-Statistik ueber Motorlaufzeit" ULONG FORMULA_0540 0 0 0.0 4294967295.0000 ECU_ADDRESS 0x3F9528 /end MEASUREMENT
/begin MEASUREMENT stat_data_toel_nv_5of8_ "toel-Statistik ueber Motorlaufzeit" ULONG FORMULA_0540 0 0 0.0 4294967295.0000 ECU_ADDRESS 0x3F952C /end MEASUREMENT
/begin MEASUREMENT stat_data_toel_nv_6of8_ "toel-Statistik ueber Motorlaufzeit" ULONG FORMULA_0540 0 0 0.0 4294967295.0000 ECU_ADDRESS 0x3F9530 /end MEASUREMENT
/begin MEASUREMENT stat_data_toel_nv_7of8_ "toel-Statistik ueber Motorlaufzeit" ULONG FORMULA_0540 0 0 0.0 4294967295.0000 ECU_ADDRESS 0x3F9534 /end MEASUREMENT
/begin MEASUREMENT stat_data_toel_nv_8of8_ "toel-Statistik ueber Motorlaufzeit" ULONG FORMULA_0540 0 0 0.0 4294967295.0000 ECU_ADDRESS 0x3F9538 /end MEASUREMENT
/begin MEASUREMENT mdrv_st_dsc_key0 "MDRV-Status DSC (CAN)" UBYTE FORMULA_0233 0 0 0.0 255.0 ECU_ADDRESS 0x3F953C /end MEASUREMENT
/begin MEASUREMENT mdrv_st_dsc_key1 "MDRV-Status DSC (CAN)" UBYTE FORMULA_0233 0 0 0.0 255.0 ECU_ADDRESS 0x3F953D /end MEASUREMENT
/begin MEASUREMENT mdrv_st_dsc_key2 "MDRV-Status DSC (CAN)" UBYTE FORMULA_0233 0 0 0.0 255.0 ECU_ADDRESS 0x3F953E /end MEASUREMENT
/begin MEASUREMENT mdrv_st_dsc_key3 "MDRV-Status DSC (CAN)" UBYTE FORMULA_0233 0 0 0.0 255.0 ECU_ADDRESS 0x3F953F /end MEASUREMENT
/begin MEASUREMENT mdrv_st_dsc_key4 "MDRV-Status DSC (CAN)" UBYTE FORMULA_0233 0 0 0.0 255.0 ECU_ADDRESS 0x3F9540 /end MEASUREMENT
/begin MEASUREMENT mdrv_st_dsc_key5 "MDRV-Status DSC (CAN)" UBYTE FORMULA_0233 0 0 0.0 255.0 ECU_ADDRESS 0x3F9541 /end MEASUREMENT
/begin MEASUREMENT mdrv_st_dsc_key6 "MDRV-Status DSC (CAN)" UBYTE FORMULA_0233 0 0 0.0 255.0 ECU_ADDRESS 0x3F9542 /end MEASUREMENT
/begin MEASUREMENT mdrv_st_dsc_key7 "MDRV-Status DSC (CAN)" UBYTE FORMULA_0233 0 0 0.0 255.0 ECU_ADDRESS 0x3F9543 /end MEASUREMENT
/begin MEASUREMENT mdrv_st_dsc_key8 "MDRV-Status DSC (CAN)" UBYTE FORMULA_0233 0 0 0.0 255.0 ECU_ADDRESS 0x3F9544 /end MEASUREMENT
/begin MEASUREMENT mdrv_st_dsc_key9 "MDRV-Status DSC (CAN)" UBYTE FORMULA_0233 0 0 0.0 255.0 ECU_ADDRESS 0x3F9545 /end MEASUREMENT
/begin MEASUREMENT mdrv_st_mod_smg_key0 "MDRV-Status SMG (CAN)" UBYTE FORMULA_0234 0 0 0.0 255.0 ECU_ADDRESS 0x3F9546 /end MEASUREMENT
/begin MEASUREMENT mdrv_st_mod_smg_key1 "MDRV-Status SMG (CAN)" UBYTE FORMULA_0234 0 0 0.0 255.0 ECU_ADDRESS 0x3F9547 /end MEASUREMENT
/begin MEASUREMENT mdrv_st_mod_smg_key2 "MDRV-Status SMG (CAN)" UBYTE FORMULA_0234 0 0 0.0 255.0 ECU_ADDRESS 0x3F9548 /end MEASUREMENT
/begin MEASUREMENT mdrv_st_mod_smg_key3 "MDRV-Status SMG (CAN)" UBYTE FORMULA_0234 0 0 0.0 255.0 ECU_ADDRESS 0x3F9549 /end MEASUREMENT
/begin MEASUREMENT mdrv_st_mod_smg_key4 "MDRV-Status SMG (CAN)" UBYTE FORMULA_0234 0 0 0.0 255.0 ECU_ADDRESS 0x3F954A /end MEASUREMENT
/begin MEASUREMENT mdrv_st_mod_smg_key5 "MDRV-Status SMG (CAN)" UBYTE FORMULA_0234 0 0 0.0 255.0 ECU_ADDRESS 0x3F954B /end MEASUREMENT
/begin MEASUREMENT mdrv_st_mod_smg_key6 "MDRV-Status SMG (CAN)" UBYTE FORMULA_0234 0 0 0.0 255.0 ECU_ADDRESS 0x3F954C /end MEASUREMENT
/begin MEASUREMENT mdrv_st_mod_smg_key7 "MDRV-Status SMG (CAN)" UBYTE FORMULA_0234 0 0 0.0 255.0 ECU_ADDRESS 0x3F954D /end MEASUREMENT
/begin MEASUREMENT mdrv_st_mod_smg_key8 "MDRV-Status SMG (CAN)" UBYTE FORMULA_0234 0 0 0.0 255.0 ECU_ADDRESS 0x3F954E /end MEASUREMENT
/begin MEASUREMENT mdrv_st_mod_smg_key9 "MDRV-Status SMG (CAN)" UBYTE FORMULA_0234 0 0 0.0 255.0 ECU_ADDRESS 0x3F954F /end MEASUREMENT
/begin MEASUREMENT mdrv_st_stg_smg_key0 "MDRV-Status Drivelogic (CAN)" UBYTE FORMULA_0235 0 0 0.0 255.0 ECU_ADDRESS 0x3F9550 /end MEASUREMENT
/begin MEASUREMENT mdrv_st_stg_smg_key1 "MDRV-Status Drivelogic (CAN)" UBYTE FORMULA_0235 0 0 0.0 255.0 ECU_ADDRESS 0x3F9551 /end MEASUREMENT
/begin MEASUREMENT mdrv_st_stg_smg_key2 "MDRV-Status Drivelogic (CAN)" UBYTE FORMULA_0235 0 0 0.0 255.0 ECU_ADDRESS 0x3F9552 /end MEASUREMENT
/begin MEASUREMENT mdrv_st_stg_smg_key3 "MDRV-Status Drivelogic (CAN)" UBYTE FORMULA_0235 0 0 0.0 255.0 ECU_ADDRESS 0x3F9553 /end MEASUREMENT
/begin MEASUREMENT mdrv_st_stg_smg_key4 "MDRV-Status Drivelogic (CAN)" UBYTE FORMULA_0235 0 0 0.0 255.0 ECU_ADDRESS 0x3F9554 /end MEASUREMENT
/begin MEASUREMENT mdrv_st_stg_smg_key5 "MDRV-Status Drivelogic (CAN)" UBYTE FORMULA_0235 0 0 0.0 255.0 ECU_ADDRESS 0x3F9555 /end MEASUREMENT
/begin MEASUREMENT mdrv_st_stg_smg_key6 "MDRV-Status Drivelogic (CAN)" UBYTE FORMULA_0235 0 0 0.0 255.0 ECU_ADDRESS 0x3F9556 /end MEASUREMENT
/begin MEASUREMENT mdrv_st_stg_smg_key7 "MDRV-Status Drivelogic (CAN)" UBYTE FORMULA_0235 0 0 0.0 255.0 ECU_ADDRESS 0x3F9557 /end MEASUREMENT
/begin MEASUREMENT mdrv_st_stg_smg_key8 "MDRV-Status Drivelogic (CAN)" UBYTE FORMULA_0235 0 0 0.0 255.0 ECU_ADDRESS 0x3F9558 /end MEASUREMENT
/begin MEASUREMENT mdrv_st_stg_smg_key9 "MDRV-Status Drivelogic (CAN)" UBYTE FORMULA_0235 0 0 0.0 255.0 ECU_ADDRESS 0x3F9559 /end MEASUREMENT
/begin MEASUREMENT mdrv_st_mod_eng_key0 "MDRV-Status Motor (CAN)" UBYTE FORMULA_0236 0 0 0.0 255.0 ECU_ADDRESS 0x3F955A /end MEASUREMENT
/begin MEASUREMENT mdrv_st_mod_eng_key1 "MDRV-Status Motor (CAN)" UBYTE FORMULA_0236 0 0 0.0 255.0 ECU_ADDRESS 0x3F955B /end MEASUREMENT
/begin MEASUREMENT mdrv_st_mod_eng_key2 "MDRV-Status Motor (CAN)" UBYTE FORMULA_0236 0 0 0.0 255.0 ECU_ADDRESS 0x3F955C /end MEASUREMENT
/begin MEASUREMENT mdrv_st_mod_eng_key3 "MDRV-Status Motor (CAN)" UBYTE FORMULA_0236 0 0 0.0 255.0 ECU_ADDRESS 0x3F955D /end MEASUREMENT
/begin MEASUREMENT mdrv_st_mod_eng_key4 "MDRV-Status Motor (CAN)" UBYTE FORMULA_0236 0 0 0.0 255.0 ECU_ADDRESS 0x3F955E /end MEASUREMENT
/begin MEASUREMENT mdrv_st_mod_eng_key5 "MDRV-Status Motor (CAN)" UBYTE FORMULA_0236 0 0 0.0 255.0 ECU_ADDRESS 0x3F955F /end MEASUREMENT
/begin MEASUREMENT mdrv_st_mod_eng_key6 "MDRV-Status Motor (CAN)" UBYTE FORMULA_0236 0 0 0.0 255.0 ECU_ADDRESS 0x3F9560 /end MEASUREMENT
/begin MEASUREMENT mdrv_st_mod_eng_key7 "MDRV-Status Motor (CAN)" UBYTE FORMULA_0236 0 0 0.0 255.0 ECU_ADDRESS 0x3F9561 /end MEASUREMENT
/begin MEASUREMENT mdrv_st_mod_eng_key8 "MDRV-Status Motor (CAN)" UBYTE FORMULA_0236 0 0 0.0 255.0 ECU_ADDRESS 0x3F9562 /end MEASUREMENT
/begin MEASUREMENT mdrv_st_mod_eng_key9 "MDRV-Status Motor (CAN)" UBYTE FORMULA_0236 0 0 0.0 255.0 ECU_ADDRESS 0x3F9563 /end MEASUREMENT
/begin MEASUREMENT mdrv_st_mod_edck_key0 "MDRV-Status EDCK (CAN)" UBYTE FORMULA_0237 0 0 0.0 255.0 ECU_ADDRESS 0x3F9564 /end MEASUREMENT
/begin MEASUREMENT mdrv_st_mod_edck_key1 "MDRV-Status EDCK (CAN)" UBYTE FORMULA_0237 0 0 0.0 255.0 ECU_ADDRESS 0x3F9565 /end MEASUREMENT
/begin MEASUREMENT mdrv_st_mod_edck_key2 "MDRV-Status EDCK (CAN)" UBYTE FORMULA_0237 0 0 0.0 255.0 ECU_ADDRESS 0x3F9566 /end MEASUREMENT
/begin MEASUREMENT mdrv_st_mod_edck_key3 "MDRV-Status EDCK (CAN)" UBYTE FORMULA_0237 0 0 0.0 255.0 ECU_ADDRESS 0x3F9567 /end MEASUREMENT
/begin MEASUREMENT mdrv_st_mod_edck_key4 "MDRV-Status EDCK (CAN)" UBYTE FORMULA_0237 0 0 0.0 255.0 ECU_ADDRESS 0x3F9568 /end MEASUREMENT
/begin MEASUREMENT mdrv_st_mod_edck_key5 "MDRV-Status EDCK (CAN)" UBYTE FORMULA_0237 0 0 0.0 255.0 ECU_ADDRESS 0x3F9569 /end MEASUREMENT
/begin MEASUREMENT mdrv_st_mod_edck_key6 "MDRV-Status EDCK (CAN)" UBYTE FORMULA_0237 0 0 0.0 255.0 ECU_ADDRESS 0x3F956A /end MEASUREMENT
/begin MEASUREMENT mdrv_st_mod_edck_key7 "MDRV-Status EDCK (CAN)" UBYTE FORMULA_0237 0 0 0.0 255.0 ECU_ADDRESS 0x3F956B /end MEASUREMENT
/begin MEASUREMENT mdrv_st_mod_edck_key8 "MDRV-Status EDCK (CAN)" UBYTE FORMULA_0237 0 0 0.0 255.0 ECU_ADDRESS 0x3F956C /end MEASUREMENT
/begin MEASUREMENT mdrv_st_mod_edck_key9 "MDRV-Status EDCK (CAN)" UBYTE FORMULA_0237 0 0 0.0 255.0 ECU_ADDRESS 0x3F956D /end MEASUREMENT
/begin MEASUREMENT mdrv_st_mod_albv_key0 "MDRV-Status aLBV (CAN)" UBYTE FORMULA_0237 0 0 0.0 255.0 ECU_ADDRESS 0x3F956E /end MEASUREMENT
/begin MEASUREMENT mdrv_st_mod_albv_key1 "MDRV-Status aLBV (CAN)" UBYTE FORMULA_0237 0 0 0.0 255.0 ECU_ADDRESS 0x3F956F /end MEASUREMENT
/begin MEASUREMENT mdrv_st_mod_albv_key2 "MDRV-Status aLBV (CAN)" UBYTE FORMULA_0237 0 0 0.0 255.0 ECU_ADDRESS 0x3F9570 /end MEASUREMENT
/begin MEASUREMENT mdrv_st_mod_albv_key3 "MDRV-Status aLBV (CAN)" UBYTE FORMULA_0237 0 0 0.0 255.0 ECU_ADDRESS 0x3F9571 /end MEASUREMENT
/begin MEASUREMENT mdrv_st_mod_albv_key4 "MDRV-Status aLBV (CAN)" UBYTE FORMULA_0237 0 0 0.0 255.0 ECU_ADDRESS 0x3F9572 /end MEASUREMENT
/begin MEASUREMENT mdrv_st_mod_albv_key5 "MDRV-Status aLBV (CAN)" UBYTE FORMULA_0237 0 0 0.0 255.0 ECU_ADDRESS 0x3F9573 /end MEASUREMENT
/begin MEASUREMENT mdrv_st_mod_albv_key6 "MDRV-Status aLBV (CAN)" UBYTE FORMULA_0237 0 0 0.0 255.0 ECU_ADDRESS 0x3F9574 /end MEASUREMENT
/begin MEASUREMENT mdrv_st_mod_albv_key7 "MDRV-Status aLBV (CAN)" UBYTE FORMULA_0237 0 0 0.0 255.0 ECU_ADDRESS 0x3F9575 /end MEASUREMENT
/begin MEASUREMENT mdrv_st_mod_albv_key8 "MDRV-Status aLBV (CAN)" UBYTE FORMULA_0237 0 0 0.0 255.0 ECU_ADDRESS 0x3F9576 /end MEASUREMENT
/begin MEASUREMENT mdrv_st_mod_albv_key9 "MDRV-Status aLBV (CAN)" UBYTE FORMULA_0237 0 0 0.0 255.0 ECU_ADDRESS 0x3F9577 /end MEASUREMENT
/begin MEASUREMENT mdrv_st_mod_hud_key0 "MDRV-Status HUD (CAN)" UBYTE FORMULA_0238 0 0 0.0 255.0 ECU_ADDRESS 0x3F9578 /end MEASUREMENT
/begin MEASUREMENT mdrv_st_mod_hud_key1 "MDRV-Status HUD (CAN)" UBYTE FORMULA_0238 0 0 0.0 255.0 ECU_ADDRESS 0x3F9579 /end MEASUREMENT
/begin MEASUREMENT mdrv_st_mod_hud_key2 "MDRV-Status HUD (CAN)" UBYTE FORMULA_0238 0 0 0.0 255.0 ECU_ADDRESS 0x3F957A /end MEASUREMENT
/begin MEASUREMENT mdrv_st_mod_hud_key3 "MDRV-Status HUD (CAN)" UBYTE FORMULA_0238 0 0 0.0 255.0 ECU_ADDRESS 0x3F957B /end MEASUREMENT
/begin MEASUREMENT mdrv_st_mod_hud_key4 "MDRV-Status HUD (CAN)" UBYTE FORMULA_0238 0 0 0.0 255.0 ECU_ADDRESS 0x3F957C /end MEASUREMENT
/begin MEASUREMENT mdrv_st_mod_hud_key5 "MDRV-Status HUD (CAN)" UBYTE FORMULA_0238 0 0 0.0 255.0 ECU_ADDRESS 0x3F957D /end MEASUREMENT
/begin MEASUREMENT mdrv_st_mod_hud_key6 "MDRV-Status HUD (CAN)" UBYTE FORMULA_0238 0 0 0.0 255.0 ECU_ADDRESS 0x3F957E /end MEASUREMENT
/begin MEASUREMENT mdrv_st_mod_hud_key7 "MDRV-Status HUD (CAN)" UBYTE FORMULA_0238 0 0 0.0 255.0 ECU_ADDRESS 0x3F957F /end MEASUREMENT
/begin MEASUREMENT mdrv_st_mod_hud_key8 "MDRV-Status HUD (CAN)" UBYTE FORMULA_0238 0 0 0.0 255.0 ECU_ADDRESS 0x3F9580 /end MEASUREMENT
/begin MEASUREMENT mdrv_st_mod_hud_key9 "MDRV-Status HUD (CAN)" UBYTE FORMULA_0238 0 0 0.0 255.0 ECU_ADDRESS 0x3F9581 /end MEASUREMENT
/begin MEASUREMENT stat_data_nrf_nv_1of7_1of8_ "Statistik n/rf-Array" ULONG FORMULA_0540 0 0 0.0 4294967295.0000 ECU_ADDRESS 0x3F9584 /end MEASUREMENT
/begin MEASUREMENT stat_data_nrf_nv_1of7_2of8_ "Statistik n/rf-Array" ULONG FORMULA_0540 0 0 0.0 4294967295.0000 ECU_ADDRESS 0x3F9588 /end MEASUREMENT
/begin MEASUREMENT stat_data_nrf_nv_1of7_3of8_ "Statistik n/rf-Array" ULONG FORMULA_0540 0 0 0.0 4294967295.0000 ECU_ADDRESS 0x3F958C /end MEASUREMENT
/begin MEASUREMENT stat_data_nrf_nv_1of7_4of8_ "Statistik n/rf-Array" ULONG FORMULA_0540 0 0 0.0 4294967295.0000 ECU_ADDRESS 0x3F9590 /end MEASUREMENT
/begin MEASUREMENT stat_data_nrf_nv_1of7_5of8_ "Statistik n/rf-Array" ULONG FORMULA_0540 0 0 0.0 4294967295.0000 ECU_ADDRESS 0x3F9594 /end MEASUREMENT
/begin MEASUREMENT stat_data_nrf_nv_1of7_6of8_ "Statistik n/rf-Array" ULONG FORMULA_0540 0 0 0.0 4294967295.0000 ECU_ADDRESS 0x3F9598 /end MEASUREMENT
/begin MEASUREMENT stat_data_nrf_nv_1of7_7of8_ "Statistik n/rf-Array" ULONG FORMULA_0540 0 0 0.0 4294967295.0000 ECU_ADDRESS 0x3F959C /end MEASUREMENT
/begin MEASUREMENT stat_data_nrf_nv_1of7_8of8_ "Statistik n/rf-Array" ULONG FORMULA_0540 0 0 0.0 4294967295.0000 ECU_ADDRESS 0x3F95A0 /end MEASUREMENT
/begin MEASUREMENT stat_data_nrf_nv_2of7_1of8_ "Statistik n/rf-Array" ULONG FORMULA_0540 0 0 0.0 4294967295.0000 ECU_ADDRESS 0x3F95A4 /end MEASUREMENT
/begin MEASUREMENT stat_data_nrf_nv_2of7_2of8_ "Statistik n/rf-Array" ULONG FORMULA_0540 0 0 0.0 4294967295.0000 ECU_ADDRESS 0x3F95A8 /end MEASUREMENT
/begin MEASUREMENT stat_data_nrf_nv_2of7_3of8_ "Statistik n/rf-Array" ULONG FORMULA_0540 0 0 0.0 4294967295.0000 ECU_ADDRESS 0x3F95AC /end MEASUREMENT
/begin MEASUREMENT stat_data_nrf_nv_2of7_4of8_ "Statistik n/rf-Array" ULONG FORMULA_0540 0 0 0.0 4294967295.0000 ECU_ADDRESS 0x3F95B0 /end MEASUREMENT
/begin MEASUREMENT stat_data_nrf_nv_2of7_5of8_ "Statistik n/rf-Array" ULONG FORMULA_0540 0 0 0.0 4294967295.0000 ECU_ADDRESS 0x3F95B4 /end MEASUREMENT
/begin MEASUREMENT stat_data_nrf_nv_2of7_6of8_ "Statistik n/rf-Array" ULONG FORMULA_0540 0 0 0.0 4294967295.0000 ECU_ADDRESS 0x3F95B8 /end MEASUREMENT
/begin MEASUREMENT stat_data_nrf_nv_2of7_7of8_ "Statistik n/rf-Array" ULONG FORMULA_0540 0 0 0.0 4294967295.0000 ECU_ADDRESS 0x3F95BC /end MEASUREMENT
/begin MEASUREMENT stat_data_nrf_nv_2of7_8of8_ "Statistik n/rf-Array" ULONG FORMULA_0540 0 0 0.0 4294967295.0000 ECU_ADDRESS 0x3F95C0 /end MEASUREMENT
/begin MEASUREMENT stat_data_nrf_nv_3of7_1of8_ "Statistik n/rf-Array" ULONG FORMULA_0540 0 0 0.0 4294967295.0000 ECU_ADDRESS 0x3F95C4 /end MEASUREMENT
/begin MEASUREMENT stat_data_nrf_nv_3of7_2of8_ "Statistik n/rf-Array" ULONG FORMULA_0540 0 0 0.0 4294967295.0000 ECU_ADDRESS 0x3F95C8 /end MEASUREMENT
/begin MEASUREMENT stat_data_nrf_nv_3of7_3of8_ "Statistik n/rf-Array" ULONG FORMULA_0540 0 0 0.0 4294967295.0000 ECU_ADDRESS 0x3F95CC /end MEASUREMENT
/begin MEASUREMENT stat_data_nrf_nv_3of7_4of8_ "Statistik n/rf-Array" ULONG FORMULA_0540 0 0 0.0 4294967295.0000 ECU_ADDRESS 0x3F95D0 /end MEASUREMENT
/begin MEASUREMENT stat_data_nrf_nv_3of7_5of8_ "Statistik n/rf-Array" ULONG FORMULA_0540 0 0 0.0 4294967295.0000 ECU_ADDRESS 0x3F95D4 /end MEASUREMENT
/begin MEASUREMENT stat_data_nrf_nv_3of7_6of8_ "Statistik n/rf-Array" ULONG FORMULA_0540 0 0 0.0 4294967295.0000 ECU_ADDRESS 0x3F95D8 /end MEASUREMENT
/begin MEASUREMENT stat_data_nrf_nv_3of7_7of8_ "Statistik n/rf-Array" ULONG FORMULA_0540 0 0 0.0 4294967295.0000 ECU_ADDRESS 0x3F95DC /end MEASUREMENT
/begin MEASUREMENT stat_data_nrf_nv_3of7_8of8_ "Statistik n/rf-Array" ULONG FORMULA_0540 0 0 0.0 4294967295.0000 ECU_ADDRESS 0x3F95E0 /end MEASUREMENT
/begin MEASUREMENT stat_data_nrf_nv_4of7_1of8_ "Statistik n/rf-Array" ULONG FORMULA_0540 0 0 0.0 4294967295.0000 ECU_ADDRESS 0x3F95E4 /end MEASUREMENT
/begin MEASUREMENT stat_data_nrf_nv_4of7_2of8_ "Statistik n/rf-Array" ULONG FORMULA_0540 0 0 0.0 4294967295.0000 ECU_ADDRESS 0x3F95E8 /end MEASUREMENT
/begin MEASUREMENT stat_data_nrf_nv_4of7_3of8_ "Statistik n/rf-Array" ULONG FORMULA_0540 0 0 0.0 4294967295.0000 ECU_ADDRESS 0x3F95EC /end MEASUREMENT
/begin MEASUREMENT stat_data_nrf_nv_4of7_4of8_ "Statistik n/rf-Array" ULONG FORMULA_0540 0 0 0.0 4294967295.0000 ECU_ADDRESS 0x3F95F0 /end MEASUREMENT
/begin MEASUREMENT stat_data_nrf_nv_4of7_5of8_ "Statistik n/rf-Array" ULONG FORMULA_0540 0 0 0.0 4294967295.0000 ECU_ADDRESS 0x3F95F4 /end MEASUREMENT
/begin MEASUREMENT stat_data_nrf_nv_4of7_6of8_ "Statistik n/rf-Array" ULONG FORMULA_0540 0 0 0.0 4294967295.0000 ECU_ADDRESS 0x3F95F8 /end MEASUREMENT
/begin MEASUREMENT stat_data_nrf_nv_4of7_7of8_ "Statistik n/rf-Array" ULONG FORMULA_0540 0 0 0.0 4294967295.0000 ECU_ADDRESS 0x3F95FC /end MEASUREMENT
/begin MEASUREMENT stat_data_nrf_nv_4of7_8of8_ "Statistik n/rf-Array" ULONG FORMULA_0540 0 0 0.0 4294967295.0000 ECU_ADDRESS 0x3F9600 /end MEASUREMENT
/begin MEASUREMENT stat_data_nrf_nv_5of7_1of8_ "Statistik n/rf-Array" ULONG FORMULA_0540 0 0 0.0 4294967295.0000 ECU_ADDRESS 0x3F9604 /end MEASUREMENT
/begin MEASUREMENT stat_data_nrf_nv_5of7_2of8_ "Statistik n/rf-Array" ULONG FORMULA_0540 0 0 0.0 4294967295.0000 ECU_ADDRESS 0x3F9608 /end MEASUREMENT
/begin MEASUREMENT stat_data_nrf_nv_5of7_3of8_ "Statistik n/rf-Array" ULONG FORMULA_0540 0 0 0.0 4294967295.0000 ECU_ADDRESS 0x3F960C /end MEASUREMENT
/begin MEASUREMENT stat_data_nrf_nv_5of7_4of8_ "Statistik n/rf-Array" ULONG FORMULA_0540 0 0 0.0 4294967295.0000 ECU_ADDRESS 0x3F9610 /end MEASUREMENT
/begin MEASUREMENT stat_data_nrf_nv_5of7_5of8_ "Statistik n/rf-Array" ULONG FORMULA_0540 0 0 0.0 4294967295.0000 ECU_ADDRESS 0x3F9614 /end MEASUREMENT
/begin MEASUREMENT stat_data_nrf_nv_5of7_6of8_ "Statistik n/rf-Array" ULONG FORMULA_0540 0 0 0.0 4294967295.0000 ECU_ADDRESS 0x3F9618 /end MEASUREMENT
/begin MEASUREMENT stat_data_nrf_nv_5of7_7of8_ "Statistik n/rf-Array" ULONG FORMULA_0540 0 0 0.0 4294967295.0000 ECU_ADDRESS 0x3F961C /end MEASUREMENT
/begin MEASUREMENT stat_data_nrf_nv_5of7_8of8_ "Statistik n/rf-Array" ULONG FORMULA_0540 0 0 0.0 4294967295.0000 ECU_ADDRESS 0x3F9620 /end MEASUREMENT
/begin MEASUREMENT stat_data_nrf_nv_6of7_1of8_ "Statistik n/rf-Array" ULONG FORMULA_0540 0 0 0.0 4294967295.0000 ECU_ADDRESS 0x3F9624 /end MEASUREMENT
/begin MEASUREMENT stat_data_nrf_nv_6of7_2of8_ "Statistik n/rf-Array" ULONG FORMULA_0540 0 0 0.0 4294967295.0000 ECU_ADDRESS 0x3F9628 /end MEASUREMENT
/begin MEASUREMENT stat_data_nrf_nv_6of7_3of8_ "Statistik n/rf-Array" ULONG FORMULA_0540 0 0 0.0 4294967295.0000 ECU_ADDRESS 0x3F962C /end MEASUREMENT
/begin MEASUREMENT stat_data_nrf_nv_6of7_4of8_ "Statistik n/rf-Array" ULONG FORMULA_0540 0 0 0.0 4294967295.0000 ECU_ADDRESS 0x3F9630 /end MEASUREMENT
/begin MEASUREMENT stat_data_nrf_nv_6of7_5of8_ "Statistik n/rf-Array" ULONG FORMULA_0540 0 0 0.0 4294967295.0000 ECU_ADDRESS 0x3F9634 /end MEASUREMENT
/begin MEASUREMENT stat_data_nrf_nv_6of7_6of8_ "Statistik n/rf-Array" ULONG FORMULA_0540 0 0 0.0 4294967295.0000 ECU_ADDRESS 0x3F9638 /end MEASUREMENT
/begin MEASUREMENT stat_data_nrf_nv_6of7_7of8_ "Statistik n/rf-Array" ULONG FORMULA_0540 0 0 0.0 4294967295.0000 ECU_ADDRESS 0x3F963C /end MEASUREMENT
/begin MEASUREMENT stat_data_nrf_nv_6of7_8of8_ "Statistik n/rf-Array" ULONG FORMULA_0540 0 0 0.0 4294967295.0000 ECU_ADDRESS 0x3F9640 /end MEASUREMENT
/begin MEASUREMENT stat_data_nrf_nv_7of7_1of8_ "Statistik n/rf-Array" ULONG FORMULA_0540 0 0 0.0 4294967295.0000 ECU_ADDRESS 0x3F9644 /end MEASUREMENT
/begin MEASUREMENT stat_data_nrf_nv_7of7_2of8_ "Statistik n/rf-Array" ULONG FORMULA_0540 0 0 0.0 4294967295.0000 ECU_ADDRESS 0x3F9648 /end MEASUREMENT
/begin MEASUREMENT stat_data_nrf_nv_7of7_3of8_ "Statistik n/rf-Array" ULONG FORMULA_0540 0 0 0.0 4294967295.0000 ECU_ADDRESS 0x3F964C /end MEASUREMENT
/begin MEASUREMENT stat_data_nrf_nv_7of7_4of8_ "Statistik n/rf-Array" ULONG FORMULA_0540 0 0 0.0 4294967295.0000 ECU_ADDRESS 0x3F9650 /end MEASUREMENT
/begin MEASUREMENT stat_data_nrf_nv_7of7_5of8_ "Statistik n/rf-Array" ULONG FORMULA_0540 0 0 0.0 4294967295.0000 ECU_ADDRESS 0x3F9654 /end MEASUREMENT
/begin MEASUREMENT stat_data_nrf_nv_7of7_6of8_ "Statistik n/rf-Array" ULONG FORMULA_0540 0 0 0.0 4294967295.0000 ECU_ADDRESS 0x3F9658 /end MEASUREMENT
/begin MEASUREMENT stat_data_nrf_nv_7of7_7of8_ "Statistik n/rf-Array" ULONG FORMULA_0540 0 0 0.0 4294967295.0000 ECU_ADDRESS 0x3F965C /end MEASUREMENT
/begin MEASUREMENT stat_data_nrf_nv_7of7_8of8_ "Statistik n/rf-Array" ULONG FORMULA_0540 0 0 0.0 4294967295.0000 ECU_ADDRESS 0x3F9660 /end MEASUREMENT
/begin MEASUREMENT mdrv_p400_only_nv "P400-Only" UWORD FORMULA_0010 0 0 0.0 65535.0000 ECU_ADDRESS 0x3F9664 /end MEASUREMENT
/begin MEASUREMENT mdrv_p500_start_nv "P500-Hochlauf" UWORD FORMULA_0010 0 0 0.0 65535.0000 ECU_ADDRESS 0x3F9666 /end MEASUREMENT
/begin MEASUREMENT time_abs_old "Absolutzeit seit 1.1.2000 letzter DME-Lauf" UWORD FORMULA_0207 0 0 0.0 65535.0000 ECU_ADDRESS 0x3F9668 /end MEASUREMENT
/begin MEASUREMENT Oz_einfahr_int_akt "Oel-Einfahrintervall aktiv (i.d.R. 2000 km)" UBYTE FORMULA_0579 0 0 0.0 255.0 ECU_ADDRESS 0x3F966A /end MEASUREMENT
/begin MEASUREMENT v_max_anh_cnt_nv "Zaehler v_max-Anhebeversuche durch Tester" UBYTE FORMULA_0003 0 0 0.0 255.0000 ECU_ADDRESS 0x3F966B /end MEASUREMENT
/begin MEASUREMENT v_max_ff_anh_st "Status v_max-Anhebung durch CAS bzw. Nachruestung" UBYTE FORMULA_0239 0 0 0.0 255.0 ECU_ADDRESS 0x3F966C /end MEASUREMENT
/* ------------------ Abschnitt erzeugt aus ag_ti.dat ------------------ */
/begin CHARACTERISTIC K_AG_TI_CFG "Welcher Aussetzergenerator" VALUE 0x70294 TKW_VV_VV_UB 100.0 FORMULA_0581 0.0 3.0 /end CHARACTERISTIC
/begin CHARACTERISTIC K_AG_TI_ZYL "Statisches Ausblendmuster. | EN: Static suppression pattern" VALUE 0x70296 TKW_VV_VV_UW 100.0 FORMULA_0010 0.0 65535.0000 /end CHARACTERISTIC
/begin CHARACTERISTIC K_AG_TI_ANZ "Anzahl der unmittelbar aufeinanderfolgenden Ausblendungen. | EN: Number of directly consecutive suppressions (injection cut-outs)" VALUE 0x70298 TKW_VV_VV_UW 100.0 FORMULA_0010 0.0 65535.0000 /end CHARACTERISTIC
/begin CHARACTERISTIC K_AG_TI_PAUSE "Anzahl der Arbeitsspiele zwischen Ausblendungen. | EN: Number of working cycles between suppressions" VALUE 0x7029A TKW_VV_VV_UW 100.0 FORMULA_0010 0.0 65535.0000 /end CHARACTERISTIC
/begin CHARACTERISTIC K_AG_TI_V_MIN "Minimale Geschwindigkeitsschwelle. | EN: Minimum vehicle speed threshold [km/h]" VALUE 0x7029C TKW_VV_VV_SW 100.0 FORMULA_0078 -80.0000 360.0000 FORMAT "%4.1" /end CHARACTERISTIC
/begin MEASUREMENT ag_ti_zyl "Naechster Zylinder der ausgeblendet wird. [V452 CHECK: injector cut-out (ag_ti) RAM block shifted in V452; address not valid]" UBYTE FORMULA_0403 0 0 1.0000 12.0000 ECU_ADDRESS 0x3FBCD8 /end MEASUREMENT
/begin MEASUREMENT ag_ti_exd_state "Exd-State. [V452 CHECK: injector cut-out (ag_ti) RAM block shifted in V452; address not valid]" UBYTE FORMULA_0580 0 0 0.0 255.0 ECU_ADDRESS 0x3FBCD9 /end MEASUREMENT
/begin MEASUREMENT ag_ti_cfg_ctrl "Welcher Aussetzergenerator [V452 CHECK: injector cut-out (ag_ti) RAM block shifted in V452; address not valid]" UBYTE FORMULA_0581 0 0 0.0 3.0 ECU_ADDRESS 0x3FBCDA /end MEASUREMENT
/begin MEASUREMENT ag_ti_zyl_ctrl "Statisches Ausblendmuster. [V452 CHECK: injector cut-out (ag_ti) RAM block shifted in V452; address not valid]" UWORD FORMULA_0010 0 0 0.0 65535.0000 ECU_ADDRESS 0x3FBCDC /end MEASUREMENT
/begin MEASUREMENT ag_ti_anz_ctrl "Anzahl der unmittelbar aufeinanderfolgenden Ausblendungen. [V452 CHECK: injector cut-out (ag_ti) RAM block shifted in V452; address not valid]" UWORD FORMULA_0010 0 0 0.0 65535.0000 ECU_ADDRESS 0x3FBCDE /end MEASUREMENT
/begin MEASUREMENT ag_ti_pause_ctrl "Anzahl der Arbeitsspiele zwischen Ausblendungen. [V452 CHECK: injector cut-out (ag_ti) RAM block shifted in V452; address not valid]" UWORD FORMULA_0010 0 0 0.0 65535.0000 ECU_ADDRESS 0x3FBCE0 /end MEASUREMENT
/begin MEASUREMENT ag_ti_anz "Zaehler der unmittelbar aufeinanderfolgenden Ausblendungen. [V452 CHECK: injector cut-out (ag_ti) RAM block shifted in V452; address not valid]" UWORD FORMULA_0010 0 0 0.0 65535.0000 ECU_ADDRESS 0x3FBCE2 /end MEASUREMENT
/begin MEASUREMENT ag_ti_pause "Zaehler der Arbeitsspiele zwischen Ausblendungen. [V452 CHECK: injector cut-out (ag_ti) RAM block shifted in V452; address not valid]" UWORD FORMULA_0010 0 0 0.0 65535.0000 ECU_ADDRESS 0x3FBCE4 /end MEASUREMENT
/begin MEASUREMENT ag_ti_mask "Status Aussetzergenerator. [V452 CHECK: injector cut-out (ag_ti) RAM block shifted in V452; address not valid]" UWORD FORMULA_0582 0 0 0.0 4095.0 ECU_ADDRESS 0x3FBCE6 /end MEASUREMENT
/begin MEASUREMENT ag_ti_mask_zyl1 "Ausblendung Zylinder 1. [V452 CHECK: injector cut-out (ag_ti) RAM block shifted in V452; address not valid]" UWORD FORMULA_0583 0 0 0.0 1.0 ECU_ADDRESS 0x3FBCE6 BIT_MASK 0x1 /end MEASUREMENT
/begin MEASUREMENT ag_ti_mask_zyl2 "Ausblendung Zylinder 2. [V452 CHECK: injector cut-out (ag_ti) RAM block shifted in V452; address not valid]" UWORD FORMULA_0584 0 0 0.0 1.0 ECU_ADDRESS 0x3FBCE6 BIT_MASK 0x2 /end MEASUREMENT
/begin MEASUREMENT ag_ti_mask_zyl3 "Ausblendung Zylinder 3. [V452 CHECK: injector cut-out (ag_ti) RAM block shifted in V452; address not valid]" UWORD FORMULA_0585 0 0 0.0 1.0 ECU_ADDRESS 0x3FBCE6 BIT_MASK 0x4 /end MEASUREMENT
/begin MEASUREMENT ag_ti_mask_zyl4 "Ausblendung Zylinder 4. [V452 CHECK: injector cut-out (ag_ti) RAM block shifted in V452; address not valid]" UWORD FORMULA_0586 0 0 0.0 1.0 ECU_ADDRESS 0x3FBCE6 BIT_MASK 0x8 /end MEASUREMENT
/begin MEASUREMENT ag_ti_mask_zyl5 "Ausblendung Zylinder 5. [V452 CHECK: injector cut-out (ag_ti) RAM block shifted in V452; address not valid]" UWORD FORMULA_0587 0 0 0.0 1.0 ECU_ADDRESS 0x3FBCE6 BIT_MASK 0x10 /end MEASUREMENT
/begin MEASUREMENT ag_ti_mask_zyl6 "Ausblendung Zylinder 6. [V452 CHECK: injector cut-out (ag_ti) RAM block shifted in V452; address not valid]" UWORD FORMULA_0588 0 0 0.0 1.0 ECU_ADDRESS 0x3FBCE6 BIT_MASK 0x20 /end MEASUREMENT
/begin MEASUREMENT ag_ti_mask_zyl7 "Ausblendung Zylinder 7. [V452 CHECK: injector cut-out (ag_ti) RAM block shifted in V452; address not valid]" UWORD FORMULA_0589 0 0 0.0 1.0 ECU_ADDRESS 0x3FBCE6 BIT_MASK 0x40 /end MEASUREMENT
/begin MEASUREMENT ag_ti_mask_zyl8 "Ausblendung Zylinder 8. [V452 CHECK: injector cut-out (ag_ti) RAM block shifted in V452; address not valid]" UWORD FORMULA_0590 0 0 0.0 1.0 ECU_ADDRESS 0x3FBCE6 BIT_MASK 0x80 /end MEASUREMENT
/begin MEASUREMENT ag_ti_mask_zyl9 "Ausblendung Zylinder 9. [V452 CHECK: injector cut-out (ag_ti) RAM block shifted in V452; address not valid]" UWORD FORMULA_0591 0 0 0.0 1.0 ECU_ADDRESS 0x3FBCE6 BIT_MASK 0x100 /end MEASUREMENT
/begin MEASUREMENT ag_ti_mask_zyl10 "Ausblendung Zylinder 10. [V452 CHECK: injector cut-out (ag_ti) RAM block shifted in V452; address not valid]" UWORD FORMULA_0592 0 0 0.0 1.0 ECU_ADDRESS 0x3FBCE6 BIT_MASK 0x200 /end MEASUREMENT
/* ------------------ Abschnitt erzeugt aus ascet_interf.dat ------------------ */
/begin CHARACTERISTIC K_GEN_SLP_UG "Generatorspannungsvorgabe bei SLP-Betrieb | EN: Generator voltage target during secondary-air-pump operation" VALUE 0x702A0 TKW_VV_VV_UW 100.0 FORMULA_0462 0.0 6553.5000 FORMAT "%6.3" /end CHARACTERISTIC
/begin CHARACTERISTIC K_GEN_BSD_VARIANTE "Gen.-regler-Variante | EN: Gen.-regler-Variante" VALUE 0x702A2 TKW_VV_VV_UB 100.0 FORMULA_0599 0.0 255.0 /end CHARACTERISTIC
/begin CHARACTERISTIC K_GEN_BSD_ERROR_CC_CNT "Generatorfehler-Zeitzaehlerschwelle" VALUE 0x702A4 TKW_VV_VV_UW 100.0 FORMULA_0600 0.0 1092.2500 FORMAT "%5.2" /end CHARACTERISTIC
/begin CHARACTERISTIC K_OELSTAND_CAN_PST_LINEAR "Oelstand per CAN Ident-381h" VALUE 0x702A6 TKW_VV_VV_UB 100.0 FORMULA_0003 0.0 1.0000 /end CHARACTERISTIC
/begin CHARACTERISTIC K_OZLBESCHS "Laengsbeschleunigung Ausblendung-Schwelle im Stand | EN: Laengsbeschleunigung Aus-blendung-Schwelle im Stand" VALUE 0x702A7 TKW_VV_VV_SB 100.0 FORMULA_0446 -32.0000 31.7500 /end CHARACTERISTIC
/begin CHARACTERISTIC K_OZQBESCHS "Querbeschleunigung Ausblendung-Schwelle im Stand | EN: Querbeschleunigung Ausblen-dung-Schwelle im Stand" VALUE 0x702A8 TKW_VV_VV_SB 100.0 FORMULA_0446 -32.0000 31.7500 /end CHARACTERISTIC
/begin CHARACTERISTIC K_OZORLIM2 "Schwelle f�r Orientierungswert �lniveau (Verlustwarnung) | EN: Schwelle für Orientierungswert Ölniveau (Verlustwarnung)" VALUE 0x702A9 TKW_VV_VV_UB 100.0 FORMULA_0431 0.0 74.7070 /end CHARACTERISTIC
/begin CHARACTERISTIC K_OZLBESCH_STAND_CC "Laengsbeschl.-Ausblendung Standmsg. | EN: Laengsbeschl.-Ausblendung Standmsg." VALUE 0x702AA TKW_VV_VV_SB 100.0 FORMULA_0446 -32.0000 31.7500 /end CHARACTERISTIC
/begin CHARACTERISTIC K_OZQBESCH_STAND_CC "Querbeschl.-Ausblendung Standmsg. | EN: Querbeschl.-Ausblendung Standmsg." VALUE 0x702AB TKW_VV_VV_SB 100.0 FORMULA_0446 -32.0000 31.7500 /end CHARACTERISTIC
/begin CHARACTERISTIC K_OZ_N_OELMAXKORR_U "unt. Drehz.grenze Wichtung Langzeitmw. | EN: unt. Drehz.grenze Wichtung Langzeitmw." VALUE 0x702AC TKW_VV_VV_SW 100.0 FORMULA_0006 -32768.0000 32767.0000 /end CHARACTERISTIC
/begin CHARACTERISTIC K_OZ_N_OELMAXKORR_O "ob. Drehz.grenze Wichtung Langzeitmw. | EN: ob. Drehz.grenze Wichtung Langzeitmw." VALUE 0x702AE TKW_VV_VV_SW 100.0 FORMULA_0006 -32768.0000 32767.0000 /end CHARACTERISTIC
/begin CHARACTERISTIC K_OZ_KRZ_MESSUNG_LL "Oelstanderfassung nach x sec. im Leerlauf | EN: Oelstanderfassung nach x sec. im Leerlauf" VALUE 0x702B0 TKW_VV_VV_UW 100.0 FORMULA_0021 0.0 655.0000 FORMAT "%5.2" /end CHARACTERISTIC
/begin CHARACTERISTIC K_OZ_ALT_NACHF "Nachfuellerkennung Motoroel | EN: Nachfuellerkennung Motoroel" VALUE 0x702B2 TKW_VV_VV_UB 100.0 FORMULA_0436 0.0 25.5000 /end CHARACTERISTIC
/begin CHARACTERISTIC K_OZ_KRZ_HYST_CBS "Mindestschwankung (CBS frisch) | EN: Mindestschwankung (CBS frisch)" VALUE 0x702B3 TKW_VV_VV_UB 100.0 FORMULA_0436 0.0 25.5000 /end CHARACTERISTIC
/begin CHARACTERISTIC K_OZ_ALT_HYST_U "Mind.schwankung (nach unten) Erstuebernahme Lzw. | EN: Mind.schwankung (nach unten) Erstuebernahme Lzw." VALUE 0x702B4 TKW_VV_VV_UB 100.0 FORMULA_0436 0.0 25.5000 /end CHARACTERISTIC
/begin CHARACTERISTIC K_OZ_ALT_HYST_F "Mindestschwankung Langzeitmsg. | EN: Mindestschwankung Langzeitmsg." VALUE 0x702B5 TKW_VV_VV_UB 100.0 FORMULA_0436 0.0 25.5000 /end CHARACTERISTIC
/begin CHARACTERISTIC K_OZ_KRZ_HYST "Mindestschwankung Kurzzeitmsg. | EN: Mindestschwankung Kurzzeitmsg." VALUE 0x702B6 TKW_VV_VV_UB 100.0 FORMULA_0436 0.0 25.5000 /end CHARACTERISTIC
/begin CHARACTERISTIC K_OZ_LZW_AEND_BEGR "neg. Inkrement Langzeitmsg. | EN: neg. Inkrement Langzeitmsg." VALUE 0x702B7 TKW_VV_VV_UB 100.0 FORMULA_0436 0.0 25.5000 /end CHARACTERISTIC
/begin CHARACTERISTIC K_OZ_1L_BEGR_U "untere 1L-Schwelle abzgl. Kraftst. | EN: untere 1L-Schwelle abzgl. Kraftst." VALUE 0x702B8 TKW_VV_VV_UB 100.0 FORMULA_0598 -10.0000 15.3999 /end CHARACTERISTIC
/begin CHARACTERISTIC K_OZ_CC_OELVERBRAUCH "Schwelle Motoroel bei Minimum" VALUE 0x702B9 TKW_VV_VV_UB 100.0 FORMULA_0598 -10.0000 15.3999 /end CHARACTERISTIC
/begin CHARACTERISTIC K_OZ_CC_OELVERLUST "Schwelle Motoroel unter Minimum bzw. Oelverlust | EN: Schwelle Motoroel unter Mini-mum bzw. Oelverlust" VALUE 0x702BA TKW_VV_VV_UB 100.0 FORMULA_0598 -10.0000 15.3999 /end CHARACTERISTIC
/begin CHARACTERISTIC K_OZ_OELVERLUST_FSP "Schwelle Motoroel unter Minimum mit FSP-Eintrag | EN: Schwelle Motoroel unter Mini-mum mit FSP-Eintrag" VALUE 0x702BB TKW_VV_VV_UB 100.0 FORMULA_0598 -10.0000 15.3999 /end CHARACTERISTIC
/begin CHARACTERISTIC K_OZ_1L_BEGR_O "obere 1L-Schwelle abzgl. Kraftst. | EN: obere 1L-Schwelle abzgl. Kraftst." VALUE 0x702BC TKW_VV_VV_UB 100.0 FORMULA_0598 -10.0000 15.3999 /end CHARACTERISTIC
/begin CHARACTERISTIC K_OZ_1_5_L_BEGR "1,5L-Anzeigeschwelle | EN: 1,5L-Anzeigeschwelle" VALUE 0x702BD TKW_VV_VV_UB 100.0 FORMULA_0598 -10.0000 15.3999 /end CHARACTERISTIC
/begin CHARACTERISTIC K_OZ_AG_MESSSTAB_MIN_OK "Schwelle Motoroel Min-OK" VALUE 0x702BE TKW_VV_VV_UB 100.0 FORMULA_0598 -10.0000 15.3999 /end CHARACTERISTIC
/begin CHARACTERISTIC K_OZ_AG_MESSSTAB_OK "Schwelle Motoroel OK | EN: Schwelle Motoroel OK" VALUE 0x702BF TKW_VV_VV_UB 100.0 FORMULA_0598 -10.0000 15.3999 /end CHARACTERISTIC
/begin CHARACTERISTIC K_OZ_AG_MESSSTAB_OK_MAX "Schwelle Motoroel OK-Max" VALUE 0x702C0 TKW_VV_VV_UB 100.0 FORMULA_0598 -10.0000 15.3999 /end CHARACTERISTIC
/begin CHARACTERISTIC K_OZ_MIN_LEVEL_VOL "Gesamtoelmenge Min-Stand | EN: Gesamtoelmenge Min-Stand" VALUE 0x702C2 TKW_VV_VV_UW 100.0 FORMULA_0601 0.0 20.0000 FORMAT "%5.2" /end CHARACTERISTIC
/begin CHARACTERISTIC K_OZ_NIV_KM_MAX "max. Km nach letzter Oelnivmessg. | EN: max. Km nach letzter Oelnivmessg." VALUE 0x702C4 TKW_VV_VV_UL 100.0 FORMULA_0027 0.0 16777214.0000 /end CHARACTERISTIC
/begin CHARACTERISTIC K_OZ_PM_CC_CBS_MSG_TEST "CC-und CBS-Meldungen-Testkonstante | EN: CC-und CBS-Meldungen-Testkonstante" VALUE 0x702C8 TKW_VV_VV_UW 100.0 FORMULA_0602 0.0 65535.0 FORMAT "%5.2" /end CHARACTERISTIC
/begin CHARACTERISTIC K_OZ_TEMPBW_KOPF "Mindesttemp. am Oelfilterkopf | EN: Mindesttemp. am Oelfilterkopf" VALUE 0x702CA TKW_VV_VV_SW 100.0 FORMULA_0023 -50.0000 170.0000 FORMAT "%4.1" /end CHARACTERISTIC
/begin CHARACTERISTIC K_OZ_TEMPBW_SUMPF "Mindesttemp. Oelwanne | EN: °C -3276.8p 2 0.75*x Mindesttemp. Oelwanne" VALUE 0x702CC TKW_VV_VV_SW 100.0 FORMULA_0426 -3276.8000 3276.7000 /end CHARACTERISTIC
/begin CHARACTERISTIC K_OZ_TEMP_KOR "Korrekturfaktor Volumenausdehnung | EN: Korrekturfaktor Volumenaus-dehnung" VALUE 0x702CE TKW_VV_VV_UB 100.0 FORMULA_0603 0.5000 1.5000 /end CHARACTERISTIC
/begin CHARACTERISTIC K_OZ_TEMP_75 "Mindesttemp. Oelwanne | EN: °C -3276.8p 2 0.75*x Mindesttemp. Oelwanne" VALUE 0x702D0 TKW_VV_VV_SW 100.0 FORMULA_0426 -3276.8000 3276.7000 /end CHARACTERISTIC
/begin CHARACTERISTIC K_SCHNELLMSG_ANZAHL_WERTE "Anzahl Oelsensor-Rohwerte" VALUE 0x702D2 TKW_VV_VV_UB 100.0 FORMULA_0483 7.0000 20.0000 /end CHARACTERISTIC
/begin CHARACTERISTIC K_SCHNELLMSG_KL15_MAX "CC-Mld-Schnellmessung-Aktivzeit" VALUE 0x702D4 TKW_VV_VV_UW 100.0 FORMULA_0021 0.0 655.0000 FORMAT "%5.2" /end CHARACTERISTIC
/begin CHARACTERISTIC K_SCHNELLMSG_KL15_AUSBLEND "Ausblendungszeit Bedingung Schnellmsg." VALUE 0x702D6 TKW_VV_VV_UW 100.0 FORMULA_0021 0.0 655.0000 FORMAT "%5.2" /end CHARACTERISTIC
/begin CHARACTERISTIC K_SCHNELLMSG_OZLBESCHS "Laengsbeschl. Ausblendung-Schwelle Schnellmessung" VALUE 0x702D8 TKW_VV_VV_SB 100.0 FORMULA_0446 -32.0000 31.7500 /end CHARACTERISTIC
/begin CHARACTERISTIC K_SCHNELLMSG_OZQBESCHS "Querbeschl. Ausblendung-Schwelle Schnellmessung" VALUE 0x702D9 TKW_VV_VV_SB 100.0 FORMULA_0446 -32.0000 31.7500 /end CHARACTERISTIC
/begin CHARACTERISTIC K_SCHNELLMSG_T_MS "Motor steht-Schwelle | EN: Motor steht-Schwelle" VALUE 0x702DA TKW_VV_VV_UW 100.0 FORMULA_0438 1.0000 65535.0000 FORMAT "%5.2" /end CHARACTERISTIC
/begin CHARACTERISTIC K_SCHNELLMSG_TOEL_MIN "Mindestoeltemp. fuer Schnellmessung" VALUE 0x702DC TKW_VV_VV_SW 100.0 FORMULA_0023 -50.0000 170.0000 FORMAT "%4.1" /end CHARACTERISTIC
/begin CHARACTERISTIC K_SCHNELLMSG_N_MAX "Maximaldrehzahl fuer Schnellmessung | EN: Maximaldrehzahl fuer Schnell-messung" VALUE 0x702DE TKW_VV_VV_SW 100.0 FORMULA_0006 0.0 10000.0000 /end CHARACTERISTIC
/begin CHARACTERISTIC K_SCHNELLMSG_V_MAX "Max.geschwindigkeit Schnellmessung | EN: Max.geschwindigkeit Schnell-messung" VALUE 0x702E0 TKW_VV_VV_SW 100.0 FORMULA_0078 -80.0000 360.0000 FORMAT "%4.1" /end CHARACTERISTIC
/begin CHARACTERISTIC K_TIME_SET_1 "- | EN: -" VALUE 0x702E2 TKW_VV_VV_SW 100.0 FORMULA_0010 -32768.0000 32767.0000 /end CHARACTERISTIC
/begin CHARACTERISTIC K_TIME_SET_2 "- | EN: -" VALUE 0x702E4 TKW_VV_VV_SW 100.0 FORMULA_0010 -32768.0000 32767.0000 /end CHARACTERISTIC
/begin CHARACTERISTIC K_TIME_SET_3 "-" VALUE 0x702E6 TKW_VV_VV_SW 100.0 FORMULA_0010 -32768.0000 32767.0000 /end CHARACTERISTIC
/begin CHARACTERISTIC KL_GEN_AUSL_BEGR "Generator Auslastungsbegrenzung | EN: Generator load limit" CURVE 0x702E8 TKL_SW_VV_UB 100.0 FORMULA_0604 0.0 87.5000 /begin AXIS_DESCR STD_AXIS N_gen FORMULA_0006 5 -32768.0000 32767.0000 /end AXIS_DESCR /end CHARACTERISTIC
/begin CHARACTERISTIC KL_OELLEVEL_KOMBI "Linearisierungskennlinie Kombianzeige | EN: Linearisierungskennlinie Kombianzeige" CURVE 0x702FA TKL_UB_VV_UB 100.0 FORMULA_0598 -10.0000 15.3999 /begin AXIS_DESCR STD_AXIS Oz_langmw FORMULA_0431 20 0.0 74.7070 /end AXIS_DESCR /end CHARACTERISTIC
/begin CHARACTERISTIC KL_OZ_LGMW_OFFSET "Linearisierungskennlinie Kombianzeige | EN: Linearisation curve, instrument cluster display" CURVE 0x70324 TKL_UB_VV_UB 100.0 FORMULA_0431 0.0 74.4140 /begin AXIS_DESCR STD_AXIS Oz_langmw FORMULA_0431 8 0.0 74.7070 /end AXIS_DESCR /end CHARACTERISTIC
/begin CHARACTERISTIC KL_OZ_LL_L_OFFSET "Laengs-Beschl. Korr. Niveau | EN: Laengs-Beschl. Korr. Niveau" CURVE 0x70336 TKL_SW_VV_SB 100.0 FORMULA_0431 -21.9726 21.9726
 /begin AXIS_DESCR STD_AXIS smg_ax_10s_mw FORMULA_0132 5 -20.0000 20.0000 FORMAT "%5.2" /end AXIS_DESCR
/end CHARACTERISTIC
/begin CHARACTERISTIC KL_OZ_LL_Q_OFFSET "Quer-Beschl. Korr. Niveau | EN: Quer-Beschl. Korr. Niveau" CURVE 0x70348 TKL_SW_VV_SB 100.0 FORMULA_0431 -21.9726 21.9726
 /begin AXIS_DESCR STD_AXIS can_ay_10s_mw FORMULA_0132 5 -20.0000 20.0000 FORMAT "%5.2" /end AXIS_DESCR
/end CHARACTERISTIC
/begin CHARACTERISTIC KF_OZ_TEMP_KOR "Temperaturkorrektur Kurzzeitmessung | EN: Temperature correction, short-term measurement" MAP 0x7035A TKF_SW_SW_UW 100.0 FORMULA_0453 0.0 63.9990
 /begin AXIS_DESCR STD_AXIS Oz_krzmwkor FORMULA_0449 6 0.0 74.7070 FORMAT "%5.2" /end AXIS_DESCR
 /begin AXIS_DESCR STD_AXIS toel_delta FORMULA_0605 6 0.0 32767.0000 FORMAT "%5.2" /end AXIS_DESCR
 FORMAT "%7.4" /end CHARACTERISTIC
/begin CHARACTERISTIC KF_SCHNELLMSG_OZNIVR_MIN "Mindestniveau kurz nach KL15ein | EN: Minimum level shortly after terminal 15 on" MAP 0x703BC TKF_SW_SW_SW 100.0 FORMULA_0606 0.0 75.3709 /begin AXIS_DESCR STD_AXIS n FORMULA_0006 6 0.0 10000.0000 /end AXIS_DESCR
 /begin AXIS_DESCR STD_AXIS tmot FORMULA_0023 6 -50.0000 170.0000 FORMAT "%4.1" /end AXIS_DESCR
 FORMAT "%5.2" /end CHARACTERISTIC
/begin MEASUREMENT Kvaverbr "Kraftstoffverbrauch (Einspritzmenge in Microliter)" UWORD FORMULA_0010 0 0 0.0 65535.0000 ECU_ADDRESS 0x3FBCFE /end MEASUREMENT
/begin MEASUREMENT Ztageabs "Tagezaehler vom Kombi " UWORD FORMULA_0010 0 0 0.0 65535.0000 ECU_ADDRESS 0x3FBD00 /end MEASUREMENT
/begin MEASUREMENT Id_bosrtw "ID fuer Motoroel vom Kombi" UWORD FORMULA_0010 0 0 0.0 65535.0000 ECU_ADDRESS 0x3FBD02 /end MEASUREMENT
/begin MEASUREMENT Id_bosrst "ID fuer BOSReset vom Kombi" UBYTE FORMULA_0003 0 0 0.0 255.0000 ECU_ADDRESS 0x3FBD04 /end MEASUREMENT
/begin MEASUREMENT Bosv "Verfuegbarkeit vom Kombi" UBYTE FORMULA_0003 0 0 0.0 255.0000 ECU_ADDRESS 0x3FBD05 /end MEASUREMENT
/begin MEASUREMENT Zrbosr "Servicezaehler vom Kombi" UBYTE FORMULA_0003 0 0 0.0 255.0000 ECU_ADDRESS 0x3FBD06 /end MEASUREMENT
/begin MEASUREMENT Id_bosrtt "ID BOS-Reset vom Tester" UBYTE FORMULA_0003 0 0 0.0 255.0000 ECU_ADDRESS 0x3FBD07 /end MEASUREMENT
/begin MEASUREMENT Bosfxid2r "ID_Funktion_BOS_Rueckstellung_2" UWORD FORMULA_0010 0 0 0.0 65535.0000 ECU_ADDRESS 0x3FBD08 /end MEASUREMENT
/begin MEASUREMENT Bosid2r "ID_2_BOS_Rueckstellung_2" UBYTE FORMULA_0003 0 0 0.0 255.0000 ECU_ADDRESS 0x3FBD0A /end MEASUREMENT
/begin MEASUREMENT Bosbtvfbkt "Verfuegbarkeit ueber Tester" UBYTE FORMULA_0003 0 0 0.0 255.0000 ECU_ADDRESS 0x3FBD0B /end MEASUREMENT
/begin MEASUREMENT Bosrlsmr "Restlaufstrecke Motoroel vom Kombi" SWORD FORMULA_0428 0 0 -327680.0000 327670.0000 ECU_ADDRESS 0x3FBD0C /end MEASUREMENT
/begin MEASUREMENT Bosrw2r "Prognose_Intervall_Weg_BOS_Rueckstellung_2" UBYTE FORMULA_0429 0 0 0.0 255000.0000 ECU_ADDRESS 0x3FBD0E /end MEASUREMENT
/begin MEASUREMENT Bosprog2r "Prognose_Intervall_Zeit_BOS_Meldung_2" UBYTE FORMULA_0003 0 0 0.0 255.0000 ECU_ADDRESS 0x3FBD0F /end MEASUREMENT
/begin MEASUREMENT Bosjzielr "Zieltermin_Monat_BOS_Rueckstellung_2" UBYTE FORMULA_0003 0 0 0.0 255.0000 ECU_ADDRESS 0x3FBD10 /end MEASUREMENT
/begin MEASUREMENT Bosjzielt "Zieltermin_Jahr vom Tester " UBYTE FORMULA_0003 0 0 0.0 255.0000 ECU_ADDRESS 0x3FBD11 /end MEASUREMENT
/begin MEASUREMENT Bosmzielr "Zieltermin_Jahr_BOS_Rueckstellung_2" UBYTE FORMULA_0003 0 0 0.0 255.0000 ECU_ADDRESS 0x3FBD12 /end MEASUREMENT
/begin MEASUREMENT Bosmzielt "Zieltermin_Monat vom Tester" UBYTE FORMULA_0003 0 0 0.0 255.0000 ECU_ADDRESS 0x3FBD13 /end MEASUREMENT
/begin MEASUREMENT Zrbosrt "Servicezaehlerstand vom Tester" UBYTE FORMULA_0003 0 0 0.0 255.0000 ECU_ADDRESS 0x3FBD14 /end MEASUREMENT
/begin MEASUREMENT Bosrw2t "Prognose_Intervall_Weg vomTester" UBYTE FORMULA_0429 0 0 0.0 255000.0000 ECU_ADDRESS 0x3FBD15 /end MEASUREMENT
/begin MEASUREMENT Acfzgl "Fahrzeuglaengsbeschleunigung " SBYTE FORMULA_0593 0 0 -32.0000 31.7500 ECU_ADDRESS 0x3FBD16 /end MEASUREMENT
/begin MEASUREMENT Acfzgq "Fahrzeugquerbeschleunigung" SBYTE FORMULA_0593 0 0 -32.0000 31.7500 ECU_ADDRESS 0x3FBD17 /end MEASUREMENT
/begin MEASUREMENT T_jahr "Borddatum" UWORD FORMULA_0010 0 0 0.0 65535.0000 ECU_ADDRESS 0x3FBD18 /end MEASUREMENT
/begin MEASUREMENT Oz_datstat "Status Datum/Uhrzeit" UBYTE FORMULA_0003 0 0 0.0 255.0000 ECU_ADDRESS 0x3FBD1A /end MEASUREMENT
/begin MEASUREMENT T_monate "Borddatum" UBYTE FORMULA_0003 0 0 0.0 255.0000 ECU_ADDRESS 0x3FBD1B /end MEASUREMENT
/begin MEASUREMENT Oz_lf1c "Laenderfaktor1 codiert" UBYTE FORMULA_0451 0 0 0.0 2.5500 ECU_ADDRESS 0x3FBD1C /end MEASUREMENT
/begin MEASUREMENT Oz_lf2c "Laenderfaktor1 codiert" UBYTE FORMULA_0451 0 0 0.0 2.5500 ECU_ADDRESS 0x3FBD1D /end MEASUREMENT
/begin MEASUREMENT Fahrzeug " = 60 ? " UBYTE FORMULA_0003 0 0 0.0 255.0000 ECU_ADDRESS 0x3FBD1E /end MEASUREMENT
/begin MEASUREMENT B_etumg "Umgebungstemperaturfehler?" UBYTE FORMULA_0003 0 0 0.0 255.0000 ECU_ADDRESS 0x3FBD21 /end MEASUREMENT
/begin MEASUREMENT B_fs "Bed. Fahrstufe" UBYTE FORMULA_0003 0 0 0.0 255.0000 ECU_ADDRESS 0x3FBD22 /end MEASUREMENT
/begin MEASUREMENT B_genslp "Spannungsanf. Sekundaerluftpumpe" UBYTE FORMULA_0003 0 0 0.0 255.0000 ECU_ADDRESS 0x3FBD23 /end MEASUREMENT
/begin MEASUREMENT B_gen_bsd_error_CC "Generatorkommunikationsfehler aktiv" UBYTE FORMULA_0594 0 0 0.0 255.0 ECU_ADDRESS 0x3FBD24 /end MEASUREMENT
/begin MEASUREMENT B_kl15 "Bed. Kl15" UBYTE FORMULA_0594 0 0 0.0 255.0 ECU_ADDRESS 0x3FBD25 /end MEASUREMENT
/begin MEASUREMENT B_kl15_ep "Bed. Kl15 gesetzt" UBYTE FORMULA_0594 0 0 0.0 255.0 ECU_ADDRESS 0x3FBD26 /end MEASUREMENT
/begin MEASUREMENT B_kwdreht "Bed. Kurbelw. syncr." UBYTE FORMULA_0003 0 0 0.0 255.0000 ECU_ADDRESS 0x3FBD27 /end MEASUREMENT
/begin MEASUREMENT B_ll "Bed. Leerlauf" UBYTE FORMULA_0003 0 0 0.0 255.0000 ECU_ADDRESS 0x3FBD28 /end MEASUREMENT
/begin MEASUREMENT B_llrein "Leerlauf mind. einmal gesetzt" UBYTE FORMULA_0003 0 0 0.0 255.0000 ECU_ADDRESS 0x3FBD29 /end MEASUREMENT
/begin MEASUREMENT B_pwf "Bed. Powerfail" UBYTE FORMULA_0003 0 0 0.0 255.0000 ECU_ADDRESS 0x3FBD2A /end MEASUREMENT
/begin MEASUREMENT B_sta "Bed. Automatikstart" UBYTE FORMULA_0003 0 0 0.0 255.0000 ECU_ADDRESS 0x3FBD2C /end MEASUREMENT
/begin MEASUREMENT B_start "Vor bzw. im Start" UBYTE FORMULA_0003 0 0 0.0 255.0000 ECU_ADDRESS 0x3FBD2D /end MEASUREMENT
/begin MEASUREMENT B_startende "Ende Startvorg." UBYTE FORMULA_0003 0 0 0.0 255.0000 ECU_ADDRESS 0x3FBD2E /end MEASUREMENT
/begin MEASUREMENT B_taerr "Tans-Fehler da ?" UBYTE FORMULA_0003 0 0 0.0 255.0000 ECU_ADDRESS 0x3FBD2F /end MEASUREMENT
/begin MEASUREMENT B_taners "Tans-Ersatzwert ?" UBYTE FORMULA_0003 0 0 0.0 255.0000 ECU_ADDRESS 0x3FBD30 /end MEASUREMENT
/begin MEASUREMENT B_tumers "Ersatzwert TUMG ?" UBYTE FORMULA_0003 0 0 0.0 255.0000 ECU_ADDRESS 0x3FBD31 /end MEASUREMENT
/begin MEASUREMENT B_vl "Bed. Vollast" UBYTE FORMULA_0003 0 0 0.0 255.0000 ECU_ADDRESS 0x3FBD32 /end MEASUREMENT
/begin MEASUREMENT Bordnetz "0x01 => CAN11H / 0x02 => CAN12H" UBYTE FORMULA_0003 0 0 0.0 255.0000 ECU_ADDRESS 0x3FBD33 /end MEASUREMENT
/begin MEASUREMENT can_ay_10s_mw "Querbeschleunigung 10s-Mittelw." SWORD FORMULA_0132 0 0 -20.0000 20.0000 ECU_ADDRESS 0x3FBD36 /end MEASUREMENT
/begin MEASUREMENT can_ay_10s_mw_sum "Querbeschleunigung Summe" SWORD FORMULA_0132 0 0 -20.0000 20.0000 ECU_ADDRESS 0x3FBD38 /end MEASUREMENT
/begin MEASUREMENT smg_ax_10s_mw "Laengsbeschleunigung 10s-Mittelw." SWORD FORMULA_0132 0 0 -20.0000 20.0000 ECU_ADDRESS 0x3FBD3A /end MEASUREMENT
/begin MEASUREMENT smg_ax_10s_mw_sum "Laengsbeschleunigung 10s-Mittelw." SWORD FORMULA_0132 0 0 -20.0000 20.0000 ECU_ADDRESS 0x3FBD3C /end MEASUREMENT
/begin MEASUREMENT cnt_mw_ax_ay "Counter fuer Mw.-Berechng." UBYTE FORMULA_0003 0 0 0.0 255.0000 ECU_ADDRESS 0x3FBD3E /end MEASUREMENT
/begin MEASUREMENT Km_st "Kilometerstand" UWORD FORMULA_0595 0 0 0.0 655350.0000 ECU_ADDRESS 0x3FBD40 /end MEASUREMENT
/begin MEASUREMENT L_pwmout "Tastverhaeltnis E-Luefter" UWORD FORMULA_0010 0 0 0.0 65535.0000 ECU_ADDRESS 0x3FBD42 /end MEASUREMENT
/begin MEASUREMENT Mslui "Integr. Luftmasse" UWORD FORMULA_0010 0 0 0.0 65535.0000 ECU_ADDRESS 0x3FBD44 /end MEASUREMENT
/begin MEASUREMENT Nsllm "Solldrehzahl im Leerlauf" SWORD FORMULA_0010 0 0 -32768.0000 32767.0000 ECU_ADDRESS 0x3FBD4E /end MEASUREMENT
/begin MEASUREMENT U_gen_slp "Generatorspannungsvorgabe bei SLP-Betrieb" UWORD FORMULA_0462 0 0 0.0 6553.5000 ECU_ADDRESS 0x3FBD6A /end MEASUREMENT
/begin MEASUREMENT Tchip "Chiptemperatur Generator1" SWORD FORMULA_0426 0 0 -3276.8000 3276.7000 ECU_ADDRESS 0x3FBD78 /end MEASUREMENT
/begin MEASUREMENT Dfgrob "Gen.-Auslastung (grob aus Dffgen)" UBYTE FORMULA_0596 0 0 0.0 87.5000 ECU_ADDRESS 0x3FBD7A /end MEASUREMENT
/begin MEASUREMENT B_ckl50 "Bedingung Klemme 50 (vom CAN)" UBYTE FORMULA_0594 0 0 0.0 255.0 ECU_ADDRESS 0x3FBD7B /end MEASUREMENT
/begin MEASUREMENT B_ckl30 "Bedingung Klemme R (vom CAN)" UBYTE FORMULA_0594 0 0 0.0 255.0 ECU_ADDRESS 0x3FBD7C /end MEASUREMENT
/begin MEASUREMENT B_pmsv_st "EEPROM sichern nach WakeUp" UBYTE FORMULA_0003 0 0 0.0 1.0000 ECU_ADDRESS 0x3FBD7E /end MEASUREMENT
/begin MEASUREMENT B_ll_niv_krz "" UBYTE FORMULA_0003 0 0 0.0 1.0000 ECU_ADDRESS 0x3FBD7F /end MEASUREMENT
/begin MEASUREMENT B_ll_niv_krz_alt "" UBYTE FORMULA_0003 0 0 0.0 1.0000 ECU_ADDRESS 0x3FBD80 /end MEASUREMENT
/begin MEASUREMENT B_ozlangmw_kl15_st "" UBYTE FORMULA_0003 0 0 0.0 1.0000 ECU_ADDRESS 0x3FBD81 /end MEASUREMENT
/begin MEASUREMENT B_oz_oelcheck_CC "CC-Mldg. Oelstand zu niedrig" UBYTE FORMULA_0003 0 0 0.0 1.0000 ECU_ADDRESS 0x3FBD82 /end MEASUREMENT
/begin MEASUREMENT B_oz_oelverbr_CC "CC: Oelverbrauchswarnung - Motoroelstand bei Minimum" UBYTE FORMULA_0003 0 0 0.0 1.0000 ECU_ADDRESS 0x3FBD83 /end MEASUREMENT
/begin MEASUREMENT B_oz_oelverlust_CC "CC: Oelverlust - Motoroelstand unter Minimum" UBYTE FORMULA_0003 0 0 0.0 1.0000 ECU_ADDRESS 0x3FBD84 /end MEASUREMENT
/begin MEASUREMENT B_schnellmsg_bed "Schnellmessung-Diagnosebedingungen OK" UBYTE FORMULA_0003 0 0 0.0 1.0000 ECU_ADDRESS 0x3FBD85 /end MEASUREMENT
/begin MEASUREMENT B_schnellmsg_fertig "Niveauwerte-Schnellmessung gesammelt" UBYTE FORMULA_0003 0 0 0.0 1.0000 ECU_ADDRESS 0x3FBD86 /end MEASUREMENT
/begin MEASUREMENT B_schnellmsg_oel_ok "Schnellmessung: mind. ein Messwert ueber OK-Schwelle" UBYTE FORMULA_0003 0 0 0.0 1.0000 ECU_ADDRESS 0x3FBD87 /end MEASUREMENT
/begin MEASUREMENT can_fllv_eoi "akt. Oel-Fuellstand" UBYTE FORMULA_0033 0 0 0.0 2.0000 ECU_ADDRESS 0x3FBD88 /end MEASUREMENT
/begin MEASUREMENT can_recm_rflv_eoi "Auskunft Nachfuellen" UBYTE FORMULA_0033 0 0 0.0 2.0000 ECU_ADDRESS 0x3FBD89 /end MEASUREMENT
/begin MEASUREMENT can_st_fllv_eoi "M-spezif. Erweit. Oel-Fuellstand" UBYTE FORMULA_0033 0 0 0.0 2.0000 ECU_ADDRESS 0x3FBD8A /end MEASUREMENT
/begin MEASUREMENT gen_n_elu "Drehzahlanforderung E-Luefter Generator" UBYTE FORMULA_0003 0 0 0.0 100.0000 ECU_ADDRESS 0x3FBD8B /end MEASUREMENT
/begin MEASUREMENT gen_bsd_error_cnt "Generatorfehler-Zeitzaehler" UWORD FORMULA_0062 0 0 0.0 65535.0000 ECU_ADDRESS 0x3FBD8C /end MEASUREMENT
/begin MEASUREMENT Oz_krzmwkor_n_kor "Drehzahlkorr. Oelniveauwert" UBYTE FORMULA_0431 0 0 0.0 74.7070 ECU_ADDRESS 0x3FBD8E /end MEASUREMENT
/begin MEASUREMENT Oz_krzmwkor_temp_kor "Temperaturkorr. Oelniveauwert" UBYTE FORMULA_0431 0 0 0.0 74.7070 ECU_ADDRESS 0x3FBD8F /end MEASUREMENT
/begin MEASUREMENT Oz_langmw_offset "Korrekturoffset Langzeitwert" UBYTE FORMULA_0431 0 0 0.0 74.7070 ECU_ADDRESS 0x3FBD90 /end MEASUREMENT
/begin MEASUREMENT Oz_offset_ll_q "q-beschl. korr. Oelniveauwert" SBYTE FORMULA_0431 0 0 -21.9726 21.9726 ECU_ADDRESS 0x3FBD91 /end MEASUREMENT
/begin MEASUREMENT Oz_offset_ll_l "l-beschl. korr. Oelniveauwert" SBYTE FORMULA_0431 0 0 -21.9726 21.9726 ECU_ADDRESS 0x3FBD92 /end MEASUREMENT
/begin MEASUREMENT Oz_n_gesamtzeit "Zeitdauer Langzeitwertermittlung" UWORD FORMULA_0062 0 0 0.0 65535.0000 ECU_ADDRESS 0x3FBD94 /end MEASUREMENT
/begin MEASUREMENT Oz_n_messzeit "Zeitdauer im Drehzahlband" UWORD FORMULA_0062 0 0 0.0 65535.0000 ECU_ADDRESS 0x3FBD96 /end MEASUREMENT
/begin MEASUREMENT Oz_verbleib_verh "Verh. Zeit im Drehzahlband/Lgztmw" UBYTE FORMULA_0032 0 0 0.0 255.0000 ECU_ADDRESS 0x3FBD98 /end MEASUREMENT
/begin MEASUREMENT St_schnellmsg_check "State Schnellmessung" UBYTE FORMULA_0003 0 0 0.0 255.0000 ECU_ADDRESS 0x3FBD99 /end MEASUREMENT
/begin MEASUREMENT time_set_1 "Wiederholzaehler" SWORD FORMULA_0010 0 0 -32768.0000 32767.0000 ECU_ADDRESS 0x3FBD9A /end MEASUREMENT
/begin MEASUREMENT time_set_2 "Wiederholzaehler" SWORD FORMULA_0010 0 0 -32768.0000 32767.0000 ECU_ADDRESS 0x3FBD9C /end MEASUREMENT
/begin MEASUREMENT time_set_3 "Wiederholzaehler" SWORD FORMULA_0010 0 0 -32768.0000 32767.0000 ECU_ADDRESS 0x3FBD9E /end MEASUREMENT
/begin MEASUREMENT time_stamp_kl15_on "Zeitpunkt Schnellmsg. time_kl15_on" ULONG FORMULA_0152 0 0 0.0 655.0000 ECU_ADDRESS 0x3FBDA0 /end MEASUREMENT
/begin MEASUREMENT B_fahisrst "Bed. Histogramm Reset" UBYTE FORMULA_0003 0 0 0.0 255.0000 ECU_ADDRESS 0x3F9838 /end MEASUREMENT
/begin MEASUREMENT B_fabttreg "Bed. Batterietausch registrieren" UBYTE FORMULA_0003 0 0 0.0 255.0000 ECU_ADDRESS 0x3F9839 /end MEASUREMENT
/begin MEASUREMENT B_fapmmess "Bed. Messmethode PM" UBYTE FORMULA_0003 0 0 0.0 255.0000 ECU_ADDRESS 0x3F983A /end MEASUREMENT
/begin MEASUREMENT Batt_class "Klassifizierung der in diesem Fzg. eingebauten Batterie" UBYTE FORMULA_0003 0 0 0.0 255.0000 ECU_ADDRESS 0x3F983B /end MEASUREMENT
/begin MEASUREMENT Ikurz_ogr "Obere Grenze Kurzschluss strom vom CAS" UBYTE FORMULA_0003 0 0 0.0 255.0000 ECU_ADDRESS 0x3F983C /end MEASUREMENT
/begin MEASUREMENT Ikurz_ugr " Untere Grenze Kurzschlussstrom vom CAS" UBYTE FORMULA_0003 0 0 0.0 255.0000 ECU_ADDRESS 0x3F983D /end MEASUREMENT
/begin MEASUREMENT Iwakeupgr "Fahrzeugspezifischer Ruhestrom" UBYTE FORMULA_0003 0 0 0.0 255.0000 ECU_ADDRESS 0x3F983E /end MEASUREMENT
/begin MEASUREMENT Oz_anz_kombi_AG_code "Peilstab-Nachr. AG-codiert (fllv_eoi) 0x381" UBYTE FORMULA_0597 0 0 0.0 255.0 ECU_ADDRESS 0x3F983F /end MEASUREMENT
/begin MEASUREMENT Oz_anzeige_kombi "Peilstab-CAN-Nachr. an Kombi (st_fllv_eoi)" UBYTE FORMULA_0598 0 0 -10.0000 15.3999 ECU_ADDRESS 0x3F9840 /end MEASUREMENT
/begin MEASUREMENT Oz_anzeige_kombi_alt "gemerktes Oz_anzeige_kombi" UBYTE FORMULA_0598 0 0 -10.0000 15.3999 ECU_ADDRESS 0x3F9841 /end MEASUREMENT
/begin MEASUREMENT Oz_niv_km_update "Km-Stand bei letzter Oelnivmessg." ULONG FORMULA_0027 0 0 0.0 16777214.0000 ECU_ADDRESS 0x3F9844 /end MEASUREMENT
/begin MEASUREMENT Pmsv_1of15_ "Angemeldete Powermanagment Standverbraucher" UBYTE FORMULA_0003 0 0 0.0 255.0000 ECU_ADDRESS 0x3F9848 /end MEASUREMENT
/begin MEASUREMENT Pmsv_2of15_ "Angemeldete Powermanagment Standverbraucher" UBYTE FORMULA_0003 0 0 0.0 255.0000 ECU_ADDRESS 0x3F9849 /end MEASUREMENT
/begin MEASUREMENT Pmsv_3of15_ "Angemeldete Powermanagment Standverbraucher" UBYTE FORMULA_0003 0 0 0.0 255.0000 ECU_ADDRESS 0x3F984A /end MEASUREMENT
/begin MEASUREMENT Pmsv_4of15_ "Angemeldete Powermanagment Standverbraucher" UBYTE FORMULA_0003 0 0 0.0 255.0000 ECU_ADDRESS 0x3F984B /end MEASUREMENT
/begin MEASUREMENT Pmsv_5of15_ "Angemeldete Powermanagment Standverbraucher" UBYTE FORMULA_0003 0 0 0.0 255.0000 ECU_ADDRESS 0x3F984C /end MEASUREMENT
/begin MEASUREMENT Pmsv_6of15_ "Angemeldete Powermanagment Standverbraucher" UBYTE FORMULA_0003 0 0 0.0 255.0000 ECU_ADDRESS 0x3F984D /end MEASUREMENT
/begin MEASUREMENT Pmsv_7of15_ "Angemeldete Powermanagment Standverbraucher" UBYTE FORMULA_0003 0 0 0.0 255.0000 ECU_ADDRESS 0x3F984E /end MEASUREMENT
/begin MEASUREMENT Pmsv_8of15_ "Angemeldete Powermanagment Standverbraucher" UBYTE FORMULA_0003 0 0 0.0 255.0000 ECU_ADDRESS 0x3F984F /end MEASUREMENT
/begin MEASUREMENT Pmsv_9of15_ "Angemeldete Powermanagment Standverbraucher" UBYTE FORMULA_0003 0 0 0.0 255.0000 ECU_ADDRESS 0x3F9850 /end MEASUREMENT
/begin MEASUREMENT Pmsv_10of15_ "Angemeldete Powermanagment Standverbraucher" UBYTE FORMULA_0003 0 0 0.0 255.0000 ECU_ADDRESS 0x3F9851 /end MEASUREMENT
/begin MEASUREMENT Pmsv_11of15_ "Angemeldete Powermanagment Standverbraucher" UBYTE FORMULA_0003 0 0 0.0 255.0000 ECU_ADDRESS 0x3F9852 /end MEASUREMENT
/begin MEASUREMENT Pmsv_12of15_ "Angemeldete Powermanagment Standverbraucher" UBYTE FORMULA_0003 0 0 0.0 255.0000 ECU_ADDRESS 0x3F9853 /end MEASUREMENT
/begin MEASUREMENT Pmsv_13of15_ "Angemeldete Powermanagment Standverbraucher" UBYTE FORMULA_0003 0 0 0.0 255.0000 ECU_ADDRESS 0x3F9854 /end MEASUREMENT
/begin MEASUREMENT Pmsv_14of15_ "Angemeldete Powermanagment Standverbraucher" UBYTE FORMULA_0003 0 0 0.0 255.0000 ECU_ADDRESS 0x3F9855 /end MEASUREMENT
/begin MEASUREMENT Pmsv_15of15_ "Angemeldete Powermanagment Standverbraucher" UBYTE FORMULA_0003 0 0 0.0 255.0000 ECU_ADDRESS 0x3F9856 /end MEASUREMENT
/begin FUNCTION AdaptCommon "" /begin DEF_CHARACTERISTIC /end DEF_CHARACTERISTIC /begin REF_CHARACTERISTIC /end REF_CHARACTERISTIC /begin IN_MEASUREMENT /end IN_MEASUREMENT
 /begin OUT_MEASUREMENT ccp_retry_cnt_nv crc32_data_carb_nv crc32_prog_carb_nv ipk_sync_error_st_nv ipk_sync_errorcount_nv os_err_ff.addr_0 os_err_ff.addr_1 os_err_ff.addr_2 os_err_ff.addr_3 os_err_ff.addr_4 os_err_ff.addr_5 os_err_ff.addr_6 os_err_ff.addr_7 os_err_ff.ptr os_proz_ff.aq_soll_grad os_proz_ff.mtime os_proz_ff.mtime_pid os_proz_ff.n os_proz_ff.rf os_proz_ff.time_ml os_proz_ff.zustand_motor os_proz_irq_ff.aq_soll_grad os_proz_irq_ff.mtime os_proz_irq_ff.mtime_pid os_proz_irq_ff.n os_proz_irq_ff.rf os_proz_irq_ff.time_ml os_proz_irq_ff.zustand_motor os_proz_irq_last_nv_10of10_ os_proz_irq_last_nv_1of10_ os_proz_irq_last_nv_2of10_ os_proz_irq_last_nv_3of10_ os_proz_irq_last_nv_4of10_ os_proz_irq_last_nv_5of10_ os_proz_irq_last_nv_6of10_ os_proz_irq_last_nv_7of10_ os_proz_irq_last_nv_8of10_ os_proz_irq_last_nv_9of10_ pctrl_proz_err_nv pctrl_task_err_nv ram_chk_err_adr_nv sk_ff.crc32_result sk_ff.egas_sk_mode sk_ff.fail_st_zyl sk_ff.kupp_ist sk_ff.kupp_wunsch_ges sk_ff.md_sk_mode sk_ff.n sk_ff.os_err_addr sk_ff.os_err_cnt sk_ff.os_err_type sk_ff.proz_err sk_ff.pwg_soll sk_ff.reset_cnt sk_ff.rf_m sk_ff.smg_sk_mode sk_ff.stufe sk_ff.task_err sk_ff.ub sk_ff.ursache spim_chain_error_nv spim_error_reinit_ctr_nv spim_errorcode_reinit_nv sys_exc_addr_nv sys_exc_lr_nv sys_exc_vec_nv sys_rsr_cnt_nv.csrs sys_rsr_cnt_nv.dbhrs sys_rsr_cnt_nv.dbsrs sys_rsr_cnt_nv.ehrs sys_rsr_cnt_nv.esrs sys_rsr_cnt_nv.ghrst sys_rsr_cnt_nv.gpor sys_rsr_cnt_nv.gsrst sys_rsr_cnt_nv.ilbc sys_rsr_cnt_nv.jtrs sys_rsr_cnt_nv.llrs sys_rsr_cnt_nv.ocrs sys_rsr_cnt_nv.swrs sys_zust_cpu_last_max_nv tpu_kw_err_ff_a.cnt tpu_kw_err_ff_a.event_time tpu_kw_err_ff_a.irq tpu_kw_err_ff_a.last_period tpu_kw_err_ff_a.n tpu_kw_err_ff_a.n_zahn tpu_kw_err_ff_a.prev_period tpu_kw_err_ff_a.state tpu_kw_err_ff_a.tooth tpu_kw_err_ff_a.tooth_time tpu_kw_err_ff_b.cnt tpu_kw_err_ff_b.event_time tpu_kw_err_ff_b.irq tpu_kw_err_ff_b.last_period tpu_kw_err_ff_b.n tpu_kw_err_ff_b.n_zahn tpu_kw_err_ff_b.prev_period tpu_kw_err_ff_b.state tpu_kw_err_ff_b.tooth tpu_kw_err_ff_b.tooth_time tpu_kw_irq_info_cnt_nv_a tpu_kw_irq_info_cnt_nv_b /end OUT_MEASUREMENT
/end FUNCTION
/begin FUNCTION Adaptiondaten_glob "" /begin DEF_CHARACTERISTIC /end DEF_CHARACTERISTIC /begin REF_CHARACTERISTIC /end REF_CHARACTERISTIC /begin IN_MEASUREMENT /end IN_MEASUREMENT
 /begin OUT_MEASUREMENT can_fzgtyp_clas_pwr_nv can_fzgtyp_grb_nv can_fzgtyp_land_nv can_fzgtyp_veh_nv can_km_stand_nv ed_css_st_ign_nv ed_css_st_ign_nv_auss ed_css_st_ign_nv_dk ed_css_st_ign_nv_lls ed_css_st_ign_nv_pwg ed_css_st_ign_nv_tmot ed_fsp_inj_fehlerzaehler_nv elu_nl_nv kat_obd_wert_gesamt_nv kat_obd_wert_nv_b1 kat_obd_wert_nv_b2 kwp_fetrawe_st laa_f_ber_nv_b1 laa_f_ber_nv_b2 tmot_abstell_nv toel_wanne /end OUT_MEASUREMENT
/end FUNCTION
/begin FUNCTION Adaptionswerte "" /begin DEF_CHARACTERISTIC /end DEF_CHARACTERISTIC /begin REF_CHARACTERISTIC /end REF_CHARACTERISTIC /begin IN_MEASUREMENT /end IN_MEASUREMENT
 /begin OUT_MEASUREMENT B_DMTL_ABBRUCH_BETANK B_DMTL_ABBRUCH_FEUCHT B_DMTL_DECKEL_DICHT B_DMTL_DECKEL_GEPRUEFT B_DMTL_FST_GESTIEGEN B_DMTL_GROBLECK_1 B_DMTL_GROBLECK_2 B_DMTL_GROB_VERMUT B_DMTL_STANDZEIT B_VAN_ANSCHL_OK_A1 B_VAN_ANSCHL_OK_A2 B_VAN_ANSCHL_OK_E1 B_VAN_ANSCHL_OK_E2 Bsd_error_cnt_nv_1of9_ Bsd_error_cnt_nv_2of9_ Bsd_error_cnt_nv_3of9_ Bsd_error_cnt_nv_4of9_ Bsd_error_cnt_nv_5of9_ Bsd_error_cnt_nv_6of9_ Bsd_error_cnt_nv_7of9_ Bsd_error_cnt_nv_8of9_ Bsd_error_cnt_nv_9of9_ Oz_einfahr_int_akt Oz_krzmsg_can_kombi_BC Oz_krzmsg_ctr Oz_krzmsg_st Oz_lgztwert_cbs_reset_st can_st_empf_nv can_standverb can_standverb_anh can_standverb_apu can_standverb_dwa can_standverb_fsh can_standverb_getr can_standverb_licht can_standverb_nmi can_standverb_rw can_standverb_sh can_standverb_skl can_standverb_sl can_standverb_tece can_standverb_tus dmtl_abbr_fein dmtl_abbr_feucht_mil dmtl_abbr_ub dmtl_anz_deckel_leck dmtl_anz_dia_deckel dmtl_anz_dia_fein dmtl_anz_dia_grob dmtl_anz_fahrten dmtl_crb_cid dmtl_crb_grenze dmtl_crb_mess dmtl_flags_nv dmtl_flags_nv2 dmtl_grob_ohne_fein dmtl_i_filt dmtl_i_filt.rest dmtl_i_min dmtl_i_ref dmtl_m6_fein_grenze_nv dmtl_m6_fein_mess_nv dmtl_m6_grob_grenze_nv dmtl_m6_grob_mess_nv dmtl_st_nv dmtl_t_abstell dmtl_t_mess ed_css_st_inj_nv ed_css_st_inj_nv_elup ed_css_st_inj_nv_fplau ed_css_st_inj_nv_hfm ed_css_st_inj_nv_kds ed_css_st_inj_nv_kw ed_css_st_inj_nv_pt_can ed_css_st_inj_nv_sls ed_css_st_inj_nv_ti ed_css_st_inj_nv_van ed_fsp_del_km_stand_nv ed_rbm_css_denominator_nv ed_rbm_css_numerator_nv ed_rbm_general_dcy_nv ed_rbm_ignition_count_nv ed_wuc_counter_nv eeprom_anzahl_schreiben_nv eeprom_crc_nv eeprom_crc_wichtig_nv eeprom_date_1of9_ eeprom_date_2of9_ eeprom_date_3of9_ eeprom_date_4of9_ eeprom_date_5of9_ eeprom_date_6of9_ eeprom_date_7of9_ eeprom_date_8of9_ eeprom_date_9of9_ eeprom_datenlaenge_nv eeprom_datenlaenge_wichtig_nv eeprom_time_1of6_ eeprom_time_2of6_ eeprom_time_3of6_ eeprom_time_4of6_ eeprom_time_5of6_ eeprom_time_6of6_ eeprom_version_prog_nv elu_typ_nv fst_max_nv fst_min_nv fst_rechts fst_rechts.rest fst_verbr_nv hdw_1_nv hdw_2_nv hdw_3_nv hdw_z1_nv kat_obd_wert_max_nv_b1 kat_obd_wert_max_nv_b2 kats_mdl_t_nv_1of2_ kats_mdl_t_nv_2of2_ kats_nkat_t_nv_1of2_ kats_nkat_t_nv_2of2_ kats_vkat_t_nv_1of2_ kats_vkat_t_nv_2of2_ kge_ml_intg_min_nv_1of2_ kge_ml_intg_min_nv_2of2_ kge_ml_mw_intg_min_nv_1of2_ kge_ml_mw_intg_min_nv_2of2_ ksd_obd_ll_max_nv_b1 ksd_obd_ll_max_nv_b2 ksd_obd_ll_min_nv_b1 ksd_obd_ll_min_nv_b2 ksd_obd_oel_sperr_nv ksd_obd_tl_max_nv_b1 ksd_obd_tl_max_nv_b2 ksd_obd_tl_min_nv_b1 ksd_obd_tl_min_nv_b2 kwp_ps_teststamp_1of3_ kwp_ps_teststamp_2of3_ kwp_ps_teststamp_3of3_ la_trim_i_ad_nv_b1 la_trim_i_ad_nv_b2 laa_offs_nv_b1 laa_offs_nv_b2 lam_reg_ff_egas_ist_dk_1of2_ lam_reg_ff_egas_ist_dk_2of2_ lam_reg_ff_egas_ist_lls_1of2_ lam_reg_ff_egas_ist_lls_2of2_ lam_reg_ff_egas_soll_dk_1of2_ lam_reg_ff_egas_soll_dk_2of2_ lam_reg_ff_egas_soll_lls_1of2_ lam_reg_ff_egas_soll_lls_2of2_ lam_reg_ff_fr_reg_out_1of2_ lam_reg_ff_fr_reg_out_2of2_ lam_reg_ff_hfm_ml_5ms_1of2_ lam_reg_ff_hfm_ml_5ms_2of2_ lam_reg_ff_kats_st_1of2_ lam_reg_ff_kats_st_2of2_ lam_reg_ff_kh_st lam_reg_ff_laa_f_b1 lam_reg_ff_laa_f_b2 lam_reg_ff_laa_f_ber_b1 lam_reg_ff_laa_f_ber_b2 lam_reg_ff_laa_offs_b1 lam_reg_ff_laa_offs_b2 lam_reg_ff_lam_ist_mw_b1 lam_reg_ff_lam_ist_mw_b2 lam_reg_ff_lam_reg_f_b1 lam_reg_ff_lam_reg_f_b2 lam_reg_ff_lam_soll_b1 lam_reg_ff_lam_soll_b2 lam_reg_ff_ml_b1 lam_reg_ff_ml_b2 lam_reg_ff_ml_hfm_b1 lam_reg_ff_ml_hfm_b2 lam_reg_ff_n lam_reg_ff_pks_rel lam_reg_ff_pumg lam_reg_ff_rf_b1 lam_reg_ff_rf_b2 lam_reg_ff_tan_mw lam_reg_ff_te_c_akf lam_reg_ff_te_tv_b1 lam_reg_ff_te_tv_b2 lam_reg_ff_tmot lam_reg_ff_ub lam_reg_ff_v_vorne lam_reg_ff_zustand_motor lank_obd_s_sa_t_nv_b1 lank_obd_s_sa_t_nv_b2 lank_obd_s_us_max_nv_b1 lank_obd_s_us_max_nv_b2 lank_obd_s_us_min_nv_b1 lank_obd_s_us_min_nv_b2 lank_obd_slope_t_max_nv_b1 lank_obd_slope_t_max_nv_b2 lank_obd_slope_t_min_nv_b1 lank_obd_slope_t_min_nv_b2 lank_obd_slope_t_mw_mode_nv_b1 lank_obd_slope_t_mw_mode_nv_b2 lavk_ad_gain_b1 lavk_ad_gain_b2 lavk_ad_offs_b1 lavk_ad_offs_b2 lavk_obd_dyn_wert_gesamt_nv lavk_obd_dyn_wert_min_nv_b1 lavk_obd_dyn_wert_min_nv_b2 lavk_obd_dyn_wert_nv_b1 lavk_obd_dyn_wert_nv_b2 lshnk_diag_r_gmw_nv_b1 lshnk_diag_r_gmw_nv_b2 lshvk_diag_aktiv_b1 lshvk_diag_aktiv_b2 lshvk_diag_info_b1 lshvk_diag_info_b2 lshvk_diag_r_adapt_b1 lshvk_diag_r_adapt_b2 lshvk_diag_r_adaption_b1 lshvk_diag_r_adaption_b2 lshvk_diag_r_gmw_nv_b1 lshvk_diag_r_gmw_nv_b2 lshvk_diag_sh_to_x_sperren_b1 lshvk_diag_sh_to_x_sperren_b2 lshvk_diag_st_nv_b1 lshvk_diag_st_nv_b2 lshvk_r_ad_gain_b1 lshvk_r_ad_gain_b2 lshvk_r_ad_offs_b1 lshvk_r_ad_offs_b2 mdrv_p400_only_nv mdrv_p500_start_nv mdrv_st_dsc_key0 mdrv_st_dsc_key1 mdrv_st_dsc_key2 mdrv_st_dsc_key3 mdrv_st_dsc_key4 mdrv_st_dsc_key5 mdrv_st_dsc_key6 mdrv_st_dsc_key7 mdrv_st_dsc_key8 mdrv_st_dsc_key9 mdrv_st_mod_albv_key0 mdrv_st_mod_albv_key1 mdrv_st_mod_albv_key2 mdrv_st_mod_albv_key3 mdrv_st_mod_albv_key4 mdrv_st_mod_albv_key5 mdrv_st_mod_albv_key6 mdrv_st_mod_albv_key7 mdrv_st_mod_albv_key8 mdrv_st_mod_albv_key9 mdrv_st_mod_edck_key0 mdrv_st_mod_edck_key1 mdrv_st_mod_edck_key2 mdrv_st_mod_edck_key3 mdrv_st_mod_edck_key4 mdrv_st_mod_edck_key5 mdrv_st_mod_edck_key6 mdrv_st_mod_edck_key7 mdrv_st_mod_edck_key8 mdrv_st_mod_edck_key9 mdrv_st_mod_eng_key0 mdrv_st_mod_eng_key1 mdrv_st_mod_eng_key2 mdrv_st_mod_eng_key3 mdrv_st_mod_eng_key4 mdrv_st_mod_eng_key5 mdrv_st_mod_eng_key6 mdrv_st_mod_eng_key7 mdrv_st_mod_eng_key8 mdrv_st_mod_eng_key9 mdrv_st_mod_hud_key0 mdrv_st_mod_hud_key1 mdrv_st_mod_hud_key2 mdrv_st_mod_hud_key3 mdrv_st_mod_hud_key4 mdrv_st_mod_hud_key5 mdrv_st_mod_hud_key6 mdrv_st_mod_hud_key7 mdrv_st_mod_hud_key8 mdrv_st_mod_hud_key9 mdrv_st_mod_smg_key0 mdrv_st_mod_smg_key1 mdrv_st_mod_smg_key2 mdrv_st_mod_smg_key3 mdrv_st_mod_smg_key4 mdrv_st_mod_smg_key5 mdrv_st_mod_smg_key6 mdrv_st_mod_smg_key7 mdrv_st_mod_smg_key8 mdrv_st_mod_smg_key9 mdrv_st_stg_smg_key0 mdrv_st_stg_smg_key1 mdrv_st_stg_smg_key2 mdrv_st_stg_smg_key3 mdrv_st_stg_smg_key4 mdrv_st_stg_smg_key5 mdrv_st_stg_smg_key6 mdrv_st_stg_smg_key7 mdrv_st_stg_smg_key8 mdrv_st_stg_smg_key9 n_max_ff_anzahl n_max_ff_gang n_max_ff_km_stand n_max_ff_md_fahrer n_max_ff_md_ist n_max_ff_md_wunsch n_max_ff_ml n_max_ff_n_getriebe n_max_ff_n_grad n_max_ff_n_vanos n_max_ff_nbegr_egas n_max_ff_nbegr_ti n_max_ff_nmax n_max_ff_pwg n_max_ff_schalter_inj n_max_ff_smg_st n_max_ff_t_nbegr_egas n_max_ff_tmot n_max_ff_toel n_max_ff_tsum_egas n_max_ff_tsum_ti n_max_ff_v_hinten n_max_ff_zustand_motor nw_fehlerzaehler_nv pks_obd_abw pksr_adap_fak_nv pksr_adap_off_roh_nv pksr_st_nv psau_adapt_nv_b1 psau_adapt_nv_b2 pumg_obd_abstell_nv pumg_obd_st_nv pumg_obd_start_nv slp_t_aus_nv slp_time_on_nv sls_obdh_lam_intg_norm_maxph_nv sls_obdh_lam_intg_norm_minph_nv sls_obdh_lam_intg_norm_nv sls_obdh_mdf_max_intg_norm_nv sls_obdh_mdf_max_intg_norm_ph_nv sls_obdh_mdf_min_intg_norm_nv sls_obdh_mdf_min_intg_norm_ph_nv stat_data_nrf_nv_1of7_1of8_ stat_data_nrf_nv_1of7_2of8_ stat_data_nrf_nv_1of7_3of8_ stat_data_nrf_nv_1of7_4of8_ stat_data_nrf_nv_1of7_5of8_ stat_data_nrf_nv_1of7_6of8_ stat_data_nrf_nv_1of7_7of8_ stat_data_nrf_nv_1of7_8of8_ stat_data_nrf_nv_2of7_1of8_ stat_data_nrf_nv_2of7_2of8_ stat_data_nrf_nv_2of7_3of8_ stat_data_nrf_nv_2of7_4of8_ stat_data_nrf_nv_2of7_5of8_ stat_data_nrf_nv_2of7_6of8_ stat_data_nrf_nv_2of7_7of8_ stat_data_nrf_nv_2of7_8of8_ stat_data_nrf_nv_3of7_1of8_ stat_data_nrf_nv_3of7_2of8_ stat_data_nrf_nv_3of7_3of8_ stat_data_nrf_nv_3of7_4of8_ stat_data_nrf_nv_3of7_5of8_ stat_data_nrf_nv_3of7_6of8_ stat_data_nrf_nv_3of7_7of8_ stat_data_nrf_nv_3of7_8of8_ stat_data_nrf_nv_4of7_1of8_ stat_data_nrf_nv_4of7_2of8_ stat_data_nrf_nv_4of7_3of8_ stat_data_nrf_nv_4of7_4of8_ stat_data_nrf_nv_4of7_5of8_ stat_data_nrf_nv_4of7_6of8_ stat_data_nrf_nv_4of7_7of8_ stat_data_nrf_nv_4of7_8of8_ stat_data_nrf_nv_5of7_1of8_ stat_data_nrf_nv_5of7_2of8_ stat_data_nrf_nv_5of7_3of8_ stat_data_nrf_nv_5of7_4of8_ stat_data_nrf_nv_5of7_5of8_ stat_data_nrf_nv_5of7_6of8_ stat_data_nrf_nv_5of7_7of8_ stat_data_nrf_nv_5of7_8of8_ stat_data_nrf_nv_6of7_1of8_ stat_data_nrf_nv_6of7_2of8_ stat_data_nrf_nv_6of7_3of8_ stat_data_nrf_nv_6of7_4of8_ stat_data_nrf_nv_6of7_5of8_ stat_data_nrf_nv_6of7_6of8_ stat_data_nrf_nv_6of7_7of8_ stat_data_nrf_nv_6of7_8of8_ stat_data_nrf_nv_7of7_1of8_ stat_data_nrf_nv_7of7_2of8_ stat_data_nrf_nv_7of7_3of8_ stat_data_nrf_nv_7of7_4of8_ stat_data_nrf_nv_7of7_5of8_ stat_data_nrf_nv_7of7_6of8_ stat_data_nrf_nv_7of7_7of8_ stat_data_nrf_nv_7of7_8of8_ stat_data_tdme_nv_1of8_ stat_data_tdme_nv_2of8_ stat_data_tdme_nv_3of8_ stat_data_tdme_nv_4of8_ stat_data_tdme_nv_5of8_ stat_data_tdme_nv_6of8_ stat_data_tdme_nv_7of8_ stat_data_tdme_nv_8of8_ stat_data_tmot_nv_1of8_ stat_data_tmot_nv_2of8_ stat_data_tmot_nv_3of8_ stat_data_tmot_nv_4of8_ stat_data_tmot_nv_5of8_ stat_data_tmot_nv_6of8_ stat_data_tmot_nv_7of8_ stat_data_tmot_nv_8of8_ stat_data_toel_nv_1of8_ stat_data_toel_nv_2of8_ stat_data_toel_nv_3of8_ stat_data_toel_nv_4of8_ stat_data_toel_nv_5of8_ stat_data_toel_nv_6of8_ stat_data_toel_nv_7of8_ stat_data_toel_nv_8of8_ t_mot_steht_1s_nv tanzyl_mr_off_nv tanzyl_off_nv te_obd_crb_cid_b1 te_obd_crb_cid_b2 te_obd_crb_grenze_b1 te_obd_crb_grenze_b2 te_obd_crb_mess_b1 te_obd_crb_mess_b2 te_obd_m6_auss_mess_nv te_obd_m6_lam_mess_nv te_obd_m6_ll_mess_nv ti_mks_ns_ist_abstell_b1 ti_mks_ns_ist_abstell_b2 time_abs_old time_bz_nv tksm_mr_off_nv tksm_off_nv tpu_kw_n_drop_ff.cnt tpu_kw_n_drop_ff.event_time tpu_kw_n_drop_ff.irq tpu_kw_n_drop_ff.last_period tpu_kw_n_drop_ff.n tpu_kw_n_drop_ff.n_zahn tpu_kw_n_drop_ff.prev_period tpu_kw_n_drop_ff.state tpu_kw_n_drop_ff.tooth tpu_kw_n_drop_ff.tooth_time v_max_anh_cnt_nv v_max_ff_anh_st v_max_ff_gang v_max_ff_km_stand v_max_ff_md_fahrer v_max_ff_md_ist v_max_ff_n v_max_ff_v_direkt v_max_ff_v_hinten v_max_ff_v_max v_max_ff_v_max_schw v_max_ff_v_max_st van_guete_A1 van_guete_A2 van_guete_E1 van_guete_E2 van_guete_min_nv_A1 van_guete_min_nv_A2 van_guete_min_nv_E1 van_guete_min_nv_E2 van_ist_anschl_A1 van_ist_anschl_A2 van_ist_anschl_E1 van_ist_anschl_E2 van_st_anschl wf_ist_zyl1 wf_ist_zyl10 wf_ist_zyl2 wf_ist_zyl3 wf_ist_zyl4 wf_ist_zyl5 wf_ist_zyl6 wf_ist_zyl7 wf_ist_zyl8 wf_ist_zyl9 zgla_f_1of2_1of5_ zgla_f_1of2_2of5_ zgla_f_1of2_3of5_ zgla_f_1of2_4of5_ zgla_f_1of2_5of5_ zgla_f_2of2_1of5_ zgla_f_2of2_2of5_ zgla_f_2of2_3of5_ zgla_f_2of2_4of5_ zgla_f_2of2_5of5_ /end OUT_MEASUREMENT
/end FUNCTION
/begin FUNCTION Ascet_interf ""
 /begin DEF_CHARACTERISTIC KF_OZ_TEMP_KOR KF_SCHNELLMSG_OZNIVR_MIN KL_GEN_AUSL_BEGR KL_OELLEVEL_KOMBI KL_OZ_LGMW_OFFSET KL_OZ_LL_L_OFFSET KL_OZ_LL_Q_OFFSET K_GEN_BSD_ERROR_CC_CNT K_GEN_BSD_VARIANTE K_GEN_SLP_UG K_OELSTAND_CAN_PST_LINEAR K_OZLBESCHS K_OZLBESCH_STAND_CC K_OZORLIM2 K_OZQBESCHS K_OZQBESCH_STAND_CC K_OZ_1L_BEGR_O K_OZ_1L_BEGR_U K_OZ_1_5_L_BEGR K_OZ_AG_MESSSTAB_MIN_OK K_OZ_AG_MESSSTAB_OK K_OZ_AG_MESSSTAB_OK_MAX K_OZ_ALT_HYST_F K_OZ_ALT_HYST_U K_OZ_ALT_NACHF K_OZ_CC_OELVERBRAUCH K_OZ_CC_OELVERLUST K_OZ_KRZ_HYST K_OZ_KRZ_HYST_CBS K_OZ_KRZ_MESSUNG_LL K_OZ_LZW_AEND_BEGR K_OZ_MIN_LEVEL_VOL K_OZ_NIV_KM_MAX K_OZ_N_OELMAXKORR_O K_OZ_N_OELMAXKORR_U K_OZ_OELVERLUST_FSP K_OZ_PM_CC_CBS_MSG_TEST K_OZ_TEMPBW_KOPF K_OZ_TEMPBW_SUMPF K_OZ_TEMP_75 K_OZ_TEMP_KOR K_SCHNELLMSG_ANZAHL_WERTE K_SCHNELLMSG_KL15_AUSBLEND K_SCHNELLMSG_KL15_MAX K_SCHNELLMSG_N_MAX K_SCHNELLMSG_OZLBESCHS K_SCHNELLMSG_OZQBESCHS K_SCHNELLMSG_TOEL_MIN K_SCHNELLMSG_T_MS K_SCHNELLMSG_V_MAX K_TIME_SET_1 K_TIME_SET_2 K_TIME_SET_3 /end DEF_CHARACTERISTIC
 /begin REF_CHARACTERISTIC /end REF_CHARACTERISTIC
 /begin IN_MEASUREMENT /end IN_MEASUREMENT
 /begin OUT_MEASUREMENT Acfzgl Acfzgq B_ckl30 B_ckl50 B_etumg B_fabttreg B_fahisrst B_fapmmess B_fs B_gen_bsd_error_CC B_genslp B_kl15 B_kl15_ep B_kwdreht B_ll B_ll_niv_krz B_ll_niv_krz_alt B_llrein B_oz_oelcheck_CC B_oz_oelverbr_CC B_oz_oelverlust_CC B_ozlangmw_kl15_st B_pmsv_st B_pwf B_schnellmsg_bed B_schnellmsg_fertig B_schnellmsg_oel_ok B_sta B_start B_startende B_taerr B_taners B_tumers B_vl Batt_class Bordnetz Bosbtvfbkt Bosfxid2r Bosid2r Bosjzielr Bosjzielt Bosmzielr Bosmzielt Bosprog2r Bosrlsmr Bosrw2r Bosrw2t Bosv Dfgrob Fahrzeug Id_bosrst Id_bosrtt Id_bosrtw Ikurz_ogr Ikurz_ugr Iwakeupgr Km_st Kvaverbr L_pwmout Mslui Nsllm Oz_anz_kombi_AG_code Oz_anzeige_kombi Oz_anzeige_kombi_alt Oz_datstat Oz_krzmwkor_n_kor Oz_krzmwkor_temp_kor Oz_langmw_offset Oz_lf1c Oz_lf2c Oz_n_gesamtzeit Oz_n_messzeit Oz_niv_km_update Oz_offset_ll_l Oz_offset_ll_q Oz_verbleib_verh Pmsv_10of15_ Pmsv_11of15_ Pmsv_12of15_ Pmsv_13of15_ Pmsv_14of15_ Pmsv_15of15_ Pmsv_1of15_ Pmsv_2of15_ Pmsv_3of15_ Pmsv_4of15_ Pmsv_5of15_ Pmsv_6of15_ Pmsv_7of15_ Pmsv_8of15_ Pmsv_9of15_ St_schnellmsg_check T_jahr T_monate Tchip U_gen_slp Zrbosr Zrbosrt Ztageabs can_ay_10s_mw can_ay_10s_mw_sum can_fllv_eoi can_recm_rflv_eoi can_st_fllv_eoi cnt_mw_ax_ay gen_bsd_error_cnt gen_n_elu smg_ax_10s_mw smg_ax_10s_mw_sum time_set_1 time_set_2 time_set_3 time_stamp_kl15_on /end OUT_MEASUREMENT
/end FUNCTION
/begin FUNCTION Aussetzererkennung ""
 /begin DEF_CHARACTERISTIC K_AG_TI_ANZ K_AG_TI_CFG K_AG_TI_PAUSE K_AG_TI_V_MIN K_AG_TI_ZYL /end DEF_CHARACTERISTIC
 /begin REF_CHARACTERISTIC /end REF_CHARACTERISTIC
 /begin IN_MEASUREMENT /end IN_MEASUREMENT
 /begin OUT_MEASUREMENT ag_ti_anz ag_ti_anz_ctrl ag_ti_cfg_ctrl ag_ti_exd_state ag_ti_mask ag_ti_mask_zyl1 ag_ti_mask_zyl10 ag_ti_mask_zyl2 ag_ti_mask_zyl3 ag_ti_mask_zyl4 ag_ti_mask_zyl5 ag_ti_mask_zyl6 ag_ti_mask_zyl7 ag_ti_mask_zyl8 ag_ti_mask_zyl9 ag_ti_pause ag_ti_pause_ctrl ag_ti_zyl ag_ti_zyl_ctrl /end OUT_MEASUREMENT
/end FUNCTION
/begin RECORD_LAYOUT TKW_VV_VV_UB FNC_VALUES 1 UBYTE COLUMN_DIR DIRECT /end RECORD_LAYOUT
/begin RECORD_LAYOUT TKW_VV_VV_SB FNC_VALUES 1 SBYTE COLUMN_DIR DIRECT /end RECORD_LAYOUT
/begin RECORD_LAYOUT TKW_VV_VV_UW FNC_VALUES 1 UWORD COLUMN_DIR DIRECT /end RECORD_LAYOUT
/begin RECORD_LAYOUT TKW_VV_VV_SW FNC_VALUES 1 SWORD COLUMN_DIR DIRECT /end RECORD_LAYOUT
/begin RECORD_LAYOUT TKW_VV_VV_UL FNC_VALUES 1 ULONG COLUMN_DIR DIRECT /end RECORD_LAYOUT
/begin RECORD_LAYOUT TKL_UB_VV_UB NO_AXIS_PTS_X 1 UBYTE RESERVED 2 BYTE AXIS_PTS_X 3 UBYTE INDEX_INCR DIRECT FNC_VALUES 4 UBYTE COLUMN_DIR DIRECT /end RECORD_LAYOUT
/begin RECORD_LAYOUT TKL_SW_VV_UB NO_AXIS_PTS_X 1 UBYTE RESERVED 2 BYTE AXIS_PTS_X 3 SWORD INDEX_INCR DIRECT FNC_VALUES 4 UBYTE COLUMN_DIR DIRECT /end RECORD_LAYOUT
/begin RECORD_LAYOUT TKL_SW_VV_SB NO_AXIS_PTS_X 1 UBYTE RESERVED 2 BYTE AXIS_PTS_X 3 SWORD INDEX_INCR DIRECT FNC_VALUES 4 SBYTE COLUMN_DIR DIRECT /end RECORD_LAYOUT
/begin RECORD_LAYOUT TKF_SW_SW_UW NO_AXIS_PTS_X 1 UBYTE NO_AXIS_PTS_Y 2 UBYTE AXIS_PTS_X 3 SWORD INDEX_INCR DIRECT AXIS_PTS_Y 4 SWORD INDEX_INCR DIRECT FNC_VALUES 5 UWORD COLUMN_DIR DIRECT /end RECORD_LAYOUT
/begin RECORD_LAYOUT TKF_SW_SW_SW NO_AXIS_PTS_X 1 UBYTE NO_AXIS_PTS_Y 2 UBYTE AXIS_PTS_X 3 SWORD INDEX_INCR DIRECT AXIS_PTS_Y 4 SWORD INDEX_INCR DIRECT FNC_VALUES 5 SWORD COLUMN_DIR DIRECT /end RECORD_LAYOUT
/end MODULE
/end PROJECT
