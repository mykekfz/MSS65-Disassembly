/begin PROJECT MSS65-inj-V452 "MSS65 INJ - V452.01-B204.00, data set 0569Q60Z160E"
/begin HEADER "" VERSION "V452.01-B204.00" /end HEADER
/begin MODULE _MSS65-inj "MSS65 INJ - V452.01-B204.00, calibration xxxxxxxx"
/begin MOD_COMMON "" BYTE_ORDER MSB_FIRST /* Default byteorder (Motorola) */ /end MOD_COMMON
/* Formel fuer 1:1-Wiedergabe ohne Einheit */
/begin COMPU_METHOD FORMULA_USER1 "FORMULA_USER1" RAT_FUNC "%7.0" "-" COEFFS 0 1 0 0 0 1 /end COMPU_METHOD
/*--------------------------- QADC A + B ------------------------------------------------*/
/begin MEASUREMENT qadca_qasr0 "qadca_qasr0, Statusregister0" UWORD FORMULA_USER1 0 0 0.0000 65535.0000 ECU_ADDRESS 0x304810 /begin FUNCTION_LIST Debugging /end FUNCTION_LIST /end MEASUREMENT
/begin MEASUREMENT qadca_qasr1 "qadca_qasr1, Statusregister1" UWORD FORMULA_USER1 0 0 0.0000 65535.0000 ECU_ADDRESS 0x304812 /begin FUNCTION_LIST Debugging /end FUNCTION_LIST /end MEASUREMENT
/begin MEASUREMENT qadcb_qasr0 "qadcb_qasr0, Statusregister0" UWORD FORMULA_USER1 0 0 0.0000 65535.0000 ECU_ADDRESS 0x304C10 /begin FUNCTION_LIST Debugging /end FUNCTION_LIST /end MEASUREMENT
/begin MEASUREMENT qadcb_qasr1 "qadcb_qasr1, Statusregister1" UWORD FORMULA_USER1 0 0 0.0000 65535.0000 ECU_ADDRESS 0x304C12 /begin FUNCTION_LIST Debugging /end FUNCTION_LIST /end MEASUREMENT
/*--------------------------- CAN A + B ------------------------------------------------*/
/begin MEASUREMENT cana_estat "Error-Status-Register" UWORD FORMULA_USER1 0 0 0.0000 65535.0000 ECU_ADDRESS 0x3070A0 /begin FUNCTION_LIST Debugging /end FUNCTION_LIST /end MEASUREMENT
/begin MEASUREMENT canb_estat "Error-Status-Register" UWORD FORMULA_USER1 0 0 0.0000 65535.0000 ECU_ADDRESS 0x3074A0 /begin FUNCTION_LIST Debugging /end FUNCTION_LIST /end MEASUREMENT
/* ------------------ Abschnitt erzeugt aus adapt_common.dat ------------------ */
/begin COMPU_METHOD FORMULA_0000 "FORMULA_0000" RAT_FUNC "%7.0" "-" COEFFS 0 1 0 0 0 1 /end COMPU_METHOD
/begin COMPU_METHOD FORMULA_0003 "FORMULA_0003" RAT_FUNC "%3.0" "-" COEFFS 0 1 0 0 0 1 /end COMPU_METHOD
/begin COMPU_METHOD FORMULA_0006 "FORMULA_0006" RAT_FUNC "%5.0" "Upm" COEFFS 0 1 0 0 0 1 /end COMPU_METHOD
/begin COMPU_METHOD FORMULA_0008 "FORMULA_0008" RAT_FUNC "%6.1" "V" COEFFS 0 10 0 0 0 1 /end COMPU_METHOD
/begin COMPU_METHOD FORMULA_0010 "FORMULA_0010" RAT_FUNC "%5.0" "-" COEFFS 0 1 0 0 0 1 /end COMPU_METHOD
/begin COMPU_METHOD FORMULA_0017 "FORMULA_0017" RAT_FUNC "%9.2" "ms" COEFFS 0 7000 0 0 0 1 /end COMPU_METHOD
/begin COMPU_METHOD FORMULA_0021 "FORMULA_0021" RAT_FUNC "%7.2" "s" COEFFS 0 100 0 0 0 1 /end COMPU_METHOD
/* ------------------ Abschnitt erzeugt aus adapt_glob.dat ------------------ */
/begin COMPU_METHOD FORMULA_0023 "FORMULA_0023" RAT_FUNC "%6.1" "�C" COEFFS 0 10 2732 0 0 1 /end COMPU_METHOD
/begin COMPU_METHOD FORMULA_0033 "FORMULA_0033" RAT_FUNC "%5.2" "-" COEFFS 0 1 0 0 0 1 /end COMPU_METHOD
/* ------------------ Abschnitt erzeugt aus crc32.dat ------------------ */
/begin COMPU_METHOD FORMULA_0039 "FORMULA_0039" TAB_VERB "%3.0" "-" COMPU_TAB_REF FORMULA_0039_VTAB /end COMPU_METHOD
/begin COMPU_VTAB FORMULA_0039_VTAB "FORMULA_0039_VTAB" TAB_VERB 4 0 "CRC iO" 1 "Daten falsch" 2 "Prog falsch" 4 "Booter falsch" DEFAULT_VALUE "Mehrfachfehler" /end COMPU_VTAB
/begin COMPU_METHOD FORMULA_0040 "FORMULA_0040" TAB_VERB "%3.0" "-" COMPU_TAB_REF FORMULA_0040_VTAB /end COMPU_METHOD
/begin COMPU_VTAB FORMULA_0040_VTAB "FORMULA_0040_VTAB" TAB_VERB 4 0 "Inaktiv" 1 "Start" 2 "Aktiv" 3 "Ende" DEFAULT_VALUE "undef" /end COMPU_VTAB
/* ------------------ Abschnitt erzeugt aus debug.dat ------------------ */
/begin COMPU_METHOD FORMULA_0041 "FORMULA_0041" RAT_FUNC "%9.2" "-" COEFFS 0 1 0 0 0 1 /end COMPU_METHOD
/begin COMPU_METHOD FORMULA_0049 "FORMULA_0049" TAB_VERB "%7.2" "-" COMPU_TAB_REF FORMULA_0049_VTAB /end COMPU_METHOD
/begin COMPU_VTAB FORMULA_0049_VTAB "FORMULA_0049_VTAB" TAB_VERB 44 0 "O.K." 1 "SH_TO_UB" 2 "SH_TO_GND" 4 "OPENLOAD" 8 "UNPLAUSI" 256 "O.K./ZYKLUS" 512 "FILTER" 513 "FIL/SH_TO_UB" 514 "FIL/SH_TO_GND" 516 "FIL/OPENLOAD" 520 "FIL/UNPLAUSI" 576 "VORHANDEN" 577 "VORH/SH_TO_UB" 578 "VORH/SH_TO_GND" 580 "VORH/OPENLOAD" 584 "VORH/UNPLAUSI" 768 "FILTER/ZYKLUS" 769 "FIL/ZYK/SH_TO_UB" 770 "FIL/ZYK/SH_TO_GND" 772 "FIL/ZYK/OPENLOAD" 776 "FIL/ZYK/UNPLAUSI" 832 "VORHANDEN/ZYKLUS" 833 "VORH/ZYK/SH_TO_UB" 834 "VORH/ZYK/SH_TO_GND" 836 "VORH/ZYK/OPENLOAD" 840 "VORH/ZYK/UNPLAUSI" 2048 "O.K./SCDN" 2304 "O.K./S/ZYKLUS" 2561 "FIL/S/SH_TO_UB" 2562 "FIL/S/SH_TO_GND" 2564 "FIL/S/OPENLOAD" 2568 "FIL/S/UNPLAUSI" 2625 "VORH/S/SH_TO_UB" 2626 "VORH/S/SH_TO_GND" 2628 "VORH/S/OPENLOAD" 2632 "VORH/S/UNPLAUSI" 2817 "FIL/ZYK/S/SH_TO_UB" 2818 "FIL/ZYK/S/SH_TO_GND" 2820 "FIL/ZYK/S/OPENLOAD" 2824 "FIL/ZYK/S/UNPLAUSI" 2881 "VORH/ZYK/S/SH_TO_UB" 2882 "VORH/ZYK/S/SH_TO_GND" 2884 "VORH/ZYK/S/OPENLOAD" 2888 "VORH/ZYK/S/UNPLAUSI" /end COMPU_VTAB
/begin COMPU_METHOD FORMULA_0062 "FORMULA_0062" RAT_FUNC "%5.0" "s" COEFFS 0 1 0 0 0 1 /end COMPU_METHOD
/begin COMPU_METHOD FORMULA_0073 "FORMULA_0073" RAT_FUNC "%6.1" "s" COEFFS 0 10 0 0 0 1 /end COMPU_METHOD
/begin COMPU_METHOD FORMULA_0074 "FORMULA_0074" RAT_FUNC "%7.0" "us" COEFFS 0 1 0 0 0 1 /end COMPU_METHOD
/begin COMPU_METHOD FORMULA_0076 "FORMULA_0076" RAT_FUNC "%6.1" "Kelvin" COEFFS 0 10 0 0 0 1 /end COMPU_METHOD
/begin COMPU_METHOD FORMULA_0077 "FORMULA_0077" RAT_FUNC "%6.1" "mbar" COEFFS 0 16 0 0 0 1 /end COMPU_METHOD
/begin COMPU_METHOD FORMULA_0078 "FORMULA_0078" RAT_FUNC "%6.1" "km/h" COEFFS 0 16 0 0 0 1 /end COMPU_METHOD
/* ------------------ Abschnitt erzeugt aus eeprom.dat ------------------ */
/begin COMPU_METHOD FORMULA_0080 "FORMULA_0080" TAB_VERB "%3.0" "Seite" COMPU_TAB_REF FORMULA_0080_VTAB /end COMPU_METHOD
/begin COMPU_VTAB FORMULA_0080_VTAB "FORMULA_0080_VTAB" TAB_VERB 1 128 "Keine Daten)" /end COMPU_VTAB
/begin COMPU_METHOD FORMULA_0081 "FORMULA_0081" TAB_VERB "%3.0" "Seite" COMPU_TAB_REF FORMULA_0081_VTAB /end COMPU_METHOD
/begin COMPU_VTAB FORMULA_0081_VTAB "FORMULA_0081_VTAB" TAB_VERB 2 64 "Sektoren voll->A" 72 "Sektoren voll->B" /end COMPU_VTAB
/begin COMPU_METHOD FORMULA_0082 "FORMULA_0082" TAB_VERB "%3.0" "-" COMPU_TAB_REF FORMULA_0082_VTAB /end COMPU_METHOD
/begin COMPU_VTAB FORMULA_0082_VTAB "FORMULA_0082_VTAB" TAB_VERB 9 0 "Daten o.k." 1 "CRC Stand falsch" 2 "Andere Erstellung" 4 "Andere Version" 8 "Wichtig groesser" 16 "Wichtig kleiner" 32 "Wichtig CRC falsch" 64 "Wichtig Laenge nio" 128 "keine Daten" /end COMPU_VTAB
/begin COMPU_METHOD FORMULA_0114 "FORMULA_0114" RAT_FUNC "%5.0" "Upm/s" COEFFS 0 1 0 0 0 1 /end COMPU_METHOD
/begin COMPU_METHOD FORMULA_0117 "FORMULA_0117" RAT_FUNC "%7.2" "s" COEFFS 0 200 0 0 0 1 /end COMPU_METHOD
/begin COMPU_METHOD FORMULA_0132 "FORMULA_0132" RAT_FUNC "%7.2" "m/(s*s)" COEFFS 0 40 0 0 0 1 /end COMPU_METHOD
/begin COMPU_METHOD FORMULA_0152 "FORMULA_0152" RAT_FUNC "%9.2" "s" COEFFS 0 100 0 0 0 1 /end COMPU_METHOD
/begin COMPU_METHOD FORMULA_0171 "FORMULA_0171" RAT_FUNC "%3.0" "Upm" COEFFS 0 1 0 0 0 50 /end COMPU_METHOD
/begin COMPU_METHOD FORMULA_0220 "FORMULA_0220" TAB_VERB "%5.2" "-" COMPU_TAB_REF FORMULA_0220_VTAB /end COMPU_METHOD
/begin COMPU_VTAB FORMULA_0220_VTAB "FORMULA_0220_VTAB" TAB_VERB 2 0 "nein" 1 "ja" /end COMPU_VTAB
/begin COMPU_METHOD FORMULA_0222 "FORMULA_0222" TAB_VERB "%5.2" "-" COMPU_TAB_REF FORMULA_0222_VTAB /end COMPU_METHOD
/begin COMPU_VTAB FORMULA_0222_VTAB "FORMULA_0222_VTAB" TAB_VERB 2 0 "nein" 1 "ja" /end COMPU_VTAB
/begin COMPU_METHOD FORMULA_0223 "FORMULA_0223" TAB_VERB "%5.2" "-" COMPU_TAB_REF FORMULA_0223_VTAB /end COMPU_METHOD
/begin COMPU_VTAB FORMULA_0223_VTAB "FORMULA_0223_VTAB" TAB_VERB 2 0 "nein" 1 "ja" /end COMPU_VTAB
/begin COMPU_METHOD FORMULA_0317 "FORMULA_0317" RAT_FUNC "%5.2" "s" COEFFS 0 100 0 0 0 1 /end COMPU_METHOD
/* ------------------ Abschnitt erzeugt aus n.dat ------------------ */
/begin COMPU_METHOD FORMULA_0348 "FORMULA_0348" TAB_VERB "%3.0" "-" COMPU_TAB_REF FORMULA_0348_VTAB /end COMPU_METHOD
/begin COMPU_VTAB FORMULA_0348_VTAB "FORMULA_0348_VTAB" TAB_VERB 6 0 "Initialisierung" 1 "Zahndrehzahl" 3 "noch Zahndrehzahl" 7 "Segmentdrehzahl" 16 "Stoerung" 17 "Stoerung" DEFAULT_VALUE "Eingefroren" /end COMPU_VTAB
/begin COMPU_METHOD FORMULA_0349 "FORMULA_0349" RAT_FUNC "%7.2" "ms" COEFFS 0 625 0 0 0 1 /end COMPU_METHOD
/* ------------------ Abschnitt erzeugt aus os.dat ------------------ */
/begin COMPU_METHOD FORMULA_0350 "FORMULA_0350" TAB_VERB "%3.0" "-" COMPU_TAB_REF FORMULA_0350_VTAB /end COMPU_METHOD
/begin COMPU_VTAB FORMULA_0350_VTAB "FORMULA_0350_VTAB" TAB_VERB 11 0 "Ok" 1 "Sync1" 2 "Sync2" 3 "SyncMS" 4 "1ms-Task" 5 "5ms-Task" 6 "10ms-Task" 7 "100ms-Task" 8 "1s-Task" 9 "Bgnd-Task" 10 "undef" /end COMPU_VTAB
/begin COMPU_METHOD FORMULA_0351 "FORMULA_0351" TAB_VERB "%3.0" "-" COMPU_TAB_REF FORMULA_0351_VTAB /end COMPU_METHOD
/begin COMPU_VTAB FORMULA_0351_VTAB "FORMULA_0351_VTAB" TAB_VERB 13 0 "Ok" 1 "Access" 2 "Level" 3 "ID" 4 "Limit" 5 "NoFnc" 6 "Resource" 7 "State" 8 "Value" 9 "TT missing" 10 "TT active" 11 "Overrun" 14 "Stack" /end COMPU_VTAB
/* ------------------ Abschnitt erzeugt aus dqlt.dat ------------------ */
/begin COMPU_METHOD FORMULA_0418 "FORMULA_0418" TAB_VERB "%5.2" "-" COMPU_TAB_REF FORMULA_0418_VTAB /end COMPU_METHOD
/begin COMPU_VTAB FORMULA_0418_VTAB "FORMULA_0418_VTAB" TAB_VERB 2 0 "FALSE" 1 "TRUE" DEFAULT_VALUE "TRUE" /end COMPU_VTAB
/begin COMPU_METHOD FORMULA_0419 "FORMULA_0419" TAB_VERB "%5.2" "-" COMPU_TAB_REF FORMULA_0419_VTAB /end COMPU_METHOD
/begin COMPU_VTAB FORMULA_0419_VTAB "FORMULA_0419_VTAB" TAB_VERB 2 0 "FALSE" 1 "TRUE" DEFAULT_VALUE "TRUE" /end COMPU_VTAB
/begin COMPU_METHOD FORMULA_0420 "FORMULA_0420" TAB_VERB "%5.2" "-" COMPU_TAB_REF FORMULA_0420_VTAB /end COMPU_METHOD
/begin COMPU_VTAB FORMULA_0420_VTAB "FORMULA_0420_VTAB" TAB_VERB 2 0 "FALSE" 1 "TRUE" DEFAULT_VALUE "TRUE" /end COMPU_VTAB
/begin COMPU_METHOD FORMULA_0421 "FORMULA_0421" TAB_VERB "%5.2" "-" COMPU_TAB_REF FORMULA_0421_VTAB /end COMPU_METHOD
/begin COMPU_VTAB FORMULA_0421_VTAB "FORMULA_0421_VTAB" TAB_VERB 2 0 "FALSE" 1 "TRUE" DEFAULT_VALUE "TRUE" /end COMPU_VTAB
/begin COMPU_METHOD FORMULA_0422 "FORMULA_0422" TAB_VERB "%5.2" "-" COMPU_TAB_REF FORMULA_0422_VTAB /end COMPU_METHOD
/begin COMPU_VTAB FORMULA_0422_VTAB "FORMULA_0422_VTAB" TAB_VERB 2 0 "FALSE" 1 "TRUE" DEFAULT_VALUE "TRUE" /end COMPU_VTAB
/begin COMPU_METHOD FORMULA_0423 "FORMULA_0423" TAB_VERB "%5.2" "-" COMPU_TAB_REF FORMULA_0423_VTAB /end COMPU_METHOD
/begin COMPU_VTAB FORMULA_0423_VTAB "FORMULA_0423_VTAB" TAB_VERB 2 0 "FALSE" 1 "TRUE" DEFAULT_VALUE "TRUE" /end COMPU_VTAB
/begin COMPU_METHOD FORMULA_0424 "FORMULA_0424" TAB_VERB "%5.2" "-" COMPU_TAB_REF FORMULA_0424_VTAB /end COMPU_METHOD
/begin COMPU_VTAB FORMULA_0424_VTAB "FORMULA_0424_VTAB" TAB_VERB 2 0 "FALSE" 1 "TRUE" DEFAULT_VALUE "TRUE" /end COMPU_VTAB
/begin COMPU_METHOD FORMULA_0425 "FORMULA_0425" TAB_VERB "%5.2" "-" COMPU_TAB_REF FORMULA_0425_VTAB /end COMPU_METHOD
/begin COMPU_VTAB FORMULA_0425_VTAB "FORMULA_0425_VTAB" TAB_VERB 2 0 "FALSE" 1 "TRUE" DEFAULT_VALUE "TRUE" /end COMPU_VTAB
/begin COMPU_METHOD FORMULA_0426 "FORMULA_0426" RAT_FUNC "%5.0" "�C" COEFFS 0 10 0 0 0 1 /end COMPU_METHOD
/* ------------------ Abschnitt erzeugt aus dgen.dat ------------------ */
/begin COMPU_METHOD FORMULA_0458 "FORMULA_0458" RAT_FUNC "%4.1" "s" COEFFS 0 10 0 0 0 1 /end COMPU_METHOD
/begin COMPU_METHOD FORMULA_0460 "FORMULA_0460" RAT_FUNC "%6.3" "A" COEFFS 0 8 0 0 0 1 /end COMPU_METHOD
/begin COMPU_METHOD FORMULA_0462 "FORMULA_0462" RAT_FUNC "%8.3" "V" COEFFS 0 10 0 0 0 1 /end COMPU_METHOD
/begin COMPU_METHOD FORMULA_0471 "FORMULA_0471" RAT_FUNC "%5.2" "%" COEFFS 0 256 0 0 0 100 /end COMPU_METHOD
/begin COMPU_METHOD FORMULA_0472 "FORMULA_0472" RAT_FUNC "%5.2" "min" COEFFS 0 1 0 0 0 1 /end COMPU_METHOD
/* ------------------ Abschnitt erzeugt aus dibs.dat ------------------ */
/begin COMPU_METHOD FORMULA_0483 "FORMULA_0483" RAT_FUNC "%4.1" "-" COEFFS 0 1 0 0 0 1 /end COMPU_METHOD
/begin COMPU_METHOD FORMULA_0494 "FORMULA_0494" RAT_FUNC "%8.3" "Ah" COEFFS 0 989 0 0 0 18 /end COMPU_METHOD
/begin COMPU_METHOD FORMULA_0497 "FORMULA_0497" RAT_FUNC "%8.3" "" COEFFS 0 -4000 24000 0 0 -1 /end COMPU_METHOD
/begin COMPU_METHOD FORMULA_0498 "FORMULA_0498" RAT_FUNC "%5.2" "" COEFFS 0 25 0 0 0 128 /end COMPU_METHOD
/begin COMPU_METHOD FORMULA_0504 "FORMULA_0504" RAT_FUNC "%8.3" "" COEFFS 0 25 5000 0 0 2 /end COMPU_METHOD
/* ------------------ Abschnitt erzeugt aus pmsoccalc.dat ------------------ */
/begin COMPU_METHOD FORMULA_0507 "FORMULA_0507" RAT_FUNC "%8.3" "A" COEFFS 0 50 0 0 0 1 /end COMPU_METHOD
/* ------------------ Abschnitt erzeugt aus pmsocstart.dat ------------------ */
/begin COMPU_METHOD FORMULA_0511 "FORMULA_0511" RAT_FUNC "%8.3" "A" COEFFS 0 1 0 0 0 0.02 /end COMPU_METHOD
/begin COMPU_METHOD FORMULA_0557 "FORMULA_0557" RAT_FUNC "%4.1" "l" COEFFS 0 2 0 0 0 1 /end COMPU_METHOD
/begin COMPU_METHOD FORMULA_0558 "FORMULA_0558" RAT_FUNC "%6.3" "l" COEFFS 0 512 0 0 0 1 /end COMPU_METHOD
/begin COMPU_METHOD FORMULA_0604 "FORMULA_0604" RAT_FUNC "%5.2" "%" COEFFS 0 10 0 0 0 125 /end COMPU_METHOD
/* ------------------ Abschnitt erzeugt aus bsd.dat ------------------ */
/begin COMPU_METHOD FORMULA_0607 "FORMULA_0607" TAB_VERB "%3.0" "-" COMPU_TAB_REF FORMULA_0607_VTAB /end COMPU_METHOD
/begin COMPU_VTAB FORMULA_0607_VTAB "FORMULA_0607_VTAB" TAB_VERB 32 0 "none" 16 "ack" 32 "par" 48 "par+ack" 64 "read" 80 "read+ack" 96 "read+par" 112 "read+par+ack" 128 "send" 144 "send+ack" 160 "send+par" 176 "send+par+ack" 192 "send+read" 208 "send+read+ack" 224 "send+read+par" 240 "send+read+par+ack" 1 "glitch" 17 "ack+glitch" 33 "par+glitch" 49 "par+ack+glitch" 65 "read+glitch" 81 "read+ack+glitch" 97 "read+par+glitch" 113 "read+par+ack+glitch" 129 "send+glitch" 145 "send+ack+glitch" 161 "send+par+glitch" 177 "send+par+ack+glitch" 193 "send+read+glitch" 209 "send+read+ack+glitch" 225 "send+read+par+glitch" 241 "send+read+par+ack+glitch" DEFAULT_VALUE "undefined" /end COMPU_VTAB
/begin COMPU_METHOD FORMULA_0608 "FORMULA_0608" TAB_VERB "%3.0" "-" COMPU_TAB_REF FORMULA_0608_VTAB /end COMPU_METHOD
/begin COMPU_VTAB FORMULA_0608_VTAB "FORMULA_0608_VTAB" TAB_VERB 9 0 "BSD_IDLE" 1 "BSDHTOK" 2 "BSDWRITE" 4 "BSDDO" 8 "BSDBSY" 16 "BSDRXRDY" 32 "BSDTXOK" 64 "BSDDTRQ" 48 "BSDTXIND" /end COMPU_VTAB
/begin COMPU_METHOD FORMULA_0616 "FORMULA_0616" RAT_FUNC "%5.0" "km" COEFFS 0 1 0 0 0 1 /end COMPU_METHOD
/* ------------------ Abschnitt erzeugt aus carbtlgr_inj.dat ------------------ */
/begin COMPU_METHOD FORMULA_0632 "FORMULA_0632" TAB_VERB "%3.0" "-" COMPU_TAB_REF FORMULA_0632_VTAB /end COMPU_METHOD
/begin COMPU_VTAB FORMULA_0632_VTAB "FORMULA_0632_VTAB" TAB_VERB 1 -1 "Kein AIF)" /end COMPU_VTAB
/begin COMPU_METHOD FORMULA_0633 "FORMULA_0633" TAB_VERB "%3.0" "-" COMPU_TAB_REF FORMULA_0633_VTAB /end COMPU_METHOD
/begin COMPU_VTAB FORMULA_0633_VTAB "FORMULA_0633_VTAB" TAB_VERB 2 0 "Kein SCAN-TOOL" 1 "SCAN-TOOL" /end COMPU_VTAB
/* ------------------ Abschnitt erzeugt aus dwf.dat ------------------ */
/begin COMPU_METHOD FORMULA_0659 "FORMULA_0659" TAB_VERB "%3.0" "-" COMPU_TAB_REF FORMULA_0659_VTAB /end COMPU_METHOD
/begin COMPU_VTAB FORMULA_0659_VTAB "FORMULA_0659_VTAB" TAB_VERB 1 0 "Aus" DEFAULT_VALUE "Ein" /end COMPU_VTAB
/begin COMPU_METHOD FORMULA_0660 "FORMULA_0660" TAB_VERB "%3.0" "-" COMPU_TAB_REF FORMULA_0660_VTAB /end COMPU_METHOD
/begin COMPU_VTAB FORMULA_0660_VTAB "FORMULA_0660_VTAB" TAB_VERB 1 0 "Aus" DEFAULT_VALUE "Ein" /end COMPU_VTAB
/begin COMPU_METHOD FORMULA_0661 "FORMULA_0661" TAB_VERB "%3.0" "-" COMPU_TAB_REF FORMULA_0661_VTAB /end COMPU_METHOD
/begin COMPU_VTAB FORMULA_0661_VTAB "FORMULA_0661_VTAB" TAB_VERB 1 0 "Aus" DEFAULT_VALUE "Blinken" /end COMPU_VTAB
/begin COMPU_METHOD FORMULA_0662 "FORMULA_0662" RAT_FUNC "%3.0" "Segmente" COEFFS 0 1 0 0 0 1 /end COMPU_METHOD
/begin COMPU_METHOD FORMULA_0663 "FORMULA_0663" RAT_FUNC "%5.2" "Upm" COEFFS 0 1 0 0 0 50 /end COMPU_METHOD
/begin COMPU_METHOD FORMULA_0664 "FORMULA_0664" RAT_FUNC "%5.2" "s" COEFFS 0 0 2.56 0 1 0 /end COMPU_METHOD
/begin COMPU_METHOD FORMULA_0665 "FORMULA_0665" RAT_FUNC "%6.3" "-" COEFFS 0 256 0 0 0 1 /end COMPU_METHOD
/begin COMPU_METHOD FORMULA_0666 "FORMULA_0666" RAT_FUNC "%5.0" ".Gang" COEFFS 0 1 0 0 0 1 /end COMPU_METHOD
/* ------------------ Abschnitt erzeugt aus ebox_elu.dat ------------------ */
/begin COMPU_METHOD FORMULA_0667 "FORMULA_0667" TAB_VERB "%3.0" "-" COMPU_TAB_REF FORMULA_0667_VTAB /end COMPU_METHOD
/begin COMPU_VTAB FORMULA_0667_VTAB "FORMULA_0667_VTAB" TAB_VERB 3 0 "aus" 1 "an" 2 "Sperre SH_TO_UB" /end COMPU_VTAB
/* ------------------ Abschnitt erzeugt aus egas_diag.dat ------------------ */
/begin COMPU_METHOD FORMULA_0669 "FORMULA_0669" TAB_VERB "%5.2" "-" COMPU_TAB_REF FORMULA_0669_VTAB /end COMPU_METHOD
/begin COMPU_VTAB FORMULA_0669_VTAB "FORMULA_0669_VTAB" TAB_VERB 3 0 "Aus" 1 "Ein" 2 "ohne Abriss" /end COMPU_VTAB
/* ------------------ Abschnitt erzeugt aus elup.dat ------------------ */
/begin COMPU_METHOD FORMULA_0678 "FORMULA_0678" RAT_FUNC "%6.1" "mbar/s" COEFFS 0 16 0 0 0 1 /end COMPU_METHOD
/begin COMPU_METHOD FORMULA_0679 "FORMULA_0679" RAT_FUNC "%5.0" "bar/s" COEFFS 0 16 0 0 0 50 /end COMPU_METHOD
/begin COMPU_METHOD FORMULA_0680 "FORMULA_0680" TAB_VERB "%5.2" "-" COMPU_TAB_REF FORMULA_0680_VTAB /end COMPU_METHOD
/begin COMPU_VTAB FORMULA_0680_VTAB "FORMULA_0680_VTAB" TAB_VERB 2 0 "nicht erfuellt" 1 "erfuellt" DEFAULT_VALUE "undef" /end COMPU_VTAB
/begin COMPU_METHOD FORMULA_0681 "FORMULA_0681" TAB_VERB "%3.0" "-" COMPU_TAB_REF FORMULA_0681_VTAB /end COMPU_METHOD
/begin COMPU_VTAB FORMULA_0681_VTAB "FORMULA_0681_VTAB" TAB_VERB 7 0 "inaktiv" 1 "Bedingungen nicht erfuellt" 5 "aktiv" 6 "beendet" 7 "Abbruch" 8 "beendet niO" 9 "beendet iO" DEFAULT_VALUE "undef" /end COMPU_VTAB
/begin COMPU_METHOD FORMULA_0682 "FORMULA_0682" TAB_VERB "%5.2" "-" COMPU_TAB_REF FORMULA_0682_VTAB /end COMPU_METHOD
/begin COMPU_VTAB FORMULA_0682_VTAB "FORMULA_0682_VTAB" TAB_VERB 2 0 "Funktion AUS" 1 "Funktion AN" DEFAULT_VALUE "undef" /end COMPU_VTAB
/begin COMPU_METHOD FORMULA_0683 "FORMULA_0683" RAT_FUNC "%5.2" "s" COEFFS 0 0 25.6 0 1 0 /end COMPU_METHOD
/* ------------------ Abschnitt erzeugt aus ews.dat ------------------ */
/begin COMPU_METHOD FORMULA_0684 "FORMULA_0684" TAB_VERB "%5.2" "-" COMPU_TAB_REF FORMULA_0684_VTAB /end COMPU_METHOD
/begin COMPU_VTAB FORMULA_0684_VTAB "FORMULA_0684_VTAB" TAB_VERB 21 0 "RESET" 1 "GET_WC_IGN" 2 "WAIT_TEL" 130 "WAIT_TEL_NACHLAUF" 131 "FREI" 132 "WEITERGESCHALTEN" 133 "GESPEICHERT" 134 "NACHLAUF" 6 "WAIT_RESTART" 7 "MANIPULATION" 8 "JUNGFRAU" 9 "WAIT_STARTWERT1" 10 "WAIT_STARTWERT2" 11 "WAIT_SYNC" 12 "SYNC_ENDE" 13 "SYNC_STW_FALSCH" 14 "SYNC_Z1_FEHLER" 15 "SYNC_KEIN_STW" 16 "SYNC_TIMEOUT" 17 "DEFEKT" 18 "WC_DEFEKT" DEFAULT_VALUE "undef" /end COMPU_VTAB
/begin COMPU_METHOD FORMULA_0685 "FORMULA_0685" TAB_VERB "%5.2" "-" COMPU_TAB_REF FORMULA_0685_VTAB /end COMPU_METHOD
/begin COMPU_VTAB FORMULA_0685_VTAB "FORMULA_0685_VTAB" TAB_VERB 3 0 "kein STW" 1 "STW defekt" 2 "STW o.k." /end COMPU_VTAB
/* ------------------ Abschnitt erzeugt aus fst.dat ------------------ */
/begin COMPU_METHOD FORMULA_0713 "FORMULA_0713" RAT_FUNC "%4.1" "ml" COEFFS 0 1 0 0 0 0.256 /end COMPU_METHOD
/begin COMPU_METHOD FORMULA_0714 "FORMULA_0714" TAB_VERB "%5.2" "-" COMPU_TAB_REF FORMULA_0714_VTAB /end COMPU_METHOD
/begin COMPU_VTAB FORMULA_0714_VTAB "FORMULA_0714_VTAB" TAB_VERB 2 0 "nein" 1 "ja" /end COMPU_VTAB
/begin COMPU_METHOD FORMULA_0715 "FORMULA_0715" TAB_VERB "%5.2" "-" COMPU_TAB_REF FORMULA_0715_VTAB /end COMPU_METHOD
/begin COMPU_VTAB FORMULA_0715_VTAB "FORMULA_0715_VTAB" TAB_VERB 2 0 "nein" 1 "ja" /end COMPU_VTAB
/begin COMPU_METHOD FORMULA_0716 "FORMULA_0716" TAB_VERB "%5.2" "-" COMPU_TAB_REF FORMULA_0716_VTAB /end COMPU_METHOD
/begin COMPU_VTAB FORMULA_0716_VTAB "FORMULA_0716_VTAB" TAB_VERB 2 0 "nein" 1 "ja" /end COMPU_VTAB
/begin COMPU_METHOD FORMULA_0717 "FORMULA_0717" TAB_VERB "%5.2" "-" COMPU_TAB_REF FORMULA_0717_VTAB /end COMPU_METHOD
/begin COMPU_VTAB FORMULA_0717_VTAB "FORMULA_0717_VTAB" TAB_VERB 2 0 "FST O.K." 8 "FST unplausibel" DEFAULT_VALUE "CAN Fehler." /end COMPU_VTAB
/begin COMPU_METHOD FORMULA_0718 "FORMULA_0718" RAT_FUNC "%5.2" "s" COEFFS 0 0 256 0 1 0 /end COMPU_METHOD
/begin COMPU_METHOD FORMULA_0731 "FORMULA_0731" RAT_FUNC "%5.2" "mm" COEFFS 0 337 0 0 0 100 /end COMPU_METHOD
/* ------------------ Abschnitt erzeugt aus kt_ibs.dat ------------------ */
/begin COMPU_METHOD FORMULA_0732 "FORMULA_0732" RAT_FUNC "%7.2" "A" COEFFS 0 50 10000 0 0 1 /end COMPU_METHOD
/begin COMPU_METHOD FORMULA_0733 "FORMULA_0733" RAT_FUNC "%5.2" "A" COEFFS 0 50 0 0 0 1 /end COMPU_METHOD
/begin COMPU_METHOD FORMULA_0734 "FORMULA_0734" RAT_FUNC "%5.2" "V" COEFFS 0 -125 750 0 0 -8 /end COMPU_METHOD
/begin COMPU_METHOD FORMULA_0735 "FORMULA_0735" RAT_FUNC "%5.2" "s" COEFFS 0 1 0 0 0 256 /end COMPU_METHOD
/begin COMPU_METHOD FORMULA_0736 "FORMULA_0736" RAT_FUNC "%5.2" "s" COEFFS 0 80 0 0 0 1 /end COMPU_METHOD
/begin COMPU_METHOD FORMULA_0737 "FORMULA_0737" RAT_FUNC "%5.2" "s" COEFFS 0 -1 0.01 0 0 -0.002 /end COMPU_METHOD
/begin COMPU_METHOD FORMULA_0738 "FORMULA_0738" RAT_FUNC "%5.2" "s" COEFFS 0 1 0 0 0 16 /end COMPU_METHOD
/begin COMPU_METHOD FORMULA_0739 "FORMULA_0739" RAT_FUNC "%5.2" "A" COEFFS 0 25 0 0 0 1 /end COMPU_METHOD
/begin COMPU_METHOD FORMULA_0740 "FORMULA_0740" RAT_FUNC "%5.2" "A" COEFFS 0 25 0 0 0 2 /end COMPU_METHOD
/begin COMPU_METHOD FORMULA_0741 "FORMULA_0741" RAT_FUNC "%5.2" "s" COEFFS 0 20 0 0 0 1 /end COMPU_METHOD
/begin COMPU_METHOD FORMULA_0742 "FORMULA_0742" RAT_FUNC "%5.2" "s" COEFFS 0 160 0 0 0 1 /end COMPU_METHOD
/begin COMPU_METHOD FORMULA_0743 "FORMULA_0743" RAT_FUNC "%5.2" "V" COEFFS 0 1 0 0 0 0.0196 /end COMPU_METHOD
/begin COMPU_METHOD FORMULA_0744 "FORMULA_0744" RAT_FUNC "%7.2" "s" COEFFS 0 20 0 0 0 1 /end COMPU_METHOD
/* ------------------ Abschnitt erzeugt aus kt_oz.dat ------------------ */
/begin COMPU_METHOD FORMULA_0745 "FORMULA_0745" RAT_FUNC "%5.0" "-" COEFFS 0 170 0 0 0 1 /end COMPU_METHOD
/* ------------------ Abschnitt erzeugt aus n_max.dat ------------------ */
/begin COMPU_METHOD FORMULA_1009 "FORMULA_1009" TAB_VERB "%7.2" "-" COMPU_TAB_REF FORMULA_1009_VTAB /end COMPU_METHOD
/begin COMPU_VTAB FORMULA_1009_VTAB "FORMULA_1009_VTAB" TAB_VERB 11 1 "Standard" 2 "SK" 4 "Toel kalt" 8 "Toel heiss" 16 "Tmot kalt" 32 "FeTraWe" 64 "Fzg steht" 128 "v-Fehler" 256 "TZ-Schutz" 512 "Extern" 1024 "Tgetr heiss" /end COMPU_VTAB
/begin COMPU_METHOD FORMULA_1010 "FORMULA_1010" TAB_VERB "%5.2" "-" COMPU_TAB_REF FORMULA_1010_VTAB /end COMPU_METHOD
/begin COMPU_VTAB FORMULA_1010_VTAB "FORMULA_1010_VTAB" TAB_VERB 4 0 "inaktiv" 1 "ueber nbegr" 2 "neuer FF" 3 "ueber nbegr und FF" /end COMPU_VTAB
/begin COMPU_METHOD FORMULA_1011 "FORMULA_1011" TAB_VERB "%3.0" "-" COMPU_TAB_REF FORMULA_1011_VTAB /end COMPU_METHOD
/begin COMPU_VTAB FORMULA_1011_VTAB "FORMULA_1011_VTAB" TAB_VERB 2 0 "Speichern" 1 "Reset" DEFAULT_VALUE "undef" /end COMPU_VTAB
/begin COMPU_METHOD FORMULA_1012 "FORMULA_1012" RAT_FUNC "%3.0" "Upm/s" COEFFS 0 1 0 0 0 100 /end COMPU_METHOD
/begin COMPU_METHOD FORMULA_1013 "FORMULA_1013" RAT_FUNC "%7.2" "Upm/s" COEFFS 0 1 0 0 0 10 /end COMPU_METHOD
/* ------------------ Abschnitt erzeugt aus crc32.dat ------------------ */
/begin MEASUREMENT crc32_result "Ergebnis der CRC-Berechnungen" UBYTE FORMULA_0039 0 0 0.0 255.0 ECU_ADDRESS 0x3FBE84 /end MEASUREMENT
/begin MEASUREMENT crc32_data_st "Status CRC-Berechnung" UBYTE FORMULA_0040 0 0 0.0 255.0 ECU_ADDRESS 0x3FBE85 /end MEASUREMENT
/begin MEASUREMENT crc32_prog_st "Status CRC-Berechnung" UBYTE FORMULA_0040 0 0 0.0 255.0 ECU_ADDRESS 0x3FBE86 /end MEASUREMENT
/begin MEASUREMENT crc32_boot_st "Status CRC-Berechnung" UBYTE FORMULA_0040 0 0 0.0 255.0 ECU_ADDRESS 0x3FBE87 /end MEASUREMENT
/begin MEASUREMENT crc32_boot "Booter-CRC" ULONG FORMULA_0000 0 0 0.0 4294967295.0000 ECU_ADDRESS 0x3FBE88 /end MEASUREMENT
/begin MEASUREMENT crc32_prog "Programm-CRC" ULONG FORMULA_0000 0 0 0.0 4294967295.0000 ECU_ADDRESS 0x3FBE8C /end MEASUREMENT
/begin MEASUREMENT crc32_data "Daten-CRC" ULONG FORMULA_0000 0 0 0.0 4294967295.0000 ECU_ADDRESS 0x3FBE90 /end MEASUREMENT
/* ------------------ Abschnitt erzeugt aus debug.dat ------------------ */
/begin CHARACTERISTIC K_DEBUG_READ_ADR "Read Address | EN: Debug read address" VALUE 0x70788 TKW_VV_VV_UL 100.0 FORMULA_0041 0.0 4294967295.0000 FORMAT "%5.2" /end CHARACTERISTIC
/begin CHARACTERISTIC K_DEBUG_WRITE_ADR "Write Address | EN: Debug write address" VALUE 0x7078C TKW_VV_VV_UL 100.0 FORMULA_0041 0.0 4294967295.0000 FORMAT "%5.2" /end CHARACTERISTIC
/begin CHARACTERISTIC K_DEBUG_WRITE_VALUE "Write VALUE | EN: Debug write value" VALUE 0x70790 TKW_VV_VV_UL 100.0 FORMULA_0041 0.0 4294967295.0000 FORMAT "%5.2" /end CHARACTERISTIC
/begin CHARACTERISTIC K_DEBUG_RW_LENGTH "Read/-Write Length | EN: Debug read/write length" VALUE 0x70794 TKW_VV_VV_UB 100.0 FORMULA_0033 0.0 255.0000 /end CHARACTERISTIC
/begin MEASUREMENT hwTaskCtr "Counter" UWORD FORMULA_0010 0 0 0.0 65535.0000 ECU_ADDRESS 0x3FBE94 /end MEASUREMENT
/begin MEASUREMENT syncTaskCtr "Counter" UWORD FORMULA_0010 0 0 0.0 65535.0000 ECU_ADDRESS 0x3FBE96 /end MEASUREMENT
/begin MEASUREMENT r1msTaskCtr "Counter" UWORD FORMULA_0010 0 0 0.0 65535.0000 ECU_ADDRESS 0x3FBE98 /end MEASUREMENT
/begin MEASUREMENT r5msTaskCtr "Counter" UWORD FORMULA_0010 0 0 0.0 65535.0000 ECU_ADDRESS 0x3FBE9A /end MEASUREMENT
/begin MEASUREMENT r10msTaskCtr "Counter" ULONG FORMULA_0000 0 0 0.0 4294967295.0000 ECU_ADDRESS 0x3FBE9C /end MEASUREMENT
/begin MEASUREMENT r100msTaskCtr "Counter" UWORD FORMULA_0010 0 0 0.0 65535.0000 ECU_ADDRESS 0x3FBEA0 /end MEASUREMENT
/begin MEASUREMENT r1sTaskCtr "Counter" UWORD FORMULA_0010 0 0 0.0 65535.0000 ECU_ADDRESS 0x3FBEA2 /end MEASUREMENT
/begin MEASUREMENT bgTaskCtr "Counter" UWORD FORMULA_0010 0 0 0.0 65535.0000 ECU_ADDRESS 0x3FBEA4 /end MEASUREMENT
/begin MEASUREMENT cana_ctBoffDbounce "BusOff-Counter" UBYTE FORMULA_0003 0 0 0.0 255.0000 ECU_ADDRESS 0x3FBEA6 /end MEASUREMENT
/begin MEASUREMENT canb_ctBoffDbounce "BusOff-Counter" UBYTE FORMULA_0003 0 0 0.0 255.0000 ECU_ADDRESS 0x3FBEA7 /end MEASUREMENT
/begin MEASUREMENT debug_rw_result "Result Read/-Write Operation" ULONG FORMULA_0000 0 0 0.0 4294967295.0000 ECU_ADDRESS 0x3FBEA8 /end MEASUREMENT
/* ------------------ Abschnitt erzeugt aus diag_tr_ed.dat ------------------ */
/begin CHARACTERISTIC K_DIAG_TR_UB_MIN "UB-Schwelle ab der die Treiberdiagnose beginnen | EN: UB-Schwelle ab der die Treiberdiagnose beginnen" VALUE 0x7079E TKW_VV_VV_SW 100.0 FORMULA_0008 0.0 28.0000 FORMAT "%4.1" /end CHARACTERISTIC
/begin MEASUREMENT ed_fil_hfm1.filter_nv "Filterwert vor und nach Eintrag" UBYTE FORMULA_0003 0 0 0.0 255.0000 ECU_ADDRESS 0x3F987C /end MEASUREMENT
/begin MEASUREMENT ed_fil_hfm2.filter_nv "Filterwert vor und nach Eintrag" UBYTE FORMULA_0003 0 0 0.0 255.0000 ECU_ADDRESS 0x3F9882 /end MEASUREMENT
/begin MEASUREMENT ed_fil_lank1.filter_nv "Filterwert vor und nach Eintrag" UBYTE FORMULA_0003 0 0 0.0 255.0000 ECU_ADDRESS 0x3F990C /end MEASUREMENT
/begin MEASUREMENT ed_fil_fplau1.filter_nv "Filterwert vor und nach Eintrag" UBYTE FORMULA_0003 0 0 0.0 255.0000 ECU_ADDRESS 0x3F995A /end MEASUREMENT
/begin MEASUREMENT ed_fil_fplau2.filter_nv "Filterwert vor und nach Eintrag" UBYTE FORMULA_0003 0 0 0.0 255.0000 ECU_ADDRESS 0x3F9960 /end MEASUREMENT
/begin MEASUREMENT ed_fil_lank1_obd_s.filter_nv "Filterwert vor und nach Eintrag" UBYTE FORMULA_0003 0 0 0.0 255.0000 ECU_ADDRESS 0x3F996C /end MEASUREMENT
/begin MEASUREMENT ed_fil_appl_data_inj.filter_nv "Filterwert vor und nach Eintrag" UBYTE FORMULA_0003 0 0 0.0 255.0000 ECU_ADDRESS 0x3F99FC /end MEASUREMENT
/begin MEASUREMENT ed_fil_lam1_reg.filter_nv "Filterwert vor und nach Eintrag" UBYTE FORMULA_0003 0 0 0.0 255.0000 ECU_ADDRESS 0x3F9A3E /end MEASUREMENT
/begin MEASUREMENT ed_fil_lam2_reg.filter_nv "Filterwert vor und nach Eintrag" UBYTE FORMULA_0003 0 0 0.0 255.0000 ECU_ADDRESS 0x3F9A44 /end MEASUREMENT
/begin MEASUREMENT ed_fil_ev1.filter_nv "Filterwert vor und nach Eintrag" UBYTE FORMULA_0003 0 0 0.0 255.0000 ECU_ADDRESS 0x3F9A7A /end MEASUREMENT
/begin MEASUREMENT ed_fil_ev2.filter_nv "Filterwert vor und nach Eintrag" UBYTE FORMULA_0003 0 0 0.0 255.0000 ECU_ADDRESS 0x3F9A80 /end MEASUREMENT
/begin MEASUREMENT ed_fil_ev3.filter_nv "Filterwert vor und nach Eintrag" UBYTE FORMULA_0003 0 0 0.0 255.0000 ECU_ADDRESS 0x3F9A86 /end MEASUREMENT
/begin MEASUREMENT ed_fil_ev4.filter_nv "Filterwert vor und nach Eintrag" UBYTE FORMULA_0003 0 0 0.0 255.0000 ECU_ADDRESS 0x3F9A8C /end MEASUREMENT
/begin MEASUREMENT ed_fil_ev5.filter_nv "Filterwert vor und nach Eintrag" UBYTE FORMULA_0003 0 0 0.0 255.0000 ECU_ADDRESS 0x3F9A92 /end MEASUREMENT
/begin MEASUREMENT ed_fil_ev6.filter_nv "Filterwert vor und nach Eintrag" UBYTE FORMULA_0003 0 0 0.0 255.0000 ECU_ADDRESS 0x3F9A98 /end MEASUREMENT
/begin MEASUREMENT ed_fil_ev7.filter_nv "Filterwert vor und nach Eintrag" UBYTE FORMULA_0003 0 0 0.0 255.0000 ECU_ADDRESS 0x3F9A9E /end MEASUREMENT
/begin MEASUREMENT ed_fil_ev8.filter_nv "Filterwert vor und nach Eintrag" UBYTE FORMULA_0003 0 0 0.0 255.0000 ECU_ADDRESS 0x3F9AA4 /end MEASUREMENT
/begin MEASUREMENT ed_fil_ev9.filter_nv "Filterwert vor und nach Eintrag" UBYTE FORMULA_0003 0 0 0.0 255.0000 ECU_ADDRESS 0x3F9AAA /end MEASUREMENT
/begin MEASUREMENT ed_fil_ev10.filter_nv "Filterwert vor und nach Eintrag" UBYTE FORMULA_0003 0 0 0.0 255.0000 ECU_ADDRESS 0x3F9AB0 /end MEASUREMENT
/begin MEASUREMENT ed_fil_dmtl_p.filter_nv "Filterwert vor und nach Eintrag" UBYTE FORMULA_0003 0 0 0.0 255.0000 ECU_ADDRESS 0x3F9AD4 /end MEASUREMENT
/begin MEASUREMENT ed_fil_dmtl_v.filter_nv "Filterwert vor und nach Eintrag" UBYTE FORMULA_0003 0 0 0.0 255.0000 ECU_ADDRESS 0x3F9ADA /end MEASUREMENT
/begin MEASUREMENT ed_fil_dmtl_h.filter_nv "Filterwert vor und nach Eintrag" UBYTE FORMULA_0003 0 0 0.0 255.0000 ECU_ADDRESS 0x3F9AE0 /end MEASUREMENT
/begin MEASUREMENT ed_fil_dmtl_grobleck.filter_nv "Filterwert vor und nach Eintrag" UBYTE FORMULA_0003 0 0 0.0 255.0000 ECU_ADDRESS 0x3F9AE6 /end MEASUREMENT
/begin MEASUREMENT ed_fil_dmtl_feucht.filter_nv "Filterwert vor und nach Eintrag" UBYTE FORMULA_0003 0 0 0.0 255.0000 ECU_ADDRESS 0x3F9AEC /end MEASUREMENT
/begin MEASUREMENT ed_fil_dmtl_deckel.filter_nv "Filterwert vor und nach Eintrag" UBYTE FORMULA_0003 0 0 0.0 255.0000 ECU_ADDRESS 0x3F9AF2 /end MEASUREMENT
/begin MEASUREMENT ed_fil_ekp_pwm.filter_nv "Filterwert vor und nach Eintrag" UBYTE FORMULA_0003 0 0 0.0 255.0000 ECU_ADDRESS 0x3F9B0A /end MEASUREMENT
/begin MEASUREMENT ed_fil_kat_obd1.filter_nv "Filterwert vor und nach Eintrag" UBYTE FORMULA_0003 0 0 0.0 255.0000 ECU_ADDRESS 0x3F9B46 /end MEASUREMENT
/begin MEASUREMENT ed_fil_kat_obd2.filter_nv "Filterwert vor und nach Eintrag" UBYTE FORMULA_0003 0 0 0.0 255.0000 ECU_ADDRESS 0x3F9B4C /end MEASUREMENT
/begin MEASUREMENT ed_fil_fi_gen.filter_nv "Filterwert vor und nach Eintrag" UBYTE FORMULA_0003 0 0 0.0 255.0000 ECU_ADDRESS 0x3F9B58 /end MEASUREMENT
/begin MEASUREMENT ed_fil_fi_bsd.filter_nv "Filterwert vor und nach Eintrag" UBYTE FORMULA_0003 0 0 0.0 255.0000 ECU_ADDRESS 0x3F9B5E /end MEASUREMENT
/begin MEASUREMENT ed_fil_fi_qlt.filter_nv "Filterwert vor und nach Eintrag" UBYTE FORMULA_0003 0 0 0.0 255.0000 ECU_ADDRESS 0x3F9B64 /end MEASUREMENT
/begin MEASUREMENT ed_fil_fi_ibs1.filter_nv "Filterwert vor und nach Eintrag" UBYTE FORMULA_0003 0 0 0.0 255.0000 ECU_ADDRESS 0x3F9B6A /end MEASUREMENT
/begin MEASUREMENT ed_fil_fi_ibs2.filter_nv "Filterwert vor und nach Eintrag" UBYTE FORMULA_0003 0 0 0.0 255.0000 ECU_ADDRESS 0x3F9B70 /end MEASUREMENT
/begin MEASUREMENT ed_fil_fi_ibs3.filter_nv "Filterwert vor und nach Eintrag" UBYTE FORMULA_0003 0 0 0.0 255.0000 ECU_ADDRESS 0x3F9B76 /end MEASUREMENT
/begin MEASUREMENT ed_fil_fi_pmbn.filter_nv "Filterwert vor und nach Eintrag" UBYTE FORMULA_0003 0 0 0.0 255.0000 ECU_ADDRESS 0x3F9B7C /end MEASUREMENT
/begin MEASUREMENT ed_fil_fi_pmbatt.filter_nv "Filterwert vor und nach Eintrag" UBYTE FORMULA_0003 0 0 0.0 255.0000 ECU_ADDRESS 0x3F9B82 /end MEASUREMENT
/begin MEASUREMENT ed_fil_ews_sci.filter_nv "Filterwert vor und nach Eintrag" UBYTE FORMULA_0003 0 0 0.0 255.0000 ECU_ADDRESS 0x3F9BA0 /end MEASUREMENT
/begin MEASUREMENT ed_fil_ews_man.filter_nv "Filterwert vor und nach Eintrag" UBYTE FORMULA_0003 0 0 0.0 255.0000 ECU_ADDRESS 0x3F9BA6 /end MEASUREMENT
/begin MEASUREMENT ed_fil_fi_bsd_0.filter_nv "Filterwert vor und nach Eintrag" UBYTE FORMULA_0003 0 0 0.0 255.0000 ECU_ADDRESS 0x3F9BAC /end MEASUREMENT
/begin MEASUREMENT ed_fil_fi_bsd_6.filter_nv "Filterwert vor und nach Eintrag" UBYTE FORMULA_0003 0 0 0.0 255.0000 ECU_ADDRESS 0x3F9BB2 /end MEASUREMENT
/begin MEASUREMENT ed_fil_fi_bsdglob.filter_nv "Filterwert vor und nach Eintrag" UBYTE FORMULA_0003 0 0 0.0 255.0000 ECU_ADDRESS 0x3F9BB8 /end MEASUREMENT
/begin MEASUREMENT ed_fil_fi_pmruhverl.filter_nv "Filterwert vor und nach Eintrag" UBYTE FORMULA_0003 0 0 0.0 255.0000 ECU_ADDRESS 0x3F9BBE /end MEASUREMENT
/begin MEASUREMENT ed_fil_fi_toens.filter_nv "Filterwert vor und nach Eintrag" UBYTE FORMULA_0003 0 0 0.0 255.0000 ECU_ADDRESS 0x3F9BC4 /end MEASUREMENT
/begin MEASUREMENT ed_fil_ebox_elu.filter_nv "Filterwert vor und nach Eintrag" UBYTE FORMULA_0003 0 0 0.0 255.0000 ECU_ADDRESS 0x3F9BCA /end MEASUREMENT
/begin MEASUREMENT ed_fil_dk1_enltg.filter_nv "Filterwert vor und nach Eintrag" UBYTE FORMULA_0003 0 0 0.0 255.0000 ECU_ADDRESS 0x3F9BD6 /end MEASUREMENT
/begin MEASUREMENT ed_fil_dk2_enltg.filter_nv "Filterwert vor und nach Eintrag" UBYTE FORMULA_0003 0 0 0.0 255.0000 ECU_ADDRESS 0x3F9BDC /end MEASUREMENT
/begin MEASUREMENT ed_fil_e2_inj.filter_nv "Filterwert vor und nach Eintrag" UBYTE FORMULA_0003 0 0 0.0 255.0000 ECU_ADDRESS 0x3F9C00 /end MEASUREMENT
/begin MEASUREMENT ed_fil_kw.filter_nv "Filterwert vor und nach Eintrag" UBYTE FORMULA_0003 0 0 0.0 255.0000 ECU_ADDRESS 0x3F9C06 /end MEASUREMENT
/begin MEASUREMENT ed_fil_la1_adapt.filter_nv "Filterwert vor und nach Eintrag" UBYTE FORMULA_0003 0 0 0.0 255.0000 ECU_ADDRESS 0x3F9C0C /end MEASUREMENT
/begin MEASUREMENT ed_fil_la2_adapt.filter_nv "Filterwert vor und nach Eintrag" UBYTE FORMULA_0003 0 0 0.0 255.0000 ECU_ADDRESS 0x3F9C12 /end MEASUREMENT
/begin MEASUREMENT ed_fil_kge1.filter_nv "Filterwert vor und nach Eintrag" UBYTE FORMULA_0003 0 0 0.0 255.0000 ECU_ADDRESS 0x3F9C18 /end MEASUREMENT
/begin MEASUREMENT ed_fil_kge2.filter_nv "Filterwert vor und nach Eintrag" UBYTE FORMULA_0003 0 0 0.0 255.0000 ECU_ADDRESS 0x3F9C1E /end MEASUREMENT
/begin MEASUREMENT ed_fil_fst.filter_nv "Filterwert vor und nach Eintrag" UBYTE FORMULA_0003 0 0 0.0 255.0000 ECU_ADDRESS 0x3F9C24 /end MEASUREMENT
/begin MEASUREMENT ed_fil_fetrawe.filter_nv "Filterwert vor und nach Eintrag" UBYTE FORMULA_0003 0 0 0.0 255.0000 ECU_ADDRESS 0x3F9C42 /end MEASUREMENT
/begin MEASUREMENT ed_fil_elup.filter_nv "Filterwert vor und nach Eintrag" UBYTE FORMULA_0003 0 0 0.0 255.0000 ECU_ADDRESS 0x3F9C5A /end MEASUREMENT
/begin MEASUREMENT ed_fil_elu.filter_nv "Filterwert vor und nach Eintrag" UBYTE FORMULA_0003 0 0 0.0 255.0000 ECU_ADDRESS 0x3F9C60 /end MEASUREMENT
/begin MEASUREMENT ed_fil_ksd1.filter_nv "Filterwert vor und nach Eintrag" UBYTE FORMULA_0003 0 0 0.0 255.0000 ECU_ADDRESS 0x3F9C6C /end MEASUREMENT
/begin MEASUREMENT ed_fil_ksd2.filter_nv "Filterwert vor und nach Eintrag" UBYTE FORMULA_0003 0 0 0.0 255.0000 ECU_ADDRESS 0x3F9C72 /end MEASUREMENT
/begin MEASUREMENT ed_fil_kats_b1.filter_nv "Filterwert vor und nach Eintrag" UBYTE FORMULA_0003 0 0 0.0 255.0000 ECU_ADDRESS 0x3F9C78 /end MEASUREMENT
/begin MEASUREMENT ed_fil_kats_b2.filter_nv "Filterwert vor und nach Eintrag" UBYTE FORMULA_0003 0 0 0.0 255.0000 ECU_ADDRESS 0x3F9C7E /end MEASUREMENT
/begin MEASUREMENT ed_fil_fst_geber.filter_nv "Filterwert vor und nach Eintrag" UBYTE FORMULA_0003 0 0 0.0 255.0000 ECU_ADDRESS 0x3F9C90 /end MEASUREMENT
/begin MEASUREMENT ed_fil_dmtl_feinleck.filter_nv "Filterwert vor und nach Eintrag" UBYTE FORMULA_0003 0 0 0.0 255.0000 ECU_ADDRESS 0x3F9CA2 /end MEASUREMENT
/begin MEASUREMENT ed_fil_la1_trim_ad.filter_nv "Filterwert vor und nach Eintrag" UBYTE FORMULA_0003 0 0 0.0 255.0000 ECU_ADDRESS 0x3F9CB4 /end MEASUREMENT
/begin MEASUREMENT ed_fil_la2_trim_ad.filter_nv "Filterwert vor und nach Eintrag" UBYTE FORMULA_0003 0 0 0.0 255.0000 ECU_ADDRESS 0x3F9CBA /end MEASUREMENT
/begin MEASUREMENT ed_fil_fst_geber_li.filter_nv "Filterwert vor und nach Eintrag" UBYTE FORMULA_0003 0 0 0.0 255.0000 ECU_ADDRESS 0x3F9D0E /end MEASUREMENT
/begin MEASUREMENT ed_fil_fst_geber_re.filter_nv "Filterwert vor und nach Eintrag" UBYTE FORMULA_0003 0 0 0.0 255.0000 ECU_ADDRESS 0x3F9D14 /end MEASUREMENT
/begin MEASUREMENT ed_fil_lank1_obd_slope.filter_nv "Filterwert vor und nach Eintrag" UBYTE FORMULA_0003 0 0 0.0 255.0000 ECU_ADDRESS 0x3F9D1A /end MEASUREMENT
/begin MEASUREMENT ed_fil_elup_obd.filter_nv "Filterwert vor und nach Eintrag" UBYTE FORMULA_0003 0 0 0.0 255.0000 ECU_ADDRESS 0x3F9D2C /end MEASUREMENT
/begin MEASUREMENT ed_fil_index_204_inj.filter_nv "Filterwert vor und nach Eintrag" UBYTE FORMULA_0003 0 0 0.0 255.0000 ECU_ADDRESS 0x3F9D38 /end MEASUREMENT
/begin MEASUREMENT ed_fil_index_205_inj.filter_nv "Filterwert vor und nach Eintrag" UBYTE FORMULA_0003 0 0 0.0 255.0000 ECU_ADDRESS 0x3F9D3E /end MEASUREMENT
/begin MEASUREMENT ed_fil_index_206_inj.filter_nv "Filterwert vor und nach Eintrag" UBYTE FORMULA_0003 0 0 0.0 255.0000 ECU_ADDRESS 0x3F9D44 /end MEASUREMENT
/begin MEASUREMENT ed_fil_index_207_inj.filter_nv "Filterwert vor und nach Eintrag" UBYTE FORMULA_0003 0 0 0.0 255.0000 ECU_ADDRESS 0x3F9D4A /end MEASUREMENT
/begin MEASUREMENT ed_fil_index_208_inj.filter_nv "Filterwert vor und nach Eintrag" UBYTE FORMULA_0003 0 0 0.0 255.0000 ECU_ADDRESS 0x3F9D50 /end MEASUREMENT
/begin MEASUREMENT ed_fil_index_209_inj.filter_nv "Filterwert vor und nach Eintrag" UBYTE FORMULA_0003 0 0 0.0 255.0000 ECU_ADDRESS 0x3F9D56 /end MEASUREMENT
/begin MEASUREMENT ed_fil_index_210_inj.filter_nv "Filterwert vor und nach Eintrag" UBYTE FORMULA_0003 0 0 0.0 255.0000 ECU_ADDRESS 0x3F9D5C /end MEASUREMENT
/begin MEASUREMENT ed_fil_index_211_inj.filter_nv "Filterwert vor und nach Eintrag" UBYTE FORMULA_0003 0 0 0.0 255.0000 ECU_ADDRESS 0x3F9D62 /end MEASUREMENT
/begin MEASUREMENT ed_fil_index_212_inj.filter_nv "Filterwert vor und nach Eintrag" UBYTE FORMULA_0003 0 0 0.0 255.0000 ECU_ADDRESS 0x3F9D68 /end MEASUREMENT
/begin MEASUREMENT ed_fil_index_213_inj.filter_nv "Filterwert vor und nach Eintrag" UBYTE FORMULA_0003 0 0 0.0 255.0000 ECU_ADDRESS 0x3F9D6E /end MEASUREMENT
/begin MEASUREMENT ed_fil_index_214_inj.filter_nv "Filterwert vor und nach Eintrag" UBYTE FORMULA_0003 0 0 0.0 255.0000 ECU_ADDRESS 0x3F9D74 /end MEASUREMENT
/begin MEASUREMENT ed_fil_index_215_inj.filter_nv "Filterwert vor und nach Eintrag" UBYTE FORMULA_0003 0 0 0.0 255.0000 ECU_ADDRESS 0x3F9D7A /end MEASUREMENT
/begin MEASUREMENT ed_fil_index_216_inj.filter_nv "Filterwert vor und nach Eintrag" UBYTE FORMULA_0003 0 0 0.0 255.0000 ECU_ADDRESS 0x3F9D80 /end MEASUREMENT
/begin MEASUREMENT ed_fil_index_217_inj.filter_nv "Filterwert vor und nach Eintrag" UBYTE FORMULA_0003 0 0 0.0 255.0000 ECU_ADDRESS 0x3F9D86 /end MEASUREMENT
/begin MEASUREMENT ed_fil_index_218_inj.filter_nv "Filterwert vor und nach Eintrag" UBYTE FORMULA_0003 0 0 0.0 255.0000 ECU_ADDRESS 0x3F9D8C /end MEASUREMENT
/begin MEASUREMENT ed_fil_index_219_inj.filter_nv "Filterwert vor und nach Eintrag" UBYTE FORMULA_0003 0 0 0.0 255.0000 ECU_ADDRESS 0x3F9D92 /end MEASUREMENT
/begin MEASUREMENT ed_fil_index_220_inj.filter_nv "Filterwert vor und nach Eintrag" UBYTE FORMULA_0003 0 0 0.0 255.0000 ECU_ADDRESS 0x3F9D98 /end MEASUREMENT
/begin MEASUREMENT ed_fil_index_221_inj.filter_nv "Filterwert vor und nach Eintrag" UBYTE FORMULA_0003 0 0 0.0 255.0000 ECU_ADDRESS 0x3F9D9E /end MEASUREMENT
/begin MEASUREMENT ed_fil_index_222_inj.filter_nv "Filterwert vor und nach Eintrag" UBYTE FORMULA_0003 0 0 0.0 255.0000 ECU_ADDRESS 0x3F9DA4 /end MEASUREMENT
/begin MEASUREMENT ed_fil_index_223_inj.filter_nv "Filterwert vor und nach Eintrag" UBYTE FORMULA_0003 0 0 0.0 255.0000 ECU_ADDRESS 0x3F9DAA /end MEASUREMENT
/begin MEASUREMENT ed_fil_hfm1.zyklus_filter_nv "Vorwaertsfilter zur Fehlerzustandsbestaetigung" UBYTE FORMULA_0003 0 0 0.0 255.0000 ECU_ADDRESS 0x3F987D /end MEASUREMENT
/begin MEASUREMENT ed_fil_hfm2.zyklus_filter_nv "Vorwaertsfilter zur Fehlerzustandsbestaetigung" UBYTE FORMULA_0003 0 0 0.0 255.0000 ECU_ADDRESS 0x3F9883 /end MEASUREMENT
/begin MEASUREMENT ed_fil_lank1.zyklus_filter_nv "Vorwaertsfilter zur Fehlerzustandsbestaetigung" UBYTE FORMULA_0003 0 0 0.0 255.0000 ECU_ADDRESS 0x3F990D /end MEASUREMENT
/begin MEASUREMENT ed_fil_fplau1.zyklus_filter_nv "Vorwaertsfilter zur Fehlerzustandsbestaetigung" UBYTE FORMULA_0003 0 0 0.0 255.0000 ECU_ADDRESS 0x3F995B /end MEASUREMENT
/begin MEASUREMENT ed_fil_fplau2.zyklus_filter_nv "Vorwaertsfilter zur Fehlerzustandsbestaetigung" UBYTE FORMULA_0003 0 0 0.0 255.0000 ECU_ADDRESS 0x3F9961 /end MEASUREMENT
/begin MEASUREMENT ed_fil_lank1_obd_s.zyklus_filter_nv "Vorwaertsfilter zur Fehlerzustandsbestaetigung" UBYTE FORMULA_0003 0 0 0.0 255.0000 ECU_ADDRESS 0x3F996D /end MEASUREMENT
/begin MEASUREMENT ed_fil_appl_data_inj.zyklus_filter_nv "Vorwaertsfilter zur Fehlerzustandsbestaetigung" UBYTE FORMULA_0003 0 0 0.0 255.0000 ECU_ADDRESS 0x3F99FD /end MEASUREMENT
/begin MEASUREMENT ed_fil_lam1_reg.zyklus_filter_nv "Vorwaertsfilter zur Fehlerzustandsbestaetigung" UBYTE FORMULA_0003 0 0 0.0 255.0000 ECU_ADDRESS 0x3F9A3F /end MEASUREMENT
/begin MEASUREMENT ed_fil_lam2_reg.zyklus_filter_nv "Vorwaertsfilter zur Fehlerzustandsbestaetigung" UBYTE FORMULA_0003 0 0 0.0 255.0000 ECU_ADDRESS 0x3F9A45 /end MEASUREMENT
/begin MEASUREMENT ed_fil_ev1.zyklus_filter_nv "Vorwaertsfilter zur Fehlerzustandsbestaetigung" UBYTE FORMULA_0003 0 0 0.0 255.0000 ECU_ADDRESS 0x3F9A7B /end MEASUREMENT
/begin MEASUREMENT ed_fil_ev2.zyklus_filter_nv "Vorwaertsfilter zur Fehlerzustandsbestaetigung" UBYTE FORMULA_0003 0 0 0.0 255.0000 ECU_ADDRESS 0x3F9A81 /end MEASUREMENT
/begin MEASUREMENT ed_fil_ev3.zyklus_filter_nv "Vorwaertsfilter zur Fehlerzustandsbestaetigung" UBYTE FORMULA_0003 0 0 0.0 255.0000 ECU_ADDRESS 0x3F9A87 /end MEASUREMENT
/begin MEASUREMENT ed_fil_ev4.zyklus_filter_nv "Vorwaertsfilter zur Fehlerzustandsbestaetigung" UBYTE FORMULA_0003 0 0 0.0 255.0000 ECU_ADDRESS 0x3F9A8D /end MEASUREMENT
/begin MEASUREMENT ed_fil_ev5.zyklus_filter_nv "Vorwaertsfilter zur Fehlerzustandsbestaetigung" UBYTE FORMULA_0003 0 0 0.0 255.0000 ECU_ADDRESS 0x3F9A93 /end MEASUREMENT
/begin MEASUREMENT ed_fil_ev6.zyklus_filter_nv "Vorwaertsfilter zur Fehlerzustandsbestaetigung" UBYTE FORMULA_0003 0 0 0.0 255.0000 ECU_ADDRESS 0x3F9A99 /end MEASUREMENT
/begin MEASUREMENT ed_fil_ev7.zyklus_filter_nv "Vorwaertsfilter zur Fehlerzustandsbestaetigung" UBYTE FORMULA_0003 0 0 0.0 255.0000 ECU_ADDRESS 0x3F9A9F /end MEASUREMENT
/begin MEASUREMENT ed_fil_ev8.zyklus_filter_nv "Vorwaertsfilter zur Fehlerzustandsbestaetigung" UBYTE FORMULA_0003 0 0 0.0 255.0000 ECU_ADDRESS 0x3F9AA5 /end MEASUREMENT
/begin MEASUREMENT ed_fil_ev9.zyklus_filter_nv "Vorwaertsfilter zur Fehlerzustandsbestaetigung" UBYTE FORMULA_0003 0 0 0.0 255.0000 ECU_ADDRESS 0x3F9AAB /end MEASUREMENT
/begin MEASUREMENT ed_fil_ev10.zyklus_filter_nv "Vorwaertsfilter zur Fehlerzustandsbestaetigung" UBYTE FORMULA_0003 0 0 0.0 255.0000 ECU_ADDRESS 0x3F9AB1 /end MEASUREMENT
/begin MEASUREMENT ed_fil_dmtl_p.zyklus_filter_nv "Vorwaertsfilter zur Fehlerzustandsbestaetigung" UBYTE FORMULA_0003 0 0 0.0 255.0000 ECU_ADDRESS 0x3F9AD5 /end MEASUREMENT
/begin MEASUREMENT ed_fil_dmtl_v.zyklus_filter_nv "Vorwaertsfilter zur Fehlerzustandsbestaetigung" UBYTE FORMULA_0003 0 0 0.0 255.0000 ECU_ADDRESS 0x3F9ADB /end MEASUREMENT
/begin MEASUREMENT ed_fil_dmtl_h.zyklus_filter_nv "Vorwaertsfilter zur Fehlerzustandsbestaetigung" UBYTE FORMULA_0003 0 0 0.0 255.0000 ECU_ADDRESS 0x3F9AE1 /end MEASUREMENT
/begin MEASUREMENT ed_fil_dmtl_grobleck.zyklus_filter_nv "Vorwaertsfilter zur Fehlerzustandsbestaetigung" UBYTE FORMULA_0003 0 0 0.0 255.0000 ECU_ADDRESS 0x3F9AE7 /end MEASUREMENT
/begin MEASUREMENT ed_fil_dmtl_feucht.zyklus_filter_nv "Vorwaertsfilter zur Fehlerzustandsbestaetigung" UBYTE FORMULA_0003 0 0 0.0 255.0000 ECU_ADDRESS 0x3F9AED /end MEASUREMENT
/begin MEASUREMENT ed_fil_dmtl_deckel.zyklus_filter_nv "Vorwaertsfilter zur Fehlerzustandsbestaetigung" UBYTE FORMULA_0003 0 0 0.0 255.0000 ECU_ADDRESS 0x3F9AF3 /end MEASUREMENT
/begin MEASUREMENT ed_fil_ekp_pwm.zyklus_filter_nv "Vorwaertsfilter zur Fehlerzustandsbestaetigung" UBYTE FORMULA_0003 0 0 0.0 255.0000 ECU_ADDRESS 0x3F9B0B /end MEASUREMENT
/begin MEASUREMENT ed_fil_kat_obd1.zyklus_filter_nv "Vorwaertsfilter zur Fehlerzustandsbestaetigung" UBYTE FORMULA_0003 0 0 0.0 255.0000 ECU_ADDRESS 0x3F9B47 /end MEASUREMENT
/begin MEASUREMENT ed_fil_kat_obd2.zyklus_filter_nv "Vorwaertsfilter zur Fehlerzustandsbestaetigung" UBYTE FORMULA_0003 0 0 0.0 255.0000 ECU_ADDRESS 0x3F9B4D /end MEASUREMENT
/begin MEASUREMENT ed_fil_fi_gen.zyklus_filter_nv "Vorwaertsfilter zur Fehlerzustandsbestaetigung" UBYTE FORMULA_0003 0 0 0.0 255.0000 ECU_ADDRESS 0x3F9B59 /end MEASUREMENT
/begin MEASUREMENT ed_fil_fi_bsd.zyklus_filter_nv "Vorwaertsfilter zur Fehlerzustandsbestaetigung" UBYTE FORMULA_0003 0 0 0.0 255.0000 ECU_ADDRESS 0x3F9B5F /end MEASUREMENT
/begin MEASUREMENT ed_fil_fi_qlt.zyklus_filter_nv "Vorwaertsfilter zur Fehlerzustandsbestaetigung" UBYTE FORMULA_0003 0 0 0.0 255.0000 ECU_ADDRESS 0x3F9B65 /end MEASUREMENT
/begin MEASUREMENT ed_fil_fi_ibs1.zyklus_filter_nv "Vorwaertsfilter zur Fehlerzustandsbestaetigung" UBYTE FORMULA_0003 0 0 0.0 255.0000 ECU_ADDRESS 0x3F9B6B /end MEASUREMENT
/begin MEASUREMENT ed_fil_fi_ibs2.zyklus_filter_nv "Vorwaertsfilter zur Fehlerzustandsbestaetigung" UBYTE FORMULA_0003 0 0 0.0 255.0000 ECU_ADDRESS 0x3F9B71 /end MEASUREMENT
/begin MEASUREMENT ed_fil_fi_ibs3.zyklus_filter_nv "Vorwaertsfilter zur Fehlerzustandsbestaetigung" UBYTE FORMULA_0003 0 0 0.0 255.0000 ECU_ADDRESS 0x3F9B77 /end MEASUREMENT
/begin MEASUREMENT ed_fil_fi_pmbn.zyklus_filter_nv "Vorwaertsfilter zur Fehlerzustandsbestaetigung" UBYTE FORMULA_0003 0 0 0.0 255.0000 ECU_ADDRESS 0x3F9B7D /end MEASUREMENT
/begin MEASUREMENT ed_fil_fi_pmbatt.zyklus_filter_nv "Vorwaertsfilter zur Fehlerzustandsbestaetigung" UBYTE FORMULA_0003 0 0 0.0 255.0000 ECU_ADDRESS 0x3F9B83 /end MEASUREMENT
/begin MEASUREMENT ed_fil_ews_sci.zyklus_filter_nv "Vorwaertsfilter zur Fehlerzustandsbestaetigung" UBYTE FORMULA_0003 0 0 0.0 255.0000 ECU_ADDRESS 0x3F9BA1 /end MEASUREMENT
/begin MEASUREMENT ed_fil_ews_man.zyklus_filter_nv "Vorwaertsfilter zur Fehlerzustandsbestaetigung" UBYTE FORMULA_0003 0 0 0.0 255.0000 ECU_ADDRESS 0x3F9BA7 /end MEASUREMENT
/begin MEASUREMENT ed_fil_fi_bsd_0.zyklus_filter_nv "Vorwaertsfilter zur Fehlerzustandsbestaetigung" UBYTE FORMULA_0003 0 0 0.0 255.0000 ECU_ADDRESS 0x3F9BAD /end MEASUREMENT
/begin MEASUREMENT ed_fil_fi_bsd_6.zyklus_filter_nv "Vorwaertsfilter zur Fehlerzustandsbestaetigung" UBYTE FORMULA_0003 0 0 0.0 255.0000 ECU_ADDRESS 0x3F9BB3 /end MEASUREMENT
/begin MEASUREMENT ed_fil_fi_bsdglob.zyklus_filter_nv "Vorwaertsfilter zur Fehlerzustandsbestaetigung" UBYTE FORMULA_0003 0 0 0.0 255.0000 ECU_ADDRESS 0x3F9BB9 /end MEASUREMENT
/begin MEASUREMENT ed_fil_fi_pmruhverl.zyklus_filter_nv "Vorwaertsfilter zur Fehlerzustandsbestaetigung" UBYTE FORMULA_0003 0 0 0.0 255.0000 ECU_ADDRESS 0x3F9BBF /end MEASUREMENT
/begin MEASUREMENT ed_fil_fi_toens.zyklus_filter_nv "Vorwaertsfilter zur Fehlerzustandsbestaetigung" UBYTE FORMULA_0003 0 0 0.0 255.0000 ECU_ADDRESS 0x3F9BC5 /end MEASUREMENT
/begin MEASUREMENT ed_fil_ebox_elu.zyklus_filter_nv "Vorwaertsfilter zur Fehlerzustandsbestaetigung" UBYTE FORMULA_0003 0 0 0.0 255.0000 ECU_ADDRESS 0x3F9BCB /end MEASUREMENT
/begin MEASUREMENT ed_fil_dk1_enltg.zyklus_filter_nv "Vorwaertsfilter zur Fehlerzustandsbestaetigung" UBYTE FORMULA_0003 0 0 0.0 255.0000 ECU_ADDRESS 0x3F9BD7 /end MEASUREMENT
/begin MEASUREMENT ed_fil_dk2_enltg.zyklus_filter_nv "Vorwaertsfilter zur Fehlerzustandsbestaetigung" UBYTE FORMULA_0003 0 0 0.0 255.0000 ECU_ADDRESS 0x3F9BDD /end MEASUREMENT
/begin MEASUREMENT ed_fil_e2_inj.zyklus_filter_nv "Vorwaertsfilter zur Fehlerzustandsbestaetigung" UBYTE FORMULA_0003 0 0 0.0 255.0000 ECU_ADDRESS 0x3F9C01 /end MEASUREMENT
/begin MEASUREMENT ed_fil_kw.zyklus_filter_nv "Vorwaertsfilter zur Fehlerzustandsbestaetigung" UBYTE FORMULA_0003 0 0 0.0 255.0000 ECU_ADDRESS 0x3F9C07 /end MEASUREMENT
/begin MEASUREMENT ed_fil_la1_adapt.zyklus_filter_nv "Vorwaertsfilter zur Fehlerzustandsbestaetigung" UBYTE FORMULA_0003 0 0 0.0 255.0000 ECU_ADDRESS 0x3F9C0D /end MEASUREMENT
/begin MEASUREMENT ed_fil_la2_adapt.zyklus_filter_nv "Vorwaertsfilter zur Fehlerzustandsbestaetigung" UBYTE FORMULA_0003 0 0 0.0 255.0000 ECU_ADDRESS 0x3F9C13 /end MEASUREMENT
/begin MEASUREMENT ed_fil_kge1.zyklus_filter_nv "Vorwaertsfilter zur Fehlerzustandsbestaetigung" UBYTE FORMULA_0003 0 0 0.0 255.0000 ECU_ADDRESS 0x3F9C19 /end MEASUREMENT
/begin MEASUREMENT ed_fil_kge2.zyklus_filter_nv "Vorwaertsfilter zur Fehlerzustandsbestaetigung" UBYTE FORMULA_0003 0 0 0.0 255.0000 ECU_ADDRESS 0x3F9C1F /end MEASUREMENT
/begin MEASUREMENT ed_fil_fst.zyklus_filter_nv "Vorwaertsfilter zur Fehlerzustandsbestaetigung" UBYTE FORMULA_0003 0 0 0.0 255.0000 ECU_ADDRESS 0x3F9C25 /end MEASUREMENT
/begin MEASUREMENT ed_fil_fetrawe.zyklus_filter_nv "Vorwaertsfilter zur Fehlerzustandsbestaetigung" UBYTE FORMULA_0003 0 0 0.0 255.0000 ECU_ADDRESS 0x3F9C43 /end MEASUREMENT
/begin MEASUREMENT ed_fil_elup.zyklus_filter_nv "Vorwaertsfilter zur Fehlerzustandsbestaetigung" UBYTE FORMULA_0003 0 0 0.0 255.0000 ECU_ADDRESS 0x3F9C5B /end MEASUREMENT
/begin MEASUREMENT ed_fil_elu.zyklus_filter_nv "Vorwaertsfilter zur Fehlerzustandsbestaetigung" UBYTE FORMULA_0003 0 0 0.0 255.0000 ECU_ADDRESS 0x3F9C61 /end MEASUREMENT
/begin MEASUREMENT ed_fil_ksd1.zyklus_filter_nv "Vorwaertsfilter zur Fehlerzustandsbestaetigung" UBYTE FORMULA_0003 0 0 0.0 255.0000 ECU_ADDRESS 0x3F9C6D /end MEASUREMENT
/begin MEASUREMENT ed_fil_ksd2.zyklus_filter_nv "Vorwaertsfilter zur Fehlerzustandsbestaetigung" UBYTE FORMULA_0003 0 0 0.0 255.0000 ECU_ADDRESS 0x3F9C73 /end MEASUREMENT
/begin MEASUREMENT ed_fil_kats_b1.zyklus_filter_nv "Vorwaertsfilter zur Fehlerzustandsbestaetigung" UBYTE FORMULA_0003 0 0 0.0 255.0000 ECU_ADDRESS 0x3F9C79 /end MEASUREMENT
/begin MEASUREMENT ed_fil_kats_b2.zyklus_filter_nv "Vorwaertsfilter zur Fehlerzustandsbestaetigung" UBYTE FORMULA_0003 0 0 0.0 255.0000 ECU_ADDRESS 0x3F9C7F /end MEASUREMENT
/begin MEASUREMENT ed_fil_fst_geber.zyklus_filter_nv "Vorwaertsfilter zur Fehlerzustandsbestaetigung" UBYTE FORMULA_0003 0 0 0.0 255.0000 ECU_ADDRESS 0x3F9C91 /end MEASUREMENT
/begin MEASUREMENT ed_fil_dmtl_feinleck.zyklus_filter_nv "Vorwaertsfilter zur Fehlerzustandsbestaetigung" UBYTE FORMULA_0003 0 0 0.0 255.0000 ECU_ADDRESS 0x3F9CA3 /end MEASUREMENT
/begin MEASUREMENT ed_fil_la1_trim_ad.zyklus_filter_nv "Vorwaertsfilter zur Fehlerzustandsbestaetigung" UBYTE FORMULA_0003 0 0 0.0 255.0000 ECU_ADDRESS 0x3F9CB5 /end MEASUREMENT
/begin MEASUREMENT ed_fil_la2_trim_ad.zyklus_filter_nv "Vorwaertsfilter zur Fehlerzustandsbestaetigung" UBYTE FORMULA_0003 0 0 0.0 255.0000 ECU_ADDRESS 0x3F9CBB /end MEASUREMENT
/begin MEASUREMENT ed_fil_fst_geber_li.zyklus_filter_nv "Vorwaertsfilter zur Fehlerzustandsbestaetigung" UBYTE FORMULA_0003 0 0 0.0 255.0000 ECU_ADDRESS 0x3F9D0F /end MEASUREMENT
/begin MEASUREMENT ed_fil_fst_geber_re.zyklus_filter_nv "Vorwaertsfilter zur Fehlerzustandsbestaetigung" UBYTE FORMULA_0003 0 0 0.0 255.0000 ECU_ADDRESS 0x3F9D15 /end MEASUREMENT
/begin MEASUREMENT ed_fil_lank1_obd_slope.zyklus_filter_nv "Vorwaertsfilter zur Fehlerzustandsbestaetigung" UBYTE FORMULA_0003 0 0 0.0 255.0000 ECU_ADDRESS 0x3F9D1B /end MEASUREMENT
/begin MEASUREMENT ed_fil_elup_obd.zyklus_filter_nv "Vorwaertsfilter zur Fehlerzustandsbestaetigung" UBYTE FORMULA_0003 0 0 0.0 255.0000 ECU_ADDRESS 0x3F9D2D /end MEASUREMENT
/begin MEASUREMENT ed_fil_index_204_inj.zyklus_filter_nv "Vorwaertsfilter zur Fehlerzustandsbestaetigung" UBYTE FORMULA_0003 0 0 0.0 255.0000 ECU_ADDRESS 0x3F9D39 /end MEASUREMENT
/begin MEASUREMENT ed_fil_index_205_inj.zyklus_filter_nv "Vorwaertsfilter zur Fehlerzustandsbestaetigung" UBYTE FORMULA_0003 0 0 0.0 255.0000 ECU_ADDRESS 0x3F9D3F /end MEASUREMENT
/begin MEASUREMENT ed_fil_index_206_inj.zyklus_filter_nv "Vorwaertsfilter zur Fehlerzustandsbestaetigung" UBYTE FORMULA_0003 0 0 0.0 255.0000 ECU_ADDRESS 0x3F9D45 /end MEASUREMENT
/begin MEASUREMENT ed_fil_index_207_inj.zyklus_filter_nv "Vorwaertsfilter zur Fehlerzustandsbestaetigung" UBYTE FORMULA_0003 0 0 0.0 255.0000 ECU_ADDRESS 0x3F9D4B /end MEASUREMENT
/begin MEASUREMENT ed_fil_index_208_inj.zyklus_filter_nv "Vorwaertsfilter zur Fehlerzustandsbestaetigung" UBYTE FORMULA_0003 0 0 0.0 255.0000 ECU_ADDRESS 0x3F9D51 /end MEASUREMENT
/begin MEASUREMENT ed_fil_index_209_inj.zyklus_filter_nv "Vorwaertsfilter zur Fehlerzustandsbestaetigung" UBYTE FORMULA_0003 0 0 0.0 255.0000 ECU_ADDRESS 0x3F9D57 /end MEASUREMENT
/begin MEASUREMENT ed_fil_index_210_inj.zyklus_filter_nv "Vorwaertsfilter zur Fehlerzustandsbestaetigung" UBYTE FORMULA_0003 0 0 0.0 255.0000 ECU_ADDRESS 0x3F9D5D /end MEASUREMENT
/begin MEASUREMENT ed_fil_index_211_inj.zyklus_filter_nv "Vorwaertsfilter zur Fehlerzustandsbestaetigung" UBYTE FORMULA_0003 0 0 0.0 255.0000 ECU_ADDRESS 0x3F9D63 /end MEASUREMENT
/begin MEASUREMENT ed_fil_index_212_inj.zyklus_filter_nv "Vorwaertsfilter zur Fehlerzustandsbestaetigung" UBYTE FORMULA_0003 0 0 0.0 255.0000 ECU_ADDRESS 0x3F9D69 /end MEASUREMENT
/begin MEASUREMENT ed_fil_index_213_inj.zyklus_filter_nv "Vorwaertsfilter zur Fehlerzustandsbestaetigung" UBYTE FORMULA_0003 0 0 0.0 255.0000 ECU_ADDRESS 0x3F9D6F /end MEASUREMENT
/begin MEASUREMENT ed_fil_index_214_inj.zyklus_filter_nv "Vorwaertsfilter zur Fehlerzustandsbestaetigung" UBYTE FORMULA_0003 0 0 0.0 255.0000 ECU_ADDRESS 0x3F9D75 /end MEASUREMENT
/begin MEASUREMENT ed_fil_index_215_inj.zyklus_filter_nv "Vorwaertsfilter zur Fehlerzustandsbestaetigung" UBYTE FORMULA_0003 0 0 0.0 255.0000 ECU_ADDRESS 0x3F9D7B /end MEASUREMENT
/begin MEASUREMENT ed_fil_index_216_inj.zyklus_filter_nv "Vorwaertsfilter zur Fehlerzustandsbestaetigung" UBYTE FORMULA_0003 0 0 0.0 255.0000 ECU_ADDRESS 0x3F9D81 /end MEASUREMENT
/begin MEASUREMENT ed_fil_index_217_inj.zyklus_filter_nv "Vorwaertsfilter zur Fehlerzustandsbestaetigung" UBYTE FORMULA_0003 0 0 0.0 255.0000 ECU_ADDRESS 0x3F9D87 /end MEASUREMENT
/begin MEASUREMENT ed_fil_index_218_inj.zyklus_filter_nv "Vorwaertsfilter zur Fehlerzustandsbestaetigung" UBYTE FORMULA_0003 0 0 0.0 255.0000 ECU_ADDRESS 0x3F9D8D /end MEASUREMENT
/begin MEASUREMENT ed_fil_index_219_inj.zyklus_filter_nv "Vorwaertsfilter zur Fehlerzustandsbestaetigung" UBYTE FORMULA_0003 0 0 0.0 255.0000 ECU_ADDRESS 0x3F9D93 /end MEASUREMENT
/begin MEASUREMENT ed_fil_index_220_inj.zyklus_filter_nv "Vorwaertsfilter zur Fehlerzustandsbestaetigung" UBYTE FORMULA_0003 0 0 0.0 255.0000 ECU_ADDRESS 0x3F9D99 /end MEASUREMENT
/begin MEASUREMENT ed_fil_index_221_inj.zyklus_filter_nv "Vorwaertsfilter zur Fehlerzustandsbestaetigung" UBYTE FORMULA_0003 0 0 0.0 255.0000 ECU_ADDRESS 0x3F9D9F /end MEASUREMENT
/begin MEASUREMENT ed_fil_index_222_inj.zyklus_filter_nv "Vorwaertsfilter zur Fehlerzustandsbestaetigung" UBYTE FORMULA_0003 0 0 0.0 255.0000 ECU_ADDRESS 0x3F9DA5 /end MEASUREMENT
/begin MEASUREMENT ed_fil_index_223_inj.zyklus_filter_nv "Vorwaertsfilter zur Fehlerzustandsbestaetigung" UBYTE FORMULA_0003 0 0 0.0 255.0000 ECU_ADDRESS 0x3F9DAB /end MEASUREMENT
/begin MEASUREMENT ed_fil_hfm1.art_aktuell_nv "Fehlerart und Statusbits" UWORD FORMULA_0049 0 0 0.0 65535.0 ECU_ADDRESS 0x3F987E BIT_MASK 0xB4F /end MEASUREMENT
/begin MEASUREMENT ed_fil_hfm2.art_aktuell_nv "Fehlerart und Statusbits" UWORD FORMULA_0049 0 0 0.0 65535.0 ECU_ADDRESS 0x3F9884 BIT_MASK 0xB4F /end MEASUREMENT
/begin MEASUREMENT ed_fil_lank1.art_aktuell_nv "Fehlerart und Statusbits" UWORD FORMULA_0049 0 0 0.0 65535.0 ECU_ADDRESS 0x3F990E BIT_MASK 0xB4F /end MEASUREMENT
/begin MEASUREMENT ed_fil_fplau1.art_aktuell_nv "Fehlerart und Statusbits" UWORD FORMULA_0049 0 0 0.0 65535.0 ECU_ADDRESS 0x3F995C BIT_MASK 0xB4F /end MEASUREMENT
/begin MEASUREMENT ed_fil_fplau2.art_aktuell_nv "Fehlerart und Statusbits" UWORD FORMULA_0049 0 0 0.0 65535.0 ECU_ADDRESS 0x3F9962 BIT_MASK 0xB4F /end MEASUREMENT
/begin MEASUREMENT ed_fil_lank1_obd_s.art_aktuell_nv "Fehlerart und Statusbits" UWORD FORMULA_0049 0 0 0.0 65535.0 ECU_ADDRESS 0x3F996E BIT_MASK 0xB4F /end MEASUREMENT
/begin MEASUREMENT ed_fil_appl_data_inj.art_aktuell_nv "Fehlerart und Statusbits" UWORD FORMULA_0049 0 0 0.0 65535.0 ECU_ADDRESS 0x3F99FE BIT_MASK 0xB4F /end MEASUREMENT
/begin MEASUREMENT ed_fil_lam1_reg.art_aktuell_nv "Fehlerart und Statusbits" UWORD FORMULA_0049 0 0 0.0 65535.0 ECU_ADDRESS 0x3F9A40 BIT_MASK 0xB4F /end MEASUREMENT
/begin MEASUREMENT ed_fil_lam2_reg.art_aktuell_nv "Fehlerart und Statusbits" UWORD FORMULA_0049 0 0 0.0 65535.0 ECU_ADDRESS 0x3F9A46 BIT_MASK 0xB4F /end MEASUREMENT
/begin MEASUREMENT ed_fil_ev1.art_aktuell_nv "Fehlerart und Statusbits" UWORD FORMULA_0049 0 0 0.0 65535.0 ECU_ADDRESS 0x3F9A7C BIT_MASK 0xB4F /end MEASUREMENT
/begin MEASUREMENT ed_fil_ev2.art_aktuell_nv "Fehlerart und Statusbits" UWORD FORMULA_0049 0 0 0.0 65535.0 ECU_ADDRESS 0x3F9A82 BIT_MASK 0xB4F /end MEASUREMENT
/begin MEASUREMENT ed_fil_ev3.art_aktuell_nv "Fehlerart und Statusbits" UWORD FORMULA_0049 0 0 0.0 65535.0 ECU_ADDRESS 0x3F9A88 BIT_MASK 0xB4F /end MEASUREMENT
/begin MEASUREMENT ed_fil_ev4.art_aktuell_nv "Fehlerart und Statusbits" UWORD FORMULA_0049 0 0 0.0 65535.0 ECU_ADDRESS 0x3F9A8E BIT_MASK 0xB4F /end MEASUREMENT
/begin MEASUREMENT ed_fil_ev5.art_aktuell_nv "Fehlerart und Statusbits" UWORD FORMULA_0049 0 0 0.0 65535.0 ECU_ADDRESS 0x3F9A94 BIT_MASK 0xB4F /end MEASUREMENT
/begin MEASUREMENT ed_fil_ev6.art_aktuell_nv "Fehlerart und Statusbits" UWORD FORMULA_0049 0 0 0.0 65535.0 ECU_ADDRESS 0x3F9A9A BIT_MASK 0xB4F /end MEASUREMENT
/begin MEASUREMENT ed_fil_ev7.art_aktuell_nv "Fehlerart und Statusbits" UWORD FORMULA_0049 0 0 0.0 65535.0 ECU_ADDRESS 0x3F9AA0 BIT_MASK 0xB4F /end MEASUREMENT
/begin MEASUREMENT ed_fil_ev8.art_aktuell_nv "Fehlerart und Statusbits" UWORD FORMULA_0049 0 0 0.0 65535.0 ECU_ADDRESS 0x3F9AA6 BIT_MASK 0xB4F /end MEASUREMENT
/begin MEASUREMENT ed_fil_ev9.art_aktuell_nv "Fehlerart und Statusbits" UWORD FORMULA_0049 0 0 0.0 65535.0 ECU_ADDRESS 0x3F9AAC BIT_MASK 0xB4F /end MEASUREMENT
/begin MEASUREMENT ed_fil_ev10.art_aktuell_nv "Fehlerart und Statusbits" UWORD FORMULA_0049 0 0 0.0 65535.0 ECU_ADDRESS 0x3F9AB2 BIT_MASK 0xB4F /end MEASUREMENT
/begin MEASUREMENT ed_fil_dmtl_p.art_aktuell_nv "Fehlerart und Statusbits" UWORD FORMULA_0049 0 0 0.0 65535.0 ECU_ADDRESS 0x3F9AD6 BIT_MASK 0xB4F /end MEASUREMENT
/begin MEASUREMENT ed_fil_dmtl_v.art_aktuell_nv "Fehlerart und Statusbits" UWORD FORMULA_0049 0 0 0.0 65535.0 ECU_ADDRESS 0x3F9ADC BIT_MASK 0xB4F /end MEASUREMENT
/begin MEASUREMENT ed_fil_dmtl_h.art_aktuell_nv "Fehlerart und Statusbits" UWORD FORMULA_0049 0 0 0.0 65535.0 ECU_ADDRESS 0x3F9AE2 BIT_MASK 0xB4F /end MEASUREMENT
/begin MEASUREMENT ed_fil_dmtl_grobleck.art_aktuell_nv "Fehlerart und Statusbits" UWORD FORMULA_0049 0 0 0.0 65535.0 ECU_ADDRESS 0x3F9AE8 BIT_MASK 0xB4F /end MEASUREMENT
/begin MEASUREMENT ed_fil_dmtl_feucht.art_aktuell_nv "Fehlerart und Statusbits" UWORD FORMULA_0049 0 0 0.0 65535.0 ECU_ADDRESS 0x3F9AEE BIT_MASK 0xB4F /end MEASUREMENT
/begin MEASUREMENT ed_fil_dmtl_deckel.art_aktuell_nv "Fehlerart und Statusbits" UWORD FORMULA_0049 0 0 0.0 65535.0 ECU_ADDRESS 0x3F9AF4 BIT_MASK 0xB4F /end MEASUREMENT
/begin MEASUREMENT ed_fil_ekp_pwm.art_aktuell_nv "Fehlerart und Statusbits" UWORD FORMULA_0049 0 0 0.0 65535.0 ECU_ADDRESS 0x3F9B0C BIT_MASK 0xB4F /end MEASUREMENT
/begin MEASUREMENT ed_fil_kat_obd1.art_aktuell_nv "Fehlerart und Statusbits" UWORD FORMULA_0049 0 0 0.0 65535.0 ECU_ADDRESS 0x3F9B48 BIT_MASK 0xB4F /end MEASUREMENT
/begin MEASUREMENT ed_fil_kat_obd2.art_aktuell_nv "Fehlerart und Statusbits" UWORD FORMULA_0049 0 0 0.0 65535.0 ECU_ADDRESS 0x3F9B4E BIT_MASK 0xB4F /end MEASUREMENT
/begin MEASUREMENT ed_fil_fi_gen.art_aktuell_nv "Fehlerart und Statusbits" UWORD FORMULA_0049 0 0 0.0 65535.0 ECU_ADDRESS 0x3F9B5A BIT_MASK 0xB4F /end MEASUREMENT
/begin MEASUREMENT ed_fil_fi_bsd.art_aktuell_nv "Fehlerart und Statusbits" UWORD FORMULA_0049 0 0 0.0 65535.0 ECU_ADDRESS 0x3F9B60 BIT_MASK 0xB4F /end MEASUREMENT
/begin MEASUREMENT ed_fil_fi_qlt.art_aktuell_nv "Fehlerart und Statusbits" UWORD FORMULA_0049 0 0 0.0 65535.0 ECU_ADDRESS 0x3F9B66 BIT_MASK 0xB4F /end MEASUREMENT
/begin MEASUREMENT ed_fil_fi_ibs1.art_aktuell_nv "Fehlerart und Statusbits" UWORD FORMULA_0049 0 0 0.0 65535.0 ECU_ADDRESS 0x3F9B6C BIT_MASK 0xB4F /end MEASUREMENT
/begin MEASUREMENT ed_fil_fi_ibs2.art_aktuell_nv "Fehlerart und Statusbits" UWORD FORMULA_0049 0 0 0.0 65535.0 ECU_ADDRESS 0x3F9B72 BIT_MASK 0xB4F /end MEASUREMENT
/begin MEASUREMENT ed_fil_fi_ibs3.art_aktuell_nv "Fehlerart und Statusbits" UWORD FORMULA_0049 0 0 0.0 65535.0 ECU_ADDRESS 0x3F9B78 BIT_MASK 0xB4F /end MEASUREMENT
/begin MEASUREMENT ed_fil_fi_pmbn.art_aktuell_nv "Fehlerart und Statusbits" UWORD FORMULA_0049 0 0 0.0 65535.0 ECU_ADDRESS 0x3F9B7E BIT_MASK 0xB4F /end MEASUREMENT
/begin MEASUREMENT ed_fil_fi_pmbatt.art_aktuell_nv "Fehlerart und Statusbits" UWORD FORMULA_0049 0 0 0.0 65535.0 ECU_ADDRESS 0x3F9B84 BIT_MASK 0xB4F /end MEASUREMENT
/begin MEASUREMENT ed_fil_ews_sci.art_aktuell_nv "Fehlerart und Statusbits" UWORD FORMULA_0049 0 0 0.0 65535.0 ECU_ADDRESS 0x3F9BA2 BIT_MASK 0xB4F /end MEASUREMENT
/begin MEASUREMENT ed_fil_ews_man.art_aktuell_nv "Fehlerart und Statusbits" UWORD FORMULA_0049 0 0 0.0 65535.0 ECU_ADDRESS 0x3F9BA8 BIT_MASK 0xB4F /end MEASUREMENT
/begin MEASUREMENT ed_fil_fi_bsd_0.art_aktuell_nv "Fehlerart und Statusbits" UWORD FORMULA_0049 0 0 0.0 65535.0 ECU_ADDRESS 0x3F9BAE BIT_MASK 0xB4F /end MEASUREMENT
/begin MEASUREMENT ed_fil_fi_bsd_6.art_aktuell_nv "Fehlerart und Statusbits" UWORD FORMULA_0049 0 0 0.0 65535.0 ECU_ADDRESS 0x3F9BB4 BIT_MASK 0xB4F /end MEASUREMENT
/begin MEASUREMENT ed_fil_fi_bsdglob.art_aktuell_nv "Fehlerart und Statusbits" UWORD FORMULA_0049 0 0 0.0 65535.0 ECU_ADDRESS 0x3F9BBA BIT_MASK 0xB4F /end MEASUREMENT
/begin MEASUREMENT ed_fil_fi_pmruhverl.art_aktuell_nv "Fehlerart und Statusbits" UWORD FORMULA_0049 0 0 0.0 65535.0 ECU_ADDRESS 0x3F9BC0 BIT_MASK 0xB4F /end MEASUREMENT
/begin MEASUREMENT ed_fil_fi_toens.art_aktuell_nv "Fehlerart und Statusbits" UWORD FORMULA_0049 0 0 0.0 65535.0 ECU_ADDRESS 0x3F9BC6 BIT_MASK 0xB4F /end MEASUREMENT
/begin MEASUREMENT ed_fil_ebox_elu.art_aktuell_nv "Fehlerart und Statusbits" UWORD FORMULA_0049 0 0 0.0 65535.0 ECU_ADDRESS 0x3F9BCC BIT_MASK 0xB4F /end MEASUREMENT
/begin MEASUREMENT ed_fil_dk1_enltg.art_aktuell_nv "Fehlerart und Statusbits" UWORD FORMULA_0049 0 0 0.0 65535.0 ECU_ADDRESS 0x3F9BD8 BIT_MASK 0xB4F /end MEASUREMENT
/begin MEASUREMENT ed_fil_dk2_enltg.art_aktuell_nv "Fehlerart und Statusbits" UWORD FORMULA_0049 0 0 0.0 65535.0 ECU_ADDRESS 0x3F9BDE BIT_MASK 0xB4F /end MEASUREMENT
/begin MEASUREMENT ed_fil_e2_inj.art_aktuell_nv "Fehlerart und Statusbits" UWORD FORMULA_0049 0 0 0.0 65535.0 ECU_ADDRESS 0x3F9C02 BIT_MASK 0xB4F /end MEASUREMENT
/begin MEASUREMENT ed_fil_kw.art_aktuell_nv "Fehlerart und Statusbits" UWORD FORMULA_0049 0 0 0.0 65535.0 ECU_ADDRESS 0x3F9C08 BIT_MASK 0xB4F /end MEASUREMENT
/begin MEASUREMENT ed_fil_la1_adapt.art_aktuell_nv "Fehlerart und Statusbits" UWORD FORMULA_0049 0 0 0.0 65535.0 ECU_ADDRESS 0x3F9C0E BIT_MASK 0xB4F /end MEASUREMENT
/begin MEASUREMENT ed_fil_la2_adapt.art_aktuell_nv "Fehlerart und Statusbits" UWORD FORMULA_0049 0 0 0.0 65535.0 ECU_ADDRESS 0x3F9C14 BIT_MASK 0xB4F /end MEASUREMENT
/begin MEASUREMENT ed_fil_kge1.art_aktuell_nv "Fehlerart und Statusbits" UWORD FORMULA_0049 0 0 0.0 65535.0 ECU_ADDRESS 0x3F9C1A BIT_MASK 0xB4F /end MEASUREMENT
/begin MEASUREMENT ed_fil_kge2.art_aktuell_nv "Fehlerart und Statusbits" UWORD FORMULA_0049 0 0 0.0 65535.0 ECU_ADDRESS 0x3F9C20 BIT_MASK 0xB4F /end MEASUREMENT
/begin MEASUREMENT ed_fil_fst.art_aktuell_nv "Fehlerart und Statusbits" UWORD FORMULA_0049 0 0 0.0 65535.0 ECU_ADDRESS 0x3F9C26 BIT_MASK 0xB4F /end MEASUREMENT
/begin MEASUREMENT ed_fil_fetrawe.art_aktuell_nv "Fehlerart und Statusbits" UWORD FORMULA_0049 0 0 0.0 65535.0 ECU_ADDRESS 0x3F9C44 BIT_MASK 0xB4F /end MEASUREMENT
/begin MEASUREMENT ed_fil_elup.art_aktuell_nv "Fehlerart und Statusbits" UWORD FORMULA_0049 0 0 0.0 65535.0 ECU_ADDRESS 0x3F9C5C BIT_MASK 0xB4F /end MEASUREMENT
/begin MEASUREMENT ed_fil_elu.art_aktuell_nv "Fehlerart und Statusbits" UWORD FORMULA_0049 0 0 0.0 65535.0 ECU_ADDRESS 0x3F9C62 BIT_MASK 0xB4F /end MEASUREMENT
/begin MEASUREMENT ed_fil_ksd1.art_aktuell_nv "Fehlerart und Statusbits" UWORD FORMULA_0049 0 0 0.0 65535.0 ECU_ADDRESS 0x3F9C6E BIT_MASK 0xB4F /end MEASUREMENT
/begin MEASUREMENT ed_fil_ksd2.art_aktuell_nv "Fehlerart und Statusbits" UWORD FORMULA_0049 0 0 0.0 65535.0 ECU_ADDRESS 0x3F9C74 BIT_MASK 0xB4F /end MEASUREMENT
/begin MEASUREMENT ed_fil_kats_b1.art_aktuell_nv "Fehlerart und Statusbits" UWORD FORMULA_0049 0 0 0.0 65535.0 ECU_ADDRESS 0x3F9C7A BIT_MASK 0xB4F /end MEASUREMENT
/begin MEASUREMENT ed_fil_kats_b2.art_aktuell_nv "Fehlerart und Statusbits" UWORD FORMULA_0049 0 0 0.0 65535.0 ECU_ADDRESS 0x3F9C80 BIT_MASK 0xB4F /end MEASUREMENT
/begin MEASUREMENT ed_fil_fst_geber.art_aktuell_nv "Fehlerart und Statusbits" UWORD FORMULA_0049 0 0 0.0 65535.0 ECU_ADDRESS 0x3F9C92 BIT_MASK 0xB4F /end MEASUREMENT
/begin MEASUREMENT ed_fil_dmtl_feinleck.art_aktuell_nv "Fehlerart und Statusbits" UWORD FORMULA_0049 0 0 0.0 65535.0 ECU_ADDRESS 0x3F9CA4 BIT_MASK 0xB4F /end MEASUREMENT
/begin MEASUREMENT ed_fil_la1_trim_ad.art_aktuell_nv "Fehlerart und Statusbits" UWORD FORMULA_0049 0 0 0.0 65535.0 ECU_ADDRESS 0x3F9CB6 BIT_MASK 0xB4F /end MEASUREMENT
/begin MEASUREMENT ed_fil_la2_trim_ad.art_aktuell_nv "Fehlerart und Statusbits" UWORD FORMULA_0049 0 0 0.0 65535.0 ECU_ADDRESS 0x3F9CBC BIT_MASK 0xB4F /end MEASUREMENT
/begin MEASUREMENT ed_fil_lank1_obd_we.art_aktuell_nv "Fehlerart und Statusbits" UWORD FORMULA_0049 0 0 0.0 65535.0 ECU_ADDRESS 0x3F9CCE BIT_MASK 0xB4F /end MEASUREMENT
/begin MEASUREMENT ed_fil_fst_geber_li.art_aktuell_nv "Fehlerart und Statusbits" UWORD FORMULA_0049 0 0 0.0 65535.0 ECU_ADDRESS 0x3F9D10 BIT_MASK 0xB4F /end MEASUREMENT
/begin MEASUREMENT ed_fil_fst_geber_re.art_aktuell_nv "Fehlerart und Statusbits" UWORD FORMULA_0049 0 0 0.0 65535.0 ECU_ADDRESS 0x3F9D16 BIT_MASK 0xB4F /end MEASUREMENT
/begin MEASUREMENT ed_fil_lank1_obd_slope.art_aktuell_nv "Fehlerart und Statusbits" UWORD FORMULA_0049 0 0 0.0 65535.0 ECU_ADDRESS 0x3F9D1C BIT_MASK 0xB4F /end MEASUREMENT
/begin MEASUREMENT ed_fil_elup_obd.art_aktuell_nv "Fehlerart und Statusbits" UWORD FORMULA_0049 0 0 0.0 65535.0 ECU_ADDRESS 0x3F9D2E BIT_MASK 0xB4F /end MEASUREMENT
/begin MEASUREMENT ed_fil_index_204_inj.art_aktuell_nv "Fehlerart und Statusbits" UWORD FORMULA_0049 0 0 0.0 65535.0 ECU_ADDRESS 0x3F9D3A BIT_MASK 0xB4F /end MEASUREMENT
/begin MEASUREMENT ed_fil_index_205_inj.art_aktuell_nv "Fehlerart und Statusbits" UWORD FORMULA_0049 0 0 0.0 65535.0 ECU_ADDRESS 0x3F9D40 BIT_MASK 0xB4F /end MEASUREMENT
/begin MEASUREMENT ed_fil_index_206_inj.art_aktuell_nv "Fehlerart und Statusbits" UWORD FORMULA_0049 0 0 0.0 65535.0 ECU_ADDRESS 0x3F9D46 BIT_MASK 0xB4F /end MEASUREMENT
/begin MEASUREMENT ed_fil_index_207_inj.art_aktuell_nv "Fehlerart und Statusbits" UWORD FORMULA_0049 0 0 0.0 65535.0 ECU_ADDRESS 0x3F9D4C BIT_MASK 0xB4F /end MEASUREMENT
/begin MEASUREMENT ed_fil_index_208_inj.art_aktuell_nv "Fehlerart und Statusbits" UWORD FORMULA_0049 0 0 0.0 65535.0 ECU_ADDRESS 0x3F9D52 BIT_MASK 0xB4F /end MEASUREMENT
/begin MEASUREMENT ed_fil_index_209_inj.art_aktuell_nv "Fehlerart und Statusbits" UWORD FORMULA_0049 0 0 0.0 65535.0 ECU_ADDRESS 0x3F9D58 BIT_MASK 0xB4F /end MEASUREMENT
/begin MEASUREMENT ed_fil_index_210_inj.art_aktuell_nv "Fehlerart und Statusbits" UWORD FORMULA_0049 0 0 0.0 65535.0 ECU_ADDRESS 0x3F9D5E BIT_MASK 0xB4F /end MEASUREMENT
/begin MEASUREMENT ed_fil_index_211_inj.art_aktuell_nv "Fehlerart und Statusbits" UWORD FORMULA_0049 0 0 0.0 65535.0 ECU_ADDRESS 0x3F9D64 BIT_MASK 0xB4F /end MEASUREMENT
/begin MEASUREMENT ed_fil_index_212_inj.art_aktuell_nv "Fehlerart und Statusbits" UWORD FORMULA_0049 0 0 0.0 65535.0 ECU_ADDRESS 0x3F9D6A BIT_MASK 0xB4F /end MEASUREMENT
/begin MEASUREMENT ed_fil_index_213_inj.art_aktuell_nv "Fehlerart und Statusbits" UWORD FORMULA_0049 0 0 0.0 65535.0 ECU_ADDRESS 0x3F9D70 BIT_MASK 0xB4F /end MEASUREMENT
/begin MEASUREMENT ed_fil_index_214_inj.art_aktuell_nv "Fehlerart und Statusbits" UWORD FORMULA_0049 0 0 0.0 65535.0 ECU_ADDRESS 0x3F9D76 BIT_MASK 0xB4F /end MEASUREMENT
/begin MEASUREMENT ed_fil_index_215_inj.art_aktuell_nv "Fehlerart und Statusbits" UWORD FORMULA_0049 0 0 0.0 65535.0 ECU_ADDRESS 0x3F9D7C BIT_MASK 0xB4F /end MEASUREMENT
/begin MEASUREMENT ed_fil_index_216_inj.art_aktuell_nv "Fehlerart und Statusbits" UWORD FORMULA_0049 0 0 0.0 65535.0 ECU_ADDRESS 0x3F9D82 BIT_MASK 0xB4F /end MEASUREMENT
/begin MEASUREMENT ed_fil_index_217_inj.art_aktuell_nv "Fehlerart und Statusbits" UWORD FORMULA_0049 0 0 0.0 65535.0 ECU_ADDRESS 0x3F9D88 BIT_MASK 0xB4F /end MEASUREMENT
/begin MEASUREMENT ed_fil_index_218_inj.art_aktuell_nv "Fehlerart und Statusbits" UWORD FORMULA_0049 0 0 0.0 65535.0 ECU_ADDRESS 0x3F9D8E BIT_MASK 0xB4F /end MEASUREMENT
/begin MEASUREMENT ed_fil_index_219_inj.art_aktuell_nv "Fehlerart und Statusbits" UWORD FORMULA_0049 0 0 0.0 65535.0 ECU_ADDRESS 0x3F9D94 BIT_MASK 0xB4F /end MEASUREMENT
/begin MEASUREMENT ed_fil_index_220_inj.art_aktuell_nv "Fehlerart und Statusbits" UWORD FORMULA_0049 0 0 0.0 65535.0 ECU_ADDRESS 0x3F9D9A BIT_MASK 0xB4F /end MEASUREMENT
/begin MEASUREMENT ed_fil_index_221_inj.art_aktuell_nv "Fehlerart und Statusbits" UWORD FORMULA_0049 0 0 0.0 65535.0 ECU_ADDRESS 0x3F9DA0 BIT_MASK 0xB4F /end MEASUREMENT
/begin MEASUREMENT ed_fil_index_222_inj.art_aktuell_nv "Fehlerart und Statusbits" UWORD FORMULA_0049 0 0 0.0 65535.0 ECU_ADDRESS 0x3F9DA6 BIT_MASK 0xB4F /end MEASUREMENT
/begin MEASUREMENT ed_fil_index_223_inj.art_aktuell_nv "Fehlerart und Statusbits" UWORD FORMULA_0049 0 0 0.0 65535.0 ECU_ADDRESS 0x3F9DAC BIT_MASK 0xB4F /end MEASUREMENT
/begin MEASUREMENT ed_fil_hfm1.filter_max_nv "Maximaler Fehlerfilterwert" UBYTE FORMULA_0003 0 0 0.0 255.0000 ECU_ADDRESS 0x3F9880 /end MEASUREMENT
/begin MEASUREMENT ed_fil_hfm2.filter_max_nv "Maximaler Fehlerfilterwert" UBYTE FORMULA_0003 0 0 0.0 255.0000 ECU_ADDRESS 0x3F9886 /end MEASUREMENT
/begin MEASUREMENT ed_fil_lank1.filter_max_nv "Maximaler Fehlerfilterwert" UBYTE FORMULA_0003 0 0 0.0 255.0000 ECU_ADDRESS 0x3F9910 /end MEASUREMENT
/begin MEASUREMENT ed_fil_fplau1.filter_max_nv "Maximaler Fehlerfilterwert" UBYTE FORMULA_0003 0 0 0.0 255.0000 ECU_ADDRESS 0x3F995E /end MEASUREMENT
/begin MEASUREMENT ed_fil_fplau2.filter_max_nv "Maximaler Fehlerfilterwert" UBYTE FORMULA_0003 0 0 0.0 255.0000 ECU_ADDRESS 0x3F9964 /end MEASUREMENT
/begin MEASUREMENT ed_fil_lank1_obd_s.filter_max_nv "Maximaler Fehlerfilterwert" UBYTE FORMULA_0003 0 0 0.0 255.0000 ECU_ADDRESS 0x3F9970 /end MEASUREMENT
/begin MEASUREMENT ed_fil_appl_data_inj.filter_max_nv "Maximaler Fehlerfilterwert" UBYTE FORMULA_0003 0 0 0.0 255.0000 ECU_ADDRESS 0x3F9A00 /end MEASUREMENT
/begin MEASUREMENT ed_fil_lam1_reg.filter_max_nv "Maximaler Fehlerfilterwert" UBYTE FORMULA_0003 0 0 0.0 255.0000 ECU_ADDRESS 0x3F9A42 /end MEASUREMENT
/begin MEASUREMENT ed_fil_lam2_reg.filter_max_nv "Maximaler Fehlerfilterwert" UBYTE FORMULA_0003 0 0 0.0 255.0000 ECU_ADDRESS 0x3F9A48 /end MEASUREMENT
/begin MEASUREMENT ed_fil_ev1.filter_max_nv "Maximaler Fehlerfilterwert" UBYTE FORMULA_0003 0 0 0.0 255.0000 ECU_ADDRESS 0x3F9A7E /end MEASUREMENT
/begin MEASUREMENT ed_fil_ev2.filter_max_nv "Maximaler Fehlerfilterwert" UBYTE FORMULA_0003 0 0 0.0 255.0000 ECU_ADDRESS 0x3F9A84 /end MEASUREMENT
/begin MEASUREMENT ed_fil_ev3.filter_max_nv "Maximaler Fehlerfilterwert" UBYTE FORMULA_0003 0 0 0.0 255.0000 ECU_ADDRESS 0x3F9A8A /end MEASUREMENT
/begin MEASUREMENT ed_fil_ev4.filter_max_nv "Maximaler Fehlerfilterwert" UBYTE FORMULA_0003 0 0 0.0 255.0000 ECU_ADDRESS 0x3F9A90 /end MEASUREMENT
/begin MEASUREMENT ed_fil_ev5.filter_max_nv "Maximaler Fehlerfilterwert" UBYTE FORMULA_0003 0 0 0.0 255.0000 ECU_ADDRESS 0x3F9A96 /end MEASUREMENT
/begin MEASUREMENT ed_fil_ev6.filter_max_nv "Maximaler Fehlerfilterwert" UBYTE FORMULA_0003 0 0 0.0 255.0000 ECU_ADDRESS 0x3F9A9C /end MEASUREMENT
/begin MEASUREMENT ed_fil_ev7.filter_max_nv "Maximaler Fehlerfilterwert" UBYTE FORMULA_0003 0 0 0.0 255.0000 ECU_ADDRESS 0x3F9AA2 /end MEASUREMENT
/begin MEASUREMENT ed_fil_ev8.filter_max_nv "Maximaler Fehlerfilterwert" UBYTE FORMULA_0003 0 0 0.0 255.0000 ECU_ADDRESS 0x3F9AA8 /end MEASUREMENT
/begin MEASUREMENT ed_fil_ev9.filter_max_nv "Maximaler Fehlerfilterwert" UBYTE FORMULA_0003 0 0 0.0 255.0000 ECU_ADDRESS 0x3F9AAE /end MEASUREMENT
/begin MEASUREMENT ed_fil_ev10.filter_max_nv "Maximaler Fehlerfilterwert" UBYTE FORMULA_0003 0 0 0.0 255.0000 ECU_ADDRESS 0x3F9AB4 /end MEASUREMENT
/begin MEASUREMENT ed_fil_dmtl_p.filter_max_nv "Maximaler Fehlerfilterwert" UBYTE FORMULA_0003 0 0 0.0 255.0000 ECU_ADDRESS 0x3F9AD8 /end MEASUREMENT
/begin MEASUREMENT ed_fil_dmtl_v.filter_max_nv "Maximaler Fehlerfilterwert" UBYTE FORMULA_0003 0 0 0.0 255.0000 ECU_ADDRESS 0x3F9ADE /end MEASUREMENT
/begin MEASUREMENT ed_fil_dmtl_h.filter_max_nv "Maximaler Fehlerfilterwert" UBYTE FORMULA_0003 0 0 0.0 255.0000 ECU_ADDRESS 0x3F9AE4 /end MEASUREMENT
/begin MEASUREMENT ed_fil_dmtl_grobleck.filter_max_nv "Maximaler Fehlerfilterwert" UBYTE FORMULA_0003 0 0 0.0 255.0000 ECU_ADDRESS 0x3F9AEA /end MEASUREMENT
/begin MEASUREMENT ed_fil_dmtl_feucht.filter_max_nv "Maximaler Fehlerfilterwert" UBYTE FORMULA_0003 0 0 0.0 255.0000 ECU_ADDRESS 0x3F9AF0 /end MEASUREMENT
/begin MEASUREMENT ed_fil_dmtl_deckel.filter_max_nv "Maximaler Fehlerfilterwert" UBYTE FORMULA_0003 0 0 0.0 255.0000 ECU_ADDRESS 0x3F9AF6 /end MEASUREMENT
/begin MEASUREMENT ed_fil_ekp_pwm.filter_max_nv "Maximaler Fehlerfilterwert" UBYTE FORMULA_0003 0 0 0.0 255.0000 ECU_ADDRESS 0x3F9B0E /end MEASUREMENT
/begin MEASUREMENT ed_fil_kat_obd1.filter_max_nv "Maximaler Fehlerfilterwert" UBYTE FORMULA_0003 0 0 0.0 255.0000 ECU_ADDRESS 0x3F9B4A /end MEASUREMENT
/begin MEASUREMENT ed_fil_kat_obd2.filter_max_nv "Maximaler Fehlerfilterwert" UBYTE FORMULA_0003 0 0 0.0 255.0000 ECU_ADDRESS 0x3F9B50 /end MEASUREMENT
/begin MEASUREMENT ed_fil_fi_gen.filter_max_nv "Maximaler Fehlerfilterwert" UBYTE FORMULA_0003 0 0 0.0 255.0000 ECU_ADDRESS 0x3F9B5C /end MEASUREMENT
/begin MEASUREMENT ed_fil_fi_bsd.filter_max_nv "Maximaler Fehlerfilterwert" UBYTE FORMULA_0003 0 0 0.0 255.0000 ECU_ADDRESS 0x3F9B62 /end MEASUREMENT
/begin MEASUREMENT ed_fil_fi_qlt.filter_max_nv "Maximaler Fehlerfilterwert" UBYTE FORMULA_0003 0 0 0.0 255.0000 ECU_ADDRESS 0x3F9B68 /end MEASUREMENT
/begin MEASUREMENT ed_fil_fi_ibs1.filter_max_nv "Maximaler Fehlerfilterwert" UBYTE FORMULA_0003 0 0 0.0 255.0000 ECU_ADDRESS 0x3F9B6E /end MEASUREMENT
/begin MEASUREMENT ed_fil_fi_ibs2.filter_max_nv "Maximaler Fehlerfilterwert" UBYTE FORMULA_0003 0 0 0.0 255.0000 ECU_ADDRESS 0x3F9B74 /end MEASUREMENT
/begin MEASUREMENT ed_fil_fi_ibs3.filter_max_nv "Maximaler Fehlerfilterwert" UBYTE FORMULA_0003 0 0 0.0 255.0000 ECU_ADDRESS 0x3F9B7A /end MEASUREMENT
/begin MEASUREMENT ed_fil_fi_pmbn.filter_max_nv "Maximaler Fehlerfilterwert" UBYTE FORMULA_0003 0 0 0.0 255.0000 ECU_ADDRESS 0x3F9B80 /end MEASUREMENT
/begin MEASUREMENT ed_fil_fi_pmbatt.filter_max_nv "Maximaler Fehlerfilterwert" UBYTE FORMULA_0003 0 0 0.0 255.0000 ECU_ADDRESS 0x3F9B86 /end MEASUREMENT
/begin MEASUREMENT ed_fil_ews_sci.filter_max_nv "Maximaler Fehlerfilterwert" UBYTE FORMULA_0003 0 0 0.0 255.0000 ECU_ADDRESS 0x3F9BA4 /end MEASUREMENT
/begin MEASUREMENT ed_fil_ews_man.filter_max_nv "Maximaler Fehlerfilterwert" UBYTE FORMULA_0003 0 0 0.0 255.0000 ECU_ADDRESS 0x3F9BAA /end MEASUREMENT
/begin MEASUREMENT ed_fil_fi_bsd_0.filter_max_nv "Maximaler Fehlerfilterwert" UBYTE FORMULA_0003 0 0 0.0 255.0000 ECU_ADDRESS 0x3F9BB0 /end MEASUREMENT
/begin MEASUREMENT ed_fil_fi_bsd_6.filter_max_nv "Maximaler Fehlerfilterwert" UBYTE FORMULA_0003 0 0 0.0 255.0000 ECU_ADDRESS 0x3F9BB6 /end MEASUREMENT
/begin MEASUREMENT ed_fil_fi_bsdglob.filter_max_nv "Maximaler Fehlerfilterwert" UBYTE FORMULA_0003 0 0 0.0 255.0000 ECU_ADDRESS 0x3F9BBC /end MEASUREMENT
/begin MEASUREMENT ed_fil_fi_pmruhverl.filter_max_nv "Maximaler Fehlerfilterwert" UBYTE FORMULA_0003 0 0 0.0 255.0000 ECU_ADDRESS 0x3F9BC2 /end MEASUREMENT
/begin MEASUREMENT ed_fil_fi_toens.filter_max_nv "Maximaler Fehlerfilterwert" UBYTE FORMULA_0003 0 0 0.0 255.0000 ECU_ADDRESS 0x3F9BC8 /end MEASUREMENT
/begin MEASUREMENT ed_fil_ebox_elu.filter_max_nv "Maximaler Fehlerfilterwert" UBYTE FORMULA_0003 0 0 0.0 255.0000 ECU_ADDRESS 0x3F9BCE /end MEASUREMENT
/begin MEASUREMENT ed_fil_dk1_enltg.filter_max_nv "Maximaler Fehlerfilterwert" UBYTE FORMULA_0003 0 0 0.0 255.0000 ECU_ADDRESS 0x3F9BDA /end MEASUREMENT
/begin MEASUREMENT ed_fil_dk2_enltg.filter_max_nv "Maximaler Fehlerfilterwert" UBYTE FORMULA_0003 0 0 0.0 255.0000 ECU_ADDRESS 0x3F9BE0 /end MEASUREMENT
/begin MEASUREMENT ed_fil_e2_inj.filter_max_nv "Maximaler Fehlerfilterwert" UBYTE FORMULA_0003 0 0 0.0 255.0000 ECU_ADDRESS 0x3F9C04 /end MEASUREMENT
/begin MEASUREMENT ed_fil_kw.filter_max_nv "Maximaler Fehlerfilterwert" UBYTE FORMULA_0003 0 0 0.0 255.0000 ECU_ADDRESS 0x3F9C0A /end MEASUREMENT
/begin MEASUREMENT ed_fil_la1_adapt.filter_max_nv "Maximaler Fehlerfilterwert" UBYTE FORMULA_0003 0 0 0.0 255.0000 ECU_ADDRESS 0x3F9C10 /end MEASUREMENT
/begin MEASUREMENT ed_fil_la2_adapt.filter_max_nv "Maximaler Fehlerfilterwert" UBYTE FORMULA_0003 0 0 0.0 255.0000 ECU_ADDRESS 0x3F9C16 /end MEASUREMENT
/begin MEASUREMENT ed_fil_kge1.filter_max_nv "Maximaler Fehlerfilterwert" UBYTE FORMULA_0003 0 0 0.0 255.0000 ECU_ADDRESS 0x3F9C1C /end MEASUREMENT
/begin MEASUREMENT ed_fil_kge2.filter_max_nv "Maximaler Fehlerfilterwert" UBYTE FORMULA_0003 0 0 0.0 255.0000 ECU_ADDRESS 0x3F9C22 /end MEASUREMENT
/begin MEASUREMENT ed_fil_fst.filter_max_nv "Maximaler Fehlerfilterwert" UBYTE FORMULA_0003 0 0 0.0 255.0000 ECU_ADDRESS 0x3F9C28 /end MEASUREMENT
/begin MEASUREMENT ed_fil_fetrawe.filter_max_nv "Maximaler Fehlerfilterwert" UBYTE FORMULA_0003 0 0 0.0 255.0000 ECU_ADDRESS 0x3F9C46 /end MEASUREMENT
/begin MEASUREMENT ed_fil_elup.filter_max_nv "Maximaler Fehlerfilterwert" UBYTE FORMULA_0003 0 0 0.0 255.0000 ECU_ADDRESS 0x3F9C5E /end MEASUREMENT
/begin MEASUREMENT ed_fil_elu.filter_max_nv "Maximaler Fehlerfilterwert" UBYTE FORMULA_0003 0 0 0.0 255.0000 ECU_ADDRESS 0x3F9C64 /end MEASUREMENT
/begin MEASUREMENT ed_fil_ksd1.filter_max_nv "Maximaler Fehlerfilterwert" UBYTE FORMULA_0003 0 0 0.0 255.0000 ECU_ADDRESS 0x3F9C70 /end MEASUREMENT
/begin MEASUREMENT ed_fil_ksd2.filter_max_nv "Maximaler Fehlerfilterwert" UBYTE FORMULA_0003 0 0 0.0 255.0000 ECU_ADDRESS 0x3F9C76 /end MEASUREMENT
/begin MEASUREMENT ed_fil_kats_b1.filter_max_nv "Maximaler Fehlerfilterwert" UBYTE FORMULA_0003 0 0 0.0 255.0000 ECU_ADDRESS 0x3F9C7C /end MEASUREMENT
/begin MEASUREMENT ed_fil_kats_b2.filter_max_nv "Maximaler Fehlerfilterwert" UBYTE FORMULA_0003 0 0 0.0 255.0000 ECU_ADDRESS 0x3F9C82 /end MEASUREMENT
/begin MEASUREMENT ed_fil_fst_geber.filter_max_nv "Maximaler Fehlerfilterwert" UBYTE FORMULA_0003 0 0 0.0 255.0000 ECU_ADDRESS 0x3F9C94 /end MEASUREMENT
/begin MEASUREMENT ed_fil_dmtl_feinleck.filter_max_nv "Maximaler Fehlerfilterwert" UBYTE FORMULA_0003 0 0 0.0 255.0000 ECU_ADDRESS 0x3F9CA6 /end MEASUREMENT
/begin MEASUREMENT ed_fil_la1_trim_ad.filter_max_nv "Maximaler Fehlerfilterwert" UBYTE FORMULA_0003 0 0 0.0 255.0000 ECU_ADDRESS 0x3F9CB8 /end MEASUREMENT
/begin MEASUREMENT ed_fil_la2_trim_ad.filter_max_nv "Maximaler Fehlerfilterwert" UBYTE FORMULA_0003 0 0 0.0 255.0000 ECU_ADDRESS 0x3F9CBE /end MEASUREMENT
/begin MEASUREMENT ed_fil_fst_geber_li.filter_max_nv "Maximaler Fehlerfilterwert" UBYTE FORMULA_0003 0 0 0.0 255.0000 ECU_ADDRESS 0x3F9D12 /end MEASUREMENT
/begin MEASUREMENT ed_fil_fst_geber_re.filter_max_nv "Maximaler Fehlerfilterwert" UBYTE FORMULA_0003 0 0 0.0 255.0000 ECU_ADDRESS 0x3F9D18 /end MEASUREMENT
/begin MEASUREMENT ed_fil_lank1_obd_slope.filter_max_nv "Maximaler Fehlerfilterwert" UBYTE FORMULA_0003 0 0 0.0 255.0000 ECU_ADDRESS 0x3F9D1E /end MEASUREMENT
/begin MEASUREMENT ed_fil_elup_obd.filter_max_nv "Maximaler Fehlerfilterwert" UBYTE FORMULA_0003 0 0 0.0 255.0000 ECU_ADDRESS 0x3F9D30 /end MEASUREMENT
/begin MEASUREMENT ed_fil_index_204_inj.filter_max_nv "Maximaler Fehlerfilterwert" UBYTE FORMULA_0003 0 0 0.0 255.0000 ECU_ADDRESS 0x3F9D3C /end MEASUREMENT
/begin MEASUREMENT ed_fil_index_205_inj.filter_max_nv "Maximaler Fehlerfilterwert" UBYTE FORMULA_0003 0 0 0.0 255.0000 ECU_ADDRESS 0x3F9D42 /end MEASUREMENT
/begin MEASUREMENT ed_fil_index_206_inj.filter_max_nv "Maximaler Fehlerfilterwert" UBYTE FORMULA_0003 0 0 0.0 255.0000 ECU_ADDRESS 0x3F9D48 /end MEASUREMENT
/begin MEASUREMENT ed_fil_index_207_inj.filter_max_nv "Maximaler Fehlerfilterwert" UBYTE FORMULA_0003 0 0 0.0 255.0000 ECU_ADDRESS 0x3F9D4E /end MEASUREMENT
/begin MEASUREMENT ed_fil_index_208_inj.filter_max_nv "Maximaler Fehlerfilterwert" UBYTE FORMULA_0003 0 0 0.0 255.0000 ECU_ADDRESS 0x3F9D54 /end MEASUREMENT
/begin MEASUREMENT ed_fil_index_209_inj.filter_max_nv "Maximaler Fehlerfilterwert" UBYTE FORMULA_0003 0 0 0.0 255.0000 ECU_ADDRESS 0x3F9D5A /end MEASUREMENT
/begin MEASUREMENT ed_fil_index_210_inj.filter_max_nv "Maximaler Fehlerfilterwert" UBYTE FORMULA_0003 0 0 0.0 255.0000 ECU_ADDRESS 0x3F9D60 /end MEASUREMENT
/begin MEASUREMENT ed_fil_index_211_inj.filter_max_nv "Maximaler Fehlerfilterwert" UBYTE FORMULA_0003 0 0 0.0 255.0000 ECU_ADDRESS 0x3F9D66 /end MEASUREMENT
/begin MEASUREMENT ed_fil_index_212_inj.filter_max_nv "Maximaler Fehlerfilterwert" UBYTE FORMULA_0003 0 0 0.0 255.0000 ECU_ADDRESS 0x3F9D6C /end MEASUREMENT
/begin MEASUREMENT ed_fil_index_213_inj.filter_max_nv "Maximaler Fehlerfilterwert" UBYTE FORMULA_0003 0 0 0.0 255.0000 ECU_ADDRESS 0x3F9D72 /end MEASUREMENT
/begin MEASUREMENT ed_fil_index_214_inj.filter_max_nv "Maximaler Fehlerfilterwert" UBYTE FORMULA_0003 0 0 0.0 255.0000 ECU_ADDRESS 0x3F9D78 /end MEASUREMENT
/begin MEASUREMENT ed_fil_index_215_inj.filter_max_nv "Maximaler Fehlerfilterwert" UBYTE FORMULA_0003 0 0 0.0 255.0000 ECU_ADDRESS 0x3F9D7E /end MEASUREMENT
/begin MEASUREMENT ed_fil_index_216_inj.filter_max_nv "Maximaler Fehlerfilterwert" UBYTE FORMULA_0003 0 0 0.0 255.0000 ECU_ADDRESS 0x3F9D84 /end MEASUREMENT
/begin MEASUREMENT ed_fil_index_217_inj.filter_max_nv "Maximaler Fehlerfilterwert" UBYTE FORMULA_0003 0 0 0.0 255.0000 ECU_ADDRESS 0x3F9D8A /end MEASUREMENT
/begin MEASUREMENT ed_fil_index_218_inj.filter_max_nv "Maximaler Fehlerfilterwert" UBYTE FORMULA_0003 0 0 0.0 255.0000 ECU_ADDRESS 0x3F9D90 /end MEASUREMENT
/begin MEASUREMENT ed_fil_index_219_inj.filter_max_nv "Maximaler Fehlerfilterwert" UBYTE FORMULA_0003 0 0 0.0 255.0000 ECU_ADDRESS 0x3F9D96 /end MEASUREMENT
/begin MEASUREMENT ed_fil_index_220_inj.filter_max_nv "Maximaler Fehlerfilterwert" UBYTE FORMULA_0003 0 0 0.0 255.0000 ECU_ADDRESS 0x3F9D9C /end MEASUREMENT
/begin MEASUREMENT ed_fil_index_221_inj.filter_max_nv "Maximaler Fehlerfilterwert" UBYTE FORMULA_0003 0 0 0.0 255.0000 ECU_ADDRESS 0x3F9DA2 /end MEASUREMENT
/begin MEASUREMENT ed_fil_index_222_inj.filter_max_nv "Maximaler Fehlerfilterwert" UBYTE FORMULA_0003 0 0 0.0 255.0000 ECU_ADDRESS 0x3F9DA8 /end MEASUREMENT
/begin MEASUREMENT ed_fil_index_223_inj.filter_max_nv "Maximaler Fehlerfilterwert" UBYTE FORMULA_0003 0 0 0.0 255.0000 ECU_ADDRESS 0x3F9DAE /end MEASUREMENT
/begin MEASUREMENT ed_fil_hfm1.fehler_aufrufe_nv "Gesamtzahl der Fehleraufrufe" UBYTE FORMULA_0003 0 0 0.0 255.0000 ECU_ADDRESS 0x3F9881 /end MEASUREMENT
/begin MEASUREMENT ed_fil_hfm2.fehler_aufrufe_nv "Gesamtzahl der Fehleraufrufe" UBYTE FORMULA_0003 0 0 0.0 255.0000 ECU_ADDRESS 0x3F9887 /end MEASUREMENT
/begin MEASUREMENT ed_fil_lank1.fehler_aufrufe_nv "Gesamtzahl der Fehleraufrufe" UBYTE FORMULA_0003 0 0 0.0 255.0000 ECU_ADDRESS 0x3F9911 /end MEASUREMENT
/begin MEASUREMENT ed_fil_fplau1.fehler_aufrufe_nv "Gesamtzahl der Fehleraufrufe" UBYTE FORMULA_0003 0 0 0.0 255.0000 ECU_ADDRESS 0x3F995F /end MEASUREMENT
/begin MEASUREMENT ed_fil_fplau2.fehler_aufrufe_nv "Gesamtzahl der Fehleraufrufe" UBYTE FORMULA_0003 0 0 0.0 255.0000 ECU_ADDRESS 0x3F9965 /end MEASUREMENT
/begin MEASUREMENT ed_fil_lank1_obd_s.fehler_aufrufe_nv "Gesamtzahl der Fehleraufrufe" UBYTE FORMULA_0003 0 0 0.0 255.0000 ECU_ADDRESS 0x3F9971 /end MEASUREMENT
/begin MEASUREMENT ed_fil_appl_data_inj.fehler_aufrufe_nv "Gesamtzahl der Fehleraufrufe" UBYTE FORMULA_0003 0 0 0.0 255.0000 ECU_ADDRESS 0x3F9A01 /end MEASUREMENT
/begin MEASUREMENT ed_fil_lam1_reg.fehler_aufrufe_nv "Gesamtzahl der Fehleraufrufe" UBYTE FORMULA_0003 0 0 0.0 255.0000 ECU_ADDRESS 0x3F9A43 /end MEASUREMENT
/begin MEASUREMENT ed_fil_lam2_reg.fehler_aufrufe_nv "Gesamtzahl der Fehleraufrufe" UBYTE FORMULA_0003 0 0 0.0 255.0000 ECU_ADDRESS 0x3F9A49 /end MEASUREMENT
/begin MEASUREMENT ed_fil_ev1.fehler_aufrufe_nv "Gesamtzahl der Fehleraufrufe" UBYTE FORMULA_0003 0 0 0.0 255.0000 ECU_ADDRESS 0x3F9A7F /end MEASUREMENT
/begin MEASUREMENT ed_fil_ev2.fehler_aufrufe_nv "Gesamtzahl der Fehleraufrufe" UBYTE FORMULA_0003 0 0 0.0 255.0000 ECU_ADDRESS 0x3F9A85 /end MEASUREMENT
/begin MEASUREMENT ed_fil_ev3.fehler_aufrufe_nv "Gesamtzahl der Fehleraufrufe" UBYTE FORMULA_0003 0 0 0.0 255.0000 ECU_ADDRESS 0x3F9A8B /end MEASUREMENT
/begin MEASUREMENT ed_fil_ev4.fehler_aufrufe_nv "Gesamtzahl der Fehleraufrufe" UBYTE FORMULA_0003 0 0 0.0 255.0000 ECU_ADDRESS 0x3F9A91 /end MEASUREMENT
/begin MEASUREMENT ed_fil_ev5.fehler_aufrufe_nv "Gesamtzahl der Fehleraufrufe" UBYTE FORMULA_0003 0 0 0.0 255.0000 ECU_ADDRESS 0x3F9A97 /end MEASUREMENT
/begin MEASUREMENT ed_fil_ev6.fehler_aufrufe_nv "Gesamtzahl der Fehleraufrufe" UBYTE FORMULA_0003 0 0 0.0 255.0000 ECU_ADDRESS 0x3F9A9D /end MEASUREMENT
/begin MEASUREMENT ed_fil_ev7.fehler_aufrufe_nv "Gesamtzahl der Fehleraufrufe" UBYTE FORMULA_0003 0 0 0.0 255.0000 ECU_ADDRESS 0x3F9AA3 /end MEASUREMENT
/begin MEASUREMENT ed_fil_ev8.fehler_aufrufe_nv "Gesamtzahl der Fehleraufrufe" UBYTE FORMULA_0003 0 0 0.0 255.0000 ECU_ADDRESS 0x3F9AA9 /end MEASUREMENT
/begin MEASUREMENT ed_fil_ev9.fehler_aufrufe_nv "Gesamtzahl der Fehleraufrufe" UBYTE FORMULA_0003 0 0 0.0 255.0000 ECU_ADDRESS 0x3F9AAF /end MEASUREMENT
/begin MEASUREMENT ed_fil_ev10.fehler_aufrufe_nv "Gesamtzahl der Fehleraufrufe" UBYTE FORMULA_0003 0 0 0.0 255.0000 ECU_ADDRESS 0x3F9AB5 /end MEASUREMENT
/begin MEASUREMENT ed_fil_dmtl_p.fehler_aufrufe_nv "Gesamtzahl der Fehleraufrufe" UBYTE FORMULA_0003 0 0 0.0 255.0000 ECU_ADDRESS 0x3F9AD9 /end MEASUREMENT
/begin MEASUREMENT ed_fil_dmtl_v.fehler_aufrufe_nv "Gesamtzahl der Fehleraufrufe" UBYTE FORMULA_0003 0 0 0.0 255.0000 ECU_ADDRESS 0x3F9ADF /end MEASUREMENT
/begin MEASUREMENT ed_fil_dmtl_h.fehler_aufrufe_nv "Gesamtzahl der Fehleraufrufe" UBYTE FORMULA_0003 0 0 0.0 255.0000 ECU_ADDRESS 0x3F9AE5 /end MEASUREMENT
/begin MEASUREMENT ed_fil_dmtl_grobleck.fehler_aufrufe_nv "Gesamtzahl der Fehleraufrufe" UBYTE FORMULA_0003 0 0 0.0 255.0000 ECU_ADDRESS 0x3F9AEB /end MEASUREMENT
/begin MEASUREMENT ed_fil_dmtl_feucht.fehler_aufrufe_nv "Gesamtzahl der Fehleraufrufe" UBYTE FORMULA_0003 0 0 0.0 255.0000 ECU_ADDRESS 0x3F9AF1 /end MEASUREMENT
/begin MEASUREMENT ed_fil_dmtl_deckel.fehler_aufrufe_nv "Gesamtzahl der Fehleraufrufe" UBYTE FORMULA_0003 0 0 0.0 255.0000 ECU_ADDRESS 0x3F9AF7 /end MEASUREMENT
/begin MEASUREMENT ed_fil_ekp_pwm.fehler_aufrufe_nv "Gesamtzahl der Fehleraufrufe" UBYTE FORMULA_0003 0 0 0.0 255.0000 ECU_ADDRESS 0x3F9B0F /end MEASUREMENT
/begin MEASUREMENT ed_fil_kat_obd1.fehler_aufrufe_nv "Gesamtzahl der Fehleraufrufe" UBYTE FORMULA_0003 0 0 0.0 255.0000 ECU_ADDRESS 0x3F9B4B /end MEASUREMENT
/begin MEASUREMENT ed_fil_kat_obd2.fehler_aufrufe_nv "Gesamtzahl der Fehleraufrufe" UBYTE FORMULA_0003 0 0 0.0 255.0000 ECU_ADDRESS 0x3F9B51 /end MEASUREMENT
/begin MEASUREMENT ed_fil_fi_gen.fehler_aufrufe_nv "Gesamtzahl der Fehleraufrufe" UBYTE FORMULA_0003 0 0 0.0 255.0000 ECU_ADDRESS 0x3F9B5D /end MEASUREMENT
/begin MEASUREMENT ed_fil_fi_bsd.fehler_aufrufe_nv "Gesamtzahl der Fehleraufrufe" UBYTE FORMULA_0003 0 0 0.0 255.0000 ECU_ADDRESS 0x3F9B63 /end MEASUREMENT
/begin MEASUREMENT ed_fil_fi_qlt.fehler_aufrufe_nv "Gesamtzahl der Fehleraufrufe" UBYTE FORMULA_0003 0 0 0.0 255.0000 ECU_ADDRESS 0x3F9B69 /end MEASUREMENT
/begin MEASUREMENT ed_fil_fi_ibs1.fehler_aufrufe_nv "Gesamtzahl der Fehleraufrufe" UBYTE FORMULA_0003 0 0 0.0 255.0000 ECU_ADDRESS 0x3F9B6F /end MEASUREMENT
/begin MEASUREMENT ed_fil_fi_ibs2.fehler_aufrufe_nv "Gesamtzahl der Fehleraufrufe" UBYTE FORMULA_0003 0 0 0.0 255.0000 ECU_ADDRESS 0x3F9B75 /end MEASUREMENT
/begin MEASUREMENT ed_fil_fi_ibs3.fehler_aufrufe_nv "Gesamtzahl der Fehleraufrufe" UBYTE FORMULA_0003 0 0 0.0 255.0000 ECU_ADDRESS 0x3F9B7B /end MEASUREMENT
/begin MEASUREMENT ed_fil_fi_pmbn.fehler_aufrufe_nv "Gesamtzahl der Fehleraufrufe" UBYTE FORMULA_0003 0 0 0.0 255.0000 ECU_ADDRESS 0x3F9B81 /end MEASUREMENT
/begin MEASUREMENT ed_fil_fi_pmbatt.fehler_aufrufe_nv "Gesamtzahl der Fehleraufrufe" UBYTE FORMULA_0003 0 0 0.0 255.0000 ECU_ADDRESS 0x3F9B87 /end MEASUREMENT
/begin MEASUREMENT ed_fil_ews_sci.fehler_aufrufe_nv "Gesamtzahl der Fehleraufrufe" UBYTE FORMULA_0003 0 0 0.0 255.0000 ECU_ADDRESS 0x3F9BA5 /end MEASUREMENT
/begin MEASUREMENT ed_fil_ews_man.fehler_aufrufe_nv "Gesamtzahl der Fehleraufrufe" UBYTE FORMULA_0003 0 0 0.0 255.0000 ECU_ADDRESS 0x3F9BAB /end MEASUREMENT
/begin MEASUREMENT ed_fil_fi_bsd_0.fehler_aufrufe_nv "Gesamtzahl der Fehleraufrufe" UBYTE FORMULA_0003 0 0 0.0 255.0000 ECU_ADDRESS 0x3F9BB1 /end MEASUREMENT
/begin MEASUREMENT ed_fil_fi_bsd_6.fehler_aufrufe_nv "Gesamtzahl der Fehleraufrufe" UBYTE FORMULA_0003 0 0 0.0 255.0000 ECU_ADDRESS 0x3F9BB7 /end MEASUREMENT
/begin MEASUREMENT ed_fil_fi_bsdglob.fehler_aufrufe_nv "Gesamtzahl der Fehleraufrufe" UBYTE FORMULA_0003 0 0 0.0 255.0000 ECU_ADDRESS 0x3F9BBD /end MEASUREMENT
/begin MEASUREMENT ed_fil_fi_pmruhverl.fehler_aufrufe_nv "Gesamtzahl der Fehleraufrufe" UBYTE FORMULA_0003 0 0 0.0 255.0000 ECU_ADDRESS 0x3F9BC3 /end MEASUREMENT
/begin MEASUREMENT ed_fil_fi_toens.fehler_aufrufe_nv "Gesamtzahl der Fehleraufrufe" UBYTE FORMULA_0003 0 0 0.0 255.0000 ECU_ADDRESS 0x3F9BC9 /end MEASUREMENT
/begin MEASUREMENT ed_fil_ebox_elu.fehler_aufrufe_nv "Gesamtzahl der Fehleraufrufe" UBYTE FORMULA_0003 0 0 0.0 255.0000 ECU_ADDRESS 0x3F9BCF /end MEASUREMENT
/begin MEASUREMENT ed_fil_dk1_enltg.fehler_aufrufe_nv "Gesamtzahl der Fehleraufrufe" UBYTE FORMULA_0003 0 0 0.0 255.0000 ECU_ADDRESS 0x3F9BDB /end MEASUREMENT
/begin MEASUREMENT ed_fil_dk2_enltg.fehler_aufrufe_nv "Gesamtzahl der Fehleraufrufe" UBYTE FORMULA_0003 0 0 0.0 255.0000 ECU_ADDRESS 0x3F9BE1 /end MEASUREMENT
/begin MEASUREMENT ed_fil_e2_inj.fehler_aufrufe_nv "Gesamtzahl der Fehleraufrufe" UBYTE FORMULA_0003 0 0 0.0 255.0000 ECU_ADDRESS 0x3F9C05 /end MEASUREMENT
/begin MEASUREMENT ed_fil_kw.fehler_aufrufe_nv "Gesamtzahl der Fehleraufrufe" UBYTE FORMULA_0003 0 0 0.0 255.0000 ECU_ADDRESS 0x3F9C0B /end MEASUREMENT
/begin MEASUREMENT ed_fil_la1_adapt.fehler_aufrufe_nv "Gesamtzahl der Fehleraufrufe" UBYTE FORMULA_0003 0 0 0.0 255.0000 ECU_ADDRESS 0x3F9C11 /end MEASUREMENT
/begin MEASUREMENT ed_fil_la2_adapt.fehler_aufrufe_nv "Gesamtzahl der Fehleraufrufe" UBYTE FORMULA_0003 0 0 0.0 255.0000 ECU_ADDRESS 0x3F9C17 /end MEASUREMENT
/begin MEASUREMENT ed_fil_kge1.fehler_aufrufe_nv "Gesamtzahl der Fehleraufrufe" UBYTE FORMULA_0003 0 0 0.0 255.0000 ECU_ADDRESS 0x3F9C1D /end MEASUREMENT
/begin MEASUREMENT ed_fil_kge2.fehler_aufrufe_nv "Gesamtzahl der Fehleraufrufe" UBYTE FORMULA_0003 0 0 0.0 255.0000 ECU_ADDRESS 0x3F9C23 /end MEASUREMENT
/begin MEASUREMENT ed_fil_fst.fehler_aufrufe_nv "Gesamtzahl der Fehleraufrufe" UBYTE FORMULA_0003 0 0 0.0 255.0000 ECU_ADDRESS 0x3F9C29 /end MEASUREMENT
/begin MEASUREMENT ed_fil_fetrawe.fehler_aufrufe_nv "Gesamtzahl der Fehleraufrufe" UBYTE FORMULA_0003 0 0 0.0 255.0000 ECU_ADDRESS 0x3F9C47 /end MEASUREMENT
/begin MEASUREMENT ed_fil_elup.fehler_aufrufe_nv "Gesamtzahl der Fehleraufrufe" UBYTE FORMULA_0003 0 0 0.0 255.0000 ECU_ADDRESS 0x3F9C5F /end MEASUREMENT
/begin MEASUREMENT ed_fil_elu.fehler_aufrufe_nv "Gesamtzahl der Fehleraufrufe" UBYTE FORMULA_0003 0 0 0.0 255.0000 ECU_ADDRESS 0x3F9C65 /end MEASUREMENT
/begin MEASUREMENT ed_fil_ksd1.fehler_aufrufe_nv "Gesamtzahl der Fehleraufrufe" UBYTE FORMULA_0003 0 0 0.0 255.0000 ECU_ADDRESS 0x3F9C71 /end MEASUREMENT
/begin MEASUREMENT ed_fil_ksd2.fehler_aufrufe_nv "Gesamtzahl der Fehleraufrufe" UBYTE FORMULA_0003 0 0 0.0 255.0000 ECU_ADDRESS 0x3F9C77 /end MEASUREMENT
/begin MEASUREMENT ed_fil_kats_b1.fehler_aufrufe_nv "Gesamtzahl der Fehleraufrufe" UBYTE FORMULA_0003 0 0 0.0 255.0000 ECU_ADDRESS 0x3F9C7D /end MEASUREMENT
/begin MEASUREMENT ed_fil_kats_b2.fehler_aufrufe_nv "Gesamtzahl der Fehleraufrufe" UBYTE FORMULA_0003 0 0 0.0 255.0000 ECU_ADDRESS 0x3F9C83 /end MEASUREMENT
/begin MEASUREMENT ed_fil_fst_geber.fehler_aufrufe_nv "Gesamtzahl der Fehleraufrufe" UBYTE FORMULA_0003 0 0 0.0 255.0000 ECU_ADDRESS 0x3F9C95 /end MEASUREMENT
/begin MEASUREMENT ed_fil_dmtl_feinleck.fehler_aufrufe_nv "Gesamtzahl der Fehleraufrufe" UBYTE FORMULA_0003 0 0 0.0 255.0000 ECU_ADDRESS 0x3F9CA7 /end MEASUREMENT
/begin MEASUREMENT ed_fil_la1_trim_ad.fehler_aufrufe_nv "Gesamtzahl der Fehleraufrufe" UBYTE FORMULA_0003 0 0 0.0 255.0000 ECU_ADDRESS 0x3F9CB9 /end MEASUREMENT
/begin MEASUREMENT ed_fil_la2_trim_ad.fehler_aufrufe_nv "Gesamtzahl der Fehleraufrufe" UBYTE FORMULA_0003 0 0 0.0 255.0000 ECU_ADDRESS 0x3F9CBF /end MEASUREMENT
/begin MEASUREMENT ed_fil_fst_geber_li.fehler_aufrufe_nv "Gesamtzahl der Fehleraufrufe" UBYTE FORMULA_0003 0 0 0.0 255.0000 ECU_ADDRESS 0x3F9D13 /end MEASUREMENT
/begin MEASUREMENT ed_fil_fst_geber_re.fehler_aufrufe_nv "Gesamtzahl der Fehleraufrufe" UBYTE FORMULA_0003 0 0 0.0 255.0000 ECU_ADDRESS 0x3F9D19 /end MEASUREMENT
/begin MEASUREMENT ed_fil_lank1_obd_slope.fehler_aufrufe_nv "Gesamtzahl der Fehleraufrufe" UBYTE FORMULA_0003 0 0 0.0 255.0000 ECU_ADDRESS 0x3F9D1F /end MEASUREMENT
/begin MEASUREMENT ed_fil_elup_obd.fehler_aufrufe_nv "Gesamtzahl der Fehleraufrufe" UBYTE FORMULA_0003 0 0 0.0 255.0000 ECU_ADDRESS 0x3F9D31 /end MEASUREMENT
/begin MEASUREMENT ed_fil_index_204_inj.fehler_aufrufe_nv "Gesamtzahl der Fehleraufrufe" UBYTE FORMULA_0003 0 0 0.0 255.0000 ECU_ADDRESS 0x3F9D3D /end MEASUREMENT
/begin MEASUREMENT ed_fil_index_205_inj.fehler_aufrufe_nv "Gesamtzahl der Fehleraufrufe" UBYTE FORMULA_0003 0 0 0.0 255.0000 ECU_ADDRESS 0x3F9D43 /end MEASUREMENT
/begin MEASUREMENT ed_fil_index_206_inj.fehler_aufrufe_nv "Gesamtzahl der Fehleraufrufe" UBYTE FORMULA_0003 0 0 0.0 255.0000 ECU_ADDRESS 0x3F9D49 /end MEASUREMENT
/begin MEASUREMENT ed_fil_index_207_inj.fehler_aufrufe_nv "Gesamtzahl der Fehleraufrufe" UBYTE FORMULA_0003 0 0 0.0 255.0000 ECU_ADDRESS 0x3F9D4F /end MEASUREMENT
/begin MEASUREMENT ed_fil_index_208_inj.fehler_aufrufe_nv "Gesamtzahl der Fehleraufrufe" UBYTE FORMULA_0003 0 0 0.0 255.0000 ECU_ADDRESS 0x3F9D55 /end MEASUREMENT
/begin MEASUREMENT ed_fil_index_209_inj.fehler_aufrufe_nv "Gesamtzahl der Fehleraufrufe" UBYTE FORMULA_0003 0 0 0.0 255.0000 ECU_ADDRESS 0x3F9D5B /end MEASUREMENT
/begin MEASUREMENT ed_fil_index_210_inj.fehler_aufrufe_nv "Gesamtzahl der Fehleraufrufe" UBYTE FORMULA_0003 0 0 0.0 255.0000 ECU_ADDRESS 0x3F9D61 /end MEASUREMENT
/begin MEASUREMENT ed_fil_index_211_inj.fehler_aufrufe_nv "Gesamtzahl der Fehleraufrufe" UBYTE FORMULA_0003 0 0 0.0 255.0000 ECU_ADDRESS 0x3F9D67 /end MEASUREMENT
/begin MEASUREMENT ed_fil_index_212_inj.fehler_aufrufe_nv "Gesamtzahl der Fehleraufrufe" UBYTE FORMULA_0003 0 0 0.0 255.0000 ECU_ADDRESS 0x3F9D6D /end MEASUREMENT
/begin MEASUREMENT ed_fil_index_213_inj.fehler_aufrufe_nv "Gesamtzahl der Fehleraufrufe" UBYTE FORMULA_0003 0 0 0.0 255.0000 ECU_ADDRESS 0x3F9D73 /end MEASUREMENT
/begin MEASUREMENT ed_fil_index_214_inj.fehler_aufrufe_nv "Gesamtzahl der Fehleraufrufe" UBYTE FORMULA_0003 0 0 0.0 255.0000 ECU_ADDRESS 0x3F9D79 /end MEASUREMENT
/begin MEASUREMENT ed_fil_index_215_inj.fehler_aufrufe_nv "Gesamtzahl der Fehleraufrufe" UBYTE FORMULA_0003 0 0 0.0 255.0000 ECU_ADDRESS 0x3F9D7F /end MEASUREMENT
/begin MEASUREMENT ed_fil_index_216_inj.fehler_aufrufe_nv "Gesamtzahl der Fehleraufrufe" UBYTE FORMULA_0003 0 0 0.0 255.0000 ECU_ADDRESS 0x3F9D85 /end MEASUREMENT
/begin MEASUREMENT ed_fil_index_217_inj.fehler_aufrufe_nv "Gesamtzahl der Fehleraufrufe" UBYTE FORMULA_0003 0 0 0.0 255.0000 ECU_ADDRESS 0x3F9D8B /end MEASUREMENT
/begin MEASUREMENT ed_fil_index_218_inj.fehler_aufrufe_nv "Gesamtzahl der Fehleraufrufe" UBYTE FORMULA_0003 0 0 0.0 255.0000 ECU_ADDRESS 0x3F9D91 /end MEASUREMENT
/begin MEASUREMENT ed_fil_index_219_inj.fehler_aufrufe_nv "Gesamtzahl der Fehleraufrufe" UBYTE FORMULA_0003 0 0 0.0 255.0000 ECU_ADDRESS 0x3F9D97 /end MEASUREMENT
/begin MEASUREMENT ed_fil_index_220_inj.fehler_aufrufe_nv "Gesamtzahl der Fehleraufrufe" UBYTE FORMULA_0003 0 0 0.0 255.0000 ECU_ADDRESS 0x3F9D9D /end MEASUREMENT
/begin MEASUREMENT ed_fil_index_221_inj.fehler_aufrufe_nv "Gesamtzahl der Fehleraufrufe" UBYTE FORMULA_0003 0 0 0.0 255.0000 ECU_ADDRESS 0x3F9DA3 /end MEASUREMENT
/begin MEASUREMENT ed_fil_index_222_inj.fehler_aufrufe_nv "Gesamtzahl der Fehleraufrufe" UBYTE FORMULA_0003 0 0 0.0 255.0000 ECU_ADDRESS 0x3F9DA9 /end MEASUREMENT
/begin MEASUREMENT ed_fil_index_223_inj.fehler_aufrufe_nv "Gesamtzahl der Fehleraufrufe" UBYTE FORMULA_0003 0 0 0.0 255.0000 ECU_ADDRESS 0x3F9DAF /end MEASUREMENT
/begin MEASUREMENT ed_debug_laufzeit "Laufzeitmessung" ULONG FORMULA_0074 0 0 0.0 4294967295.0000 ECU_ADDRESS 0x3FBF60 /end MEASUREMENT
/* ------------------ Abschnitt erzeugt aus eeprom.dat ------------------ */
/begin MEASUREMENT eeprom_seite_lesen "Wo wurde der letzte Datensatz gefunden" UBYTE FORMULA_0080 0 0 0.0 255.0 ECU_ADDRESS 0x3FBF64 /end MEASUREMENT
/begin MEASUREMENT eeprom_seite_lesen_hdw "Wo wurde der letzte HDW-Datensatz gefunden" UBYTE FORMULA_0080 0 0 0.0 255.0 ECU_ADDRESS 0x3FBF65 /end MEASUREMENT
/begin MEASUREMENT eeprom_seite_schreiben "Wo hin soll der naechste Datensatz geschrieben werden" UBYTE FORMULA_0081 0 0 0.0 255.0 ECU_ADDRESS 0x3FBF66 /end MEASUREMENT
/begin MEASUREMENT eeprom_st "Status der EEPROM-Emulation" UBYTE FORMULA_0082 0 0 0.0 255.0 ECU_ADDRESS 0x3FBF67 /end MEASUREMENT
/* ------------------ Abschnitt erzeugt aus n.dat ------------------ */
/begin CHARACTERISTIC K_N_ZEIT_STOERUNG "Einfrierzeit Drehzahlerfassung nach TPU Stoerung | EN: Freeze time of speed sensing after TPU fault [s]" VALUE 0x74C62 TKW_VV_VV_SB 100.0 FORMULA_0317 0.0 1.2700 /end CHARACTERISTIC
/begin CHARACTERISTIC K_N_OBERGRENZE "Plausibilitaetsgrenze fuer die n-Erfassung | EN: Plausibility limit for engine-speed sensing [Upm]" VALUE 0x74C64 TKW_VV_VV_SW 100.0 FORMULA_0006 0.0 20000.0000 /end CHARACTERISTIC
/begin CHARACTERISTIC K_N_MIN_FREEZE "Minimale Eintrittsdrehzahl fuer Drehzahl-Freeze | EN: Minimum entry speed for engine-speed freeze [Upm]" VALUE 0x74C66 TKW_VV_VV_SW 100.0 FORMULA_0006 0.0 10000.0000 /end CHARACTERISTIC
/begin MEASUREMENT n_st_a "Status Drehzahlerfassung" UBYTE FORMULA_0348 0 0 0.0 255.0 ECU_ADDRESS 0x3FCA78 /end MEASUREMENT
/begin MEASUREMENT n_st_b "Status Drehzahlerfassung" UBYTE FORMULA_0348 0 0 0.0 255.0 ECU_ADDRESS 0x3FCA79 /end MEASUREMENT
/begin MEASUREMENT n_timer_stoerung_a "Zeitzaehler fuer Freeze Drehzahlerfassung" SBYTE FORMULA_0317 0 0 -1.2800 1.2700 ECU_ADDRESS 0x3FCA7A /end MEASUREMENT
/begin MEASUREMENT n_timer_stoerung_b "Zeitzaehler fuer Freeze Drehzahlerfassung" SBYTE FORMULA_0317 0 0 -1.2800 1.2700 ECU_ADDRESS 0x3FCA7B /end MEASUREMENT
/begin MEASUREMENT n_proz "Ersatzdrehzahl des jeweiligen Prozessors." SWORD FORMULA_0006 0 0 0.0 10000.0000 ECU_ADDRESS 0x3FCA7C /end MEASUREMENT
/begin MEASUREMENT n_zahn_a "Drehzahl aus Zahnabstand" SWORD FORMULA_0006 0 0 0.0 10000.0000 ECU_ADDRESS 0x3FCA7E /end MEASUREMENT
/begin MEASUREMENT n_zahn_b "Drehzahl aus Zahnabstand" SWORD FORMULA_0006 0 0 0.0 10000.0000 ECU_ADDRESS 0x3FCA80 /end MEASUREMENT
/begin MEASUREMENT n_segm_a "Drehzahl aus Segmentabstand." SWORD FORMULA_0006 0 0 0.0 10000.0000 ECU_ADDRESS 0x3FCA82 /end MEASUREMENT
/begin MEASUREMENT n_segm_b "Drehzahl aus Segmentabstand." SWORD FORMULA_0006 0 0 0.0 10000.0000 ECU_ADDRESS 0x3FCA84 /end MEASUREMENT
/begin MEASUREMENT n_t_segm_a "Segmentzeit." UWORD FORMULA_0349 0 0 0.0 104.8560 ECU_ADDRESS 0x3FCA86 /end MEASUREMENT
/begin MEASUREMENT n_t_segm_b "Segmentzeit." UWORD FORMULA_0349 0 0 0.0 104.8560 ECU_ADDRESS 0x3FCA88 /end MEASUREMENT
/begin MEASUREMENT n_t_segm_start_a "Segmentstartzeit." ULONG FORMULA_0017 0 0 0.0 2396.7450 ECU_ADDRESS 0x3FCA8C /end MEASUREMENT
/begin MEASUREMENT n_t_segm_start_b "Segmentstartzeit." ULONG FORMULA_0017 0 0 0.0 2396.7450 ECU_ADDRESS 0x3FCA90 /end MEASUREMENT
/* ------------------ Abschnitt erzeugt aus os.dat ------------------ */
/begin MEASUREMENT os_err.id.cnt "OS-Err: ID" UBYTE FORMULA_0003 0 0 0.0 255.0000 ECU_ADDRESS 0x3FCBF4 /end MEASUREMENT
/begin MEASUREMENT os_err.id.task "OS-Err: ID" UBYTE FORMULA_0350 0 0 0.0 255.0 ECU_ADDRESS 0x3FCBF5 /end MEASUREMENT
/begin MEASUREMENT os_err.limit.cnt "OS-Err: Limit" UBYTE FORMULA_0003 0 0 0.0 255.0000 ECU_ADDRESS 0x3FCBF6 /end MEASUREMENT
/begin MEASUREMENT os_err.limit.task "OS-Err: Limit" UBYTE FORMULA_0350 0 0 0.0 255.0 ECU_ADDRESS 0x3FCBF7 /end MEASUREMENT
/begin MEASUREMENT os_err.tt_act.cnt "OS-Err: TT aktiv" UBYTE FORMULA_0003 0 0 0.0 255.0000 ECU_ADDRESS 0x3FCBF8 /end MEASUREMENT
/begin MEASUREMENT os_err.tt_act.task "OS-Err: TT aktiv" UBYTE FORMULA_0350 0 0 0.0 255.0 ECU_ADDRESS 0x3FCBF9 /end MEASUREMENT
/begin MEASUREMENT os_err.no_fnc.cnt "OS-Err: No Fkt" UBYTE FORMULA_0003 0 0 0.0 255.0000 ECU_ADDRESS 0x3FCBFA /end MEASUREMENT
/begin MEASUREMENT os_err.no_fnc.task "OS-Err: No Fkt" UBYTE FORMULA_0350 0 0 0.0 255.0 ECU_ADDRESS 0x3FCBFB /end MEASUREMENT
/begin MEASUREMENT os_err.tt_miss.cnt "OS-Err: TT missing" UBYTE FORMULA_0003 0 0 0.0 255.0000 ECU_ADDRESS 0x3FCBFC /end MEASUREMENT
/begin MEASUREMENT os_err.tt_miss.task "OS-Err: TT missing" UBYTE FORMULA_0350 0 0 0.0 255.0 ECU_ADDRESS 0x3FCBFD /end MEASUREMENT
/begin MEASUREMENT os_err.stack.cnt "OS-Err: Stack" UBYTE FORMULA_0003 0 0 0.0 255.0000 ECU_ADDRESS 0x3FCBFE /end MEASUREMENT
/begin MEASUREMENT os_err.stack.task "OS-Err: Stack" UBYTE FORMULA_0350 0 0 0.0 255.0 ECU_ADDRESS 0x3FCBFF /end MEASUREMENT
/begin MEASUREMENT os_err.fifo.cnt "OS-Err: FIFO full" UBYTE FORMULA_0003 0 0 0.0 255.0000 ECU_ADDRESS 0x3FCC00 /end MEASUREMENT
/begin MEASUREMENT os_err.fifo.task "OS-Err: FIFO full" UBYTE FORMULA_0350 0 0 0.0 255.0 ECU_ADDRESS 0x3FCC01 /end MEASUREMENT
/begin MEASUREMENT os_err.value.cnt "OS-Err: Value" UBYTE FORMULA_0003 0 0 0.0 255.0000 ECU_ADDRESS 0x3FCC02 /end MEASUREMENT
/begin MEASUREMENT os_err.value.task "OS-Err: Value" UBYTE FORMULA_0350 0 0 0.0 255.0 ECU_ADDRESS 0x3FCC03 /end MEASUREMENT
/begin MEASUREMENT os_err.deadline.cnt "OS-Err: Deadline" UBYTE FORMULA_0003 0 0 0.0 255.0000 ECU_ADDRESS 0x3FCC04 /end MEASUREMENT
/begin MEASUREMENT os_err.deadline.task "OS-Err: Deadline" UBYTE FORMULA_0350 0 0 0.0 255.0 ECU_ADDRESS 0x3FCC05 /end MEASUREMENT
/begin MEASUREMENT os_err.dflt.cnt "OS-Err: Default" UBYTE FORMULA_0003 0 0 0.0 255.0000 ECU_ADDRESS 0x3FCC06 /end MEASUREMENT
/begin MEASUREMENT os_err.dflt.task "OS-Err: Default" UBYTE FORMULA_0350 0 0 0.0 255.0 ECU_ADDRESS 0x3FCC07 /end MEASUREMENT
/begin MEASUREMENT os_err.addr "OS-Err: Adresse" ULONG FORMULA_0000 0 0 0.0 4294967295.0000 ECU_ADDRESS 0x3FCC08 /end MEASUREMENT
/begin MEASUREMENT os_err.sum_cnt "OS-Err: Summe" UBYTE FORMULA_0003 0 0 0.0 255.0000 ECU_ADDRESS 0x3FCC0C /end MEASUREMENT
/begin MEASUREMENT os_err.type "Fehlertyp" UBYTE FORMULA_0351 0 0 0.0 255.0 ECU_ADDRESS 0x3FCC0D /end MEASUREMENT
/* ------------------ Abschnitt erzeugt aus bsd.dat ------------------ */
/begin CHARACTERISTIC K_BSD_BUS_ENABLE "BSD Bus aktivieren. | EN: Activate BSD bus" VALUE 0x70753 TKW_VV_VV_UB 100.0 FORMULA_0003 0.0 1.0000 /end CHARACTERISTIC
/begin MEASUREMENT bsd_error "BSD Bus Fehler." UBYTE FORMULA_0607 0 0 0.0 255.0 ECU_ADDRESS 0x3FBDA8 /end MEASUREMENT
/begin MEASUREMENT Bsd_status_1of8_ "Bearbeitungsstatus BSD pro Device:" UBYTE FORMULA_0608 0 0 0.0 255.0 ECU_ADDRESS 0x3FBDA9 /end MEASUREMENT
/begin MEASUREMENT Bsd_status_2of8_ "Bearbeitungsstatus BSD pro Device:" UBYTE FORMULA_0608 0 0 0.0 255.0 ECU_ADDRESS 0x3FBDAA /end MEASUREMENT
/begin MEASUREMENT Bsd_status_3of8_ "Bearbeitungsstatus BSD pro Device:" UBYTE FORMULA_0608 0 0 0.0 255.0 ECU_ADDRESS 0x3FBDAB /end MEASUREMENT
/begin MEASUREMENT Bsd_status_4of8_ "Bearbeitungsstatus BSD pro Device:" UBYTE FORMULA_0608 0 0 0.0 255.0 ECU_ADDRESS 0x3FBDAC /end MEASUREMENT
/begin MEASUREMENT Bsd_status_5of8_ "Bearbeitungsstatus BSD pro Device:" UBYTE FORMULA_0608 0 0 0.0 255.0 ECU_ADDRESS 0x3FBDAD /end MEASUREMENT
/begin MEASUREMENT Bsd_status_6of8_ "Bearbeitungsstatus BSD pro Device:" UBYTE FORMULA_0608 0 0 0.0 255.0 ECU_ADDRESS 0x3FBDAE /end MEASUREMENT
/begin MEASUREMENT Bsd_status_7of8_ "Bearbeitungsstatus BSD pro Device:" UBYTE FORMULA_0608 0 0 0.0 255.0 ECU_ADDRESS 0x3FBDAF /end MEASUREMENT
/begin MEASUREMENT Bsd_status_8of8_ "Bearbeitungsstatus BSD pro Device:" UBYTE FORMULA_0608 0 0 0.0 255.0 ECU_ADDRESS 0x3FBDB0 /end MEASUREMENT
/begin MEASUREMENT Bsd_slot_idx "aktueller Slot der BSD fuer Device:" UBYTE FORMULA_0003 0 0 0.0 255.0000 ECU_ADDRESS 0x3FBDB1 /end MEASUREMENT
/begin MEASUREMENT Bsd_cur_dev "aktuelles Device BSD zugeordnet" UBYTE FORMULA_0003 0 0 0.0 255.0000 ECU_ADDRESS 0x3FBDB2 /end MEASUREMENT
/* ------------------ Abschnitt erzeugt aus bsd_conf.dat ------------------ */
/begin CHARACTERISTIC K_BSD_SCHEDTAB_1of32_ "BSD Schedulertabelle | EN: BSD Schedulertabelle" VALUE 0x70754 TKW_VV_VV_UB 100.0 FORMULA_0483 0.0 8.0000 /end CHARACTERISTIC
/begin CHARACTERISTIC K_BSD_SCHEDTAB_2of32_ "BSD Schedulertabelle | EN: BSD Schedulertabelle" VALUE 0x70755 TKW_VV_VV_UB 100.0 FORMULA_0483 0.0 8.0000 /end CHARACTERISTIC
/begin CHARACTERISTIC K_BSD_SCHEDTAB_3of32_ "BSD Schedulertabelle | EN: BSD Schedulertabelle" VALUE 0x70756 TKW_VV_VV_UB 100.0 FORMULA_0483 0.0 8.0000 /end CHARACTERISTIC
/begin CHARACTERISTIC K_BSD_SCHEDTAB_4of32_ "BSD Schedulertabelle | EN: BSD Schedulertabelle" VALUE 0x70757 TKW_VV_VV_UB 100.0 FORMULA_0483 0.0 8.0000 /end CHARACTERISTIC
/begin CHARACTERISTIC K_BSD_SCHEDTAB_5of32_ "BSD Schedulertabelle | EN: BSD Schedulertabelle" VALUE 0x70758 TKW_VV_VV_UB 100.0 FORMULA_0483 0.0 8.0000 /end CHARACTERISTIC
/begin CHARACTERISTIC K_BSD_SCHEDTAB_6of32_ "BSD Schedulertabelle | EN: BSD Schedulertabelle" VALUE 0x70759 TKW_VV_VV_UB 100.0 FORMULA_0483 0.0 8.0000 /end CHARACTERISTIC
/begin CHARACTERISTIC K_BSD_SCHEDTAB_7of32_ "BSD Schedulertabelle | EN: BSD Schedulertabelle" VALUE 0x7075A TKW_VV_VV_UB 100.0 FORMULA_0483 0.0 8.0000 /end CHARACTERISTIC
/begin CHARACTERISTIC K_BSD_SCHEDTAB_8of32_ "BSD Schedulertabelle | EN: BSD Schedulertabelle" VALUE 0x7075B TKW_VV_VV_UB 100.0 FORMULA_0483 0.0 8.0000 /end CHARACTERISTIC
/begin CHARACTERISTIC K_BSD_SCHEDTAB_9of32_ "BSD Schedulertabelle | EN: BSD Schedulertabelle" VALUE 0x7075C TKW_VV_VV_UB 100.0 FORMULA_0483 0.0 8.0000 /end CHARACTERISTIC
/begin CHARACTERISTIC K_BSD_SCHEDTAB_10of32_ "BSD Schedulertabelle | EN: BSD Schedulertabelle" VALUE 0x7075D TKW_VV_VV_UB 100.0 FORMULA_0483 0.0 8.0000 /end CHARACTERISTIC
/begin CHARACTERISTIC K_BSD_SCHEDTAB_11of32_ "BSD Schedulertabelle | EN: BSD Schedulertabelle" VALUE 0x7075E TKW_VV_VV_UB 100.0 FORMULA_0483 0.0 8.0000 /end CHARACTERISTIC
/begin CHARACTERISTIC K_BSD_SCHEDTAB_12of32_ "BSD Schedulertabelle | EN: BSD Schedulertabelle" VALUE 0x7075F TKW_VV_VV_UB 100.0 FORMULA_0483 0.0 8.0000 /end CHARACTERISTIC
/begin CHARACTERISTIC K_BSD_SCHEDTAB_13of32_ "BSD Schedulertabelle | EN: BSD Schedulertabelle" VALUE 0x70760 TKW_VV_VV_UB 100.0 FORMULA_0483 0.0 8.0000 /end CHARACTERISTIC
/begin CHARACTERISTIC K_BSD_SCHEDTAB_14of32_ "BSD Schedulertabelle | EN: BSD Schedulertabelle" VALUE 0x70761 TKW_VV_VV_UB 100.0 FORMULA_0483 0.0 8.0000 /end CHARACTERISTIC
/begin CHARACTERISTIC K_BSD_SCHEDTAB_15of32_ "BSD Schedulertabelle | EN: BSD Schedulertabelle" VALUE 0x70762 TKW_VV_VV_UB 100.0 FORMULA_0483 0.0 8.0000 /end CHARACTERISTIC
/begin CHARACTERISTIC K_BSD_SCHEDTAB_16of32_ "BSD Schedulertabelle | EN: BSD Schedulertabelle" VALUE 0x70763 TKW_VV_VV_UB 100.0 FORMULA_0483 0.0 8.0000 /end CHARACTERISTIC
/begin CHARACTERISTIC K_BSD_SCHEDTAB_17of32_ "BSD Schedulertabelle | EN: BSD Schedulertabelle" VALUE 0x70764 TKW_VV_VV_UB 100.0 FORMULA_0483 0.0 8.0000 /end CHARACTERISTIC
/begin CHARACTERISTIC K_BSD_SCHEDTAB_18of32_ "BSD Schedulertabelle | EN: BSD Schedulertabelle" VALUE 0x70765 TKW_VV_VV_UB 100.0 FORMULA_0483 0.0 8.0000 /end CHARACTERISTIC
/begin CHARACTERISTIC K_BSD_SCHEDTAB_19of32_ "BSD Schedulertabelle | EN: BSD Schedulertabelle" VALUE 0x70766 TKW_VV_VV_UB 100.0 FORMULA_0483 0.0 8.0000 /end CHARACTERISTIC
/begin CHARACTERISTIC K_BSD_SCHEDTAB_20of32_ "BSD Schedulertabelle | EN: BSD Schedulertabelle" VALUE 0x70767 TKW_VV_VV_UB 100.0 FORMULA_0483 0.0 8.0000 /end CHARACTERISTIC
/begin CHARACTERISTIC K_BSD_SCHEDTAB_21of32_ "BSD Schedulertabelle | EN: BSD Schedulertabelle" VALUE 0x70768 TKW_VV_VV_UB 100.0 FORMULA_0483 0.0 8.0000 /end CHARACTERISTIC
/begin CHARACTERISTIC K_BSD_SCHEDTAB_22of32_ "BSD Schedulertabelle | EN: BSD Schedulertabelle" VALUE 0x70769 TKW_VV_VV_UB 100.0 FORMULA_0483 0.0 8.0000 /end CHARACTERISTIC
/begin CHARACTERISTIC K_BSD_SCHEDTAB_23of32_ "BSD Schedulertabelle | EN: BSD Schedulertabelle" VALUE 0x7076A TKW_VV_VV_UB 100.0 FORMULA_0483 0.0 8.0000 /end CHARACTERISTIC
/begin CHARACTERISTIC K_BSD_SCHEDTAB_24of32_ "BSD Schedulertabelle | EN: BSD Schedulertabelle" VALUE 0x7076B TKW_VV_VV_UB 100.0 FORMULA_0483 0.0 8.0000 /end CHARACTERISTIC
/begin CHARACTERISTIC K_BSD_SCHEDTAB_25of32_ "BSD Schedulertabelle | EN: BSD Schedulertabelle" VALUE 0x7076C TKW_VV_VV_UB 100.0 FORMULA_0483 0.0 8.0000 /end CHARACTERISTIC
/begin CHARACTERISTIC K_BSD_SCHEDTAB_26of32_ "BSD Schedulertabelle | EN: BSD Schedulertabelle" VALUE 0x7076D TKW_VV_VV_UB 100.0 FORMULA_0483 0.0 8.0000 /end CHARACTERISTIC
/begin CHARACTERISTIC K_BSD_SCHEDTAB_27of32_ "BSD Schedulertabelle | EN: BSD Schedulertabelle" VALUE 0x7076E TKW_VV_VV_UB 100.0 FORMULA_0483 0.0 8.0000 /end CHARACTERISTIC
/begin CHARACTERISTIC K_BSD_SCHEDTAB_28of32_ "BSD Schedulertabelle | EN: BSD Schedulertabelle" VALUE 0x7076F TKW_VV_VV_UB 100.0 FORMULA_0483 0.0 8.0000 /end CHARACTERISTIC
/begin CHARACTERISTIC K_BSD_SCHEDTAB_29of32_ "BSD Schedulertabelle | EN: BSD Schedulertabelle" VALUE 0x70770 TKW_VV_VV_UB 100.0 FORMULA_0483 0.0 8.0000 /end CHARACTERISTIC
/begin CHARACTERISTIC K_BSD_SCHEDTAB_30of32_ "BSD Schedulertabelle | EN: BSD Schedulertabelle" VALUE 0x70771 TKW_VV_VV_UB 100.0 FORMULA_0483 0.0 8.0000 /end CHARACTERISTIC
/begin CHARACTERISTIC K_BSD_SCHEDTAB_31of32_ "BSD Schedulertabelle | EN: BSD Schedulertabelle" VALUE 0x70772 TKW_VV_VV_UB 100.0 FORMULA_0483 0.0 8.0000 /end CHARACTERISTIC
/begin CHARACTERISTIC K_BSD_SCHEDTAB_32of32_ "BSD Schedulertabelle | EN: BSD Schedulertabelle" VALUE 0x70773 TKW_VV_VV_UB 100.0 FORMULA_0483 0.0 8.0000 /end CHARACTERISTIC
/begin CHARACTERISTIC K_BSD_KTENABLE "Codewort aktivierte BSD Komponententreiber | EN: Code word: activated BSD component drivers" VALUE 0x70774 TKW_VV_VV_UB 100.0 FORMULA_0003 0.0 255.0000 /end CHARACTERISTIC
/begin MEASUREMENT St_bsd_ktenable.B_dev_ibs "IBS enabled" UBYTE FORMULA_0418 0 0 0.0 255.0 ECU_ADDRESS 0x3FBDD4 BIT_MASK 0x1 /end MEASUREMENT
/begin MEASUREMENT St_bsd_ktenable.B_dev_ozon "Ozonsensor enabled" UBYTE FORMULA_0419 0 0 0.0 255.0 ECU_ADDRESS 0x3FBDD4 BIT_MASK 0x2 /end MEASUREMENT
/begin MEASUREMENT St_bsd_ktenable.B_dev_wapue "Wasserpumpe Elektrik enabled" UBYTE FORMULA_0420 0 0 0.0 255.0 ECU_ADDRESS 0x3FBDD4 BIT_MASK 0x4 /end MEASUREMENT
/begin MEASUREMENT St_bsd_ktenable.B_dev_wapum "Wasserpumpe Motor enabled" UBYTE FORMULA_0421 0 0 0.0 255.0 ECU_ADDRESS 0x3FBDD4 BIT_MASK 0x8 /end MEASUREMENT
/begin MEASUREMENT St_bsd_ktenable.B_dev_oz "Oelzustandssensor/QLT enabled" UBYTE FORMULA_0422 0 0 0.0 255.0 ECU_ADDRESS 0x3FBDD4 BIT_MASK 0x10 /end MEASUREMENT
/begin MEASUREMENT St_bsd_ktenable.B_dev_gen1 "Generator 1 enabled" UBYTE FORMULA_0423 0 0 0.0 255.0 ECU_ADDRESS 0x3FBDD4 BIT_MASK 0x20 /end MEASUREMENT
/begin MEASUREMENT St_bsd_ktenable.B_dev_gen2 "Generator 2 enabled" UBYTE FORMULA_0424 0 0 0.0 255.0 ECU_ADDRESS 0x3FBDD4 BIT_MASK 0x40 /end MEASUREMENT
/begin MEASUREMENT St_bsd_ktenable.B_dev_glrd "Diesel Gluehsteuergeraet enabled" UBYTE FORMULA_0425 0 0 0.0 255.0 ECU_ADDRESS 0x3FBDD4 BIT_MASK 0x80 /end MEASUREMENT
/begin MEASUREMENT St_bsd_ktenable "Zustand aktivierte BSD Komponententreiber" UBYTE FORMULA_0003 0 0 0.0 255.0000 ECU_ADDRESS 0x3FBDD4 /end MEASUREMENT
/* ------------------ Abschnitt erzeugt aus bsd_exd.dat ------------------ */
/begin MEASUREMENT gen_exd_timeout "KWP-Ansteuerzeit" UBYTE FORMULA_0458 0 0 0.0 25.5000 ECU_ADDRESS 0x3FBDD6 /end MEASUREMENT
/begin MEASUREMENT batt_tausch_exd_timeout "Batterietausch-Erkennungszeit" UBYTE FORMULA_0458 0 0 0.0 25.5000 ECU_ADDRESS 0x3FBDD7 /end MEASUREMENT
/begin MEASUREMENT history_reset_exd_timeout "Ruhestrommessung-Erkennungszeit" UBYTE FORMULA_0458 0 0 0.0 25.5000 ECU_ADDRESS 0x3FBDD8 /end MEASUREMENT
/begin MEASUREMENT U_gen_exd "Sollwert Generatorspannung (ext. Diagnose)" UWORD FORMULA_0462 0 0 0.0 6553.5000 ECU_ADDRESS 0x3FBDDA /end MEASUREMENT
/begin MEASUREMENT Tlrgen_exd "Sollwert Load-Response Generator (ext. Diagnose)" UBYTE FORMULA_0458 0 0 0.0 25.5000 ECU_ADDRESS 0x3FBDDC /end MEASUREMENT
/* ------------------ Abschnitt erzeugt aus carbtlgr_inj.dat ------------------ */
/begin MEASUREMENT carbtlgr_aif_nummer "Stelle des letzten AIF" SBYTE FORMULA_0632 0 0 -128.0 127.0 ECU_ADDRESS 0x3FBE66 /end MEASUREMENT
/begin MEASUREMENT carbtlgr_st "Wurde ein CAN-CARB-Telegramm bei Klemme 15 erkannt" UBYTE FORMULA_0633 0 0 0.0 255.0 ECU_ADDRESS 0x3FBE67 /end MEASUREMENT
/* ------------------ Abschnitt erzeugt aus dwf.dat ------------------ */
/begin CHARACTERISTIC K_DWF_CFG "Konfiguration DWF-Anzeige | EN: Konfiguration DWF-Anzeige" VALUE 0x70896 TKW_VV_VV_UW 100.0 FORMULA_0010 0.0 65535.0000 /end CHARACTERISTIC
/begin CHARACTERISTIC K_DWF_ORANGE_OFF "Offset auf roten Bereich | EN: Offset auf roten Bereich" VALUE 0x70898 TKW_VV_VV_SB 100.0 FORMULA_0663 -6400.0000 6350.0000 /end CHARACTERISTIC
/begin CHARACTERISTIC K_DWF_SHLI_TAU_DN "dn-Filter Shiflights" VALUE 0x70899 TKW_VV_VV_UB 100.0 FORMULA_0664 0.0101 2.5600 /end CHARACTERISTIC
/begin CHARACTERISTIC K_DWF_SHLI_TAU_N "n-Filter Shiflights" VALUE 0x7089A TKW_VV_VV_UB 100.0 FORMULA_0664 0.0101 2.5600 /end CHARACTERISTIC
/begin CHARACTERISTIC K_DWF_SHLI_T_TOT "Fahrertotzeit" VALUE 0x7089B TKW_VV_VV_UB 100.0 FORMULA_0317 0.0 2.5500 /end CHARACTERISTIC
/begin CHARACTERISTIC K_DWF_SHLI_TAB_FAK "Einfluss Abregelzeit" VALUE 0x7089C TKW_VV_VV_UB 100.0 FORMULA_0665 0.0 0.9960 /end CHARACTERISTIC
/begin CHARACTERISTIC K_DWF_SHLI_T_FLS "Flash Segmentzeit" VALUE 0x7089D TKW_VV_VV_UB 100.0 FORMULA_0317 0.0 2.5500 /end CHARACTERISTIC
/begin CHARACTERISTIC K_DWF_SHLI_T_AKTIV "Aktivierungsschwelle | EN: Aktivierungsschwelle" VALUE 0x7089E TKW_VV_VV_UW 100.0 FORMULA_0021 0.0 655.0000 FORMAT "%5.2" /end CHARACTERISTIC
/begin CHARACTERISTIC K_DWF_SHLI_T_INAKTIV "Deaktivierungsschwelle | EN: Deaktivierungsschwelle" VALUE 0x708A0 TKW_VV_VV_UW 100.0 FORMULA_0021 0.0 655.0000 FORMAT "%5.2" /end CHARACTERISTIC
/begin CHARACTERISTIC K_DWF_SHLI_T_BL "Aktivierungsschwelle Blinken | EN: Aktivierungsschwelle Blinken" VALUE 0x708A2 TKW_VV_VV_UW 100.0 FORMULA_0117 0.0 325.0000 FORMAT "%5.2" /end CHARACTERISTIC
/begin CHARACTERISTIC K_DWF_SHLI_AX_AKTIV "Aktivierungsschwelle | EN: Aktivierungsschwelle" VALUE 0x708A4 TKW_VV_VV_SW 100.0 FORMULA_0132 -20.0000 20.0000 FORMAT "%5.2" /end CHARACTERISTIC
/begin CHARACTERISTIC KL_DWF_SHLI_V_DIFF "max. Radschlupf | EN: Maximum wheel slip" CURVE 0x708A6 TKL_SW_VV_SW 100.0 FORMULA_0078 -80.0000 360.0000 /begin AXIS_DESCR STD_AXIS gang FORMULA_0666 6 -1.0000 10.0000 /end AXIS_DESCR FORMAT "%4.1" /end CHARACTERISTIC
/begin CHARACTERISTIC KL_DWF_SHLI_SEG "Rest-Segmente | EN: Remaining segments" CURVE 0x708C0 TKL_SW_VV_UB 100.0 FORMULA_0003 0.0 10.0000 /begin AXIS_DESCR STD_AXIS dwf_shli_n FORMULA_0006 4 0.0 10000.0000 /end AXIS_DESCR /end CHARACTERISTIC
/begin MEASUREMENT dwf_n_max "Maxwert von KL_N_BEGR_GANG" SWORD FORMULA_0006 0 0 0.0 10000.0000 ECU_ADDRESS 0x3FBF44 /end MEASUREMENT
/begin MEASUREMENT dwf_n_rot "roter Drehzahlbereich" UBYTE FORMULA_0171 0 0 0.0 12750.0000 ECU_ADDRESS 0x3FBF46 /end MEASUREMENT
/begin MEASUREMENT dwf_repeat "Wiederholzaehler" UBYTE FORMULA_0003 0 0 0.0 255.0000 ECU_ADDRESS 0x3FBF47 /end MEASUREMENT
/begin MEASUREMENT dwf_shli_st "Status Shiftlights" UBYTE FORMULA_0003 0 0 0.0 255.0000 ECU_ADDRESS 0x3FBF48 /end MEASUREMENT
/begin MEASUREMENT dwf_shli_st_on "Shiftlights Ein" UBYTE FORMULA_0659 0 0 0.0 255.0 ECU_ADDRESS 0x3FBF48 BIT_MASK 0x1 /end MEASUREMENT
/begin MEASUREMENT dwf_shli_st_fls "Shiftlights Flash Ein" UBYTE FORMULA_0660 0 0 0.0 255.0 ECU_ADDRESS 0x3FBF48 BIT_MASK 0x2 /end MEASUREMENT
/begin MEASUREMENT dwf_shli_st_bl "Shiftlights Blinken" UBYTE FORMULA_0661 0 0 0.0 255.0 ECU_ADDRESS 0x3FBF48 BIT_MASK 0x4 /end MEASUREMENT
/begin MEASUREMENT dwf_shli_seg "angezeigte Segmente" UBYTE FORMULA_0662 0 0 0.0 10.0000 ECU_ADDRESS 0x3FBF49 /end MEASUREMENT
/begin MEASUREMENT dwf_shli_dn "gefilt. Gradient" SWORD FORMULA_0114 0 0 -10000.0000 10000.0000 ECU_ADDRESS 0x3FBF4A /end MEASUREMENT
/begin MEASUREMENT dwf_shli_n "gefilt. Drehzahl" SWORD FORMULA_0006 0 0 0.0 10000.0000 ECU_ADDRESS 0x3FBF4C /end MEASUREMENT
/begin MEASUREMENT dwf_shli_tbegr "Zeit bis zum Begrenzer" UWORD FORMULA_0021 0 0 0.0 10.0000 ECU_ADDRESS 0x3FBF4E /end MEASUREMENT
/begin MEASUREMENT dwf_shli_tseg "Zeit fuer ein Segment" UWORD FORMULA_0021 0 0 0.0 10.0000 ECU_ADDRESS 0x3FBF50 /end MEASUREMENT
/* ------------------ Abschnitt erzeugt aus ebox_elu.dat ------------------ */
/begin CHARACTERISTIC K_EBOX_ELU_EIN "Eischaltschwelle | EN: Eischaltschwelle" VALUE 0x708CE TKW_VV_VV_SW 100.0 FORMULA_0023 -50.0000 170.0000 FORMAT "%4.1" /end CHARACTERISTIC
/begin CHARACTERISTIC K_EBOX_ELU_HYS "Ausschalt-Hysterese | EN: Ausschalt-Hysterese" VALUE 0x708D0 TKW_VV_VV_SW 100.0 FORMULA_0076 0.0 1000.0000 FORMAT "%4.1" /end CHARACTERISTIC
/begin CHARACTERISTIC K_EBOX_ELU_LOSBRECHEN "Eischaltdauer zum Losbrechen | EN: Eischaltdauer zum Losbrechen" VALUE 0x708D2 TKW_VV_VV_UW 100.0 FORMULA_0021 0.0 655.0000 FORMAT "%5.2" /end CHARACTERISTIC
/begin MEASUREMENT ebox_elu_st "Status der E-Box E-Luefteransteuerung" UBYTE FORMULA_0667 0 0 0.0 255.0 ECU_ADDRESS 0x3FBF52 BIT_MASK 0x3 /end MEASUREMENT
/begin MEASUREMENT ebox_elu_exd_timeout "KWP-Ansteuerzeit" UBYTE FORMULA_0458 0 0 0.0 25.5000 ECU_ADDRESS 0x3FBF53 /end MEASUREMENT
/begin MEASUREMENT ed_css_time "Zeit fuer CSS-Denominator" UWORD FORMULA_0073 0 0 0.0 6553.5000 ECU_ADDRESS 0x3FBF56 /end MEASUREMENT
/* ------------------ Abschnitt erzeugt aus egas_diag.dat ------------------ */
/begin CHARACTERISTIC K_EGAS_CFG_DIAG "DK-Konfiguration elektr. Diagnose | EN: Throttle configuration, electrical diagnosis" VALUE 0x71FEE TKW_VV_VV_UB 100.0 FORMULA_0669 0.0 255.0 /end CHARACTERISTIC
/* ------------------ Abschnitt erzeugt aus elup.dat ------------------ */
/begin CHARACTERISTIC K_ELUP_CFG "Software-Schalter ELUP" VALUE 0x720C8 TKW_VV_VV_UB 100.0 FORMULA_0682 0.0 255.0 /end CHARACTERISTIC
/begin CHARACTERISTIC K_ELUP_UB_MIN "Mindestspannung an KL87 fuer ELUP-Ansteuerung | EN: Mindestspannung an KL87 fuer ELUP-Ansteuerung" VALUE 0x720CA TKW_VV_VV_SW 100.0 FORMULA_0008 0.0 28.0000 FORMAT "%4.1" /end CHARACTERISTIC
/begin CHARACTERISTIC K_ELUP_ON_TIME_MIN "mindest ELUP-Ansteuerzeit | EN: mindest ELUP-Ansteuerzeit" VALUE 0x720CC TKW_VV_VV_UW 100.0 FORMULA_0021 0.0 655.0000 FORMAT "%5.2" /end CHARACTERISTIC
/begin CHARACTERISTIC K_ELUP_ON_TIME_MAX "maximale ELUP-Ansteuerzeit | EN: maximale ELUP-Ansteuerzeit" VALUE 0x720CE TKW_VV_VV_UW 100.0 FORMULA_0021 0.0 655.0000 FORMAT "%5.2" /end CHARACTERISTIC
/begin CHARACTERISTIC K_ELUP_OFF_TIME_MIN "mindest ELUP-Verriegelungszeit | EN: mindest ELUP -Verriegelungszeit" VALUE 0x720D0 TKW_VV_VV_UW 100.0 FORMULA_0021 0.0 655.0000 FORMAT "%5.2" /end CHARACTERISTIC
/begin CHARACTERISTIC K_ELUP_OBD_MVACP_GRAD_T "Filterkonstante fuer elup_obd_mvacp_grad | EN: Filter constant for elup_ed_mvacp_grad" VALUE 0x720D2 TKW_VV_VV_UB 100.0 FORMULA_0683 0.1004 25.6000 /end CHARACTERISTIC
/begin CHARACTERISTIC K_ELUP_OBD_BRPGRAD_T "Filterkonstante fuer elup_obd_brp_grad | EN: Filter constant for elup_ed_brp_grad" VALUE 0x720D3 TKW_VV_VV_UB 100.0 FORMULA_0664 0.0101 2.5600 /end CHARACTERISTIC
/begin CHARACTERISTIC K_ELUP_OBD_PSAU_SW "Diag-Schwelle durch Saugrohrdruck zu pumg | EN: Diagnosis threshold from intake pressure vs ambient pressure" VALUE 0x720D4 TKW_VV_VV_SW 100.0 FORMULA_0077 0.0 2000.0000 FORMAT "%4.1" /end CHARACTERISTIC
/begin CHARACTERISTIC K_ELUP_OBD_MVACP_GRAD_SW "Diag-Schwelle durch Differenzdruckgradient | EN: Diagnosis threshold from differential-pressure gradient" VALUE 0x720D6 TKW_VV_VV_SW 100.0 FORMULA_0678 -312.5000 312.5000 FORMAT "%4.1" /end CHARACTERISTIC
/begin CHARACTERISTIC K_ELUP_OBD_BRPGRAD_SW "Diag-Schwelle durch Bremsdruckgradient | EN: Diagnosis threshold from brake-pressure gradient" VALUE 0x720D8 TKW_VV_VV_SW 100.0 FORMULA_0679 -5000.0000 5000.0000 /end CHARACTERISTIC
/begin CHARACTERISTIC K_ELUP_OBD_DEL "Verzoegerung ELUP_OBD UNPLAUSIBEL durch Druckgradient | EN: Verzoegerung ELUP_OBD UNPLAUSIBEL durch Druckgradient" VALUE 0x720DA TKW_VV_VV_UB 100.0 FORMULA_0458 0.0 25.5000 /end CHARACTERISTIC
/begin CHARACTERISTIC K_ELUP_OBD_ABS_DEL "Verzoegerung ELUP_OBD UNPLAUSIBEL durch Einschaltschwelle | EN: Verzoegerung ELUP_OBD UNPLAUSIBEL durch Einschaltschwelle" VALUE 0x720DB TKW_VV_VV_UB 100.0 FORMULA_0458 0.0 25.5000 /end CHARACTERISTIC
/begin CHARACTERISTIC K_ELUP_PL_AN_SW "ELUP-Ansteuerschwelle fuer Prueflauf | EN: Vacuum-pump activation threshold for test run [mbar]" VALUE 0x720DC TKW_VV_VV_SW 100.0 FORMULA_0077 -1100.0000 200.0000 FORMAT "%4.1" /end CHARACTERISTIC
/begin CHARACTERISTIC K_ELUP_PL_IO_SW "ELUP-iO-Schwelle bei Prueflauf | EN: Vacuum-pump OK threshold during test run [mbar]" VALUE 0x720DE TKW_VV_VV_SW 100.0 FORMULA_0077 -1100.0000 200.0000 FORMAT "%4.1" /end CHARACTERISTIC
/begin CHARACTERISTIC K_ELUP_PL_ON_TIME "ELUP-Ansteuerzeit fuer Prueflauf | EN: Vacuum-pump activation time for test run [s]" VALUE 0x720E0 TKW_VV_VV_UW 100.0 FORMULA_0021 0.0 655.0000 FORMAT "%5.2" /end CHARACTERISTIC
/begin CHARACTERISTIC KL_ELUP_EIN "Kennlinie Einschaltschwelle ELUP | EN: Curve: electric vacuum pump switch-on threshold" CURVE 0x720E2 TKL_SW_VV_SW 100.0 FORMULA_0077 -1100.0000 200.0000
 /begin AXIS_DESCR STD_AXIS pumg FORMULA_0077 8 400.0000 1200.0000 FORMAT "%4.1" /end AXIS_DESCR
 FORMAT "%4.1" /end CHARACTERISTIC
/begin CHARACTERISTIC KL_ELUP_AUS "Kennlinie Ausschaltschwelle ELUP | EN: Curve: electric vacuum pump switch-off threshold" CURVE 0x72104 TKL_SW_VV_SW 100.0 FORMULA_0077 -1100.0000 200.0000
 /begin AXIS_DESCR STD_AXIS pumg FORMULA_0077 8 400.0000 1200.0000 FORMAT "%4.1" /end AXIS_DESCR
 FORMAT "%4.1" /end CHARACTERISTIC
/begin CHARACTERISTIC KL_ELUP_V_OFFS "Kennlinie v-Offset auf ELUP-Schaltschwelle | EN: Curve: speed offset on vacuum-pump switching threshold" CURVE 0x72126 TKL_SW_VV_SW 100.0 FORMULA_0077 -200.0000 200.0000
 /begin AXIS_DESCR STD_AXIS v_vorne FORMULA_0078 6 -80.0000 360.0000 FORMAT "%4.1" /end AXIS_DESCR
 FORMAT "%4.1" /end CHARACTERISTIC
/begin CHARACTERISTIC KL_ELUP_EIN_V_DEL "Kennlinie Einschlatverzoegerung druch v_vorne" CURVE 0x72140 TKL_SW_VV_UW 100.0 FORMULA_0021 0.0 655.0000
 /begin AXIS_DESCR STD_AXIS v_vorne FORMULA_0078 6 -80.0000 360.0000 FORMAT "%4.1" /end AXIS_DESCR
 FORMAT "%5.2" /end CHARACTERISTIC
/begin MEASUREMENT elup_interlock_time "Timer Schaltverriegelung fuer AN/AUS" UWORD FORMULA_0021 0 0 0.0 655.0000 ECU_ADDRESS 0x3FBF9A /end MEASUREMENT
/begin MEASUREMENT elup_exd_timeout "KWP-Ansteuerzeit" UWORD FORMULA_0021 0 0 0.0 655.0000 ECU_ADDRESS 0x3FBF9C /end MEASUREMENT
/begin MEASUREMENT elup_sw_ein "ermittelte ELUP-Einschaltschwelle" SWORD FORMULA_0077 0 0 -1100.0000 200.0000 ECU_ADDRESS 0x3FBF9E /end MEASUREMENT
/begin MEASUREMENT elup_sw_aus "ermittelte ELUP-Ausschaltschwelle" SWORD FORMULA_0077 0 0 -1100.0000 200.0000 ECU_ADDRESS 0x3FBFA0 /end MEASUREMENT
/begin MEASUREMENT elup_v_offs "Offset auf ELUP-Schaltschwelle durch v_vorne" SWORD FORMULA_0077 0 0 -200.0000 200.0000 ECU_ADDRESS 0x3FBFA2 /end MEASUREMENT
/begin MEASUREMENT elup_obd_mvacp_old "gemessener Differenzdruck aus vorherigem Diagnosezyklus" SWORD FORMULA_0077 0 0 -1100.0000 200.0000 ECU_ADDRESS 0x3FBFA4 /end MEASUREMENT
/begin MEASUREMENT elup_obd_mvacp_grad "Differenzdruckgradient" SWORD FORMULA_0678 0 0 -312.5000 312.5000 ECU_ADDRESS 0x3FBFA6 /end MEASUREMENT
/begin MEASUREMENT elup_obd_brp_grad "PT1-gefilterter Bremsdruckgradient" SWORD FORMULA_0679 0 0 -5000.0000 5000.0000 ECU_ADDRESS 0x3FBFA8 /end MEASUREMENT
/begin MEASUREMENT elup_obd_del "Verzoegerung ELUP_ED UNPLAUSIBEL durch Druckgradient" UBYTE FORMULA_0458 0 0 0.0 25.5000 ECU_ADDRESS 0x3FBFAA /end MEASUREMENT
/begin MEASUREMENT elup_obd_abs_del "Verzoegerung ELUP_ED UNPLAUSIBEL durch Einschaltschwelle" UBYTE FORMULA_0458 0 0 0.0 25.5000 ECU_ADDRESS 0x3FBFAB /end MEASUREMENT
/begin MEASUREMENT elup_ein_v_del "Einschaltverzoegerung durch v_vorne" UWORD FORMULA_0021 0 0 0.0 655.0000 ECU_ADDRESS 0x3FBFAC /end MEASUREMENT
/begin MEASUREMENT elup_obd_aktiv "OBD-Bedingung fuer ELUP-Funktion" UBYTE FORMULA_0680 0 0 0.0 255.0 ECU_ADDRESS 0x3FBFAE /end MEASUREMENT
/begin MEASUREMENT elup_pl_st "Prueflaufstatus ELUP" UBYTE FORMULA_0681 0 0 0.0 255.0 ECU_ADDRESS 0x3FBFAF /end MEASUREMENT
/begin MEASUREMENT elup_pl_mvac_p_start "mvac_p zu Beginn des ELUP-Prueflaufs" SWORD FORMULA_0077 0 0 -1100.0000 200.0000 ECU_ADDRESS 0x3FBFB0 /end MEASUREMENT
/begin MEASUREMENT elup_pl_mvac_p_ende "mvac_p am Ende des ELUP-Prueflaufs" SWORD FORMULA_0077 0 0 -1100.0000 200.0000 ECU_ADDRESS 0x3FBFB2 /end MEASUREMENT
/* ------------------ Abschnitt erzeugt aus ews.dat ------------------ */
/begin CHARACTERISTIC K_EWS_FETRAWE_WEG "zul. Kilometerstand zum automatischen aktivieren des Fertigungsmodes beim EWS-DME-Abgl. | EN: Permitted mileage for auto-activating production mode on EWS-DME alignment [km]" VALUE 0x7215C TKW_VV_VV_UW 100.0 FORMULA_0616 0.0 65535.0000 /end CHARACTERISTIC
/begin MEASUREMENT ews_st "Status EWS" UBYTE FORMULA_0684 0 0 0.0 255.0 ECU_ADDRESS 0x3FBFB6 /end MEASUREMENT
/begin MEASUREMENT ews_stw_st "EWS-STW-Status" UBYTE FORMULA_0685 0 0 0.0 255.0 ECU_ADDRESS 0x3FBFB7 /end MEASUREMENT
/* ------------------ Abschnitt erzeugt aus fst.dat ------------------ */
/begin CHARACTERISTIC K_FST_ABWEICHUNG "Zulaessige Abweichung Verbrauch/Fuellstand | EN: Zulaessige Abweichung Ve r-brauch/Fuellstand" VALUE 0x7230C TKW_VV_VV_UB 100.0 FORMULA_0557 0.0 127.5000 /end CHARACTERISTIC
/begin CHARACTERISTIC K_FST_CAN_FEHLER "min. Dauer CAN-Fehler (65535s = aus) | EN: min. Dauer CAN -Fehler (65535s = aus)" VALUE 0x7230E TKW_VV_VV_UW 100.0 FORMULA_0062 0.0 65535.0000 /end CHARACTERISTIC
/begin CHARACTERISTIC K_FST_NACHTANK "Delta fuer Nachtankerkennung | EN: Delta fuer Nachtankerkennung" VALUE 0x72310 TKW_VV_VV_UB 100.0 FORMULA_0557 0.0 127.5000 /end CHARACTERISTIC
/begin CHARACTERISTIC K_FST_FILT "Filter Geberwert Li/Re | EN: Filter Geberwert Li/Re" VALUE 0x72311 TKW_VV_VV_UB 100.0 FORMULA_0718 1.0040 256.0000 /end CHARACTERISTIC
/begin CHARACTERISTIC K_FST_TANK_LEER_SUM "Summenfuellstand Tank Leer Info | EN: Summenfuellstand Tank Leer Info" VALUE 0x72312 TKW_VV_VV_UB 100.0 FORMULA_0557 0.0 127.5000 /end CHARACTERISTIC
/begin CHARACTERISTIC K_FST_TANK_LEER_RECHTS "Fuellstand rechts Tank Leer Info | EN: Fuellstand rechts Tank Leer Info" VALUE 0x72313 TKW_VV_VV_UB 100.0 FORMULA_0557 0.0 127.5000 /end CHARACTERISTIC
/begin CHARACTERISTIC K_FST_VOLL "Maximaler Fuellstand fuer Volldiagnose | EN: Maximaler Fuellstand fuer Volld i-agnose" VALUE 0x72314 TKW_VV_VV_UB 100.0 FORMULA_0557 0.0 127.5000 /end CHARACTERISTIC
/begin CHARACTERISTIC K_FST_V_BETANK_END "Geschw. fuer Tanken beendet | EN: Geschw. fuer Tanken beendet" VALUE 0x72316 TKW_VV_VV_SW 100.0 FORMULA_0078 -80.0000 360.0000 FORMAT "%4.1" /end CHARACTERISTIC
/begin CHARACTERISTIC K_FST_VERBRAUCH "FST-Plausi, wenn soviel verbraucht | EN: FST-Plausi, wenn soviel ve r-braucht" VALUE 0x72318 TKW_VV_VV_UB 100.0 FORMULA_0557 0.0 127.5000 /end CHARACTERISTIC
/begin CHARACTERISTIC K_FST_VERBRAUCH_VOLL "Unplausibl. Verbrauch bei FST voll | EN: Unplausibl. Verbrauch bei FST voll" VALUE 0x72319 TKW_VV_VV_UB 100.0 FORMULA_0557 0.0 127.5000 /end CHARACTERISTIC
/begin MEASUREMENT fst_can_fehler_li "Dauer CAN-Geberfehler links " UWORD FORMULA_0062 0 0 0.0 65535.0000 ECU_ADDRESS 0x3FC008 /end MEASUREMENT
/begin MEASUREMENT fst_can_fehler_re "Dauer CAN-Geberfehler rechts" UWORD FORMULA_0062 0 0 0.0 65535.0000 ECU_ADDRESS 0x3FC00A /end MEASUREMENT
/begin MEASUREMENT fst_kva_old "letzter Stand Kraftstoffverbrauch" UBYTE FORMULA_0713 0 0 0.0 65.2800 ECU_ADDRESS 0x3FC00C /end MEASUREMENT
/begin MEASUREMENT fst_links "gefilterter Geberwert links" UBYTE FORMULA_0557 0 0 0.0 127.5000 ECU_ADDRESS 0x3FC00D /end MEASUREMENT
/begin MEASUREMENT fst_links.rest "Filter Rest Geberwert links" UBYTE FORMULA_0558 0 0 0.0 0.4980 ECU_ADDRESS 0x3FC00E /end MEASUREMENT
/begin MEASUREMENT B_FST_CAN_FEHLERKENNUNG "Fehlerkennzeichnung = el. Fehler" UBYTE FORMULA_0714 0 0 0.0 255.0 ECU_ADDRESS 0x3FC00F BIT_MASK 0x2 /end MEASUREMENT
/begin MEASUREMENT B_FST_KEIN_CAN "Kein CAN-Telegramm" UBYTE FORMULA_0715 0 0 0.0 255.0 ECU_ADDRESS 0x3FC00F BIT_MASK 0x4 /end MEASUREMENT
/begin MEASUREMENT B_FST_UNPLAUSIBEL "Fuellstand unplausibel" UBYTE FORMULA_0716 0 0 0.0 255.0 ECU_ADDRESS 0x3FC00F BIT_MASK 0x8 /end MEASUREMENT
/begin MEASUREMENT B_FST_CAN_INIT "fst_li/re ist initialisiert" UBYTE FORMULA_0220 0 0 0.0 255.0 ECU_ADDRESS 0x3FC00F BIT_MASK 0x10 /end MEASUREMENT
/begin MEASUREMENT B_FST_NACHTANK "Nachtanken erkannt fuer DMTL" UBYTE FORMULA_0222 0 0 0.0 255.0 ECU_ADDRESS 0x3FC00F BIT_MASK 0x40 /end MEASUREMENT
/begin MEASUREMENT B_FST_NACHTANK_LA "Nachtanken erkannt fuer LA-Diag" UBYTE FORMULA_0223 0 0 0.0 255.0 ECU_ADDRESS 0x3FC00F BIT_MASK 0x80 /end MEASUREMENT
/begin MEASUREMENT fst_st "Status Tankfuellstand" UBYTE FORMULA_0717 0 0 0.0 255.0 ECU_ADDRESS 0x3FC00F BIT_MASK 0xF /end MEASUREMENT
/begin MEASUREMENT fst_tank_leer_st_inj "Fehlerstatus Tank leer Fehler" ULONG FORMULA_0041 0 0 0.0 4294967295.0000 ECU_ADDRESS 0x3FC010 /end MEASUREMENT
/begin MEASUREMENT fst_tank_leer_st_ign "Fehlerstatus Tank leer Fehler" ULONG FORMULA_0041 0 0 0.0 4294967295.0000 ECU_ADDRESS 0x3FC014 /end MEASUREMENT
/* ------------------ Abschnitt erzeugt aus kt_gen.dat ------------------ */
/begin MEASUREMENT St_generator.B_genactiv "Interface aktiv Generator" UBYTE FORMULA_0418 0 0 0.0 255.0 ECU_ADDRESS 0x3FAF74 BIT_MASK 0x1 /end MEASUREMENT
/begin MEASUREMENT St_generator.B_genfbsd "BSD-Fehler Generator" UBYTE FORMULA_0420 0 0 0.0 255.0 ECU_ADDRESS 0x3FAF74 BIT_MASK 0x4 /end MEASUREMENT
/begin MEASUREMENT St_generator.B_genfel "Elektrischer Fehler Generator" UBYTE FORMULA_0421 0 0 0.0 255.0 ECU_ADDRESS 0x3FAF74 BIT_MASK 0x8 /end MEASUREMENT
/begin MEASUREMENT St_generator.B_genfht "Hohe Temperatur Generator" UBYTE FORMULA_0422 0 0 0.0 255.0 ECU_ADDRESS 0x3FAF74 BIT_MASK 0x10 /end MEASUREMENT
/begin MEASUREMENT St_generator.B_genfme "Mechanischer Fehler Generator" UBYTE FORMULA_0423 0 0 0.0 255.0 ECU_ADDRESS 0x3FAF74 BIT_MASK 0x20 /end MEASUREMENT
/begin MEASUREMENT St_generator.B_crashgen "Crash f�r Generatorabschaltung" UBYTE FORMULA_0424 0 0 0.0 255.0 ECU_ADDRESS 0x3FAF74 BIT_MASK 0x40 /end MEASUREMENT
/begin MEASUREMENT St_generator "Bitbasis Zustand Generator" UBYTE FORMULA_0003 0 0 0.0 255.0000 ECU_ADDRESS 0x3FAF74 /end MEASUREMENT
/begin MEASUREMENT Dfsiggen "Auslastungsgrad Generator" UBYTE FORMULA_0471 0 0 0.0 99.6093 ECU_ADDRESS 0x3FAF75 /end MEASUREMENT
/begin MEASUREMENT Gen_manufak "Herstellerkennung Generator" UBYTE FORMULA_0003 0 0 0.0 255.0000 ECU_ADDRESS 0x3FAF76 /end MEASUREMENT
/begin MEASUREMENT Gen_typkenn "Typkennung Generator" UBYTE FORMULA_0003 0 0 0.0 255.0000 ECU_ADDRESS 0x3FAF77 /end MEASUREMENT
/begin MEASUREMENT Gen_typregler "Typkennung Generatorregler" UBYTE FORMULA_0003 0 0 0.0 255.0000 ECU_ADDRESS 0x3FAF78 /end MEASUREMENT
/begin MEASUREMENT Tlrfgen "Sollwert Load-Response-Zeit, empfangen vom Generator" UBYTE FORMULA_0458 0 0 0.0 25.5000 ECU_ADDRESS 0x3FAF79 /end MEASUREMENT
/begin MEASUREMENT U_fgen "Spannung Generator, empfangen vom Generator" UWORD FORMULA_0462 0 0 0.0 6553.5000 ECU_ADDRESS 0x3FAF7A /end MEASUREMENT
/begin MEASUREMENT Gen_temp_chip "Generatortemp. (Chip)" UBYTE FORMULA_0003 0 0 0.0 255.0000 ECU_ADDRESS 0x3FAF7C /end MEASUREMENT
/begin MEASUREMENT Dfbegr "Begrenzung Gen.-Auslastung" UBYTE FORMULA_0604 0 0 0.0 87.5000 ECU_ADDRESS 0x3FAF7D /end MEASUREMENT
/begin MEASUREMENT Ierr "Erregerstrom momentan" UBYTE FORMULA_0460 0 0 0.0 7.8750 ECU_ADDRESS 0x3FAF7E /end MEASUREMENT
/begin MEASUREMENT Ierrfgrenz "Erregerstrom Begrenzung (Kopie von Ierrfgrenz)" UBYTE FORMULA_0460 0 0 0.0 3.8750 ECU_ADDRESS 0x3FAF7F /end MEASUREMENT
/* ------------------ Abschnitt erzeugt aus kt_ibs.dat ------------------ */
/begin CHARACTERISTIC K_ENISOC0 "" VALUE 0x72E84 TKW_VV_VV_UB 100.0 FORMULA_0733 0.0 5.1000 /end CHARACTERISTIC
/begin CHARACTERISTIC K_ENUSOC0 "" VALUE 0x72E85 TKW_VV_VV_UB 100.0 FORMULA_0734 6.0000 22.3200 /end CHARACTERISTIC
/begin CHARACTERISTIC K_T1SOC0 "" VALUE 0x72E86 TKW_VV_VV_UB 100.0 FORMULA_0735 0.0 65280.0000 /end CHARACTERISTIC
/begin CHARACTERISTIC K_T2SOC0 "" VALUE 0x72E87 TKW_VV_VV_UB 100.0 FORMULA_0735 0.0 65280.0000 /end CHARACTERISTIC
/begin CHARACTERISTIC K_T3SOC0 "" VALUE 0x72E88 TKW_VV_VV_UB 100.0 FORMULA_0735 0.0 65280.0000 /end CHARACTERISTIC
/begin CHARACTERISTIC K_ISTARTTRIG "" VALUE 0x72E89 TKW_VV_VV_UB 100.0 FORMULA_0498 0.0 1305.6000 /end CHARACTERISTIC
/begin CHARACTERISTIC K_TNUSTART "" VALUE 0x72E8A TKW_VV_VV_UB 100.0 FORMULA_0736 0.0 3.1875 /end CHARACTERISTIC
/begin CHARACTERISTIC K_TNUSTARTFL "" VALUE 0x72E8B TKW_VV_VV_UB 100.0 FORMULA_0737 0.0100 0.5200 /end CHARACTERISTIC
/begin CHARACTERISTIC K_UTIEFAPP "" VALUE 0x72E8C TKW_VV_VV_UB 100.0 FORMULA_0734 6.0000 22.3200 /end CHARACTERISTIC
/begin CHARACTERISTIC K_T_UTIEFSET "" VALUE 0x72E8D TKW_VV_VV_UB 100.0 FORMULA_0472 0.0 255.0000 /end CHARACTERISTIC
/begin CHARACTERISTIC K_TSLEEPRUH "" VALUE 0x72E8E TKW_VV_VV_UB 100.0 FORMULA_0738 0.0 4080.0000 /end CHARACTERISTIC
/begin CHARACTERISTIC K_T1SCHWELLE "" VALUE 0x72E8F TKW_VV_VV_UB 100.0 FORMULA_0739 0.0 10.2000 /end CHARACTERISTIC
/begin CHARACTERISTIC K_T2SCHWELLE "" VALUE 0x72E90 TKW_VV_VV_UB 100.0 FORMULA_0739 0.0 10.2000 /end CHARACTERISTIC
/begin CHARACTERISTIC K_T3SCHWELLE "" VALUE 0x72E91 TKW_VV_VV_UB 100.0 FORMULA_0739 0.0 10.2000 /end CHARACTERISTIC
/begin CHARACTERISTIC K_ISLEEPGRZ "" VALUE 0x72E92 TKW_VV_VV_UB 100.0 FORMULA_0733 0.0 5.1000 /end CHARACTERISTIC
/begin CHARACTERISTIC K_DI1000TGRZ "" VALUE 0x72E93 TKW_VV_VV_UB 100.0 FORMULA_0472 0.0 255.0000 /end CHARACTERISTIC
/begin CHARACTERISTIC K_DUIGRZ "" VALUE 0x72E94 TKW_VV_VV_UB 100.0 FORMULA_0733 0.0 5.1000 /end CHARACTERISTIC
/begin CHARACTERISTIC K_DTMAXGRZI "" VALUE 0x72E95 TKW_VV_VV_UB 100.0 FORMULA_0472 0.0 255.0000 /end CHARACTERISTIC
/begin CHARACTERISTIC K_DILOWGRZ "" VALUE 0x72E96 TKW_VV_VV_UB 100.0 FORMULA_0733 0.0 5.1000 /end CHARACTERISTIC
/begin CHARACTERISTIC K_DIHIGHGRZ "" VALUE 0x72E97 TKW_VV_VV_UB 100.0 FORMULA_0740 0.0 20.4000 /end CHARACTERISTIC
/begin CHARACTERISTIC K_DUMINTGRZ "" VALUE 0x72E98 TKW_VV_VV_UB 100.0 FORMULA_0741 0.0 12.7500 /end CHARACTERISTIC
/begin CHARACTERISTIC K_DKL15FIL "" VALUE 0x72E99 TKW_VV_VV_UB 100.0 FORMULA_0742 0.0 1.5937 /end CHARACTERISTIC
/begin CHARACTERISTIC K_DUREFMAX "" VALUE 0x72E9A TKW_VV_VV_UB 100.0 FORMULA_0743 0.0 4.9980 /end CHARACTERISTIC
/begin CHARACTERISTIC K_DI200STG "" VALUE 0x72E9B TKW_VV_VV_UB 100.0 FORMULA_0733 0.0 5.1000 /end CHARACTERISTIC
/begin CHARACTERISTIC K_DI1000STG "" VALUE 0x72E9C TKW_VV_VV_UB 100.0 FORMULA_0740 0.0 20.4000 /end CHARACTERISTIC
/begin CHARACTERISTIC K_DI200DT "" VALUE 0x72E9D TKW_VV_VV_UB 100.0 FORMULA_0741 0.0 12.7500 /end CHARACTERISTIC
/begin CHARACTERISTIC K_DI1000DT "" VALUE 0x72E9E TKW_VV_VV_UB 100.0 FORMULA_0741 0.0 12.7500 /end CHARACTERISTIC
/begin CHARACTERISTIC K_TMPCOM_MUL "" VALUE 0x72E9F TKW_VV_VV_UB 100.0 FORMULA_0003 0.0 255.0000 /end CHARACTERISTIC
/begin CHARACTERISTIC K_TMPCOM_DIV "" VALUE 0x72EA0 TKW_VV_VV_UB 100.0 FORMULA_0003 0.0 255.0000 /end CHARACTERISTIC
/begin CHARACTERISTIC K_DIPL5 "" VALUE 0x72EA1 TKW_VV_VV_UB 100.0 FORMULA_0003 0.0 255.0000 /end CHARACTERISTIC
/begin CHARACTERISTIC K_DIPL6 "" VALUE 0x72EA2 TKW_VV_VV_UB 100.0 FORMULA_0003 0.0 255.0000 /end CHARACTERISTIC
/begin CHARACTERISTIC K_DIPL7 "" VALUE 0x72EA3 TKW_VV_VV_UB 100.0 FORMULA_0003 0.0 255.0000 /end CHARACTERISTIC
/begin CHARACTERISTIC K_DIPL8 "" VALUE 0x72EA4 TKW_VV_VV_UB 100.0 FORMULA_0003 0.0 255.0000 /end CHARACTERISTIC
/begin CHARACTERISTIC K_DUREFMINI "" VALUE 0x72EA5 TKW_VV_VV_UB 100.0 FORMULA_0743 0.0 4.9980 /end CHARACTERISTIC
/begin CHARACTERISTIC K_IBTEMPMAXI "" VALUE 0x72EA6 TKW_VV_VV_UB 100.0 FORMULA_0003 0.0 255.0000 /end CHARACTERISTIC
/begin CHARACTERISTIC K_IBTEMPMINI "" VALUE 0x72EA7 TKW_VV_VV_UB 100.0 FORMULA_0003 0.0 255.0000 /end CHARACTERISTIC
/begin CHARACTERISTIC K_IBSVERSION_1of16_ "Liste der kompatiblen IBS SW- Versionen | EN: Liste der kompatiblen IBS SW- Versionen" VALUE 0x72EA8 TKW_VV_VV_UB 100.0 FORMULA_0003 0.0 255.0000 /end CHARACTERISTIC
/begin CHARACTERISTIC K_IBSVERSION_2of16_ "Liste der kompatiblen IBS SW- Versionen | EN: Liste der kompatiblen IBS SW- Versionen" VALUE 0x72EA9 TKW_VV_VV_UB 100.0 FORMULA_0003 0.0 255.0000 /end CHARACTERISTIC
/begin CHARACTERISTIC K_IBSVERSION_3of16_ "Liste der kompatiblen IBS SW- Versionen | EN: Liste der kompatiblen IBS SW- Versionen" VALUE 0x72EAA TKW_VV_VV_UB 100.0 FORMULA_0003 0.0 255.0000 /end CHARACTERISTIC
/begin CHARACTERISTIC K_IBSVERSION_4of16_ "Liste der kompatiblen IBS SW- Versionen | EN: Liste der kompatiblen IBS SW- Versionen" VALUE 0x72EAB TKW_VV_VV_UB 100.0 FORMULA_0003 0.0 255.0000 /end CHARACTERISTIC
/begin CHARACTERISTIC K_IBSVERSION_5of16_ "Liste der kompatiblen IBS SW- Versionen | EN: Liste der kompatiblen IBS SW- Versionen" VALUE 0x72EAC TKW_VV_VV_UB 100.0 FORMULA_0003 0.0 255.0000 /end CHARACTERISTIC
/begin CHARACTERISTIC K_IBSVERSION_6of16_ "Liste der kompatiblen IBS SW- Versionen | EN: Liste der kompatiblen IBS SW- Versionen" VALUE 0x72EAD TKW_VV_VV_UB 100.0 FORMULA_0003 0.0 255.0000 /end CHARACTERISTIC
/begin CHARACTERISTIC K_IBSVERSION_7of16_ "Liste der kompatiblen IBS SW- Versionen | EN: Liste der kompatiblen IBS SW- Versionen" VALUE 0x72EAE TKW_VV_VV_UB 100.0 FORMULA_0003 0.0 255.0000 /end CHARACTERISTIC
/begin CHARACTERISTIC K_IBSVERSION_8of16_ "Liste der kompatiblen IBS SW- Versionen | EN: Liste der kompatiblen IBS SW- Versionen" VALUE 0x72EAF TKW_VV_VV_UB 100.0 FORMULA_0003 0.0 255.0000 /end CHARACTERISTIC
/begin CHARACTERISTIC K_IBSVERSION_9of16_ "Liste der kompatiblen IBS SW- Versionen | EN: Liste der kompatiblen IBS SW- Versionen" VALUE 0x72EB0 TKW_VV_VV_UB 100.0 FORMULA_0003 0.0 255.0000 /end CHARACTERISTIC
/begin CHARACTERISTIC K_IBSVERSION_10of16_ "Liste der kompatiblen IBS SW- Versionen | EN: Liste der kompatiblen IBS SW- Versionen" VALUE 0x72EB1 TKW_VV_VV_UB 100.0 FORMULA_0003 0.0 255.0000 /end CHARACTERISTIC
/begin CHARACTERISTIC K_IBSVERSION_11of16_ "Liste der kompatiblen IBS SW- Versionen | EN: Liste der kompatiblen IBS SW- Versionen" VALUE 0x72EB2 TKW_VV_VV_UB 100.0 FORMULA_0003 0.0 255.0000 /end CHARACTERISTIC
/begin CHARACTERISTIC K_IBSVERSION_12of16_ "Liste der kompatiblen IBS SW- Versionen | EN: Liste der kompatiblen IBS SW- Versionen" VALUE 0x72EB3 TKW_VV_VV_UB 100.0 FORMULA_0003 0.0 255.0000 /end CHARACTERISTIC
/begin CHARACTERISTIC K_IBSVERSION_13of16_ "Liste der kompatiblen IBS SW- Versionen | EN: Liste der kompatiblen IBS SW- Versionen" VALUE 0x72EB4 TKW_VV_VV_UB 100.0 FORMULA_0003 0.0 255.0000 /end CHARACTERISTIC
/begin CHARACTERISTIC K_IBSVERSION_14of16_ "Liste der kompatiblen IBS SW- Versionen | EN: Liste der kompatiblen IBS SW- Versionen" VALUE 0x72EB5 TKW_VV_VV_UB 100.0 FORMULA_0003 0.0 255.0000 /end CHARACTERISTIC
/begin CHARACTERISTIC K_IBSVERSION_15of16_ "Liste der kompatiblen IBS SW- Versionen | EN: Liste der kompatiblen IBS SW- Versionen" VALUE 0x72EB6 TKW_VV_VV_UB 100.0 FORMULA_0003 0.0 255.0000 /end CHARACTERISTIC
/begin CHARACTERISTIC K_IBSVERSION_16of16_ "Liste der kompatiblen IBS SW- Versionen | EN: Liste der kompatiblen IBS SW- Versionen" VALUE 0x72EB7 TKW_VV_VV_UB 100.0 FORMULA_0003 0.0 255.0000 /end CHARACTERISTIC
/begin CHARACTERISTIC K_ENABSDIBS "kt_ibs enable Kommunikation | EN: Enable intelligent-battery-sensor communication" VALUE 0x72EB8 TKW_VV_VV_UB 100.0 FORMULA_0003 0.0 255.0000 /end CHARACTERISTIC
/begin CHARACTERISTIC K_ERREPEAT "EBSD Fehler repeat | EN: EBSD Fehler repeat" VALUE 0x72EB9 TKW_VV_VV_UB 100.0 FORMULA_0003 0.0 255.0000 /end CHARACTERISTIC
/begin CHARACTERISTIC K_IBUNPLADEL "EBSD Fehler repeat | EN: EBSD Fehler repeat" VALUE 0x72EBA TKW_VV_VV_UB 100.0 FORMULA_0003 0.0 255.0000 /end CHARACTERISTIC
/begin CHARACTERISTIC K_IBSTSTERR "EBSD Fehler repeat" VALUE 0x72EBB TKW_VV_VV_UB 100.0 FORMULA_0003 0.0 255.0000 /end CHARACTERISTIC
/begin CHARACTERISTIC K_S_CLERRIBS "IBS Fehlerl�schen schaltbar | EN: Intelligent battery sensor fault clearing switchable" VALUE 0x72EBC TKW_VV_VV_UB 100.0 FORMULA_0003 0.0 255.0000 /end CHARACTERISTIC
/begin CHARACTERISTIC K_T_CLERRIBS " | EN: Time for clearing intelligent battery sensor faults" VALUE 0x72EBD TKW_VV_VV_UB 100.0 FORMULA_0003 0.0 255.0000 /end CHARACTERISTIC
/begin CHARACTERISTIC K_SLEEPWAIT "" VALUE 0x72EBE TKW_VV_VV_UB 100.0 FORMULA_0483 0.0 255.0000 /end CHARACTERISTIC
/begin CHARACTERISTIC K_TPT1TICO "" VALUE 0x72EC0 TKW_VV_VV_UW 100.0 FORMULA_0744 0.0 3276.7500 FORMAT "%5.2" /end CHARACTERISTIC
/begin MEASUREMENT St_sleep.B_sleepwait "Signal Verzoegerung Sleep Indication" UBYTE FORMULA_0418 0 0 0.0 255.0 ECU_ADDRESS 0x3FC274 BIT_MASK 0x1 /end MEASUREMENT
/begin MEASUREMENT St_sleep "Statuswort Einschlafverhalten" UBYTE FORMULA_0033 0 0 0.0 255.0000 ECU_ADDRESS 0x3FC274 /end MEASUREMENT
/begin MEASUREMENT St_ibsreg4.B_startfgk "Bedingung Startf�higkeit gef�hrdet" UBYTE FORMULA_0418 0 0 0.0 255.0 ECU_ADDRESS 0x3FC275 BIT_MASK 0x1 /end MEASUREMENT
/begin MEASUREMENT St_ibsreg4.B_strtaw "Bedingung Startauswertung gerechnet" UBYTE FORMULA_0419 0 0 0.0 255.0 ECU_ADDRESS 0x3FC275 BIT_MASK 0x2 /end MEASUREMENT
/begin MEASUREMENT St_ibsreg4.B_ibspwf "Bedingung IBS powerfail erkannt" UBYTE FORMULA_0422 0 0 0.0 255.0 ECU_ADDRESS 0x3FC275 BIT_MASK 0x10 /end MEASUREMENT
/begin MEASUREMENT St_ibsreg4.B_tiefset "Bedingung Tiefentladung" UBYTE FORMULA_0423 0 0 0.0 255.0 ECU_ADDRESS 0x3FC275 BIT_MASK 0x20 /end MEASUREMENT
/begin MEASUREMENT St_ibsreg4.B_ibsweck "Bedingung IBS hat geweckt" UBYTE FORMULA_0424 0 0 0.0 255.0 ECU_ADDRESS 0x3FC275 BIT_MASK 0x40 /end MEASUREMENT
/begin MEASUREMENT St_ibsreg4 "" UBYTE FORMULA_0003 0 0 0.0 255.0000 ECU_ADDRESS 0x3FC275 /end MEASUREMENT
/begin MEASUREMENT St_ibsreg5.B_fsclr "Bedingung IBS interne Fehler loeschen" UBYTE FORMULA_0421 0 0 0.0 255.0 ECU_ADDRESS 0x3FC276 BIT_MASK 0x8 /end MEASUREMENT
/begin MEASUREMENT St_ibsreg5 "Statuswort ibsreg5" UBYTE FORMULA_0003 0 0 0.0 255.0000 ECU_ADDRESS 0x3FC276 /end MEASUREMENT
/begin MEASUREMENT Ibs_reg5 "IBS Register 5 Var.not used: now St_ibsreg5" UBYTE FORMULA_0003 0 0 0.0 255.0000 ECU_ADDRESS 0x3FC277 /end MEASUREMENT
/begin MEASUREMENT Ibs_errors "Fehler Reg. aus IBS gelesen" UBYTE FORMULA_0003 0 0 0.0 255.0000 ECU_ADDRESS 0x3FC278 /end MEASUREMENT
/begin MEASUREMENT Ibs_msgind "Index auf EBSD Botschaft" UBYTE FORMULA_0003 0 0 0.0 255.0000 ECU_ADDRESS 0x3FC279 /end MEASUREMENT
/begin MEASUREMENT Ibs_msgsta "EBSD Fehler Status" UBYTE FORMULA_0003 0 0 0.0 255.0000 ECU_ADDRESS 0x3FC27A /end MEASUREMENT
/begin MEASUREMENT Kt_ibsstatus "Status BSD Statemachine" UBYTE FORMULA_0003 0 0 0.0 255.0000 ECU_ADDRESS 0x3FC27B /end MEASUREMENT
/begin MEASUREMENT Ibs_start "Status Statemachine Startup Kommunikation" UBYTE FORMULA_0003 0 0 0.0 255.0000 ECU_ADDRESS 0x3FC27C /end MEASUREMENT
/begin MEASUREMENT Comcontrol "Kontrolle Diagnose Modul DIBS" UBYTE FORMULA_0003 0 0 0.0 255.0000 ECU_ADDRESS 0x3FC27D /end MEASUREMENT
/begin MEASUREMENT St_ibebsd1.B_ibs_msgrdy "Bedingung EBSD Botschaft von IBS empfangen" UBYTE FORMULA_0418 0 0 0.0 255.0 ECU_ADDRESS 0x3FC27E BIT_MASK 0x1 /end MEASUREMENT
/begin MEASUREMENT St_ibebsd1.B_ibs_msgwri "Bedingung EBSD �bertragungsrichtung schreiben" UBYTE FORMULA_0419 0 0 0.0 255.0 ECU_ADDRESS 0x3FC27E BIT_MASK 0x2 /end MEASUREMENT
/begin MEASUREMENT St_ibebsd1.B_eb_txok "Bedingung EBSD �bertragungsrichtung schreiben" UBYTE FORMULA_0420 0 0 0.0 255.0 ECU_ADDRESS 0x3FC27E BIT_MASK 0x4 /end MEASUREMENT
/begin MEASUREMENT St_ibebsd1.B_eb_busy "Bedingung EBSD �bertragungsrichtung schreiben" UBYTE FORMULA_0421 0 0 0.0 255.0 ECU_ADDRESS 0x3FC27E BIT_MASK 0x8 /end MEASUREMENT
/begin MEASUREMENT St_ibebsd1 "" UBYTE FORMULA_0003 0 0 0.0 255.0000 ECU_ADDRESS 0x3FC27E /end MEASUREMENT
/begin MEASUREMENT St_ibserr.B_ibfbsd "Bedingung BSD Fehler" UBYTE FORMULA_0418 0 0 0.0 255.0 ECU_ADDRESS 0x3FC27F BIT_MASK 0x1 /end MEASUREMENT
/begin MEASUREMENT St_ibserr.B_ibfebsd "Bedingung EBSD Fehler" UBYTE FORMULA_0419 0 0 0.0 255.0 ECU_ADDRESS 0x3FC27F BIT_MASK 0x2 /end MEASUREMENT
/begin MEASUREMENT St_ibserr.B_ibunplau "Bedingung IBS Version unplausibel" UBYTE FORMULA_0420 0 0 0.0 255.0 ECU_ADDRESS 0x3FC27F BIT_MASK 0x4 /end MEASUREMENT
/begin MEASUREMENT St_ibserr "Statuswort ibserr" UBYTE FORMULA_0003 0 0 0.0 255.0000 ECU_ADDRESS 0x3FC27F /end MEASUREMENT
/begin MEASUREMENT St_ibmix.B_ibrhilo "toggle Bit Register0/ 1 hi- od. lo byte" UBYTE FORMULA_0418 0 0 0.0 255.0 ECU_ADDRESS 0x3FC280 BIT_MASK 0x1 /end MEASUREMENT
/begin MEASUREMENT St_ibmix.B_ibttog "global toggle bit" UBYTE FORMULA_0419 0 0 0.0 255.0 ECU_ADDRESS 0x3FC280 BIT_MASK 0x2 /end MEASUREMENT
/begin MEASUREMENT St_ibmix "Statuswort ibmix" UBYTE FORMULA_0003 0 0 0.0 255.0000 ECU_ADDRESS 0x3FC280 /end MEASUREMENT
/begin MEASUREMENT Ibswbase "IBS Software Baseline" UBYTE FORMULA_0003 0 0 0.0 255.0000 ECU_ADDRESS 0x3FC281 /end MEASUREMENT
/begin MEASUREMENT Ibswchang "IBS Software �nderungs Status" UBYTE FORMULA_0003 0 0 0.0 255.0000 ECU_ADDRESS 0x3FC282 /end MEASUREMENT
/begin MEASUREMENT Ibhwversi "IBS Hardware Version" UBYTE FORMULA_0003 0 0 0.0 255.0000 ECU_ADDRESS 0x3FC283 /end MEASUREMENT
/begin MEASUREMENT Ib_parlen "L�nge IBS Parameterliste" UBYTE FORMULA_0003 0 0 0.0 255.0000 ECU_ADDRESS 0x3FC284 /end MEASUREMENT
/begin MEASUREMENT Ibsiicctri "IBS Fehlerz�hler" UBYTE FORMULA_0003 0 0 0.0 255.0000 ECU_ADDRESS 0x3FC285 /end MEASUREMENT
/begin MEASUREMENT Ibsbclctri "IBS Fehlerz�hler" UBYTE FORMULA_0003 0 0 0.0 255.0000 ECU_ADDRESS 0x3FC286 /end MEASUREMENT
/begin MEASUREMENT Ibseromctr "IBS Fehlerz�hler" UBYTE FORMULA_0003 0 0 0.0 255.0000 ECU_ADDRESS 0x3FC287 /end MEASUREMENT
/begin MEASUREMENT Ibsramctr "IBS Fehlerz�hler" UBYTE FORMULA_0003 0 0 0.0 255.0000 ECU_ADDRESS 0x3FC288 /end MEASUREMENT
/begin MEASUREMENT Ibspromctr "IBS Fehlerz�hler" UBYTE FORMULA_0003 0 0 0.0 255.0000 ECU_ADDRESS 0x3FC289 /end MEASUREMENT
/begin MEASUREMENT Ibsdncsctr "IBS Fehlerz�hler download checksum" UBYTE FORMULA_0003 0 0 0.0 255.0000 ECU_ADDRESS 0x3FC28A /end MEASUREMENT
/begin MEASUREMENT T_battsoci "T_battsoc0, Rohwert aus IBS" UBYTE FORMULA_0003 0 0 0.0 255.0000 ECU_ADDRESS 0x3FC28B /end MEASUREMENT
/begin MEASUREMENT Tbatt_maxi "T_batt_max, Rohwert aus IBS" UBYTE FORMULA_0003 0 0 0.0 255.0000 ECU_ADDRESS 0x3FC28C /end MEASUREMENT
/begin MEASUREMENT Tbatt_mini "T_batt_min, Rohwert aus IBS" UBYTE FORMULA_0003 0 0 0.0 255.0000 ECU_ADDRESS 0x3FC28D /end MEASUREMENT
/begin MEASUREMENT Ibslvdctr "IBS Fehlerz�hler" UWORD FORMULA_0010 0 0 0.0 65535.0000 ECU_ADDRESS 0x3FC28E /end MEASUREMENT
/begin MEASUREMENT I_batt "Batteriestrom von IBS gemessen" UWORD FORMULA_0504 0 0 -200.0000 5042.8000 ECU_ADDRESS 0x3FC290 /end MEASUREMENT
/begin MEASUREMENT U_batt "Batteriespannung von IBS gemessen" UWORD FORMULA_0497 0 0 6.0000 22.3837 ECU_ADDRESS 0x3FC292 /end MEASUREMENT
/begin MEASUREMENT Ibsborctr "IBS Fehlerz�hler" UWORD FORMULA_0010 0 0 0.0 65535.0000 ECU_ADDRESS 0x3FC294 /end MEASUREMENT
/begin MEASUREMENT Ibswdtctr "IBS Fehlerz�hler watchdog" UWORD FORMULA_0010 0 0 0.0 65535.0000 ECU_ADDRESS 0x3FC296 /end MEASUREMENT
/begin MEASUREMENT Ibsporctr "IBS Fehlerz�hler power on" UWORD FORMULA_0010 0 0 0.0 65535.0000 ECU_ADDRESS 0x3FC298 /end MEASUREMENT
/begin MEASUREMENT Ibsptyctr "IBS Fehlerz�hler BSD parity" UWORD FORMULA_0010 0 0 0.0 65535.0000 ECU_ADDRESS 0x3FC29A /end MEASUREMENT
/begin MEASUREMENT Qlad "Delta Batterieladung" UWORD FORMULA_0494 0 0 0.0 1192.7502 ECU_ADDRESS 0x3FC29C /end MEASUREMENT
/begin MEASUREMENT Qelad "Delta Batterieentladung" UWORD FORMULA_0494 0 0 0.0 1192.7502 ECU_ADDRESS 0x3FC29E /end MEASUREMENT
/begin MEASUREMENT I_soc0 "Strom bei Ruhespannungsmessung" SWORD FORMULA_0507 0 0 -655.3600 655.3400 ECU_ADDRESS 0x3FC2A0 /end MEASUREMENT
/begin MEASUREMENT T_battsoc0 "Batterietemperatur bei Ruhespannungsmessung" SWORD FORMULA_0426 0 0 -3276.8000 3276.7000 ECU_ADDRESS 0x3FC2A2 /end MEASUREMENT
/begin MEASUREMENT U1soc0 "Ruhespannung 1" UWORD FORMULA_0497 0 0 6.0000 22.3837 ECU_ADDRESS 0x3FC2A4 /end MEASUREMENT
/begin MEASUREMENT U2soc0 "Ruhespannung 1" UWORD FORMULA_0497 0 0 6.0000 22.3837 ECU_ADDRESS 0x3FC2A6 /end MEASUREMENT
/begin MEASUREMENT U3soc0 "Ruhespannung 1" UWORD FORMULA_0497 0 0 6.0000 22.3837 ECU_ADDRESS 0x3FC2A8 /end MEASUREMENT
/begin MEASUREMENT Qladsoc0 "Ladung bei Ruhespannungsmessung" UWORD FORMULA_0494 0 0 0.0 1192.7502 ECU_ADDRESS 0x3FC2AA /end MEASUREMENT
/begin MEASUREMENT Qeladsoc0 "Entladung bei Ruhespannungsmessung" UWORD FORMULA_0494 0 0 0.0 1192.7502 ECU_ADDRESS 0x3FC2AC /end MEASUREMENT
/begin MEASUREMENT U_vorstart "Spannung vor Start" UWORD FORMULA_0497 0 0 6.0000 22.3837 ECU_ADDRESS 0x3FC2AE /end MEASUREMENT
/begin MEASUREMENT U_tnstart "Spannung im Start" UWORD FORMULA_0497 0 0 6.0000 22.3837 ECU_ADDRESS 0x3FC2B0 /end MEASUREMENT
/begin MEASUREMENT I_vorstart "Batteriestrom vor Start" UWORD FORMULA_0732 0 0 -200.0000 1110.7000 ECU_ADDRESS 0x3FC2B2 /end MEASUREMENT
/begin MEASUREMENT I_tnstart "Batteriestrom im Start" UWORD FORMULA_0511 0 0 0.0 1310.7000 ECU_ADDRESS 0x3FC2B4 /end MEASUREMENT
/begin MEASUREMENT T1histiruh "Ruhestromhistogramm Klasse 1" UWORD FORMULA_0010 0 0 0.0 65535.0000 ECU_ADDRESS 0x3FC2B6 /end MEASUREMENT
/begin MEASUREMENT T2histiruh "Ruhestromhistogramm Klasse 2" UWORD FORMULA_0010 0 0 0.0 65535.0000 ECU_ADDRESS 0x3FC2B8 /end MEASUREMENT
/begin MEASUREMENT T3histiruh "Ruhestromhistogramm Klasse 3" UWORD FORMULA_0010 0 0 0.0 65535.0000 ECU_ADDRESS 0x3FC2BA /end MEASUREMENT
/begin MEASUREMENT T4histiruh "Ruhestromhistogramm Klasse 4" UWORD FORMULA_0010 0 0 0.0 65535.0000 ECU_ADDRESS 0x3FC2BC /end MEASUREMENT
/begin MEASUREMENT T_batt_ibs "Batterietemperatur" SWORD FORMULA_0426 0 0 -3276.8000 3276.7000 ECU_ADDRESS 0x3FC2BE /end MEASUREMENT
/begin MEASUREMENT T_batt_max "Maximale Batt. Temperatur bei Stillstand" SWORD FORMULA_0426 0 0 -3276.8000 3276.7000 ECU_ADDRESS 0x3FC2C0 /end MEASUREMENT
/begin MEASUREMENT T_batt_min "Minimale Batt. Temperatur bei Stillstand" SWORD FORMULA_0426 0 0 -3276.8000 3276.7000 ECU_ADDRESS 0x3FC2C2 /end MEASUREMENT
/begin MEASUREMENT Ktupcsctr "kt_ibs Fehlerz�hler EBSD Checksumme" UWORD FORMULA_0010 0 0 0.0 65535.0000 ECU_ADDRESS 0x3FC2C4 /end MEASUREMENT
/begin MEASUREMENT Zbibs "Zusbaunummer" ULONG FORMULA_0000 0 0 0.0 4294967295.0000 ECU_ADDRESS 0x3FC2C8 /end MEASUREMENT
/begin MEASUREMENT Snibs "Seriennummer" ULONG FORMULA_0000 0 0 0.0 4294967295.0000 ECU_ADDRESS 0x3FC2CC /end MEASUREMENT
/begin MEASUREMENT Ebsd_varin "Index EBSD Variable" UBYTE FORMULA_0003 0 0 0.0 255.0000 ECU_ADDRESS 0x3FAF88 /end MEASUREMENT
/begin MEASUREMENT Ebsd_nbyt "L�nge EBSD Variable" UBYTE FORMULA_0003 0 0 0.0 255.0000 ECU_ADDRESS 0x3FAF89 /end MEASUREMENT
/begin MEASUREMENT Unind "EBSD Puffer Index" UBYTE FORMULA_0003 0 0 0.0 255.0000 ECU_ADDRESS 0x3FAF8A /end MEASUREMENT
/begin MEASUREMENT Ebsd_adr "EBSD Adresse im IBS" UBYTE FORMULA_0003 0 0 0.0 255.0000 ECU_ADDRESS 0x3FAF8B /end MEASUREMENT
/begin MEASUREMENT Ebsd_errdir "EBSD �bertragungsrichtung bei Fehler" UBYTE FORMULA_0003 0 0 0.0 255.0000 ECU_ADDRESS 0x3FAF8C /end MEASUREMENT
/begin MEASUREMENT Ebsd_errin "EBSD Index bei Fehler" UBYTE FORMULA_0003 0 0 0.0 255.0000 ECU_ADDRESS 0x3FAF8D /end MEASUREMENT
/begin MEASUREMENT Ebsd_errep "EBSD Fehler repeat timer" UBYTE FORMULA_0003 0 0 0.0 255.0000 ECU_ADDRESS 0x3FAF8E /end MEASUREMENT
/begin MEASUREMENT Ebsd_timo "EBSD Fehler timeout counter" UBYTE FORMULA_0003 0 0 0.0 255.0000 ECU_ADDRESS 0x3FAF8F /end MEASUREMENT
/begin MEASUREMENT R5cyctim "Timer f. zyklisches Senden IBS Reg. 5" UBYTE FORMULA_0003 0 0 0.0 255.0000 ECU_ADDRESS 0x3FAF90 /end MEASUREMENT
/begin MEASUREMENT Fsclctr "Hilfszaehler IBS Fehler loeschen" UBYTE FORMULA_0003 0 0 0.0 255.0000 ECU_ADDRESS 0x3FAF91 /end MEASUREMENT
/begin MEASUREMENT Ktib_chk16 "Checksumme EBSD �bertragung intern" UWORD FORMULA_0010 0 0 0.0 65535.0000 ECU_ADDRESS 0x3FAF92 /end MEASUREMENT
/begin MEASUREMENT Ib_chk16 "Checksumme EBSD �bertragung aus IBS" UWORD FORMULA_0010 0 0 0.0 65535.0000 ECU_ADDRESS 0x3FAF94 /end MEASUREMENT
/begin MEASUREMENT Chk16_ibs "Checksumme Parameter aus IBS" UWORD FORMULA_0010 0 0 0.0 65535.0000 ECU_ADDRESS 0x3FAF96 /end MEASUREMENT
/begin MEASUREMENT Chkpara "Checksumme Parameter intern" UWORD FORMULA_0010 0 0 0.0 65535.0000 ECU_ADDRESS 0x3FAF98 /end MEASUREMENT
/* ------------------ Abschnitt erzeugt aus kt_oz.dat ------------------ */
/begin MEASUREMENT St_oz.B_anhang "Bedingung Anh�nger erkannt" UBYTE FORMULA_0418 0 0 0.0 255.0 ECU_ADDRESS 0x3FAFC4 BIT_MASK 0x1 /end MEASUREMENT
/begin MEASUREMENT St_oz.B_ozfbsd "Bedingung Fehler BSD-Kommunikation" UBYTE FORMULA_0419 0 0 0.0 255.0 ECU_ADDRESS 0x3FAFC4 BIT_MASK 0x2 /end MEASUREMENT
/begin MEASUREMENT St_oz "Statuswort mit Biteingangsgroessen OZ" UBYTE FORMULA_0003 0 0 0.0 255.0000 ECU_ADDRESS 0x3FAFC4 /end MEASUREMENT
/begin MEASUREMENT Oz_nivr "Rohwert �lniveaumessung vom Sensor" UBYTE FORMULA_0731 0 0 0.1000 75.0000 ECU_ADDRESS 0x3FAFC5 /end MEASUREMENT
/begin MEASUREMENT Oz_status "Statusinformation vom �lzustandssensor" UBYTE FORMULA_0003 0 0 0.0 255.0000 ECU_ADDRESS 0x3FAFC6 /end MEASUREMENT
/begin MEASUREMENT Oz_permr "Rohwert Permittivit�t vom Sensor" UWORD FORMULA_0745 0 0 1.0000 6.0000 ECU_ADDRESS 0x3FAFC8 /end MEASUREMENT
/begin MEASUREMENT Oz_nivr_index "Rohwert-Index-Zaehler" UBYTE FORMULA_0033 0 0 0.0 255.0000 ECU_ADDRESS 0x3FAFCA /end MEASUREMENT
/* ------------------ Abschnitt erzeugt aus n_dyn.dat ------------------ */
/begin CHARACTERISTIC K_N_OBD_DYN_TAU "Zeitkonstante f�r n-Filter Dynamikerkennung | EN: Time constant for speed filter, dynamics detection" VALUE 0x74C68 TKW_VV_VV_UB 100.0 FORMULA_0664 0.0101 2.5600 /end CHARACTERISTIC
/begin CHARACTERISTIC K_N_OBD_DYN_DELTA "Differenzdrehzahl fuer Dynamikerkennung | EN: Speed difference for dynamics detection" VALUE 0x74C6A TKW_VV_VV_SW 100.0 FORMULA_0006 0.0 10000.0000 /end CHARACTERISTIC
/begin CHARACTERISTIC K_N_OBD_DYN_T "Sperrzeit fuer Ruecknahme N-Dynamik | EN: Lock-out time for withdrawing speed dynamics" VALUE 0x74C6C TKW_VV_VV_UW 100.0 FORMULA_0021 0.0 655.0000 FORMAT "%5.2" /end CHARACTERISTIC
/begin MEASUREMENT n_dyn_timer "Aktuelle Sperrzeit fuer Ruecknahme N-Dynamik" UWORD FORMULA_0021 0 0 0.0 655.0000 ECU_ADDRESS 0x3FCA94 /end MEASUREMENT
/begin MEASUREMENT n_dyn_filter "gefilterte Drehzahl fuer Dynamikerkennung" SWORD FORMULA_0006 0 0 0.0 10000.0000 ECU_ADDRESS 0x3FCA96 /end MEASUREMENT
/* ------------------ Abschnitt erzeugt aus n_grad.dat ------------------ */
/begin MEASUREMENT n_grad_buf_0 "History Drehzahlgradient." SWORD FORMULA_0006 0 0 0.0 10000.0000 ECU_ADDRESS 0x3FCA98 /end MEASUREMENT
/begin MEASUREMENT n_grad_buf_1 "History Drehzahlgradient." SWORD FORMULA_0006 0 0 0.0 10000.0000 ECU_ADDRESS 0x3FCA9A /end MEASUREMENT
/begin MEASUREMENT n_grad_buf_2 "History Drehzahlgradient." SWORD FORMULA_0006 0 0 0.0 10000.0000 ECU_ADDRESS 0x3FCA9C /end MEASUREMENT
/begin MEASUREMENT n_grad_buf_3 "History Drehzahlgradient." SWORD FORMULA_0006 0 0 0.0 10000.0000 ECU_ADDRESS 0x3FCA9E /end MEASUREMENT
/begin MEASUREMENT n_grad_buf_4 "History Drehzahlgradient." SWORD FORMULA_0006 0 0 0.0 10000.0000 ECU_ADDRESS 0x3FCAA0 /end MEASUREMENT
/begin MEASUREMENT n_grad_buf_5 "History Drehzahlgradient." SWORD FORMULA_0006 0 0 0.0 10000.0000 ECU_ADDRESS 0x3FCAA2 /end MEASUREMENT
/begin MEASUREMENT n_grad_buf_6 "History Drehzahlgradient." SWORD FORMULA_0006 0 0 0.0 10000.0000 ECU_ADDRESS 0x3FCAA4 /end MEASUREMENT
/begin MEASUREMENT n_grad_buf_7 "History Drehzahlgradient." SWORD FORMULA_0006 0 0 0.0 10000.0000 ECU_ADDRESS 0x3FCAA6 /end MEASUREMENT
/begin MEASUREMENT n_grad_buf_8 "History Drehzahlgradient." SWORD FORMULA_0006 0 0 0.0 10000.0000 ECU_ADDRESS 0x3FCAA8 /end MEASUREMENT
/begin MEASUREMENT n_grad_buf_9 "History Drehzahlgradient." SWORD FORMULA_0006 0 0 0.0 10000.0000 ECU_ADDRESS 0x3FCAAA /end MEASUREMENT
/* ------------------ Abschnitt erzeugt aus n_max.dat ------------------ */
/begin CHARACTERISTIC K_N_BEGR_TI_OFF_RSS "N-Offset bei Rennstartschaltung | EN: N-Offset bei Rennstartschaltung" VALUE 0x74C6E TKW_VV_VV_SW 100.0 FORMULA_0006 0.0 5000.0000 /end CHARACTERISTIC
/begin CHARACTERISTIC K_N_BEGR_EGAS_HYS "Hysterese fuer N-Begrenzung ueber Egas | EN: Hysterese fuer N -Begrenzung ueber Egas" VALUE 0x74C70 TKW_VV_VV_SW 100.0 FORMULA_0006 0.0 500.0000 /end CHARACTERISTIC
/begin CHARACTERISTIC K_N_BEGR_TI_HYS "Hysterese fuer N-Begrenzung ueber TI | EN: Hysterese fuer N -Begrenzung ueber TI" VALUE 0x74C72 TKW_VV_VV_SW 100.0 FORMULA_0006 0.0 500.0000 /end CHARACTERISTIC
/begin CHARACTERISTIC K_N_MAX_FF_RESET "FF-Reset fuer meinen INCA-Spezl" VALUE 0x74C74 TKW_VV_VV_UB 100.0 FORMULA_1011 0.0 255.0 /end CHARACTERISTIC
/begin CHARACTERISTIC K_N_BEGR_SK_RAMPE "Rampe fuer SK-Begrenzung | EN: Ramp for safety-concept limit [Upm/s]" VALUE 0x74C75 TKW_VV_VV_UB 100.0 FORMULA_1012 0.0 25500.0000 /end CHARACTERISTIC
/begin CHARACTERISTIC K_N_BEGR_FERTIGUNG "N-Max-Begrenzung fuer Fertigung | EN: Rev limit for production/factory [Upm]" VALUE 0x74C76 TKW_VV_VV_SW 100.0 FORMULA_0006 0.0 10000.0000 /end CHARACTERISTIC
/begin CHARACTERISTIC K_N_BEGR_TRANSPORT "N-Max-Begrenzung fuer Fertigung | EN: Rev limit for production/factory [Upm]" VALUE 0x74C78 TKW_VV_VV_SW 100.0 FORMULA_0006 0.0 10000.0000 /end CHARACTERISTIC
/begin CHARACTERISTIC K_N_BEGR_WERKSTATT "N-Max-Begrenzung fuer Fertigung | EN: Rev limit for production/factory [Upm]" VALUE 0x74C7A TKW_VV_VV_SW 100.0 FORMULA_0006 0.0 10000.0000 /end CHARACTERISTIC
/begin CHARACTERISTIC K_N_BEGR_FETRAWE_WEG "zul. Kilometerstand fuer N-Max-Begrenzung im Fertigungs- bzw. Transportmode | EN: Permitted mileage for rev limit in production or transport mode [km]" VALUE 0x74C7C TKW_VV_VV_UW 100.0 FORMULA_0616 0.0 65535.0000 /end CHARACTERISTIC
/begin CHARACTERISTIC K_N_BEGR_V_FEHLER "N-Max-Begrenzung fuer Fertigung | EN: Rev limit for production/factory [Upm]" VALUE 0x74C7E TKW_VV_VV_SW 100.0 FORMULA_0006 0.0 10000.0000 /end CHARACTERISTIC
/begin CHARACTERISTIC K_N_BEGR_FZG_STEHT "N-Max-Begrenzung fuer Fertigung | EN: N-Max-Begrenzung fuer Fertigung" VALUE 0x74C80 TKW_VV_VV_SW 100.0 FORMULA_0006 0.0 10000.0000 /end CHARACTERISTIC
/begin CHARACTERISTIC K_N_BEGR_CFG "Konfiguration Begrenzer | EN: Konfiguration Begrenzer" VALUE 0x74C82 TKW_VV_VV_UW 100.0 FORMULA_0010 0.0 65535.0000 /end CHARACTERISTIC
/begin CHARACTERISTIC K_N_BEGR_TGETR_AEBGR_UP "�nderungsbegrenzung Drehzahlbegr. nach oben, Tgetr | EN: Änderungsbegrenzung Drehzahlbegr. nach o ben, Tgetr" VALUE 0x74C84 TKW_VV_VV_UW 100.0 FORMULA_1013 0.0 20000.0000 FORMAT "%5.2" /end CHARACTERISTIC
/begin CHARACTERISTIC K_N_BEGR_TGETR_AEBGR_DOWN "�nderungsbegrenzung Drehzahlbegr. nach unten, Tgetr | EN: Änderungsbegrenzung Drehzahlbegr. nach un ten, Tgetr" VALUE 0x74C86 TKW_VV_VV_UW 100.0 FORMULA_1013 0.0 20000.0000 FORMAT "%5.2" /end CHARACTERISTIC
/begin CHARACTERISTIC KL_N_BEGR_GANG "gangabhaengige Drehzahlbegrenzung | EN: Gear-dependent rev limit" CURVE 0x74C88 TKL_SW_VV_SW 100.0 FORMULA_0006 0.0 10000.0000 /begin AXIS_DESCR STD_AXIS gang FORMULA_0666 8 -1.0000 10.0000 /end AXIS_DESCR /end CHARACTERISTIC
/begin CHARACTERISTIC KL_N_BEGR_SK "Maximaldrehzahl bei SK-Fehler | EN: Maximum engine speed with safety-concept fault" CURVE 0x74CAA TKL_UB_VV_SW 100.0 FORMULA_0006 0.0 10000.0000 /begin AXIS_DESCR STD_AXIS Stufe FORMULA_0003 6 0.0 255.0000 /end AXIS_DESCR /end CHARACTERISTIC
/begin CHARACTERISTIC KL_N_BEGR_TOEL_KALT "Begrenzung bei kaltem Oel | EN: Rev limit with cold oil" CURVE 0x74CBE TKL_SW_VV_SW 100.0 FORMULA_0006 0.0 10000.0000
 /begin AXIS_DESCR STD_AXIS toel FORMULA_0023 6 -50.0000 170.0000 FORMAT "%4.1" /end AXIS_DESCR
/end CHARACTERISTIC
/begin CHARACTERISTIC KL_N_BEGR_TOEL_HEISS "Begrenzung bei heissem Oel | EN: Rev limit with hot oil" CURVE 0x74CD8 TKL_SW_VV_SW 100.0 FORMULA_0006 0.0 10000.0000
 /begin AXIS_DESCR STD_AXIS toel_wanne FORMULA_0023 6 -50.0000 170.0000 FORMAT "%4.1" /end AXIS_DESCR
/end CHARACTERISTIC
/begin CHARACTERISTIC KL_N_BEGR_TMOT_HEISS "Begrenzung bei heissem Tmot | EN: Rev limit with hot coolant" CURVE 0x74CF2 TKL_SW_VV_SW 100.0 FORMULA_0006 0.0 10000.0000
 /begin AXIS_DESCR STD_AXIS tmot FORMULA_0023 6 -50.0000 170.0000 FORMAT "%4.1" /end AXIS_DESCR
/end CHARACTERISTIC
/begin CHARACTERISTIC KL_N_BEGR_TGETR_HEISS "Begrenzung bei heissem Getriebeoel | EN: Rev limit with hot gearbox oil" CURVE 0x74D0C TKL_SW_VV_SW 100.0 FORMULA_0006 0.0 10000.0000
 /begin AXIS_DESCR STD_AXIS tgetr FORMULA_0023 8 -50.0000 190.0000 FORMAT "%4.1" /end AXIS_DESCR
/end CHARACTERISTIC
/begin CHARACTERISTIC KL_N_BEGR_TI_OFFSET "N-Offset auf Momenteneingriff | EN: N-Offset auf Momenteneingriff" CURVE 0x74D2E TKL_SW_VV_SW 100.0 FORMULA_0006 0.0 10000.0000 /begin AXIS_DESCR STD_AXIS n_begr_egas FORMULA_0006 4 0.0 10000.0000 /end AXIS_DESCR /end CHARACTERISTIC
/begin CHARACTERISTIC K_N_BEGR_ERR_E2 "max. Fehler nmax Ebene 2" VALUE 0x79596 TKW_VV_VV_UB 100.0 FORMULA_0003 0.0 255.0000 /end CHARACTERISTIC
/begin CHARACTERISTIC K_N_BEGR_TI_MAX_E2 "max. nBegr-TI Ebene 2 | EN: Maximum rev-limit injection, level 2 [Upm]" VALUE 0x79598 TKW_VV_VV_SW 100.0 FORMULA_0006 0.0 10000.0000 /end CHARACTERISTIC
/begin CHARACTERISTIC K_N_BEGR_OFF_E2 "Offset fuer Fehlererkennung Ebene 2" VALUE 0x7959A TKW_VV_VV_SW 100.0 FORMULA_0006 0.0 10000.0000 /end CHARACTERISTIC
/begin MEASUREMENT n_begr_ti "Drehzahlbegrenzung ueber Einspritzausblendung" SWORD FORMULA_0006 0 0 0.0 10000.0000 ECU_ADDRESS 0x3FCABE /end MEASUREMENT
/begin MEASUREMENT n_begr_sk "SK-Drehzahlbegrenzung" SWORD FORMULA_0006 0 0 0.0 10000.0000 ECU_ADDRESS 0x3FCAC0 /end MEASUREMENT
/begin MEASUREMENT n_begr_toel_kalt "Drehzahlbegrenzung bei kaltem Oel" SWORD FORMULA_0006 0 0 0.0 10000.0000 ECU_ADDRESS 0x3FCAC2 /end MEASUREMENT
/begin MEASUREMENT n_begr_toel_heiss "Drehzahlbegrenzung bei heissem Oel" SWORD FORMULA_0006 0 0 0.0 10000.0000 ECU_ADDRESS 0x3FCAC4 /end MEASUREMENT
/begin MEASUREMENT n_begr_tmot_heiss "Drehzahlbegrenzung bei heissem Tmot" SWORD FORMULA_0006 0 0 0.0 10000.0000 ECU_ADDRESS 0x3FCAC6 /end MEASUREMENT
/begin MEASUREMENT n_begr_tgetr_heiss_neu "Drehzahlbegrenzung bei heissem Tgetr" SWORD FORMULA_0006 0 0 0.0 10000.0000 ECU_ADDRESS 0x3FCAC8 /end MEASUREMENT
/begin MEASUREMENT n_begr_tgetr_heiss "aenderungsbegr. Drehzahlbegrenzung bei heissem Tgetr" SWORD FORMULA_0006 0 0 0.0 10000.0000 ECU_ADDRESS 0x3FCACA /end MEASUREMENT
/begin MEASUREMENT n_begr_tgetr_heiss_cnt "Zaehler, um Aenderungsbegrenzung auf 100ms umzustellen" UBYTE FORMULA_0003 0 0 0.0 255.0000 ECU_ADDRESS 0x3FCACC /end MEASUREMENT
/begin MEASUREMENT n_begr_fetrawe "Drehzahlbegrenzung bei FeTraWe" SWORD FORMULA_0006 0 0 0.0 10000.0000 ECU_ADDRESS 0x3FCACE /end MEASUREMENT
/begin MEASUREMENT n_begr_v_fehler "Drehzahlbegrenzung bei v-Fehler" SWORD FORMULA_0006 0 0 0.0 10000.0000 ECU_ADDRESS 0x3FCAD0 /end MEASUREMENT
/begin MEASUREMENT n_begr_fzg_steht "Drehzahlbegrenzung bei stehendem Fzg" SWORD FORMULA_0006 0 0 0.0 10000.0000 ECU_ADDRESS 0x3FCAD2 /end MEASUREMENT
/begin MEASUREMENT n_begr_tz_err "Drehzahlbegrenzung fuer Zuendspulenschutz" SWORD FORMULA_0006 0 0 0.0 10000.0000 ECU_ADDRESS 0x3FCAD4 /end MEASUREMENT
/begin MEASUREMENT n_begr_status "Gewinner der MIN-Auswahl" UWORD FORMULA_1009 0 0 0.0 65535.0 ECU_ADDRESS 0x3FCAD6 /end MEASUREMENT
/begin MEASUREMENT n_begr_time "Verweildauer ueber n_begr_egas" ULONG FORMULA_0152 0 0 0.0 36000.0000 ECU_ADDRESS 0x3FCAD8 /end MEASUREMENT
/begin MEASUREMENT n_max_ff_flag "Steuerflag fuer nmax Freeze Frame" UBYTE FORMULA_1010 0 0 0.0 255.0 ECU_ADDRESS 0x3FCADC /end MEASUREMENT
/begin MEASUREMENT n_max_err_e2 "nmax-Fehlerzaehler Ebene 2" UBYTE FORMULA_0003 0 0 0.0 255.0000 ECU_ADDRESS 0x3FD7DA /end MEASUREMENT
/begin FUNCTION BSD_KOMPONENTENTREIBER ""
 /begin DEF_CHARACTERISTIC K_BSD_BUS_ENABLE K_BSD_KTENABLE K_BSD_SCHEDTAB_10of32_ K_BSD_SCHEDTAB_11of32_ K_BSD_SCHEDTAB_12of32_ K_BSD_SCHEDTAB_13of32_ K_BSD_SCHEDTAB_14of32_ K_BSD_SCHEDTAB_15of32_ K_BSD_SCHEDTAB_16of32_ K_BSD_SCHEDTAB_17of32_ K_BSD_SCHEDTAB_18of32_ K_BSD_SCHEDTAB_19of32_ K_BSD_SCHEDTAB_1of32_ K_BSD_SCHEDTAB_20of32_ K_BSD_SCHEDTAB_21of32_ K_BSD_SCHEDTAB_22of32_ K_BSD_SCHEDTAB_23of32_ K_BSD_SCHEDTAB_24of32_ K_BSD_SCHEDTAB_25of32_ K_BSD_SCHEDTAB_26of32_ K_BSD_SCHEDTAB_27of32_ K_BSD_SCHEDTAB_28of32_ K_BSD_SCHEDTAB_29of32_ K_BSD_SCHEDTAB_2of32_ K_BSD_SCHEDTAB_30of32_ K_BSD_SCHEDTAB_31of32_ K_BSD_SCHEDTAB_32of32_ K_BSD_SCHEDTAB_3of32_ K_BSD_SCHEDTAB_4of32_ K_BSD_SCHEDTAB_5of32_ K_BSD_SCHEDTAB_6of32_ K_BSD_SCHEDTAB_7of32_ K_BSD_SCHEDTAB_8of32_ K_BSD_SCHEDTAB_9of32_ K_DI1000DT K_DI1000STG K_DI1000TGRZ K_DI200DT K_DI200STG K_DIHIGHGRZ K_DILOWGRZ K_DIPL5 K_DIPL6 K_DIPL7 K_DIPL8 K_DKL15FIL K_DTMAXGRZI K_DUIGRZ K_DUMINTGRZ K_DUREFMAX K_DUREFMINI K_ENABSDIBS K_ENISOC0 K_ENUSOC0 K_ERREPEAT K_IBSTSTERR K_IBSVERSION_10of16_ K_IBSVERSION_11of16_ K_IBSVERSION_12of16_ K_IBSVERSION_13of16_ K_IBSVERSION_14of16_ K_IBSVERSION_15of16_ K_IBSVERSION_16of16_ K_IBSVERSION_1of16_ K_IBSVERSION_2of16_ K_IBSVERSION_3of16_ K_IBSVERSION_4of16_ K_IBSVERSION_5of16_ K_IBSVERSION_6of16_ K_IBSVERSION_7of16_ K_IBSVERSION_8of16_ K_IBSVERSION_9of16_ K_IBTEMPMAXI K_IBTEMPMINI K_IBUNPLADEL K_ISLEEPGRZ K_ISTARTTRIG K_SLEEPWAIT K_S_CLERRIBS K_T1SCHWELLE K_T1SOC0 K_T2SCHWELLE K_T2SOC0 K_T3SCHWELLE K_T3SOC0 K_TMPCOM_DIV K_TMPCOM_MUL K_TNUSTART K_TNUSTARTFL K_TPT1TICO K_TSLEEPRUH K_T_CLERRIBS K_T_UTIEFSET K_UTIEFAPP /end DEF_CHARACTERISTIC
 /begin REF_CHARACTERISTIC /end REF_CHARACTERISTIC
 /begin IN_MEASUREMENT /end IN_MEASUREMENT
 /begin OUT_MEASUREMENT Bsd_cur_dev Bsd_slot_idx Bsd_status_1of8_ Bsd_status_2of8_ Bsd_status_3of8_ Bsd_status_4of8_ Bsd_status_5of8_ Bsd_status_6of8_ Bsd_status_7of8_ Bsd_status_8of8_ Chk16_ibs Chkpara Comcontrol Dfbegr Dfsiggen Ebsd_adr Ebsd_errdir Ebsd_errep Ebsd_errin Ebsd_nbyt Ebsd_timo Ebsd_varin Fsclctr Gen_manufak Gen_temp_chip Gen_typkenn Gen_typregler I_batt I_soc0 I_tnstart I_vorstart Ib_chk16 Ib_parlen Ibhwversi Ibs_errors Ibs_msgind Ibs_msgsta Ibs_reg5 Ibs_start Ibsbclctri Ibsborctr Ibsdncsctr Ibseromctr Ibsiicctri Ibslvdctr Ibsporctr Ibspromctr Ibsptyctr Ibsramctr Ibswbase Ibswchang Ibswdtctr Ierr Ierrfgrenz Kt_ibsstatus Ktib_chk16 Ktupcsctr Oz_nivr Oz_nivr_index Oz_permr Oz_status Qelad Qeladsoc0 Qlad Qladsoc0 R5cyctim Snibs St_bsd_ktenable St_bsd_ktenable.B_dev_gen1 St_bsd_ktenable.B_dev_gen2 St_bsd_ktenable.B_dev_glrd St_bsd_ktenable.B_dev_ibs St_bsd_ktenable.B_dev_oz St_bsd_ktenable.B_dev_ozon St_bsd_ktenable.B_dev_wapue St_bsd_ktenable.B_dev_wapum St_generator St_generator.B_crashgen St_generator.B_genactiv St_generator.B_genfbsd St_generator.B_genfel St_generator.B_genfht St_generator.B_genfme St_ibebsd1 St_ibebsd1.B_eb_busy St_ibebsd1.B_eb_txok St_ibebsd1.B_ibs_msgrdy St_ibebsd1.B_ibs_msgwri St_ibmix St_ibmix.B_ibrhilo St_ibmix.B_ibttog St_ibserr St_ibserr.B_ibfbsd St_ibserr.B_ibfebsd St_ibserr.B_ibunplau St_ibsreg4 St_ibsreg4.B_ibspwf St_ibsreg4.B_ibsweck St_ibsreg4.B_startfgk St_ibsreg4.B_strtaw St_ibsreg4.B_tiefset St_ibsreg5 St_ibsreg5.B_fsclr St_oz St_oz.B_anhang St_oz.B_ozfbsd St_sleep St_sleep.B_sleepwait T1histiruh T2histiruh T3histiruh T4histiruh T_batt_ibs T_batt_max T_batt_min T_battsoc0 T_battsoci Tbatt_maxi Tbatt_mini Tlrfgen Tlrgen_exd U1soc0 U2soc0 U3soc0 U_batt U_fgen U_gen_exd U_tnstart U_vorstart Unind Zbibs batt_tausch_exd_timeout bsd_error gen_exd_timeout history_reset_exd_timeout /end OUT_MEASUREMENT
/end FUNCTION
/begin FUNCTION Betriebssystem "" /begin DEF_CHARACTERISTIC /end DEF_CHARACTERISTIC /begin REF_CHARACTERISTIC /end REF_CHARACTERISTIC /begin IN_MEASUREMENT /end IN_MEASUREMENT
 /begin OUT_MEASUREMENT os_err.addr os_err.deadline.cnt os_err.deadline.task os_err.dflt.cnt os_err.dflt.task os_err.fifo.cnt os_err.fifo.task os_err.id.cnt os_err.id.task os_err.limit.cnt os_err.limit.task os_err.no_fnc.cnt os_err.no_fnc.task os_err.stack.cnt os_err.stack.task os_err.sum_cnt os_err.tt_act.cnt os_err.tt_act.task os_err.tt_miss.cnt os_err.tt_miss.task os_err.type os_err.value.cnt os_err.value.task /end OUT_MEASUREMENT
/end FUNCTION
/begin FUNCTION Carbtelegramm "" /begin DEF_CHARACTERISTIC /end DEF_CHARACTERISTIC /begin REF_CHARACTERISTIC /end REF_CHARACTERISTIC /begin IN_MEASUREMENT /end IN_MEASUREMENT /begin OUT_MEASUREMENT carbtlgr_aif_nummer carbtlgr_st /end OUT_MEASUREMENT /end FUNCTION
/begin FUNCTION Checksumme "" /begin DEF_CHARACTERISTIC /end DEF_CHARACTERISTIC /begin REF_CHARACTERISTIC /end REF_CHARACTERISTIC /begin IN_MEASUREMENT /end IN_MEASUREMENT
 /begin OUT_MEASUREMENT crc32_boot crc32_boot_st crc32_data crc32_data_st crc32_prog crc32_prog_st crc32_result /end OUT_MEASUREMENT
/end FUNCTION
/begin FUNCTION DMTL ""
 /begin DEF_CHARACTERISTIC K_FST_ABWEICHUNG K_FST_CAN_FEHLER K_FST_FILT K_FST_NACHTANK K_FST_TANK_LEER_RECHTS K_FST_TANK_LEER_SUM K_FST_VERBRAUCH K_FST_VERBRAUCH_VOLL K_FST_VOLL K_FST_V_BETANK_END /end DEF_CHARACTERISTIC
 /begin REF_CHARACTERISTIC /end REF_CHARACTERISTIC
 /begin IN_MEASUREMENT /end IN_MEASUREMENT
 /begin OUT_MEASUREMENT B_FST_CAN_FEHLERKENNUNG B_FST_CAN_INIT B_FST_KEIN_CAN B_FST_NACHTANK B_FST_NACHTANK_LA B_FST_UNPLAUSIBEL fst_can_fehler_li fst_can_fehler_re fst_kva_old fst_links fst_links.rest fst_st fst_tank_leer_st_ign fst_tank_leer_st_inj /end OUT_MEASUREMENT
/end FUNCTION
/begin FUNCTION Debugging ""
 /begin DEF_CHARACTERISTIC K_DEBUG_READ_ADR K_DEBUG_RW_LENGTH K_DEBUG_WRITE_ADR K_DEBUG_WRITE_VALUE /end DEF_CHARACTERISTIC
 /begin REF_CHARACTERISTIC /end REF_CHARACTERISTIC
 /begin IN_MEASUREMENT /end IN_MEASUREMENT
 /begin OUT_MEASUREMENT bgTaskCtr cana_ctBoffDbounce canb_ctBoffDbounce debug_rw_result hwTaskCtr r100msTaskCtr r10msTaskCtr r1msTaskCtr r1sTaskCtr r5msTaskCtr syncTaskCtr /end OUT_MEASUREMENT
/end FUNCTION
/begin FUNCTION Diag_tr "" /begin DEF_CHARACTERISTIC K_DIAG_TR_UB_MIN /end DEF_CHARACTERISTIC /begin REF_CHARACTERISTIC /end REF_CHARACTERISTIC /begin IN_MEASUREMENT /end IN_MEASUREMENT /begin OUT_MEASUREMENT /end OUT_MEASUREMENT /end FUNCTION
/begin FUNCTION Drehtzahlwarnfeld ""
 /begin DEF_CHARACTERISTIC KL_DWF_SHLI_SEG KL_DWF_SHLI_V_DIFF K_DWF_CFG K_DWF_ORANGE_OFF K_DWF_SHLI_AX_AKTIV K_DWF_SHLI_TAB_FAK K_DWF_SHLI_TAU_DN K_DWF_SHLI_TAU_N K_DWF_SHLI_T_AKTIV K_DWF_SHLI_T_BL K_DWF_SHLI_T_FLS K_DWF_SHLI_T_INAKTIV K_DWF_SHLI_T_TOT /end DEF_CHARACTERISTIC
 /begin REF_CHARACTERISTIC /end REF_CHARACTERISTIC
 /begin IN_MEASUREMENT /end IN_MEASUREMENT
 /begin OUT_MEASUREMENT dwf_n_max dwf_n_rot dwf_repeat dwf_shli_dn dwf_shli_n dwf_shli_seg dwf_shli_st dwf_shli_st_bl dwf_shli_st_fls dwf_shli_st_on dwf_shli_tbegr dwf_shli_tseg /end OUT_MEASUREMENT
/end FUNCTION
/begin FUNCTION Drehzahlerfassung ""
 /begin DEF_CHARACTERISTIC KL_N_BEGR_GANG KL_N_BEGR_SK KL_N_BEGR_TGETR_HEISS KL_N_BEGR_TI_OFFSET KL_N_BEGR_TMOT_HEISS KL_N_BEGR_TOEL_HEISS KL_N_BEGR_TOEL_KALT K_N_BEGR_CFG K_N_BEGR_EGAS_HYS K_N_BEGR_ERR_E2 K_N_BEGR_FERTIGUNG K_N_BEGR_FETRAWE_WEG K_N_BEGR_FZG_STEHT K_N_BEGR_OFF_E2 K_N_BEGR_SK_RAMPE K_N_BEGR_TGETR_AEBGR_DOWN K_N_BEGR_TGETR_AEBGR_UP K_N_BEGR_TI_HYS K_N_BEGR_TI_MAX_E2 K_N_BEGR_TI_OFF_RSS K_N_BEGR_TRANSPORT K_N_BEGR_V_FEHLER K_N_BEGR_WERKSTATT K_N_MAX_FF_RESET K_N_MIN_FREEZE K_N_OBD_DYN_DELTA K_N_OBD_DYN_T K_N_OBD_DYN_TAU K_N_OBERGRENZE K_N_ZEIT_STOERUNG /end DEF_CHARACTERISTIC
 /begin REF_CHARACTERISTIC /end REF_CHARACTERISTIC
 /begin IN_MEASUREMENT /end IN_MEASUREMENT
 /begin OUT_MEASUREMENT n_begr_fetrawe n_begr_fzg_steht n_begr_sk n_begr_status n_begr_tgetr_heiss n_begr_tgetr_heiss_cnt n_begr_tgetr_heiss_neu n_begr_ti n_begr_time n_begr_tmot_heiss n_begr_toel_heiss n_begr_toel_kalt n_begr_tz_err n_begr_v_fehler n_dyn_filter n_dyn_timer n_grad_buf_0 n_grad_buf_1 n_grad_buf_2 n_grad_buf_3 n_grad_buf_4 n_grad_buf_5 n_grad_buf_6 n_grad_buf_7 n_grad_buf_8 n_grad_buf_9 n_max_err_e2 n_max_ff_flag n_proz n_segm_a n_segm_b n_st_a n_st_b n_t_segm_a n_t_segm_b n_t_segm_start_a n_t_segm_start_b n_timer_stoerung_a n_timer_stoerung_b n_zahn_a n_zahn_b /end OUT_MEASUREMENT
/end FUNCTION
/begin FUNCTION E-Boxluefter "" /begin DEF_CHARACTERISTIC K_EBOX_ELU_EIN K_EBOX_ELU_HYS K_EBOX_ELU_LOSBRECHEN /end DEF_CHARACTERISTIC /begin REF_CHARACTERISTIC /end REF_CHARACTERISTIC /begin IN_MEASUREMENT /end IN_MEASUREMENT /begin OUT_MEASUREMENT ebox_elu_exd_timeout ebox_elu_st /end OUT_MEASUREMENT /end FUNCTION
/begin FUNCTION EEPROM "" /begin DEF_CHARACTERISTIC /end DEF_CHARACTERISTIC /begin REF_CHARACTERISTIC /end REF_CHARACTERISTIC /begin IN_MEASUREMENT /end IN_MEASUREMENT
 /begin OUT_MEASUREMENT eeprom_seite_lesen eeprom_seite_lesen_hdw eeprom_seite_schreiben eeprom_st /end OUT_MEASUREMENT
/end FUNCTION
/begin FUNCTION ELUP ""
 /begin DEF_CHARACTERISTIC KL_ELUP_AUS KL_ELUP_EIN KL_ELUP_EIN_V_DEL KL_ELUP_V_OFFS K_ELUP_CFG K_ELUP_OBD_ABS_DEL K_ELUP_OBD_BRPGRAD_SW K_ELUP_OBD_BRPGRAD_T K_ELUP_OBD_DEL K_ELUP_OBD_MVACP_GRAD_SW K_ELUP_OBD_MVACP_GRAD_T K_ELUP_OBD_PSAU_SW K_ELUP_OFF_TIME_MIN K_ELUP_ON_TIME_MAX K_ELUP_ON_TIME_MIN K_ELUP_PL_AN_SW K_ELUP_PL_IO_SW K_ELUP_PL_ON_TIME K_ELUP_UB_MIN /end DEF_CHARACTERISTIC
 /begin REF_CHARACTERISTIC /end REF_CHARACTERISTIC
 /begin IN_MEASUREMENT /end IN_MEASUREMENT
 /begin OUT_MEASUREMENT elup_ein_v_del elup_exd_timeout elup_interlock_time elup_obd_abs_del elup_obd_aktiv elup_obd_brp_grad elup_obd_del elup_obd_mvacp_grad elup_obd_mvacp_old elup_pl_mvac_p_ende elup_pl_mvac_p_start elup_pl_st elup_sw_aus elup_sw_ein elup_v_offs /end OUT_MEASUREMENT
/end FUNCTION
/begin FUNCTION EWS "" /begin DEF_CHARACTERISTIC K_EWS_FETRAWE_WEG /end DEF_CHARACTERISTIC /begin REF_CHARACTERISTIC /end REF_CHARACTERISTIC /begin IN_MEASUREMENT /end IN_MEASUREMENT /begin OUT_MEASUREMENT ews_st ews_stw_st /end OUT_MEASUREMENT /end FUNCTION
/begin FUNCTION Egas "" /begin DEF_CHARACTERISTIC K_EGAS_CFG_DIAG /end DEF_CHARACTERISTIC /begin REF_CHARACTERISTIC /end REF_CHARACTERISTIC /begin IN_MEASUREMENT /end IN_MEASUREMENT /begin OUT_MEASUREMENT /end OUT_MEASUREMENT /end FUNCTION
/begin FUNCTION Eigendiagnose "" /begin REF_CHARACTERISTIC /end REF_CHARACTERISTIC /begin IN_MEASUREMENT /end IN_MEASUREMENT
 /begin OUT_MEASUREMENT ed_css_time ed_debug_laufzeit ed_fil_appl_data_inj.art_aktuell_nv ed_fil_appl_data_inj.fehler_aufrufe_nv ed_fil_appl_data_inj.filter_max_nv ed_fil_appl_data_inj.filter_nv ed_fil_appl_data_inj.zyklus_filter_nv ed_fil_dk1_enltg.art_aktuell_nv ed_fil_dk1_enltg.fehler_aufrufe_nv ed_fil_dk1_enltg.filter_max_nv ed_fil_dk1_enltg.filter_nv ed_fil_dk1_enltg.zyklus_filter_nv ed_fil_dk2_enltg.art_aktuell_nv ed_fil_dk2_enltg.fehler_aufrufe_nv ed_fil_dk2_enltg.filter_max_nv ed_fil_dk2_enltg.filter_nv ed_fil_dk2_enltg.zyklus_filter_nv ed_fil_dmtl_deckel.art_aktuell_nv ed_fil_dmtl_deckel.fehler_aufrufe_nv ed_fil_dmtl_deckel.filter_max_nv ed_fil_dmtl_deckel.filter_nv ed_fil_dmtl_deckel.zyklus_filter_nv ed_fil_dmtl_feinleck.art_aktuell_nv ed_fil_dmtl_feinleck.fehler_aufrufe_nv ed_fil_dmtl_feinleck.filter_max_nv ed_fil_dmtl_feinleck.filter_nv ed_fil_dmtl_feinleck.zyklus_filter_nv ed_fil_dmtl_feucht.art_aktuell_nv ed_fil_dmtl_feucht.fehler_aufrufe_nv ed_fil_dmtl_feucht.filter_max_nv ed_fil_dmtl_feucht.filter_nv ed_fil_dmtl_feucht.zyklus_filter_nv ed_fil_dmtl_grobleck.art_aktuell_nv ed_fil_dmtl_grobleck.fehler_aufrufe_nv ed_fil_dmtl_grobleck.filter_max_nv ed_fil_dmtl_grobleck.filter_nv ed_fil_dmtl_grobleck.zyklus_filter_nv ed_fil_dmtl_h.art_aktuell_nv ed_fil_dmtl_h.fehler_aufrufe_nv ed_fil_dmtl_h.filter_max_nv ed_fil_dmtl_h.filter_nv ed_fil_dmtl_h.zyklus_filter_nv ed_fil_dmtl_p.art_aktuell_nv ed_fil_dmtl_p.fehler_aufrufe_nv ed_fil_dmtl_p.filter_max_nv ed_fil_dmtl_p.filter_nv ed_fil_dmtl_p.zyklus_filter_nv ed_fil_dmtl_v.art_aktuell_nv ed_fil_dmtl_v.fehler_aufrufe_nv ed_fil_dmtl_v.filter_max_nv ed_fil_dmtl_v.filter_nv ed_fil_dmtl_v.zyklus_filter_nv ed_fil_e2_inj.art_aktuell_nv ed_fil_e2_inj.fehler_aufrufe_nv ed_fil_e2_inj.filter_max_nv ed_fil_e2_inj.filter_nv ed_fil_e2_inj.zyklus_filter_nv ed_fil_ebox_elu.art_aktuell_nv ed_fil_ebox_elu.fehler_aufrufe_nv ed_fil_ebox_elu.filter_max_nv ed_fil_ebox_elu.filter_nv ed_fil_ebox_elu.zyklus_filter_nv ed_fil_ekp_pwm.art_aktuell_nv ed_fil_ekp_pwm.fehler_aufrufe_nv ed_fil_ekp_pwm.filter_max_nv ed_fil_ekp_pwm.filter_nv ed_fil_ekp_pwm.zyklus_filter_nv ed_fil_elu.art_aktuell_nv ed_fil_elu.fehler_aufrufe_nv ed_fil_elu.filter_max_nv ed_fil_elu.filter_nv ed_fil_elu.zyklus_filter_nv ed_fil_elup.art_aktuell_nv ed_fil_elup.fehler_aufrufe_nv ed_fil_elup.filter_max_nv ed_fil_elup.filter_nv ed_fil_elup.zyklus_filter_nv ed_fil_elup_obd.art_aktuell_nv ed_fil_elup_obd.fehler_aufrufe_nv ed_fil_elup_obd.filter_max_nv ed_fil_elup_obd.filter_nv ed_fil_elup_obd.zyklus_filter_nv ed_fil_ev1.art_aktuell_nv ed_fil_ev1.fehler_aufrufe_nv ed_fil_ev1.filter_max_nv ed_fil_ev1.filter_nv ed_fil_ev1.zyklus_filter_nv ed_fil_ev10.art_aktuell_nv ed_fil_ev10.fehler_aufrufe_nv ed_fil_ev10.filter_max_nv ed_fil_ev10.filter_nv ed_fil_ev10.zyklus_filter_nv ed_fil_ev2.art_aktuell_nv ed_fil_ev2.fehler_aufrufe_nv ed_fil_ev2.filter_max_nv ed_fil_ev2.filter_nv ed_fil_ev2.zyklus_filter_nv ed_fil_ev3.art_aktuell_nv ed_fil_ev3.fehler_aufrufe_nv ed_fil_ev3.filter_max_nv ed_fil_ev3.filter_nv ed_fil_ev3.zyklus_filter_nv ed_fil_ev4.art_aktuell_nv ed_fil_ev4.fehler_aufrufe_nv ed_fil_ev4.filter_max_nv ed_fil_ev4.filter_nv ed_fil_ev4.zyklus_filter_nv ed_fil_ev5.art_aktuell_nv ed_fil_ev5.fehler_aufrufe_nv ed_fil_ev5.filter_max_nv ed_fil_ev5.filter_nv ed_fil_ev5.zyklus_filter_nv ed_fil_ev6.art_aktuell_nv ed_fil_ev6.fehler_aufrufe_nv ed_fil_ev6.filter_max_nv ed_fil_ev6.filter_nv ed_fil_ev6.zyklus_filter_nv ed_fil_ev7.art_aktuell_nv ed_fil_ev7.fehler_aufrufe_nv ed_fil_ev7.filter_max_nv ed_fil_ev7.filter_nv ed_fil_ev7.zyklus_filter_nv ed_fil_ev8.art_aktuell_nv ed_fil_ev8.fehler_aufrufe_nv ed_fil_ev8.filter_max_nv ed_fil_ev8.filter_nv ed_fil_ev8.zyklus_filter_nv ed_fil_ev9.art_aktuell_nv ed_fil_ev9.fehler_aufrufe_nv ed_fil_ev9.filter_max_nv ed_fil_ev9.filter_nv ed_fil_ev9.zyklus_filter_nv ed_fil_ews_man.art_aktuell_nv ed_fil_ews_man.fehler_aufrufe_nv ed_fil_ews_man.filter_max_nv ed_fil_ews_man.filter_nv ed_fil_ews_man.zyklus_filter_nv ed_fil_ews_sci.art_aktuell_nv ed_fil_ews_sci.fehler_aufrufe_nv ed_fil_ews_sci.filter_max_nv ed_fil_ews_sci.filter_nv ed_fil_ews_sci.zyklus_filter_nv ed_fil_fetrawe.art_aktuell_nv ed_fil_fetrawe.fehler_aufrufe_nv ed_fil_fetrawe.filter_max_nv ed_fil_fetrawe.filter_nv ed_fil_fetrawe.zyklus_filter_nv ed_fil_fi_bsd.art_aktuell_nv ed_fil_fi_bsd.fehler_aufrufe_nv ed_fil_fi_bsd.filter_max_nv ed_fil_fi_bsd.filter_nv ed_fil_fi_bsd.zyklus_filter_nv ed_fil_fi_bsd_0.art_aktuell_nv ed_fil_fi_bsd_0.fehler_aufrufe_nv ed_fil_fi_bsd_0.filter_max_nv ed_fil_fi_bsd_0.filter_nv ed_fil_fi_bsd_0.zyklus_filter_nv ed_fil_fi_bsd_6.art_aktuell_nv ed_fil_fi_bsd_6.fehler_aufrufe_nv ed_fil_fi_bsd_6.filter_max_nv ed_fil_fi_bsd_6.filter_nv ed_fil_fi_bsd_6.zyklus_filter_nv ed_fil_fi_bsdglob.art_aktuell_nv ed_fil_fi_bsdglob.fehler_aufrufe_nv ed_fil_fi_bsdglob.filter_max_nv ed_fil_fi_bsdglob.filter_nv ed_fil_fi_bsdglob.zyklus_filter_nv ed_fil_fi_gen.art_aktuell_nv ed_fil_fi_gen.fehler_aufrufe_nv ed_fil_fi_gen.filter_max_nv ed_fil_fi_gen.filter_nv ed_fil_fi_gen.zyklus_filter_nv ed_fil_fi_ibs1.art_aktuell_nv ed_fil_fi_ibs1.fehler_aufrufe_nv ed_fil_fi_ibs1.filter_max_nv ed_fil_fi_ibs1.filter_nv ed_fil_fi_ibs1.zyklus_filter_nv ed_fil_fi_ibs2.art_aktuell_nv ed_fil_fi_ibs2.fehler_aufrufe_nv ed_fil_fi_ibs2.filter_max_nv ed_fil_fi_ibs2.filter_nv ed_fil_fi_ibs2.zyklus_filter_nv ed_fil_fi_ibs3.art_aktuell_nv ed_fil_fi_ibs3.fehler_aufrufe_nv ed_fil_fi_ibs3.filter_max_nv ed_fil_fi_ibs3.filter_nv ed_fil_fi_ibs3.zyklus_filter_nv ed_fil_fi_pmbatt.art_aktuell_nv ed_fil_fi_pmbatt.fehler_aufrufe_nv ed_fil_fi_pmbatt.filter_max_nv ed_fil_fi_pmbatt.filter_nv ed_fil_fi_pmbatt.zyklus_filter_nv ed_fil_fi_pmbn.art_aktuell_nv ed_fil_fi_pmbn.fehler_aufrufe_nv ed_fil_fi_pmbn.filter_max_nv ed_fil_fi_pmbn.filter_nv ed_fil_fi_pmbn.zyklus_filter_nv ed_fil_fi_pmruhverl.art_aktuell_nv ed_fil_fi_pmruhverl.fehler_aufrufe_nv ed_fil_fi_pmruhverl.filter_max_nv ed_fil_fi_pmruhverl.filter_nv ed_fil_fi_pmruhverl.zyklus_filter_nv ed_fil_fi_qlt.art_aktuell_nv ed_fil_fi_qlt.fehler_aufrufe_nv ed_fil_fi_qlt.filter_max_nv ed_fil_fi_qlt.filter_nv ed_fil_fi_qlt.zyklus_filter_nv ed_fil_fi_toens.art_aktuell_nv ed_fil_fi_toens.fehler_aufrufe_nv ed_fil_fi_toens.filter_max_nv ed_fil_fi_toens.filter_nv ed_fil_fi_toens.zyklus_filter_nv ed_fil_fplau1.art_aktuell_nv ed_fil_fplau1.fehler_aufrufe_nv ed_fil_fplau1.filter_max_nv ed_fil_fplau1.filter_nv ed_fil_fplau1.zyklus_filter_nv ed_fil_fplau2.art_aktuell_nv ed_fil_fplau2.fehler_aufrufe_nv ed_fil_fplau2.filter_max_nv ed_fil_fplau2.filter_nv ed_fil_fplau2.zyklus_filter_nv ed_fil_fst.art_aktuell_nv ed_fil_fst.fehler_aufrufe_nv ed_fil_fst.filter_max_nv ed_fil_fst.filter_nv ed_fil_fst.zyklus_filter_nv ed_fil_fst_geber.art_aktuell_nv ed_fil_fst_geber.fehler_aufrufe_nv ed_fil_fst_geber.filter_max_nv ed_fil_fst_geber.filter_nv ed_fil_fst_geber.zyklus_filter_nv ed_fil_fst_geber_li.art_aktuell_nv ed_fil_fst_geber_li.fehler_aufrufe_nv ed_fil_fst_geber_li.filter_max_nv ed_fil_fst_geber_li.filter_nv ed_fil_fst_geber_li.zyklus_filter_nv ed_fil_fst_geber_re.art_aktuell_nv ed_fil_fst_geber_re.fehler_aufrufe_nv ed_fil_fst_geber_re.filter_max_nv ed_fil_fst_geber_re.filter_nv ed_fil_fst_geber_re.zyklus_filter_nv ed_fil_hfm1.art_aktuell_nv ed_fil_hfm1.fehler_aufrufe_nv ed_fil_hfm1.filter_max_nv ed_fil_hfm1.filter_nv ed_fil_hfm1.zyklus_filter_nv ed_fil_hfm2.art_aktuell_nv ed_fil_hfm2.fehler_aufrufe_nv ed_fil_hfm2.filter_max_nv ed_fil_hfm2.filter_nv ed_fil_hfm2.zyklus_filter_nv ed_fil_index_204_inj.art_aktuell_nv ed_fil_index_204_inj.fehler_aufrufe_nv ed_fil_index_204_inj.filter_max_nv ed_fil_index_204_inj.filter_nv ed_fil_index_204_inj.zyklus_filter_nv ed_fil_index_205_inj.art_aktuell_nv ed_fil_index_205_inj.fehler_aufrufe_nv ed_fil_index_205_inj.filter_max_nv ed_fil_index_205_inj.filter_nv ed_fil_index_205_inj.zyklus_filter_nv ed_fil_index_206_inj.art_aktuell_nv ed_fil_index_206_inj.fehler_aufrufe_nv ed_fil_index_206_inj.filter_max_nv ed_fil_index_206_inj.filter_nv ed_fil_index_206_inj.zyklus_filter_nv ed_fil_index_207_inj.art_aktuell_nv ed_fil_index_207_inj.fehler_aufrufe_nv ed_fil_index_207_inj.filter_max_nv ed_fil_index_207_inj.filter_nv ed_fil_index_207_inj.zyklus_filter_nv ed_fil_index_208_inj.art_aktuell_nv ed_fil_index_208_inj.fehler_aufrufe_nv ed_fil_index_208_inj.filter_max_nv ed_fil_index_208_inj.filter_nv ed_fil_index_208_inj.zyklus_filter_nv ed_fil_index_209_inj.art_aktuell_nv ed_fil_index_209_inj.fehler_aufrufe_nv ed_fil_index_209_inj.filter_max_nv ed_fil_index_209_inj.filter_nv ed_fil_index_209_inj.zyklus_filter_nv ed_fil_index_210_inj.art_aktuell_nv ed_fil_index_210_inj.fehler_aufrufe_nv ed_fil_index_210_inj.filter_max_nv ed_fil_index_210_inj.filter_nv ed_fil_index_210_inj.zyklus_filter_nv ed_fil_index_211_inj.art_aktuell_nv ed_fil_index_211_inj.fehler_aufrufe_nv ed_fil_index_211_inj.filter_max_nv ed_fil_index_211_inj.filter_nv ed_fil_index_211_inj.zyklus_filter_nv ed_fil_index_212_inj.art_aktuell_nv ed_fil_index_212_inj.fehler_aufrufe_nv ed_fil_index_212_inj.filter_max_nv ed_fil_index_212_inj.filter_nv ed_fil_index_212_inj.zyklus_filter_nv ed_fil_index_213_inj.art_aktuell_nv ed_fil_index_213_inj.fehler_aufrufe_nv ed_fil_index_213_inj.filter_max_nv ed_fil_index_213_inj.filter_nv ed_fil_index_213_inj.zyklus_filter_nv ed_fil_index_214_inj.art_aktuell_nv ed_fil_index_214_inj.fehler_aufrufe_nv ed_fil_index_214_inj.filter_max_nv ed_fil_index_214_inj.filter_nv ed_fil_index_214_inj.zyklus_filter_nv ed_fil_index_215_inj.art_aktuell_nv ed_fil_index_215_inj.fehler_aufrufe_nv ed_fil_index_215_inj.filter_max_nv ed_fil_index_215_inj.filter_nv ed_fil_index_215_inj.zyklus_filter_nv ed_fil_index_216_inj.art_aktuell_nv ed_fil_index_216_inj.fehler_aufrufe_nv ed_fil_index_216_inj.filter_max_nv ed_fil_index_216_inj.filter_nv ed_fil_index_216_inj.zyklus_filter_nv ed_fil_index_217_inj.art_aktuell_nv ed_fil_index_217_inj.fehler_aufrufe_nv ed_fil_index_217_inj.filter_max_nv ed_fil_index_217_inj.filter_nv ed_fil_index_217_inj.zyklus_filter_nv ed_fil_index_218_inj.art_aktuell_nv ed_fil_index_218_inj.fehler_aufrufe_nv ed_fil_index_218_inj.filter_max_nv ed_fil_index_218_inj.filter_nv ed_fil_index_218_inj.zyklus_filter_nv ed_fil_index_219_inj.art_aktuell_nv ed_fil_index_219_inj.fehler_aufrufe_nv ed_fil_index_219_inj.filter_max_nv ed_fil_index_219_inj.filter_nv ed_fil_index_219_inj.zyklus_filter_nv ed_fil_index_220_inj.art_aktuell_nv ed_fil_index_220_inj.fehler_aufrufe_nv ed_fil_index_220_inj.filter_max_nv ed_fil_index_220_inj.filter_nv ed_fil_index_220_inj.zyklus_filter_nv ed_fil_index_221_inj.art_aktuell_nv ed_fil_index_221_inj.fehler_aufrufe_nv ed_fil_index_221_inj.filter_max_nv ed_fil_index_221_inj.filter_nv ed_fil_index_221_inj.zyklus_filter_nv ed_fil_index_222_inj.art_aktuell_nv ed_fil_index_222_inj.fehler_aufrufe_nv ed_fil_index_222_inj.filter_max_nv ed_fil_index_222_inj.filter_nv ed_fil_index_222_inj.zyklus_filter_nv ed_fil_index_223_inj.art_aktuell_nv ed_fil_index_223_inj.fehler_aufrufe_nv ed_fil_index_223_inj.filter_max_nv ed_fil_index_223_inj.filter_nv ed_fil_index_223_inj.zyklus_filter_nv ed_fil_kat_obd1.art_aktuell_nv ed_fil_kat_obd1.fehler_aufrufe_nv ed_fil_kat_obd1.filter_max_nv ed_fil_kat_obd1.filter_nv ed_fil_kat_obd1.zyklus_filter_nv ed_fil_kat_obd2.art_aktuell_nv ed_fil_kat_obd2.fehler_aufrufe_nv ed_fil_kat_obd2.filter_max_nv ed_fil_kat_obd2.filter_nv ed_fil_kat_obd2.zyklus_filter_nv ed_fil_kats_b1.art_aktuell_nv ed_fil_kats_b1.fehler_aufrufe_nv ed_fil_kats_b1.filter_max_nv ed_fil_kats_b1.filter_nv ed_fil_kats_b1.zyklus_filter_nv ed_fil_kats_b2.art_aktuell_nv ed_fil_kats_b2.fehler_aufrufe_nv ed_fil_kats_b2.filter_max_nv ed_fil_kats_b2.filter_nv ed_fil_kats_b2.zyklus_filter_nv ed_fil_kge1.art_aktuell_nv ed_fil_kge1.fehler_aufrufe_nv ed_fil_kge1.filter_max_nv ed_fil_kge1.filter_nv ed_fil_kge1.zyklus_filter_nv ed_fil_kge2.art_aktuell_nv ed_fil_kge2.fehler_aufrufe_nv ed_fil_kge2.filter_max_nv ed_fil_kge2.filter_nv ed_fil_kge2.zyklus_filter_nv ed_fil_ksd1.art_aktuell_nv ed_fil_ksd1.fehler_aufrufe_nv ed_fil_ksd1.filter_max_nv ed_fil_ksd1.filter_nv ed_fil_ksd1.zyklus_filter_nv ed_fil_ksd2.art_aktuell_nv ed_fil_ksd2.fehler_aufrufe_nv ed_fil_ksd2.filter_max_nv ed_fil_ksd2.filter_nv ed_fil_ksd2.zyklus_filter_nv ed_fil_kw.art_aktuell_nv ed_fil_kw.fehler_aufrufe_nv ed_fil_kw.filter_max_nv ed_fil_kw.filter_nv ed_fil_kw.zyklus_filter_nv ed_fil_la1_adapt.art_aktuell_nv ed_fil_la1_adapt.fehler_aufrufe_nv ed_fil_la1_adapt.filter_max_nv ed_fil_la1_adapt.filter_nv ed_fil_la1_adapt.zyklus_filter_nv ed_fil_la1_trim_ad.art_aktuell_nv ed_fil_la1_trim_ad.fehler_aufrufe_nv ed_fil_la1_trim_ad.filter_max_nv ed_fil_la1_trim_ad.filter_nv ed_fil_la1_trim_ad.zyklus_filter_nv ed_fil_la2_adapt.art_aktuell_nv ed_fil_la2_adapt.fehler_aufrufe_nv ed_fil_la2_adapt.filter_max_nv ed_fil_la2_adapt.filter_nv ed_fil_la2_adapt.zyklus_filter_nv ed_fil_la2_trim_ad.art_aktuell_nv ed_fil_la2_trim_ad.fehler_aufrufe_nv ed_fil_la2_trim_ad.filter_max_nv ed_fil_la2_trim_ad.filter_nv ed_fil_la2_trim_ad.zyklus_filter_nv ed_fil_lam1_reg.art_aktuell_nv ed_fil_lam1_reg.fehler_aufrufe_nv ed_fil_lam1_reg.filter_max_nv ed_fil_lam1_reg.filter_nv ed_fil_lam1_reg.zyklus_filter_nv ed_fil_lam2_reg.art_aktuell_nv ed_fil_lam2_reg.fehler_aufrufe_nv ed_fil_lam2_reg.filter_max_nv ed_fil_lam2_reg.filter_nv ed_fil_lam2_reg.zyklus_filter_nv ed_fil_lank1.art_aktuell_nv ed_fil_lank1.fehler_aufrufe_nv ed_fil_lank1.filter_max_nv ed_fil_lank1.filter_nv ed_fil_lank1.zyklus_filter_nv ed_fil_lank1_obd_s.art_aktuell_nv ed_fil_lank1_obd_s.fehler_aufrufe_nv ed_fil_lank1_obd_s.filter_max_nv ed_fil_lank1_obd_s.filter_nv ed_fil_lank1_obd_s.zyklus_filter_nv ed_fil_lank1_obd_slope.art_aktuell_nv ed_fil_lank1_obd_slope.fehler_aufrufe_nv ed_fil_lank1_obd_slope.filter_max_nv ed_fil_lank1_obd_slope.filter_nv ed_fil_lank1_obd_slope.zyklus_filter_nv ed_fil_lank1_obd_we.art_aktuell_nv /end OUT_MEASUREMENT
/end FUNCTION
/begin RECORD_LAYOUT TKW_VV_VV_UB FNC_VALUES 1 UBYTE COLUMN_DIR DIRECT /end RECORD_LAYOUT
/begin RECORD_LAYOUT TKW_VV_VV_SB FNC_VALUES 1 SBYTE COLUMN_DIR DIRECT /end RECORD_LAYOUT
/begin RECORD_LAYOUT TKW_VV_VV_UW FNC_VALUES 1 UWORD COLUMN_DIR DIRECT /end RECORD_LAYOUT
/begin RECORD_LAYOUT TKW_VV_VV_SW FNC_VALUES 1 SWORD COLUMN_DIR DIRECT /end RECORD_LAYOUT
/begin RECORD_LAYOUT TKW_VV_VV_UL FNC_VALUES 1 ULONG COLUMN_DIR DIRECT /end RECORD_LAYOUT
/begin RECORD_LAYOUT TKL_UB_VV_SW NO_AXIS_PTS_X 1 UBYTE RESERVED 2 BYTE AXIS_PTS_X 3 UBYTE INDEX_INCR DIRECT FNC_VALUES 4 SWORD COLUMN_DIR DIRECT /end RECORD_LAYOUT
/begin RECORD_LAYOUT TKL_SW_VV_UB NO_AXIS_PTS_X 1 UBYTE RESERVED 2 BYTE AXIS_PTS_X 3 SWORD INDEX_INCR DIRECT FNC_VALUES 4 UBYTE COLUMN_DIR DIRECT /end RECORD_LAYOUT
/begin RECORD_LAYOUT TKL_SW_VV_UW NO_AXIS_PTS_X 1 UBYTE RESERVED 2 BYTE AXIS_PTS_X 3 SWORD INDEX_INCR DIRECT FNC_VALUES 4 UWORD COLUMN_DIR DIRECT /end RECORD_LAYOUT
/begin RECORD_LAYOUT TKL_SW_VV_SW NO_AXIS_PTS_X 1 UBYTE RESERVED 2 BYTE AXIS_PTS_X 3 SWORD INDEX_INCR DIRECT FNC_VALUES 4 SWORD COLUMN_DIR DIRECT /end RECORD_LAYOUT
/end MODULE
/end PROJECT
