/begin PROJECT MSS65-inj-V452 "MSS65 INJ - V452.01-B204.00, data set 0569Q60Z160E"
/begin HEADER "" VERSION "V452.01-B204.00" /end HEADER
/begin MODULE _MSS65-inj "MSS65 INJ - V452.01-B204.00, calibration xxxxxxxx"
/begin MOD_COMMON "" BYTE_ORDER MSB_FIRST /* Default byteorder (Motorola) */ /end MOD_COMMON
/begin COMPU_METHOD FORMULA_0003 "FORMULA_0003" RAT_FUNC "%3.0" "-" COEFFS 0 1 0 0 0 1 /end COMPU_METHOD
/begin COMPU_METHOD FORMULA_0010 "FORMULA_0010" RAT_FUNC "%5.0" "-" COEFFS 0 1 0 0 0 1 /end COMPU_METHOD
/* ------------------ Abschnitt erzeugt aus ed.dat ------------------ */
/begin COMPU_METHOD FORMULA_0668 "FORMULA_0668" TAB_VERB "%3.0" "-" COMPU_TAB_REF FORMULA_0668_VTAB /end COMPU_METHOD
/begin COMPU_VTAB FORMULA_0668_VTAB "FORMULA_0668_VTAB" TAB_VERB 5 0 "MIL immer aus" 1 "ohne Predrive" 2 "nur Predrive" 134 "OBD" 142 "OBD+SMG" /end COMPU_VTAB
/begin CHARACTERISTIC K_ED_PSAU1.P_CODE_SH_TO_UB "P-Code fuer die Art SH_TO_UB | EN: Fault code PSAU1 - OBD P-code reported for short to battery voltage" VALUE 0x7093E TKW_VV_VV_UW 100.0 FORMULA_0010 0.0 65535.0000 /end CHARACTERISTIC
/begin CHARACTERISTIC K_ED_PSAU2.P_CODE_SH_TO_UB "P-Code fuer die Art SH_TO_UB | EN: Fault code PSAU2 - OBD P-code reported for short to battery voltage" VALUE 0x70958 TKW_VV_VV_UW 100.0 FORMULA_0010 0.0 65535.0000 /end CHARACTERISTIC
/begin CHARACTERISTIC K_ED_NW1_SYNC.P_CODE_SH_TO_UB "P-Code fuer die Art SH_TO_UB" VALUE 0x70A42 TKW_VV_VV_UW 100.0 FORMULA_0010 0.0 65535.0000 /end CHARACTERISTIC
/begin CHARACTERISTIC K_ED_NW2_SYNC.P_CODE_SH_TO_UB "P-Code fuer die Art SH_TO_UB" VALUE 0x70A5C TKW_VV_VV_UW 100.0 FORMULA_0010 0.0 65535.0000 /end CHARACTERISTIC
/begin CHARACTERISTIC K_ED_PCTRL_INJ.P_CODE_SH_TO_UB "P-Code fuer die Art SH_TO_UB | EN: Fault code PCTRL_INJ - OBD P-code reported for short to battery voltage" VALUE 0x70A76 TKW_VV_VV_UW 100.0 FORMULA_0010 0.0 65535.0000 /end CHARACTERISTIC
/begin CHARACTERISTIC K_ED_PT_STATDKG.P_CODE_SH_TO_UB "P-Code fuer die Art SH_TO_UB | EN: Fault code PT_STATDKG - OBD P-code reported for short to battery voltage" VALUE 0x70A90 TKW_VV_VV_UW 100.0 FORMULA_0010 0.0 65535.0000 /end CHARACTERISTIC
/begin CHARACTERISTIC K_ED_PKS.P_CODE_SH_TO_UB "P-Code fuer die Art SH_TO_UB | EN: Fault code PKS - OBD P-code reported for short to battery voltage" VALUE 0x70AAA TKW_VV_VV_UW 100.0 FORMULA_0010 0.0 65535.0000 /end CHARACTERISTIC
/begin CHARACTERISTIC K_ED_PT_STATR.P_CODE_SH_TO_UB "P-Code fuer die Art SH_TO_UB | EN: Fault code PT_STATR - OBD P-code reported for short to battery voltage" VALUE 0x70AC4 TKW_VV_VV_UW 100.0 FORMULA_0010 0.0 65535.0000 /end CHARACTERISTIC
/begin CHARACTERISTIC K_ED_LAVK2.P_CODE_SH_TO_UB "P-Code fuer die Art SH_TO_UB | EN: Fault code LAVK2 - OBD P-code reported for short to battery voltage" VALUE 0x70AF8 TKW_VV_VV_UW 100.0 FORMULA_0010 0.0 65535.0000 /end CHARACTERISTIC
/begin CHARACTERISTIC K_ED_LAVK2_OBD_PLAU.P_CODE_SH_TO_UB "P-Code fuer die Art SH_TO_UB | EN: Fault code LAVK2_OBD_PLAU - OBD P-code reported for short to battery voltage" VALUE 0x70B2C TKW_VV_VV_UW 100.0 FORMULA_0010 0.0 65535.0000 /end CHARACTERISTIC
/begin CHARACTERISTIC K_ED_LAVK2_OBD_SA.P_CODE_SH_TO_UB "P-Code fuer die Art SH_TO_UB | EN: Fault code LAVK2_OBD_SA - OBD P-code reported for short to battery voltage" VALUE 0x70B60 TKW_VV_VV_UW 100.0 FORMULA_0010 0.0 65535.0000 /end CHARACTERISTIC
/begin CHARACTERISTIC K_ED_LSHNK1.P_CODE_SH_TO_UB "P-Code fuer die Art SH_TO_UB | EN: Fault code LSHNK1 - OBD P-code reported for short to battery voltage" VALUE 0x70BAE TKW_VV_VV_UW 100.0 FORMULA_0010 0.0 65535.0000 /end CHARACTERISTIC
/begin CHARACTERISTIC K_ED_LSHNK2.P_CODE_SH_TO_UB "P-Code fuer die Art SH_TO_UB | EN: Fault code LSHNK2 - OBD P-code reported for short to battery voltage" VALUE 0x70BC8 TKW_VV_VV_UW 100.0 FORMULA_0010 0.0 65535.0000 /end CHARACTERISTIC
/begin CHARACTERISTIC K_ED_PT_BUSOFF.P_CODE_SH_TO_UB "P-Code fuer die Art SH_TO_UB | EN: Fault code PT_BUSOFF - OBD P-code reported for short to battery voltage" VALUE 0x70BE2 TKW_VV_VV_UW 100.0 FORMULA_0010 0.0 65535.0000 /end CHARACTERISTIC
/begin CHARACTERISTIC K_ED_PT_TORQDSC.P_CODE_SH_TO_UB "P-Code fuer die Art SH_TO_UB | EN: Fault code PT_TORQDSC - OBD P-code reported for short to battery voltage" VALUE 0x70BFC TKW_VV_VV_UW 100.0 FORMULA_0010 0.0 65535.0000 /end CHARACTERISTIC
/begin CHARACTERISTIC K_ED_PT_STDSC.P_CODE_SH_TO_UB "P-Code fuer die Art SH_TO_UB | EN: Fault code PT_STDSC - OBD P-code reported for short to battery voltage" VALUE 0x70C16 TKW_VV_VV_UW 100.0 FORMULA_0010 0.0 65535.0000 /end CHARACTERISTIC
/begin CHARACTERISTIC K_ED_PT_ATEMP.P_CODE_SH_TO_UB "P-Code fuer die Art SH_TO_UB | EN: Fault code PT_ATEMP - OBD P-code reported for short to battery voltage" VALUE 0x70C64 TKW_VV_VV_UW 100.0 FORMULA_0010 0.0 65535.0000 /end CHARACTERISTIC
/begin CHARACTERISTIC K_ED_PT_KLST.P_CODE_SH_TO_UB "P-Code fuer die Art SH_TO_UB | EN: Fault code PT_KLST - OBD P-code reported for short to battery voltage" VALUE 0x70C7E TKW_VV_VV_UW 100.0 FORMULA_0010 0.0 65535.0000 /end CHARACTERISTIC
/begin CHARACTERISTIC K_ED_PT_KKOS.P_CODE_SH_TO_UB "P-Code fuer die Art SH_TO_UB | EN: Fault code PT_KKOS - OBD P-code reported for short to battery voltage" VALUE 0x70C98 TKW_VV_VV_UW 100.0 FORMULA_0010 0.0 65535.0000 /end CHARACTERISTIC
/begin CHARACTERISTIC K_ED_PT_LRW.P_CODE_SH_TO_UB "P-Code fuer die Art SH_TO_UB | EN: Fault code PT_LRW - OBD P-code reported for short to battery voltage" VALUE 0x70CB2 TKW_VV_VV_UW 100.0 FORMULA_0010 0.0 65535.0000 /end CHARACTERISTIC
/begin CHARACTERISTIC K_ED_LAVK2_OBD_TL.P_CODE_SH_TO_UB "P-Code fuer die Art SH_TO_UB | EN: Fault code LAVK2_OBD_TL - OBD P-code reported for short to battery voltage" VALUE 0x70D68 TKW_VV_VV_UW 100.0 FORMULA_0010 0.0 65535.0000 /end CHARACTERISTIC
/begin CHARACTERISTIC K_ED_LSHVK1.P_CODE_SH_TO_UB "P-Code fuer die Art SH_TO_UB | EN: Fault code LSHVK1 - OBD P-code reported for short to battery voltage" VALUE 0x70D82 TKW_VV_VV_UW 100.0 FORMULA_0010 0.0 65535.0000 /end CHARACTERISTIC
/begin CHARACTERISTIC K_ED_LSHVK2.P_CODE_SH_TO_UB "P-Code fuer die Art SH_TO_UB | EN: Fault code LSHVK2 - OBD P-code reported for short to battery voltage" VALUE 0x70D9C TKW_VV_VV_UW 100.0 FORMULA_0010 0.0 65535.0000 /end CHARACTERISTIC
/begin CHARACTERISTIC K_ED_LSRVK1_OBD_REG.P_CODE_SH_TO_UB "P-Code fuer die Art SH_TO_UB | EN: Fault code LSRVK1_OBD_REG - OBD P-code reported for short to battery voltage" VALUE 0x70DB6 TKW_VV_VV_UW 100.0 FORMULA_0010 0.0 65535.0000 /end CHARACTERISTIC
/begin CHARACTERISTIC K_ED_LSRVK2_OBD_REG.P_CODE_SH_TO_UB "P-Code fuer die Art SH_TO_UB | EN: Fault code LSRVK2_OBD_REG - OBD P-code reported for short to battery voltage" VALUE 0x70DD0 TKW_VV_VV_UW 100.0 FORMULA_0010 0.0 65535.0000 /end CHARACTERISTIC
/begin CHARACTERISTIC K_ED_LSHVK1_R.P_CODE_SH_TO_UB "P-Code fuer die Art SH_TO_UB | EN: Fault code LSHVK1_R - OBD P-code reported for short to battery voltage" VALUE 0x70DEA TKW_VV_VV_UW 100.0 FORMULA_0010 0.0 65535.0000 /end CHARACTERISTIC
/begin CHARACTERISTIC K_ED_LSHVK2_R.P_CODE_SH_TO_UB "P-Code fuer die Art SH_TO_UB | EN: Fault code LSHVK2_R - OBD P-code reported for short to battery voltage" VALUE 0x70E04 TKW_VV_VV_UW 100.0 FORMULA_0010 0.0 65535.0000 /end CHARACTERISTIC
/begin CHARACTERISTIC K_ED_LSRVK1_OBD_START.P_CODE_SH_TO_UB "P-Code fuer die Art SH_TO_UB | EN: Fault code LSRVK1_OBD_START - OBD P-code reported for short to battery voltage" VALUE 0x70E1E TKW_VV_VV_UW 100.0 FORMULA_0010 0.0 65535.0000 /end CHARACTERISTIC
/begin CHARACTERISTIC K_ED_LSRVK2_OBD_START.P_CODE_SH_TO_UB "P-Code fuer die Art SH_TO_UB | EN: Fault code LSRVK2_OBD_START - OBD P-code reported for short to battery voltage" VALUE 0x70E38 TKW_VV_VV_UW 100.0 FORMULA_0010 0.0 65535.0000 /end CHARACTERISTIC
/begin CHARACTERISTIC K_ED_LSRVK1_OBD_REF.P_CODE_SH_TO_UB "P-Code fuer die Art SH_TO_UB | EN: Fault code LSRVK1_OBD_REF - OBD P-code reported for short to battery voltage" VALUE 0x70E52 TKW_VV_VV_UW 100.0 FORMULA_0010 0.0 65535.0000 /end CHARACTERISTIC
/begin CHARACTERISTIC K_ED_LSRVK2_OBD_REF.P_CODE_SH_TO_UB "P-Code fuer die Art SH_TO_UB | EN: Fault code LSRVK2_OBD_REF - OBD P-code reported for short to battery voltage" VALUE 0x70E6C TKW_VV_VV_UW 100.0 FORMULA_0010 0.0 65535.0000 /end CHARACTERISTIC
/begin CHARACTERISTIC K_ED_LAVK2_DIAG.P_CODE_SH_TO_UB "P-Code fuer die Art SH_TO_UB | EN: Fault code LAVK2_DIAG - OBD P-code reported for short to battery voltage" VALUE 0x70EA0 TKW_VV_VV_UW 100.0 FORMULA_0010 0.0 65535.0000 /end CHARACTERISTIC
/begin CHARACTERISTIC K_ED_LAVK2_IA_OPENLOAD.P_CODE_SH_TO_UB "P-Code fuer die Art SH_TO_UB | EN: Fault code LAVK2_IA_OPENLOAD - OBD P-code reported for short to battery voltage" VALUE 0x70ED4 TKW_VV_VV_UW 100.0 FORMULA_0010 0.0 65535.0000 /end CHARACTERISTIC
/begin CHARACTERISTIC K_ED_PT_GRB.P_CODE_SH_TO_UB "P-Code fuer die Art SH_TO_UB | EN: Fault code PT_GRB - OBD P-code reported for short to battery voltage" VALUE 0x70EEE TKW_VV_VV_UW 100.0 FORMULA_0010 0.0 65535.0000 /end CHARACTERISTIC
/begin CHARACTERISTIC K_ED_PT_GRB2.P_CODE_SH_TO_UB "P-Code fuer die Art SH_TO_UB | EN: Fault code PT_GRB2 - OBD P-code reported for short to battery voltage" VALUE 0x70F08 TKW_VV_VV_UW 100.0 FORMULA_0010 0.0 65535.0000 /end CHARACTERISTIC
/begin CHARACTERISTIC K_ED_LAVK1_UN_OPENLOAD.P_CODE_SH_TO_UB "P-Code fuer die Art SH_TO_UB | EN: Fault code LAVK1_UN_OPENLOAD - OBD P-code reported for short to battery voltage" VALUE 0x70F22 TKW_VV_VV_UW 100.0 FORMULA_0010 0.0 65535.0000 /end CHARACTERISTIC
/begin CHARACTERISTIC K_ED_LAVK2_UN_OPENLOAD.P_CODE_SH_TO_UB "P-Code fuer die Art SH_TO_UB | EN: Fault code LAVK2_UN_OPENLOAD - OBD P-code reported for short to battery voltage" VALUE 0x70F3C TKW_VV_VV_UW 100.0 FORMULA_0010 0.0 65535.0000 /end CHARACTERISTIC
/begin CHARACTERISTIC K_ED_LAVK2_IP_OPENLOAD.P_CODE_SH_TO_UB "P-Code fuer die Art SH_TO_UB | EN: Fault code LAVK2_IP_OPENLOAD - OBD P-code reported for short to battery voltage" VALUE 0x70F70 TKW_VV_VV_UW 100.0 FORMULA_0010 0.0 65535.0000 /end CHARACTERISTIC
/begin CHARACTERISTIC K_ED_LAVK2_OBD_DYN.P_CODE_SH_TO_UB "P-Code fuer die Art SH_TO_UB | EN: Fault code LAVK2_OBD_DYN - OBD P-code reported for short to battery voltage" VALUE 0x712CA TKW_VV_VV_UW 100.0 FORMULA_0010 0.0 65535.0000 /end CHARACTERISTIC
/begin CHARACTERISTIC K_ED_PT_CRASH.P_CODE_SH_TO_UB "P-Code fuer die Art SH_TO_UB | EN: Fault code PT_CRASH - OBD P-code reported for short to battery voltage" VALUE 0x712E4 TKW_VV_VV_UW 100.0 FORMULA_0010 0.0 65535.0000 /end CHARACTERISTIC
/begin CHARACTERISTIC K_ED_PT_BEDFGR.P_CODE_SH_TO_UB "P-Code fuer die Art SH_TO_UB | EN: Fault code PT_BEDFGR - OBD P-code reported for short to battery voltage" VALUE 0x71318 TKW_VV_VV_UW 100.0 FORMULA_0010 0.0 65535.0000 /end CHARACTERISTIC
/begin CHARACTERISTIC K_ED_LAVK2_TRIM.P_CODE_SH_TO_UB "P-Code fuer die Art SH_TO_UB | EN: Fault code LAVK2_TRIM - OBD P-code reported for short to battery voltage" VALUE 0x713E8 TKW_VV_VV_UW 100.0 FORMULA_0010 0.0 65535.0000 /end CHARACTERISTIC
/begin CHARACTERISTIC K_ED_PT_KM.P_CODE_SH_TO_UB "P-Code fuer die Art SH_TO_UB | EN: Fault code PT_KM - OBD P-code reported for short to battery voltage" VALUE 0x7149E TKW_VV_VV_UW 100.0 FORMULA_0010 0.0 65535.0000 /end CHARACTERISTIC
/begin CHARACTERISTIC K_ED_PT_KOMBI.P_CODE_SH_TO_UB "P-Code fuer die Art SH_TO_UB | EN: Fault code PT_KOMBI - OBD P-code reported for short to battery voltage" VALUE 0x714B8 TKW_VV_VV_UW 100.0 FORMULA_0010 0.0 65535.0000 /end CHARACTERISTIC
/begin CHARACTERISTIC K_ED_PKS_LL.P_CODE_SH_TO_UB "P-Code fuer die Art SH_TO_UB | EN: Fault code PKS_LL - OBD P-code reported for short to battery voltage" VALUE 0x714D2 TKW_VV_VV_UW 100.0 FORMULA_0010 0.0 65535.0000 /end CHARACTERISTIC
/begin CHARACTERISTIC K_ED_PKS_TL.P_CODE_SH_TO_UB "P-Code fuer die Art SH_TO_UB | EN: Fault code PKS_TL - OBD P-code reported for short to battery voltage" VALUE 0x714EC TKW_VV_VV_UW 100.0 FORMULA_0010 0.0 65535.0000 /end CHARACTERISTIC
/begin CHARACTERISTIC K_ED_PKS_Q.P_CODE_SH_TO_UB "P-Code fuer die Art SH_TO_UB | EN: Fault code PKS_Q - OBD P-code reported for short to battery voltage" VALUE 0x71506 TKW_VV_VV_UW 100.0 FORMULA_0010 0.0 65535.0000 /end CHARACTERISTIC
/begin CHARACTERISTIC K_ED_MVAC_DRUCKSENSOR.P_CODE_SH_TO_UB "P-Code fuer die Art SH_TO_UB | EN: Fault code MVAC_DRUCKSENSOR - OBD P-code reported for short to battery voltage" VALUE 0x7163E TKW_VV_VV_UW 100.0 FORMULA_0010 0.0 65535.0000 /end CHARACTERISTIC
/begin CHARACTERISTIC K_ED_PT_BEDAT.P_CODE_SH_TO_UB "P-Code fuer die Art SH_TO_UB | EN: Fault code PT_BEDAT - OBD P-code reported for short to battery voltage" VALUE 0x71658 TKW_VV_VV_UW 100.0 FORMULA_0010 0.0 65535.0000 /end CHARACTERISTIC
/begin CHARACTERISTIC K_ED_PT_STATANH.P_CODE_SH_TO_UB "P-Code fuer die Art SH_TO_UB | EN: Fault code PT_STATANH - OBD P-code reported for short to battery voltage" VALUE 0x71A00 TKW_VV_VV_UW 100.0 FORMULA_0010 0.0 65535.0000 /end CHARACTERISTIC
/begin CHARACTERISTIC K_ED_PT_STATGRB.P_CODE_SH_TO_UB "P-Code fuer die Art SH_TO_UB" VALUE 0x71A82 TKW_VV_VV_UW 100.0 FORMULA_0010 0.0 65535.0000 /end CHARACTERISTIC
/begin CHARACTERISTIC K_ED_PT_ANFRADMOM.P_CODE_SH_TO_UB "P-Code fuer die Art SH_TO_UB | EN: Fault code PT_ANFRADMOM - OBD P-code reported for short to battery voltage" VALUE 0x71A9C TKW_VV_VV_UW 100.0 FORMULA_0010 0.0 65535.0000 /end CHARACTERISTIC
/begin CHARACTERISTIC K_ED_PT_TOMA.P_CODE_SH_TO_UB "P-Code fuer die Art SH_TO_UB | EN: Fault code PT_TOMA - OBD P-code reported for short to battery voltage" VALUE 0x71AEA TKW_VV_VV_UW 100.0 FORMULA_0010 0.0 65535.0000 /end CHARACTERISTIC
/begin CHARACTERISTIC K_ED_LSHNK1_R.P_CODE_SH_TO_UB "P-Code fuer die Art SH_TO_UB | EN: Fault code LSHNK1_R - OBD P-code reported for short to battery voltage" VALUE 0x71BEE TKW_VV_VV_UW 100.0 FORMULA_0010 0.0 65535.0000 /end CHARACTERISTIC
/begin CHARACTERISTIC K_ED_LSHNK2_R.P_CODE_SH_TO_UB "P-Code fuer die Art SH_TO_UB | EN: Fault code LSHNK2_R - OBD P-code reported for short to battery voltage" VALUE 0x71C08 TKW_VV_VV_UW 100.0 FORMULA_0010 0.0 65535.0000 /end CHARACTERISTIC
/begin CHARACTERISTIC K_ED_PKS_MODELL.P_CODE_SH_TO_UB "P-Code fuer die Art SH_TO_UB | EN: Fault code PKS_MODELL - OBD P-code reported for short to battery voltage" VALUE 0x71C22 TKW_VV_VV_UW 100.0 FORMULA_0010 0.0 65535.0000 /end CHARACTERISTIC
/begin CHARACTERISTIC K_ED_PKS_PAUFBAU.P_CODE_SH_TO_UB "P-Code fuer die Art SH_TO_UB | EN: Fault code PKS_PAUFBAU - OBD P-code reported for short to battery voltage" VALUE 0x71C3C TKW_VV_VV_UW 100.0 FORMULA_0010 0.0 65535.0000 /end CHARACTERISTIC
/begin CHARACTERISTIC K_ED_PKS_ADAPT_ANSCHL.P_CODE_SH_TO_UB "P-Code fuer die Art SH_TO_UB | EN: Fault code PKS_ADAPT_ANSCHL - OBD P-code reported for short to battery voltage" VALUE 0x71C56 TKW_VV_VV_UW 100.0 FORMULA_0010 0.0 65535.0000 /end CHARACTERISTIC
/begin CHARACTERISTIC K_ED_LAVK_ATIC42.P_CODE_SH_TO_UB "P-Code fuer die Art SH_TO_UB | EN: Fault code LAVK_ATIC42 - OBD P-code reported for short to battery voltage" VALUE 0x71C8A TKW_VV_VV_UW 100.0 FORMULA_0010 0.0 65535.0000 /end CHARACTERISTIC
/begin CHARACTERISTIC K_ED_PT_AX.P_CODE_SH_TO_UB "P-Code fuer die Art SH_TO_UB | EN: Fault code PT_AX - OBD P-code reported for short to battery voltage" VALUE 0x71CA4 TKW_VV_VV_UW 100.0 FORMULA_0010 0.0 65535.0000 /end CHARACTERISTIC
/begin CHARACTERISTIC K_ED_PT_OBD_ED.P_CODE_SH_TO_UB "P-Code fuer die Art SH_TO_UB" VALUE 0x71CBE TKW_VV_VV_UW 100.0 FORMULA_0010 0.0 65535.0000 /end CHARACTERISTIC
/begin CHARACTERISTIC K_ED_MVAC_OBD.P_CODE_SH_TO_UB "P-Code fuer die Art SH_TO_UB" VALUE 0x71D40 TKW_VV_VV_UW 100.0 FORMULA_0010 0.0 65535.0000 /end CHARACTERISTIC
/begin CHARACTERISTIC K_ED_LAVK2_ATIC42.P_CODE_SH_TO_UB "P-Code fuer die Art SH_TO_UB" VALUE 0x71D74 TKW_VV_VV_UW 100.0 FORMULA_0010 0.0 65535.0000 /end CHARACTERISTIC
/begin CHARACTERISTIC K_ED_PSAU1.P_CODE_SH_TO_GND "P-Code fuer die Art SH_TO_GND | EN: Fault code PSAU1 - OBD P-code reported for short to ground" VALUE 0x70940 TKW_VV_VV_UW 100.0 FORMULA_0010 0.0 65535.0000 /end CHARACTERISTIC
/begin CHARACTERISTIC K_ED_PSAU2.P_CODE_SH_TO_GND "P-Code fuer die Art SH_TO_GND | EN: Fault code PSAU2 - OBD P-code reported for short to ground" VALUE 0x7095A TKW_VV_VV_UW 100.0 FORMULA_0010 0.0 65535.0000 /end CHARACTERISTIC
/begin CHARACTERISTIC K_ED_NW1_SYNC.P_CODE_SH_TO_GND "P-Code fuer die Art SH_TO_GND" VALUE 0x70A44 TKW_VV_VV_UW 100.0 FORMULA_0010 0.0 65535.0000 /end CHARACTERISTIC
/begin CHARACTERISTIC K_ED_NW2_SYNC.P_CODE_SH_TO_GND "P-Code fuer die Art SH_TO_GND" VALUE 0x70A5E TKW_VV_VV_UW 100.0 FORMULA_0010 0.0 65535.0000 /end CHARACTERISTIC
/begin CHARACTERISTIC K_ED_PCTRL_INJ.P_CODE_SH_TO_GND "P-Code fuer die Art SH_TO_GND | EN: Fault code PCTRL_INJ - OBD P-code reported for short to ground" VALUE 0x70A78 TKW_VV_VV_UW 100.0 FORMULA_0010 0.0 65535.0000 /end CHARACTERISTIC
/begin CHARACTERISTIC K_ED_PT_STATDKG.P_CODE_SH_TO_GND "P-Code fuer die Art SH_TO_GND | EN: Fault code PT_STATDKG - OBD P-code reported for short to ground" VALUE 0x70A92 TKW_VV_VV_UW 100.0 FORMULA_0010 0.0 65535.0000 /end CHARACTERISTIC
/begin CHARACTERISTIC K_ED_PKS.P_CODE_SH_TO_GND "P-Code fuer die Art SH_TO_GND | EN: Fault code PKS - OBD P-code reported for short to ground" VALUE 0x70AAC TKW_VV_VV_UW 100.0 FORMULA_0010 0.0 65535.0000 /end CHARACTERISTIC
/begin CHARACTERISTIC K_ED_PT_STATR.P_CODE_SH_TO_GND "P-Code fuer die Art SH_TO_GND | EN: Fault code PT_STATR - OBD P-code reported for short to ground" VALUE 0x70AC6 TKW_VV_VV_UW 100.0 FORMULA_0010 0.0 65535.0000 /end CHARACTERISTIC
/begin CHARACTERISTIC K_ED_LAVK2.P_CODE_SH_TO_GND "P-Code fuer die Art SH_TO_GND | EN: Fault code LAVK2 - OBD P-code reported for short to ground" VALUE 0x70AFA TKW_VV_VV_UW 100.0 FORMULA_0010 0.0 65535.0000 /end CHARACTERISTIC
/begin CHARACTERISTIC K_ED_LAVK2_OBD_PLAU.P_CODE_SH_TO_GND "P-Code fuer die Art SH_TO_GND | EN: Fault code LAVK2_OBD_PLAU - OBD P-code reported for short to ground" VALUE 0x70B2E TKW_VV_VV_UW 100.0 FORMULA_0010 0.0 65535.0000 /end CHARACTERISTIC
/begin CHARACTERISTIC K_ED_LAVK2_OBD_SA.P_CODE_SH_TO_GND "P-Code fuer die Art SH_TO_GND | EN: Fault code LAVK2_OBD_SA - OBD P-code reported for short to ground" VALUE 0x70B62 TKW_VV_VV_UW 100.0 FORMULA_0010 0.0 65535.0000 /end CHARACTERISTIC
/begin CHARACTERISTIC K_ED_LSHNK1.P_CODE_SH_TO_GND "P-Code fuer die Art SH_TO_GND | EN: Fault code LSHNK1 - OBD P-code reported for short to ground" VALUE 0x70BB0 TKW_VV_VV_UW 100.0 FORMULA_0010 0.0 65535.0000 /end CHARACTERISTIC
/begin CHARACTERISTIC K_ED_LSHNK2.P_CODE_SH_TO_GND "P-Code fuer die Art SH_TO_GND | EN: Fault code LSHNK2 - OBD P-code reported for short to ground" VALUE 0x70BCA TKW_VV_VV_UW 100.0 FORMULA_0010 0.0 65535.0000 /end CHARACTERISTIC
/begin CHARACTERISTIC K_ED_PT_BUSOFF.P_CODE_SH_TO_GND "P-Code fuer die Art SH_TO_GND | EN: Fault code PT_BUSOFF - OBD P-code reported for short to ground" VALUE 0x70BE4 TKW_VV_VV_UW 100.0 FORMULA_0010 0.0 65535.0000 /end CHARACTERISTIC
/begin CHARACTERISTIC K_ED_PT_TORQDSC.P_CODE_SH_TO_GND "P-Code fuer die Art SH_TO_GND | EN: Fault code PT_TORQDSC - OBD P-code reported for short to ground" VALUE 0x70BFE TKW_VV_VV_UW 100.0 FORMULA_0010 0.0 65535.0000 /end CHARACTERISTIC
/begin CHARACTERISTIC K_ED_PT_STDSC.P_CODE_SH_TO_GND "P-Code fuer die Art SH_TO_GND | EN: Fault code PT_STDSC - OBD P-code reported for short to ground" VALUE 0x70C18 TKW_VV_VV_UW 100.0 FORMULA_0010 0.0 65535.0000 /end CHARACTERISTIC
/begin CHARACTERISTIC K_ED_PT_ATEMP.P_CODE_SH_TO_GND "P-Code fuer die Art SH_TO_GND | EN: Fault code PT_ATEMP - OBD P-code reported for short to ground" VALUE 0x70C66 TKW_VV_VV_UW 100.0 FORMULA_0010 0.0 65535.0000 /end CHARACTERISTIC
/begin CHARACTERISTIC K_ED_PT_KLST.P_CODE_SH_TO_GND "P-Code fuer die Art SH_TO_GND | EN: Fault code PT_KLST - OBD P-code reported for short to ground" VALUE 0x70C80 TKW_VV_VV_UW 100.0 FORMULA_0010 0.0 65535.0000 /end CHARACTERISTIC
/begin CHARACTERISTIC K_ED_PT_KKOS.P_CODE_SH_TO_GND "P-Code fuer die Art SH_TO_GND | EN: Fault code PT_KKOS - OBD P-code reported for short to ground" VALUE 0x70C9A TKW_VV_VV_UW 100.0 FORMULA_0010 0.0 65535.0000 /end CHARACTERISTIC
/begin CHARACTERISTIC K_ED_PT_LRW.P_CODE_SH_TO_GND "P-Code fuer die Art SH_TO_GND | EN: Fault code PT_LRW - OBD P-code reported for short to ground" VALUE 0x70CB4 TKW_VV_VV_UW 100.0 FORMULA_0010 0.0 65535.0000 /end CHARACTERISTIC
/begin CHARACTERISTIC K_ED_LAVK2_OBD_TL.P_CODE_SH_TO_GND "P-Code fuer die Art SH_TO_GND | EN: Fault code LAVK2_OBD_TL - OBD P-code reported for short to ground" VALUE 0x70D6A TKW_VV_VV_UW 100.0 FORMULA_0010 0.0 65535.0000 /end CHARACTERISTIC
/begin CHARACTERISTIC K_ED_LSHVK1.P_CODE_SH_TO_GND "P-Code fuer die Art SH_TO_GND | EN: Fault code LSHVK1 - OBD P-code reported for short to ground" VALUE 0x70D84 TKW_VV_VV_UW 100.0 FORMULA_0010 0.0 65535.0000 /end CHARACTERISTIC
/begin CHARACTERISTIC K_ED_LSHVK2.P_CODE_SH_TO_GND "P-Code fuer die Art SH_TO_GND | EN: Fault code LSHVK2 - OBD P-code reported for short to ground" VALUE 0x70D9E TKW_VV_VV_UW 100.0 FORMULA_0010 0.0 65535.0000 /end CHARACTERISTIC
/begin CHARACTERISTIC K_ED_LSRVK1_OBD_REG.P_CODE_SH_TO_GND "P-Code fuer die Art SH_TO_GND | EN: Fault code LSRVK1_OBD_REG - OBD P-code reported for short to ground" VALUE 0x70DB8 TKW_VV_VV_UW 100.0 FORMULA_0010 0.0 65535.0000 /end CHARACTERISTIC
/begin CHARACTERISTIC K_ED_LSRVK2_OBD_REG.P_CODE_SH_TO_GND "P-Code fuer die Art SH_TO_GND | EN: Fault code LSRVK2_OBD_REG - OBD P-code reported for short to ground" VALUE 0x70DD2 TKW_VV_VV_UW 100.0 FORMULA_0010 0.0 65535.0000 /end CHARACTERISTIC
/begin CHARACTERISTIC K_ED_LSHVK1_R.P_CODE_SH_TO_GND "P-Code fuer die Art SH_TO_GND | EN: Fault code LSHVK1_R - OBD P-code reported for short to ground" VALUE 0x70DEC TKW_VV_VV_UW 100.0 FORMULA_0010 0.0 65535.0000 /end CHARACTERISTIC
/begin CHARACTERISTIC K_ED_LSHVK2_R.P_CODE_SH_TO_GND "P-Code fuer die Art SH_TO_GND | EN: Fault code LSHVK2_R - OBD P-code reported for short to ground" VALUE 0x70E06 TKW_VV_VV_UW 100.0 FORMULA_0010 0.0 65535.0000 /end CHARACTERISTIC
/begin CHARACTERISTIC K_ED_LSRVK1_OBD_START.P_CODE_SH_TO_GND "P-Code fuer die Art SH_TO_GND | EN: Fault code LSRVK1_OBD_START - OBD P-code reported for short to ground" VALUE 0x70E20 TKW_VV_VV_UW 100.0 FORMULA_0010 0.0 65535.0000 /end CHARACTERISTIC
/begin CHARACTERISTIC K_ED_LSRVK2_OBD_START.P_CODE_SH_TO_GND "P-Code fuer die Art SH_TO_GND | EN: Fault code LSRVK2_OBD_START - OBD P-code reported for short to ground" VALUE 0x70E3A TKW_VV_VV_UW 100.0 FORMULA_0010 0.0 65535.0000 /end CHARACTERISTIC
/begin CHARACTERISTIC K_ED_LSRVK1_OBD_REF.P_CODE_SH_TO_GND "P-Code fuer die Art SH_TO_GND | EN: Fault code LSRVK1_OBD_REF - OBD P-code reported for short to ground" VALUE 0x70E54 TKW_VV_VV_UW 100.0 FORMULA_0010 0.0 65535.0000 /end CHARACTERISTIC
/begin CHARACTERISTIC K_ED_LSRVK2_OBD_REF.P_CODE_SH_TO_GND "P-Code fuer die Art SH_TO_GND | EN: Fault code LSRVK2_OBD_REF - OBD P-code reported for short to ground" VALUE 0x70E6E TKW_VV_VV_UW 100.0 FORMULA_0010 0.0 65535.0000 /end CHARACTERISTIC
/begin CHARACTERISTIC K_ED_LAVK2_DIAG.P_CODE_SH_TO_GND "P-Code fuer die Art SH_TO_GND | EN: Fault code LAVK2_DIAG - OBD P-code reported for short to ground" VALUE 0x70EA2 TKW_VV_VV_UW 100.0 FORMULA_0010 0.0 65535.0000 /end CHARACTERISTIC
/begin CHARACTERISTIC K_ED_LAVK2_IA_OPENLOAD.P_CODE_SH_TO_GND "P-Code fuer die Art SH_TO_GND | EN: Fault code LAVK2_IA_OPENLOAD - OBD P-code reported for short to ground" VALUE 0x70ED6 TKW_VV_VV_UW 100.0 FORMULA_0010 0.0 65535.0000 /end CHARACTERISTIC
/begin CHARACTERISTIC K_ED_PT_GRB.P_CODE_SH_TO_GND "P-Code fuer die Art SH_TO_GND | EN: Fault code PT_GRB - OBD P-code reported for short to ground" VALUE 0x70EF0 TKW_VV_VV_UW 100.0 FORMULA_0010 0.0 65535.0000 /end CHARACTERISTIC
/begin CHARACTERISTIC K_ED_PT_GRB2.P_CODE_SH_TO_GND "P-Code fuer die Art SH_TO_GND | EN: Fault code PT_GRB2 - OBD P-code reported for short to ground" VALUE 0x70F0A TKW_VV_VV_UW 100.0 FORMULA_0010 0.0 65535.0000 /end CHARACTERISTIC
/begin CHARACTERISTIC K_ED_LAVK1_UN_OPENLOAD.P_CODE_SH_TO_GND "P-Code fuer die Art SH_TO_GND | EN: Fault code LAVK1_UN_OPENLOAD - OBD P-code reported for short to ground" VALUE 0x70F24 TKW_VV_VV_UW 100.0 FORMULA_0010 0.0 65535.0000 /end CHARACTERISTIC
/begin CHARACTERISTIC K_ED_LAVK2_UN_OPENLOAD.P_CODE_SH_TO_GND "P-Code fuer die Art SH_TO_GND | EN: Fault code LAVK2_UN_OPENLOAD - OBD P-code reported for short to ground" VALUE 0x70F3E TKW_VV_VV_UW 100.0 FORMULA_0010 0.0 65535.0000 /end CHARACTERISTIC
/begin CHARACTERISTIC K_ED_LAVK2_IP_OPENLOAD.P_CODE_SH_TO_GND "P-Code fuer die Art SH_TO_GND | EN: Fault code LAVK2_IP_OPENLOAD - OBD P-code reported for short to ground" VALUE 0x70F72 TKW_VV_VV_UW 100.0 FORMULA_0010 0.0 65535.0000 /end CHARACTERISTIC
/begin CHARACTERISTIC K_ED_LAVK2_OBD_DYN.P_CODE_SH_TO_GND "P-Code fuer die Art SH_TO_GND | EN: Fault code LAVK2_OBD_DYN - OBD P-code reported for short to ground" VALUE 0x712CC TKW_VV_VV_UW 100.0 FORMULA_0010 0.0 65535.0000 /end CHARACTERISTIC
/begin CHARACTERISTIC K_ED_PT_CRASH.P_CODE_SH_TO_GND "P-Code fuer die Art SH_TO_GND | EN: Fault code PT_CRASH - OBD P-code reported for short to ground" VALUE 0x712E6 TKW_VV_VV_UW 100.0 FORMULA_0010 0.0 65535.0000 /end CHARACTERISTIC
/begin CHARACTERISTIC K_ED_PT_VEHMOD.P_CODE_SH_TO_GND "P-Code fuer die Art SH_TO_GND | EN: Fault code PT_VEHMOD - OBD P-code reported for short to ground" VALUE 0x71300 TKW_VV_VV_UW 100.0 FORMULA_0010 0.0 65535.0000 /end CHARACTERISTIC
/begin CHARACTERISTIC K_ED_PT_BEDFGR.P_CODE_SH_TO_GND "P-Code fuer die Art SH_TO_GND | EN: Fault code PT_BEDFGR - OBD P-code reported for short to ground" VALUE 0x7131A TKW_VV_VV_UW 100.0 FORMULA_0010 0.0 65535.0000 /end CHARACTERISTIC
/begin CHARACTERISTIC K_ED_LAVK2_TRIM.P_CODE_SH_TO_GND "P-Code fuer die Art SH_TO_GND | EN: Fault code LAVK2_TRIM - OBD P-code reported for short to ground" VALUE 0x713EA TKW_VV_VV_UW 100.0 FORMULA_0010 0.0 65535.0000 /end CHARACTERISTIC
/begin CHARACTERISTIC K_ED_PT_KM.P_CODE_SH_TO_GND "P-Code fuer die Art SH_TO_GND | EN: Fault code PT_KM - OBD P-code reported for short to ground" VALUE 0x714A0 TKW_VV_VV_UW 100.0 FORMULA_0010 0.0 65535.0000 /end CHARACTERISTIC
/begin CHARACTERISTIC K_ED_PT_KOMBI.P_CODE_SH_TO_GND "P-Code fuer die Art SH_TO_GND | EN: Fault code PT_KOMBI - OBD P-code reported for short to ground" VALUE 0x714BA TKW_VV_VV_UW 100.0 FORMULA_0010 0.0 65535.0000 /end CHARACTERISTIC
/begin CHARACTERISTIC K_ED_PKS_LL.P_CODE_SH_TO_GND "P-Code fuer die Art SH_TO_GND | EN: Fault code PKS_LL - OBD P-code reported for short to ground" VALUE 0x714D4 TKW_VV_VV_UW 100.0 FORMULA_0010 0.0 65535.0000 /end CHARACTERISTIC
/begin CHARACTERISTIC K_ED_PKS_TL.P_CODE_SH_TO_GND "P-Code fuer die Art SH_TO_GND | EN: Fault code PKS_TL - OBD P-code reported for short to ground" VALUE 0x714EE TKW_VV_VV_UW 100.0 FORMULA_0010 0.0 65535.0000 /end CHARACTERISTIC
/begin CHARACTERISTIC K_ED_PKS_Q.P_CODE_SH_TO_GND "P-Code fuer die Art SH_TO_GND | EN: Fault code PKS_Q - OBD P-code reported for short to ground" VALUE 0x71508 TKW_VV_VV_UW 100.0 FORMULA_0010 0.0 65535.0000 /end CHARACTERISTIC
/begin CHARACTERISTIC K_ED_MVAC_DRUCKSENSOR.P_CODE_SH_TO_GND "P-Code fuer die Art SH_TO_GND | EN: Fault code MVAC_DRUCKSENSOR - OBD P-code reported for short to ground" VALUE 0x71640 TKW_VV_VV_UW 100.0 FORMULA_0010 0.0 65535.0000 /end CHARACTERISTIC
/begin CHARACTERISTIC K_ED_PT_BEDAT.P_CODE_SH_TO_GND "P-Code fuer die Art SH_TO_GND | EN: Fault code PT_BEDAT - OBD P-code reported for short to ground" VALUE 0x7165A TKW_VV_VV_UW 100.0 FORMULA_0010 0.0 65535.0000 /end CHARACTERISTIC
/begin CHARACTERISTIC K_ED_PT_STATANH.P_CODE_SH_TO_GND "P-Code fuer die Art SH_TO_GND | EN: Fault code PT_STATANH - OBD P-code reported for short to ground" VALUE 0x71A02 TKW_VV_VV_UW 100.0 FORMULA_0010 0.0 65535.0000 /end CHARACTERISTIC
/begin CHARACTERISTIC K_ED_PT_STATGRB.P_CODE_SH_TO_GND "P-Code fuer die Art SH_TO_GND" VALUE 0x71A84 TKW_VV_VV_UW 100.0 FORMULA_0010 0.0 65535.0000 /end CHARACTERISTIC
/begin CHARACTERISTIC K_ED_PT_ANFRADMOM.P_CODE_SH_TO_GND "P-Code fuer die Art SH_TO_GND | EN: Fault code PT_ANFRADMOM - OBD P-code reported for short to ground" VALUE 0x71A9E TKW_VV_VV_UW 100.0 FORMULA_0010 0.0 65535.0000 /end CHARACTERISTIC
/begin CHARACTERISTIC K_ED_PT_TOMA.P_CODE_SH_TO_GND "P-Code fuer die Art SH_TO_GND | EN: Fault code PT_TOMA - OBD P-code reported for short to ground" VALUE 0x71AEC TKW_VV_VV_UW 100.0 FORMULA_0010 0.0 65535.0000 /end CHARACTERISTIC
/begin CHARACTERISTIC K_ED_LSHNK1_R.P_CODE_SH_TO_GND "P-Code fuer die Art SH_TO_GND | EN: Fault code LSHNK1_R - OBD P-code reported for short to ground" VALUE 0x71BF0 TKW_VV_VV_UW 100.0 FORMULA_0010 0.0 65535.0000 /end CHARACTERISTIC
/begin CHARACTERISTIC K_ED_LSHNK2_R.P_CODE_SH_TO_GND "P-Code fuer die Art SH_TO_GND | EN: Fault code LSHNK2_R - OBD P-code reported for short to ground" VALUE 0x71C0A TKW_VV_VV_UW 100.0 FORMULA_0010 0.0 65535.0000 /end CHARACTERISTIC
/begin CHARACTERISTIC K_ED_PKS_MODELL.P_CODE_SH_TO_GND "P-Code fuer die Art SH_TO_GND | EN: Fault code PKS_MODELL - OBD P-code reported for short to ground" VALUE 0x71C24 TKW_VV_VV_UW 100.0 FORMULA_0010 0.0 65535.0000 /end CHARACTERISTIC
/begin CHARACTERISTIC K_ED_PKS_PAUFBAU.P_CODE_SH_TO_GND "P-Code fuer die Art SH_TO_GND | EN: Fault code PKS_PAUFBAU - OBD P-code reported for short to ground" VALUE 0x71C3E TKW_VV_VV_UW 100.0 FORMULA_0010 0.0 65535.0000 /end CHARACTERISTIC
/begin CHARACTERISTIC K_ED_PKS_ADAPT_ANSCHL.P_CODE_SH_TO_GND "P-Code fuer die Art SH_TO_GND | EN: Fault code PKS_ADAPT_ANSCHL - OBD P-code reported for short to ground" VALUE 0x71C58 TKW_VV_VV_UW 100.0 FORMULA_0010 0.0 65535.0000 /end CHARACTERISTIC
/begin CHARACTERISTIC K_ED_LAVK_ATIC42.P_CODE_SH_TO_GND "P-Code fuer die Art SH_TO_GND | EN: Fault code LAVK_ATIC42 - OBD P-code reported for short to ground" VALUE 0x71C8C TKW_VV_VV_UW 100.0 FORMULA_0010 0.0 65535.0000 /end CHARACTERISTIC
/begin CHARACTERISTIC K_ED_PT_AX.P_CODE_SH_TO_GND "P-Code fuer die Art SH_TO_GND | EN: Fault code PT_AX - OBD P-code reported for short to ground" VALUE 0x71CA6 TKW_VV_VV_UW 100.0 FORMULA_0010 0.0 65535.0000 /end CHARACTERISTIC
/begin CHARACTERISTIC K_ED_PT_OBD_ED.P_CODE_SH_TO_GND "P-Code fuer die Art SH_TO_GND" VALUE 0x71CC0 TKW_VV_VV_UW 100.0 FORMULA_0010 0.0 65535.0000 /end CHARACTERISTIC
/begin CHARACTERISTIC K_ED_MVAC_OBD.P_CODE_SH_TO_GND "P-Code fuer die Art SH_TO_GND" VALUE 0x71D42 TKW_VV_VV_UW 100.0 FORMULA_0010 0.0 65535.0000 /end CHARACTERISTIC
/begin CHARACTERISTIC K_ED_LAVK2_ATIC42.P_CODE_SH_TO_GND "P-Code fuer die Art SH_TO_GND" VALUE 0x71D76 TKW_VV_VV_UW 100.0 FORMULA_0010 0.0 65535.0000 /end CHARACTERISTIC
/begin CHARACTERISTIC K_ED_PSAU1.P_CODE_OPENLOAD "P-Code fuer die Art OPENLOAD | EN: Fault code PSAU1 - OBD P-code reported for open circuit" VALUE 0x70942 TKW_VV_VV_UW 100.0 FORMULA_0010 0.0 65535.0000 /end CHARACTERISTIC
/begin CHARACTERISTIC K_ED_PSAU2.P_CODE_OPENLOAD "P-Code fuer die Art OPENLOAD | EN: Fault code PSAU2 - OBD P-code reported for open circuit" VALUE 0x7095C TKW_VV_VV_UW 100.0 FORMULA_0010 0.0 65535.0000 /end CHARACTERISTIC
/begin CHARACTERISTIC K_ED_NW1_SYNC.P_CODE_OPENLOAD "P-Code fuer die Art OPENLOAD" VALUE 0x70A46 TKW_VV_VV_UW 100.0 FORMULA_0010 0.0 65535.0000 /end CHARACTERISTIC
/begin CHARACTERISTIC K_ED_NW2_SYNC.P_CODE_OPENLOAD "P-Code fuer die Art OPENLOAD" VALUE 0x70A60 TKW_VV_VV_UW 100.0 FORMULA_0010 0.0 65535.0000 /end CHARACTERISTIC
/begin CHARACTERISTIC K_ED_PCTRL_INJ.P_CODE_OPENLOAD "P-Code fuer die Art OPENLOAD | EN: Fault code PCTRL_INJ - OBD P-code reported for open circuit" VALUE 0x70A7A TKW_VV_VV_UW 100.0 FORMULA_0010 0.0 65535.0000 /end CHARACTERISTIC
/begin CHARACTERISTIC K_ED_PT_STATDKG.P_CODE_OPENLOAD "P-Code fuer die Art OPENLOAD | EN: Fault code PT_STATDKG - OBD P-code reported for open circuit" VALUE 0x70A94 TKW_VV_VV_UW 100.0 FORMULA_0010 0.0 65535.0000 /end CHARACTERISTIC
/begin CHARACTERISTIC K_ED_PKS.P_CODE_OPENLOAD "P-Code fuer die Art OPENLOAD | EN: Fault code PKS - OBD P-code reported for open circuit" VALUE 0x70AAE TKW_VV_VV_UW 100.0 FORMULA_0010 0.0 65535.0000 /end CHARACTERISTIC
/begin CHARACTERISTIC K_ED_PT_STATR.P_CODE_OPENLOAD "P-Code fuer die Art OPENLOAD | EN: Fault code PT_STATR - OBD P-code reported for open circuit" VALUE 0x70AC8 TKW_VV_VV_UW 100.0 FORMULA_0010 0.0 65535.0000 /end CHARACTERISTIC
/begin CHARACTERISTIC K_ED_LAVK2.P_CODE_OPENLOAD "P-Code fuer die Art OPENLOAD | EN: Fault code LAVK2 - OBD P-code reported for open circuit" VALUE 0x70AFC TKW_VV_VV_UW 100.0 FORMULA_0010 0.0 65535.0000 /end CHARACTERISTIC
/begin CHARACTERISTIC K_ED_LAVK2_OBD_PLAU.P_CODE_OPENLOAD "P-Code fuer die Art OPENLOAD | EN: Fault code LAVK2_OBD_PLAU - OBD P-code reported for open circuit" VALUE 0x70B30 TKW_VV_VV_UW 100.0 FORMULA_0010 0.0 65535.0000 /end CHARACTERISTIC
/begin CHARACTERISTIC K_ED_LAVK2_OBD_SA.P_CODE_OPENLOAD "P-Code fuer die Art OPENLOAD | EN: Fault code LAVK2_OBD_SA - OBD P-code reported for open circuit" VALUE 0x70B64 TKW_VV_VV_UW 100.0 FORMULA_0010 0.0 65535.0000 /end CHARACTERISTIC
/begin CHARACTERISTIC K_ED_LSHNK1.P_CODE_OPENLOAD "P-Code fuer die Art OPENLOAD | EN: Fault code LSHNK1 - OBD P-code reported for open circuit" VALUE 0x70BB2 TKW_VV_VV_UW 100.0 FORMULA_0010 0.0 65535.0000 /end CHARACTERISTIC
/begin CHARACTERISTIC K_ED_LSHNK2.P_CODE_OPENLOAD "P-Code fuer die Art OPENLOAD | EN: Fault code LSHNK2 - OBD P-code reported for open circuit" VALUE 0x70BCC TKW_VV_VV_UW 100.0 FORMULA_0010 0.0 65535.0000 /end CHARACTERISTIC
/begin CHARACTERISTIC K_ED_PT_BUSOFF.P_CODE_OPENLOAD "P-Code fuer die Art OPENLOAD | EN: Fault code PT_BUSOFF - OBD P-code reported for open circuit" VALUE 0x70BE6 TKW_VV_VV_UW 100.0 FORMULA_0010 0.0 65535.0000 /end CHARACTERISTIC
/begin CHARACTERISTIC K_ED_PT_TORQDSC.P_CODE_OPENLOAD "P-Code fuer die Art OPENLOAD | EN: Fault code PT_TORQDSC - OBD P-code reported for open circuit" VALUE 0x70C00 TKW_VV_VV_UW 100.0 FORMULA_0010 0.0 65535.0000 /end CHARACTERISTIC
/begin CHARACTERISTIC K_ED_PT_STDSC.P_CODE_OPENLOAD "P-Code fuer die Art OPENLOAD | EN: Fault code PT_STDSC - OBD P-code reported for open circuit" VALUE 0x70C1A TKW_VV_VV_UW 100.0 FORMULA_0010 0.0 65535.0000 /end CHARACTERISTIC
/begin CHARACTERISTIC K_ED_PT_ATEMP.P_CODE_OPENLOAD "P-Code fuer die Art OPENLOAD | EN: Fault code PT_ATEMP - OBD P-code reported for open circuit" VALUE 0x70C68 TKW_VV_VV_UW 100.0 FORMULA_0010 0.0 65535.0000 /end CHARACTERISTIC
/begin CHARACTERISTIC K_ED_PT_KLST.P_CODE_OPENLOAD "P-Code fuer die Art OPENLOAD | EN: Fault code PT_KLST - OBD P-code reported for open circuit" VALUE 0x70C82 TKW_VV_VV_UW 100.0 FORMULA_0010 0.0 65535.0000 /end CHARACTERISTIC
/begin CHARACTERISTIC K_ED_PT_KKOS.P_CODE_OPENLOAD "P-Code fuer die Art OPENLOAD | EN: Fault code PT_KKOS - OBD P-code reported for open circuit" VALUE 0x70C9C TKW_VV_VV_UW 100.0 FORMULA_0010 0.0 65535.0000 /end CHARACTERISTIC
/begin CHARACTERISTIC K_ED_PT_LRW.P_CODE_OPENLOAD "P-Code fuer die Art OPENLOAD | EN: Fault code PT_LRW - OBD P-code reported for open circuit" VALUE 0x70CB6 TKW_VV_VV_UW 100.0 FORMULA_0010 0.0 65535.0000 /end CHARACTERISTIC
/begin CHARACTERISTIC K_ED_LAVK2_OBD_TL.P_CODE_OPENLOAD "P-Code fuer die Art OPENLOAD | EN: Fault code LAVK2_OBD_TL - OBD P-code reported for open circuit" VALUE 0x70D6C TKW_VV_VV_UW 100.0 FORMULA_0010 0.0 65535.0000 /end CHARACTERISTIC
/begin CHARACTERISTIC K_ED_LSHVK1.P_CODE_OPENLOAD "P-Code fuer die Art OPENLOAD | EN: Fault code LSHVK1 - OBD P-code reported for open circuit" VALUE 0x70D86 TKW_VV_VV_UW 100.0 FORMULA_0010 0.0 65535.0000 /end CHARACTERISTIC
/begin CHARACTERISTIC K_ED_LSHVK2.P_CODE_OPENLOAD "P-Code fuer die Art OPENLOAD | EN: Fault code LSHVK2 - OBD P-code reported for open circuit" VALUE 0x70DA0 TKW_VV_VV_UW 100.0 FORMULA_0010 0.0 65535.0000 /end CHARACTERISTIC
/begin CHARACTERISTIC K_ED_LSRVK1_OBD_REG.P_CODE_OPENLOAD "P-Code fuer die Art OPENLOAD | EN: Fault code LSRVK1_OBD_REG - OBD P-code reported for open circuit" VALUE 0x70DBA TKW_VV_VV_UW 100.0 FORMULA_0010 0.0 65535.0000 /end CHARACTERISTIC
/begin CHARACTERISTIC K_ED_LSRVK2_OBD_REG.P_CODE_OPENLOAD "P-Code fuer die Art OPENLOAD | EN: Fault code LSRVK2_OBD_REG - OBD P-code reported for open circuit" VALUE 0x70DD4 TKW_VV_VV_UW 100.0 FORMULA_0010 0.0 65535.0000 /end CHARACTERISTIC
/begin CHARACTERISTIC K_ED_LSHVK1_R.P_CODE_OPENLOAD "P-Code fuer die Art OPENLOAD | EN: Fault code LSHVK1_R - OBD P-code reported for open circuit" VALUE 0x70DEE TKW_VV_VV_UW 100.0 FORMULA_0010 0.0 65535.0000 /end CHARACTERISTIC
/begin CHARACTERISTIC K_ED_LSHVK2_R.P_CODE_OPENLOAD "P-Code fuer die Art OPENLOAD | EN: Fault code LSHVK2_R - OBD P-code reported for open circuit" VALUE 0x70E08 TKW_VV_VV_UW 100.0 FORMULA_0010 0.0 65535.0000 /end CHARACTERISTIC
/begin CHARACTERISTIC K_ED_LSRVK1_OBD_START.P_CODE_OPENLOAD "P-Code fuer die Art OPENLOAD | EN: Fault code LSRVK1_OBD_START - OBD P-code reported for open circuit" VALUE 0x70E22 TKW_VV_VV_UW 100.0 FORMULA_0010 0.0 65535.0000 /end CHARACTERISTIC
/begin CHARACTERISTIC K_ED_LSRVK2_OBD_START.P_CODE_OPENLOAD "P-Code fuer die Art OPENLOAD | EN: Fault code LSRVK2_OBD_START - OBD P-code reported for open circuit" VALUE 0x70E3C TKW_VV_VV_UW 100.0 FORMULA_0010 0.0 65535.0000 /end CHARACTERISTIC
/begin CHARACTERISTIC K_ED_LSRVK1_OBD_REF.P_CODE_OPENLOAD "P-Code fuer die Art OPENLOAD | EN: Fault code LSRVK1_OBD_REF - OBD P-code reported for open circuit" VALUE 0x70E56 TKW_VV_VV_UW 100.0 FORMULA_0010 0.0 65535.0000 /end CHARACTERISTIC
/begin CHARACTERISTIC K_ED_LSRVK2_OBD_REF.P_CODE_OPENLOAD "P-Code fuer die Art OPENLOAD | EN: Fault code LSRVK2_OBD_REF - OBD P-code reported for open circuit" VALUE 0x70E70 TKW_VV_VV_UW 100.0 FORMULA_0010 0.0 65535.0000 /end CHARACTERISTIC
/begin CHARACTERISTIC K_ED_LAVK2_DIAG.P_CODE_OPENLOAD "P-Code fuer die Art OPENLOAD | EN: Fault code LAVK2_DIAG - OBD P-code reported for open circuit" VALUE 0x70EA4 TKW_VV_VV_UW 100.0 FORMULA_0010 0.0 65535.0000 /end CHARACTERISTIC
/begin CHARACTERISTIC K_ED_LAVK2_IA_OPENLOAD.P_CODE_OPENLOAD "P-Code fuer die Art OPENLOAD | EN: Fault code LAVK2_IA_OPENLOAD - OBD P-code reported for open circuit" VALUE 0x70ED8 TKW_VV_VV_UW 100.0 FORMULA_0010 0.0 65535.0000 /end CHARACTERISTIC
/begin CHARACTERISTIC K_ED_PT_GRB.P_CODE_OPENLOAD "P-Code fuer die Art OPENLOAD | EN: Fault code PT_GRB - OBD P-code reported for open circuit" VALUE 0x70EF2 TKW_VV_VV_UW 100.0 FORMULA_0010 0.0 65535.0000 /end CHARACTERISTIC
/begin CHARACTERISTIC K_ED_PT_GRB2.P_CODE_OPENLOAD "P-Code fuer die Art OPENLOAD | EN: Fault code PT_GRB2 - OBD P-code reported for open circuit" VALUE 0x70F0C TKW_VV_VV_UW 100.0 FORMULA_0010 0.0 65535.0000 /end CHARACTERISTIC
/begin CHARACTERISTIC K_ED_LAVK1_UN_OPENLOAD.P_CODE_OPENLOAD "P-Code fuer die Art OPENLOAD | EN: Fault code LAVK1_UN_OPENLOAD - OBD P-code reported for open circuit" VALUE 0x70F26 TKW_VV_VV_UW 100.0 FORMULA_0010 0.0 65535.0000 /end CHARACTERISTIC
/begin CHARACTERISTIC K_ED_LAVK2_UN_OPENLOAD.P_CODE_OPENLOAD "P-Code fuer die Art OPENLOAD | EN: Fault code LAVK2_UN_OPENLOAD - OBD P-code reported for open circuit" VALUE 0x70F40 TKW_VV_VV_UW 100.0 FORMULA_0010 0.0 65535.0000 /end CHARACTERISTIC
/begin CHARACTERISTIC K_ED_LAVK2_IP_OPENLOAD.P_CODE_OPENLOAD "P-Code fuer die Art OPENLOAD | EN: Fault code LAVK2_IP_OPENLOAD - OBD P-code reported for open circuit" VALUE 0x70F74 TKW_VV_VV_UW 100.0 FORMULA_0010 0.0 65535.0000 /end CHARACTERISTIC
/begin CHARACTERISTIC K_ED_LAVK2_OBD_DYN.P_CODE_OPENLOAD "P-Code fuer die Art OPENLOAD | EN: Fault code LAVK2_OBD_DYN - OBD P-code reported for open circuit" VALUE 0x712CE TKW_VV_VV_UW 100.0 FORMULA_0010 0.0 65535.0000 /end CHARACTERISTIC
/begin CHARACTERISTIC K_ED_PT_CRASH.P_CODE_OPENLOAD "P-Code fuer die Art OPENLOAD | EN: Fault code PT_CRASH - OBD P-code reported for open circuit" VALUE 0x712E8 TKW_VV_VV_UW 100.0 FORMULA_0010 0.0 65535.0000 /end CHARACTERISTIC
/begin CHARACTERISTIC K_ED_PT_VEHMOD.P_CODE_OPENLOAD "P-Code fuer die Art OPENLOAD | EN: Fault code PT_VEHMOD - OBD P-code reported for open circuit" VALUE 0x71302 TKW_VV_VV_UW 100.0 FORMULA_0010 0.0 65535.0000 /end CHARACTERISTIC
/begin CHARACTERISTIC K_ED_PT_BEDFGR.P_CODE_OPENLOAD "P-Code fuer die Art OPENLOAD | EN: Fault code PT_BEDFGR - OBD P-code reported for open circuit" VALUE 0x7131C TKW_VV_VV_UW 100.0 FORMULA_0010 0.0 65535.0000 /end CHARACTERISTIC
/begin CHARACTERISTIC K_ED_LAVK2_TRIM.P_CODE_OPENLOAD "P-Code fuer die Art OPENLOAD | EN: Fault code LAVK2_TRIM - OBD P-code reported for open circuit" VALUE 0x713EC TKW_VV_VV_UW 100.0 FORMULA_0010 0.0 65535.0000 /end CHARACTERISTIC
/begin CHARACTERISTIC K_ED_PT_KM.P_CODE_OPENLOAD "P-Code fuer die Art OPENLOAD | EN: Fault code PT_KM - OBD P-code reported for open circuit" VALUE 0x714A2 TKW_VV_VV_UW 100.0 FORMULA_0010 0.0 65535.0000 /end CHARACTERISTIC
/begin CHARACTERISTIC K_ED_PT_KOMBI.P_CODE_OPENLOAD "P-Code fuer die Art OPENLOAD | EN: Fault code PT_KOMBI - OBD P-code reported for open circuit" VALUE 0x714BC TKW_VV_VV_UW 100.0 FORMULA_0010 0.0 65535.0000 /end CHARACTERISTIC
/begin CHARACTERISTIC K_ED_PKS_LL.P_CODE_OPENLOAD "P-Code fuer die Art OPENLOAD | EN: Fault code PKS_LL - OBD P-code reported for open circuit" VALUE 0x714D6 TKW_VV_VV_UW 100.0 FORMULA_0010 0.0 65535.0000 /end CHARACTERISTIC
/begin CHARACTERISTIC K_ED_PKS_TL.P_CODE_OPENLOAD "P-Code fuer die Art OPENLOAD | EN: Fault code PKS_TL - OBD P-code reported for open circuit" VALUE 0x714F0 TKW_VV_VV_UW 100.0 FORMULA_0010 0.0 65535.0000 /end CHARACTERISTIC
/begin CHARACTERISTIC K_ED_PKS_Q.P_CODE_OPENLOAD "P-Code fuer die Art OPENLOAD | EN: Fault code PKS_Q - OBD P-code reported for open circuit" VALUE 0x7150A TKW_VV_VV_UW 100.0 FORMULA_0010 0.0 65535.0000 /end CHARACTERISTIC
/begin CHARACTERISTIC K_ED_MVAC_DRUCKSENSOR.P_CODE_OPENLOAD "P-Code fuer die Art OPENLOAD | EN: Fault code MVAC_DRUCKSENSOR - OBD P-code reported for open circuit" VALUE 0x71642 TKW_VV_VV_UW 100.0 FORMULA_0010 0.0 65535.0000 /end CHARACTERISTIC
/begin CHARACTERISTIC K_ED_PT_BEDAT.P_CODE_OPENLOAD "P-Code fuer die Art OPENLOAD | EN: Fault code PT_BEDAT - OBD P-code reported for open circuit" VALUE 0x7165C TKW_VV_VV_UW 100.0 FORMULA_0010 0.0 65535.0000 /end CHARACTERISTIC
/begin CHARACTERISTIC K_ED_PT_STATANH.P_CODE_OPENLOAD "P-Code fuer die Art OPENLOAD | EN: Fault code PT_STATANH - OBD P-code reported for open circuit" VALUE 0x71A04 TKW_VV_VV_UW 100.0 FORMULA_0010 0.0 65535.0000 /end CHARACTERISTIC
/begin CHARACTERISTIC K_ED_PT_STATGRB.P_CODE_OPENLOAD "P-Code fuer die Art OPENLOAD" VALUE 0x71A86 TKW_VV_VV_UW 100.0 FORMULA_0010 0.0 65535.0000 /end CHARACTERISTIC
/begin CHARACTERISTIC K_ED_PT_ANFRADMOM.P_CODE_OPENLOAD "P-Code fuer die Art OPENLOAD | EN: Fault code PT_ANFRADMOM - OBD P-code reported for open circuit" VALUE 0x71AA0 TKW_VV_VV_UW 100.0 FORMULA_0010 0.0 65535.0000 /end CHARACTERISTIC
/begin CHARACTERISTIC K_ED_PT_TOMA.P_CODE_OPENLOAD "P-Code fuer die Art OPENLOAD | EN: Fault code PT_TOMA - OBD P-code reported for open circuit" VALUE 0x71AEE TKW_VV_VV_UW 100.0 FORMULA_0010 0.0 65535.0000 /end CHARACTERISTIC
/begin CHARACTERISTIC K_ED_LSHNK1_R.P_CODE_OPENLOAD "P-Code fuer die Art OPENLOAD | EN: Fault code LSHNK1_R - OBD P-code reported for open circuit" VALUE 0x71BF2 TKW_VV_VV_UW 100.0 FORMULA_0010 0.0 65535.0000 /end CHARACTERISTIC
/begin CHARACTERISTIC K_ED_LSHNK2_R.P_CODE_OPENLOAD "P-Code fuer die Art OPENLOAD | EN: Fault code LSHNK2_R - OBD P-code reported for open circuit" VALUE 0x71C0C TKW_VV_VV_UW 100.0 FORMULA_0010 0.0 65535.0000 /end CHARACTERISTIC
/begin CHARACTERISTIC K_ED_PKS_MODELL.P_CODE_OPENLOAD "P-Code fuer die Art OPENLOAD | EN: Fault code PKS_MODELL - OBD P-code reported for open circuit" VALUE 0x71C26 TKW_VV_VV_UW 100.0 FORMULA_0010 0.0 65535.0000 /end CHARACTERISTIC
/begin CHARACTERISTIC K_ED_PKS_PAUFBAU.P_CODE_OPENLOAD "P-Code fuer die Art OPENLOAD | EN: Fault code PKS_PAUFBAU - OBD P-code reported for open circuit" VALUE 0x71C40 TKW_VV_VV_UW 100.0 FORMULA_0010 0.0 65535.0000 /end CHARACTERISTIC
/begin CHARACTERISTIC K_ED_PKS_ADAPT_ANSCHL.P_CODE_OPENLOAD "P-Code fuer die Art OPENLOAD | EN: Fault code PKS_ADAPT_ANSCHL - OBD P-code reported for open circuit" VALUE 0x71C5A TKW_VV_VV_UW 100.0 FORMULA_0010 0.0 65535.0000 /end CHARACTERISTIC
/begin CHARACTERISTIC K_ED_LAVK_ATIC42.P_CODE_OPENLOAD "P-Code fuer die Art OPENLOAD | EN: Fault code LAVK_ATIC42 - OBD P-code reported for open circuit" VALUE 0x71C8E TKW_VV_VV_UW 100.0 FORMULA_0010 0.0 65535.0000 /end CHARACTERISTIC
/begin CHARACTERISTIC K_ED_PT_AX.P_CODE_OPENLOAD "P-Code fuer die Art OPENLOAD | EN: Fault code PT_AX - OBD P-code reported for open circuit" VALUE 0x71CA8 TKW_VV_VV_UW 100.0 FORMULA_0010 0.0 65535.0000 /end CHARACTERISTIC
/begin CHARACTERISTIC K_ED_PT_OBD_ED.P_CODE_OPENLOAD "P-Code fuer die Art OPENLOAD" VALUE 0x71CC2 TKW_VV_VV_UW 100.0 FORMULA_0010 0.0 65535.0000 /end CHARACTERISTIC
/begin CHARACTERISTIC K_ED_MVAC_OBD.P_CODE_OPENLOAD "P-Code fuer die Art OPENLOAD" VALUE 0x71D44 TKW_VV_VV_UW 100.0 FORMULA_0010 0.0 65535.0000 /end CHARACTERISTIC
/begin CHARACTERISTIC K_ED_LAVK2_ATIC42.P_CODE_OPENLOAD "P-Code fuer die Art OPENLOAD" VALUE 0x71D78 TKW_VV_VV_UW 100.0 FORMULA_0010 0.0 65535.0000 /end CHARACTERISTIC
/begin CHARACTERISTIC K_ED_PSAU1.P_CODE_UNPLAUSIBEL "P-Code fuer die Art UNPLAUSIBEL | EN: Fault code PSAU1 - OBD P-code reported for implausible signal" VALUE 0x70944 TKW_VV_VV_UW 100.0 FORMULA_0010 0.0 65535.0000 /end CHARACTERISTIC
/begin CHARACTERISTIC K_ED_PSAU2.P_CODE_UNPLAUSIBEL "P-Code fuer die Art UNPLAUSIBEL | EN: Fault code PSAU2 - OBD P-code reported for implausible signal" VALUE 0x7095E TKW_VV_VV_UW 100.0 FORMULA_0010 0.0 65535.0000 /end CHARACTERISTIC
/begin CHARACTERISTIC K_ED_NW1_SYNC.P_CODE_UNPLAUSIBEL "P-Code fuer die Art UNPLAUSIBEL" VALUE 0x70A48 TKW_VV_VV_UW 100.0 FORMULA_0010 0.0 65535.0000 /end CHARACTERISTIC
/begin CHARACTERISTIC K_ED_NW2_SYNC.P_CODE_UNPLAUSIBEL "P-Code fuer die Art UNPLAUSIBEL" VALUE 0x70A62 TKW_VV_VV_UW 100.0 FORMULA_0010 0.0 65535.0000 /end CHARACTERISTIC
/begin CHARACTERISTIC K_ED_PCTRL_INJ.P_CODE_UNPLAUSIBEL "P-Code fuer die Art UNPLAUSIBEL | EN: Fault code PCTRL_INJ - OBD P-code reported for implausible signal" VALUE 0x70A7C TKW_VV_VV_UW 100.0 FORMULA_0010 0.0 65535.0000 /end CHARACTERISTIC
/begin CHARACTERISTIC K_ED_PT_STATDKG.P_CODE_UNPLAUSIBEL "P-Code fuer die Art UNPLAUSIBEL | EN: Fault code PT_STATDKG - OBD P-code reported for implausible signal" VALUE 0x70A96 TKW_VV_VV_UW 100.0 FORMULA_0010 0.0 65535.0000 /end CHARACTERISTIC
/begin CHARACTERISTIC K_ED_PKS.P_CODE_UNPLAUSIBEL "P-Code fuer die Art UNPLAUSIBEL | EN: Fault code PKS - OBD P-code reported for implausible signal" VALUE 0x70AB0 TKW_VV_VV_UW 100.0 FORMULA_0010 0.0 65535.0000 /end CHARACTERISTIC
/begin CHARACTERISTIC K_ED_PT_STATR.P_CODE_UNPLAUSIBEL "P-Code fuer die Art UNPLAUSIBEL | EN: Fault code PT_STATR - OBD P-code reported for implausible signal" VALUE 0x70ACA TKW_VV_VV_UW 100.0 FORMULA_0010 0.0 65535.0000 /end CHARACTERISTIC
/begin CHARACTERISTIC K_ED_LAVK2.P_CODE_UNPLAUSIBEL "P-Code fuer die Art UNPLAUSIBEL | EN: Fault code LAVK2 - OBD P-code reported for implausible signal" VALUE 0x70AFE TKW_VV_VV_UW 100.0 FORMULA_0010 0.0 65535.0000 /end CHARACTERISTIC
/begin CHARACTERISTIC K_ED_LAVK2_OBD_PLAU.P_CODE_UNPLAUSIBEL "P-Code fuer die Art UNPLAUSIBEL | EN: Fault code LAVK2_OBD_PLAU - OBD P-code reported for implausible signal" VALUE 0x70B32 TKW_VV_VV_UW 100.0 FORMULA_0010 0.0 65535.0000 /end CHARACTERISTIC
/begin CHARACTERISTIC K_ED_LAVK2_OBD_SA.P_CODE_UNPLAUSIBEL "P-Code fuer die Art UNPLAUSIBEL | EN: Fault code LAVK2_OBD_SA - OBD P-code reported for implausible signal" VALUE 0x70B66 TKW_VV_VV_UW 100.0 FORMULA_0010 0.0 65535.0000 /end CHARACTERISTIC
/begin CHARACTERISTIC K_ED_LSHNK1.P_CODE_UNPLAUSIBEL "P-Code fuer die Art UNPLAUSIBEL | EN: Fault code LSHNK1 - OBD P-code reported for implausible signal" VALUE 0x70BB4 TKW_VV_VV_UW 100.0 FORMULA_0010 0.0 65535.0000 /end CHARACTERISTIC
/begin CHARACTERISTIC K_ED_LSHNK2.P_CODE_UNPLAUSIBEL "P-Code fuer die Art UNPLAUSIBEL | EN: Fault code LSHNK2 - OBD P-code reported for implausible signal" VALUE 0x70BCE TKW_VV_VV_UW 100.0 FORMULA_0010 0.0 65535.0000 /end CHARACTERISTIC
/begin CHARACTERISTIC K_ED_PT_BUSOFF.P_CODE_UNPLAUSIBEL "P-Code fuer die Art UNPLAUSIBEL | EN: Fault code PT_BUSOFF - OBD P-code reported for implausible signal" VALUE 0x70BE8 TKW_VV_VV_UW 100.0 FORMULA_0010 0.0 65535.0000 /end CHARACTERISTIC
/begin CHARACTERISTIC K_ED_PT_TORQDSC.P_CODE_UNPLAUSIBEL "P-Code fuer die Art UNPLAUSIBEL | EN: Fault code PT_TORQDSC - OBD P-code reported for implausible signal" VALUE 0x70C02 TKW_VV_VV_UW 100.0 FORMULA_0010 0.0 65535.0000 /end CHARACTERISTIC
/begin CHARACTERISTIC K_ED_PT_STDSC.P_CODE_UNPLAUSIBEL "P-Code fuer die Art UNPLAUSIBEL | EN: Fault code PT_STDSC - OBD P-code reported for implausible signal" VALUE 0x70C1C TKW_VV_VV_UW 100.0 FORMULA_0010 0.0 65535.0000 /end CHARACTERISTIC
/begin CHARACTERISTIC K_ED_PT_ATEMP.P_CODE_UNPLAUSIBEL "P-Code fuer die Art UNPLAUSIBEL | EN: Fault code PT_ATEMP - OBD P-code reported for implausible signal" VALUE 0x70C6A TKW_VV_VV_UW 100.0 FORMULA_0010 0.0 65535.0000 /end CHARACTERISTIC
/begin CHARACTERISTIC K_ED_PT_KLST.P_CODE_UNPLAUSIBEL "P-Code fuer die Art UNPLAUSIBEL | EN: Fault code PT_KLST - OBD P-code reported for implausible signal" VALUE 0x70C84 TKW_VV_VV_UW 100.0 FORMULA_0010 0.0 65535.0000 /end CHARACTERISTIC
/begin CHARACTERISTIC K_ED_PT_KKOS.P_CODE_UNPLAUSIBEL "P-Code fuer die Art UNPLAUSIBEL | EN: Fault code PT_KKOS - OBD P-code reported for implausible signal" VALUE 0x70C9E TKW_VV_VV_UW 100.0 FORMULA_0010 0.0 65535.0000 /end CHARACTERISTIC
/begin CHARACTERISTIC K_ED_PT_LRW.P_CODE_UNPLAUSIBEL "P-Code fuer die Art UNPLAUSIBEL | EN: Fault code PT_LRW - OBD P-code reported for implausible signal" VALUE 0x70CB8 TKW_VV_VV_UW 100.0 FORMULA_0010 0.0 65535.0000 /end CHARACTERISTIC
/begin CHARACTERISTIC K_ED_LAVK2_OBD_TL.P_CODE_UNPLAUSIBEL "P-Code fuer die Art UNPLAUSIBEL | EN: Fault code LAVK2_OBD_TL - OBD P-code reported for implausible signal" VALUE 0x70D6E TKW_VV_VV_UW 100.0 FORMULA_0010 0.0 65535.0000 /end CHARACTERISTIC
/begin CHARACTERISTIC K_ED_LSHVK1.P_CODE_UNPLAUSIBEL "P-Code fuer die Art UNPLAUSIBEL | EN: Fault code LSHVK1 - OBD P-code reported for implausible signal" VALUE 0x70D88 TKW_VV_VV_UW 100.0 FORMULA_0010 0.0 65535.0000 /end CHARACTERISTIC
/begin CHARACTERISTIC K_ED_LSHVK2.P_CODE_UNPLAUSIBEL "P-Code fuer die Art UNPLAUSIBEL | EN: Fault code LSHVK2 - OBD P-code reported for implausible signal" VALUE 0x70DA2 TKW_VV_VV_UW 100.0 FORMULA_0010 0.0 65535.0000 /end CHARACTERISTIC
/begin CHARACTERISTIC K_ED_LSRVK1_OBD_REG.P_CODE_UNPLAUSIBEL "P-Code fuer die Art UNPLAUSIBEL | EN: Fault code LSRVK1_OBD_REG - OBD P-code reported for implausible signal" VALUE 0x70DBC TKW_VV_VV_UW 100.0 FORMULA_0010 0.0 65535.0000 /end CHARACTERISTIC
/begin CHARACTERISTIC K_ED_LSRVK2_OBD_REG.P_CODE_UNPLAUSIBEL "P-Code fuer die Art UNPLAUSIBEL | EN: Fault code LSRVK2_OBD_REG - OBD P-code reported for implausible signal" VALUE 0x70DD6 TKW_VV_VV_UW 100.0 FORMULA_0010 0.0 65535.0000 /end CHARACTERISTIC
/begin CHARACTERISTIC K_ED_LSHVK1_R.P_CODE_UNPLAUSIBEL "P-Code fuer die Art UNPLAUSIBEL | EN: Fault code LSHVK1_R - OBD P-code reported for implausible signal" VALUE 0x70DF0 TKW_VV_VV_UW 100.0 FORMULA_0010 0.0 65535.0000 /end CHARACTERISTIC
/begin CHARACTERISTIC K_ED_LSHVK2_R.P_CODE_UNPLAUSIBEL "P-Code fuer die Art UNPLAUSIBEL | EN: Fault code LSHVK2_R - OBD P-code reported for implausible signal" VALUE 0x70E0A TKW_VV_VV_UW 100.0 FORMULA_0010 0.0 65535.0000 /end CHARACTERISTIC
/begin CHARACTERISTIC K_ED_LSRVK1_OBD_START.P_CODE_UNPLAUSIBEL "P-Code fuer die Art UNPLAUSIBEL | EN: Fault code LSRVK1_OBD_START - OBD P-code reported for implausible signal" VALUE 0x70E24 TKW_VV_VV_UW 100.0 FORMULA_0010 0.0 65535.0000 /end CHARACTERISTIC
/begin CHARACTERISTIC K_ED_LSRVK2_OBD_START.P_CODE_UNPLAUSIBEL "P-Code fuer die Art UNPLAUSIBEL | EN: Fault code LSRVK2_OBD_START - OBD P-code reported for implausible signal" VALUE 0x70E3E TKW_VV_VV_UW 100.0 FORMULA_0010 0.0 65535.0000 /end CHARACTERISTIC
/begin CHARACTERISTIC K_ED_LSRVK1_OBD_REF.P_CODE_UNPLAUSIBEL "P-Code fuer die Art UNPLAUSIBEL | EN: Fault code LSRVK1_OBD_REF - OBD P-code reported for implausible signal" VALUE 0x70E58 TKW_VV_VV_UW 100.0 FORMULA_0010 0.0 65535.0000 /end CHARACTERISTIC
/begin CHARACTERISTIC K_ED_LSRVK2_OBD_REF.P_CODE_UNPLAUSIBEL "P-Code fuer die Art UNPLAUSIBEL | EN: Fault code LSRVK2_OBD_REF - OBD P-code reported for implausible signal" VALUE 0x70E72 TKW_VV_VV_UW 100.0 FORMULA_0010 0.0 65535.0000 /end CHARACTERISTIC
/begin CHARACTERISTIC K_ED_LAVK2_DIAG.P_CODE_UNPLAUSIBEL "P-Code fuer die Art UNPLAUSIBEL | EN: Fault code LAVK2_DIAG - OBD P-code reported for implausible signal" VALUE 0x70EA6 TKW_VV_VV_UW 100.0 FORMULA_0010 0.0 65535.0000 /end CHARACTERISTIC
/begin CHARACTERISTIC K_ED_LAVK2_IA_OPENLOAD.P_CODE_UNPLAUSIBEL "P-Code fuer die Art UNPLAUSIBEL | EN: Fault code LAVK2_IA_OPENLOAD - OBD P-code reported for implausible signal" VALUE 0x70EDA TKW_VV_VV_UW 100.0 FORMULA_0010 0.0 65535.0000 /end CHARACTERISTIC
/begin CHARACTERISTIC K_ED_PT_GRB.P_CODE_UNPLAUSIBEL "P-Code fuer die Art UNPLAUSIBEL | EN: Fault code PT_GRB - OBD P-code reported for implausible signal" VALUE 0x70EF4 TKW_VV_VV_UW 100.0 FORMULA_0010 0.0 65535.0000 /end CHARACTERISTIC
/begin CHARACTERISTIC K_ED_PT_GRB2.P_CODE_UNPLAUSIBEL "P-Code fuer die Art UNPLAUSIBEL | EN: Fault code PT_GRB2 - OBD P-code reported for implausible signal" VALUE 0x70F0E TKW_VV_VV_UW 100.0 FORMULA_0010 0.0 65535.0000 /end CHARACTERISTIC
/begin CHARACTERISTIC K_ED_LAVK1_UN_OPENLOAD.P_CODE_UNPLAUSIBEL "P-Code fuer die Art UNPLAUSIBEL | EN: Fault code LAVK1_UN_OPENLOAD - OBD P-code reported for implausible signal" VALUE 0x70F28 TKW_VV_VV_UW 100.0 FORMULA_0010 0.0 65535.0000 /end CHARACTERISTIC
/begin CHARACTERISTIC K_ED_LAVK2_UN_OPENLOAD.P_CODE_UNPLAUSIBEL "P-Code fuer die Art UNPLAUSIBEL | EN: Fault code LAVK2_UN_OPENLOAD - OBD P-code reported for implausible signal" VALUE 0x70F42 TKW_VV_VV_UW 100.0 FORMULA_0010 0.0 65535.0000 /end CHARACTERISTIC
/begin CHARACTERISTIC K_ED_LAVK2_IP_OPENLOAD.P_CODE_UNPLAUSIBEL "P-Code fuer die Art UNPLAUSIBEL | EN: Fault code LAVK2_IP_OPENLOAD - OBD P-code reported for implausible signal" VALUE 0x70F76 TKW_VV_VV_UW 100.0 FORMULA_0010 0.0 65535.0000 /end CHARACTERISTIC
/begin CHARACTERISTIC K_ED_LAVK2_OBD_DYN.P_CODE_UNPLAUSIBEL "P-Code fuer die Art UNPLAUSIBEL | EN: Fault code LAVK2_OBD_DYN - OBD P-code reported for implausible signal" VALUE 0x712D0 TKW_VV_VV_UW 100.0 FORMULA_0010 0.0 65535.0000 /end CHARACTERISTIC
/begin CHARACTERISTIC K_ED_PT_CRASH.P_CODE_UNPLAUSIBEL "P-Code fuer die Art UNPLAUSIBEL | EN: Fault code PT_CRASH - OBD P-code reported for implausible signal" VALUE 0x712EA TKW_VV_VV_UW 100.0 FORMULA_0010 0.0 65535.0000 /end CHARACTERISTIC
/begin CHARACTERISTIC K_ED_PT_BEDFGR.P_CODE_UNPLAUSIBEL "P-Code fuer die Art UNPLAUSIBEL | EN: Fault code PT_BEDFGR - OBD P-code reported for implausible signal" VALUE 0x7131E TKW_VV_VV_UW 100.0 FORMULA_0010 0.0 65535.0000 /end CHARACTERISTIC
/begin CHARACTERISTIC K_ED_LAVK2_TRIM.P_CODE_UNPLAUSIBEL "P-Code fuer die Art UNPLAUSIBEL | EN: Fault code LAVK2_TRIM - OBD P-code reported for implausible signal" VALUE 0x713EE TKW_VV_VV_UW 100.0 FORMULA_0010 0.0 65535.0000 /end CHARACTERISTIC
/begin CHARACTERISTIC K_ED_PT_KM.P_CODE_UNPLAUSIBEL "P-Code fuer die Art UNPLAUSIBEL | EN: Fault code PT_KM - OBD P-code reported for implausible signal" VALUE 0x714A4 TKW_VV_VV_UW 100.0 FORMULA_0010 0.0 65535.0000 /end CHARACTERISTIC
/begin CHARACTERISTIC K_ED_PT_KOMBI.P_CODE_UNPLAUSIBEL "P-Code fuer die Art UNPLAUSIBEL | EN: Fault code PT_KOMBI - OBD P-code reported for implausible signal" VALUE 0x714BE TKW_VV_VV_UW 100.0 FORMULA_0010 0.0 65535.0000 /end CHARACTERISTIC
/begin CHARACTERISTIC K_ED_PKS_LL.P_CODE_UNPLAUSIBEL "P-Code fuer die Art UNPLAUSIBEL | EN: Fault code PKS_LL - OBD P-code reported for implausible signal" VALUE 0x714D8 TKW_VV_VV_UW 100.0 FORMULA_0010 0.0 65535.0000 /end CHARACTERISTIC
/begin CHARACTERISTIC K_ED_PKS_TL.P_CODE_UNPLAUSIBEL "P-Code fuer die Art UNPLAUSIBEL | EN: Fault code PKS_TL - OBD P-code reported for implausible signal" VALUE 0x714F2 TKW_VV_VV_UW 100.0 FORMULA_0010 0.0 65535.0000 /end CHARACTERISTIC
/begin CHARACTERISTIC K_ED_PKS_Q.P_CODE_UNPLAUSIBEL "P-Code fuer die Art UNPLAUSIBEL | EN: Fault code PKS_Q - OBD P-code reported for implausible signal" VALUE 0x7150C TKW_VV_VV_UW 100.0 FORMULA_0010 0.0 65535.0000 /end CHARACTERISTIC
/begin CHARACTERISTIC K_ED_MVAC_DRUCKSENSOR.P_CODE_UNPLAUSIBEL "P-Code fuer die Art UNPLAUSIBEL | EN: Fault code MVAC_DRUCKSENSOR - OBD P-code reported for implausible signal" VALUE 0x71644 TKW_VV_VV_UW 100.0 FORMULA_0010 0.0 65535.0000 /end CHARACTERISTIC
/begin CHARACTERISTIC K_ED_PT_BEDAT.P_CODE_UNPLAUSIBEL "P-Code fuer die Art UNPLAUSIBEL | EN: Fault code PT_BEDAT - OBD P-code reported for implausible signal" VALUE 0x7165E TKW_VV_VV_UW 100.0 FORMULA_0010 0.0 65535.0000 /end CHARACTERISTIC
/begin CHARACTERISTIC K_ED_PT_STATANH.P_CODE_UNPLAUSIBEL "P-Code fuer die Art UNPLAUSIBEL | EN: Fault code PT_STATANH - OBD P-code reported for implausible signal" VALUE 0x71A06 TKW_VV_VV_UW 100.0 FORMULA_0010 0.0 65535.0000 /end CHARACTERISTIC
/begin CHARACTERISTIC K_ED_PT_STATGRB.P_CODE_UNPLAUSIBEL "P-Code fuer die Art UNPLAUSIBEL" VALUE 0x71A88 TKW_VV_VV_UW 100.0 FORMULA_0010 0.0 65535.0000 /end CHARACTERISTIC
/begin CHARACTERISTIC K_ED_PT_ANFRADMOM.P_CODE_UNPLAUSIBEL "P-Code fuer die Art UNPLAUSIBEL | EN: Fault code PT_ANFRADMOM - OBD P-code reported for implausible signal" VALUE 0x71AA2 TKW_VV_VV_UW 100.0 FORMULA_0010 0.0 65535.0000 /end CHARACTERISTIC
/begin CHARACTERISTIC K_ED_PT_TOMA.P_CODE_UNPLAUSIBEL "P-Code fuer die Art UNPLAUSIBEL | EN: Fault code PT_TOMA - OBD P-code reported for implausible signal" VALUE 0x71AF0 TKW_VV_VV_UW 100.0 FORMULA_0010 0.0 65535.0000 /end CHARACTERISTIC
/begin CHARACTERISTIC K_ED_LSHNK1_R.P_CODE_UNPLAUSIBEL "P-Code fuer die Art UNPLAUSIBEL | EN: Fault code LSHNK1_R - OBD P-code reported for implausible signal" VALUE 0x71BF4 TKW_VV_VV_UW 100.0 FORMULA_0010 0.0 65535.0000 /end CHARACTERISTIC
/begin CHARACTERISTIC K_ED_LSHNK2_R.P_CODE_UNPLAUSIBEL "P-Code fuer die Art UNPLAUSIBEL | EN: Fault code LSHNK2_R - OBD P-code reported for implausible signal" VALUE 0x71C0E TKW_VV_VV_UW 100.0 FORMULA_0010 0.0 65535.0000 /end CHARACTERISTIC
/begin CHARACTERISTIC K_ED_PKS_MODELL.P_CODE_UNPLAUSIBEL "P-Code fuer die Art UNPLAUSIBEL | EN: Fault code PKS_MODELL - OBD P-code reported for implausible signal" VALUE 0x71C28 TKW_VV_VV_UW 100.0 FORMULA_0010 0.0 65535.0000 /end CHARACTERISTIC
/begin CHARACTERISTIC K_ED_PKS_PAUFBAU.P_CODE_UNPLAUSIBEL "P-Code fuer die Art UNPLAUSIBEL | EN: Fault code PKS_PAUFBAU - OBD P-code reported for implausible signal" VALUE 0x71C42 TKW_VV_VV_UW 100.0 FORMULA_0010 0.0 65535.0000 /end CHARACTERISTIC
/begin CHARACTERISTIC K_ED_PKS_ADAPT_ANSCHL.P_CODE_UNPLAUSIBEL "P-Code fuer die Art UNPLAUSIBEL | EN: Fault code PKS_ADAPT_ANSCHL - OBD P-code reported for implausible signal" VALUE 0x71C5C TKW_VV_VV_UW 100.0 FORMULA_0010 0.0 65535.0000 /end CHARACTERISTIC
/begin CHARACTERISTIC K_ED_LAVK_ATIC42.P_CODE_UNPLAUSIBEL "P-Code fuer die Art UNPLAUSIBEL | EN: Fault code LAVK_ATIC42 - OBD P-code reported for implausible signal" VALUE 0x71C90 TKW_VV_VV_UW 100.0 FORMULA_0010 0.0 65535.0000 /end CHARACTERISTIC
/begin CHARACTERISTIC K_ED_PT_AX.P_CODE_UNPLAUSIBEL "P-Code fuer die Art UNPLAUSIBEL | EN: Fault code PT_AX - OBD P-code reported for implausible signal" VALUE 0x71CAA TKW_VV_VV_UW 100.0 FORMULA_0010 0.0 65535.0000 /end CHARACTERISTIC
/begin CHARACTERISTIC K_ED_PT_OBD_ED.P_CODE_UNPLAUSIBEL "P-Code fuer die Art UNPLAUSIBEL" VALUE 0x71CC4 TKW_VV_VV_UW 100.0 FORMULA_0010 0.0 65535.0000 /end CHARACTERISTIC
/begin CHARACTERISTIC K_ED_MVAC_OBD.P_CODE_UNPLAUSIBEL "P-Code fuer die Art UNPLAUSIBEL" VALUE 0x71D46 TKW_VV_VV_UW 100.0 FORMULA_0010 0.0 65535.0000 /end CHARACTERISTIC
/begin CHARACTERISTIC K_ED_LAVK2_ATIC42.P_CODE_UNPLAUSIBEL "P-Code fuer die Art UNPLAUSIBEL" VALUE 0x71D7A TKW_VV_VV_UW 100.0 FORMULA_0010 0.0 65535.0000 /end CHARACTERISTIC
/begin CHARACTERISTIC K_ED_PSAU1.FEHLERSCHWELLE "Filterschwelle fuer Fehlereintrag | EN: Fault code PSAU1 - debounce filter threshold for setting the fault" VALUE 0x70946 TKW_VV_VV_UB 100.0 FORMULA_0003 0.0 255.0000 /end CHARACTERISTIC
/begin CHARACTERISTIC K_ED_PSAU2.FEHLERSCHWELLE "Filterschwelle fuer Fehlereintrag | EN: Fault code PSAU2 - debounce filter threshold for setting the fault" VALUE 0x70960 TKW_VV_VV_UB 100.0 FORMULA_0003 0.0 255.0000 /end CHARACTERISTIC
/begin CHARACTERISTIC K_ED_NW1_SYNC.FEHLERSCHWELLE "Filterschwelle fuer Fehlereintrag" VALUE 0x70A4A TKW_VV_VV_UB 100.0 FORMULA_0003 0.0 255.0000 /end CHARACTERISTIC
/begin CHARACTERISTIC K_ED_NW2_SYNC.FEHLERSCHWELLE "Filterschwelle fuer Fehlereintrag" VALUE 0x70A64 TKW_VV_VV_UB 100.0 FORMULA_0003 0.0 255.0000 /end CHARACTERISTIC
/begin CHARACTERISTIC K_ED_PCTRL_INJ.FEHLERSCHWELLE "Filterschwelle fuer Fehlereintrag | EN: Fault code PCTRL_INJ - debounce filter threshold for setting the fault" VALUE 0x70A7E TKW_VV_VV_UB 100.0 FORMULA_0003 0.0 255.0000 /end CHARACTERISTIC
/begin CHARACTERISTIC K_ED_PT_STATDKG.FEHLERSCHWELLE "Filterschwelle fuer Fehlereintrag | EN: Fault code PT_STATDKG - debounce filter threshold for setting the fault" VALUE 0x70A98 TKW_VV_VV_UB 100.0 FORMULA_0003 0.0 255.0000 /end CHARACTERISTIC
/begin CHARACTERISTIC K_ED_PKS.FEHLERSCHWELLE "Filterschwelle fuer Fehlereintrag | EN: Fault code PKS - debounce filter threshold for setting the fault" VALUE 0x70AB2 TKW_VV_VV_UB 100.0 FORMULA_0003 0.0 255.0000 /end CHARACTERISTIC
/begin CHARACTERISTIC K_ED_PT_STATR.FEHLERSCHWELLE "Filterschwelle fuer Fehlereintrag | EN: Fault code PT_STATR - debounce filter threshold for setting the fault" VALUE 0x70ACC TKW_VV_VV_UB 100.0 FORMULA_0003 0.0 255.0000 /end CHARACTERISTIC
/begin CHARACTERISTIC K_ED_LAVK2.FEHLERSCHWELLE "Filterschwelle fuer Fehlereintrag | EN: Fault code LAVK2 - debounce filter threshold for setting the fault" VALUE 0x70B00 TKW_VV_VV_UB 100.0 FORMULA_0003 0.0 255.0000 /end CHARACTERISTIC
/begin CHARACTERISTIC K_ED_LAVK2_OBD_PLAU.FEHLERSCHWELLE "Filterschwelle fuer Fehlereintrag | EN: Fault code LAVK2_OBD_PLAU - debounce filter threshold for setting the fault" VALUE 0x70B34 TKW_VV_VV_UB 100.0 FORMULA_0003 0.0 255.0000 /end CHARACTERISTIC
/begin CHARACTERISTIC K_ED_LAVK2_OBD_SA.FEHLERSCHWELLE "Filterschwelle fuer Fehlereintrag | EN: Fault code LAVK2_OBD_SA - debounce filter threshold for setting the fault" VALUE 0x70B68 TKW_VV_VV_UB 100.0 FORMULA_0003 0.0 255.0000 /end CHARACTERISTIC
/begin CHARACTERISTIC K_ED_LSHNK1.FEHLERSCHWELLE "Filterschwelle fuer Fehlereintrag | EN: Fault code LSHNK1 - debounce filter threshold for setting the fault" VALUE 0x70BB6 TKW_VV_VV_UB 100.0 FORMULA_0003 0.0 255.0000 /end CHARACTERISTIC
/begin CHARACTERISTIC K_ED_LSHNK2.FEHLERSCHWELLE "Filterschwelle fuer Fehlereintrag | EN: Fault code LSHNK2 - debounce filter threshold for setting the fault" VALUE 0x70BD0 TKW_VV_VV_UB 100.0 FORMULA_0003 0.0 255.0000 /end CHARACTERISTIC
/begin CHARACTERISTIC K_ED_PT_BUSOFF.FEHLERSCHWELLE "Filterschwelle fuer Fehlereintrag | EN: Fault code PT_BUSOFF - debounce filter threshold for setting the fault" VALUE 0x70BEA TKW_VV_VV_UB 100.0 FORMULA_0003 0.0 255.0000 /end CHARACTERISTIC
/begin CHARACTERISTIC K_ED_PT_TORQDSC.FEHLERSCHWELLE "Filterschwelle fuer Fehlereintrag | EN: Fault code PT_TORQDSC - debounce filter threshold for setting the fault" VALUE 0x70C04 TKW_VV_VV_UB 100.0 FORMULA_0003 0.0 255.0000 /end CHARACTERISTIC
/begin CHARACTERISTIC K_ED_PT_STDSC.FEHLERSCHWELLE "Filterschwelle fuer Fehlereintrag | EN: Fault code PT_STDSC - debounce filter threshold for setting the fault" VALUE 0x70C1E TKW_VV_VV_UB 100.0 FORMULA_0003 0.0 255.0000 /end CHARACTERISTIC
/begin CHARACTERISTIC K_ED_PT_ATEMP.FEHLERSCHWELLE "Filterschwelle fuer Fehlereintrag | EN: Fault code PT_ATEMP - debounce filter threshold for setting the fault" VALUE 0x70C6C TKW_VV_VV_UB 100.0 FORMULA_0003 0.0 255.0000 /end CHARACTERISTIC
/begin CHARACTERISTIC K_ED_PT_KLST.FEHLERSCHWELLE "Filterschwelle fuer Fehlereintrag | EN: Fault code PT_KLST - debounce filter threshold for setting the fault" VALUE 0x70C86 TKW_VV_VV_UB 100.0 FORMULA_0003 0.0 255.0000 /end CHARACTERISTIC
/begin CHARACTERISTIC K_ED_PT_KKOS.FEHLERSCHWELLE "Filterschwelle fuer Fehlereintrag | EN: Fault code PT_KKOS - debounce filter threshold for setting the fault" VALUE 0x70CA0 TKW_VV_VV_UB 100.0 FORMULA_0003 0.0 255.0000 /end CHARACTERISTIC
/begin CHARACTERISTIC K_ED_PT_LRW.FEHLERSCHWELLE "Filterschwelle fuer Fehlereintrag | EN: Fault code PT_LRW - debounce filter threshold for setting the fault" VALUE 0x70CBA TKW_VV_VV_UB 100.0 FORMULA_0003 0.0 255.0000 /end CHARACTERISTIC
/begin CHARACTERISTIC K_ED_LAVK2_OBD_TL.FEHLERSCHWELLE "Filterschwelle fuer Fehlereintrag | EN: Fault code LAVK2_OBD_TL - debounce filter threshold for setting the fault" VALUE 0x70D70 TKW_VV_VV_UB 100.0 FORMULA_0003 0.0 255.0000 /end CHARACTERISTIC
/begin CHARACTERISTIC K_ED_LSHVK1.FEHLERSCHWELLE "Filterschwelle fuer Fehlereintrag | EN: Fault code LSHVK1 - debounce filter threshold for setting the fault" VALUE 0x70D8A TKW_VV_VV_UB 100.0 FORMULA_0003 0.0 255.0000 /end CHARACTERISTIC
/begin CHARACTERISTIC K_ED_LSHVK2.FEHLERSCHWELLE "Filterschwelle fuer Fehlereintrag | EN: Fault code LSHVK2 - debounce filter threshold for setting the fault" VALUE 0x70DA4 TKW_VV_VV_UB 100.0 FORMULA_0003 0.0 255.0000 /end CHARACTERISTIC
/begin CHARACTERISTIC K_ED_LSRVK1_OBD_REG.FEHLERSCHWELLE "Filterschwelle fuer Fehlereintrag | EN: Fault code LSRVK1_OBD_REG - debounce filter threshold for setting the fault" VALUE 0x70DBE TKW_VV_VV_UB 100.0 FORMULA_0003 0.0 255.0000 /end CHARACTERISTIC
/begin CHARACTERISTIC K_ED_LSRVK2_OBD_REG.FEHLERSCHWELLE "Filterschwelle fuer Fehlereintrag | EN: Fault code LSRVK2_OBD_REG - debounce filter threshold for setting the fault" VALUE 0x70DD8 TKW_VV_VV_UB 100.0 FORMULA_0003 0.0 255.0000 /end CHARACTERISTIC
/begin CHARACTERISTIC K_ED_LSHVK1_R.FEHLERSCHWELLE "Filterschwelle fuer Fehlereintrag | EN: Fault code LSHVK1_R - debounce filter threshold for setting the fault" VALUE 0x70DF2 TKW_VV_VV_UB 100.0 FORMULA_0003 0.0 255.0000 /end CHARACTERISTIC
/begin CHARACTERISTIC K_ED_LSHVK2_R.FEHLERSCHWELLE "Filterschwelle fuer Fehlereintrag | EN: Fault code LSHVK2_R - debounce filter threshold for setting the fault" VALUE 0x70E0C TKW_VV_VV_UB 100.0 FORMULA_0003 0.0 255.0000 /end CHARACTERISTIC
/begin CHARACTERISTIC K_ED_LSRVK1_OBD_START.FEHLERSCHWELLE "Filterschwelle fuer Fehlereintrag | EN: Fault code LSRVK1_OBD_START - debounce filter threshold for setting the fault" VALUE 0x70E26 TKW_VV_VV_UB 100.0 FORMULA_0003 0.0 255.0000 /end CHARACTERISTIC
/begin CHARACTERISTIC K_ED_LSRVK2_OBD_START.FEHLERSCHWELLE "Filterschwelle fuer Fehlereintrag | EN: Fault code LSRVK2_OBD_START - debounce filter threshold for setting the fault" VALUE 0x70E40 TKW_VV_VV_UB 100.0 FORMULA_0003 0.0 255.0000 /end CHARACTERISTIC
/begin CHARACTERISTIC K_ED_LSRVK1_OBD_REF.FEHLERSCHWELLE "Filterschwelle fuer Fehlereintrag | EN: Fault code LSRVK1_OBD_REF - debounce filter threshold for setting the fault" VALUE 0x70E5A TKW_VV_VV_UB 100.0 FORMULA_0003 0.0 255.0000 /end CHARACTERISTIC
/begin CHARACTERISTIC K_ED_LSRVK2_OBD_REF.FEHLERSCHWELLE "Filterschwelle fuer Fehlereintrag | EN: Fault code LSRVK2_OBD_REF - debounce filter threshold for setting the fault" VALUE 0x70E74 TKW_VV_VV_UB 100.0 FORMULA_0003 0.0 255.0000 /end CHARACTERISTIC
/begin CHARACTERISTIC K_ED_LAVK2_DIAG.FEHLERSCHWELLE "Filterschwelle fuer Fehlereintrag | EN: Fault code LAVK2_DIAG - debounce filter threshold for setting the fault" VALUE 0x70EA8 TKW_VV_VV_UB 100.0 FORMULA_0003 0.0 255.0000 /end CHARACTERISTIC
/begin CHARACTERISTIC K_ED_LAVK2_IA_OPENLOAD.FEHLERSCHWELLE "Filterschwelle fuer Fehlereintrag | EN: Fault code LAVK2_IA_OPENLOAD - debounce filter threshold for setting the fault" VALUE 0x70EDC TKW_VV_VV_UB 100.0 FORMULA_0003 0.0 255.0000 /end CHARACTERISTIC
/begin CHARACTERISTIC K_ED_PT_GRB.FEHLERSCHWELLE "Filterschwelle fuer Fehlereintrag | EN: Fault code PT_GRB - debounce filter threshold for setting the fault" VALUE 0x70EF6 TKW_VV_VV_UB 100.0 FORMULA_0003 0.0 255.0000 /end CHARACTERISTIC
/begin CHARACTERISTIC K_ED_PT_GRB2.FEHLERSCHWELLE "Filterschwelle fuer Fehlereintrag | EN: Fault code PT_GRB2 - debounce filter threshold for setting the fault" VALUE 0x70F10 TKW_VV_VV_UB 100.0 FORMULA_0003 0.0 255.0000 /end CHARACTERISTIC
/begin CHARACTERISTIC K_ED_LAVK2_UN_OPENLOAD.FEHLERSCHWELLE "Filterschwelle fuer Fehlereintrag | EN: Fault code LAVK2_UN_OPENLOAD - debounce filter threshold for setting the fault" VALUE 0x70F44 TKW_VV_VV_UB 100.0 FORMULA_0003 0.0 255.0000 /end CHARACTERISTIC
/begin CHARACTERISTIC K_ED_LAVK2_IP_OPENLOAD.FEHLERSCHWELLE "Filterschwelle fuer Fehlereintrag | EN: Fault code LAVK2_IP_OPENLOAD - debounce filter threshold for setting the fault" VALUE 0x70F78 TKW_VV_VV_UB 100.0 FORMULA_0003 0.0 255.0000 /end CHARACTERISTIC
/begin CHARACTERISTIC K_ED_LAVK2_OBD_DYN.FEHLERSCHWELLE "Filterschwelle fuer Fehlereintrag | EN: Fault code LAVK2_OBD_DYN - debounce filter threshold for setting the fault" VALUE 0x712D2 TKW_VV_VV_UB 100.0 FORMULA_0003 0.0 255.0000 /end CHARACTERISTIC
/begin CHARACTERISTIC K_ED_PT_CRASH.FEHLERSCHWELLE "Filterschwelle fuer Fehlereintrag | EN: Fault code PT_CRASH - debounce filter threshold for setting the fault" VALUE 0x712EC TKW_VV_VV_UB 100.0 FORMULA_0003 0.0 255.0000 /end CHARACTERISTIC
/begin CHARACTERISTIC K_ED_PT_VEHMOD.FEHLERSCHWELLE "Filterschwelle fuer Fehlereintrag | EN: Fault code PT_VEHMOD - debounce filter threshold for setting the fault" VALUE 0x71306 TKW_VV_VV_UB 100.0 FORMULA_0003 0.0 255.0000 /end CHARACTERISTIC
/begin CHARACTERISTIC K_ED_PT_BEDFGR.FEHLERSCHWELLE "Filterschwelle fuer Fehlereintrag | EN: Fault code PT_BEDFGR - debounce filter threshold for setting the fault" VALUE 0x71320 TKW_VV_VV_UB 100.0 FORMULA_0003 0.0 255.0000 /end CHARACTERISTIC
/begin CHARACTERISTIC K_ED_LAVK2_TRIM.FEHLERSCHWELLE "Filterschwelle fuer Fehlereintrag | EN: Fault code LAVK2_TRIM - debounce filter threshold for setting the fault" VALUE 0x713F0 TKW_VV_VV_UB 100.0 FORMULA_0003 0.0 255.0000 /end CHARACTERISTIC
/begin CHARACTERISTIC K_ED_PT_KM.FEHLERSCHWELLE "Filterschwelle fuer Fehlereintrag | EN: Fault code PT_KM - debounce filter threshold for setting the fault" VALUE 0x714A6 TKW_VV_VV_UB 100.0 FORMULA_0003 0.0 255.0000 /end CHARACTERISTIC
/begin CHARACTERISTIC K_ED_PT_KOMBI.FEHLERSCHWELLE "Filterschwelle fuer Fehlereintrag | EN: Fault code PT_KOMBI - debounce filter threshold for setting the fault" VALUE 0x714C0 TKW_VV_VV_UB 100.0 FORMULA_0003 0.0 255.0000 /end CHARACTERISTIC
/begin CHARACTERISTIC K_ED_PKS_LL.FEHLERSCHWELLE "Filterschwelle fuer Fehlereintrag | EN: Fault code PKS_LL - debounce filter threshold for setting the fault" VALUE 0x714DA TKW_VV_VV_UB 100.0 FORMULA_0003 0.0 255.0000 /end CHARACTERISTIC
/begin CHARACTERISTIC K_ED_PKS_TL.FEHLERSCHWELLE "Filterschwelle fuer Fehlereintrag | EN: Fault code PKS_TL - debounce filter threshold for setting the fault" VALUE 0x714F4 TKW_VV_VV_UB 100.0 FORMULA_0003 0.0 255.0000 /end CHARACTERISTIC
/begin CHARACTERISTIC K_ED_PKS_Q.FEHLERSCHWELLE "Filterschwelle fuer Fehlereintrag | EN: Fault code PKS_Q - debounce filter threshold for setting the fault" VALUE 0x7150E TKW_VV_VV_UB 100.0 FORMULA_0003 0.0 255.0000 /end CHARACTERISTIC
/begin CHARACTERISTIC K_ED_MVAC_DRUCKSENSOR.FEHLERSCHWELLE "Filterschwelle fuer Fehlereintrag | EN: Fault code MVAC_DRUCKSENSOR - debounce filter threshold for setting the fault" VALUE 0x71646 TKW_VV_VV_UB 100.0 FORMULA_0003 0.0 255.0000 /end CHARACTERISTIC
/begin CHARACTERISTIC K_ED_PT_BEDAT.FEHLERSCHWELLE "Filterschwelle fuer Fehlereintrag | EN: Fault code PT_BEDAT - debounce filter threshold for setting the fault" VALUE 0x71660 TKW_VV_VV_UB 100.0 FORMULA_0003 0.0 255.0000 /end CHARACTERISTIC
/begin CHARACTERISTIC K_ED_PT_STATANH.FEHLERSCHWELLE "Filterschwelle fuer Fehlereintrag | EN: Fault code PT_STATANH - debounce filter threshold for setting the fault" VALUE 0x71A08 TKW_VV_VV_UB 100.0 FORMULA_0003 0.0 255.0000 /end CHARACTERISTIC
/begin CHARACTERISTIC K_ED_PT_STATGRB.FEHLERSCHWELLE "Filterschwelle fuer Fehlereintrag" VALUE 0x71A8A TKW_VV_VV_UB 100.0 FORMULA_0003 0.0 255.0000 /end CHARACTERISTIC
/begin CHARACTERISTIC K_ED_PT_ANFRADMOM.FEHLERSCHWELLE "Filterschwelle fuer Fehlereintrag | EN: Fault code PT_ANFRADMOM - debounce filter threshold for setting the fault" VALUE 0x71AA4 TKW_VV_VV_UB 100.0 FORMULA_0003 0.0 255.0000 /end CHARACTERISTIC
/begin CHARACTERISTIC K_ED_PT_TOMA.FEHLERSCHWELLE "Filterschwelle fuer Fehlereintrag | EN: Fault code PT_TOMA - debounce filter threshold for setting the fault" VALUE 0x71AF2 TKW_VV_VV_UB 100.0 FORMULA_0003 0.0 255.0000 /end CHARACTERISTIC
/begin CHARACTERISTIC K_ED_LSHNK1_R.FEHLERSCHWELLE "Filterschwelle fuer Fehlereintrag | EN: Fault code LSHNK1_R - debounce filter threshold for setting the fault" VALUE 0x71BF6 TKW_VV_VV_UB 100.0 FORMULA_0003 0.0 255.0000 /end CHARACTERISTIC
/begin CHARACTERISTIC K_ED_LSHNK2_R.FEHLERSCHWELLE "Filterschwelle fuer Fehlereintrag | EN: Fault code LSHNK2_R - debounce filter threshold for setting the fault" VALUE 0x71C10 TKW_VV_VV_UB 100.0 FORMULA_0003 0.0 255.0000 /end CHARACTERISTIC
/begin CHARACTERISTIC K_ED_PKS_MODELL.FEHLERSCHWELLE "Filterschwelle fuer Fehlereintrag | EN: Fault code PKS_MODELL - debounce filter threshold for setting the fault" VALUE 0x71C2A TKW_VV_VV_UB 100.0 FORMULA_0003 0.0 255.0000 /end CHARACTERISTIC
/begin CHARACTERISTIC K_ED_PKS_PAUFBAU.FEHLERSCHWELLE "Filterschwelle fuer Fehlereintrag | EN: Fault code PKS_PAUFBAU - debounce filter threshold for setting the fault" VALUE 0x71C44 TKW_VV_VV_UB 100.0 FORMULA_0003 0.0 255.0000 /end CHARACTERISTIC
/begin CHARACTERISTIC K_ED_PKS_ADAPT_ANSCHL.FEHLERSCHWELLE "Filterschwelle fuer Fehlereintrag | EN: Fault code PKS_ADAPT_ANSCHL - debounce filter threshold for setting the fault" VALUE 0x71C5E TKW_VV_VV_UB 100.0 FORMULA_0003 0.0 255.0000 /end CHARACTERISTIC
/begin CHARACTERISTIC K_ED_LAVK_ATIC42.FEHLERSCHWELLE "Filterschwelle fuer Fehlereintrag | EN: Fault code LAVK_ATIC42 - debounce filter threshold for setting the fault" VALUE 0x71C92 TKW_VV_VV_UB 100.0 FORMULA_0003 0.0 255.0000 /end CHARACTERISTIC
/begin CHARACTERISTIC K_ED_PT_AX.FEHLERSCHWELLE "Filterschwelle fuer Fehlereintrag | EN: Fault code PT_AX - debounce filter threshold for setting the fault" VALUE 0x71CAC TKW_VV_VV_UB 100.0 FORMULA_0003 0.0 255.0000 /end CHARACTERISTIC
/begin CHARACTERISTIC K_ED_PT_OBD_ED.FEHLERSCHWELLE "Filterschwelle fuer Fehlereintrag" VALUE 0x71CC6 TKW_VV_VV_UB 100.0 FORMULA_0003 0.0 255.0000 /end CHARACTERISTIC
/begin CHARACTERISTIC K_ED_MVAC_OBD.FEHLERSCHWELLE "Filterschwelle fuer Fehlereintrag" VALUE 0x71D48 TKW_VV_VV_UB 100.0 FORMULA_0003 0.0 255.0000 /end CHARACTERISTIC
/begin CHARACTERISTIC K_ED_LAVK2_ATIC42.FEHLERSCHWELLE "Filterschwelle fuer Fehlereintrag" VALUE 0x71D7C TKW_VV_VV_UB 100.0 FORMULA_0003 0.0 255.0000 /end CHARACTERISTIC
/begin CHARACTERISTIC K_ED_PSAU1.OK_SCHWELLE "Filterschwelle fuer Fehleraustrag | EN: Fault code PSAU1 - debounce filter threshold for clearing (healing) the fault" VALUE 0x70947 TKW_VV_VV_UB 100.0 FORMULA_0003 0.0 255.0000 /end CHARACTERISTIC
/begin CHARACTERISTIC K_ED_PSAU2.OK_SCHWELLE "Filterschwelle fuer Fehleraustrag | EN: Fault code PSAU2 - debounce filter threshold for clearing (healing) the fault" VALUE 0x70961 TKW_VV_VV_UB 100.0 FORMULA_0003 0.0 255.0000 /end CHARACTERISTIC
/begin CHARACTERISTIC K_ED_NW1_SYNC.OK_SCHWELLE "Filterschwelle fuer Fehleraustrag" VALUE 0x70A4B TKW_VV_VV_UB 100.0 FORMULA_0003 0.0 255.0000 /end CHARACTERISTIC
/begin CHARACTERISTIC K_ED_NW2_SYNC.OK_SCHWELLE "Filterschwelle fuer Fehleraustrag" VALUE 0x70A65 TKW_VV_VV_UB 100.0 FORMULA_0003 0.0 255.0000 /end CHARACTERISTIC
/begin CHARACTERISTIC K_ED_PCTRL_INJ.OK_SCHWELLE "Filterschwelle fuer Fehleraustrag | EN: Fault code PCTRL_INJ - debounce filter threshold for clearing (healing) the fault" VALUE 0x70A7F TKW_VV_VV_UB 100.0 FORMULA_0003 0.0 255.0000 /end CHARACTERISTIC
/begin CHARACTERISTIC K_ED_PT_STATDKG.OK_SCHWELLE "Filterschwelle fuer Fehleraustrag | EN: Fault code PT_STATDKG - debounce filter threshold for clearing (healing) the fault" VALUE 0x70A99 TKW_VV_VV_UB 100.0 FORMULA_0003 0.0 255.0000 /end CHARACTERISTIC
/begin CHARACTERISTIC K_ED_PKS.OK_SCHWELLE "Filterschwelle fuer Fehleraustrag | EN: Fault code PKS - debounce filter threshold for clearing (healing) the fault" VALUE 0x70AB3 TKW_VV_VV_UB 100.0 FORMULA_0003 0.0 255.0000 /end CHARACTERISTIC
/begin CHARACTERISTIC K_ED_PT_STATR.OK_SCHWELLE "Filterschwelle fuer Fehleraustrag | EN: Fault code PT_STATR - debounce filter threshold for clearing (healing) the fault" VALUE 0x70ACD TKW_VV_VV_UB 100.0 FORMULA_0003 0.0 255.0000 /end CHARACTERISTIC
/begin CHARACTERISTIC K_ED_LAVK2.OK_SCHWELLE "Filterschwelle fuer Fehleraustrag | EN: Fault code LAVK2 - debounce filter threshold for clearing (healing) the fault" VALUE 0x70B01 TKW_VV_VV_UB 100.0 FORMULA_0003 0.0 255.0000 /end CHARACTERISTIC
/begin CHARACTERISTIC K_ED_LAVK2_OBD_PLAU.OK_SCHWELLE "Filterschwelle fuer Fehleraustrag | EN: Fault code LAVK2_OBD_PLAU - debounce filter threshold for clearing (healing) the fault" VALUE 0x70B35 TKW_VV_VV_UB 100.0 FORMULA_0003 0.0 255.0000 /end CHARACTERISTIC
/begin CHARACTERISTIC K_ED_LAVK2_OBD_SA.OK_SCHWELLE "Filterschwelle fuer Fehleraustrag | EN: Fault code LAVK2_OBD_SA - debounce filter threshold for clearing (healing) the fault" VALUE 0x70B69 TKW_VV_VV_UB 100.0 FORMULA_0003 0.0 255.0000 /end CHARACTERISTIC
/begin CHARACTERISTIC K_ED_LSHNK1.OK_SCHWELLE "Filterschwelle fuer Fehleraustrag | EN: Fault code LSHNK1 - debounce filter threshold for clearing (healing) the fault" VALUE 0x70BB7 TKW_VV_VV_UB 100.0 FORMULA_0003 0.0 255.0000 /end CHARACTERISTIC
/begin CHARACTERISTIC K_ED_LSHNK2.OK_SCHWELLE "Filterschwelle fuer Fehleraustrag | EN: Fault code LSHNK2 - debounce filter threshold for clearing (healing) the fault" VALUE 0x70BD1 TKW_VV_VV_UB 100.0 FORMULA_0003 0.0 255.0000 /end CHARACTERISTIC
/begin CHARACTERISTIC K_ED_PT_BUSOFF.OK_SCHWELLE "Filterschwelle fuer Fehleraustrag | EN: Fault code PT_BUSOFF - debounce filter threshold for clearing (healing) the fault" VALUE 0x70BEB TKW_VV_VV_UB 100.0 FORMULA_0003 0.0 255.0000 /end CHARACTERISTIC
/begin CHARACTERISTIC K_ED_PT_TORQDSC.OK_SCHWELLE "Filterschwelle fuer Fehleraustrag | EN: Fault code PT_TORQDSC - debounce filter threshold for clearing (healing) the fault" VALUE 0x70C05 TKW_VV_VV_UB 100.0 FORMULA_0003 0.0 255.0000 /end CHARACTERISTIC
/begin CHARACTERISTIC K_ED_PT_STDSC.OK_SCHWELLE "Filterschwelle fuer Fehleraustrag | EN: Fault code PT_STDSC - debounce filter threshold for clearing (healing) the fault" VALUE 0x70C1F TKW_VV_VV_UB 100.0 FORMULA_0003 0.0 255.0000 /end CHARACTERISTIC
/begin CHARACTERISTIC K_ED_PT_ATEMP.OK_SCHWELLE "Filterschwelle fuer Fehleraustrag | EN: Fault code PT_ATEMP - debounce filter threshold for clearing (healing) the fault" VALUE 0x70C6D TKW_VV_VV_UB 100.0 FORMULA_0003 0.0 255.0000 /end CHARACTERISTIC
/begin CHARACTERISTIC K_ED_PT_KLST.OK_SCHWELLE "Filterschwelle fuer Fehleraustrag | EN: Fault code PT_KLST - debounce filter threshold for clearing (healing) the fault" VALUE 0x70C87 TKW_VV_VV_UB 100.0 FORMULA_0003 0.0 255.0000 /end CHARACTERISTIC
/begin CHARACTERISTIC K_ED_PT_KKOS.OK_SCHWELLE "Filterschwelle fuer Fehleraustrag | EN: Fault code PT_KKOS - debounce filter threshold for clearing (healing) the fault" VALUE 0x70CA1 TKW_VV_VV_UB 100.0 FORMULA_0003 0.0 255.0000 /end CHARACTERISTIC
/begin CHARACTERISTIC K_ED_PT_LRW.OK_SCHWELLE "Filterschwelle fuer Fehleraustrag | EN: Fault code PT_LRW - debounce filter threshold for clearing (healing) the fault" VALUE 0x70CBB TKW_VV_VV_UB 100.0 FORMULA_0003 0.0 255.0000 /end CHARACTERISTIC
/begin CHARACTERISTIC K_ED_LAVK2_OBD_TL.OK_SCHWELLE "Filterschwelle fuer Fehleraustrag | EN: Fault code LAVK2_OBD_TL - debounce filter threshold for clearing (healing) the fault" VALUE 0x70D71 TKW_VV_VV_UB 100.0 FORMULA_0003 0.0 255.0000 /end CHARACTERISTIC
/begin CHARACTERISTIC K_ED_LSHVK1.OK_SCHWELLE "Filterschwelle fuer Fehleraustrag | EN: Fault code LSHVK1 - debounce filter threshold for clearing (healing) the fault" VALUE 0x70D8B TKW_VV_VV_UB 100.0 FORMULA_0003 0.0 255.0000 /end CHARACTERISTIC
/begin CHARACTERISTIC K_ED_LSHVK2.OK_SCHWELLE "Filterschwelle fuer Fehleraustrag | EN: Fault code LSHVK2 - debounce filter threshold for clearing (healing) the fault" VALUE 0x70DA5 TKW_VV_VV_UB 100.0 FORMULA_0003 0.0 255.0000 /end CHARACTERISTIC
/begin CHARACTERISTIC K_ED_LSRVK1_OBD_REG.OK_SCHWELLE "Filterschwelle fuer Fehleraustrag | EN: Fault code LSRVK1_OBD_REG - debounce filter threshold for clearing (healing) the fault" VALUE 0x70DBF TKW_VV_VV_UB 100.0 FORMULA_0003 0.0 255.0000 /end CHARACTERISTIC
/begin CHARACTERISTIC K_ED_LSRVK2_OBD_REG.OK_SCHWELLE "Filterschwelle fuer Fehleraustrag | EN: Fault code LSRVK2_OBD_REG - debounce filter threshold for clearing (healing) the fault" VALUE 0x70DD9 TKW_VV_VV_UB 100.0 FORMULA_0003 0.0 255.0000 /end CHARACTERISTIC
/begin CHARACTERISTIC K_ED_LSHVK1_R.OK_SCHWELLE "Filterschwelle fuer Fehleraustrag | EN: Fault code LSHVK1_R - debounce filter threshold for clearing (healing) the fault" VALUE 0x70DF3 TKW_VV_VV_UB 100.0 FORMULA_0003 0.0 255.0000 /end CHARACTERISTIC
/begin CHARACTERISTIC K_ED_LSHVK2_R.OK_SCHWELLE "Filterschwelle fuer Fehleraustrag | EN: Fault code LSHVK2_R - debounce filter threshold for clearing (healing) the fault" VALUE 0x70E0D TKW_VV_VV_UB 100.0 FORMULA_0003 0.0 255.0000 /end CHARACTERISTIC
/begin CHARACTERISTIC K_ED_LSRVK1_OBD_START.OK_SCHWELLE "Filterschwelle fuer Fehleraustrag | EN: Fault code LSRVK1_OBD_START - debounce filter threshold for clearing (healing) the fault" VALUE 0x70E27 TKW_VV_VV_UB 100.0 FORMULA_0003 0.0 255.0000 /end CHARACTERISTIC
/begin CHARACTERISTIC K_ED_LSRVK2_OBD_START.OK_SCHWELLE "Filterschwelle fuer Fehleraustrag | EN: Fault code LSRVK2_OBD_START - debounce filter threshold for clearing (healing) the fault" VALUE 0x70E41 TKW_VV_VV_UB 100.0 FORMULA_0003 0.0 255.0000 /end CHARACTERISTIC
/begin CHARACTERISTIC K_ED_LSRVK1_OBD_REF.OK_SCHWELLE "Filterschwelle fuer Fehleraustrag | EN: Fault code LSRVK1_OBD_REF - debounce filter threshold for clearing (healing) the fault" VALUE 0x70E5B TKW_VV_VV_UB 100.0 FORMULA_0003 0.0 255.0000 /end CHARACTERISTIC
/begin CHARACTERISTIC K_ED_LSRVK2_OBD_REF.OK_SCHWELLE "Filterschwelle fuer Fehleraustrag | EN: Fault code LSRVK2_OBD_REF - debounce filter threshold for clearing (healing) the fault" VALUE 0x70E75 TKW_VV_VV_UB 100.0 FORMULA_0003 0.0 255.0000 /end CHARACTERISTIC
/begin CHARACTERISTIC K_ED_LAVK2_DIAG.OK_SCHWELLE "Filterschwelle fuer Fehleraustrag | EN: Fault code LAVK2_DIAG - debounce filter threshold for clearing (healing) the fault" VALUE 0x70EA9 TKW_VV_VV_UB 100.0 FORMULA_0003 0.0 255.0000 /end CHARACTERISTIC
/begin CHARACTERISTIC K_ED_LAVK2_IA_OPENLOAD.OK_SCHWELLE "Filterschwelle fuer Fehleraustrag | EN: Fault code LAVK2_IA_OPENLOAD - debounce filter threshold for clearing (healing) the fault" VALUE 0x70EDD TKW_VV_VV_UB 100.0 FORMULA_0003 0.0 255.0000 /end CHARACTERISTIC
/begin CHARACTERISTIC K_ED_PT_GRB.OK_SCHWELLE "Filterschwelle fuer Fehleraustrag | EN: Fault code PT_GRB - debounce filter threshold for clearing (healing) the fault" VALUE 0x70EF7 TKW_VV_VV_UB 100.0 FORMULA_0003 0.0 255.0000 /end CHARACTERISTIC
/begin CHARACTERISTIC K_ED_PT_GRB2.OK_SCHWELLE "Filterschwelle fuer Fehleraustrag | EN: Fault code PT_GRB2 - debounce filter threshold for clearing (healing) the fault" VALUE 0x70F11 TKW_VV_VV_UB 100.0 FORMULA_0003 0.0 255.0000 /end CHARACTERISTIC
/begin CHARACTERISTIC K_ED_LAVK1_UN_OPENLOAD.OK_SCHWELLE "Filterschwelle fuer Fehleraustrag | EN: Fault code LAVK1_UN_OPENLOAD - debounce filter threshold for clearing (healing) the fault" VALUE 0x70F2B TKW_VV_VV_UB 100.0 FORMULA_0003 0.0 255.0000 /end CHARACTERISTIC
/begin CHARACTERISTIC K_ED_LAVK2_UN_OPENLOAD.OK_SCHWELLE "Filterschwelle fuer Fehleraustrag | EN: Fault code LAVK2_UN_OPENLOAD - debounce filter threshold for clearing (healing) the fault" VALUE 0x70F45 TKW_VV_VV_UB 100.0 FORMULA_0003 0.0 255.0000 /end CHARACTERISTIC
/begin CHARACTERISTIC K_ED_LAVK2_IP_OPENLOAD.OK_SCHWELLE "Filterschwelle fuer Fehleraustrag | EN: Fault code LAVK2_IP_OPENLOAD - debounce filter threshold for clearing (healing) the fault" VALUE 0x70F79 TKW_VV_VV_UB 100.0 FORMULA_0003 0.0 255.0000 /end CHARACTERISTIC
/begin CHARACTERISTIC K_ED_LAVK2_OBD_DYN.OK_SCHWELLE "Filterschwelle fuer Fehleraustrag | EN: Fault code LAVK2_OBD_DYN - debounce filter threshold for clearing (healing) the fault" VALUE 0x712D3 TKW_VV_VV_UB 100.0 FORMULA_0003 0.0 255.0000 /end CHARACTERISTIC
/begin CHARACTERISTIC K_ED_PT_CRASH.OK_SCHWELLE "Filterschwelle fuer Fehleraustrag | EN: Fault code PT_CRASH - debounce filter threshold for clearing (healing) the fault" VALUE 0x712ED TKW_VV_VV_UB 100.0 FORMULA_0003 0.0 255.0000 /end CHARACTERISTIC
/begin CHARACTERISTIC K_ED_PT_VEHMOD.OK_SCHWELLE "Filterschwelle fuer Fehleraustrag | EN: Fault code PT_VEHMOD - debounce filter threshold for clearing (healing) the fault" VALUE 0x71307 TKW_VV_VV_UB 100.0 FORMULA_0003 0.0 255.0000 /end CHARACTERISTIC
/begin CHARACTERISTIC K_ED_PT_BEDFGR.OK_SCHWELLE "Filterschwelle fuer Fehleraustrag | EN: Fault code PT_BEDFGR - debounce filter threshold for clearing (healing) the fault" VALUE 0x71321 TKW_VV_VV_UB 100.0 FORMULA_0003 0.0 255.0000 /end CHARACTERISTIC
/begin CHARACTERISTIC K_ED_LAVK2_TRIM.OK_SCHWELLE "Filterschwelle fuer Fehleraustrag | EN: Fault code LAVK2_TRIM - debounce filter threshold for clearing (healing) the fault" VALUE 0x713F1 TKW_VV_VV_UB 100.0 FORMULA_0003 0.0 255.0000 /end CHARACTERISTIC
/begin CHARACTERISTIC K_ED_PT_KM.OK_SCHWELLE "Filterschwelle fuer Fehleraustrag | EN: Fault code PT_KM - debounce filter threshold for clearing (healing) the fault" VALUE 0x714A7 TKW_VV_VV_UB 100.0 FORMULA_0003 0.0 255.0000 /end CHARACTERISTIC
/begin CHARACTERISTIC K_ED_PT_KOMBI.OK_SCHWELLE "Filterschwelle fuer Fehleraustrag | EN: Fault code PT_KOMBI - debounce filter threshold for clearing (healing) the fault" VALUE 0x714C1 TKW_VV_VV_UB 100.0 FORMULA_0003 0.0 255.0000 /end CHARACTERISTIC
/begin CHARACTERISTIC K_ED_PKS_LL.OK_SCHWELLE "Filterschwelle fuer Fehleraustrag | EN: Fault code PKS_LL - debounce filter threshold for clearing (healing) the fault" VALUE 0x714DB TKW_VV_VV_UB 100.0 FORMULA_0003 0.0 255.0000 /end CHARACTERISTIC
/begin CHARACTERISTIC K_ED_PKS_TL.OK_SCHWELLE "Filterschwelle fuer Fehleraustrag | EN: Fault code PKS_TL - debounce filter threshold for clearing (healing) the fault" VALUE 0x714F5 TKW_VV_VV_UB 100.0 FORMULA_0003 0.0 255.0000 /end CHARACTERISTIC
/begin CHARACTERISTIC K_ED_PKS_Q.OK_SCHWELLE "Filterschwelle fuer Fehleraustrag | EN: Fault code PKS_Q - debounce filter threshold for clearing (healing) the fault" VALUE 0x7150F TKW_VV_VV_UB 100.0 FORMULA_0003 0.0 255.0000 /end CHARACTERISTIC
/begin CHARACTERISTIC K_ED_MVAC_DRUCKSENSOR.OK_SCHWELLE "Filterschwelle fuer Fehleraustrag | EN: Fault code MVAC_DRUCKSENSOR - debounce filter threshold for clearing (healing) the fault" VALUE 0x71647 TKW_VV_VV_UB 100.0 FORMULA_0003 0.0 255.0000 /end CHARACTERISTIC
/begin CHARACTERISTIC K_ED_PT_BEDAT.OK_SCHWELLE "Filterschwelle fuer Fehleraustrag | EN: Fault code PT_BEDAT - debounce filter threshold for clearing (healing) the fault" VALUE 0x71661 TKW_VV_VV_UB 100.0 FORMULA_0003 0.0 255.0000 /end CHARACTERISTIC
/begin CHARACTERISTIC K_ED_PT_STATANH.OK_SCHWELLE "Filterschwelle fuer Fehleraustrag | EN: Fault code PT_STATANH - debounce filter threshold for clearing (healing) the fault" VALUE 0x71A09 TKW_VV_VV_UB 100.0 FORMULA_0003 0.0 255.0000 /end CHARACTERISTIC
/begin CHARACTERISTIC K_ED_PT_STATGRB.OK_SCHWELLE "Filterschwelle fuer Fehleraustrag" VALUE 0x71A8B TKW_VV_VV_UB 100.0 FORMULA_0003 0.0 255.0000 /end CHARACTERISTIC
/begin CHARACTERISTIC K_ED_PT_ANFRADMOM.OK_SCHWELLE "Filterschwelle fuer Fehleraustrag | EN: Fault code PT_ANFRADMOM - debounce filter threshold for clearing (healing) the fault" VALUE 0x71AA5 TKW_VV_VV_UB 100.0 FORMULA_0003 0.0 255.0000 /end CHARACTERISTIC
/begin CHARACTERISTIC K_ED_PT_TOMA.OK_SCHWELLE "Filterschwelle fuer Fehleraustrag | EN: Fault code PT_TOMA - debounce filter threshold for clearing (healing) the fault" VALUE 0x71AF3 TKW_VV_VV_UB 100.0 FORMULA_0003 0.0 255.0000 /end CHARACTERISTIC
/begin CHARACTERISTIC K_ED_LSHNK1_R.OK_SCHWELLE "Filterschwelle fuer Fehleraustrag | EN: Fault code LSHNK1_R - debounce filter threshold for clearing (healing) the fault" VALUE 0x71BF7 TKW_VV_VV_UB 100.0 FORMULA_0003 0.0 255.0000 /end CHARACTERISTIC
/begin CHARACTERISTIC K_ED_LSHNK2_R.OK_SCHWELLE "Filterschwelle fuer Fehleraustrag | EN: Fault code LSHNK2_R - debounce filter threshold for clearing (healing) the fault" VALUE 0x71C11 TKW_VV_VV_UB 100.0 FORMULA_0003 0.0 255.0000 /end CHARACTERISTIC
/begin CHARACTERISTIC K_ED_PKS_MODELL.OK_SCHWELLE "Filterschwelle fuer Fehleraustrag | EN: Fault code PKS_MODELL - debounce filter threshold for clearing (healing) the fault" VALUE 0x71C2B TKW_VV_VV_UB 100.0 FORMULA_0003 0.0 255.0000 /end CHARACTERISTIC
/begin CHARACTERISTIC K_ED_PKS_PAUFBAU.OK_SCHWELLE "Filterschwelle fuer Fehleraustrag | EN: Fault code PKS_PAUFBAU - debounce filter threshold for clearing (healing) the fault" VALUE 0x71C45 TKW_VV_VV_UB 100.0 FORMULA_0003 0.0 255.0000 /end CHARACTERISTIC
/begin CHARACTERISTIC K_ED_PKS_ADAPT_ANSCHL.OK_SCHWELLE "Filterschwelle fuer Fehleraustrag | EN: Fault code PKS_ADAPT_ANSCHL - debounce filter threshold for clearing (healing) the fault" VALUE 0x71C5F TKW_VV_VV_UB 100.0 FORMULA_0003 0.0 255.0000 /end CHARACTERISTIC
/begin CHARACTERISTIC K_ED_LAVK_ATIC42.OK_SCHWELLE "Filterschwelle fuer Fehleraustrag | EN: Fault code LAVK_ATIC42 - debounce filter threshold for clearing (healing) the fault" VALUE 0x71C93 TKW_VV_VV_UB 100.0 FORMULA_0003 0.0 255.0000 /end CHARACTERISTIC
/begin CHARACTERISTIC K_ED_PT_AX.OK_SCHWELLE "Filterschwelle fuer Fehleraustrag | EN: Fault code PT_AX - debounce filter threshold for clearing (healing) the fault" VALUE 0x71CAD TKW_VV_VV_UB 100.0 FORMULA_0003 0.0 255.0000 /end CHARACTERISTIC
/begin CHARACTERISTIC K_ED_PT_OBD_ED.OK_SCHWELLE "Filterschwelle fuer Fehleraustrag" VALUE 0x71CC7 TKW_VV_VV_UB 100.0 FORMULA_0003 0.0 255.0000 /end CHARACTERISTIC
/begin CHARACTERISTIC K_ED_MVAC_OBD.OK_SCHWELLE "Filterschwelle fuer Fehleraustrag" VALUE 0x71D49 TKW_VV_VV_UB 100.0 FORMULA_0003 0.0 255.0000 /end CHARACTERISTIC
/begin CHARACTERISTIC K_ED_LAVK2_ATIC42.OK_SCHWELLE "Filterschwelle fuer Fehleraustrag" VALUE 0x71D7D TKW_VV_VV_UB 100.0 FORMULA_0003 0.0 255.0000 /end CHARACTERISTIC
/begin CHARACTERISTIC K_ED_PSAU1.INC_VOR_EINTRAG "Filtererhoehung vorm Fehlerspeichereintrag | EN: Fault code PSAU1 - debounce filter increment before fault-memory entry" VALUE 0x70948 TKW_VV_VV_UB 100.0 FORMULA_0003 0.0 255.0000 /end CHARACTERISTIC
/begin CHARACTERISTIC K_ED_PSAU2.INC_VOR_EINTRAG "Filtererhoehung vorm Fehlerspeichereintrag | EN: Fault code PSAU2 - debounce filter increment before fault-memory entry" VALUE 0x70962 TKW_VV_VV_UB 100.0 FORMULA_0003 0.0 255.0000 /end CHARACTERISTIC
/begin CHARACTERISTIC K_ED_NW1_SYNC.INC_VOR_EINTRAG "Filtererhoehung vorm Fehlerspeichereintrag" VALUE 0x70A4C TKW_VV_VV_UB 100.0 FORMULA_0003 0.0 255.0000 /end CHARACTERISTIC
/begin CHARACTERISTIC K_ED_NW2_SYNC.INC_VOR_EINTRAG "Filtererhoehung vorm Fehlerspeichereintrag" VALUE 0x70A66 TKW_VV_VV_UB 100.0 FORMULA_0003 0.0 255.0000 /end CHARACTERISTIC
/begin CHARACTERISTIC K_ED_PCTRL_INJ.INC_VOR_EINTRAG "Filtererhoehung vorm Fehlerspeichereintrag | EN: Fault code PCTRL_INJ - debounce filter increment before fault-memory entry" VALUE 0x70A80 TKW_VV_VV_UB 100.0 FORMULA_0003 0.0 255.0000 /end CHARACTERISTIC
/begin CHARACTERISTIC K_ED_PT_STATDKG.INC_VOR_EINTRAG "Filtererhoehung vorm Fehlerspeichereintrag | EN: Fault code PT_STATDKG - debounce filter increment before fault-memory entry" VALUE 0x70A9A TKW_VV_VV_UB 100.0 FORMULA_0003 0.0 255.0000 /end CHARACTERISTIC
/begin CHARACTERISTIC K_ED_PKS.INC_VOR_EINTRAG "Filtererhoehung vorm Fehlerspeichereintrag | EN: Fault code PKS - debounce filter increment before fault-memory entry" VALUE 0x70AB4 TKW_VV_VV_UB 100.0 FORMULA_0003 0.0 255.0000 /end CHARACTERISTIC
/begin CHARACTERISTIC K_ED_PT_STATR.INC_VOR_EINTRAG "Filtererhoehung vorm Fehlerspeichereintrag | EN: Fault code PT_STATR - debounce filter increment before fault-memory entry" VALUE 0x70ACE TKW_VV_VV_UB 100.0 FORMULA_0003 0.0 255.0000 /end CHARACTERISTIC
/begin CHARACTERISTIC K_ED_LAVK2.INC_VOR_EINTRAG "Filtererhoehung vorm Fehlerspeichereintrag | EN: Fault code LAVK2 - debounce filter increment before fault-memory entry" VALUE 0x70B02 TKW_VV_VV_UB 100.0 FORMULA_0003 0.0 255.0000 /end CHARACTERISTIC
/begin CHARACTERISTIC K_ED_LAVK2_OBD_PLAU.INC_VOR_EINTRAG "Filtererhoehung vorm Fehlerspeichereintrag | EN: Fault code LAVK2_OBD_PLAU - debounce filter increment before fault-memory entry" VALUE 0x70B36 TKW_VV_VV_UB 100.0 FORMULA_0003 0.0 255.0000 /end CHARACTERISTIC
/begin CHARACTERISTIC K_ED_LAVK2_OBD_SA.INC_VOR_EINTRAG "Filtererhoehung vorm Fehlerspeichereintrag | EN: Fault code LAVK2_OBD_SA - debounce filter increment before fault-memory entry" VALUE 0x70B6A TKW_VV_VV_UB 100.0 FORMULA_0003 0.0 255.0000 /end CHARACTERISTIC
/begin CHARACTERISTIC K_ED_LSHNK1.INC_VOR_EINTRAG "Filtererhoehung vorm Fehlerspeichereintrag | EN: Fault code LSHNK1 - debounce filter increment before fault-memory entry" VALUE 0x70BB8 TKW_VV_VV_UB 100.0 FORMULA_0003 0.0 255.0000 /end CHARACTERISTIC
/begin CHARACTERISTIC K_ED_LSHNK2.INC_VOR_EINTRAG "Filtererhoehung vorm Fehlerspeichereintrag | EN: Fault code LSHNK2 - debounce filter increment before fault-memory entry" VALUE 0x70BD2 TKW_VV_VV_UB 100.0 FORMULA_0003 0.0 255.0000 /end CHARACTERISTIC
/begin CHARACTERISTIC K_ED_PT_BUSOFF.INC_VOR_EINTRAG "Filtererhoehung vorm Fehlerspeichereintrag | EN: Fault code PT_BUSOFF - debounce filter increment before fault-memory entry" VALUE 0x70BEC TKW_VV_VV_UB 100.0 FORMULA_0003 0.0 255.0000 /end CHARACTERISTIC
/begin CHARACTERISTIC K_ED_PT_TORQDSC.INC_VOR_EINTRAG "Filtererhoehung vorm Fehlerspeichereintrag | EN: Fault code PT_TORQDSC - debounce filter increment before fault-memory entry" VALUE 0x70C06 TKW_VV_VV_UB 100.0 FORMULA_0003 0.0 255.0000 /end CHARACTERISTIC
/begin CHARACTERISTIC K_ED_PT_STDSC.INC_VOR_EINTRAG "Filtererhoehung vorm Fehlerspeichereintrag | EN: Fault code PT_STDSC - debounce filter increment before fault-memory entry" VALUE 0x70C20 TKW_VV_VV_UB 100.0 FORMULA_0003 0.0 255.0000 /end CHARACTERISTIC
/begin CHARACTERISTIC K_ED_PT_ATEMP.INC_VOR_EINTRAG "Filtererhoehung vorm Fehlerspeichereintrag | EN: Fault code PT_ATEMP - debounce filter increment before fault-memory entry" VALUE 0x70C6E TKW_VV_VV_UB 100.0 FORMULA_0003 0.0 255.0000 /end CHARACTERISTIC
/begin CHARACTERISTIC K_ED_PT_KLST.INC_VOR_EINTRAG "Filtererhoehung vorm Fehlerspeichereintrag | EN: Fault code PT_KLST - debounce filter increment before fault-memory entry" VALUE 0x70C88 TKW_VV_VV_UB 100.0 FORMULA_0003 0.0 255.0000 /end CHARACTERISTIC
/begin CHARACTERISTIC K_ED_PT_KKOS.INC_VOR_EINTRAG "Filtererhoehung vorm Fehlerspeichereintrag | EN: Fault code PT_KKOS - debounce filter increment before fault-memory entry" VALUE 0x70CA2 TKW_VV_VV_UB 100.0 FORMULA_0003 0.0 255.0000 /end CHARACTERISTIC
/begin CHARACTERISTIC K_ED_PT_LRW.INC_VOR_EINTRAG "Filtererhoehung vorm Fehlerspeichereintrag | EN: Fault code PT_LRW - debounce filter increment before fault-memory entry" VALUE 0x70CBC TKW_VV_VV_UB 100.0 FORMULA_0003 0.0 255.0000 /end CHARACTERISTIC
/begin CHARACTERISTIC K_ED_LAVK2_OBD_TL.INC_VOR_EINTRAG "Filtererhoehung vorm Fehlerspeichereintrag | EN: Fault code LAVK2_OBD_TL - debounce filter increment before fault-memory entry" VALUE 0x70D72 TKW_VV_VV_UB 100.0 FORMULA_0003 0.0 255.0000 /end CHARACTERISTIC
/begin CHARACTERISTIC K_ED_LSHVK1.INC_VOR_EINTRAG "Filtererhoehung vorm Fehlerspeichereintrag | EN: Fault code LSHVK1 - debounce filter increment before fault-memory entry" VALUE 0x70D8C TKW_VV_VV_UB 100.0 FORMULA_0003 0.0 255.0000 /end CHARACTERISTIC
/begin CHARACTERISTIC K_ED_LSHVK2.INC_VOR_EINTRAG "Filtererhoehung vorm Fehlerspeichereintrag | EN: Fault code LSHVK2 - debounce filter increment before fault-memory entry" VALUE 0x70DA6 TKW_VV_VV_UB 100.0 FORMULA_0003 0.0 255.0000 /end CHARACTERISTIC
/begin CHARACTERISTIC K_ED_LSRVK1_OBD_REG.INC_VOR_EINTRAG "Filtererhoehung vorm Fehlerspeichereintrag | EN: Fault code LSRVK1_OBD_REG - debounce filter increment before fault-memory entry" VALUE 0x70DC0 TKW_VV_VV_UB 100.0 FORMULA_0003 0.0 255.0000 /end CHARACTERISTIC
/begin CHARACTERISTIC K_ED_LSRVK2_OBD_REG.INC_VOR_EINTRAG "Filtererhoehung vorm Fehlerspeichereintrag | EN: Fault code LSRVK2_OBD_REG - debounce filter increment before fault-memory entry" VALUE 0x70DDA TKW_VV_VV_UB 100.0 FORMULA_0003 0.0 255.0000 /end CHARACTERISTIC
/begin CHARACTERISTIC K_ED_LSHVK1_R.INC_VOR_EINTRAG "Filtererhoehung vorm Fehlerspeichereintrag | EN: Fault code LSHVK1_R - debounce filter increment before fault-memory entry" VALUE 0x70DF4 TKW_VV_VV_UB 100.0 FORMULA_0003 0.0 255.0000 /end CHARACTERISTIC
/begin CHARACTERISTIC K_ED_LSHVK2_R.INC_VOR_EINTRAG "Filtererhoehung vorm Fehlerspeichereintrag | EN: Fault code LSHVK2_R - debounce filter increment before fault-memory entry" VALUE 0x70E0E TKW_VV_VV_UB 100.0 FORMULA_0003 0.0 255.0000 /end CHARACTERISTIC
/begin CHARACTERISTIC K_ED_LSRVK1_OBD_START.INC_VOR_EINTRAG "Filtererhoehung vorm Fehlerspeichereintrag | EN: Fault code LSRVK1_OBD_START - debounce filter increment before fault-memory entry" VALUE 0x70E28 TKW_VV_VV_UB 100.0 FORMULA_0003 0.0 255.0000 /end CHARACTERISTIC
/begin CHARACTERISTIC K_ED_LSRVK2_OBD_START.INC_VOR_EINTRAG "Filtererhoehung vorm Fehlerspeichereintrag | EN: Fault code LSRVK2_OBD_START - debounce filter increment before fault-memory entry" VALUE 0x70E42 TKW_VV_VV_UB 100.0 FORMULA_0003 0.0 255.0000 /end CHARACTERISTIC
/begin CHARACTERISTIC K_ED_LSRVK1_OBD_REF.INC_VOR_EINTRAG "Filtererhoehung vorm Fehlerspeichereintrag | EN: Fault code LSRVK1_OBD_REF - debounce filter increment before fault-memory entry" VALUE 0x70E5C TKW_VV_VV_UB 100.0 FORMULA_0003 0.0 255.0000 /end CHARACTERISTIC
/begin CHARACTERISTIC K_ED_LSRVK2_OBD_REF.INC_VOR_EINTRAG "Filtererhoehung vorm Fehlerspeichereintrag | EN: Fault code LSRVK2_OBD_REF - debounce filter increment before fault-memory entry" VALUE 0x70E76 TKW_VV_VV_UB 100.0 FORMULA_0003 0.0 255.0000 /end CHARACTERISTIC
/begin CHARACTERISTIC K_ED_LAVK2_DIAG.INC_VOR_EINTRAG "Filtererhoehung vorm Fehlerspeichereintrag | EN: Fault code LAVK2_DIAG - debounce filter increment before fault-memory entry" VALUE 0x70EAA TKW_VV_VV_UB 100.0 FORMULA_0003 0.0 255.0000 /end CHARACTERISTIC
/begin CHARACTERISTIC K_ED_LAVK2_IA_OPENLOAD.INC_VOR_EINTRAG "Filtererhoehung vorm Fehlerspeichereintrag | EN: Fault code LAVK2_IA_OPENLOAD - debounce filter increment before fault-memory entry" VALUE 0x70EDE TKW_VV_VV_UB 100.0 FORMULA_0003 0.0 255.0000 /end CHARACTERISTIC
/begin CHARACTERISTIC K_ED_PT_GRB.INC_VOR_EINTRAG "Filtererhoehung vorm Fehlerspeichereintrag | EN: Fault code PT_GRB - debounce filter increment before fault-memory entry" VALUE 0x70EF8 TKW_VV_VV_UB 100.0 FORMULA_0003 0.0 255.0000 /end CHARACTERISTIC
/begin CHARACTERISTIC K_ED_PT_GRB2.INC_VOR_EINTRAG "Filtererhoehung vorm Fehlerspeichereintrag | EN: Fault code PT_GRB2 - debounce filter increment before fault-memory entry" VALUE 0x70F12 TKW_VV_VV_UB 100.0 FORMULA_0003 0.0 255.0000 /end CHARACTERISTIC
/begin CHARACTERISTIC K_ED_LAVK2_UN_OPENLOAD.INC_VOR_EINTRAG "Filtererhoehung vorm Fehlerspeichereintrag | EN: Fault code LAVK2_UN_OPENLOAD - debounce filter increment before fault-memory entry" VALUE 0x70F46 TKW_VV_VV_UB 100.0 FORMULA_0003 0.0 255.0000 /end CHARACTERISTIC
/begin CHARACTERISTIC K_ED_LAVK2_IP_OPENLOAD.INC_VOR_EINTRAG "Filtererhoehung vorm Fehlerspeichereintrag | EN: Fault code LAVK2_IP_OPENLOAD - debounce filter increment before fault-memory entry" VALUE 0x70F7A TKW_VV_VV_UB 100.0 FORMULA_0003 0.0 255.0000 /end CHARACTERISTIC
/begin CHARACTERISTIC K_ED_LAVK2_OBD_DYN.INC_VOR_EINTRAG "Filtererhoehung vorm Fehlerspeichereintrag | EN: Fault code LAVK2_OBD_DYN - debounce filter increment before fault-memory entry" VALUE 0x712D4 TKW_VV_VV_UB 100.0 FORMULA_0003 0.0 255.0000 /end CHARACTERISTIC
/begin CHARACTERISTIC K_ED_PT_CRASH.INC_VOR_EINTRAG "Filtererhoehung vorm Fehlerspeichereintrag | EN: Fault code PT_CRASH - debounce filter increment before fault-memory entry" VALUE 0x712EE TKW_VV_VV_UB 100.0 FORMULA_0003 0.0 255.0000 /end CHARACTERISTIC
/begin CHARACTERISTIC K_ED_PT_VEHMOD.INC_VOR_EINTRAG "Filtererhoehung vorm Fehlerspeichereintrag | EN: Fault code PT_VEHMOD - debounce filter increment before fault-memory entry" VALUE 0x71308 TKW_VV_VV_UB 100.0 FORMULA_0003 0.0 255.0000 /end CHARACTERISTIC
/begin CHARACTERISTIC K_ED_PT_BEDFGR.INC_VOR_EINTRAG "Filtererhoehung vorm Fehlerspeichereintrag | EN: Fault code PT_BEDFGR - debounce filter increment before fault-memory entry" VALUE 0x71322 TKW_VV_VV_UB 100.0 FORMULA_0003 0.0 255.0000 /end CHARACTERISTIC
/begin CHARACTERISTIC K_ED_LAVK2_TRIM.INC_VOR_EINTRAG "Filtererhoehung vorm Fehlerspeichereintrag | EN: Fault code LAVK2_TRIM - debounce filter increment before fault-memory entry" VALUE 0x713F2 TKW_VV_VV_UB 100.0 FORMULA_0003 0.0 255.0000 /end CHARACTERISTIC
/begin CHARACTERISTIC K_ED_PT_KM.INC_VOR_EINTRAG "Filtererhoehung vorm Fehlerspeichereintrag | EN: Fault code PT_KM - debounce filter increment before fault-memory entry" VALUE 0x714A8 TKW_VV_VV_UB 100.0 FORMULA_0003 0.0 255.0000 /end CHARACTERISTIC
/begin CHARACTERISTIC K_ED_PT_KOMBI.INC_VOR_EINTRAG "Filtererhoehung vorm Fehlerspeichereintrag | EN: Fault code PT_KOMBI - debounce filter increment before fault-memory entry" VALUE 0x714C2 TKW_VV_VV_UB 100.0 FORMULA_0003 0.0 255.0000 /end CHARACTERISTIC
/begin CHARACTERISTIC K_ED_PKS_LL.INC_VOR_EINTRAG "Filtererhoehung vorm Fehlerspeichereintrag | EN: Fault code PKS_LL - debounce filter increment before fault-memory entry" VALUE 0x714DC TKW_VV_VV_UB 100.0 FORMULA_0003 0.0 255.0000 /end CHARACTERISTIC
/begin CHARACTERISTIC K_ED_PKS_TL.INC_VOR_EINTRAG "Filtererhoehung vorm Fehlerspeichereintrag | EN: Fault code PKS_TL - debounce filter increment before fault-memory entry" VALUE 0x714F6 TKW_VV_VV_UB 100.0 FORMULA_0003 0.0 255.0000 /end CHARACTERISTIC
/begin CHARACTERISTIC K_ED_PKS_Q.INC_VOR_EINTRAG "Filtererhoehung vorm Fehlerspeichereintrag | EN: Fault code PKS_Q - debounce filter increment before fault-memory entry" VALUE 0x71510 TKW_VV_VV_UB 100.0 FORMULA_0003 0.0 255.0000 /end CHARACTERISTIC
/begin CHARACTERISTIC K_ED_MVAC_DRUCKSENSOR.INC_VOR_EINTRAG "Filtererhoehung vorm Fehlerspeichereintrag | EN: Fault code MVAC_DRUCKSENSOR - debounce filter increment before fault-memory entry" VALUE 0x71648 TKW_VV_VV_UB 100.0 FORMULA_0003 0.0 255.0000 /end CHARACTERISTIC
/begin CHARACTERISTIC K_ED_PT_BEDAT.INC_VOR_EINTRAG "Filtererhoehung vorm Fehlerspeichereintrag | EN: Fault code PT_BEDAT - debounce filter increment before fault-memory entry" VALUE 0x71662 TKW_VV_VV_UB 100.0 FORMULA_0003 0.0 255.0000 /end CHARACTERISTIC
/begin CHARACTERISTIC K_ED_PT_STATANH.INC_VOR_EINTRAG "Filtererhoehung vorm Fehlerspeichereintrag | EN: Fault code PT_STATANH - debounce filter increment before fault-memory entry" VALUE 0x71A0A TKW_VV_VV_UB 100.0 FORMULA_0003 0.0 255.0000 /end CHARACTERISTIC
/begin CHARACTERISTIC K_ED_PT_STATGRB.INC_VOR_EINTRAG "Filtererhoehung vorm Fehlerspeichereintrag" VALUE 0x71A8C TKW_VV_VV_UB 100.0 FORMULA_0003 0.0 255.0000 /end CHARACTERISTIC
/begin CHARACTERISTIC K_ED_PT_ANFRADMOM.INC_VOR_EINTRAG "Filtererhoehung vorm Fehlerspeichereintrag | EN: Fault code PT_ANFRADMOM - debounce filter increment before fault-memory entry" VALUE 0x71AA6 TKW_VV_VV_UB 100.0 FORMULA_0003 0.0 255.0000 /end CHARACTERISTIC
/begin CHARACTERISTIC K_ED_PT_TOMA.INC_VOR_EINTRAG "Filtererhoehung vorm Fehlerspeichereintrag | EN: Fault code PT_TOMA - debounce filter increment before fault-memory entry" VALUE 0x71AF4 TKW_VV_VV_UB 100.0 FORMULA_0003 0.0 255.0000 /end CHARACTERISTIC
/begin CHARACTERISTIC K_ED_LSHNK1_R.INC_VOR_EINTRAG "Filtererhoehung vorm Fehlerspeichereintrag | EN: Fault code LSHNK1_R - debounce filter increment before fault-memory entry" VALUE 0x71BF8 TKW_VV_VV_UB 100.0 FORMULA_0003 0.0 255.0000 /end CHARACTERISTIC
/begin CHARACTERISTIC K_ED_LSHNK2_R.INC_VOR_EINTRAG "Filtererhoehung vorm Fehlerspeichereintrag | EN: Fault code LSHNK2_R - debounce filter increment before fault-memory entry" VALUE 0x71C12 TKW_VV_VV_UB 100.0 FORMULA_0003 0.0 255.0000 /end CHARACTERISTIC
/begin CHARACTERISTIC K_ED_PKS_MODELL.INC_VOR_EINTRAG "Filtererhoehung vorm Fehlerspeichereintrag | EN: Fault code PKS_MODELL - debounce filter increment before fault-memory entry" VALUE 0x71C2C TKW_VV_VV_UB 100.0 FORMULA_0003 0.0 255.0000 /end CHARACTERISTIC
/begin CHARACTERISTIC K_ED_PKS_PAUFBAU.INC_VOR_EINTRAG "Filtererhoehung vorm Fehlerspeichereintrag | EN: Fault code PKS_PAUFBAU - debounce filter increment before fault-memory entry" VALUE 0x71C46 TKW_VV_VV_UB 100.0 FORMULA_0003 0.0 255.0000 /end CHARACTERISTIC
/begin CHARACTERISTIC K_ED_PKS_ADAPT_ANSCHL.INC_VOR_EINTRAG "Filtererhoehung vorm Fehlerspeichereintrag | EN: Fault code PKS_ADAPT_ANSCHL - debounce filter increment before fault-memory entry" VALUE 0x71C60 TKW_VV_VV_UB 100.0 FORMULA_0003 0.0 255.0000 /end CHARACTERISTIC
/begin CHARACTERISTIC K_ED_LAVK_ATIC42.INC_VOR_EINTRAG "Filtererhoehung vorm Fehlerspeichereintrag | EN: Fault code LAVK_ATIC42 - debounce filter increment before fault-memory entry" VALUE 0x71C94 TKW_VV_VV_UB 100.0 FORMULA_0003 0.0 255.0000 /end CHARACTERISTIC
/begin CHARACTERISTIC K_ED_PT_AX.INC_VOR_EINTRAG "Filtererhoehung vorm Fehlerspeichereintrag | EN: Fault code PT_AX - debounce filter increment before fault-memory entry" VALUE 0x71CAE TKW_VV_VV_UB 100.0 FORMULA_0003 0.0 255.0000 /end CHARACTERISTIC
/begin CHARACTERISTIC K_ED_PT_OBD_ED.INC_VOR_EINTRAG "Filtererhoehung vorm Fehlerspeichereintrag" VALUE 0x71CC8 TKW_VV_VV_UB 100.0 FORMULA_0003 0.0 255.0000 /end CHARACTERISTIC
/begin CHARACTERISTIC K_ED_MVAC_OBD.INC_VOR_EINTRAG "Filtererhoehung vorm Fehlerspeichereintrag" VALUE 0x71D4A TKW_VV_VV_UB 100.0 FORMULA_0003 0.0 255.0000 /end CHARACTERISTIC
/begin CHARACTERISTIC K_ED_LAVK2_ATIC42.INC_VOR_EINTRAG "Filtererhoehung vorm Fehlerspeichereintrag" VALUE 0x71D7E TKW_VV_VV_UB 100.0 FORMULA_0003 0.0 255.0000 /end CHARACTERISTIC
/begin CHARACTERISTIC K_ED_PSAU1.DEC_VOR_EINTRAG "Filterverringerung vorm Fehlerspeichereintrag | EN: Fault code PSAU1 - debounce filter decrement before fault-memory entry" VALUE 0x70949 TKW_VV_VV_UB 100.0 FORMULA_0003 0.0 255.0000 /end CHARACTERISTIC
/begin CHARACTERISTIC K_ED_PSAU2.DEC_VOR_EINTRAG "Filterverringerung vorm Fehlerspeichereintrag | EN: Fault code PSAU2 - debounce filter decrement before fault-memory entry" VALUE 0x70963 TKW_VV_VV_UB 100.0 FORMULA_0003 0.0 255.0000 /end CHARACTERISTIC
/begin CHARACTERISTIC K_ED_NW1_SYNC.DEC_VOR_EINTRAG "Filterverringerung vorm Fehlerspeichereintrag" VALUE 0x70A4D TKW_VV_VV_UB 100.0 FORMULA_0003 0.0 255.0000 /end CHARACTERISTIC
/begin CHARACTERISTIC K_ED_NW2_SYNC.DEC_VOR_EINTRAG "Filterverringerung vorm Fehlerspeichereintrag" VALUE 0x70A67 TKW_VV_VV_UB 100.0 FORMULA_0003 0.0 255.0000 /end CHARACTERISTIC
/begin CHARACTERISTIC K_ED_PCTRL_INJ.DEC_VOR_EINTRAG "Filterverringerung vorm Fehlerspeichereintrag | EN: Fault code PCTRL_INJ - debounce filter decrement before fault-memory entry" VALUE 0x70A81 TKW_VV_VV_UB 100.0 FORMULA_0003 0.0 255.0000 /end CHARACTERISTIC
/begin CHARACTERISTIC K_ED_PT_STATDKG.DEC_VOR_EINTRAG "Filterverringerung vorm Fehlerspeichereintrag | EN: Fault code PT_STATDKG - debounce filter decrement before fault-memory entry" VALUE 0x70A9B TKW_VV_VV_UB 100.0 FORMULA_0003 0.0 255.0000 /end CHARACTERISTIC
/begin CHARACTERISTIC K_ED_PKS.DEC_VOR_EINTRAG "Filterverringerung vorm Fehlerspeichereintrag | EN: Fault code PKS - debounce filter decrement before fault-memory entry" VALUE 0x70AB5 TKW_VV_VV_UB 100.0 FORMULA_0003 0.0 255.0000 /end CHARACTERISTIC
/begin CHARACTERISTIC K_ED_PT_STATR.DEC_VOR_EINTRAG "Filterverringerung vorm Fehlerspeichereintrag | EN: Fault code PT_STATR - debounce filter decrement before fault-memory entry" VALUE 0x70ACF TKW_VV_VV_UB 100.0 FORMULA_0003 0.0 255.0000 /end CHARACTERISTIC
/begin CHARACTERISTIC K_ED_LAVK2.DEC_VOR_EINTRAG "Filterverringerung vorm Fehlerspeichereintrag | EN: Fault code LAVK2 - debounce filter decrement before fault-memory entry" VALUE 0x70B03 TKW_VV_VV_UB 100.0 FORMULA_0003 0.0 255.0000 /end CHARACTERISTIC
/begin CHARACTERISTIC K_ED_LAVK2_OBD_PLAU.DEC_VOR_EINTRAG "Filterverringerung vorm Fehlerspeichereintrag | EN: Fault code LAVK2_OBD_PLAU - debounce filter decrement before fault-memory entry" VALUE 0x70B37 TKW_VV_VV_UB 100.0 FORMULA_0003 0.0 255.0000 /end CHARACTERISTIC
/begin CHARACTERISTIC K_ED_LAVK2_OBD_SA.DEC_VOR_EINTRAG "Filterverringerung vorm Fehlerspeichereintrag | EN: Fault code LAVK2_OBD_SA - debounce filter decrement before fault-memory entry" VALUE 0x70B6B TKW_VV_VV_UB 100.0 FORMULA_0003 0.0 255.0000 /end CHARACTERISTIC
/begin CHARACTERISTIC K_ED_LSHNK1.DEC_VOR_EINTRAG "Filterverringerung vorm Fehlerspeichereintrag | EN: Fault code LSHNK1 - debounce filter decrement before fault-memory entry" VALUE 0x70BB9 TKW_VV_VV_UB 100.0 FORMULA_0003 0.0 255.0000 /end CHARACTERISTIC
/begin CHARACTERISTIC K_ED_LSHNK2.DEC_VOR_EINTRAG "Filterverringerung vorm Fehlerspeichereintrag | EN: Fault code LSHNK2 - debounce filter decrement before fault-memory entry" VALUE 0x70BD3 TKW_VV_VV_UB 100.0 FORMULA_0003 0.0 255.0000 /end CHARACTERISTIC
/begin CHARACTERISTIC K_ED_PT_BUSOFF.DEC_VOR_EINTRAG "Filterverringerung vorm Fehlerspeichereintrag | EN: Fault code PT_BUSOFF - debounce filter decrement before fault-memory entry" VALUE 0x70BED TKW_VV_VV_UB 100.0 FORMULA_0003 0.0 255.0000 /end CHARACTERISTIC
/begin CHARACTERISTIC K_ED_PT_TORQDSC.DEC_VOR_EINTRAG "Filterverringerung vorm Fehlerspeichereintrag | EN: Fault code PT_TORQDSC - debounce filter decrement before fault-memory entry" VALUE 0x70C07 TKW_VV_VV_UB 100.0 FORMULA_0003 0.0 255.0000 /end CHARACTERISTIC
/begin CHARACTERISTIC K_ED_PT_STDSC.DEC_VOR_EINTRAG "Filterverringerung vorm Fehlerspeichereintrag | EN: Fault code PT_STDSC - debounce filter decrement before fault-memory entry" VALUE 0x70C21 TKW_VV_VV_UB 100.0 FORMULA_0003 0.0 255.0000 /end CHARACTERISTIC
/begin CHARACTERISTIC K_ED_PT_ATEMP.DEC_VOR_EINTRAG "Filterverringerung vorm Fehlerspeichereintrag | EN: Fault code PT_ATEMP - debounce filter decrement before fault-memory entry" VALUE 0x70C6F TKW_VV_VV_UB 100.0 FORMULA_0003 0.0 255.0000 /end CHARACTERISTIC
/begin CHARACTERISTIC K_ED_PT_KLST.DEC_VOR_EINTRAG "Filterverringerung vorm Fehlerspeichereintrag | EN: Fault code PT_KLST - debounce filter decrement before fault-memory entry" VALUE 0x70C89 TKW_VV_VV_UB 100.0 FORMULA_0003 0.0 255.0000 /end CHARACTERISTIC
/begin CHARACTERISTIC K_ED_PT_KKOS.DEC_VOR_EINTRAG "Filterverringerung vorm Fehlerspeichereintrag | EN: Fault code PT_KKOS - debounce filter decrement before fault-memory entry" VALUE 0x70CA3 TKW_VV_VV_UB 100.0 FORMULA_0003 0.0 255.0000 /end CHARACTERISTIC
/begin CHARACTERISTIC K_ED_PT_LRW.DEC_VOR_EINTRAG "Filterverringerung vorm Fehlerspeichereintrag | EN: Fault code PT_LRW - debounce filter decrement before fault-memory entry" VALUE 0x70CBD TKW_VV_VV_UB 100.0 FORMULA_0003 0.0 255.0000 /end CHARACTERISTIC
/begin CHARACTERISTIC K_ED_LAVK2_OBD_TL.DEC_VOR_EINTRAG "Filterverringerung vorm Fehlerspeichereintrag | EN: Fault code LAVK2_OBD_TL - debounce filter decrement before fault-memory entry" VALUE 0x70D73 TKW_VV_VV_UB 100.0 FORMULA_0003 0.0 255.0000 /end CHARACTERISTIC
/begin CHARACTERISTIC K_ED_LSHVK1.DEC_VOR_EINTRAG "Filterverringerung vorm Fehlerspeichereintrag | EN: Fault code LSHVK1 - debounce filter decrement before fault-memory entry" VALUE 0x70D8D TKW_VV_VV_UB 100.0 FORMULA_0003 0.0 255.0000 /end CHARACTERISTIC
/begin CHARACTERISTIC K_ED_LSHVK2.DEC_VOR_EINTRAG "Filterverringerung vorm Fehlerspeichereintrag | EN: Fault code LSHVK2 - debounce filter decrement before fault-memory entry" VALUE 0x70DA7 TKW_VV_VV_UB 100.0 FORMULA_0003 0.0 255.0000 /end CHARACTERISTIC
/begin CHARACTERISTIC K_ED_LSRVK1_OBD_REG.DEC_VOR_EINTRAG "Filterverringerung vorm Fehlerspeichereintrag | EN: Fault code LSRVK1_OBD_REG - debounce filter decrement before fault-memory entry" VALUE 0x70DC1 TKW_VV_VV_UB 100.0 FORMULA_0003 0.0 255.0000 /end CHARACTERISTIC
/begin CHARACTERISTIC K_ED_LSRVK2_OBD_REG.DEC_VOR_EINTRAG "Filterverringerung vorm Fehlerspeichereintrag | EN: Fault code LSRVK2_OBD_REG - debounce filter decrement before fault-memory entry" VALUE 0x70DDB TKW_VV_VV_UB 100.0 FORMULA_0003 0.0 255.0000 /end CHARACTERISTIC
/begin CHARACTERISTIC K_ED_LSHVK1_R.DEC_VOR_EINTRAG "Filterverringerung vorm Fehlerspeichereintrag | EN: Fault code LSHVK1_R - debounce filter decrement before fault-memory entry" VALUE 0x70DF5 TKW_VV_VV_UB 100.0 FORMULA_0003 0.0 255.0000 /end CHARACTERISTIC
/begin CHARACTERISTIC K_ED_LSHVK2_R.DEC_VOR_EINTRAG "Filterverringerung vorm Fehlerspeichereintrag | EN: Fault code LSHVK2_R - debounce filter decrement before fault-memory entry" VALUE 0x70E0F TKW_VV_VV_UB 100.0 FORMULA_0003 0.0 255.0000 /end CHARACTERISTIC
/begin CHARACTERISTIC K_ED_LSRVK1_OBD_START.DEC_VOR_EINTRAG "Filterverringerung vorm Fehlerspeichereintrag | EN: Fault code LSRVK1_OBD_START - debounce filter decrement before fault-memory entry" VALUE 0x70E29 TKW_VV_VV_UB 100.0 FORMULA_0003 0.0 255.0000 /end CHARACTERISTIC
/begin CHARACTERISTIC K_ED_LSRVK2_OBD_START.DEC_VOR_EINTRAG "Filterverringerung vorm Fehlerspeichereintrag | EN: Fault code LSRVK2_OBD_START - debounce filter decrement before fault-memory entry" VALUE 0x70E43 TKW_VV_VV_UB 100.0 FORMULA_0003 0.0 255.0000 /end CHARACTERISTIC
/begin CHARACTERISTIC K_ED_LSRVK1_OBD_REF.DEC_VOR_EINTRAG "Filterverringerung vorm Fehlerspeichereintrag | EN: Fault code LSRVK1_OBD_REF - debounce filter decrement before fault-memory entry" VALUE 0x70E5D TKW_VV_VV_UB 100.0 FORMULA_0003 0.0 255.0000 /end CHARACTERISTIC
/begin CHARACTERISTIC K_ED_LSRVK2_OBD_REF.DEC_VOR_EINTRAG "Filterverringerung vorm Fehlerspeichereintrag | EN: Fault code LSRVK2_OBD_REF - debounce filter decrement before fault-memory entry" VALUE 0x70E77 TKW_VV_VV_UB 100.0 FORMULA_0003 0.0 255.0000 /end CHARACTERISTIC
/begin CHARACTERISTIC K_ED_LAVK2_DIAG.DEC_VOR_EINTRAG "Filterverringerung vorm Fehlerspeichereintrag | EN: Fault code LAVK2_DIAG - debounce filter decrement before fault-memory entry" VALUE 0x70EAB TKW_VV_VV_UB 100.0 FORMULA_0003 0.0 255.0000 /end CHARACTERISTIC
/begin CHARACTERISTIC K_ED_LAVK2_IA_OPENLOAD.DEC_VOR_EINTRAG "Filterverringerung vorm Fehlerspeichereintrag | EN: Fault code LAVK2_IA_OPENLOAD - debounce filter decrement before fault-memory entry" VALUE 0x70EDF TKW_VV_VV_UB 100.0 FORMULA_0003 0.0 255.0000 /end CHARACTERISTIC
/begin CHARACTERISTIC K_ED_PT_GRB.DEC_VOR_EINTRAG "Filterverringerung vorm Fehlerspeichereintrag | EN: Fault code PT_GRB - debounce filter decrement before fault-memory entry" VALUE 0x70EF9 TKW_VV_VV_UB 100.0 FORMULA_0003 0.0 255.0000 /end CHARACTERISTIC
/begin CHARACTERISTIC K_ED_PT_GRB2.DEC_VOR_EINTRAG "Filterverringerung vorm Fehlerspeichereintrag | EN: Fault code PT_GRB2 - debounce filter decrement before fault-memory entry" VALUE 0x70F13 TKW_VV_VV_UB 100.0 FORMULA_0003 0.0 255.0000 /end CHARACTERISTIC
/begin CHARACTERISTIC K_ED_LAVK2_UN_OPENLOAD.DEC_VOR_EINTRAG "Filterverringerung vorm Fehlerspeichereintrag | EN: Fault code LAVK2_UN_OPENLOAD - debounce filter decrement before fault-memory entry" VALUE 0x70F47 TKW_VV_VV_UB 100.0 FORMULA_0003 0.0 255.0000 /end CHARACTERISTIC
/begin CHARACTERISTIC K_ED_LAVK2_IP_OPENLOAD.DEC_VOR_EINTRAG "Filterverringerung vorm Fehlerspeichereintrag | EN: Fault code LAVK2_IP_OPENLOAD - debounce filter decrement before fault-memory entry" VALUE 0x70F7B TKW_VV_VV_UB 100.0 FORMULA_0003 0.0 255.0000 /end CHARACTERISTIC
/begin CHARACTERISTIC K_ED_LAVK2_OBD_DYN.DEC_VOR_EINTRAG "Filterverringerung vorm Fehlerspeichereintrag | EN: Fault code LAVK2_OBD_DYN - debounce filter decrement before fault-memory entry" VALUE 0x712D5 TKW_VV_VV_UB 100.0 FORMULA_0003 0.0 255.0000 /end CHARACTERISTIC
/begin CHARACTERISTIC K_ED_PT_CRASH.DEC_VOR_EINTRAG "Filterverringerung vorm Fehlerspeichereintrag | EN: Fault code PT_CRASH - debounce filter decrement before fault-memory entry" VALUE 0x712EF TKW_VV_VV_UB 100.0 FORMULA_0003 0.0 255.0000 /end CHARACTERISTIC
/begin CHARACTERISTIC K_ED_PT_VEHMOD.DEC_VOR_EINTRAG "Filterverringerung vorm Fehlerspeichereintrag | EN: Fault code PT_VEHMOD - debounce filter decrement before fault-memory entry" VALUE 0x71309 TKW_VV_VV_UB 100.0 FORMULA_0003 0.0 255.0000 /end CHARACTERISTIC
/begin CHARACTERISTIC K_ED_PT_BEDFGR.DEC_VOR_EINTRAG "Filterverringerung vorm Fehlerspeichereintrag | EN: Fault code PT_BEDFGR - debounce filter decrement before fault-memory entry" VALUE 0x71323 TKW_VV_VV_UB 100.0 FORMULA_0003 0.0 255.0000 /end CHARACTERISTIC
/begin CHARACTERISTIC K_ED_LAVK2_TRIM.DEC_VOR_EINTRAG "Filterverringerung vorm Fehlerspeichereintrag | EN: Fault code LAVK2_TRIM - debounce filter decrement before fault-memory entry" VALUE 0x713F3 TKW_VV_VV_UB 100.0 FORMULA_0003 0.0 255.0000 /end CHARACTERISTIC
/begin CHARACTERISTIC K_ED_PT_KM.DEC_VOR_EINTRAG "Filterverringerung vorm Fehlerspeichereintrag | EN: Fault code PT_KM - debounce filter decrement before fault-memory entry" VALUE 0x714A9 TKW_VV_VV_UB 100.0 FORMULA_0003 0.0 255.0000 /end CHARACTERISTIC
/begin CHARACTERISTIC K_ED_PT_KOMBI.DEC_VOR_EINTRAG "Filterverringerung vorm Fehlerspeichereintrag | EN: Fault code PT_KOMBI - debounce filter decrement before fault-memory entry" VALUE 0x714C3 TKW_VV_VV_UB 100.0 FORMULA_0003 0.0 255.0000 /end CHARACTERISTIC
/begin CHARACTERISTIC K_ED_PKS_LL.DEC_VOR_EINTRAG "Filterverringerung vorm Fehlerspeichereintrag | EN: Fault code PKS_LL - debounce filter decrement before fault-memory entry" VALUE 0x714DD TKW_VV_VV_UB 100.0 FORMULA_0003 0.0 255.0000 /end CHARACTERISTIC
/begin CHARACTERISTIC K_ED_PKS_TL.DEC_VOR_EINTRAG "Filterverringerung vorm Fehlerspeichereintrag | EN: Fault code PKS_TL - debounce filter decrement before fault-memory entry" VALUE 0x714F7 TKW_VV_VV_UB 100.0 FORMULA_0003 0.0 255.0000 /end CHARACTERISTIC
/begin CHARACTERISTIC K_ED_PKS_Q.DEC_VOR_EINTRAG "Filterverringerung vorm Fehlerspeichereintrag | EN: Fault code PKS_Q - debounce filter decrement before fault-memory entry" VALUE 0x71511 TKW_VV_VV_UB 100.0 FORMULA_0003 0.0 255.0000 /end CHARACTERISTIC
/begin CHARACTERISTIC K_ED_MVAC_DRUCKSENSOR.DEC_VOR_EINTRAG "Filterverringerung vorm Fehlerspeichereintrag | EN: Fault code MVAC_DRUCKSENSOR - debounce filter decrement before fault-memory entry" VALUE 0x71649 TKW_VV_VV_UB 100.0 FORMULA_0003 0.0 255.0000 /end CHARACTERISTIC
/begin CHARACTERISTIC K_ED_PT_BEDAT.DEC_VOR_EINTRAG "Filterverringerung vorm Fehlerspeichereintrag | EN: Fault code PT_BEDAT - debounce filter decrement before fault-memory entry" VALUE 0x71663 TKW_VV_VV_UB 100.0 FORMULA_0003 0.0 255.0000 /end CHARACTERISTIC
/begin CHARACTERISTIC K_ED_PT_STATANH.DEC_VOR_EINTRAG "Filterverringerung vorm Fehlerspeichereintrag | EN: Fault code PT_STATANH - debounce filter decrement before fault-memory entry" VALUE 0x71A0B TKW_VV_VV_UB 100.0 FORMULA_0003 0.0 255.0000 /end CHARACTERISTIC
/begin CHARACTERISTIC K_ED_PT_STATGRB.DEC_VOR_EINTRAG "Filterverringerung vorm Fehlerspeichereintrag" VALUE 0x71A8D TKW_VV_VV_UB 100.0 FORMULA_0003 0.0 255.0000 /end CHARACTERISTIC
/begin CHARACTERISTIC K_ED_PT_ANFRADMOM.DEC_VOR_EINTRAG "Filterverringerung vorm Fehlerspeichereintrag | EN: Fault code PT_ANFRADMOM - debounce filter decrement before fault-memory entry" VALUE 0x71AA7 TKW_VV_VV_UB 100.0 FORMULA_0003 0.0 255.0000 /end CHARACTERISTIC
/begin CHARACTERISTIC K_ED_PT_TOMA.DEC_VOR_EINTRAG "Filterverringerung vorm Fehlerspeichereintrag | EN: Fault code PT_TOMA - debounce filter decrement before fault-memory entry" VALUE 0x71AF5 TKW_VV_VV_UB 100.0 FORMULA_0003 0.0 255.0000 /end CHARACTERISTIC
/begin CHARACTERISTIC K_ED_LSHNK1_R.DEC_VOR_EINTRAG "Filterverringerung vorm Fehlerspeichereintrag | EN: Fault code LSHNK1_R - debounce filter decrement before fault-memory entry" VALUE 0x71BF9 TKW_VV_VV_UB 100.0 FORMULA_0003 0.0 255.0000 /end CHARACTERISTIC
/begin CHARACTERISTIC K_ED_LSHNK2_R.DEC_VOR_EINTRAG "Filterverringerung vorm Fehlerspeichereintrag | EN: Fault code LSHNK2_R - debounce filter decrement before fault-memory entry" VALUE 0x71C13 TKW_VV_VV_UB 100.0 FORMULA_0003 0.0 255.0000 /end CHARACTERISTIC
/begin CHARACTERISTIC K_ED_PKS_MODELL.DEC_VOR_EINTRAG "Filterverringerung vorm Fehlerspeichereintrag | EN: Fault code PKS_MODELL - debounce filter decrement before fault-memory entry" VALUE 0x71C2D TKW_VV_VV_UB 100.0 FORMULA_0003 0.0 255.0000 /end CHARACTERISTIC
/begin CHARACTERISTIC K_ED_PKS_PAUFBAU.DEC_VOR_EINTRAG "Filterverringerung vorm Fehlerspeichereintrag | EN: Fault code PKS_PAUFBAU - debounce filter decrement before fault-memory entry" VALUE 0x71C47 TKW_VV_VV_UB 100.0 FORMULA_0003 0.0 255.0000 /end CHARACTERISTIC
/begin CHARACTERISTIC K_ED_PKS_ADAPT_ANSCHL.DEC_VOR_EINTRAG "Filterverringerung vorm Fehlerspeichereintrag | EN: Fault code PKS_ADAPT_ANSCHL - debounce filter decrement before fault-memory entry" VALUE 0x71C61 TKW_VV_VV_UB 100.0 FORMULA_0003 0.0 255.0000 /end CHARACTERISTIC
/begin CHARACTERISTIC K_ED_LAVK_ATIC42.DEC_VOR_EINTRAG "Filterverringerung vorm Fehlerspeichereintrag | EN: Fault code LAVK_ATIC42 - debounce filter decrement before fault-memory entry" VALUE 0x71C95 TKW_VV_VV_UB 100.0 FORMULA_0003 0.0 255.0000 /end CHARACTERISTIC
/begin CHARACTERISTIC K_ED_PT_AX.DEC_VOR_EINTRAG "Filterverringerung vorm Fehlerspeichereintrag | EN: Fault code PT_AX - debounce filter decrement before fault-memory entry" VALUE 0x71CAF TKW_VV_VV_UB 100.0 FORMULA_0003 0.0 255.0000 /end CHARACTERISTIC
/begin CHARACTERISTIC K_ED_PT_OBD_ED.DEC_VOR_EINTRAG "Filterverringerung vorm Fehlerspeichereintrag" VALUE 0x71CC9 TKW_VV_VV_UB 100.0 FORMULA_0003 0.0 255.0000 /end CHARACTERISTIC
/begin CHARACTERISTIC K_ED_MVAC_OBD.DEC_VOR_EINTRAG "Filterverringerung vorm Fehlerspeichereintrag" VALUE 0x71D4B TKW_VV_VV_UB 100.0 FORMULA_0003 0.0 255.0000 /end CHARACTERISTIC
/begin CHARACTERISTIC K_ED_LAVK2_ATIC42.DEC_VOR_EINTRAG "Filterverringerung vorm Fehlerspeichereintrag" VALUE 0x71D7F TKW_VV_VV_UB 100.0 FORMULA_0003 0.0 255.0000 /end CHARACTERISTIC
/begin CHARACTERISTIC K_ED_PSAU1.INC_NACH_EINTRAG "Filtererhoehung nach Fehlerspeichereintrag | EN: Fault code PSAU1 - debounce filter increment after fault-memory entry" VALUE 0x7094A TKW_VV_VV_UB 100.0 FORMULA_0003 0.0 255.0000 /end CHARACTERISTIC
/begin CHARACTERISTIC K_ED_PSAU2.INC_NACH_EINTRAG "Filtererhoehung nach Fehlerspeichereintrag | EN: Fault code PSAU2 - debounce filter increment after fault-memory entry" VALUE 0x70964 TKW_VV_VV_UB 100.0 FORMULA_0003 0.0 255.0000 /end CHARACTERISTIC
/begin CHARACTERISTIC K_ED_NW1_SYNC.INC_NACH_EINTRAG "Filtererhoehung nach Fehlerspeichereintrag" VALUE 0x70A4E TKW_VV_VV_UB 100.0 FORMULA_0003 0.0 255.0000 /end CHARACTERISTIC
/begin CHARACTERISTIC K_ED_NW2_SYNC.INC_NACH_EINTRAG "Filtererhoehung nach Fehlerspeichereintrag" VALUE 0x70A68 TKW_VV_VV_UB 100.0 FORMULA_0003 0.0 255.0000 /end CHARACTERISTIC
/begin CHARACTERISTIC K_ED_PCTRL_INJ.INC_NACH_EINTRAG "Filtererhoehung nach Fehlerspeichereintrag | EN: Fault code PCTRL_INJ - debounce filter increment after fault-memory entry" VALUE 0x70A82 TKW_VV_VV_UB 100.0 FORMULA_0003 0.0 255.0000 /end CHARACTERISTIC
/begin CHARACTERISTIC K_ED_PT_STATDKG.INC_NACH_EINTRAG "Filtererhoehung nach Fehlerspeichereintrag | EN: Fault code PT_STATDKG - debounce filter increment after fault-memory entry" VALUE 0x70A9C TKW_VV_VV_UB 100.0 FORMULA_0003 0.0 255.0000 /end CHARACTERISTIC
/begin CHARACTERISTIC K_ED_PKS.INC_NACH_EINTRAG "Filtererhoehung nach Fehlerspeichereintrag | EN: Fault code PKS - debounce filter increment after fault-memory entry" VALUE 0x70AB6 TKW_VV_VV_UB 100.0 FORMULA_0003 0.0 255.0000 /end CHARACTERISTIC
/begin CHARACTERISTIC K_ED_PT_STATR.INC_NACH_EINTRAG "Filtererhoehung nach Fehlerspeichereintrag | EN: Fault code PT_STATR - debounce filter increment after fault-memory entry" VALUE 0x70AD0 TKW_VV_VV_UB 100.0 FORMULA_0003 0.0 255.0000 /end CHARACTERISTIC
/begin CHARACTERISTIC K_ED_LAVK2.INC_NACH_EINTRAG "Filtererhoehung nach Fehlerspeichereintrag | EN: Fault code LAVK2 - debounce filter increment after fault-memory entry" VALUE 0x70B04 TKW_VV_VV_UB 100.0 FORMULA_0003 0.0 255.0000 /end CHARACTERISTIC
/begin CHARACTERISTIC K_ED_LAVK2_OBD_PLAU.INC_NACH_EINTRAG "Filtererhoehung nach Fehlerspeichereintrag | EN: Fault code LAVK2_OBD_PLAU - debounce filter increment after fault-memory entry" VALUE 0x70B38 TKW_VV_VV_UB 100.0 FORMULA_0003 0.0 255.0000 /end CHARACTERISTIC
/begin CHARACTERISTIC K_ED_LAVK2_OBD_SA.INC_NACH_EINTRAG "Filtererhoehung nach Fehlerspeichereintrag | EN: Fault code LAVK2_OBD_SA - debounce filter increment after fault-memory entry" VALUE 0x70B6C TKW_VV_VV_UB 100.0 FORMULA_0003 0.0 255.0000 /end CHARACTERISTIC
/begin CHARACTERISTIC K_ED_LSHNK1.INC_NACH_EINTRAG "Filtererhoehung nach Fehlerspeichereintrag | EN: Fault code LSHNK1 - debounce filter increment after fault-memory entry" VALUE 0x70BBA TKW_VV_VV_UB 100.0 FORMULA_0003 0.0 255.0000 /end CHARACTERISTIC
/begin CHARACTERISTIC K_ED_LSHNK2.INC_NACH_EINTRAG "Filtererhoehung nach Fehlerspeichereintrag | EN: Fault code LSHNK2 - debounce filter increment after fault-memory entry" VALUE 0x70BD4 TKW_VV_VV_UB 100.0 FORMULA_0003 0.0 255.0000 /end CHARACTERISTIC
/begin CHARACTERISTIC K_ED_PT_BUSOFF.INC_NACH_EINTRAG "Filtererhoehung nach Fehlerspeichereintrag | EN: Fault code PT_BUSOFF - debounce filter increment after fault-memory entry" VALUE 0x70BEE TKW_VV_VV_UB 100.0 FORMULA_0003 0.0 255.0000 /end CHARACTERISTIC
/begin CHARACTERISTIC K_ED_PT_TORQDSC.INC_NACH_EINTRAG "Filtererhoehung nach Fehlerspeichereintrag | EN: Fault code PT_TORQDSC - debounce filter increment after fault-memory entry" VALUE 0x70C08 TKW_VV_VV_UB 100.0 FORMULA_0003 0.0 255.0000 /end CHARACTERISTIC
/begin CHARACTERISTIC K_ED_PT_STDSC.INC_NACH_EINTRAG "Filtererhoehung nach Fehlerspeichereintrag | EN: Fault code PT_STDSC - debounce filter increment after fault-memory entry" VALUE 0x70C22 TKW_VV_VV_UB 100.0 FORMULA_0003 0.0 255.0000 /end CHARACTERISTIC
/begin CHARACTERISTIC K_ED_PT_ATEMP.INC_NACH_EINTRAG "Filtererhoehung nach Fehlerspeichereintrag | EN: Fault code PT_ATEMP - debounce filter increment after fault-memory entry" VALUE 0x70C70 TKW_VV_VV_UB 100.0 FORMULA_0003 0.0 255.0000 /end CHARACTERISTIC
/begin CHARACTERISTIC K_ED_PT_KLST.INC_NACH_EINTRAG "Filtererhoehung nach Fehlerspeichereintrag | EN: Fault code PT_KLST - debounce filter increment after fault-memory entry" VALUE 0x70C8A TKW_VV_VV_UB 100.0 FORMULA_0003 0.0 255.0000 /end CHARACTERISTIC
/begin CHARACTERISTIC K_ED_PT_KKOS.INC_NACH_EINTRAG "Filtererhoehung nach Fehlerspeichereintrag | EN: Fault code PT_KKOS - debounce filter increment after fault-memory entry" VALUE 0x70CA4 TKW_VV_VV_UB 100.0 FORMULA_0003 0.0 255.0000 /end CHARACTERISTIC
/begin CHARACTERISTIC K_ED_PT_LRW.INC_NACH_EINTRAG "Filtererhoehung nach Fehlerspeichereintrag | EN: Fault code PT_LRW - debounce filter increment after fault-memory entry" VALUE 0x70CBE TKW_VV_VV_UB 100.0 FORMULA_0003 0.0 255.0000 /end CHARACTERISTIC
/begin CHARACTERISTIC K_ED_LAVK2_OBD_TL.INC_NACH_EINTRAG "Filtererhoehung nach Fehlerspeichereintrag | EN: Fault code LAVK2_OBD_TL - debounce filter increment after fault-memory entry" VALUE 0x70D74 TKW_VV_VV_UB 100.0 FORMULA_0003 0.0 255.0000 /end CHARACTERISTIC
/begin CHARACTERISTIC K_ED_LSHVK1.INC_NACH_EINTRAG "Filtererhoehung nach Fehlerspeichereintrag | EN: Fault code LSHVK1 - debounce filter increment after fault-memory entry" VALUE 0x70D8E TKW_VV_VV_UB 100.0 FORMULA_0003 0.0 255.0000 /end CHARACTERISTIC
/begin CHARACTERISTIC K_ED_LSHVK2.INC_NACH_EINTRAG "Filtererhoehung nach Fehlerspeichereintrag | EN: Fault code LSHVK2 - debounce filter increment after fault-memory entry" VALUE 0x70DA8 TKW_VV_VV_UB 100.0 FORMULA_0003 0.0 255.0000 /end CHARACTERISTIC
/begin CHARACTERISTIC K_ED_LSRVK1_OBD_REG.INC_NACH_EINTRAG "Filtererhoehung nach Fehlerspeichereintrag | EN: Fault code LSRVK1_OBD_REG - debounce filter increment after fault-memory entry" VALUE 0x70DC2 TKW_VV_VV_UB 100.0 FORMULA_0003 0.0 255.0000 /end CHARACTERISTIC
/begin CHARACTERISTIC K_ED_LSRVK2_OBD_REG.INC_NACH_EINTRAG "Filtererhoehung nach Fehlerspeichereintrag | EN: Fault code LSRVK2_OBD_REG - debounce filter increment after fault-memory entry" VALUE 0x70DDC TKW_VV_VV_UB 100.0 FORMULA_0003 0.0 255.0000 /end CHARACTERISTIC
/begin CHARACTERISTIC K_ED_LSHVK1_R.INC_NACH_EINTRAG "Filtererhoehung nach Fehlerspeichereintrag | EN: Fault code LSHVK1_R - debounce filter increment after fault-memory entry" VALUE 0x70DF6 TKW_VV_VV_UB 100.0 FORMULA_0003 0.0 255.0000 /end CHARACTERISTIC
/begin CHARACTERISTIC K_ED_LSHVK2_R.INC_NACH_EINTRAG "Filtererhoehung nach Fehlerspeichereintrag | EN: Fault code LSHVK2_R - debounce filter increment after fault-memory entry" VALUE 0x70E10 TKW_VV_VV_UB 100.0 FORMULA_0003 0.0 255.0000 /end CHARACTERISTIC
/begin CHARACTERISTIC K_ED_LSRVK1_OBD_START.INC_NACH_EINTRAG "Filtererhoehung nach Fehlerspeichereintrag | EN: Fault code LSRVK1_OBD_START - debounce filter increment after fault-memory entry" VALUE 0x70E2A TKW_VV_VV_UB 100.0 FORMULA_0003 0.0 255.0000 /end CHARACTERISTIC
/begin CHARACTERISTIC K_ED_LSRVK2_OBD_START.INC_NACH_EINTRAG "Filtererhoehung nach Fehlerspeichereintrag | EN: Fault code LSRVK2_OBD_START - debounce filter increment after fault-memory entry" VALUE 0x70E44 TKW_VV_VV_UB 100.0 FORMULA_0003 0.0 255.0000 /end CHARACTERISTIC
/begin CHARACTERISTIC K_ED_LSRVK1_OBD_REF.INC_NACH_EINTRAG "Filtererhoehung nach Fehlerspeichereintrag | EN: Fault code LSRVK1_OBD_REF - debounce filter increment after fault-memory entry" VALUE 0x70E5E TKW_VV_VV_UB 100.0 FORMULA_0003 0.0 255.0000 /end CHARACTERISTIC
/begin CHARACTERISTIC K_ED_LSRVK2_OBD_REF.INC_NACH_EINTRAG "Filtererhoehung nach Fehlerspeichereintrag | EN: Fault code LSRVK2_OBD_REF - debounce filter increment after fault-memory entry" VALUE 0x70E78 TKW_VV_VV_UB 100.0 FORMULA_0003 0.0 255.0000 /end CHARACTERISTIC
/begin CHARACTERISTIC K_ED_LAVK2_DIAG.INC_NACH_EINTRAG "Filtererhoehung nach Fehlerspeichereintrag | EN: Fault code LAVK2_DIAG - debounce filter increment after fault-memory entry" VALUE 0x70EAC TKW_VV_VV_UB 100.0 FORMULA_0003 0.0 255.0000 /end CHARACTERISTIC
/begin CHARACTERISTIC K_ED_LAVK2_IA_OPENLOAD.INC_NACH_EINTRAG "Filtererhoehung nach Fehlerspeichereintrag | EN: Fault code LAVK2_IA_OPENLOAD - debounce filter increment after fault-memory entry" VALUE 0x70EE0 TKW_VV_VV_UB 100.0 FORMULA_0003 0.0 255.0000 /end CHARACTERISTIC
/begin CHARACTERISTIC K_ED_PT_GRB.INC_NACH_EINTRAG "Filtererhoehung nach Fehlerspeichereintrag | EN: Fault code PT_GRB - debounce filter increment after fault-memory entry" VALUE 0x70EFA TKW_VV_VV_UB 100.0 FORMULA_0003 0.0 255.0000 /end CHARACTERISTIC
/begin CHARACTERISTIC K_ED_PT_GRB2.INC_NACH_EINTRAG "Filtererhoehung nach Fehlerspeichereintrag | EN: Fault code PT_GRB2 - debounce filter increment after fault-memory entry" VALUE 0x70F14 TKW_VV_VV_UB 100.0 FORMULA_0003 0.0 255.0000 /end CHARACTERISTIC
/begin CHARACTERISTIC K_ED_LAVK2_UN_OPENLOAD.INC_NACH_EINTRAG "Filtererhoehung nach Fehlerspeichereintrag | EN: Fault code LAVK2_UN_OPENLOAD - debounce filter increment after fault-memory entry" VALUE 0x70F48 TKW_VV_VV_UB 100.0 FORMULA_0003 0.0 255.0000 /end CHARACTERISTIC
/begin CHARACTERISTIC K_ED_LAVK2_IP_OPENLOAD.INC_NACH_EINTRAG "Filtererhoehung nach Fehlerspeichereintrag | EN: Fault code LAVK2_IP_OPENLOAD - debounce filter increment after fault-memory entry" VALUE 0x70F7C TKW_VV_VV_UB 100.0 FORMULA_0003 0.0 255.0000 /end CHARACTERISTIC
/begin CHARACTERISTIC K_ED_LAVK2_OBD_DYN.INC_NACH_EINTRAG "Filtererhoehung nach Fehlerspeichereintrag | EN: Fault code LAVK2_OBD_DYN - debounce filter increment after fault-memory entry" VALUE 0x712D6 TKW_VV_VV_UB 100.0 FORMULA_0003 0.0 255.0000 /end CHARACTERISTIC
/begin CHARACTERISTIC K_ED_PT_CRASH.INC_NACH_EINTRAG "Filtererhoehung nach Fehlerspeichereintrag | EN: Fault code PT_CRASH - debounce filter increment after fault-memory entry" VALUE 0x712F0 TKW_VV_VV_UB 100.0 FORMULA_0003 0.0 255.0000 /end CHARACTERISTIC
/begin CHARACTERISTIC K_ED_PT_VEHMOD.INC_NACH_EINTRAG "Filtererhoehung nach Fehlerspeichereintrag | EN: Fault code PT_VEHMOD - debounce filter increment after fault-memory entry" VALUE 0x7130A TKW_VV_VV_UB 100.0 FORMULA_0003 0.0 255.0000 /end CHARACTERISTIC
/begin CHARACTERISTIC K_ED_PT_BEDFGR.INC_NACH_EINTRAG "Filtererhoehung nach Fehlerspeichereintrag | EN: Fault code PT_BEDFGR - debounce filter increment after fault-memory entry" VALUE 0x71324 TKW_VV_VV_UB 100.0 FORMULA_0003 0.0 255.0000 /end CHARACTERISTIC
/begin CHARACTERISTIC K_ED_LAVK2_TRIM.INC_NACH_EINTRAG "Filtererhoehung nach Fehlerspeichereintrag | EN: Fault code LAVK2_TRIM - debounce filter increment after fault-memory entry" VALUE 0x713F4 TKW_VV_VV_UB 100.0 FORMULA_0003 0.0 255.0000 /end CHARACTERISTIC
/begin CHARACTERISTIC K_ED_PT_KM.INC_NACH_EINTRAG "Filtererhoehung nach Fehlerspeichereintrag | EN: Fault code PT_KM - debounce filter increment after fault-memory entry" VALUE 0x714AA TKW_VV_VV_UB 100.0 FORMULA_0003 0.0 255.0000 /end CHARACTERISTIC
/begin CHARACTERISTIC K_ED_PT_KOMBI.INC_NACH_EINTRAG "Filtererhoehung nach Fehlerspeichereintrag | EN: Fault code PT_KOMBI - debounce filter increment after fault-memory entry" VALUE 0x714C4 TKW_VV_VV_UB 100.0 FORMULA_0003 0.0 255.0000 /end CHARACTERISTIC
/begin CHARACTERISTIC K_ED_PKS_LL.INC_NACH_EINTRAG "Filtererhoehung nach Fehlerspeichereintrag | EN: Fault code PKS_LL - debounce filter increment after fault-memory entry" VALUE 0x714DE TKW_VV_VV_UB 100.0 FORMULA_0003 0.0 255.0000 /end CHARACTERISTIC
/begin CHARACTERISTIC K_ED_PKS_TL.INC_NACH_EINTRAG "Filtererhoehung nach Fehlerspeichereintrag | EN: Fault code PKS_TL - debounce filter increment after fault-memory entry" VALUE 0x714F8 TKW_VV_VV_UB 100.0 FORMULA_0003 0.0 255.0000 /end CHARACTERISTIC
/begin CHARACTERISTIC K_ED_PKS_Q.INC_NACH_EINTRAG "Filtererhoehung nach Fehlerspeichereintrag | EN: Fault code PKS_Q - debounce filter increment after fault-memory entry" VALUE 0x71512 TKW_VV_VV_UB 100.0 FORMULA_0003 0.0 255.0000 /end CHARACTERISTIC
/begin CHARACTERISTIC K_ED_MVAC_DRUCKSENSOR.INC_NACH_EINTRAG "Filtererhoehung nach Fehlerspeichereintrag | EN: Fault code MVAC_DRUCKSENSOR - debounce filter increment after fault-memory entry" VALUE 0x7164A TKW_VV_VV_UB 100.0 FORMULA_0003 0.0 255.0000 /end CHARACTERISTIC
/begin CHARACTERISTIC K_ED_PT_BEDAT.INC_NACH_EINTRAG "Filtererhoehung nach Fehlerspeichereintrag | EN: Fault code PT_BEDAT - debounce filter increment after fault-memory entry" VALUE 0x71664 TKW_VV_VV_UB 100.0 FORMULA_0003 0.0 255.0000 /end CHARACTERISTIC
/begin CHARACTERISTIC K_ED_PT_STATANH.INC_NACH_EINTRAG "Filtererhoehung nach Fehlerspeichereintrag | EN: Fault code PT_STATANH - debounce filter increment after fault-memory entry" VALUE 0x71A0C TKW_VV_VV_UB 100.0 FORMULA_0003 0.0 255.0000 /end CHARACTERISTIC
/begin CHARACTERISTIC K_ED_PT_STATGRB.INC_NACH_EINTRAG "Filtererhoehung nach Fehlerspeichereintrag" VALUE 0x71A8E TKW_VV_VV_UB 100.0 FORMULA_0003 0.0 255.0000 /end CHARACTERISTIC
/begin CHARACTERISTIC K_ED_PT_ANFRADMOM.INC_NACH_EINTRAG "Filtererhoehung nach Fehlerspeichereintrag | EN: Fault code PT_ANFRADMOM - debounce filter increment after fault-memory entry" VALUE 0x71AA8 TKW_VV_VV_UB 100.0 FORMULA_0003 0.0 255.0000 /end CHARACTERISTIC
/begin CHARACTERISTIC K_ED_PT_TOMA.INC_NACH_EINTRAG "Filtererhoehung nach Fehlerspeichereintrag | EN: Fault code PT_TOMA - debounce filter increment after fault-memory entry" VALUE 0x71AF6 TKW_VV_VV_UB 100.0 FORMULA_0003 0.0 255.0000 /end CHARACTERISTIC
/begin CHARACTERISTIC K_ED_LSHNK1_R.INC_NACH_EINTRAG "Filtererhoehung nach Fehlerspeichereintrag | EN: Fault code LSHNK1_R - debounce filter increment after fault-memory entry" VALUE 0x71BFA TKW_VV_VV_UB 100.0 FORMULA_0003 0.0 255.0000 /end CHARACTERISTIC
/begin CHARACTERISTIC K_ED_LSHNK2_R.INC_NACH_EINTRAG "Filtererhoehung nach Fehlerspeichereintrag | EN: Fault code LSHNK2_R - debounce filter increment after fault-memory entry" VALUE 0x71C14 TKW_VV_VV_UB 100.0 FORMULA_0003 0.0 255.0000 /end CHARACTERISTIC
/begin CHARACTERISTIC K_ED_PKS_MODELL.INC_NACH_EINTRAG "Filtererhoehung nach Fehlerspeichereintrag | EN: Fault code PKS_MODELL - debounce filter increment after fault-memory entry" VALUE 0x71C2E TKW_VV_VV_UB 100.0 FORMULA_0003 0.0 255.0000 /end CHARACTERISTIC
/begin CHARACTERISTIC K_ED_PKS_PAUFBAU.INC_NACH_EINTRAG "Filtererhoehung nach Fehlerspeichereintrag | EN: Fault code PKS_PAUFBAU - debounce filter increment after fault-memory entry" VALUE 0x71C48 TKW_VV_VV_UB 100.0 FORMULA_0003 0.0 255.0000 /end CHARACTERISTIC
/begin CHARACTERISTIC K_ED_PKS_ADAPT_ANSCHL.INC_NACH_EINTRAG "Filtererhoehung nach Fehlerspeichereintrag | EN: Fault code PKS_ADAPT_ANSCHL - debounce filter increment after fault-memory entry" VALUE 0x71C62 TKW_VV_VV_UB 100.0 FORMULA_0003 0.0 255.0000 /end CHARACTERISTIC
/begin CHARACTERISTIC K_ED_LAVK_ATIC42.INC_NACH_EINTRAG "Filtererhoehung nach Fehlerspeichereintrag | EN: Fault code LAVK_ATIC42 - debounce filter increment after fault-memory entry" VALUE 0x71C96 TKW_VV_VV_UB 100.0 FORMULA_0003 0.0 255.0000 /end CHARACTERISTIC
/begin CHARACTERISTIC K_ED_PT_AX.INC_NACH_EINTRAG "Filtererhoehung nach Fehlerspeichereintrag | EN: Fault code PT_AX - debounce filter increment after fault-memory entry" VALUE 0x71CB0 TKW_VV_VV_UB 100.0 FORMULA_0003 0.0 255.0000 /end CHARACTERISTIC
/begin CHARACTERISTIC K_ED_PT_OBD_ED.INC_NACH_EINTRAG "Filtererhoehung nach Fehlerspeichereintrag" VALUE 0x71CCA TKW_VV_VV_UB 100.0 FORMULA_0003 0.0 255.0000 /end CHARACTERISTIC
/begin CHARACTERISTIC K_ED_MVAC_OBD.INC_NACH_EINTRAG "Filtererhoehung nach Fehlerspeichereintrag" VALUE 0x71D4C TKW_VV_VV_UB 100.0 FORMULA_0003 0.0 255.0000 /end CHARACTERISTIC
/begin CHARACTERISTIC K_ED_LAVK2_ATIC42.INC_NACH_EINTRAG "Filtererhoehung nach Fehlerspeichereintrag" VALUE 0x71D80 TKW_VV_VV_UB 100.0 FORMULA_0003 0.0 255.0000 /end CHARACTERISTIC
/begin CHARACTERISTIC K_ED_PSAU1.DEC_NACH_EINTRAG "Filterverringerung nach Fehlerspeichereintrag | EN: Fault code PSAU1 - debounce filter decrement after fault-memory entry" VALUE 0x7094B TKW_VV_VV_UB 100.0 FORMULA_0003 0.0 255.0000 /end CHARACTERISTIC
/begin CHARACTERISTIC K_ED_PSAU2.DEC_NACH_EINTRAG "Filterverringerung nach Fehlerspeichereintrag | EN: Fault code PSAU2 - debounce filter decrement after fault-memory entry" VALUE 0x70965 TKW_VV_VV_UB 100.0 FORMULA_0003 0.0 255.0000 /end CHARACTERISTIC
/begin CHARACTERISTIC K_ED_NW1_SYNC.DEC_NACH_EINTRAG "Filterverringerung nach Fehlerspeichereintrag" VALUE 0x70A4F TKW_VV_VV_UB 100.0 FORMULA_0003 0.0 255.0000 /end CHARACTERISTIC
/begin CHARACTERISTIC K_ED_NW2_SYNC.DEC_NACH_EINTRAG "Filterverringerung nach Fehlerspeichereintrag" VALUE 0x70A69 TKW_VV_VV_UB 100.0 FORMULA_0003 0.0 255.0000 /end CHARACTERISTIC
/begin CHARACTERISTIC K_ED_PCTRL_INJ.DEC_NACH_EINTRAG "Filterverringerung nach Fehlerspeichereintrag | EN: Fault code PCTRL_INJ - debounce filter decrement after fault-memory entry" VALUE 0x70A83 TKW_VV_VV_UB 100.0 FORMULA_0003 0.0 255.0000 /end CHARACTERISTIC
/begin CHARACTERISTIC K_ED_PT_STATDKG.DEC_NACH_EINTRAG "Filterverringerung nach Fehlerspeichereintrag | EN: Fault code PT_STATDKG - debounce filter decrement after fault-memory entry" VALUE 0x70A9D TKW_VV_VV_UB 100.0 FORMULA_0003 0.0 255.0000 /end CHARACTERISTIC
/begin CHARACTERISTIC K_ED_PKS.DEC_NACH_EINTRAG "Filterverringerung nach Fehlerspeichereintrag | EN: Fault code PKS - debounce filter decrement after fault-memory entry" VALUE 0x70AB7 TKW_VV_VV_UB 100.0 FORMULA_0003 0.0 255.0000 /end CHARACTERISTIC
/begin CHARACTERISTIC K_ED_PT_STATR.DEC_NACH_EINTRAG "Filterverringerung nach Fehlerspeichereintrag | EN: Fault code PT_STATR - debounce filter decrement after fault-memory entry" VALUE 0x70AD1 TKW_VV_VV_UB 100.0 FORMULA_0003 0.0 255.0000 /end CHARACTERISTIC
/begin CHARACTERISTIC K_ED_LAVK2.DEC_NACH_EINTRAG "Filterverringerung nach Fehlerspeichereintrag | EN: Fault code LAVK2 - debounce filter decrement after fault-memory entry" VALUE 0x70B05 TKW_VV_VV_UB 100.0 FORMULA_0003 0.0 255.0000 /end CHARACTERISTIC
/begin CHARACTERISTIC K_ED_LAVK2_OBD_PLAU.DEC_NACH_EINTRAG "Filterverringerung nach Fehlerspeichereintrag | EN: Fault code LAVK2_OBD_PLAU - debounce filter decrement after fault-memory entry" VALUE 0x70B39 TKW_VV_VV_UB 100.0 FORMULA_0003 0.0 255.0000 /end CHARACTERISTIC
/begin CHARACTERISTIC K_ED_LAVK2_OBD_SA.DEC_NACH_EINTRAG "Filterverringerung nach Fehlerspeichereintrag | EN: Fault code LAVK2_OBD_SA - debounce filter decrement after fault-memory entry" VALUE 0x70B6D TKW_VV_VV_UB 100.0 FORMULA_0003 0.0 255.0000 /end CHARACTERISTIC
/begin CHARACTERISTIC K_ED_LSHNK1.DEC_NACH_EINTRAG "Filterverringerung nach Fehlerspeichereintrag | EN: Fault code LSHNK1 - debounce filter decrement after fault-memory entry" VALUE 0x70BBB TKW_VV_VV_UB 100.0 FORMULA_0003 0.0 255.0000 /end CHARACTERISTIC
/begin CHARACTERISTIC K_ED_LSHNK2.DEC_NACH_EINTRAG "Filterverringerung nach Fehlerspeichereintrag | EN: Fault code LSHNK2 - debounce filter decrement after fault-memory entry" VALUE 0x70BD5 TKW_VV_VV_UB 100.0 FORMULA_0003 0.0 255.0000 /end CHARACTERISTIC
/begin CHARACTERISTIC K_ED_PT_BUSOFF.DEC_NACH_EINTRAG "Filterverringerung nach Fehlerspeichereintrag | EN: Fault code PT_BUSOFF - debounce filter decrement after fault-memory entry" VALUE 0x70BEF TKW_VV_VV_UB 100.0 FORMULA_0003 0.0 255.0000 /end CHARACTERISTIC
/begin CHARACTERISTIC K_ED_PT_TORQDSC.DEC_NACH_EINTRAG "Filterverringerung nach Fehlerspeichereintrag | EN: Fault code PT_TORQDSC - debounce filter decrement after fault-memory entry" VALUE 0x70C09 TKW_VV_VV_UB 100.0 FORMULA_0003 0.0 255.0000 /end CHARACTERISTIC
/begin CHARACTERISTIC K_ED_PT_STDSC.DEC_NACH_EINTRAG "Filterverringerung nach Fehlerspeichereintrag | EN: Fault code PT_STDSC - debounce filter decrement after fault-memory entry" VALUE 0x70C23 TKW_VV_VV_UB 100.0 FORMULA_0003 0.0 255.0000 /end CHARACTERISTIC
/begin CHARACTERISTIC K_ED_PT_ATEMP.DEC_NACH_EINTRAG "Filterverringerung nach Fehlerspeichereintrag | EN: Fault code PT_ATEMP - debounce filter decrement after fault-memory entry" VALUE 0x70C71 TKW_VV_VV_UB 100.0 FORMULA_0003 0.0 255.0000 /end CHARACTERISTIC
/begin CHARACTERISTIC K_ED_PT_KLST.DEC_NACH_EINTRAG "Filterverringerung nach Fehlerspeichereintrag | EN: Fault code PT_KLST - debounce filter decrement after fault-memory entry" VALUE 0x70C8B TKW_VV_VV_UB 100.0 FORMULA_0003 0.0 255.0000 /end CHARACTERISTIC
/begin CHARACTERISTIC K_ED_PT_KKOS.DEC_NACH_EINTRAG "Filterverringerung nach Fehlerspeichereintrag | EN: Fault code PT_KKOS - debounce filter decrement after fault-memory entry" VALUE 0x70CA5 TKW_VV_VV_UB 100.0 FORMULA_0003 0.0 255.0000 /end CHARACTERISTIC
/begin CHARACTERISTIC K_ED_PT_LRW.DEC_NACH_EINTRAG "Filterverringerung nach Fehlerspeichereintrag | EN: Fault code PT_LRW - debounce filter decrement after fault-memory entry" VALUE 0x70CBF TKW_VV_VV_UB 100.0 FORMULA_0003 0.0 255.0000 /end CHARACTERISTIC
/begin CHARACTERISTIC K_ED_LAVK2_OBD_TL.DEC_NACH_EINTRAG "Filterverringerung nach Fehlerspeichereintrag | EN: Fault code LAVK2_OBD_TL - debounce filter decrement after fault-memory entry" VALUE 0x70D75 TKW_VV_VV_UB 100.0 FORMULA_0003 0.0 255.0000 /end CHARACTERISTIC
/begin CHARACTERISTIC K_ED_LSHVK1.DEC_NACH_EINTRAG "Filterverringerung nach Fehlerspeichereintrag | EN: Fault code LSHVK1 - debounce filter decrement after fault-memory entry" VALUE 0x70D8F TKW_VV_VV_UB 100.0 FORMULA_0003 0.0 255.0000 /end CHARACTERISTIC
/begin CHARACTERISTIC K_ED_LSHVK2.DEC_NACH_EINTRAG "Filterverringerung nach Fehlerspeichereintrag | EN: Fault code LSHVK2 - debounce filter decrement after fault-memory entry" VALUE 0x70DA9 TKW_VV_VV_UB 100.0 FORMULA_0003 0.0 255.0000 /end CHARACTERISTIC
/begin CHARACTERISTIC K_ED_LSRVK1_OBD_REG.DEC_NACH_EINTRAG "Filterverringerung nach Fehlerspeichereintrag | EN: Fault code LSRVK1_OBD_REG - debounce filter decrement after fault-memory entry" VALUE 0x70DC3 TKW_VV_VV_UB 100.0 FORMULA_0003 0.0 255.0000 /end CHARACTERISTIC
/begin CHARACTERISTIC K_ED_LSRVK2_OBD_REG.DEC_NACH_EINTRAG "Filterverringerung nach Fehlerspeichereintrag | EN: Fault code LSRVK2_OBD_REG - debounce filter decrement after fault-memory entry" VALUE 0x70DDD TKW_VV_VV_UB 100.0 FORMULA_0003 0.0 255.0000 /end CHARACTERISTIC
/begin CHARACTERISTIC K_ED_LSHVK1_R.DEC_NACH_EINTRAG "Filterverringerung nach Fehlerspeichereintrag | EN: Fault code LSHVK1_R - debounce filter decrement after fault-memory entry" VALUE 0x70DF7 TKW_VV_VV_UB 100.0 FORMULA_0003 0.0 255.0000 /end CHARACTERISTIC
/begin CHARACTERISTIC K_ED_LSHVK2_R.DEC_NACH_EINTRAG "Filterverringerung nach Fehlerspeichereintrag | EN: Fault code LSHVK2_R - debounce filter decrement after fault-memory entry" VALUE 0x70E11 TKW_VV_VV_UB 100.0 FORMULA_0003 0.0 255.0000 /end CHARACTERISTIC
/begin CHARACTERISTIC K_ED_LSRVK1_OBD_START.DEC_NACH_EINTRAG "Filterverringerung nach Fehlerspeichereintrag | EN: Fault code LSRVK1_OBD_START - debounce filter decrement after fault-memory entry" VALUE 0x70E2B TKW_VV_VV_UB 100.0 FORMULA_0003 0.0 255.0000 /end CHARACTERISTIC
/begin CHARACTERISTIC K_ED_LSRVK2_OBD_START.DEC_NACH_EINTRAG "Filterverringerung nach Fehlerspeichereintrag | EN: Fault code LSRVK2_OBD_START - debounce filter decrement after fault-memory entry" VALUE 0x70E45 TKW_VV_VV_UB 100.0 FORMULA_0003 0.0 255.0000 /end CHARACTERISTIC
/begin CHARACTERISTIC K_ED_LSRVK1_OBD_REF.DEC_NACH_EINTRAG "Filterverringerung nach Fehlerspeichereintrag | EN: Fault code LSRVK1_OBD_REF - debounce filter decrement after fault-memory entry" VALUE 0x70E5F TKW_VV_VV_UB 100.0 FORMULA_0003 0.0 255.0000 /end CHARACTERISTIC
/begin CHARACTERISTIC K_ED_LSRVK2_OBD_REF.DEC_NACH_EINTRAG "Filterverringerung nach Fehlerspeichereintrag | EN: Fault code LSRVK2_OBD_REF - debounce filter decrement after fault-memory entry" VALUE 0x70E79 TKW_VV_VV_UB 100.0 FORMULA_0003 0.0 255.0000 /end CHARACTERISTIC
/begin CHARACTERISTIC K_ED_LAVK2_DIAG.DEC_NACH_EINTRAG "Filterverringerung nach Fehlerspeichereintrag | EN: Fault code LAVK2_DIAG - debounce filter decrement after fault-memory entry" VALUE 0x70EAD TKW_VV_VV_UB 100.0 FORMULA_0003 0.0 255.0000 /end CHARACTERISTIC
/begin CHARACTERISTIC K_ED_LAVK2_IA_OPENLOAD.DEC_NACH_EINTRAG "Filterverringerung nach Fehlerspeichereintrag | EN: Fault code LAVK2_IA_OPENLOAD - debounce filter decrement after fault-memory entry" VALUE 0x70EE1 TKW_VV_VV_UB 100.0 FORMULA_0003 0.0 255.0000 /end CHARACTERISTIC
/begin CHARACTERISTIC K_ED_PT_GRB.DEC_NACH_EINTRAG "Filterverringerung nach Fehlerspeichereintrag | EN: Fault code PT_GRB - debounce filter decrement after fault-memory entry" VALUE 0x70EFB TKW_VV_VV_UB 100.0 FORMULA_0003 0.0 255.0000 /end CHARACTERISTIC
/begin CHARACTERISTIC K_ED_PT_GRB2.DEC_NACH_EINTRAG "Filterverringerung nach Fehlerspeichereintrag | EN: Fault code PT_GRB2 - debounce filter decrement after fault-memory entry" VALUE 0x70F15 TKW_VV_VV_UB 100.0 FORMULA_0003 0.0 255.0000 /end CHARACTERISTIC
/begin CHARACTERISTIC K_ED_LAVK2_UN_OPENLOAD.DEC_NACH_EINTRAG "Filterverringerung nach Fehlerspeichereintrag | EN: Fault code LAVK2_UN_OPENLOAD - debounce filter decrement after fault-memory entry" VALUE 0x70F49 TKW_VV_VV_UB 100.0 FORMULA_0003 0.0 255.0000 /end CHARACTERISTIC
/begin CHARACTERISTIC K_ED_LAVK2_IP_OPENLOAD.DEC_NACH_EINTRAG "Filterverringerung nach Fehlerspeichereintrag | EN: Fault code LAVK2_IP_OPENLOAD - debounce filter decrement after fault-memory entry" VALUE 0x70F7D TKW_VV_VV_UB 100.0 FORMULA_0003 0.0 255.0000 /end CHARACTERISTIC
/begin CHARACTERISTIC K_ED_LAVK2_OBD_DYN.DEC_NACH_EINTRAG "Filterverringerung nach Fehlerspeichereintrag | EN: Fault code LAVK2_OBD_DYN - debounce filter decrement after fault-memory entry" VALUE 0x712D7 TKW_VV_VV_UB 100.0 FORMULA_0003 0.0 255.0000 /end CHARACTERISTIC
/begin CHARACTERISTIC K_ED_PT_CRASH.DEC_NACH_EINTRAG "Filterverringerung nach Fehlerspeichereintrag | EN: Fault code PT_CRASH - debounce filter decrement after fault-memory entry" VALUE 0x712F1 TKW_VV_VV_UB 100.0 FORMULA_0003 0.0 255.0000 /end CHARACTERISTIC
/begin CHARACTERISTIC K_ED_PT_VEHMOD.DEC_NACH_EINTRAG "Filterverringerung nach Fehlerspeichereintrag | EN: Fault code PT_VEHMOD - debounce filter decrement after fault-memory entry" VALUE 0x7130B TKW_VV_VV_UB 100.0 FORMULA_0003 0.0 255.0000 /end CHARACTERISTIC
/begin CHARACTERISTIC K_ED_PT_BEDFGR.DEC_NACH_EINTRAG "Filterverringerung nach Fehlerspeichereintrag | EN: Fault code PT_BEDFGR - debounce filter decrement after fault-memory entry" VALUE 0x71325 TKW_VV_VV_UB 100.0 FORMULA_0003 0.0 255.0000 /end CHARACTERISTIC
/begin CHARACTERISTIC K_ED_LAVK2_TRIM.DEC_NACH_EINTRAG "Filterverringerung nach Fehlerspeichereintrag | EN: Fault code LAVK2_TRIM - debounce filter decrement after fault-memory entry" VALUE 0x713F5 TKW_VV_VV_UB 100.0 FORMULA_0003 0.0 255.0000 /end CHARACTERISTIC
/begin CHARACTERISTIC K_ED_PT_KM.DEC_NACH_EINTRAG "Filterverringerung nach Fehlerspeichereintrag | EN: Fault code PT_KM - debounce filter decrement after fault-memory entry" VALUE 0x714AB TKW_VV_VV_UB 100.0 FORMULA_0003 0.0 255.0000 /end CHARACTERISTIC
/begin CHARACTERISTIC K_ED_PT_KOMBI.DEC_NACH_EINTRAG "Filterverringerung nach Fehlerspeichereintrag | EN: Fault code PT_KOMBI - debounce filter decrement after fault-memory entry" VALUE 0x714C5 TKW_VV_VV_UB 100.0 FORMULA_0003 0.0 255.0000 /end CHARACTERISTIC
/begin CHARACTERISTIC K_ED_PKS_LL.DEC_NACH_EINTRAG "Filterverringerung nach Fehlerspeichereintrag | EN: Fault code PKS_LL - debounce filter decrement after fault-memory entry" VALUE 0x714DF TKW_VV_VV_UB 100.0 FORMULA_0003 0.0 255.0000 /end CHARACTERISTIC
/begin CHARACTERISTIC K_ED_PKS_TL.DEC_NACH_EINTRAG "Filterverringerung nach Fehlerspeichereintrag | EN: Fault code PKS_TL - debounce filter decrement after fault-memory entry" VALUE 0x714F9 TKW_VV_VV_UB 100.0 FORMULA_0003 0.0 255.0000 /end CHARACTERISTIC
/begin CHARACTERISTIC K_ED_PKS_Q.DEC_NACH_EINTRAG "Filterverringerung nach Fehlerspeichereintrag | EN: Fault code PKS_Q - debounce filter decrement after fault-memory entry" VALUE 0x71513 TKW_VV_VV_UB 100.0 FORMULA_0003 0.0 255.0000 /end CHARACTERISTIC
/begin CHARACTERISTIC K_ED_MVAC_DRUCKSENSOR.DEC_NACH_EINTRAG "Filterverringerung nach Fehlerspeichereintrag | EN: Fault code MVAC_DRUCKSENSOR - debounce filter decrement after fault-memory entry" VALUE 0x7164B TKW_VV_VV_UB 100.0 FORMULA_0003 0.0 255.0000 /end CHARACTERISTIC
/begin CHARACTERISTIC K_ED_PT_BEDAT.DEC_NACH_EINTRAG "Filterverringerung nach Fehlerspeichereintrag | EN: Fault code PT_BEDAT - debounce filter decrement after fault-memory entry" VALUE 0x71665 TKW_VV_VV_UB 100.0 FORMULA_0003 0.0 255.0000 /end CHARACTERISTIC
/begin CHARACTERISTIC K_ED_PT_STATANH.DEC_NACH_EINTRAG "Filterverringerung nach Fehlerspeichereintrag | EN: Fault code PT_STATANH - debounce filter decrement after fault-memory entry" VALUE 0x71A0D TKW_VV_VV_UB 100.0 FORMULA_0003 0.0 255.0000 /end CHARACTERISTIC
/begin CHARACTERISTIC K_ED_PT_STATGRB.DEC_NACH_EINTRAG "Filterverringerung nach Fehlerspeichereintrag" VALUE 0x71A8F TKW_VV_VV_UB 100.0 FORMULA_0003 0.0 255.0000 /end CHARACTERISTIC
/begin CHARACTERISTIC K_ED_PT_ANFRADMOM.DEC_NACH_EINTRAG "Filterverringerung nach Fehlerspeichereintrag | EN: Fault code PT_ANFRADMOM - debounce filter decrement after fault-memory entry" VALUE 0x71AA9 TKW_VV_VV_UB 100.0 FORMULA_0003 0.0 255.0000 /end CHARACTERISTIC
/begin CHARACTERISTIC K_ED_PT_TOMA.DEC_NACH_EINTRAG "Filterverringerung nach Fehlerspeichereintrag | EN: Fault code PT_TOMA - debounce filter decrement after fault-memory entry" VALUE 0x71AF7 TKW_VV_VV_UB 100.0 FORMULA_0003 0.0 255.0000 /end CHARACTERISTIC
/begin CHARACTERISTIC K_ED_LSHNK1_R.DEC_NACH_EINTRAG "Filterverringerung nach Fehlerspeichereintrag | EN: Fault code LSHNK1_R - debounce filter decrement after fault-memory entry" VALUE 0x71BFB TKW_VV_VV_UB 100.0 FORMULA_0003 0.0 255.0000 /end CHARACTERISTIC
/begin CHARACTERISTIC K_ED_LSHNK2_R.DEC_NACH_EINTRAG "Filterverringerung nach Fehlerspeichereintrag | EN: Fault code LSHNK2_R - debounce filter decrement after fault-memory entry" VALUE 0x71C15 TKW_VV_VV_UB 100.0 FORMULA_0003 0.0 255.0000 /end CHARACTERISTIC
/begin CHARACTERISTIC K_ED_PKS_MODELL.DEC_NACH_EINTRAG "Filterverringerung nach Fehlerspeichereintrag | EN: Fault code PKS_MODELL - debounce filter decrement after fault-memory entry" VALUE 0x71C2F TKW_VV_VV_UB 100.0 FORMULA_0003 0.0 255.0000 /end CHARACTERISTIC
/begin CHARACTERISTIC K_ED_PKS_PAUFBAU.DEC_NACH_EINTRAG "Filterverringerung nach Fehlerspeichereintrag | EN: Fault code PKS_PAUFBAU - debounce filter decrement after fault-memory entry" VALUE 0x71C49 TKW_VV_VV_UB 100.0 FORMULA_0003 0.0 255.0000 /end CHARACTERISTIC
/begin CHARACTERISTIC K_ED_PKS_ADAPT_ANSCHL.DEC_NACH_EINTRAG "Filterverringerung nach Fehlerspeichereintrag | EN: Fault code PKS_ADAPT_ANSCHL - debounce filter decrement after fault-memory entry" VALUE 0x71C63 TKW_VV_VV_UB 100.0 FORMULA_0003 0.0 255.0000 /end CHARACTERISTIC
/begin CHARACTERISTIC K_ED_LAVK_ATIC42.DEC_NACH_EINTRAG "Filterverringerung nach Fehlerspeichereintrag | EN: Fault code LAVK_ATIC42 - debounce filter decrement after fault-memory entry" VALUE 0x71C97 TKW_VV_VV_UB 100.0 FORMULA_0003 0.0 255.0000 /end CHARACTERISTIC
/begin CHARACTERISTIC K_ED_PT_AX.DEC_NACH_EINTRAG "Filterverringerung nach Fehlerspeichereintrag | EN: Fault code PT_AX - debounce filter decrement after fault-memory entry" VALUE 0x71CB1 TKW_VV_VV_UB 100.0 FORMULA_0003 0.0 255.0000 /end CHARACTERISTIC
/begin CHARACTERISTIC K_ED_PT_OBD_ED.DEC_NACH_EINTRAG "Filterverringerung nach Fehlerspeichereintrag" VALUE 0x71CCB TKW_VV_VV_UB 100.0 FORMULA_0003 0.0 255.0000 /end CHARACTERISTIC
/begin CHARACTERISTIC K_ED_MVAC_OBD.DEC_NACH_EINTRAG "Filterverringerung nach Fehlerspeichereintrag" VALUE 0x71D4D TKW_VV_VV_UB 100.0 FORMULA_0003 0.0 255.0000 /end CHARACTERISTIC
/begin CHARACTERISTIC K_ED_LAVK2_ATIC42.DEC_NACH_EINTRAG "Filterverringerung nach Fehlerspeichereintrag" VALUE 0x71D81 TKW_VV_VV_UB 100.0 FORMULA_0003 0.0 255.0000 /end CHARACTERISTIC
/begin CHARACTERISTIC K_ED_PSAU1.KLASSENINDEX "Auswahl der Fehlerklasse | EN: Fault code PSAU1 - fault class selection (lamp / warning behaviour)" VALUE 0x7094C TKW_VV_VV_UB 100.0 FORMULA_0003 0.0 8.0000 /end CHARACTERISTIC
/begin CHARACTERISTIC K_ED_PSAU2.KLASSENINDEX "Auswahl der Fehlerklasse | EN: Fault code PSAU2 - fault class selection (lamp / warning behaviour)" VALUE 0x70966 TKW_VV_VV_UB 100.0 FORMULA_0003 0.0 8.0000 /end CHARACTERISTIC
/begin CHARACTERISTIC K_ED_NW1_SYNC.KLASSENINDEX "Auswahl der Fehlerklasse" VALUE 0x70A50 TKW_VV_VV_UB 100.0 FORMULA_0003 0.0 8.0000 /end CHARACTERISTIC
/begin CHARACTERISTIC K_ED_NW2_SYNC.KLASSENINDEX "Auswahl der Fehlerklasse" VALUE 0x70A6A TKW_VV_VV_UB 100.0 FORMULA_0003 0.0 8.0000 /end CHARACTERISTIC
/begin CHARACTERISTIC K_ED_PCTRL_INJ.KLASSENINDEX "Auswahl der Fehlerklasse | EN: Fault code PCTRL_INJ - fault class selection (lamp / warning behaviour)" VALUE 0x70A84 TKW_VV_VV_UB 100.0 FORMULA_0003 0.0 8.0000 /end CHARACTERISTIC
/begin CHARACTERISTIC K_ED_PT_STATDKG.KLASSENINDEX "Auswahl der Fehlerklasse | EN: Fault code PT_STATDKG - fault class selection (lamp / warning behaviour)" VALUE 0x70A9E TKW_VV_VV_UB 100.0 FORMULA_0003 0.0 8.0000 /end CHARACTERISTIC
/begin CHARACTERISTIC K_ED_PKS.KLASSENINDEX "Auswahl der Fehlerklasse | EN: Fault code PKS - fault class selection (lamp / warning behaviour)" VALUE 0x70AB8 TKW_VV_VV_UB 100.0 FORMULA_0003 0.0 8.0000 /end CHARACTERISTIC
/begin CHARACTERISTIC K_ED_PT_STATR.KLASSENINDEX "Auswahl der Fehlerklasse | EN: Fault code PT_STATR - fault class selection (lamp / warning behaviour)" VALUE 0x70AD2 TKW_VV_VV_UB 100.0 FORMULA_0003 0.0 8.0000 /end CHARACTERISTIC
/begin CHARACTERISTIC K_ED_LAVK2.KLASSENINDEX "Auswahl der Fehlerklasse | EN: Fault code LAVK2 - fault class selection (lamp / warning behaviour)" VALUE 0x70B06 TKW_VV_VV_UB 100.0 FORMULA_0003 0.0 8.0000 /end CHARACTERISTIC
/begin CHARACTERISTIC K_ED_LAVK2_OBD_PLAU.KLASSENINDEX "Auswahl der Fehlerklasse | EN: Fault code LAVK2_OBD_PLAU - fault class selection (lamp / warning behaviour)" VALUE 0x70B3A TKW_VV_VV_UB 100.0 FORMULA_0003 0.0 8.0000 /end CHARACTERISTIC
/begin CHARACTERISTIC K_ED_LAVK2_OBD_SA.KLASSENINDEX "Auswahl der Fehlerklasse | EN: Fault code LAVK2_OBD_SA - fault class selection (lamp / warning behaviour)" VALUE 0x70B6E TKW_VV_VV_UB 100.0 FORMULA_0003 0.0 8.0000 /end CHARACTERISTIC
/begin CHARACTERISTIC K_ED_LSHNK1.KLASSENINDEX "Auswahl der Fehlerklasse | EN: Fault code LSHNK1 - fault class selection (lamp / warning behaviour)" VALUE 0x70BBC TKW_VV_VV_UB 100.0 FORMULA_0003 0.0 8.0000 /end CHARACTERISTIC
/begin CHARACTERISTIC K_ED_LSHNK2.KLASSENINDEX "Auswahl der Fehlerklasse | EN: Fault code LSHNK2 - fault class selection (lamp / warning behaviour)" VALUE 0x70BD6 TKW_VV_VV_UB 100.0 FORMULA_0003 0.0 8.0000 /end CHARACTERISTIC
/begin CHARACTERISTIC K_ED_PT_BUSOFF.KLASSENINDEX "Auswahl der Fehlerklasse | EN: Fault code PT_BUSOFF - fault class selection (lamp / warning behaviour)" VALUE 0x70BF0 TKW_VV_VV_UB 100.0 FORMULA_0003 0.0 8.0000 /end CHARACTERISTIC
/begin CHARACTERISTIC K_ED_PT_TORQDSC.KLASSENINDEX "Auswahl der Fehlerklasse | EN: Fault code PT_TORQDSC - fault class selection (lamp / warning behaviour)" VALUE 0x70C0A TKW_VV_VV_UB 100.0 FORMULA_0003 0.0 8.0000 /end CHARACTERISTIC
/begin CHARACTERISTIC K_ED_PT_STDSC.KLASSENINDEX "Auswahl der Fehlerklasse | EN: Fault code PT_STDSC - fault class selection (lamp / warning behaviour)" VALUE 0x70C24 TKW_VV_VV_UB 100.0 FORMULA_0003 0.0 8.0000 /end CHARACTERISTIC
/begin CHARACTERISTIC K_ED_PT_ATEMP.KLASSENINDEX "Auswahl der Fehlerklasse | EN: Fault code PT_ATEMP - fault class selection (lamp / warning behaviour)" VALUE 0x70C72 TKW_VV_VV_UB 100.0 FORMULA_0003 0.0 8.0000 /end CHARACTERISTIC
/begin CHARACTERISTIC K_ED_PT_KLST.KLASSENINDEX "Auswahl der Fehlerklasse | EN: Fault code PT_KLST - fault class selection (lamp / warning behaviour)" VALUE 0x70C8C TKW_VV_VV_UB 100.0 FORMULA_0003 0.0 8.0000 /end CHARACTERISTIC
/begin CHARACTERISTIC K_ED_PT_KKOS.KLASSENINDEX "Auswahl der Fehlerklasse | EN: Fault code PT_KKOS - fault class selection (lamp / warning behaviour)" VALUE 0x70CA6 TKW_VV_VV_UB 100.0 FORMULA_0003 0.0 8.0000 /end CHARACTERISTIC
/begin CHARACTERISTIC K_ED_PT_LRW.KLASSENINDEX "Auswahl der Fehlerklasse | EN: Fault code PT_LRW - fault class selection (lamp / warning behaviour)" VALUE 0x70CC0 TKW_VV_VV_UB 100.0 FORMULA_0003 0.0 8.0000 /end CHARACTERISTIC
/begin CHARACTERISTIC K_ED_LAVK2_OBD_TL.KLASSENINDEX "Auswahl der Fehlerklasse | EN: Fault code LAVK2_OBD_TL - fault class selection (lamp / warning behaviour)" VALUE 0x70D76 TKW_VV_VV_UB 100.0 FORMULA_0003 0.0 8.0000 /end CHARACTERISTIC
/begin CHARACTERISTIC K_ED_LSHVK1.KLASSENINDEX "Auswahl der Fehlerklasse | EN: Fault code LSHVK1 - fault class selection (lamp / warning behaviour)" VALUE 0x70D90 TKW_VV_VV_UB 100.0 FORMULA_0003 0.0 8.0000 /end CHARACTERISTIC
/begin CHARACTERISTIC K_ED_LSHVK2.KLASSENINDEX "Auswahl der Fehlerklasse | EN: Fault code LSHVK2 - fault class selection (lamp / warning behaviour)" VALUE 0x70DAA TKW_VV_VV_UB 100.0 FORMULA_0003 0.0 8.0000 /end CHARACTERISTIC
/begin CHARACTERISTIC K_ED_LSRVK1_OBD_REG.KLASSENINDEX "Auswahl der Fehlerklasse | EN: Fault code LSRVK1_OBD_REG - fault class selection (lamp / warning behaviour)" VALUE 0x70DC4 TKW_VV_VV_UB 100.0 FORMULA_0003 0.0 8.0000 /end CHARACTERISTIC
/begin CHARACTERISTIC K_ED_LSRVK2_OBD_REG.KLASSENINDEX "Auswahl der Fehlerklasse | EN: Fault code LSRVK2_OBD_REG - fault class selection (lamp / warning behaviour)" VALUE 0x70DDE TKW_VV_VV_UB 100.0 FORMULA_0003 0.0 8.0000 /end CHARACTERISTIC
/begin CHARACTERISTIC K_ED_LSHVK1_R.KLASSENINDEX "Auswahl der Fehlerklasse | EN: Fault code LSHVK1_R - fault class selection (lamp / warning behaviour)" VALUE 0x70DF8 TKW_VV_VV_UB 100.0 FORMULA_0003 0.0 8.0000 /end CHARACTERISTIC
/begin CHARACTERISTIC K_ED_LSHVK2_R.KLASSENINDEX "Auswahl der Fehlerklasse | EN: Fault code LSHVK2_R - fault class selection (lamp / warning behaviour)" VALUE 0x70E12 TKW_VV_VV_UB 100.0 FORMULA_0003 0.0 8.0000 /end CHARACTERISTIC
/begin CHARACTERISTIC K_ED_LSRVK1_OBD_START.KLASSENINDEX "Auswahl der Fehlerklasse | EN: Fault code LSRVK1_OBD_START - fault class selection (lamp / warning behaviour)" VALUE 0x70E2C TKW_VV_VV_UB 100.0 FORMULA_0003 0.0 8.0000 /end CHARACTERISTIC
/begin CHARACTERISTIC K_ED_LSRVK2_OBD_START.KLASSENINDEX "Auswahl der Fehlerklasse | EN: Fault code LSRVK2_OBD_START - fault class selection (lamp / warning behaviour)" VALUE 0x70E46 TKW_VV_VV_UB 100.0 FORMULA_0003 0.0 8.0000 /end CHARACTERISTIC
/begin CHARACTERISTIC K_ED_LSRVK1_OBD_REF.KLASSENINDEX "Auswahl der Fehlerklasse | EN: Fault code LSRVK1_OBD_REF - fault class selection (lamp / warning behaviour)" VALUE 0x70E60 TKW_VV_VV_UB 100.0 FORMULA_0003 0.0 8.0000 /end CHARACTERISTIC
/begin CHARACTERISTIC K_ED_LSRVK2_OBD_REF.KLASSENINDEX "Auswahl der Fehlerklasse | EN: Fault code LSRVK2_OBD_REF - fault class selection (lamp / warning behaviour)" VALUE 0x70E7A TKW_VV_VV_UB 100.0 FORMULA_0003 0.0 8.0000 /end CHARACTERISTIC
/begin CHARACTERISTIC K_ED_LAVK2_DIAG.KLASSENINDEX "Auswahl der Fehlerklasse | EN: Fault code LAVK2_DIAG - fault class selection (lamp / warning behaviour)" VALUE 0x70EAE TKW_VV_VV_UB 100.0 FORMULA_0003 0.0 8.0000 /end CHARACTERISTIC
/begin CHARACTERISTIC K_ED_LAVK2_IA_OPENLOAD.KLASSENINDEX "Auswahl der Fehlerklasse | EN: Fault code LAVK2_IA_OPENLOAD - fault class selection (lamp / warning behaviour)" VALUE 0x70EE2 TKW_VV_VV_UB 100.0 FORMULA_0003 0.0 8.0000 /end CHARACTERISTIC
/begin CHARACTERISTIC K_ED_PT_GRB.KLASSENINDEX "Auswahl der Fehlerklasse | EN: Fault code PT_GRB - fault class selection (lamp / warning behaviour)" VALUE 0x70EFC TKW_VV_VV_UB 100.0 FORMULA_0003 0.0 8.0000 /end CHARACTERISTIC
/begin CHARACTERISTIC K_ED_PT_GRB2.KLASSENINDEX "Auswahl der Fehlerklasse | EN: Fault code PT_GRB2 - fault class selection (lamp / warning behaviour)" VALUE 0x70F16 TKW_VV_VV_UB 100.0 FORMULA_0003 0.0 8.0000 /end CHARACTERISTIC
/begin CHARACTERISTIC K_ED_LAVK2_UN_OPENLOAD.KLASSENINDEX "Auswahl der Fehlerklasse | EN: Fault code LAVK2_UN_OPENLOAD - fault class selection (lamp / warning behaviour)" VALUE 0x70F4A TKW_VV_VV_UB 100.0 FORMULA_0003 0.0 8.0000 /end CHARACTERISTIC
/begin CHARACTERISTIC K_ED_LAVK2_IP_OPENLOAD.KLASSENINDEX "Auswahl der Fehlerklasse | EN: Fault code LAVK2_IP_OPENLOAD - fault class selection (lamp / warning behaviour)" VALUE 0x70F7E TKW_VV_VV_UB 100.0 FORMULA_0003 0.0 8.0000 /end CHARACTERISTIC
/begin CHARACTERISTIC K_ED_LAVK2_OBD_DYN.KLASSENINDEX "Auswahl der Fehlerklasse | EN: Fault code LAVK2_OBD_DYN - fault class selection (lamp / warning behaviour)" VALUE 0x712D8 TKW_VV_VV_UB 100.0 FORMULA_0003 0.0 8.0000 /end CHARACTERISTIC
/begin CHARACTERISTIC K_ED_PT_CRASH.KLASSENINDEX "Auswahl der Fehlerklasse | EN: Fault code PT_CRASH - fault class selection (lamp / warning behaviour)" VALUE 0x712F2 TKW_VV_VV_UB 100.0 FORMULA_0003 0.0 8.0000 /end CHARACTERISTIC
/begin CHARACTERISTIC K_ED_PT_VEHMOD.KLASSENINDEX "Auswahl der Fehlerklasse | EN: Fault code PT_VEHMOD - fault class selection (lamp / warning behaviour)" VALUE 0x7130C TKW_VV_VV_UB 100.0 FORMULA_0003 0.0 8.0000 /end CHARACTERISTIC
/begin CHARACTERISTIC K_ED_PT_BEDFGR.KLASSENINDEX "Auswahl der Fehlerklasse | EN: Fault code PT_BEDFGR - fault class selection (lamp / warning behaviour)" VALUE 0x71326 TKW_VV_VV_UB 100.0 FORMULA_0003 0.0 8.0000 /end CHARACTERISTIC
/begin CHARACTERISTIC K_ED_LAVK2_TRIM.KLASSENINDEX "Auswahl der Fehlerklasse | EN: Fault code LAVK2_TRIM - fault class selection (lamp / warning behaviour)" VALUE 0x713F6 TKW_VV_VV_UB 100.0 FORMULA_0003 0.0 8.0000 /end CHARACTERISTIC
/begin CHARACTERISTIC K_ED_PT_KM.KLASSENINDEX "Auswahl der Fehlerklasse | EN: Fault code PT_KM - fault class selection (lamp / warning behaviour)" VALUE 0x714AC TKW_VV_VV_UB 100.0 FORMULA_0003 0.0 8.0000 /end CHARACTERISTIC
/begin CHARACTERISTIC K_ED_PT_KOMBI.KLASSENINDEX "Auswahl der Fehlerklasse | EN: Fault code PT_KOMBI - fault class selection (lamp / warning behaviour)" VALUE 0x714C6 TKW_VV_VV_UB 100.0 FORMULA_0003 0.0 8.0000 /end CHARACTERISTIC
/begin CHARACTERISTIC K_ED_PKS_LL.KLASSENINDEX "Auswahl der Fehlerklasse | EN: Fault code PKS_LL - fault class selection (lamp / warning behaviour)" VALUE 0x714E0 TKW_VV_VV_UB 100.0 FORMULA_0003 0.0 8.0000 /end CHARACTERISTIC
/begin CHARACTERISTIC K_ED_PKS_TL.KLASSENINDEX "Auswahl der Fehlerklasse | EN: Fault code PKS_TL - fault class selection (lamp / warning behaviour)" VALUE 0x714FA TKW_VV_VV_UB 100.0 FORMULA_0003 0.0 8.0000 /end CHARACTERISTIC
/begin CHARACTERISTIC K_ED_PKS_Q.KLASSENINDEX "Auswahl der Fehlerklasse | EN: Fault code PKS_Q - fault class selection (lamp / warning behaviour)" VALUE 0x71514 TKW_VV_VV_UB 100.0 FORMULA_0003 0.0 8.0000 /end CHARACTERISTIC
/begin CHARACTERISTIC K_ED_MVAC_DRUCKSENSOR.KLASSENINDEX "Auswahl der Fehlerklasse | EN: Fault code MVAC_DRUCKSENSOR - fault class selection (lamp / warning behaviour)" VALUE 0x7164C TKW_VV_VV_UB 100.0 FORMULA_0003 0.0 8.0000 /end CHARACTERISTIC
/begin CHARACTERISTIC K_ED_PT_BEDAT.KLASSENINDEX "Auswahl der Fehlerklasse | EN: Fault code PT_BEDAT - fault class selection (lamp / warning behaviour)" VALUE 0x71666 TKW_VV_VV_UB 100.0 FORMULA_0003 0.0 8.0000 /end CHARACTERISTIC
/begin CHARACTERISTIC K_ED_PT_STATANH.KLASSENINDEX "Auswahl der Fehlerklasse | EN: Fault code PT_STATANH - fault class selection (lamp / warning behaviour)" VALUE 0x71A0E TKW_VV_VV_UB 100.0 FORMULA_0003 0.0 8.0000 /end CHARACTERISTIC
/begin CHARACTERISTIC K_ED_PT_STATGRB.KLASSENINDEX "Auswahl der Fehlerklasse" VALUE 0x71A90 TKW_VV_VV_UB 100.0 FORMULA_0003 0.0 8.0000 /end CHARACTERISTIC
/begin CHARACTERISTIC K_ED_PT_ANFRADMOM.KLASSENINDEX "Auswahl der Fehlerklasse | EN: Fault code PT_ANFRADMOM - fault class selection (lamp / warning behaviour)" VALUE 0x71AAA TKW_VV_VV_UB 100.0 FORMULA_0003 0.0 8.0000 /end CHARACTERISTIC
/begin CHARACTERISTIC K_ED_PT_TOMA.KLASSENINDEX "Auswahl der Fehlerklasse | EN: Fault code PT_TOMA - fault class selection (lamp / warning behaviour)" VALUE 0x71AF8 TKW_VV_VV_UB 100.0 FORMULA_0003 0.0 8.0000 /end CHARACTERISTIC
/begin CHARACTERISTIC K_ED_LSHNK1_R.KLASSENINDEX "Auswahl der Fehlerklasse | EN: Fault code LSHNK1_R - fault class selection (lamp / warning behaviour)" VALUE 0x71BFC TKW_VV_VV_UB 100.0 FORMULA_0003 0.0 8.0000 /end CHARACTERISTIC
/begin CHARACTERISTIC K_ED_LSHNK2_R.KLASSENINDEX "Auswahl der Fehlerklasse | EN: Fault code LSHNK2_R - fault class selection (lamp / warning behaviour)" VALUE 0x71C16 TKW_VV_VV_UB 100.0 FORMULA_0003 0.0 8.0000 /end CHARACTERISTIC
/begin CHARACTERISTIC K_ED_PKS_MODELL.KLASSENINDEX "Auswahl der Fehlerklasse | EN: Fault code PKS_MODELL - fault class selection (lamp / warning behaviour)" VALUE 0x71C30 TKW_VV_VV_UB 100.0 FORMULA_0003 0.0 8.0000 /end CHARACTERISTIC
/begin CHARACTERISTIC K_ED_PKS_PAUFBAU.KLASSENINDEX "Auswahl der Fehlerklasse | EN: Fault code PKS_PAUFBAU - fault class selection (lamp / warning behaviour)" VALUE 0x71C4A TKW_VV_VV_UB 100.0 FORMULA_0003 0.0 8.0000 /end CHARACTERISTIC
/begin CHARACTERISTIC K_ED_PKS_ADAPT_ANSCHL.KLASSENINDEX "Auswahl der Fehlerklasse | EN: Fault code PKS_ADAPT_ANSCHL - fault class selection (lamp / warning behaviour)" VALUE 0x71C64 TKW_VV_VV_UB 100.0 FORMULA_0003 0.0 8.0000 /end CHARACTERISTIC
/begin CHARACTERISTIC K_ED_LAVK_ATIC42.KLASSENINDEX "Auswahl der Fehlerklasse | EN: Fault code LAVK_ATIC42 - fault class selection (lamp / warning behaviour)" VALUE 0x71C98 TKW_VV_VV_UB 100.0 FORMULA_0003 0.0 8.0000 /end CHARACTERISTIC
/begin CHARACTERISTIC K_ED_PT_AX.KLASSENINDEX "Auswahl der Fehlerklasse | EN: Fault code PT_AX - fault class selection (lamp / warning behaviour)" VALUE 0x71CB2 TKW_VV_VV_UB 100.0 FORMULA_0003 0.0 8.0000 /end CHARACTERISTIC
/begin CHARACTERISTIC K_ED_PT_OBD_ED.KLASSENINDEX "Auswahl der Fehlerklasse" VALUE 0x71CCC TKW_VV_VV_UB 100.0 FORMULA_0003 0.0 8.0000 /end CHARACTERISTIC
/begin CHARACTERISTIC K_ED_MVAC_OBD.KLASSENINDEX "Auswahl der Fehlerklasse" VALUE 0x71D4E TKW_VV_VV_UB 100.0 FORMULA_0003 0.0 8.0000 /end CHARACTERISTIC
/begin CHARACTERISTIC K_ED_LAVK2_ATIC42.KLASSENINDEX "Auswahl der Fehlerklasse" VALUE 0x71D82 TKW_VV_VV_UB 100.0 FORMULA_0003 0.0 8.0000 /end CHARACTERISTIC
/begin CHARACTERISTIC K_ED_MIL_MASKE "Auswahl wer Mil ansteuert | EN: Auswahl wer Mil ansteuert" VALUE 0x71F94 TKW_VV_VV_UB 100.0 FORMULA_0668 0.0 255.0 /end CHARACTERISTIC
/begin FUNCTION Eigendiagnose ""
 /begin DEF_CHARACTERISTIC K_ED_LAVK1_UN_OPENLOAD.OK_SCHWELLE K_ED_LAVK1_UN_OPENLOAD.P_CODE_OPENLOAD K_ED_LAVK1_UN_OPENLOAD.P_CODE_SH_TO_GND K_ED_LAVK1_UN_OPENLOAD.P_CODE_SH_TO_UB K_ED_LAVK1_UN_OPENLOAD.P_CODE_UNPLAUSIBEL K_ED_LAVK2.DEC_NACH_EINTRAG K_ED_LAVK2.DEC_VOR_EINTRAG K_ED_LAVK2.FEHLERSCHWELLE K_ED_LAVK2.INC_NACH_EINTRAG K_ED_LAVK2.INC_VOR_EINTRAG K_ED_LAVK2.KLASSENINDEX K_ED_LAVK2.OK_SCHWELLE K_ED_LAVK2.P_CODE_OPENLOAD K_ED_LAVK2.P_CODE_SH_TO_GND K_ED_LAVK2.P_CODE_SH_TO_UB K_ED_LAVK2.P_CODE_UNPLAUSIBEL K_ED_LAVK2_ATIC42.DEC_NACH_EINTRAG K_ED_LAVK2_ATIC42.DEC_VOR_EINTRAG K_ED_LAVK2_ATIC42.FEHLERSCHWELLE K_ED_LAVK2_ATIC42.INC_NACH_EINTRAG K_ED_LAVK2_ATIC42.INC_VOR_EINTRAG K_ED_LAVK2_ATIC42.KLASSENINDEX K_ED_LAVK2_ATIC42.OK_SCHWELLE K_ED_LAVK2_ATIC42.P_CODE_OPENLOAD K_ED_LAVK2_ATIC42.P_CODE_SH_TO_GND K_ED_LAVK2_ATIC42.P_CODE_SH_TO_UB K_ED_LAVK2_ATIC42.P_CODE_UNPLAUSIBEL K_ED_LAVK2_DIAG.DEC_NACH_EINTRAG K_ED_LAVK2_DIAG.DEC_VOR_EINTRAG K_ED_LAVK2_DIAG.FEHLERSCHWELLE K_ED_LAVK2_DIAG.INC_NACH_EINTRAG K_ED_LAVK2_DIAG.INC_VOR_EINTRAG K_ED_LAVK2_DIAG.KLASSENINDEX K_ED_LAVK2_DIAG.OK_SCHWELLE K_ED_LAVK2_DIAG.P_CODE_OPENLOAD K_ED_LAVK2_DIAG.P_CODE_SH_TO_GND K_ED_LAVK2_DIAG.P_CODE_SH_TO_UB K_ED_LAVK2_DIAG.P_CODE_UNPLAUSIBEL K_ED_LAVK2_IA_OPENLOAD.DEC_NACH_EINTRAG K_ED_LAVK2_IA_OPENLOAD.DEC_VOR_EINTRAG K_ED_LAVK2_IA_OPENLOAD.FEHLERSCHWELLE K_ED_LAVK2_IA_OPENLOAD.INC_NACH_EINTRAG K_ED_LAVK2_IA_OPENLOAD.INC_VOR_EINTRAG K_ED_LAVK2_IA_OPENLOAD.KLASSENINDEX K_ED_LAVK2_IA_OPENLOAD.OK_SCHWELLE K_ED_LAVK2_IA_OPENLOAD.P_CODE_OPENLOAD K_ED_LAVK2_IA_OPENLOAD.P_CODE_SH_TO_GND K_ED_LAVK2_IA_OPENLOAD.P_CODE_SH_TO_UB K_ED_LAVK2_IA_OPENLOAD.P_CODE_UNPLAUSIBEL K_ED_LAVK2_IP_OPENLOAD.DEC_NACH_EINTRAG K_ED_LAVK2_IP_OPENLOAD.DEC_VOR_EINTRAG K_ED_LAVK2_IP_OPENLOAD.FEHLERSCHWELLE K_ED_LAVK2_IP_OPENLOAD.INC_NACH_EINTRAG K_ED_LAVK2_IP_OPENLOAD.INC_VOR_EINTRAG K_ED_LAVK2_IP_OPENLOAD.KLASSENINDEX K_ED_LAVK2_IP_OPENLOAD.OK_SCHWELLE K_ED_LAVK2_IP_OPENLOAD.P_CODE_OPENLOAD K_ED_LAVK2_IP_OPENLOAD.P_CODE_SH_TO_GND K_ED_LAVK2_IP_OPENLOAD.P_CODE_SH_TO_UB K_ED_LAVK2_IP_OPENLOAD.P_CODE_UNPLAUSIBEL K_ED_LAVK2_OBD_DYN.DEC_NACH_EINTRAG K_ED_LAVK2_OBD_DYN.DEC_VOR_EINTRAG K_ED_LAVK2_OBD_DYN.FEHLERSCHWELLE K_ED_LAVK2_OBD_DYN.INC_NACH_EINTRAG K_ED_LAVK2_OBD_DYN.INC_VOR_EINTRAG K_ED_LAVK2_OBD_DYN.KLASSENINDEX K_ED_LAVK2_OBD_DYN.OK_SCHWELLE K_ED_LAVK2_OBD_DYN.P_CODE_OPENLOAD K_ED_LAVK2_OBD_DYN.P_CODE_SH_TO_GND K_ED_LAVK2_OBD_DYN.P_CODE_SH_TO_UB K_ED_LAVK2_OBD_DYN.P_CODE_UNPLAUSIBEL K_ED_LAVK2_OBD_PLAU.DEC_NACH_EINTRAG K_ED_LAVK2_OBD_PLAU.DEC_VOR_EINTRAG K_ED_LAVK2_OBD_PLAU.FEHLERSCHWELLE K_ED_LAVK2_OBD_PLAU.INC_NACH_EINTRAG K_ED_LAVK2_OBD_PLAU.INC_VOR_EINTRAG K_ED_LAVK2_OBD_PLAU.KLASSENINDEX K_ED_LAVK2_OBD_PLAU.OK_SCHWELLE K_ED_LAVK2_OBD_PLAU.P_CODE_OPENLOAD K_ED_LAVK2_OBD_PLAU.P_CODE_SH_TO_GND K_ED_LAVK2_OBD_PLAU.P_CODE_SH_TO_UB K_ED_LAVK2_OBD_PLAU.P_CODE_UNPLAUSIBEL K_ED_LAVK2_OBD_SA.DEC_NACH_EINTRAG K_ED_LAVK2_OBD_SA.DEC_VOR_EINTRAG K_ED_LAVK2_OBD_SA.FEHLERSCHWELLE K_ED_LAVK2_OBD_SA.INC_NACH_EINTRAG K_ED_LAVK2_OBD_SA.INC_VOR_EINTRAG K_ED_LAVK2_OBD_SA.KLASSENINDEX K_ED_LAVK2_OBD_SA.OK_SCHWELLE K_ED_LAVK2_OBD_SA.P_CODE_OPENLOAD K_ED_LAVK2_OBD_SA.P_CODE_SH_TO_GND K_ED_LAVK2_OBD_SA.P_CODE_SH_TO_UB K_ED_LAVK2_OBD_SA.P_CODE_UNPLAUSIBEL K_ED_LAVK2_OBD_TL.DEC_NACH_EINTRAG K_ED_LAVK2_OBD_TL.DEC_VOR_EINTRAG K_ED_LAVK2_OBD_TL.FEHLERSCHWELLE K_ED_LAVK2_OBD_TL.INC_NACH_EINTRAG K_ED_LAVK2_OBD_TL.INC_VOR_EINTRAG K_ED_LAVK2_OBD_TL.KLASSENINDEX K_ED_LAVK2_OBD_TL.OK_SCHWELLE K_ED_LAVK2_OBD_TL.P_CODE_OPENLOAD K_ED_LAVK2_OBD_TL.P_CODE_SH_TO_GND K_ED_LAVK2_OBD_TL.P_CODE_SH_TO_UB K_ED_LAVK2_OBD_TL.P_CODE_UNPLAUSIBEL K_ED_LAVK2_TRIM.DEC_NACH_EINTRAG K_ED_LAVK2_TRIM.DEC_VOR_EINTRAG K_ED_LAVK2_TRIM.FEHLERSCHWELLE K_ED_LAVK2_TRIM.INC_NACH_EINTRAG K_ED_LAVK2_TRIM.INC_VOR_EINTRAG K_ED_LAVK2_TRIM.KLASSENINDEX K_ED_LAVK2_TRIM.OK_SCHWELLE K_ED_LAVK2_TRIM.P_CODE_OPENLOAD K_ED_LAVK2_TRIM.P_CODE_SH_TO_GND K_ED_LAVK2_TRIM.P_CODE_SH_TO_UB K_ED_LAVK2_TRIM.P_CODE_UNPLAUSIBEL K_ED_LAVK2_UN_OPENLOAD.DEC_NACH_EINTRAG K_ED_LAVK2_UN_OPENLOAD.DEC_VOR_EINTRAG K_ED_LAVK2_UN_OPENLOAD.FEHLERSCHWELLE K_ED_LAVK2_UN_OPENLOAD.INC_NACH_EINTRAG K_ED_LAVK2_UN_OPENLOAD.INC_VOR_EINTRAG K_ED_LAVK2_UN_OPENLOAD.KLASSENINDEX K_ED_LAVK2_UN_OPENLOAD.OK_SCHWELLE K_ED_LAVK2_UN_OPENLOAD.P_CODE_OPENLOAD K_ED_LAVK2_UN_OPENLOAD.P_CODE_SH_TO_GND K_ED_LAVK2_UN_OPENLOAD.P_CODE_SH_TO_UB K_ED_LAVK2_UN_OPENLOAD.P_CODE_UNPLAUSIBEL K_ED_LAVK_ATIC42.DEC_NACH_EINTRAG K_ED_LAVK_ATIC42.DEC_VOR_EINTRAG K_ED_LAVK_ATIC42.FEHLERSCHWELLE K_ED_LAVK_ATIC42.INC_NACH_EINTRAG K_ED_LAVK_ATIC42.INC_VOR_EINTRAG K_ED_LAVK_ATIC42.KLASSENINDEX K_ED_LAVK_ATIC42.OK_SCHWELLE K_ED_LAVK_ATIC42.P_CODE_OPENLOAD K_ED_LAVK_ATIC42.P_CODE_SH_TO_GND K_ED_LAVK_ATIC42.P_CODE_SH_TO_UB K_ED_LAVK_ATIC42.P_CODE_UNPLAUSIBEL K_ED_LSHNK1.DEC_NACH_EINTRAG K_ED_LSHNK1.DEC_VOR_EINTRAG K_ED_LSHNK1.FEHLERSCHWELLE K_ED_LSHNK1.INC_NACH_EINTRAG K_ED_LSHNK1.INC_VOR_EINTRAG K_ED_LSHNK1.KLASSENINDEX K_ED_LSHNK1.OK_SCHWELLE K_ED_LSHNK1.P_CODE_OPENLOAD K_ED_LSHNK1.P_CODE_SH_TO_GND K_ED_LSHNK1.P_CODE_SH_TO_UB K_ED_LSHNK1.P_CODE_UNPLAUSIBEL K_ED_LSHNK1_R.DEC_NACH_EINTRAG K_ED_LSHNK1_R.DEC_VOR_EINTRAG K_ED_LSHNK1_R.FEHLERSCHWELLE K_ED_LSHNK1_R.INC_NACH_EINTRAG K_ED_LSHNK1_R.INC_VOR_EINTRAG K_ED_LSHNK1_R.KLASSENINDEX K_ED_LSHNK1_R.OK_SCHWELLE K_ED_LSHNK1_R.P_CODE_OPENLOAD K_ED_LSHNK1_R.P_CODE_SH_TO_GND K_ED_LSHNK1_R.P_CODE_SH_TO_UB K_ED_LSHNK1_R.P_CODE_UNPLAUSIBEL K_ED_LSHNK2.DEC_NACH_EINTRAG K_ED_LSHNK2.DEC_VOR_EINTRAG K_ED_LSHNK2.FEHLERSCHWELLE K_ED_LSHNK2.INC_NACH_EINTRAG K_ED_LSHNK2.INC_VOR_EINTRAG K_ED_LSHNK2.KLASSENINDEX K_ED_LSHNK2.OK_SCHWELLE K_ED_LSHNK2.P_CODE_OPENLOAD K_ED_LSHNK2.P_CODE_SH_TO_GND K_ED_LSHNK2.P_CODE_SH_TO_UB K_ED_LSHNK2.P_CODE_UNPLAUSIBEL K_ED_LSHNK2_R.DEC_NACH_EINTRAG K_ED_LSHNK2_R.DEC_VOR_EINTRAG K_ED_LSHNK2_R.FEHLERSCHWELLE K_ED_LSHNK2_R.INC_NACH_EINTRAG K_ED_LSHNK2_R.INC_VOR_EINTRAG K_ED_LSHNK2_R.KLASSENINDEX K_ED_LSHNK2_R.OK_SCHWELLE K_ED_LSHNK2_R.P_CODE_OPENLOAD K_ED_LSHNK2_R.P_CODE_SH_TO_GND K_ED_LSHNK2_R.P_CODE_SH_TO_UB K_ED_LSHNK2_R.P_CODE_UNPLAUSIBEL K_ED_LSHVK1.DEC_NACH_EINTRAG K_ED_LSHVK1.DEC_VOR_EINTRAG K_ED_LSHVK1.FEHLERSCHWELLE K_ED_LSHVK1.INC_NACH_EINTRAG K_ED_LSHVK1.INC_VOR_EINTRAG K_ED_LSHVK1.KLASSENINDEX K_ED_LSHVK1.OK_SCHWELLE K_ED_LSHVK1.P_CODE_OPENLOAD K_ED_LSHVK1.P_CODE_SH_TO_GND K_ED_LSHVK1.P_CODE_SH_TO_UB K_ED_LSHVK1.P_CODE_UNPLAUSIBEL K_ED_LSHVK1_R.DEC_NACH_EINTRAG K_ED_LSHVK1_R.DEC_VOR_EINTRAG K_ED_LSHVK1_R.FEHLERSCHWELLE K_ED_LSHVK1_R.INC_NACH_EINTRAG K_ED_LSHVK1_R.INC_VOR_EINTRAG K_ED_LSHVK1_R.KLASSENINDEX K_ED_LSHVK1_R.OK_SCHWELLE K_ED_LSHVK1_R.P_CODE_OPENLOAD K_ED_LSHVK1_R.P_CODE_SH_TO_GND K_ED_LSHVK1_R.P_CODE_SH_TO_UB K_ED_LSHVK1_R.P_CODE_UNPLAUSIBEL K_ED_LSHVK2.DEC_NACH_EINTRAG K_ED_LSHVK2.DEC_VOR_EINTRAG K_ED_LSHVK2.FEHLERSCHWELLE K_ED_LSHVK2.INC_NACH_EINTRAG K_ED_LSHVK2.INC_VOR_EINTRAG K_ED_LSHVK2.KLASSENINDEX K_ED_LSHVK2.OK_SCHWELLE K_ED_LSHVK2.P_CODE_OPENLOAD K_ED_LSHVK2.P_CODE_SH_TO_GND K_ED_LSHVK2.P_CODE_SH_TO_UB K_ED_LSHVK2.P_CODE_UNPLAUSIBEL K_ED_LSHVK2_R.DEC_NACH_EINTRAG K_ED_LSHVK2_R.DEC_VOR_EINTRAG K_ED_LSHVK2_R.FEHLERSCHWELLE K_ED_LSHVK2_R.INC_NACH_EINTRAG K_ED_LSHVK2_R.INC_VOR_EINTRAG K_ED_LSHVK2_R.KLASSENINDEX K_ED_LSHVK2_R.OK_SCHWELLE K_ED_LSHVK2_R.P_CODE_OPENLOAD K_ED_LSHVK2_R.P_CODE_SH_TO_GND K_ED_LSHVK2_R.P_CODE_SH_TO_UB K_ED_LSHVK2_R.P_CODE_UNPLAUSIBEL K_ED_LSRVK1_OBD_REF.DEC_NACH_EINTRAG K_ED_LSRVK1_OBD_REF.DEC_VOR_EINTRAG K_ED_LSRVK1_OBD_REF.FEHLERSCHWELLE K_ED_LSRVK1_OBD_REF.INC_NACH_EINTRAG K_ED_LSRVK1_OBD_REF.INC_VOR_EINTRAG K_ED_LSRVK1_OBD_REF.KLASSENINDEX K_ED_LSRVK1_OBD_REF.OK_SCHWELLE K_ED_LSRVK1_OBD_REF.P_CODE_OPENLOAD K_ED_LSRVK1_OBD_REF.P_CODE_SH_TO_GND K_ED_LSRVK1_OBD_REF.P_CODE_SH_TO_UB K_ED_LSRVK1_OBD_REF.P_CODE_UNPLAUSIBEL K_ED_LSRVK1_OBD_REG.DEC_NACH_EINTRAG K_ED_LSRVK1_OBD_REG.DEC_VOR_EINTRAG K_ED_LSRVK1_OBD_REG.FEHLERSCHWELLE K_ED_LSRVK1_OBD_REG.INC_NACH_EINTRAG K_ED_LSRVK1_OBD_REG.INC_VOR_EINTRAG K_ED_LSRVK1_OBD_REG.KLASSENINDEX K_ED_LSRVK1_OBD_REG.OK_SCHWELLE K_ED_LSRVK1_OBD_REG.P_CODE_OPENLOAD K_ED_LSRVK1_OBD_REG.P_CODE_SH_TO_GND K_ED_LSRVK1_OBD_REG.P_CODE_SH_TO_UB K_ED_LSRVK1_OBD_REG.P_CODE_UNPLAUSIBEL K_ED_LSRVK1_OBD_START.DEC_NACH_EINTRAG K_ED_LSRVK1_OBD_START.DEC_VOR_EINTRAG K_ED_LSRVK1_OBD_START.FEHLERSCHWELLE K_ED_LSRVK1_OBD_START.INC_NACH_EINTRAG K_ED_LSRVK1_OBD_START.INC_VOR_EINTRAG K_ED_LSRVK1_OBD_START.KLASSENINDEX K_ED_LSRVK1_OBD_START.OK_SCHWELLE K_ED_LSRVK1_OBD_START.P_CODE_OPENLOAD K_ED_LSRVK1_OBD_START.P_CODE_SH_TO_GND K_ED_LSRVK1_OBD_START.P_CODE_SH_TO_UB K_ED_LSRVK1_OBD_START.P_CODE_UNPLAUSIBEL K_ED_LSRVK2_OBD_REF.DEC_NACH_EINTRAG K_ED_LSRVK2_OBD_REF.DEC_VOR_EINTRAG K_ED_LSRVK2_OBD_REF.FEHLERSCHWELLE K_ED_LSRVK2_OBD_REF.INC_NACH_EINTRAG K_ED_LSRVK2_OBD_REF.INC_VOR_EINTRAG K_ED_LSRVK2_OBD_REF.KLASSENINDEX K_ED_LSRVK2_OBD_REF.OK_SCHWELLE K_ED_LSRVK2_OBD_REF.P_CODE_OPENLOAD K_ED_LSRVK2_OBD_REF.P_CODE_SH_TO_GND K_ED_LSRVK2_OBD_REF.P_CODE_SH_TO_UB K_ED_LSRVK2_OBD_REF.P_CODE_UNPLAUSIBEL K_ED_LSRVK2_OBD_REG.DEC_NACH_EINTRAG K_ED_LSRVK2_OBD_REG.DEC_VOR_EINTRAG K_ED_LSRVK2_OBD_REG.FEHLERSCHWELLE K_ED_LSRVK2_OBD_REG.INC_NACH_EINTRAG K_ED_LSRVK2_OBD_REG.INC_VOR_EINTRAG K_ED_LSRVK2_OBD_REG.KLASSENINDEX K_ED_LSRVK2_OBD_REG.OK_SCHWELLE K_ED_LSRVK2_OBD_REG.P_CODE_OPENLOAD K_ED_LSRVK2_OBD_REG.P_CODE_SH_TO_GND K_ED_LSRVK2_OBD_REG.P_CODE_SH_TO_UB K_ED_LSRVK2_OBD_REG.P_CODE_UNPLAUSIBEL K_ED_LSRVK2_OBD_START.DEC_NACH_EINTRAG K_ED_LSRVK2_OBD_START.DEC_VOR_EINTRAG K_ED_LSRVK2_OBD_START.FEHLERSCHWELLE K_ED_LSRVK2_OBD_START.INC_NACH_EINTRAG K_ED_LSRVK2_OBD_START.INC_VOR_EINTRAG K_ED_LSRVK2_OBD_START.KLASSENINDEX K_ED_LSRVK2_OBD_START.OK_SCHWELLE K_ED_LSRVK2_OBD_START.P_CODE_OPENLOAD K_ED_LSRVK2_OBD_START.P_CODE_SH_TO_GND K_ED_LSRVK2_OBD_START.P_CODE_SH_TO_UB K_ED_LSRVK2_OBD_START.P_CODE_UNPLAUSIBEL K_ED_MIL_MASKE K_ED_MVAC_DRUCKSENSOR.DEC_NACH_EINTRAG K_ED_MVAC_DRUCKSENSOR.DEC_VOR_EINTRAG K_ED_MVAC_DRUCKSENSOR.FEHLERSCHWELLE K_ED_MVAC_DRUCKSENSOR.INC_NACH_EINTRAG K_ED_MVAC_DRUCKSENSOR.INC_VOR_EINTRAG K_ED_MVAC_DRUCKSENSOR.KLASSENINDEX K_ED_MVAC_DRUCKSENSOR.OK_SCHWELLE K_ED_MVAC_DRUCKSENSOR.P_CODE_OPENLOAD K_ED_MVAC_DRUCKSENSOR.P_CODE_SH_TO_GND K_ED_MVAC_DRUCKSENSOR.P_CODE_SH_TO_UB K_ED_MVAC_DRUCKSENSOR.P_CODE_UNPLAUSIBEL K_ED_MVAC_OBD.DEC_NACH_EINTRAG K_ED_MVAC_OBD.DEC_VOR_EINTRAG K_ED_MVAC_OBD.FEHLERSCHWELLE K_ED_MVAC_OBD.INC_NACH_EINTRAG K_ED_MVAC_OBD.INC_VOR_EINTRAG K_ED_MVAC_OBD.KLASSENINDEX K_ED_MVAC_OBD.OK_SCHWELLE K_ED_MVAC_OBD.P_CODE_OPENLOAD K_ED_MVAC_OBD.P_CODE_SH_TO_GND K_ED_MVAC_OBD.P_CODE_SH_TO_UB K_ED_MVAC_OBD.P_CODE_UNPLAUSIBEL K_ED_NW1_SYNC.DEC_NACH_EINTRAG K_ED_NW1_SYNC.DEC_VOR_EINTRAG K_ED_NW1_SYNC.FEHLERSCHWELLE K_ED_NW1_SYNC.INC_NACH_EINTRAG K_ED_NW1_SYNC.INC_VOR_EINTRAG K_ED_NW1_SYNC.KLASSENINDEX K_ED_NW1_SYNC.OK_SCHWELLE K_ED_NW1_SYNC.P_CODE_OPENLOAD K_ED_NW1_SYNC.P_CODE_SH_TO_GND K_ED_NW1_SYNC.P_CODE_SH_TO_UB K_ED_NW1_SYNC.P_CODE_UNPLAUSIBEL K_ED_NW2_SYNC.DEC_NACH_EINTRAG K_ED_NW2_SYNC.DEC_VOR_EINTRAG K_ED_NW2_SYNC.FEHLERSCHWELLE K_ED_NW2_SYNC.INC_NACH_EINTRAG K_ED_NW2_SYNC.INC_VOR_EINTRAG K_ED_NW2_SYNC.KLASSENINDEX K_ED_NW2_SYNC.OK_SCHWELLE K_ED_NW2_SYNC.P_CODE_OPENLOAD K_ED_NW2_SYNC.P_CODE_SH_TO_GND K_ED_NW2_SYNC.P_CODE_SH_TO_UB K_ED_NW2_SYNC.P_CODE_UNPLAUSIBEL K_ED_PCTRL_INJ.DEC_NACH_EINTRAG K_ED_PCTRL_INJ.DEC_VOR_EINTRAG K_ED_PCTRL_INJ.FEHLERSCHWELLE K_ED_PCTRL_INJ.INC_NACH_EINTRAG K_ED_PCTRL_INJ.INC_VOR_EINTRAG K_ED_PCTRL_INJ.KLASSENINDEX K_ED_PCTRL_INJ.OK_SCHWELLE K_ED_PCTRL_INJ.P_CODE_OPENLOAD K_ED_PCTRL_INJ.P_CODE_SH_TO_GND K_ED_PCTRL_INJ.P_CODE_SH_TO_UB K_ED_PCTRL_INJ.P_CODE_UNPLAUSIBEL K_ED_PKS.DEC_NACH_EINTRAG K_ED_PKS.DEC_VOR_EINTRAG K_ED_PKS.FEHLERSCHWELLE K_ED_PKS.INC_NACH_EINTRAG K_ED_PKS.INC_VOR_EINTRAG K_ED_PKS.KLASSENINDEX K_ED_PKS.OK_SCHWELLE K_ED_PKS.P_CODE_OPENLOAD K_ED_PKS.P_CODE_SH_TO_GND K_ED_PKS.P_CODE_SH_TO_UB K_ED_PKS.P_CODE_UNPLAUSIBEL K_ED_PKS_ADAPT_ANSCHL.DEC_NACH_EINTRAG K_ED_PKS_ADAPT_ANSCHL.DEC_VOR_EINTRAG K_ED_PKS_ADAPT_ANSCHL.FEHLERSCHWELLE K_ED_PKS_ADAPT_ANSCHL.INC_NACH_EINTRAG K_ED_PKS_ADAPT_ANSCHL.INC_VOR_EINTRAG K_ED_PKS_ADAPT_ANSCHL.KLASSENINDEX K_ED_PKS_ADAPT_ANSCHL.OK_SCHWELLE K_ED_PKS_ADAPT_ANSCHL.P_CODE_OPENLOAD K_ED_PKS_ADAPT_ANSCHL.P_CODE_SH_TO_GND K_ED_PKS_ADAPT_ANSCHL.P_CODE_SH_TO_UB K_ED_PKS_ADAPT_ANSCHL.P_CODE_UNPLAUSIBEL K_ED_PKS_LL.DEC_NACH_EINTRAG K_ED_PKS_LL.DEC_VOR_EINTRAG K_ED_PKS_LL.FEHLERSCHWELLE K_ED_PKS_LL.INC_NACH_EINTRAG K_ED_PKS_LL.INC_VOR_EINTRAG K_ED_PKS_LL.KLASSENINDEX K_ED_PKS_LL.OK_SCHWELLE K_ED_PKS_LL.P_CODE_OPENLOAD K_ED_PKS_LL.P_CODE_SH_TO_GND K_ED_PKS_LL.P_CODE_SH_TO_UB K_ED_PKS_LL.P_CODE_UNPLAUSIBEL K_ED_PKS_MODELL.DEC_NACH_EINTRAG K_ED_PKS_MODELL.DEC_VOR_EINTRAG K_ED_PKS_MODELL.FEHLERSCHWELLE K_ED_PKS_MODELL.INC_NACH_EINTRAG K_ED_PKS_MODELL.INC_VOR_EINTRAG K_ED_PKS_MODELL.KLASSENINDEX K_ED_PKS_MODELL.OK_SCHWELLE K_ED_PKS_MODELL.P_CODE_OPENLOAD K_ED_PKS_MODELL.P_CODE_SH_TO_GND K_ED_PKS_MODELL.P_CODE_SH_TO_UB K_ED_PKS_MODELL.P_CODE_UNPLAUSIBEL K_ED_PKS_PAUFBAU.DEC_NACH_EINTRAG K_ED_PKS_PAUFBAU.DEC_VOR_EINTRAG K_ED_PKS_PAUFBAU.FEHLERSCHWELLE K_ED_PKS_PAUFBAU.INC_NACH_EINTRAG K_ED_PKS_PAUFBAU.INC_VOR_EINTRAG K_ED_PKS_PAUFBAU.KLASSENINDEX K_ED_PKS_PAUFBAU.OK_SCHWELLE K_ED_PKS_PAUFBAU.P_CODE_OPENLOAD K_ED_PKS_PAUFBAU.P_CODE_SH_TO_GND K_ED_PKS_PAUFBAU.P_CODE_SH_TO_UB K_ED_PKS_PAUFBAU.P_CODE_UNPLAUSIBEL K_ED_PKS_Q.DEC_NACH_EINTRAG K_ED_PKS_Q.DEC_VOR_EINTRAG K_ED_PKS_Q.FEHLERSCHWELLE K_ED_PKS_Q.INC_NACH_EINTRAG K_ED_PKS_Q.INC_VOR_EINTRAG K_ED_PKS_Q.KLASSENINDEX K_ED_PKS_Q.OK_SCHWELLE K_ED_PKS_Q.P_CODE_OPENLOAD K_ED_PKS_Q.P_CODE_SH_TO_GND K_ED_PKS_Q.P_CODE_SH_TO_UB K_ED_PKS_Q.P_CODE_UNPLAUSIBEL K_ED_PKS_TL.DEC_NACH_EINTRAG K_ED_PKS_TL.DEC_VOR_EINTRAG K_ED_PKS_TL.FEHLERSCHWELLE K_ED_PKS_TL.INC_NACH_EINTRAG K_ED_PKS_TL.INC_VOR_EINTRAG K_ED_PKS_TL.KLASSENINDEX K_ED_PKS_TL.OK_SCHWELLE K_ED_PKS_TL.P_CODE_OPENLOAD K_ED_PKS_TL.P_CODE_SH_TO_GND K_ED_PKS_TL.P_CODE_SH_TO_UB K_ED_PKS_TL.P_CODE_UNPLAUSIBEL K_ED_PSAU1.DEC_NACH_EINTRAG K_ED_PSAU1.DEC_VOR_EINTRAG K_ED_PSAU1.FEHLERSCHWELLE K_ED_PSAU1.INC_NACH_EINTRAG K_ED_PSAU1.INC_VOR_EINTRAG K_ED_PSAU1.KLASSENINDEX K_ED_PSAU1.OK_SCHWELLE K_ED_PSAU1.P_CODE_OPENLOAD K_ED_PSAU1.P_CODE_SH_TO_GND K_ED_PSAU1.P_CODE_SH_TO_UB K_ED_PSAU1.P_CODE_UNPLAUSIBEL K_ED_PSAU2.DEC_NACH_EINTRAG K_ED_PSAU2.DEC_VOR_EINTRAG K_ED_PSAU2.FEHLERSCHWELLE K_ED_PSAU2.INC_NACH_EINTRAG K_ED_PSAU2.INC_VOR_EINTRAG K_ED_PSAU2.KLASSENINDEX K_ED_PSAU2.OK_SCHWELLE K_ED_PSAU2.P_CODE_OPENLOAD K_ED_PSAU2.P_CODE_SH_TO_GND K_ED_PSAU2.P_CODE_SH_TO_UB K_ED_PSAU2.P_CODE_UNPLAUSIBEL K_ED_PT_ANFRADMOM.DEC_NACH_EINTRAG K_ED_PT_ANFRADMOM.DEC_VOR_EINTRAG K_ED_PT_ANFRADMOM.FEHLERSCHWELLE K_ED_PT_ANFRADMOM.INC_NACH_EINTRAG K_ED_PT_ANFRADMOM.INC_VOR_EINTRAG K_ED_PT_ANFRADMOM.KLASSENINDEX K_ED_PT_ANFRADMOM.OK_SCHWELLE K_ED_PT_ANFRADMOM.P_CODE_OPENLOAD K_ED_PT_ANFRADMOM.P_CODE_SH_TO_GND K_ED_PT_ANFRADMOM.P_CODE_SH_TO_UB K_ED_PT_ANFRADMOM.P_CODE_UNPLAUSIBEL K_ED_PT_ATEMP.DEC_NACH_EINTRAG K_ED_PT_ATEMP.DEC_VOR_EINTRAG K_ED_PT_ATEMP.FEHLERSCHWELLE K_ED_PT_ATEMP.INC_NACH_EINTRAG K_ED_PT_ATEMP.INC_VOR_EINTRAG K_ED_PT_ATEMP.KLASSENINDEX K_ED_PT_ATEMP.OK_SCHWELLE K_ED_PT_ATEMP.P_CODE_OPENLOAD K_ED_PT_ATEMP.P_CODE_SH_TO_GND K_ED_PT_ATEMP.P_CODE_SH_TO_UB K_ED_PT_ATEMP.P_CODE_UNPLAUSIBEL K_ED_PT_AX.DEC_NACH_EINTRAG K_ED_PT_AX.DEC_VOR_EINTRAG K_ED_PT_AX.FEHLERSCHWELLE K_ED_PT_AX.INC_NACH_EINTRAG K_ED_PT_AX.INC_VOR_EINTRAG K_ED_PT_AX.KLASSENINDEX K_ED_PT_AX.OK_SCHWELLE K_ED_PT_AX.P_CODE_OPENLOAD K_ED_PT_AX.P_CODE_SH_TO_GND K_ED_PT_AX.P_CODE_SH_TO_UB K_ED_PT_AX.P_CODE_UNPLAUSIBEL K_ED_PT_BEDAT.DEC_NACH_EINTRAG K_ED_PT_BEDAT.DEC_VOR_EINTRAG K_ED_PT_BEDAT.FEHLERSCHWELLE K_ED_PT_BEDAT.INC_NACH_EINTRAG K_ED_PT_BEDAT.INC_VOR_EINTRAG K_ED_PT_BEDAT.KLASSENINDEX K_ED_PT_BEDAT.OK_SCHWELLE K_ED_PT_BEDAT.P_CODE_OPENLOAD K_ED_PT_BEDAT.P_CODE_SH_TO_GND K_ED_PT_BEDAT.P_CODE_SH_TO_UB K_ED_PT_BEDAT.P_CODE_UNPLAUSIBEL K_ED_PT_BEDFGR.DEC_NACH_EINTRAG K_ED_PT_BEDFGR.DEC_VOR_EINTRAG K_ED_PT_BEDFGR.FEHLERSCHWELLE K_ED_PT_BEDFGR.INC_NACH_EINTRAG K_ED_PT_BEDFGR.INC_VOR_EINTRAG K_ED_PT_BEDFGR.KLASSENINDEX K_ED_PT_BEDFGR.OK_SCHWELLE K_ED_PT_BEDFGR.P_CODE_OPENLOAD K_ED_PT_BEDFGR.P_CODE_SH_TO_GND K_ED_PT_BEDFGR.P_CODE_SH_TO_UB K_ED_PT_BEDFGR.P_CODE_UNPLAUSIBEL K_ED_PT_BUSOFF.DEC_NACH_EINTRAG K_ED_PT_BUSOFF.DEC_VOR_EINTRAG K_ED_PT_BUSOFF.FEHLERSCHWELLE K_ED_PT_BUSOFF.INC_NACH_EINTRAG K_ED_PT_BUSOFF.INC_VOR_EINTRAG K_ED_PT_BUSOFF.KLASSENINDEX K_ED_PT_BUSOFF.OK_SCHWELLE K_ED_PT_BUSOFF.P_CODE_OPENLOAD K_ED_PT_BUSOFF.P_CODE_SH_TO_GND K_ED_PT_BUSOFF.P_CODE_SH_TO_UB K_ED_PT_BUSOFF.P_CODE_UNPLAUSIBEL K_ED_PT_CRASH.DEC_NACH_EINTRAG K_ED_PT_CRASH.DEC_VOR_EINTRAG K_ED_PT_CRASH.FEHLERSCHWELLE K_ED_PT_CRASH.INC_NACH_EINTRAG K_ED_PT_CRASH.INC_VOR_EINTRAG K_ED_PT_CRASH.KLASSENINDEX K_ED_PT_CRASH.OK_SCHWELLE K_ED_PT_CRASH.P_CODE_OPENLOAD K_ED_PT_CRASH.P_CODE_SH_TO_GND K_ED_PT_CRASH.P_CODE_SH_TO_UB K_ED_PT_CRASH.P_CODE_UNPLAUSIBEL K_ED_PT_GRB.DEC_NACH_EINTRAG K_ED_PT_GRB.DEC_VOR_EINTRAG K_ED_PT_GRB.FEHLERSCHWELLE K_ED_PT_GRB.INC_NACH_EINTRAG K_ED_PT_GRB.INC_VOR_EINTRAG K_ED_PT_GRB.KLASSENINDEX K_ED_PT_GRB.OK_SCHWELLE K_ED_PT_GRB.P_CODE_OPENLOAD K_ED_PT_GRB.P_CODE_SH_TO_GND K_ED_PT_GRB.P_CODE_SH_TO_UB K_ED_PT_GRB.P_CODE_UNPLAUSIBEL K_ED_PT_GRB2.DEC_NACH_EINTRAG K_ED_PT_GRB2.DEC_VOR_EINTRAG K_ED_PT_GRB2.FEHLERSCHWELLE K_ED_PT_GRB2.INC_NACH_EINTRAG K_ED_PT_GRB2.INC_VOR_EINTRAG K_ED_PT_GRB2.KLASSENINDEX K_ED_PT_GRB2.OK_SCHWELLE K_ED_PT_GRB2.P_CODE_OPENLOAD K_ED_PT_GRB2.P_CODE_SH_TO_GND K_ED_PT_GRB2.P_CODE_SH_TO_UB K_ED_PT_GRB2.P_CODE_UNPLAUSIBEL K_ED_PT_KKOS.DEC_NACH_EINTRAG K_ED_PT_KKOS.DEC_VOR_EINTRAG K_ED_PT_KKOS.FEHLERSCHWELLE K_ED_PT_KKOS.INC_NACH_EINTRAG K_ED_PT_KKOS.INC_VOR_EINTRAG K_ED_PT_KKOS.KLASSENINDEX K_ED_PT_KKOS.OK_SCHWELLE K_ED_PT_KKOS.P_CODE_OPENLOAD K_ED_PT_KKOS.P_CODE_SH_TO_GND K_ED_PT_KKOS.P_CODE_SH_TO_UB K_ED_PT_KKOS.P_CODE_UNPLAUSIBEL K_ED_PT_KLST.DEC_NACH_EINTRAG K_ED_PT_KLST.DEC_VOR_EINTRAG K_ED_PT_KLST.FEHLERSCHWELLE K_ED_PT_KLST.INC_NACH_EINTRAG K_ED_PT_KLST.INC_VOR_EINTRAG K_ED_PT_KLST.KLASSENINDEX K_ED_PT_KLST.OK_SCHWELLE K_ED_PT_KLST.P_CODE_OPENLOAD K_ED_PT_KLST.P_CODE_SH_TO_GND K_ED_PT_KLST.P_CODE_SH_TO_UB K_ED_PT_KLST.P_CODE_UNPLAUSIBEL K_ED_PT_KM.DEC_NACH_EINTRAG K_ED_PT_KM.DEC_VOR_EINTRAG K_ED_PT_KM.FEHLERSCHWELLE K_ED_PT_KM.INC_NACH_EINTRAG K_ED_PT_KM.INC_VOR_EINTRAG K_ED_PT_KM.KLASSENINDEX K_ED_PT_KM.OK_SCHWELLE K_ED_PT_KM.P_CODE_OPENLOAD K_ED_PT_KM.P_CODE_SH_TO_GND K_ED_PT_KM.P_CODE_SH_TO_UB K_ED_PT_KM.P_CODE_UNPLAUSIBEL K_ED_PT_KOMBI.DEC_NACH_EINTRAG K_ED_PT_KOMBI.DEC_VOR_EINTRAG K_ED_PT_KOMBI.FEHLERSCHWELLE K_ED_PT_KOMBI.INC_NACH_EINTRAG K_ED_PT_KOMBI.INC_VOR_EINTRAG K_ED_PT_KOMBI.KLASSENINDEX K_ED_PT_KOMBI.OK_SCHWELLE K_ED_PT_KOMBI.P_CODE_OPENLOAD K_ED_PT_KOMBI.P_CODE_SH_TO_GND K_ED_PT_KOMBI.P_CODE_SH_TO_UB K_ED_PT_KOMBI.P_CODE_UNPLAUSIBEL K_ED_PT_LRW.DEC_NACH_EINTRAG K_ED_PT_LRW.DEC_VOR_EINTRAG K_ED_PT_LRW.FEHLERSCHWELLE K_ED_PT_LRW.INC_NACH_EINTRAG K_ED_PT_LRW.INC_VOR_EINTRAG K_ED_PT_LRW.KLASSENINDEX K_ED_PT_LRW.OK_SCHWELLE K_ED_PT_LRW.P_CODE_OPENLOAD K_ED_PT_LRW.P_CODE_SH_TO_GND K_ED_PT_LRW.P_CODE_SH_TO_UB K_ED_PT_LRW.P_CODE_UNPLAUSIBEL K_ED_PT_OBD_ED.DEC_NACH_EINTRAG K_ED_PT_OBD_ED.DEC_VOR_EINTRAG K_ED_PT_OBD_ED.FEHLERSCHWELLE K_ED_PT_OBD_ED.INC_NACH_EINTRAG K_ED_PT_OBD_ED.INC_VOR_EINTRAG K_ED_PT_OBD_ED.KLASSENINDEX K_ED_PT_OBD_ED.OK_SCHWELLE K_ED_PT_OBD_ED.P_CODE_OPENLOAD K_ED_PT_OBD_ED.P_CODE_SH_TO_GND K_ED_PT_OBD_ED.P_CODE_SH_TO_UB K_ED_PT_OBD_ED.P_CODE_UNPLAUSIBEL K_ED_PT_STATANH.DEC_NACH_EINTRAG K_ED_PT_STATANH.DEC_VOR_EINTRAG K_ED_PT_STATANH.FEHLERSCHWELLE K_ED_PT_STATANH.INC_NACH_EINTRAG K_ED_PT_STATANH.INC_VOR_EINTRAG K_ED_PT_STATANH.KLASSENINDEX K_ED_PT_STATANH.OK_SCHWELLE K_ED_PT_STATANH.P_CODE_OPENLOAD K_ED_PT_STATANH.P_CODE_SH_TO_GND K_ED_PT_STATANH.P_CODE_SH_TO_UB K_ED_PT_STATANH.P_CODE_UNPLAUSIBEL K_ED_PT_STATDKG.DEC_NACH_EINTRAG K_ED_PT_STATDKG.DEC_VOR_EINTRAG K_ED_PT_STATDKG.FEHLERSCHWELLE K_ED_PT_STATDKG.INC_NACH_EINTRAG K_ED_PT_STATDKG.INC_VOR_EINTRAG K_ED_PT_STATDKG.KLASSENINDEX K_ED_PT_STATDKG.OK_SCHWELLE K_ED_PT_STATDKG.P_CODE_OPENLOAD K_ED_PT_STATDKG.P_CODE_SH_TO_GND K_ED_PT_STATDKG.P_CODE_SH_TO_UB K_ED_PT_STATDKG.P_CODE_UNPLAUSIBEL K_ED_PT_STATGRB.DEC_NACH_EINTRAG K_ED_PT_STATGRB.DEC_VOR_EINTRAG K_ED_PT_STATGRB.FEHLERSCHWELLE K_ED_PT_STATGRB.INC_NACH_EINTRAG K_ED_PT_STATGRB.INC_VOR_EINTRAG K_ED_PT_STATGRB.KLASSENINDEX K_ED_PT_STATGRB.OK_SCHWELLE K_ED_PT_STATGRB.P_CODE_OPENLOAD K_ED_PT_STATGRB.P_CODE_SH_TO_GND K_ED_PT_STATGRB.P_CODE_SH_TO_UB K_ED_PT_STATGRB.P_CODE_UNPLAUSIBEL K_ED_PT_STATR.DEC_NACH_EINTRAG K_ED_PT_STATR.DEC_VOR_EINTRAG K_ED_PT_STATR.FEHLERSCHWELLE K_ED_PT_STATR.INC_NACH_EINTRAG K_ED_PT_STATR.INC_VOR_EINTRAG K_ED_PT_STATR.KLASSENINDEX K_ED_PT_STATR.OK_SCHWELLE K_ED_PT_STATR.P_CODE_OPENLOAD K_ED_PT_STATR.P_CODE_SH_TO_GND K_ED_PT_STATR.P_CODE_SH_TO_UB K_ED_PT_STATR.P_CODE_UNPLAUSIBEL K_ED_PT_STDSC.DEC_NACH_EINTRAG K_ED_PT_STDSC.DEC_VOR_EINTRAG K_ED_PT_STDSC.FEHLERSCHWELLE K_ED_PT_STDSC.INC_NACH_EINTRAG K_ED_PT_STDSC.INC_VOR_EINTRAG K_ED_PT_STDSC.KLASSENINDEX K_ED_PT_STDSC.OK_SCHWELLE K_ED_PT_STDSC.P_CODE_OPENLOAD K_ED_PT_STDSC.P_CODE_SH_TO_GND K_ED_PT_STDSC.P_CODE_SH_TO_UB K_ED_PT_STDSC.P_CODE_UNPLAUSIBEL K_ED_PT_TOMA.DEC_NACH_EINTRAG K_ED_PT_TOMA.DEC_VOR_EINTRAG K_ED_PT_TOMA.FEHLERSCHWELLE K_ED_PT_TOMA.INC_NACH_EINTRAG K_ED_PT_TOMA.INC_VOR_EINTRAG K_ED_PT_TOMA.KLASSENINDEX K_ED_PT_TOMA.OK_SCHWELLE K_ED_PT_TOMA.P_CODE_OPENLOAD K_ED_PT_TOMA.P_CODE_SH_TO_GND K_ED_PT_TOMA.P_CODE_SH_TO_UB K_ED_PT_TOMA.P_CODE_UNPLAUSIBEL K_ED_PT_TORQDSC.DEC_NACH_EINTRAG K_ED_PT_TORQDSC.DEC_VOR_EINTRAG K_ED_PT_TORQDSC.FEHLERSCHWELLE K_ED_PT_TORQDSC.INC_NACH_EINTRAG K_ED_PT_TORQDSC.INC_VOR_EINTRAG K_ED_PT_TORQDSC.KLASSENINDEX K_ED_PT_TORQDSC.OK_SCHWELLE K_ED_PT_TORQDSC.P_CODE_OPENLOAD K_ED_PT_TORQDSC.P_CODE_SH_TO_GND K_ED_PT_TORQDSC.P_CODE_SH_TO_UB K_ED_PT_TORQDSC.P_CODE_UNPLAUSIBEL K_ED_PT_VEHMOD.DEC_NACH_EINTRAG K_ED_PT_VEHMOD.DEC_VOR_EINTRAG K_ED_PT_VEHMOD.FEHLERSCHWELLE K_ED_PT_VEHMOD.INC_NACH_EINTRAG K_ED_PT_VEHMOD.INC_VOR_EINTRAG K_ED_PT_VEHMOD.KLASSENINDEX K_ED_PT_VEHMOD.OK_SCHWELLE K_ED_PT_VEHMOD.P_CODE_OPENLOAD K_ED_PT_VEHMOD.P_CODE_SH_TO_GND /end DEF_CHARACTERISTIC
/end FUNCTION
/begin RECORD_LAYOUT TKW_VV_VV_UB FNC_VALUES 1 UBYTE COLUMN_DIR DIRECT /end RECORD_LAYOUT
/begin RECORD_LAYOUT TKW_VV_VV_UW FNC_VALUES 1 UWORD COLUMN_DIR DIRECT /end RECORD_LAYOUT
/end MODULE
/end PROJECT
