/begin PROJECT MSS65-inj-V452 "MSS65 INJ - V452.01-B204.00, data set 0569Q60Z160E"
/begin HEADER "" VERSION "V452.01-B204.00" /end HEADER
/begin MODULE _MSS65-inj "MSS65 INJ - V452.01-B204.00, calibration xxxxxxxx"
/begin MOD_COMMON "" BYTE_ORDER MSB_FIRST /* Default byteorder (Motorola) */ /end MOD_COMMON
/* ------------------ Abschnitt erzeugt aus adapt_common.dat ------------------ */
/begin COMPU_METHOD FORMULA_0000 "FORMULA_0000" RAT_FUNC "%7.0" "-" COEFFS 0 1 0 0 0 1 /end COMPU_METHOD
/begin COMPU_METHOD FORMULA_0001 "FORMULA_0001" RAT_FUNC "%6.1" "%" COEFFS 0 10 0 0 0 1 /end COMPU_METHOD
/begin COMPU_METHOD FORMULA_0003 "FORMULA_0003" RAT_FUNC "%3.0" "-" COEFFS 0 1 0 0 0 1 /end COMPU_METHOD
/begin COMPU_METHOD FORMULA_0006 "FORMULA_0006" RAT_FUNC "%5.0" "Upm" COEFFS 0 1 0 0 0 1 /end COMPU_METHOD
/begin COMPU_METHOD FORMULA_0007 "FORMULA_0007" RAT_FUNC "%8.3" "-" COEFFS 0 10000 0 0 0 1 /end COMPU_METHOD
/begin COMPU_METHOD FORMULA_0008 "FORMULA_0008" RAT_FUNC "%6.1" "V" COEFFS 0 10 0 0 0 1 /end COMPU_METHOD
/begin COMPU_METHOD FORMULA_0009 "FORMULA_0009" RAT_FUNC "%6.1" "Nm" COEFFS 0 10 0 0 0 1 /end COMPU_METHOD
/begin COMPU_METHOD FORMULA_0010 "FORMULA_0010" RAT_FUNC "%5.0" "-" COEFFS 0 1 0 0 0 1 /end COMPU_METHOD
/begin COMPU_METHOD FORMULA_0012 "FORMULA_0012" TAB_VERB "%3.0" "-" COMPU_TAB_REF FORMULA_0012_VTAB /end COMPU_METHOD
/begin COMPU_VTAB FORMULA_0012_VTAB "FORMULA_0012_VTAB" TAB_VERB 1 0 "iO" DEFAULT_VALUE "Fehler" /end COMPU_VTAB
/begin COMPU_METHOD FORMULA_0019 "FORMULA_0019" TAB_VERB "%7.2" "-" COMPU_TAB_REF FORMULA_0019_VTAB /end COMPU_METHOD
/begin COMPU_VTAB FORMULA_0019_VTAB "FORMULA_0019_VTAB" TAB_VERB 13 1 "Motor steht" 2 "Motor presync" 4 "Start" 8 "LLOKS" 16 "LLMKS" 32 "TL" 64 "VL" 128 "SA" 256 "NL" 512 "Abgew." 1024 "Kl15 aus" 2048 "Wakeup" 4096 "Schub" DEFAULT_VALUE "undefiniert" /end COMPU_VTAB
/begin COMPU_METHOD FORMULA_0020 "FORMULA_0020" RAT_FUNC "%5.0" "qmm/s" COEFFS 0 1 0 0 0 20 /end COMPU_METHOD
/begin COMPU_METHOD FORMULA_0021 "FORMULA_0021" RAT_FUNC "%7.2" "s" COEFFS 0 100 0 0 0 1 /end COMPU_METHOD
/begin COMPU_METHOD FORMULA_0022 "FORMULA_0022" RAT_FUNC "%7.2" "%" COEFFS 0 100 0 0 0 1 /end COMPU_METHOD
/* ------------------ Abschnitt erzeugt aus adapt_glob.dat ------------------ */
/begin COMPU_METHOD FORMULA_0023 "FORMULA_0023" RAT_FUNC "%6.1" "�C" COEFFS 0 10 2732 0 0 1 /end COMPU_METHOD
/begin COMPU_METHOD FORMULA_0024 "FORMULA_0024" RAT_FUNC "%9.4" "-" COEFFS 0 32768 0 0 0 1 /end COMPU_METHOD
/begin COMPU_METHOD FORMULA_0025 "FORMULA_0025" RAT_FUNC "%8.3" "-" COEFFS 0 16384 0 0 0 1 /end COMPU_METHOD
/begin COMPU_METHOD FORMULA_0033 "FORMULA_0033" RAT_FUNC "%5.2" "-" COEFFS 0 1 0 0 0 1 /end COMPU_METHOD
/begin COMPU_METHOD FORMULA_0053 "FORMULA_0053" RAT_FUNC "%7.2" "g/s" COEFFS 0 100 0 0 0 1 /end COMPU_METHOD
/begin COMPU_METHOD FORMULA_0057 "FORMULA_0057" RAT_FUNC "%3.0" "�C" COEFFS 0 1 40 0 0 1 /end COMPU_METHOD
/begin COMPU_METHOD FORMULA_0065 "FORMULA_0065" RAT_FUNC "%5.2" "%" COEFFS 0 255 0 0 0 100 /end COMPU_METHOD
/begin COMPU_METHOD FORMULA_0075 "FORMULA_0075" RAT_FUNC "%8.3" "-" COEFFS 0 1024 0 0 0 1 /end COMPU_METHOD
/begin COMPU_METHOD FORMULA_0076 "FORMULA_0076" RAT_FUNC "%6.1" "Kelvin" COEFFS 0 10 0 0 0 1 /end COMPU_METHOD
/begin COMPU_METHOD FORMULA_0077 "FORMULA_0077" RAT_FUNC "%6.1" "mbar" COEFFS 0 16 0 0 0 1 /end COMPU_METHOD
/begin COMPU_METHOD FORMULA_0078 "FORMULA_0078" RAT_FUNC "%6.1" "km/h" COEFFS 0 16 0 0 0 1 /end COMPU_METHOD
/begin COMPU_METHOD FORMULA_0079 "FORMULA_0079" RAT_FUNC "%6.1" "l" COEFFS 0 2 0 0 0 1 /end COMPU_METHOD
/* ------------------ Abschnitt erzeugt aus glob.dat ------------------ */
/begin COMPU_METHOD FORMULA_0083 "FORMULA_0083" RAT_FUNC "%7.2" "-" COEFFS 0 1 0 0 0 1 /end COMPU_METHOD
/begin COMPU_METHOD FORMULA_0084 "FORMULA_0084" TAB_VERB "%7.2" "-" COMPU_TAB_REF FORMULA_0084_VTAB /end COMPU_METHOD
/begin COMPU_VTAB FORMULA_0084_VTAB "FORMULA_0084_VTAB" TAB_VERB 3 1 "Regler-RESET" 2 "Regler aktiv" 4 "Regler inaktiv" /end COMPU_VTAB
/begin COMPU_METHOD FORMULA_0085 "FORMULA_0085" TAB_VERB "%7.2" "-" COMPU_TAB_REF FORMULA_0085_VTAB /end COMPU_METHOD
/begin COMPU_VTAB FORMULA_0085_VTAB "FORMULA_0085_VTAB" TAB_VERB 2 0 "nicht einger." 1 "einger." /end COMPU_VTAB
/begin COMPU_METHOD FORMULA_0086 "FORMULA_0086" TAB_VERB "%7.2" "-" COMPU_TAB_REF FORMULA_0086_VTAB /end COMPU_METHOD
/begin COMPU_VTAB FORMULA_0086_VTAB "FORMULA_0086_VTAB" TAB_VERB 2 0 "inaktiv" 1 "aktiv" /end COMPU_VTAB
/begin COMPU_METHOD FORMULA_0087 "FORMULA_0087" TAB_VERB "%7.2" "-" COMPU_TAB_REF FORMULA_0087_VTAB /end COMPU_METHOD
/begin COMPU_VTAB FORMULA_0087_VTAB "FORMULA_0087_VTAB" TAB_VERB 2 0 "i.O." 1 "ti_min" /end COMPU_VTAB
/begin COMPU_METHOD FORMULA_0088 "FORMULA_0088" TAB_VERB "%7.2" "-" COMPU_TAB_REF FORMULA_0088_VTAB /end COMPU_METHOD
/begin COMPU_VTAB FORMULA_0088_VTAB "FORMULA_0088_VTAB" TAB_VERB 2 0 "i.O." 1 "MIN" /end COMPU_VTAB
/begin COMPU_METHOD FORMULA_0089 "FORMULA_0089" TAB_VERB "%7.2" "-" COMPU_TAB_REF FORMULA_0089_VTAB /end COMPU_METHOD
/begin COMPU_VTAB FORMULA_0089_VTAB "FORMULA_0089_VTAB" TAB_VERB 2 0 "i.O." 1 "MAX" /end COMPU_VTAB
/begin COMPU_METHOD FORMULA_0090 "FORMULA_0090" TAB_VERB "%7.2" "-" COMPU_TAB_REF FORMULA_0090_VTAB /end COMPU_METHOD
/begin COMPU_VTAB FORMULA_0090_VTAB "FORMULA_0090_VTAB" TAB_VERB 2 0 "-" 1 "SA-Verz." /end COMPU_VTAB
/begin COMPU_METHOD FORMULA_0091 "FORMULA_0091" TAB_VERB "%7.2" "-" COMPU_TAB_REF FORMULA_0091_VTAB /end COMPU_METHOD
/begin COMPU_VTAB FORMULA_0091_VTAB "FORMULA_0091_VTAB" TAB_VERB 2 0 "-" 1 "SLP-Verz." /end COMPU_VTAB
/begin COMPU_METHOD FORMULA_0092 "FORMULA_0092" TAB_VERB "%7.2" "-" COMPU_TAB_REF FORMULA_0092_VTAB /end COMPU_METHOD
/begin COMPU_VTAB FORMULA_0092_VTAB "FORMULA_0092_VTAB" TAB_VERB 2 0 "nicht einger." 1 "einger." /end COMPU_VTAB
/begin COMPU_METHOD FORMULA_0093 "FORMULA_0093" RAT_FUNC "%7.2" "mg" COEFFS 0 10 0 0 0 1 /end COMPU_METHOD
/begin COMPU_METHOD FORMULA_0094 "FORMULA_0094" TAB_VERB "%7.2" "-" COMPU_TAB_REF FORMULA_0094_VTAB /end COMPU_METHOD
/begin COMPU_VTAB FORMULA_0094_VTAB "FORMULA_0094_VTAB" TAB_VERB 2 0 "inaktiv" 1 "aktiv" /end COMPU_VTAB
/begin COMPU_METHOD FORMULA_0095 "FORMULA_0095" TAB_VERB "%7.2" "-" COMPU_TAB_REF FORMULA_0095_VTAB /end COMPU_METHOD
/begin COMPU_VTAB FORMULA_0095_VTAB "FORMULA_0095_VTAB" TAB_VERB 2 0 "inaktiv" 1 "aktiv" /end COMPU_VTAB
/begin COMPU_METHOD FORMULA_0096 "FORMULA_0096" TAB_VERB "%7.2" "-" COMPU_TAB_REF FORMULA_0096_VTAB /end COMPU_METHOD
/begin COMPU_VTAB FORMULA_0096_VTAB "FORMULA_0096_VTAB" TAB_VERB 2 0 "inaktiv" 1 "aktiv" /end COMPU_VTAB
/begin COMPU_METHOD FORMULA_0097 "FORMULA_0097" TAB_VERB "%7.2" "-" COMPU_TAB_REF FORMULA_0097_VTAB /end COMPU_METHOD
/begin COMPU_VTAB FORMULA_0097_VTAB "FORMULA_0097_VTAB" TAB_VERB 2 0 "inaktiv" 1 "aktiv" /end COMPU_VTAB
/begin COMPU_METHOD FORMULA_0098 "FORMULA_0098" TAB_VERB "%7.2" "-" COMPU_TAB_REF FORMULA_0098_VTAB /end COMPU_METHOD
/begin COMPU_VTAB FORMULA_0098_VTAB "FORMULA_0098_VTAB" TAB_VERB 2 0 "nein" 1 "ja" /end COMPU_VTAB
/begin COMPU_METHOD FORMULA_0099 "FORMULA_0099" TAB_VERB "%7.2" "-" COMPU_TAB_REF FORMULA_0099_VTAB /end COMPU_METHOD
/begin COMPU_VTAB FORMULA_0099_VTAB "FORMULA_0099_VTAB" TAB_VERB 2 0 "inaktiv" 1 "aktiv" /end COMPU_VTAB
/begin COMPU_METHOD FORMULA_0100 "FORMULA_0100" TAB_VERB "%7.2" "-" COMPU_TAB_REF FORMULA_0100_VTAB /end COMPU_METHOD
/begin COMPU_VTAB FORMULA_0100_VTAB "FORMULA_0100_VTAB" TAB_VERB 2 0 "inaktiv" 1 "aktiv" /end COMPU_VTAB
/begin COMPU_METHOD FORMULA_0101 "FORMULA_0101" TAB_VERB "%7.2" "-" COMPU_TAB_REF FORMULA_0101_VTAB /end COMPU_METHOD
/begin COMPU_VTAB FORMULA_0101_VTAB "FORMULA_0101_VTAB" TAB_VERB 2 0 "inaktiv" 1 "aktiv" /end COMPU_VTAB
/begin COMPU_METHOD FORMULA_0102 "FORMULA_0102" TAB_VERB "%7.2" "-" COMPU_TAB_REF FORMULA_0102_VTAB /end COMPU_METHOD
/begin COMPU_VTAB FORMULA_0102_VTAB "FORMULA_0102_VTAB" TAB_VERB 2 0 "no" 1 "yes" /end COMPU_VTAB
/begin COMPU_METHOD FORMULA_0103 "FORMULA_0103" TAB_VERB "%7.2" "-" COMPU_TAB_REF FORMULA_0103_VTAB /end COMPU_METHOD
/begin COMPU_VTAB FORMULA_0103_VTAB "FORMULA_0103_VTAB" TAB_VERB 5 1 "PASSIV" 2 "WARTEN" 4 "AMPLITUDE" 8 "NORMIERUNG" 16 "ENDE" DEFAULT_VALUE "undef." /end COMPU_VTAB
/begin COMPU_METHOD FORMULA_0104 "FORMULA_0104" TAB_VERB "%7.2" "-" COMPU_TAB_REF FORMULA_0104_VTAB /end COMPU_METHOD
/begin COMPU_VTAB FORMULA_0104_VTAB "FORMULA_0104_VTAB" TAB_VERB 1 0 "-" DEFAULT_VALUE "MAX-Ermittlung" /end COMPU_VTAB
/begin COMPU_METHOD FORMULA_0105 "FORMULA_0105" TAB_VERB "%7.2" "-" COMPU_TAB_REF FORMULA_0105_VTAB /end COMPU_METHOD
/begin COMPU_VTAB FORMULA_0105_VTAB "FORMULA_0105_VTAB" TAB_VERB 1 0 "-" DEFAULT_VALUE "MIN-Ermittlung" /end COMPU_VTAB
/begin COMPU_METHOD FORMULA_0106 "FORMULA_0106" TAB_VERB "%7.2" "-" COMPU_TAB_REF FORMULA_0106_VTAB /end COMPU_METHOD
/begin COMPU_VTAB FORMULA_0106_VTAB "FORMULA_0106_VTAB" TAB_VERB 1 0 "-" DEFAULT_VALUE "aktiv" /end COMPU_VTAB
/begin COMPU_METHOD FORMULA_0107 "FORMULA_0107" TAB_VERB "%7.2" "-" COMPU_TAB_REF FORMULA_0107_VTAB /end COMPU_METHOD
/begin COMPU_VTAB FORMULA_0107_VTAB "FORMULA_0107_VTAB" TAB_VERB 1 0 "inaktiv" DEFAULT_VALUE "aktiv" /end COMPU_VTAB
/begin COMPU_METHOD FORMULA_0108 "FORMULA_0108" TAB_VERB "%7.2" "-" COMPU_TAB_REF FORMULA_0108_VTAB /end COMPU_METHOD
/begin COMPU_VTAB FORMULA_0108_VTAB "FORMULA_0108_VTAB" TAB_VERB 1 0 "inaktiv" DEFAULT_VALUE "aktiv" /end COMPU_VTAB
/begin COMPU_METHOD FORMULA_0109 "FORMULA_0109" RAT_FUNC "%7.2" "-" COEFFS 0 10000 0 0 0 1 /end COMPU_METHOD
/begin COMPU_METHOD FORMULA_0110 "FORMULA_0110" TAB_VERB "%3.0" "-" COMPU_TAB_REF FORMULA_0110_VTAB /end COMPU_METHOD
/begin COMPU_VTAB FORMULA_0110_VTAB "FORMULA_0110_VTAB" TAB_VERB 5 1 "warte Sync." 2 "Sync. laeuft" 4 "synchronisiert" 8 "nicht sync." 20 "Sync. vio Ionenstrom" DEFAULT_VALUE "gibts nicht" /end COMPU_VTAB
/begin COMPU_METHOD FORMULA_0111 "FORMULA_0111" RAT_FUNC "%6.1" "�KW" COEFFS 0 10 0 0 0 1 /end COMPU_METHOD
/begin COMPU_METHOD FORMULA_0112 "FORMULA_0112" RAT_FUNC "%6.1" "kg/h" COEFFS 0 10 0 0 0 1 /end COMPU_METHOD
/begin COMPU_METHOD FORMULA_0113 "FORMULA_0113" RAT_FUNC "%6.1" "mg/asp" COEFFS 0 10 0 0 0 1 /end COMPU_METHOD
/begin COMPU_METHOD FORMULA_0114 "FORMULA_0114" RAT_FUNC "%5.0" "Upm/s" COEFFS 0 1 0 0 0 1 /end COMPU_METHOD
/begin COMPU_METHOD FORMULA_0115 "FORMULA_0115" RAT_FUNC "%7.2" "%" COEFFS 0 16384 0 0 0 100 /end COMPU_METHOD
/begin COMPU_METHOD FORMULA_0116 "FORMULA_0116" TAB_VERB "%5.2" "-" COMPU_TAB_REF FORMULA_0116_VTAB /end COMPU_METHOD
/begin COMPU_VTAB FORMULA_0116_VTAB "FORMULA_0116_VTAB" TAB_VERB 7 0 "Inaktiv" 1 "Trigger" 2 "Bereit" 3 "Tr+Be" 4 "Aktiv" 7 "Tr+Be+Aktiv" 8 "WE" DEFAULT_VALUE "undef" /end COMPU_VTAB
/begin COMPU_METHOD FORMULA_0117 "FORMULA_0117" RAT_FUNC "%7.2" "s" COEFFS 0 200 0 0 0 1 /end COMPU_METHOD
/begin COMPU_METHOD FORMULA_0118 "FORMULA_0118" RAT_FUNC "%8.3" "bar" COEFFS 0 1000 0 0 0 1 /end COMPU_METHOD
/begin COMPU_METHOD FORMULA_0119 "FORMULA_0119" RAT_FUNC "%5.2" "bar" COEFFS 0 100 0 0 0 3 /end COMPU_METHOD
/begin COMPU_METHOD FORMULA_0120 "FORMULA_0120" TAB_VERB "%5.2" "-" COMPU_TAB_REF FORMULA_0120_VTAB /end COMPU_METHOD
/begin COMPU_VTAB FORMULA_0120_VTAB "FORMULA_0120_VTAB" TAB_VERB 2 0 "QLT-Temp.fehler" 1 "QLT-Temp.OK" DEFAULT_VALUE "undef." /end COMPU_VTAB
/begin COMPU_METHOD FORMULA_0121 "FORMULA_0121" RAT_FUNC "%7.2" "Nm" COEFFS 0 10 0 0 0 1 /end COMPU_METHOD
/begin COMPU_METHOD FORMULA_0122 "FORMULA_0122" TAB_VERB "%5.2" "-" COMPU_TAB_REF FORMULA_0122_VTAB /end COMPU_METHOD
/begin COMPU_VTAB FORMULA_0122_VTAB "FORMULA_0122_VTAB" TAB_VERB 2 0 "Inaktiv" 1 "Aktiv" /end COMPU_VTAB
/begin COMPU_METHOD FORMULA_0123 "FORMULA_0123" RAT_FUNC "%5.0" "digit" COEFFS 0 1 0 0 0 1 /end COMPU_METHOD
/begin COMPU_METHOD FORMULA_0124 "FORMULA_0124" TAB_VERB "%3.0" "-" COMPU_TAB_REF FORMULA_0124_VTAB /end COMPU_METHOD
/begin COMPU_VTAB FORMULA_0124_VTAB "FORMULA_0124_VTAB" TAB_VERB 2 0 "CBS-RESET nicht ausgef." 1 "CBS-RESET ausgefuehrt" /end COMPU_VTAB
/begin COMPU_METHOD FORMULA_0125 "FORMULA_0125" TAB_VERB "%5.0" "-" COMPU_TAB_REF FORMULA_0125_VTAB /end COMPU_METHOD
/begin COMPU_VTAB FORMULA_0125_VTAB "FORMULA_0125_VTAB" TAB_VERB 8 0 "O.K." 1 "BusOff" 2 "DPR" 4 "Timeout" 5 "BusOff+Timeout" 8 "Overflow" 16 "Chksum" 32 "Alive" DEFAULT_VALUE "Mehrfachfehler" /end COMPU_VTAB
/begin COMPU_METHOD FORMULA_0126 "FORMULA_0126" TAB_VERB "%3.0" "-" COMPU_TAB_REF FORMULA_0126_VTAB /end COMPU_METHOD
/begin COMPU_VTAB FORMULA_0126_VTAB "FORMULA_0126_VTAB" TAB_VERB 8 0 "O.K." 1 "BusOff" 2 "DPR" 4 "Timeout" 5 "BusOff+Timeout" 8 "Overflow" 16 "Chksum" 32 "Alive" DEFAULT_VALUE "Mehrfachfehler" /end COMPU_VTAB
/begin COMPU_METHOD FORMULA_0127 "FORMULA_0127" TAB_VERB "%3.0" "-" COMPU_TAB_REF FORMULA_0127_VTAB /end COMPU_METHOD
/begin COMPU_VTAB FORMULA_0127_VTAB "FORMULA_0127_VTAB" TAB_VERB 4 0 "aus" 1 "ein" 2 "Stufe 1" 4 "Stufe 2" DEFAULT_VALUE "ungueltig" /end COMPU_VTAB
/begin COMPU_METHOD FORMULA_0128 "FORMULA_0128" TAB_VERB "%3.0" "-" COMPU_TAB_REF FORMULA_0128_VTAB /end COMPU_METHOD
/begin COMPU_VTAB FORMULA_0128_VTAB "FORMULA_0128_VTAB" TAB_VERB 3 0 "aus" 1 "ZH" 2 "NTKW" DEFAULT_VALUE "ungueltig" /end COMPU_VTAB
/begin COMPU_METHOD FORMULA_0129 "FORMULA_0129" RAT_FUNC "%6.1" "Nm" COEFFS 0 2 0 0 0 1 /end COMPU_METHOD
/begin COMPU_METHOD FORMULA_0130 "FORMULA_0130" TAB_VERB "%7.2" "-" COMPU_TAB_REF FORMULA_0130_VTAB /end COMPU_METHOD
/begin COMPU_VTAB FORMULA_0130_VTAB "FORMULA_0130_VTAB" TAB_VERB 7 0 "iO" 1 "VL defekt" 2 "VR defekt" 4 "HL defekt" 8 "HR defekt" 16 "vVorne" 20 "vTacho" DEFAULT_VALUE "Mehrfach" /end COMPU_VTAB
/begin COMPU_METHOD FORMULA_0131 "FORMULA_0131" TAB_VERB "%5.2" "-" COMPU_TAB_REF FORMULA_0131_VTAB /end COMPU_METHOD
/begin COMPU_VTAB FORMULA_0131_VTAB "FORMULA_0131_VTAB" TAB_VERB 4 0 "steht" 1 "vorwaerts" 2 "rueckwaerts" 3 "faehrt" DEFAULT_VALUE "ungueltig" /end COMPU_VTAB
/begin COMPU_METHOD FORMULA_0132 "FORMULA_0132" RAT_FUNC "%7.2" "m/(s*s)" COEFFS 0 40 0 0 0 1 /end COMPU_METHOD
/begin COMPU_METHOD FORMULA_0133 "FORMULA_0133" TAB_VERB "%5.2" "-" COMPU_TAB_REF FORMULA_0133_VTAB /end COMPU_METHOD
/begin COMPU_VTAB FORMULA_0133_VTAB "FORMULA_0133_VTAB" TAB_VERB 4 0 "iO" 1 "ax-Err" 2 "ay-Err" 3 "ax-ay-Err" DEFAULT_VALUE "ungueltig" /end COMPU_VTAB
/begin COMPU_METHOD FORMULA_0134 "FORMULA_0134" TAB_VERB "%5.2" "-" COMPU_TAB_REF FORMULA_0134_VTAB /end COMPU_METHOD
/begin COMPU_VTAB FORMULA_0134_VTAB "FORMULA_0134_VTAB" TAB_VERB 3 0 "Inaktiv" 1 "MSR" 2 "ASC" DEFAULT_VALUE "ungueltig" /end COMPU_VTAB
/begin COMPU_METHOD FORMULA_0135 "FORMULA_0135" TAB_VERB "%3.0" "-" COMPU_TAB_REF FORMULA_0135_VTAB /end COMPU_METHOD
/begin COMPU_VTAB FORMULA_0135_VTAB "FORMULA_0135_VTAB" TAB_VERB 8 0 "iO" 1 "passiv" 2 "defekt" 3 "reserviert" 4 "MDM" 5 "reserviert" 6 "Unterspannung" 7 "ungueltig" /end COMPU_VTAB
/begin COMPU_METHOD FORMULA_0136 "FORMULA_0136" TAB_VERB "%3.0" "-" COMPU_TAB_REF FORMULA_0136_VTAB /end COMPU_METHOD
/begin COMPU_VTAB FORMULA_0136_VTAB "FORMULA_0136_VTAB" TAB_VERB 11 0 "keine" 1 "ABS" 2 "ASC" 3 "ABS/ASC" 4 "DSC" 5 "ABS/DSC" 8 "HBA" 16 "MSR" 17 "ABS/MSR" 32 "EBV" 255 "ungueltig" DEFAULT_VALUE "selbstrechnen" /end COMPU_VTAB
/begin COMPU_METHOD FORMULA_0137 "FORMULA_0137" TAB_VERB "%3.0" "-" COMPU_TAB_REF FORMULA_0137_VTAB /end COMPU_METHOD
/begin COMPU_VTAB FORMULA_0137_VTAB "FORMULA_0137_VTAB" TAB_VERB 4 0 "keiner" 1 "vorhanden" 2 "???" 3 "ungueltig" /end COMPU_VTAB
/begin COMPU_METHOD FORMULA_0138 "FORMULA_0138" RAT_FUNC "%3.0" "bar" COEFFS 0 1 0 0 0 1 /end COMPU_METHOD
/begin COMPU_METHOD FORMULA_0139 "FORMULA_0139" TAB_VERB "%5.2" "-" COMPU_TAB_REF FORMULA_0139_VTAB /end COMPU_METHOD
/begin COMPU_VTAB FORMULA_0139_VTAB "FORMULA_0139_VTAB" TAB_VERB 4 0 "iO" 1 "Verifikation" 2 "Fehler" 3 "ungueltig" /end COMPU_VTAB
/begin COMPU_METHOD FORMULA_0140 "FORMULA_0140" RAT_FUNC "%5.0" "bar/s" COEFFS 0 1 0 0 0 50 /end COMPU_METHOD
/begin COMPU_METHOD FORMULA_0141 "FORMULA_0141" RAT_FUNC "%7.2" "Grad" COEFFS 0 1 0 0 0 0.04395 /end COMPU_METHOD
/begin COMPU_METHOD FORMULA_0142 "FORMULA_0142" RAT_FUNC "%7.2" "Grad/s" COEFFS 0 1 0 0 0 0.04395 /end COMPU_METHOD
/begin COMPU_METHOD FORMULA_0143 "FORMULA_0143" TAB_VERB "%3.0" "-" COMPU_TAB_REF FORMULA_0143_VTAB /end COMPU_METHOD
/begin COMPU_VTAB FORMULA_0143_VTAB "FORMULA_0143_VTAB" TAB_VERB 8 0 "alle aus" 1 "Kl R" 2 "Kl 15" 3 "Kl R+15" 4 "Kl 50" 5 "Kl R+50" 6 "Kl 15+50" 7 "Kl R+15+50" /end COMPU_VTAB
/begin COMPU_METHOD FORMULA_0144 "FORMULA_0144" TAB_VERB "%3.0" "-" COMPU_TAB_REF FORMULA_0144_VTAB /end COMPU_METHOD
/begin COMPU_VTAB FORMULA_0144_VTAB "FORMULA_0144_VTAB" TAB_VERB 8 0 "keine" 1 "T vo" 2 "UeT vo" 4 "T hi" 8 "UeT hi" 16 "T ob/un" 64 "T ax" 255 "ungueltig" /end COMPU_VTAB
/begin COMPU_METHOD FORMULA_0145 "FORMULA_0145" TAB_VERB "%5.2" "-" COMPU_TAB_REF FORMULA_0145_VTAB /end COMPU_METHOD
/begin COMPU_VTAB FORMULA_0145_VTAB "FORMULA_0145_VTAB" TAB_VERB 4 0 "aus" 1 "an" 2 "Anf aus" 4 "Anf aus rec" DEFAULT_VALUE "ungueltig" /end COMPU_VTAB
/begin COMPU_METHOD FORMULA_0146 "FORMULA_0146" RAT_FUNC "%6.1" "%" COEFFS 0 1667 0 0 0 100 /end COMPU_METHOD
/begin COMPU_METHOD FORMULA_0147 "FORMULA_0147" RAT_FUNC "%6.1" "qmm" COEFFS 0 10 0 0 0 1 /end COMPU_METHOD
/begin COMPU_METHOD FORMULA_0148 "FORMULA_0148" RAT_FUNC "%8.3" "ml" COEFFS 0 1000 0 0 0 1 /end COMPU_METHOD
/begin COMPU_METHOD FORMULA_0149 "FORMULA_0149" RAT_FUNC "%9.2" "min" COEFFS 0 60 0 0 0 1 /end COMPU_METHOD
/begin COMPU_METHOD FORMULA_0150 "FORMULA_0150" TAB_VERB "%5.2" "-" COMPU_TAB_REF FORMULA_0150_VTAB /end COMPU_METHOD
/begin COMPU_VTAB FORMULA_0150_VTAB "FORMULA_0150_VTAB" TAB_VERB 2 0 "Ok" 1 "Fehler" /end COMPU_VTAB
/begin COMPU_METHOD FORMULA_0151 "FORMULA_0151" TAB_VERB "%7.2" "-" COMPU_TAB_REF FORMULA_0151_VTAB /end COMPU_METHOD
/begin COMPU_VTAB FORMULA_0151_VTAB "FORMULA_0151_VTAB" TAB_VERB 5 1 "PASSIV" 2 "WARTEN" 4 "ZYK MAGER" 8 "ZYK FETT" 16 "ENDE" DEFAULT_VALUE "undef." /end COMPU_VTAB
/begin COMPU_METHOD FORMULA_0152 "FORMULA_0152" RAT_FUNC "%9.2" "s" COEFFS 0 100 0 0 0 1 /end COMPU_METHOD
/begin COMPU_METHOD FORMULA_0153 "FORMULA_0153" TAB_VERB "%5.2" "-" COMPU_TAB_REF FORMULA_0153_VTAB /end COMPU_METHOD
/begin COMPU_VTAB FORMULA_0153_VTAB "FORMULA_0153_VTAB" TAB_VERB 4 0 "inaktiv" 1 "Momenteneingriff" 2 "Einspritzausblendung" 3 "Md + TT-Eingriff" /end COMPU_VTAB
/begin COMPU_METHOD FORMULA_0154 "FORMULA_0154" TAB_VERB "%5.2" "-" COMPU_TAB_REF FORMULA_0154_VTAB /end COMPU_METHOD
/begin COMPU_VTAB FORMULA_0154_VTAB "FORMULA_0154_VTAB" TAB_VERB 2 0 "inaktiv" 1 "N-Dynamik aktiv" /end COMPU_VTAB
/begin COMPU_METHOD FORMULA_0155 "FORMULA_0155" TAB_VERB "%7.2" "-" COMPU_TAB_REF FORMULA_0155_VTAB /end COMPU_METHOD
/begin COMPU_VTAB FORMULA_0155_VTAB "FORMULA_0155_VTAB" TAB_VERB 2 0 "BLS aus" 1 "BLS ein" /end COMPU_VTAB
/begin COMPU_METHOD FORMULA_0156 "FORMULA_0156" TAB_VERB "%7.2" "-" COMPU_TAB_REF FORMULA_0156_VTAB /end COMPU_METHOD
/begin COMPU_VTAB FORMULA_0156_VTAB "FORMULA_0156_VTAB" TAB_VERB 2 0 "offen" 1 "geschlossen" /end COMPU_VTAB
/begin COMPU_METHOD FORMULA_0157 "FORMULA_0157" TAB_VERB "%7.2" "-" COMPU_TAB_REF FORMULA_0157_VTAB /end COMPU_METHOD
/begin COMPU_VTAB FORMULA_0157_VTAB "FORMULA_0157_VTAB" TAB_VERB 4 0 "Leergasse" 1 "Gerader Gang" 8 "Leergasse" 9 "Ungerader Gang" /end COMPU_VTAB
/begin COMPU_METHOD FORMULA_0158 "FORMULA_0158" TAB_VERB "%7.2" "-" COMPU_TAB_REF FORMULA_0158_VTAB /end COMPU_METHOD
/begin COMPU_VTAB FORMULA_0158_VTAB "FORMULA_0158_VTAB" TAB_VERB 2 0 "Sleep" 1 "Wakeup" /end COMPU_VTAB
/begin COMPU_METHOD FORMULA_0159 "FORMULA_0159" TAB_VERB "%7.2" "-" COMPU_TAB_REF FORMULA_0159_VTAB /end COMPU_METHOD
/begin COMPU_VTAB FORMULA_0159_VTAB "FORMULA_0159_VTAB" TAB_VERB 2 0 "aus" 1 "ein" /end COMPU_VTAB
/begin COMPU_METHOD FORMULA_0160 "FORMULA_0160" TAB_VERB "%7.2" "-" COMPU_TAB_REF FORMULA_0160_VTAB /end COMPU_METHOD
/begin COMPU_VTAB FORMULA_0160_VTAB "FORMULA_0160_VTAB" TAB_VERB 2 0 "keine Schaltung" 1 "Schaltung" /end COMPU_VTAB
/begin COMPU_METHOD FORMULA_0161 "FORMULA_0161" TAB_VERB "%7.2" "-" COMPU_TAB_REF FORMULA_0161_VTAB /end COMPU_METHOD
/begin COMPU_VTAB FORMULA_0161_VTAB "FORMULA_0161_VTAB" TAB_VERB 2 0 "kein Druck" 1 "Oeldruck" /end COMPU_VTAB
/begin COMPU_METHOD FORMULA_0162 "FORMULA_0162" TAB_VERB "%7.2" "-" COMPU_TAB_REF FORMULA_0162_VTAB /end COMPU_METHOD
/begin COMPU_VTAB FORMULA_0162_VTAB "FORMULA_0162_VTAB" TAB_VERB 2 0 "Motor abstellen" 1 "O.K." /end COMPU_VTAB
/begin COMPU_METHOD FORMULA_0163 "FORMULA_0163" TAB_VERB "%7.2" "-" COMPU_TAB_REF FORMULA_0163_VTAB /end COMPU_METHOD
/begin COMPU_VTAB FORMULA_0163_VTAB "FORMULA_0163_VTAB" TAB_VERB 2 0 "offen" 1 "Kraftschluss" /end COMPU_VTAB
/begin COMPU_METHOD FORMULA_0164 "FORMULA_0164" TAB_VERB "%5.2" "-" COMPU_TAB_REF FORMULA_0164_VTAB /end COMPU_METHOD
/begin COMPU_VTAB FORMULA_0164_VTAB "FORMULA_0164_VTAB" TAB_VERB 2 0 "AUS" 1 "EIN" DEFAULT_VALUE "ungueltig" /end COMPU_VTAB
/begin COMPU_METHOD FORMULA_0165 "FORMULA_0165" TAB_VERB "%3.0" "-" COMPU_TAB_REF FORMULA_0165_VTAB /end COMPU_METHOD
/begin COMPU_VTAB FORMULA_0165_VTAB "FORMULA_0165_VTAB" TAB_VERB 5 1 "Init" 2 "Awake" 3 "Ring" 4 "GoSleep" 5 "BusSleep" /end COMPU_VTAB
/begin COMPU_METHOD FORMULA_0166 "FORMULA_0166" TAB_VERB "%5.2" "-" COMPU_TAB_REF FORMULA_0166_VTAB /end COMPU_METHOD
/begin COMPU_VTAB FORMULA_0166_VTAB "FORMULA_0166_VTAB" TAB_VERB 2 0 "Inaktiv" 1 "Aktiv" /end COMPU_VTAB
/begin COMPU_METHOD FORMULA_0167 "FORMULA_0167" TAB_VERB "%5.2" "-" COMPU_TAB_REF FORMULA_0167_VTAB /end COMPU_METHOD
/begin COMPU_VTAB FORMULA_0167_VTAB "FORMULA_0167_VTAB" TAB_VERB 2 0 "Inaktiv" 1 "Aktiv" /end COMPU_VTAB
/begin COMPU_METHOD FORMULA_0168 "FORMULA_0168" TAB_VERB "%3.0" "-" COMPU_TAB_REF FORMULA_0168_VTAB /end COMPU_METHOD
/begin COMPU_VTAB FORMULA_0168_VTAB "FORMULA_0168_VTAB" TAB_VERB 3 0 "Konfigmodus" 1 "Aus" 2 "Ein" DEFAULT_VALUE "undef" /end COMPU_VTAB
/begin COMPU_METHOD FORMULA_0169 "FORMULA_0169" TAB_VERB "%3.0" "-" COMPU_TAB_REF FORMULA_0169_VTAB /end COMPU_METHOD
/begin COMPU_VTAB FORMULA_0169_VTAB "FORMULA_0169_VTAB" TAB_VERB 3 0 "Komfort" 1 "Normal" 2 "Sport" DEFAULT_VALUE "undef" /end COMPU_VTAB
/begin COMPU_METHOD FORMULA_0170 "FORMULA_0170" RAT_FUNC "%6.3" "�C" COEFFS 0 1 48 0 0 1 /end COMPU_METHOD
/begin COMPU_METHOD FORMULA_0171 "FORMULA_0171" RAT_FUNC "%3.0" "Upm" COEFFS 0 1 0 0 0 50 /end COMPU_METHOD
/begin COMPU_METHOD FORMULA_0172 "FORMULA_0172" TAB_VERB "%3.0" "-" COMPU_TAB_REF FORMULA_0172_VTAB /end COMPU_METHOD
/begin COMPU_VTAB FORMULA_0172_VTAB "FORMULA_0172_VTAB" TAB_VERB 1 0 "kein Fehler" /end COMPU_VTAB
/begin COMPU_METHOD FORMULA_0173 "FORMULA_0173" TAB_VERB "%3.0" "-" COMPU_TAB_REF FORMULA_0173_VTAB /end COMPU_METHOD
/begin COMPU_VTAB FORMULA_0173_VTAB "FORMULA_0173_VTAB" TAB_VERB 2 0 "inaktiv" 1 "aktiv" /end COMPU_VTAB
/begin COMPU_METHOD FORMULA_0174 "FORMULA_0174" TAB_VERB "%3.0" "-" COMPU_TAB_REF FORMULA_0174_VTAB /end COMPU_METHOD
/begin COMPU_VTAB FORMULA_0174_VTAB "FORMULA_0174_VTAB" TAB_VERB 2 0 "inaktiv" 1 "aktiv" /end COMPU_VTAB
/begin COMPU_METHOD FORMULA_0175 "FORMULA_0175" TAB_VERB "%3.0" "-" COMPU_TAB_REF FORMULA_0175_VTAB /end COMPU_METHOD
/begin COMPU_VTAB FORMULA_0175_VTAB "FORMULA_0175_VTAB" TAB_VERB 8 0 "iO" 1 "LA" 4 "LAA" 5 "LA+LAA" 16 "Mager" 17 "LA+Mager" 20 "LAA+Mager" 21 "LA+LAA+Mager" /end COMPU_VTAB
/begin COMPU_METHOD FORMULA_0176 "FORMULA_0176" TAB_VERB "%3.0" "-" COMPU_TAB_REF FORMULA_0176_VTAB /end COMPU_METHOD
/begin COMPU_VTAB FORMULA_0176_VTAB "FORMULA_0176_VTAB" TAB_VERB 8 0 "iO" 2 "LA" 8 "LAA" 10 "LA+LAA" 32 "Mager" 34 "LA+Mager" 40 "LAA+Mager" 42 "LA+LAA+Mager" /end COMPU_VTAB
/begin COMPU_METHOD FORMULA_0177 "FORMULA_0177" TAB_VERB "%3.0" "-" COMPU_TAB_REF FORMULA_0177_VTAB /end COMPU_METHOD
/begin COMPU_VTAB FORMULA_0177_VTAB "FORMULA_0177_VTAB" TAB_VERB 4 0 "iO" 1 "B1-Notl" 2 "B2-Notl" 3 "B1+B2-Notl" /end COMPU_VTAB
/begin COMPU_METHOD FORMULA_0178 "FORMULA_0178" TAB_VERB "%3.0" "-" COMPU_TAB_REF FORMULA_0178_VTAB /end COMPU_METHOD
/begin COMPU_VTAB FORMULA_0178_VTAB "FORMULA_0178_VTAB" TAB_VERB 2 0 "iO" 1 "PKS-Notlauf" /end COMPU_VTAB
/begin COMPU_METHOD FORMULA_0179 "FORMULA_0179" TAB_VERB "%3.0" "-" COMPU_TAB_REF FORMULA_0179_VTAB /end COMPU_METHOD
/begin COMPU_VTAB FORMULA_0179_VTAB "FORMULA_0179_VTAB" TAB_VERB 2 0 "iO" 1 "LLRA-Sperre" /end COMPU_VTAB
/begin COMPU_METHOD FORMULA_0180 "FORMULA_0180" TAB_VERB "%3.0" "-" COMPU_TAB_REF FORMULA_0180_VTAB /end COMPU_METHOD
/begin COMPU_VTAB FORMULA_0180_VTAB "FORMULA_0180_VTAB" TAB_VERB 2 0 "iO" 1 "FRA-Sperre" /end COMPU_VTAB
/begin COMPU_METHOD FORMULA_0181 "FORMULA_0181" TAB_VERB "%3.0" "-" COMPU_TAB_REF FORMULA_0181_VTAB /end COMPU_METHOD
/begin COMPU_VTAB FORMULA_0181_VTAB "FORMULA_0181_VTAB" TAB_VERB 2 0 "iO" 1 "KH-Sperre" /end COMPU_VTAB
/begin COMPU_METHOD FORMULA_0182 "FORMULA_0182" TAB_VERB "%3.0" "-" COMPU_TAB_REF FORMULA_0182_VTAB /end COMPU_METHOD
/begin COMPU_VTAB FORMULA_0182_VTAB "FORMULA_0182_VTAB" TAB_VERB 3 0 "iO" 1 "HFM" 2 "AQ" /end COMPU_VTAB
/begin COMPU_METHOD FORMULA_0183 "FORMULA_0183" TAB_VERB "%3.0" "-" COMPU_TAB_REF FORMULA_0183_VTAB /end COMPU_METHOD
/begin COMPU_VTAB FORMULA_0183_VTAB "FORMULA_0183_VTAB" TAB_VERB 2 0 "iO" 1 "FR-Sperre" /end COMPU_VTAB
/begin COMPU_METHOD FORMULA_0184 "FORMULA_0184" TAB_VERB "%5.0" "-" COMPU_TAB_REF FORMULA_0184_VTAB /end COMPU_METHOD
/begin COMPU_VTAB FORMULA_0184_VTAB "FORMULA_0184_VTAB" TAB_VERB 1 0 "alle ein" /end COMPU_VTAB
/begin COMPU_METHOD FORMULA_0185 "FORMULA_0185" TAB_VERB "%7.2" "-" COMPU_TAB_REF FORMULA_0185_VTAB /end COMPU_METHOD
/begin COMPU_VTAB FORMULA_0185_VTAB "FORMULA_0185_VTAB" TAB_VERB 2 0 "-" 1 "zulaessig" /end COMPU_VTAB
/begin COMPU_METHOD FORMULA_0186 "FORMULA_0186" TAB_VERB "%7.2" "-" COMPU_TAB_REF FORMULA_0186_VTAB /end COMPU_METHOD
/begin COMPU_VTAB FORMULA_0186_VTAB "FORMULA_0186_VTAB" TAB_VERB 2 0 "-" 1 "aktiv" /end COMPU_VTAB
/begin COMPU_METHOD FORMULA_0187 "FORMULA_0187" TAB_VERB "%7.2" "-" COMPU_TAB_REF FORMULA_0187_VTAB /end COMPU_METHOD
/begin COMPU_VTAB FORMULA_0187_VTAB "FORMULA_0187_VTAB" TAB_VERB 2 0 "-" 1 "Abbruch" /end COMPU_VTAB
/begin COMPU_METHOD FORMULA_0188 "FORMULA_0188" TAB_VERB "%7.2" "-" COMPU_TAB_REF FORMULA_0188_VTAB /end COMPU_METHOD
/begin COMPU_VTAB FORMULA_0188_VTAB "FORMULA_0188_VTAB" TAB_VERB 2 0 "-" 1 "STOP" /end COMPU_VTAB
/begin COMPU_METHOD FORMULA_0189 "FORMULA_0189" TAB_VERB "%7.2" "-" COMPU_TAB_REF FORMULA_0189_VTAB /end COMPU_METHOD
/begin COMPU_VTAB FORMULA_0189_VTAB "FORMULA_0189_VTAB" TAB_VERB 2 0 "-" 1 "DAUER" /end COMPU_VTAB
/begin COMPU_METHOD FORMULA_0190 "FORMULA_0190" TAB_VERB "%7.2" "-" COMPU_TAB_REF FORMULA_0190_VTAB /end COMPU_METHOD
/begin COMPU_VTAB FORMULA_0190_VTAB "FORMULA_0190_VTAB" TAB_VERB 2 0 "no" 1 "yes" /end COMPU_VTAB
/begin COMPU_METHOD FORMULA_0191 "FORMULA_0191" TAB_VERB "%7.2" "-" COMPU_TAB_REF FORMULA_0191_VTAB /end COMPU_METHOD
/begin COMPU_VTAB FORMULA_0191_VTAB "FORMULA_0191_VTAB" TAB_VERB 2 0 "no" 1 "yes" /end COMPU_VTAB
/begin COMPU_METHOD FORMULA_0192 "FORMULA_0192" TAB_VERB "%7.2" "-" COMPU_TAB_REF FORMULA_0192_VTAB /end COMPU_METHOD
/begin COMPU_VTAB FORMULA_0192_VTAB "FORMULA_0192_VTAB" TAB_VERB 2 0 "no" 1 "yes" /end COMPU_VTAB
/begin COMPU_METHOD FORMULA_0193 "FORMULA_0193" TAB_VERB "%7.2" "-" COMPU_TAB_REF FORMULA_0193_VTAB /end COMPU_METHOD
/begin COMPU_VTAB FORMULA_0193_VTAB "FORMULA_0193_VTAB" TAB_VERB 2 0 "no" 1 "yes" /end COMPU_VTAB
/begin COMPU_METHOD FORMULA_0194 "FORMULA_0194" TAB_VERB "%7.2" "-" COMPU_TAB_REF FORMULA_0194_VTAB /end COMPU_METHOD
/begin COMPU_VTAB FORMULA_0194_VTAB "FORMULA_0194_VTAB" TAB_VERB 2 0 "no" 1 "yes" /end COMPU_VTAB
/begin COMPU_METHOD FORMULA_0195 "FORMULA_0195" TAB_VERB "%7.2" "-" COMPU_TAB_REF FORMULA_0195_VTAB /end COMPU_METHOD
/begin COMPU_VTAB FORMULA_0195_VTAB "FORMULA_0195_VTAB" TAB_VERB 2 0 "i.O." 1 "SH_TO_X_SPERREN" /end COMPU_VTAB
/begin COMPU_METHOD FORMULA_0196 "FORMULA_0196" TAB_VERB "%7.2" "-" COMPU_TAB_REF FORMULA_0196_VTAB /end COMPU_METHOD
/begin COMPU_VTAB FORMULA_0196_VTAB "FORMULA_0196_VTAB" TAB_VERB 2 0 "i.O." 1 "SH_TO_X_SPERREN" /end COMPU_VTAB
/begin COMPU_METHOD FORMULA_0197 "FORMULA_0197" TAB_VERB "%7.2" "-" COMPU_TAB_REF FORMULA_0197_VTAB /end COMPU_METHOD
/begin COMPU_VTAB FORMULA_0197_VTAB "FORMULA_0197_VTAB" TAB_VERB 5 1 "SPUELEN-INI" 2 "TE-LAA-INI" 4 "SPUELEN KURZ" 8 "SPUELEN LANG" 16 "TE-LAA" DEFAULT_VALUE "nicht verf." /end COMPU_VTAB
/begin COMPU_METHOD FORMULA_0198 "FORMULA_0198" TAB_VERB "%7.2" "-" COMPU_TAB_REF FORMULA_0198_VTAB /end COMPU_METHOD
/begin COMPU_VTAB FORMULA_0198_VTAB "FORMULA_0198_VTAB" TAB_VERB 14 0 "AUS" 1 "WAIT" 2 "HFM-DIAG" 4 "ML-PLAUS" 8 "MDF-WAIT" 16 "MDF-DIAG" 32 "ZWD-100" 64 "ZWD-0" 128 "ZWD-OFF" 256 "SLV-DIAG" 512 "Abgas Lambda" 8192 "DIAG Ende Abbruch" 16384 "DIAG Ende IO" 32768 "DIAG Ende NIO" DEFAULT_VALUE "Ende mit Fehler" /end COMPU_VTAB
/begin COMPU_METHOD FORMULA_0199 "FORMULA_0199" TAB_VERB "%5.0" "-" COMPU_TAB_REF FORMULA_0199_VTAB /end COMPU_METHOD
/begin COMPU_VTAB FORMULA_0199_VTAB "FORMULA_0199_VTAB" TAB_VERB 13 0 "Motor steht" 1 "Normalbetrieb" 2 "Notlauf" 5 "Normal/Warmlauf" 8 "nBegr" 12 "nBegr/Warmlauf" 16 "vBegr" 20 "vBegr/Warmlauf" 32 "DSC" 36 "DSC/Warmlauf" 64 "Getr" 68 "Getr/Warmlauf" 128 "Rollenbetrieb" DEFAULT_VALUE "undef" /end COMPU_VTAB
/begin COMPU_METHOD FORMULA_0200 "FORMULA_0200" TAB_VERB "%5.2" "-" COMPU_TAB_REF FORMULA_0200_VTAB /end COMPU_METHOD
/begin COMPU_VTAB FORMULA_0200_VTAB "FORMULA_0200_VTAB" TAB_VERB 1 1 "time_ms Ok" DEFAULT_VALUE "aus" /end COMPU_VTAB
/begin COMPU_METHOD FORMULA_0201 "FORMULA_0201" TAB_VERB "%3.0" "-" COMPU_TAB_REF FORMULA_0201_VTAB /end COMPU_METHOD
/begin COMPU_VTAB FORMULA_0201_VTAB "FORMULA_0201_VTAB" TAB_VERB 3 0 "ATIC39-Treiber aus [ELUP aus]" 1 "ATIC39-Treiber an [ELUP an]" 2 "wg. SHT_TO_UB ATIC39-Treiber+ELUP aus" DEFAULT_VALUE "undef" /end COMPU_VTAB
/begin COMPU_METHOD FORMULA_0202 "FORMULA_0202" TAB_VERB "%5.0" "-" COMPU_TAB_REF FORMULA_0202_VTAB /end COMPU_METHOD
/begin COMPU_VTAB FORMULA_0202_VTAB "FORMULA_0202_VTAB" TAB_VERB 10 0 "AUS" 1 "Ger 2.5" 2 "Ger 5.5" 4 "Ger" 8 "Rampe" 16 "TV 100%" 32 "TV 65%" 64 "TV 65% FW 100%" 16384 "Abbruch" 32768 "Ende" /end COMPU_VTAB
/begin COMPU_METHOD FORMULA_0203 "FORMULA_0203" RAT_FUNC "%8.3" "-/10ms" COEFFS 0 10000 0 0 0 1 /end COMPU_METHOD
/begin COMPU_METHOD FORMULA_0204 "FORMULA_0204" RAT_FUNC "%8.3" "100/10ms" COEFFS 0 100 0 0 0 1 /end COMPU_METHOD
/begin COMPU_METHOD FORMULA_0205 "FORMULA_0205" TAB_VERB "%5.2" "-" COMPU_TAB_REF FORMULA_0205_VTAB /end COMPU_METHOD
/begin COMPU_VTAB FORMULA_0205_VTAB "FORMULA_0205_VTAB" TAB_VERB 4 0 "in Ordnung" 1 "kein Wert empf." 128 "Err/TUMG" 129 "Fehler/TAN" /end COMPU_VTAB
/begin COMPU_METHOD FORMULA_0206 "FORMULA_0206" TAB_VERB "%5.2" "-" COMPU_TAB_REF FORMULA_0206_VTAB /end COMPU_METHOD
/begin COMPU_VTAB FORMULA_0206_VTAB "FORMULA_0206_VTAB" TAB_VERB 4 0 "in Ordnung" 1 "Abs-Err" 2 "Rel-Err" 3 "Abs-Rel-Err" /end COMPU_VTAB
/begin COMPU_METHOD FORMULA_0207 "FORMULA_0207" RAT_FUNC "%5.0" "Tage" COEFFS 0 1 0 0 0 1 /end COMPU_METHOD
/begin COMPU_METHOD FORMULA_0208 "FORMULA_0208" TAB_VERB "%5.2" "-" COMPU_TAB_REF FORMULA_0208_VTAB /end COMPU_METHOD
/begin COMPU_VTAB FORMULA_0208_VTAB "FORMULA_0208_VTAB" TAB_VERB 7 0 "in Ordnung" 1 "Range" 2 "Reserve" 4 "Fst links" 8 "Fst rechts" 16 "Fst Summe" 32 "km-Stand" DEFAULT_VALUE "selbstrechnen" /end COMPU_VTAB
/begin COMPU_METHOD FORMULA_0209 "FORMULA_0209" RAT_FUNC "%3.0" "�C" COEFFS 0 1 55.2 0 0 0.9 /end COMPU_METHOD
/begin COMPU_METHOD FORMULA_0210 "FORMULA_0210" TAB_VERB "%7.2" "-" COMPU_TAB_REF FORMULA_0210_VTAB /end COMPU_METHOD
/begin COMPU_VTAB FORMULA_0210_VTAB "FORMULA_0210_VTAB" TAB_VERB 10 0 "init" 1 "an" 2 "Bauteilschutz" 4 "an OBD" 8 "aus ED" 16 "Abbruch" 32 "aus" 64 "aus Restlaufzeit" 128 "an Restlaufzeit" 256 "an Prueflauf" DEFAULT_VALUE "undef" /end COMPU_VTAB
/begin COMPU_METHOD FORMULA_0211 "FORMULA_0211" TAB_VERB "%5.2" "-" COMPU_TAB_REF FORMULA_0211_VTAB /end COMPU_METHOD
/begin COMPU_VTAB FORMULA_0211_VTAB "FORMULA_0211_VTAB" TAB_VERB 4 0 "aus" 1 "an" 2 "an OBD" 4 "aus ED" DEFAULT_VALUE "ungueltig" /end COMPU_VTAB
/begin COMPU_METHOD FORMULA_0212 "FORMULA_0212" TAB_VERB "%3.0" "-" COMPU_TAB_REF FORMULA_0212_VTAB /end COMPU_METHOD
/begin COMPU_VTAB FORMULA_0212_VTAB "FORMULA_0212_VTAB" TAB_VERB 4 0 "iO" 1 "Kombi-Err" 2 "ACC-Err" 4 "FGR-Err" DEFAULT_VALUE "Mehrfach" /end COMPU_VTAB
/begin COMPU_METHOD FORMULA_0213 "FORMULA_0213" TAB_VERB "%3.0" "-" COMPU_TAB_REF FORMULA_0213_VTAB /end COMPU_METHOD
/begin COMPU_VTAB FORMULA_0213_VTAB "FORMULA_0213_VTAB" TAB_VERB 2 0 "Aus" 1 "Ein" /end COMPU_VTAB
/begin COMPU_METHOD FORMULA_0214 "FORMULA_0214" TAB_VERB "%3.0" "-" COMPU_TAB_REF FORMULA_0214_VTAB /end COMPU_METHOD
/begin COMPU_VTAB FORMULA_0214_VTAB "FORMULA_0214_VTAB" TAB_VERB 2 0 "Aus" 1 "Ein" /end COMPU_VTAB
/begin COMPU_METHOD FORMULA_0215 "FORMULA_0215" TAB_VERB "%3.0" "-" COMPU_TAB_REF FORMULA_0215_VTAB /end COMPU_METHOD
/begin COMPU_VTAB FORMULA_0215_VTAB "FORMULA_0215_VTAB" TAB_VERB 2 0 "Nein" 1 "Ja" /end COMPU_VTAB
/begin COMPU_METHOD FORMULA_0216 "FORMULA_0216" TAB_VERB "%5.2" "-" COMPU_TAB_REF FORMULA_0216_VTAB /end COMPU_METHOD
/begin COMPU_VTAB FORMULA_0216_VTAB "FORMULA_0216_VTAB" TAB_VERB 2 0 "nein" 1 "ja" /end COMPU_VTAB
/begin COMPU_METHOD FORMULA_0217 "FORMULA_0217" TAB_VERB "%5.2" "-" COMPU_TAB_REF FORMULA_0217_VTAB /end COMPU_METHOD
/begin COMPU_VTAB FORMULA_0217_VTAB "FORMULA_0217_VTAB" TAB_VERB 2 0 "nein" 1 "ja" /end COMPU_VTAB
/begin COMPU_METHOD FORMULA_0218 "FORMULA_0218" TAB_VERB "%5.2" "-" COMPU_TAB_REF FORMULA_0218_VTAB /end COMPU_METHOD
/begin COMPU_VTAB FORMULA_0218_VTAB "FORMULA_0218_VTAB" TAB_VERB 2 0 "nein" 1 "ja" /end COMPU_VTAB
/begin COMPU_METHOD FORMULA_0219 "FORMULA_0219" TAB_VERB "%5.2" "-" COMPU_TAB_REF FORMULA_0219_VTAB /end COMPU_METHOD
/begin COMPU_VTAB FORMULA_0219_VTAB "FORMULA_0219_VTAB" TAB_VERB 2 0 "nein" 1 "ja" /end COMPU_VTAB
/begin COMPU_METHOD FORMULA_0220 "FORMULA_0220" TAB_VERB "%5.2" "-" COMPU_TAB_REF FORMULA_0220_VTAB /end COMPU_METHOD
/begin COMPU_VTAB FORMULA_0220_VTAB "FORMULA_0220_VTAB" TAB_VERB 2 0 "nein" 1 "ja" /end COMPU_VTAB
/begin COMPU_METHOD FORMULA_0221 "FORMULA_0221" TAB_VERB "%5.2" "-" COMPU_TAB_REF FORMULA_0221_VTAB /end COMPU_METHOD
/begin COMPU_VTAB FORMULA_0221_VTAB "FORMULA_0221_VTAB" TAB_VERB 2 0 "nein" 1 "ja" /end COMPU_VTAB
/begin COMPU_METHOD FORMULA_0222 "FORMULA_0222" TAB_VERB "%5.2" "-" COMPU_TAB_REF FORMULA_0222_VTAB /end COMPU_METHOD
/begin COMPU_VTAB FORMULA_0222_VTAB "FORMULA_0222_VTAB" TAB_VERB 2 0 "nein" 1 "ja" /end COMPU_VTAB
/begin COMPU_METHOD FORMULA_0223 "FORMULA_0223" TAB_VERB "%5.2" "-" COMPU_TAB_REF FORMULA_0223_VTAB /end COMPU_METHOD
/begin COMPU_VTAB FORMULA_0223_VTAB "FORMULA_0223_VTAB" TAB_VERB 2 0 "nein" 1 "ja" /end COMPU_VTAB
/begin COMPU_METHOD FORMULA_0224 "FORMULA_0224" TAB_VERB "%3.0" "-" COMPU_TAB_REF FORMULA_0224_VTAB /end COMPU_METHOD
/begin COMPU_VTAB FORMULA_0224_VTAB "FORMULA_0224_VTAB" TAB_VERB 3 0 "Fahrzeugbetrieb" 1 "Pruefstandbetrieb" 2 "Rollenbetrieb" DEFAULT_VALUE "undef" /end COMPU_VTAB
/begin COMPU_METHOD FORMULA_0225 "FORMULA_0225" TAB_VERB "%3.0" "-" COMPU_TAB_REF FORMULA_0225_VTAB /end COMPU_METHOD
/begin COMPU_VTAB FORMULA_0225_VTAB "FORMULA_0225_VTAB" TAB_VERB 3 0 "Treiber aus [SSP an]" 1 "Treiber an [SSP aus]" 2 "Sperre SH_TO_UB" /end COMPU_VTAB
/begin COMPU_METHOD FORMULA_0226 "FORMULA_0226" TAB_VERB "%3.0" "-" COMPU_TAB_REF FORMULA_0226_VTAB /end COMPU_METHOD
/begin COMPU_VTAB FORMULA_0226_VTAB "FORMULA_0226_VTAB" TAB_VERB 7 0 "-------------------" 1 "SSP-Diag-Freigabe" 2 "SSP-Diag abgelaufen" 4 "SSP-Diag i. O." 8 "SSP-Diag n. i. O." 16 "SSP-Diag Stop exd" 32 "SSP-Diag Start exd" DEFAULT_VALUE "undefiniert" /end COMPU_VTAB
/begin COMPU_METHOD FORMULA_0227 "FORMULA_0227" TAB_VERB "%3.0" "-" COMPU_TAB_REF FORMULA_0227_VTAB /end COMPU_METHOD
/begin COMPU_VTAB FORMULA_0227_VTAB "FORMULA_0227_VTAB" TAB_VERB 2 0 "niO" 1 "ok" /end COMPU_VTAB
/begin COMPU_METHOD FORMULA_0228 "FORMULA_0228" TAB_VERB "%5.2" "-" COMPU_TAB_REF FORMULA_0228_VTAB /end COMPU_METHOD
/begin COMPU_VTAB FORMULA_0228_VTAB "FORMULA_0228_VTAB" TAB_VERB 16 0 "O.K." 1 "SH_TO_UB" 2 "SH_TO_GND" 3 "UB+GND" 4 "OPENLOAD" 5 "UB+OL" 6 "GND+OL" 7 "UB+GND+OL" 8 "UNPLAUSI" 9 "UB+UP" 10 "GND+UP" 11 "UB+GND+UP" 12 "OL+UP" 13 "UB+OL+UP" 14 "GND+OL+UP" 15 "UB+GND+OL+UP" /end COMPU_VTAB
/begin COMPU_METHOD FORMULA_0229 "FORMULA_0229" TAB_VERB "%3.0" "-" COMPU_TAB_REF FORMULA_0229_VTAB /end COMPU_METHOD
/begin COMPU_VTAB FORMULA_0229_VTAB "FORMULA_0229_VTAB" TAB_VERB 1 0 "alles i.O" DEFAULT_VALUE "Fehler oder Ansteuerung" /end COMPU_VTAB
/begin COMPU_METHOD FORMULA_0230 "FORMULA_0230" TAB_VERB "%5.2" "-" COMPU_TAB_REF FORMULA_0230_VTAB /end COMPU_METHOD
/begin COMPU_VTAB FORMULA_0230_VTAB "FORMULA_0230_VTAB" TAB_VERB 2 0 "nein" 1 "ja" /end COMPU_VTAB
/begin COMPU_METHOD FORMULA_0231 "FORMULA_0231" TAB_VERB "%3.0" "-" COMPU_TAB_REF FORMULA_0231_VTAB /end COMPU_METHOD
/begin COMPU_VTAB FORMULA_0231_VTAB "FORMULA_0231_VTAB" TAB_VERB 6 17 "FP im RAM" 51 "FP warten" 119 "FP fertig" 136 "Rueckflashen" 170 "RF warten" 238 "RF fertig" /end COMPU_VTAB
/begin COMPU_METHOD FORMULA_0232 "FORMULA_0232" RAT_FUNC "%3.0" "s" COEFFS 0 1 0 0 0 1 /end COMPU_METHOD
/begin COMPU_METHOD FORMULA_0233 "FORMULA_0233" TAB_VERB "%3.0" "-" COMPU_TAB_REF FORMULA_0233_VTAB /end COMPU_METHOD
/begin COMPU_VTAB FORMULA_0233_VTAB "FORMULA_0233_VTAB" TAB_VERB 4 0 "k. Aenderung" 1 "Aus" 2 "Ein" 4 "Sport" DEFAULT_VALUE "undef" /end COMPU_VTAB
/begin COMPU_METHOD FORMULA_0234 "FORMULA_0234" TAB_VERB "%3.0" "-" COMPU_TAB_REF FORMULA_0234_VTAB /end COMPU_METHOD
/begin COMPU_VTAB FORMULA_0234_VTAB "FORMULA_0234_VTAB" TAB_VERB 3 0 "k. Aenderung" 1 "Automat" 2 "Sequentiell" DEFAULT_VALUE "undef" /end COMPU_VTAB
/begin COMPU_METHOD FORMULA_0235 "FORMULA_0235" TAB_VERB "%3.0" "-" COMPU_TAB_REF FORMULA_0235_VTAB /end COMPU_METHOD
/begin COMPU_VTAB FORMULA_0235_VTAB "FORMULA_0235_VTAB" TAB_VERB 1 0 "k. Aenderung" /end COMPU_VTAB
/begin COMPU_METHOD FORMULA_0236 "FORMULA_0236" TAB_VERB "%3.0" "-" COMPU_TAB_REF FORMULA_0236_VTAB /end COMPU_METHOD
/begin COMPU_VTAB FORMULA_0236_VTAB "FORMULA_0236_VTAB" TAB_VERB 4 0 "k. Aenderung" 1 "Komfort" 2 "Normal" 3 "Sport" DEFAULT_VALUE "undef" /end COMPU_VTAB
/begin COMPU_METHOD FORMULA_0237 "FORMULA_0237" TAB_VERB "%3.0" "-" COMPU_TAB_REF FORMULA_0237_VTAB /end COMPU_METHOD
/begin COMPU_VTAB FORMULA_0237_VTAB "FORMULA_0237_VTAB" TAB_VERB 4 0 "k. Aenderung" 1 "KL1" 2 "KL2" 3 "KL3" DEFAULT_VALUE "undef" /end COMPU_VTAB
/begin COMPU_METHOD FORMULA_0238 "FORMULA_0238" TAB_VERB "%3.0" "-" COMPU_TAB_REF FORMULA_0238_VTAB /end COMPU_METHOD
/begin COMPU_VTAB FORMULA_0238_VTAB "FORMULA_0238_VTAB" TAB_VERB 2 0 "k. Aenderung" 1 "M-Cfg" DEFAULT_VALUE "undef" /end COMPU_VTAB
/begin COMPU_METHOD FORMULA_0239 "FORMULA_0239" TAB_VERB "%3.0" "-" COMPU_TAB_REF FORMULA_0239_VTAB /end COMPU_METHOD
/begin COMPU_VTAB FORMULA_0239_VTAB "FORMULA_0239_VTAB" TAB_VERB 2 0 "nicht angehoben" 1 "angehoben" DEFAULT_VALUE "undef" /end COMPU_VTAB
/begin COMPU_METHOD FORMULA_0240 "FORMULA_0240" TAB_VERB "%3.0" "-" COMPU_TAB_REF FORMULA_0240_VTAB /end COMPU_METHOD
/begin COMPU_VTAB FORMULA_0240_VTAB "FORMULA_0240_VTAB" TAB_VERB 3 0 "kein R" 1 "R" 2 "Fehler" /end COMPU_VTAB
/begin COMPU_METHOD FORMULA_0241 "FORMULA_0241" TAB_VERB "%5.2" "-" COMPU_TAB_REF FORMULA_0241_VTAB /end COMPU_METHOD
/begin COMPU_VTAB FORMULA_0241_VTAB "FORMULA_0241_VTAB" TAB_VERB 2 0 "aus" 1 "ein" /end COMPU_VTAB
/begin COMPU_METHOD FORMULA_0242 "FORMULA_0242" TAB_VERB "%5.2" "-" COMPU_TAB_REF FORMULA_0242_VTAB /end COMPU_METHOD
/begin COMPU_VTAB FORMULA_0242_VTAB "FORMULA_0242_VTAB" TAB_VERB 4 0 "Ok" 1 "SH_TO_GND" 2 "SH_TO_UB" 255 "Init" DEFAULT_VALUE "unused" /end COMPU_VTAB
/begin COMPU_METHOD FORMULA_0243 "FORMULA_0243" RAT_FUNC "%10.3" "�KW" COEFFS 0 81920 0 0 0 1 /end COMPU_METHOD
/begin COMPU_METHOD FORMULA_0244 "FORMULA_0244" RAT_FUNC "%8.1" "�KW" COEFFS 0 10 0 0 0 1 /end COMPU_METHOD
/begin COMPU_METHOD FORMULA_0245 "FORMULA_0245" RAT_FUNC "%7.2" "nSs" COEFFS 0 1 0 0 0 0.01952206 /end COMPU_METHOD
/begin COMPU_METHOD FORMULA_0246 "FORMULA_0246" TAB_VERB "%5.0" "-" COMPU_TAB_REF FORMULA_0246_VTAB /end COMPU_METHOD
/begin COMPU_VTAB FORMULA_0246_VTAB "FORMULA_0246_VTAB" TAB_VERB 13 0 "Aus" 391 "Aktiv" 389 "Einspr. aus" 385 "Zuendung aus" 263 "Doppelzuendung" 261 "Doppelzuendung" 257 "Doppelzuendung" 135 "Fehlerspeicher" 133 "Fehlerspeicher" 129 "Fehlerspeicher" 7 "Fehlerspeicher" 5 "Fehlerspeicher" 1 "Fehlerspeicher" DEFAULT_VALUE "Idle" /end COMPU_VTAB
/begin COMPU_METHOD FORMULA_0247 "FORMULA_0247" TAB_VERB "%5.0" "-" COMPU_TAB_REF FORMULA_0247_VTAB /end COMPU_METHOD
/begin COMPU_VTAB FORMULA_0247_VTAB "FORMULA_0247_VTAB" TAB_VERB 15 0 "Aus" 62975 "Aktiv" 46591 "Lambda" 58877 "Einspr. aus" 62973 "Einspr. aus" 58870 "Zuendung aus" 62966 "Zuendung aus" 58871 "N Schwelle" 58863 "RF Schwelle" 58847 "Pos. Dynamik" 58831 "Neg. Dynamik" 58783 "Dynamik" 62847 "Doppelzuendung" 54783 "TZ Gradient" 30207 "FeTraWe" DEFAULT_VALUE "Idle" /end COMPU_VTAB
/begin COMPU_METHOD FORMULA_0248 "FORMULA_0248" TAB_VERB "%5.0" "-" COMPU_TAB_REF FORMULA_0248_VTAB /end COMPU_METHOD
/begin COMPU_VTAB FORMULA_0248_VTAB "FORMULA_0248_VTAB" TAB_VERB 15 0 "Aus" 48127 "Aktiv" 44029 "Einspr. aus" 48125 "Einspr. aus" 44022 "Zuendung aus" 48118 "Zuendung aus" 44023 "N Schwelle" 44015 "RF Schwelle" 43999 "Pos. Dynamik" 43983 "Neg. Dynamik" 43935 "Dynamik" 47999 "Doppelzuendung" 39935 "TZ Gradient" 46079 "Nach Start" 15359 "FeTraWe" DEFAULT_VALUE "Idle" /end COMPU_VTAB
/begin COMPU_METHOD FORMULA_0249 "FORMULA_0249" RAT_FUNC "%8.3" "�KW/Segm" COEFFS 0 10 0 0 0 1 /end COMPU_METHOD
/begin COMPU_METHOD FORMULA_0250 "FORMULA_0250" TAB_VERB "%5.0" "-" COMPU_TAB_REF FORMULA_0250_VTAB /end COMPU_METHOD
/begin COMPU_VTAB FORMULA_0250_VTAB "FORMULA_0250_VTAB" TAB_VERB 1 0 "Kein Aussetzer" DEFAULT_VALUE "Aussetzer erkannt" /end COMPU_VTAB
/begin COMPU_METHOD FORMULA_0251 "FORMULA_0251" TAB_VERB "%5.0" "-" COMPU_TAB_REF FORMULA_0251_VTAB /end COMPU_METHOD
/begin COMPU_VTAB FORMULA_0251_VTAB "FORMULA_0251_VTAB" TAB_VERB 1 0 "Zyl. 1 ok." DEFAULT_VALUE "Auss. Zyl. 1." /end COMPU_VTAB
/begin COMPU_METHOD FORMULA_0252 "FORMULA_0252" TAB_VERB "%5.0" "-" COMPU_TAB_REF FORMULA_0252_VTAB /end COMPU_METHOD
/begin COMPU_VTAB FORMULA_0252_VTAB "FORMULA_0252_VTAB" TAB_VERB 1 0 "Zyl. 2 ok." DEFAULT_VALUE "Auss. Zyl. 2." /end COMPU_VTAB
/begin COMPU_METHOD FORMULA_0253 "FORMULA_0253" TAB_VERB "%5.0" "-" COMPU_TAB_REF FORMULA_0253_VTAB /end COMPU_METHOD
/begin COMPU_VTAB FORMULA_0253_VTAB "FORMULA_0253_VTAB" TAB_VERB 1 0 "Zyl. 3 ok." DEFAULT_VALUE "Auss. Zyl. 3." /end COMPU_VTAB
/begin COMPU_METHOD FORMULA_0254 "FORMULA_0254" TAB_VERB "%5.0" "-" COMPU_TAB_REF FORMULA_0254_VTAB /end COMPU_METHOD
/begin COMPU_VTAB FORMULA_0254_VTAB "FORMULA_0254_VTAB" TAB_VERB 1 0 "Zyl. 4 ok." DEFAULT_VALUE "Auss. Zyl. 4." /end COMPU_VTAB
/begin COMPU_METHOD FORMULA_0255 "FORMULA_0255" TAB_VERB "%5.0" "-" COMPU_TAB_REF FORMULA_0255_VTAB /end COMPU_METHOD
/begin COMPU_VTAB FORMULA_0255_VTAB "FORMULA_0255_VTAB" TAB_VERB 1 0 "Zyl. 5 ok." DEFAULT_VALUE "Auss. Zyl. 5." /end COMPU_VTAB
/begin COMPU_METHOD FORMULA_0256 "FORMULA_0256" TAB_VERB "%5.0" "-" COMPU_TAB_REF FORMULA_0256_VTAB /end COMPU_METHOD
/begin COMPU_VTAB FORMULA_0256_VTAB "FORMULA_0256_VTAB" TAB_VERB 1 0 "Zyl. 6 ok." DEFAULT_VALUE "Auss. Zyl. 6." /end COMPU_VTAB
/begin COMPU_METHOD FORMULA_0257 "FORMULA_0257" TAB_VERB "%5.0" "-" COMPU_TAB_REF FORMULA_0257_VTAB /end COMPU_METHOD
/begin COMPU_VTAB FORMULA_0257_VTAB "FORMULA_0257_VTAB" TAB_VERB 1 0 "Zyl. 7 ok." DEFAULT_VALUE "Auss. Zyl. 7." /end COMPU_VTAB
/begin COMPU_METHOD FORMULA_0258 "FORMULA_0258" TAB_VERB "%5.0" "-" COMPU_TAB_REF FORMULA_0258_VTAB /end COMPU_METHOD
/begin COMPU_VTAB FORMULA_0258_VTAB "FORMULA_0258_VTAB" TAB_VERB 1 0 "Zyl. 8 ok." DEFAULT_VALUE "Auss. Zyl. 8." /end COMPU_VTAB
/begin COMPU_METHOD FORMULA_0259 "FORMULA_0259" TAB_VERB "%5.0" "-" COMPU_TAB_REF FORMULA_0259_VTAB /end COMPU_METHOD
/begin COMPU_VTAB FORMULA_0259_VTAB "FORMULA_0259_VTAB" TAB_VERB 1 0 "Zyl. 9 ok." DEFAULT_VALUE "Auss. Zyl. 9." /end COMPU_VTAB
/begin COMPU_METHOD FORMULA_0260 "FORMULA_0260" TAB_VERB "%5.0" "-" COMPU_TAB_REF FORMULA_0260_VTAB /end COMPU_METHOD
/begin COMPU_VTAB FORMULA_0260_VTAB "FORMULA_0260_VTAB" TAB_VERB 1 0 "Zyl. 10 ok." DEFAULT_VALUE "Auss. Zyl. 10." /end COMPU_VTAB
/begin COMPU_METHOD FORMULA_0261 "FORMULA_0261" TAB_VERB "%3.0" "-" COMPU_TAB_REF FORMULA_0261_VTAB /end COMPU_METHOD
/begin COMPU_VTAB FORMULA_0261_VTAB "FORMULA_0261_VTAB" TAB_VERB 8 0 "Reset" 1 "Inaktiv" 2 "LLR oKS" 3 "LLR mKS" 4 "Abst. B1" 5 "Abst. B2" 6 "Stop" 7 "Fehler" DEFAULT_VALUE "undef" /end COMPU_VTAB
/begin COMPU_METHOD FORMULA_0262 "FORMULA_0262" TAB_VERB "%5.2" "-" COMPU_TAB_REF FORMULA_0262_VTAB /end COMPU_METHOD
/begin COMPU_VTAB FORMULA_0262_VTAB "FORMULA_0262_VTAB" TAB_VERB 2 0 "Nein" 1 "Ja" /end COMPU_VTAB
/begin COMPU_METHOD FORMULA_0263 "FORMULA_0263" TAB_VERB "%5.2" "-" COMPU_TAB_REF FORMULA_0263_VTAB /end COMPU_METHOD
/begin COMPU_VTAB FORMULA_0263_VTAB "FORMULA_0263_VTAB" TAB_VERB 2 0 "Inaktiv" 1 "Aktiv" /end COMPU_VTAB
/begin COMPU_METHOD FORMULA_0264 "FORMULA_0264" TAB_VERB "%5.2" "-" COMPU_TAB_REF FORMULA_0264_VTAB /end COMPU_METHOD
/begin COMPU_VTAB FORMULA_0264_VTAB "FORMULA_0264_VTAB" TAB_VERB 2 0 "Inaktiv" 1 "Aktiv" /end COMPU_VTAB
/begin COMPU_METHOD FORMULA_0265 "FORMULA_0265" RAT_FUNC "%7.2" "V" COEFFS 0 1966080 0 0 0 200 /end COMPU_METHOD
/begin COMPU_METHOD FORMULA_0266 "FORMULA_0266" TAB_VERB "%5.2" "-" COMPU_TAB_REF FORMULA_0266_VTAB /end COMPU_METHOD
/begin COMPU_VTAB FORMULA_0266_VTAB "FORMULA_0266_VTAB" TAB_VERB 2 0 "kein Kickdown" 1 "Kickdown" /end COMPU_VTAB
/begin COMPU_METHOD FORMULA_0267 "FORMULA_0267" TAB_VERB "%3.0" "-" COMPU_TAB_REF FORMULA_0267_VTAB /end COMPU_METHOD
/begin COMPU_VTAB FORMULA_0267_VTAB "FORMULA_0267_VTAB" TAB_VERB 6 0 "O.K." 1 "Kanalfilter" 2 "Kanalfehler" 3 "PWG2_Fehler" 4 "PWG1_Fehler" 5 "Totalausfall" DEFAULT_VALUE "undefiniert" /end COMPU_VTAB
/begin COMPU_METHOD FORMULA_0268 "FORMULA_0268" TAB_VERB "%3.0" "-" COMPU_TAB_REF FORMULA_0268_VTAB /end COMPU_METHOD
/begin COMPU_VTAB FORMULA_0268_VTAB "FORMULA_0268_VTAB" TAB_VERB 5 0 "unbegrenzt" 1 "TZ-Begr" 2 "DK-Begr" 3 "TZ-DK-Begr" 15 "ungueltig" /end COMPU_VTAB
/begin COMPU_METHOD FORMULA_0269 "FORMULA_0269" TAB_VERB "%3.0" "-" COMPU_TAB_REF FORMULA_0269_VTAB /end COMPU_METHOD
/begin COMPU_VTAB FORMULA_0269_VTAB "FORMULA_0269_VTAB" TAB_VERB 6 0 "frei" 1 "CAN sperrt" 2 "DME sperrt" 3 "CAN/DME" 4 "DSC sperrt" 6 "DME/DSC" DEFAULT_VALUE "Mehrfach" /end COMPU_VTAB
/begin COMPU_METHOD FORMULA_0270 "FORMULA_0270" TAB_VERB "%5.2" "-" COMPU_TAB_REF FORMULA_0270_VTAB /end COMPU_METHOD
/begin COMPU_VTAB FORMULA_0270_VTAB "FORMULA_0270_VTAB" TAB_VERB 4 0 "Inaktiv" 1 "Bereit" 2 "Aktiv" 3 "Aktiv" /end COMPU_VTAB
/begin COMPU_METHOD FORMULA_0271 "FORMULA_0271" TAB_VERB "%5.2" "-" COMPU_TAB_REF FORMULA_0271_VTAB /end COMPU_METHOD
/begin COMPU_VTAB FORMULA_0271_VTAB "FORMULA_0271_VTAB" TAB_VERB 4 0 "Inaktiv" 1 "Trigger" 2 "Aktiv" 3 "Aktiv" /end COMPU_VTAB
/begin COMPU_METHOD FORMULA_0272 "FORMULA_0272" TAB_VERB "%5.2" "-" COMPU_TAB_REF FORMULA_0272_VTAB /end COMPU_METHOD
/begin COMPU_VTAB FORMULA_0272_VTAB "FORMULA_0272_VTAB" TAB_VERB 4 0 "Inaktiv" 1 "CUF" 2 "VMA" 3 "CUF+VMA" DEFAULT_VALUE "undef" /end COMPU_VTAB
/begin COMPU_METHOD FORMULA_0273 "FORMULA_0273" TAB_VERB "%5.2" "-" COMPU_TAB_REF FORMULA_0273_VTAB /end COMPU_METHOD
/begin COMPU_VTAB FORMULA_0273_VTAB "FORMULA_0273_VTAB" TAB_VERB 2 0 "not ready" 1 "ready" /end COMPU_VTAB
/begin COMPU_METHOD FORMULA_0274 "FORMULA_0274" TAB_VERB "%5.2" "-" COMPU_TAB_REF FORMULA_0274_VTAB /end COMPU_METHOD
/begin COMPU_VTAB FORMULA_0274_VTAB "FORMULA_0274_VTAB" TAB_VERB 3 0 "iO" 1 "Spalt" 2 "Klemmen" /end COMPU_VTAB
/begin COMPU_METHOD FORMULA_0275 "FORMULA_0275" TAB_VERB "%5.2" "-" COMPU_TAB_REF FORMULA_0275_VTAB /end COMPU_METHOD
/begin COMPU_VTAB FORMULA_0275_VTAB "FORMULA_0275_VTAB" TAB_VERB 4 0 "Inaktiv" 1 "MSR" 2 "ASC" 130 "ASC+SA" DEFAULT_VALUE "undef" /end COMPU_VTAB
/begin COMPU_METHOD FORMULA_0276 "FORMULA_0276" RAT_FUNC "%5.0" "%/s" COEFFS 0 1 0 0 0 20 /end COMPU_METHOD
/begin COMPU_METHOD FORMULA_0277 "FORMULA_0277" RAT_FUNC "%8.3" "V" COEFFS 0 1 0 0 0 0.00155892 /end COMPU_METHOD
/begin COMPU_METHOD FORMULA_0278 "FORMULA_0278" TAB_VERB "%3.0" "-" COMPU_TAB_REF FORMULA_0278_VTAB /end COMPU_METHOD
/begin COMPU_VTAB FORMULA_0278_VTAB "FORMULA_0278_VTAB" TAB_VERB 9 0 "kein Fehler" 1 "nGetr" 2 "nZiel" 4 "nAnfahr" 8 "mKupp" 16 "axMess" 32 "KuppSt" 64 "GetrSt" 128 "Modul" /end COMPU_VTAB
/begin COMPU_METHOD FORMULA_0279 "FORMULA_0279" RAT_FUNC "%3.0" ".Prog" COEFFS 0 1 0 0 0 1 /end COMPU_METHOD
/begin COMPU_METHOD FORMULA_0280 "FORMULA_0280" TAB_VERB "%5.2" "-" COMPU_TAB_REF FORMULA_0280_VTAB /end COMPU_METHOD
/begin COMPU_VTAB FORMULA_0280_VTAB "FORMULA_0280_VTAB" TAB_VERB 2 0 "KL87 aus" 1 "KL87 ein" /end COMPU_VTAB
/begin COMPU_METHOD FORMULA_0281 "FORMULA_0281" TAB_VERB "%5.2" "-" COMPU_TAB_REF FORMULA_0281_VTAB /end COMPU_METHOD
/begin COMPU_VTAB FORMULA_0281_VTAB "FORMULA_0281_VTAB" TAB_VERB 2 0 "MM aus" 1 "MM ein" /end COMPU_VTAB
/begin COMPU_METHOD FORMULA_0282 "FORMULA_0282" TAB_VERB "%3.0" "-" COMPU_TAB_REF FORMULA_0282_VTAB /end COMPU_METHOD
/begin COMPU_VTAB FORMULA_0282_VTAB "FORMULA_0282_VTAB" TAB_VERB 4 0 "kein Fehler" 1 "SAT-Err" 2 "Differenz" 4 "Bereich" DEFAULT_VALUE "Mehrfach" /end COMPU_VTAB
/begin COMPU_METHOD FORMULA_0283 "FORMULA_0283" TAB_VERB "%5.2" "-" COMPU_TAB_REF FORMULA_0283_VTAB /end COMPU_METHOD
/begin COMPU_VTAB FORMULA_0283_VTAB "FORMULA_0283_VTAB" TAB_VERB 6 0 "Inaktiv" 1 "Aktiv" 3 "Aktiv+SA" 4 "TZ frei" 5 "Aktiv+TZ" 7 "Aktiv+TZ+SA" DEFAULT_VALUE "undef" /end COMPU_VTAB
/begin COMPU_METHOD FORMULA_0284 "FORMULA_0284" TAB_VERB "%5.2" "-" COMPU_TAB_REF FORMULA_0284_VTAB /end COMPU_METHOD
/begin COMPU_VTAB FORMULA_0284_VTAB "FORMULA_0284_VTAB" TAB_VERB 2 0 "Inaktiv" 1 "Aktiv" /end COMPU_VTAB
/begin COMPU_METHOD FORMULA_0285 "FORMULA_0285" TAB_VERB "%5.2" "-" COMPU_TAB_REF FORMULA_0285_VTAB /end COMPU_METHOD
/begin COMPU_VTAB FORMULA_0285_VTAB "FORMULA_0285_VTAB" TAB_VERB 2 0 "LL-Eingr" 1 "TL-Eingr" /end COMPU_VTAB
/begin COMPU_METHOD FORMULA_0286 "FORMULA_0286" TAB_VERB "%5.2" "-" COMPU_TAB_REF FORMULA_0286_VTAB /end COMPU_METHOD
/begin COMPU_VTAB FORMULA_0286_VTAB "FORMULA_0286_VTAB" TAB_VERB 2 0 "Inaktiv" 1 "Aktiv" /end COMPU_VTAB
/begin COMPU_METHOD FORMULA_0287 "FORMULA_0287" TAB_VERB "%3.0" "-" COMPU_TAB_REF FORMULA_0287_VTAB /end COMPU_METHOD
/begin COMPU_VTAB FORMULA_0287_VTAB "FORMULA_0287_VTAB" TAB_VERB 13 0 "undef" 1 "Anfahren" 2 "Anfahren-KD" 3 "Wait-RS" 4 "Anfahren-RS" 5 "Schalten" 6 "Einkuppeln" 7 "Anhalten" 8 "Abwuergen" 9 "Radabriss" 11 "ABS-Eingr" 12 "Trampeln" 15 "Fehler" /end COMPU_VTAB
/begin COMPU_METHOD FORMULA_0288 "FORMULA_0288" TAB_VERB "%5.2" "-" COMPU_TAB_REF FORMULA_0288_VTAB /end COMPU_METHOD
/begin COMPU_VTAB FORMULA_0288_VTAB "FORMULA_0288_VTAB" TAB_VERB 22 0 "Fahrer" 1 "Getr" 2 "ASC" 3 "MSR" 4 "Schub" 5 "MCS" 16 "Fahrer+LLR" 17 "Getr+LLR" 18 "ASC+LLR" 19 "MSR+LLR" 32 "Fahrer+AR" 33 "Getr+AR" 34 "ASC+AR" 35 "MSR+AR" 64 "Fahrer+Begr" 65 "Getr+Begr" 66 "ASC+Begr" 67 "MSR+Begr" 128 "Fahrer+SK" 129 "Getr+SK" 130 "ASC+SK" 131 "MSR+SK" DEFAULT_VALUE "Mehrfach" /end COMPU_VTAB
/begin COMPU_METHOD FORMULA_0289 "FORMULA_0289" TAB_VERB "%3.0" "-" COMPU_TAB_REF FORMULA_0289_VTAB /end COMPU_METHOD
/begin COMPU_VTAB FORMULA_0289_VTAB "FORMULA_0289_VTAB" TAB_VERB 2 0 "Sperre Aus" 1 "Sperre Ein" /end COMPU_VTAB
/begin COMPU_METHOD FORMULA_0290 "FORMULA_0290" RAT_FUNC "%7.2" "Nms2" COEFFS 0 512 0 0 0 1 /end COMPU_METHOD
/begin COMPU_METHOD FORMULA_0291 "FORMULA_0291" TAB_VERB "%7.2" "-" COMPU_TAB_REF FORMULA_0291_VTAB /end COMPU_METHOD
/begin COMPU_VTAB FORMULA_0291_VTAB "FORMULA_0291_VTAB" TAB_VERB 2 0 "BLTS aus" 1 "BLTS ein" /end COMPU_VTAB
/begin COMPU_METHOD FORMULA_0292 "FORMULA_0292" TAB_VERB "%7.2" "-" COMPU_TAB_REF FORMULA_0292_VTAB /end COMPU_METHOD
/begin COMPU_VTAB FORMULA_0292_VTAB "FORMULA_0292_VTAB" TAB_VERB 2 0 "Sleep" 1 "Wakeup" /end COMPU_VTAB
/begin COMPU_METHOD FORMULA_0293 "FORMULA_0293" TAB_VERB "%7.2" "-" COMPU_TAB_REF FORMULA_0293_VTAB /end COMPU_METHOD
/begin COMPU_VTAB FORMULA_0293_VTAB "FORMULA_0293_VTAB" TAB_VERB 2 0 "Kl87 aus" 1 "Kl87 ein" /end COMPU_VTAB
/begin COMPU_METHOD FORMULA_0294 "FORMULA_0294" TAB_VERB "%7.2" "-" COMPU_TAB_REF FORMULA_0294_VTAB /end COMPU_METHOD
/begin COMPU_VTAB FORMULA_0294_VTAB "FORMULA_0294_VTAB" TAB_VERB 2 0 "offen" 1 "Kraftschluss" /end COMPU_VTAB
/begin COMPU_METHOD FORMULA_0295 "FORMULA_0295" RAT_FUNC "%9.4" "-" COEFFS 0 16384 0 0 0 1 /end COMPU_METHOD
/begin COMPU_METHOD FORMULA_0296 "FORMULA_0296" TAB_VERB "%7.2" "-" COMPU_TAB_REF FORMULA_0296_VTAB /end COMPU_METHOD
/begin COMPU_VTAB FORMULA_0296_VTAB "FORMULA_0296_VTAB" TAB_VERB 1 2365 "aktiv" DEFAULT_VALUE "nicht aktiv" /end COMPU_VTAB
/begin COMPU_METHOD FORMULA_0297 "FORMULA_0297" TAB_VERB "%7.2" "-" COMPU_TAB_REF FORMULA_0297_VTAB /end COMPU_METHOD
/begin COMPU_VTAB FORMULA_0297_VTAB "FORMULA_0297_VTAB" TAB_VERB 2 0 "sperrt" 1 "aktiv" /end COMPU_VTAB
/begin COMPU_METHOD FORMULA_0298 "FORMULA_0298" TAB_VERB "%7.2" "-" COMPU_TAB_REF FORMULA_0298_VTAB /end COMPU_METHOD
/begin COMPU_VTAB FORMULA_0298_VTAB "FORMULA_0298_VTAB" TAB_VERB 2 0 "inaktiv" 1 "aktiv" /end COMPU_VTAB
/begin COMPU_METHOD FORMULA_0299 "FORMULA_0299" TAB_VERB "%7.2" "-" COMPU_TAB_REF FORMULA_0299_VTAB /end COMPU_METHOD
/begin COMPU_VTAB FORMULA_0299_VTAB "FORMULA_0299_VTAB" TAB_VERB 2 0 "sperrt" 1 "aktiv" /end COMPU_VTAB
/begin COMPU_METHOD FORMULA_0300 "FORMULA_0300" TAB_VERB "%7.2" "-" COMPU_TAB_REF FORMULA_0300_VTAB /end COMPU_METHOD
/begin COMPU_VTAB FORMULA_0300_VTAB "FORMULA_0300_VTAB" TAB_VERB 2 0 "sperrt" 1 "aktiv" /end COMPU_VTAB
/begin COMPU_METHOD FORMULA_0301 "FORMULA_0301" TAB_VERB "%7.2" "-" COMPU_TAB_REF FORMULA_0301_VTAB /end COMPU_METHOD
/begin COMPU_VTAB FORMULA_0301_VTAB "FORMULA_0301_VTAB" TAB_VERB 2 0 "sperrt" 1 "aktiv" /end COMPU_VTAB
/begin COMPU_METHOD FORMULA_0302 "FORMULA_0302" TAB_VERB "%7.2" "-" COMPU_TAB_REF FORMULA_0302_VTAB /end COMPU_METHOD
/begin COMPU_VTAB FORMULA_0302_VTAB "FORMULA_0302_VTAB" TAB_VERB 2 0 "sperrt" 1 "aktiv" /end COMPU_VTAB
/begin COMPU_METHOD FORMULA_0303 "FORMULA_0303" TAB_VERB "%7.2" "-" COMPU_TAB_REF FORMULA_0303_VTAB /end COMPU_METHOD
/begin COMPU_VTAB FORMULA_0303_VTAB "FORMULA_0303_VTAB" TAB_VERB 2 0 "aus" 1 "aktiv" /end COMPU_VTAB
/begin COMPU_METHOD FORMULA_0304 "FORMULA_0304" TAB_VERB "%7.2" "-" COMPU_TAB_REF FORMULA_0304_VTAB /end COMPU_METHOD
/begin COMPU_VTAB FORMULA_0304_VTAB "FORMULA_0304_VTAB" TAB_VERB 2 0 "aus" 1 "aktiv" /end COMPU_VTAB
/begin COMPU_METHOD FORMULA_0305 "FORMULA_0305" TAB_VERB "%7.2" "-" COMPU_TAB_REF FORMULA_0305_VTAB /end COMPU_METHOD
/begin COMPU_VTAB FORMULA_0305_VTAB "FORMULA_0305_VTAB" TAB_VERB 2 0 "sperrt" 1 "aktiv" /end COMPU_VTAB
/begin COMPU_METHOD FORMULA_0306 "FORMULA_0306" TAB_VERB "%7.2" "-" COMPU_TAB_REF FORMULA_0306_VTAB /end COMPU_METHOD
/begin COMPU_VTAB FORMULA_0306_VTAB "FORMULA_0306_VTAB" TAB_VERB 2 0 "aus" 1 "aktiv" /end COMPU_VTAB
/begin COMPU_METHOD FORMULA_0307 "FORMULA_0307" TAB_VERB "%7.2" "-" COMPU_TAB_REF FORMULA_0307_VTAB /end COMPU_METHOD
/begin COMPU_VTAB FORMULA_0307_VTAB "FORMULA_0307_VTAB" TAB_VERB 2 0 "aus" 1 "aktiv" /end COMPU_VTAB
/begin COMPU_METHOD FORMULA_0308 "FORMULA_0308" TAB_VERB "%7.2" "-" COMPU_TAB_REF FORMULA_0308_VTAB /end COMPU_METHOD
/begin COMPU_VTAB FORMULA_0308_VTAB "FORMULA_0308_VTAB" TAB_VERB 2 0 "aus" 1 "aktiv" /end COMPU_VTAB
/begin COMPU_METHOD FORMULA_0309 "FORMULA_0309" TAB_VERB "%5.2" "-" COMPU_TAB_REF FORMULA_0309_VTAB /end COMPU_METHOD
/begin COMPU_VTAB FORMULA_0309_VTAB "FORMULA_0309_VTAB" TAB_VERB 6 0 "Inaktiv" 1 "Abregeln" 2 "Schalten" 3 "Aufregeln" 4 "Ende" 15 "Error" /end COMPU_VTAB
/begin COMPU_METHOD FORMULA_0310 "FORMULA_0310" TAB_VERB "%7.2" "-" COMPU_TAB_REF FORMULA_0310_VTAB /end COMPU_METHOD
/begin COMPU_VTAB FORMULA_0310_VTAB "FORMULA_0310_VTAB" TAB_VERB 2 0 "Schubbetrieb" 1 "Zugbetrieb" /end COMPU_VTAB
/begin COMPU_METHOD FORMULA_0311 "FORMULA_0311" TAB_VERB "%7.2" "-" COMPU_TAB_REF FORMULA_0311_VTAB /end COMPU_METHOD
/begin COMPU_VTAB FORMULA_0311_VTAB "FORMULA_0311_VTAB" TAB_VERB 3 0 "keine Schaltung" 1 "Hochschaltung" 2 "Rueckschaltung" DEFAULT_VALUE "undef" /end COMPU_VTAB
/begin COMPU_METHOD FORMULA_0312 "FORMULA_0312" TAB_VERB "%7.2" "-" COMPU_TAB_REF FORMULA_0312_VTAB /end COMPU_METHOD
/begin COMPU_VTAB FORMULA_0312_VTAB "FORMULA_0312_VTAB" TAB_VERB 2 0 "Manuell" 1 "Automat" /end COMPU_VTAB
/begin COMPU_METHOD FORMULA_0313 "FORMULA_0313" TAB_VERB "%7.2" "-" COMPU_TAB_REF FORMULA_0313_VTAB /end COMPU_METHOD
/begin COMPU_VTAB FORMULA_0313_VTAB "FORMULA_0313_VTAB" TAB_VERB 2 0 "mit Eingriff" 1 "ohne Eingriff" /end COMPU_VTAB
/begin COMPU_METHOD FORMULA_0314 "FORMULA_0314" TAB_VERB "%7.2" "-" COMPU_TAB_REF FORMULA_0314_VTAB /end COMPU_METHOD
/begin COMPU_VTAB FORMULA_0314_VTAB "FORMULA_0314_VTAB" TAB_VERB 2 0 "nein" 1 "ja" /end COMPU_VTAB
/begin COMPU_METHOD FORMULA_0315 "FORMULA_0315" TAB_VERB "%7.2" "-" COMPU_TAB_REF FORMULA_0315_VTAB /end COMPU_METHOD
/begin COMPU_VTAB FORMULA_0315_VTAB "FORMULA_0315_VTAB" TAB_VERB 2 0 "nein" 1 "ja" /end COMPU_VTAB
/begin COMPU_METHOD FORMULA_0316 "FORMULA_0316" TAB_VERB "%7.2" "-" COMPU_TAB_REF FORMULA_0316_VTAB /end COMPU_METHOD
/begin COMPU_VTAB FORMULA_0316_VTAB "FORMULA_0316_VTAB" TAB_VERB 2 0 "nein" 1 "ja" /end COMPU_VTAB
/begin COMPU_METHOD FORMULA_0317 "FORMULA_0317" RAT_FUNC "%5.2" "s" COEFFS 0 100 0 0 0 1 /end COMPU_METHOD
/begin COMPU_METHOD FORMULA_0318 "FORMULA_0318" RAT_FUNC "%3.0" ".Gang" COEFFS 0 1 0 0 0 1 /end COMPU_METHOD
/begin COMPU_METHOD FORMULA_0319 "FORMULA_0319" TAB_VERB "%7.2" "-" COMPU_TAB_REF FORMULA_0319_VTAB /end COMPU_METHOD
/begin COMPU_VTAB FORMULA_0319_VTAB "FORMULA_0319_VTAB" TAB_VERB 2 0 "bekannt" 1 "unbekannt" /end COMPU_VTAB
/begin COMPU_METHOD FORMULA_0320 "FORMULA_0320" TAB_VERB "%7.2" "-" COMPU_TAB_REF FORMULA_0320_VTAB /end COMPU_METHOD
/begin COMPU_VTAB FORMULA_0320_VTAB "FORMULA_0320_VTAB" TAB_VERB 2 0 "nicht ungerade" 1 "ungerade" /end COMPU_VTAB
/begin COMPU_METHOD FORMULA_0321 "FORMULA_0321" TAB_VERB "%7.2" "-" COMPU_TAB_REF FORMULA_0321_VTAB /end COMPU_METHOD
/begin COMPU_VTAB FORMULA_0321_VTAB "FORMULA_0321_VTAB" TAB_VERB 2 0 "nicht gerade" 1 "gerade" /end COMPU_VTAB
/begin COMPU_METHOD FORMULA_0322 "FORMULA_0322" TAB_VERB "%7.2" "-" COMPU_TAB_REF FORMULA_0322_VTAB /end COMPU_METHOD
/begin COMPU_VTAB FORMULA_0322_VTAB "FORMULA_0322_VTAB" TAB_VERB 2 0 "keine Aktion" 1 "Aktion" /end COMPU_VTAB
/begin COMPU_METHOD FORMULA_0323 "FORMULA_0323" TAB_VERB "%7.2" "-" COMPU_TAB_REF FORMULA_0323_VTAB /end COMPU_METHOD
/begin COMPU_VTAB FORMULA_0323_VTAB "FORMULA_0323_VTAB" TAB_VERB 2 0 "nicht plausibel" 1 "plausibel" /end COMPU_VTAB
/begin COMPU_METHOD FORMULA_0324 "FORMULA_0324" TAB_VERB "%7.2" "-" COMPU_TAB_REF FORMULA_0324_VTAB /end COMPU_METHOD
/begin COMPU_VTAB FORMULA_0324_VTAB "FORMULA_0324_VTAB" TAB_VERB 2 0 "nicht berechnen" 1 "neu berechnen" /end COMPU_VTAB
/begin COMPU_METHOD FORMULA_0325 "FORMULA_0325" TAB_VERB "%7.2" "-" COMPU_TAB_REF FORMULA_0325_VTAB /end COMPU_METHOD
/begin COMPU_VTAB FORMULA_0325_VTAB "FORMULA_0325_VTAB" TAB_VERB 2 0 "Gang halten" 1 "Gang uebernehmen" /end COMPU_VTAB
/begin COMPU_METHOD FORMULA_0326 "FORMULA_0326" TAB_VERB "%3.0" "-" COMPU_TAB_REF FORMULA_0326_VTAB /end COMPU_METHOD
/begin COMPU_VTAB FORMULA_0326_VTAB "FORMULA_0326_VTAB" TAB_VERB 3 0 "aus" 1 "inaktiv" 2 "aktiv" /end COMPU_VTAB
/begin COMPU_METHOD FORMULA_0327 "FORMULA_0327" TAB_VERB "%3.0" "-" COMPU_TAB_REF FORMULA_0327_VTAB /end COMPU_METHOD
/begin COMPU_VTAB FORMULA_0327_VTAB "FORMULA_0327_VTAB" TAB_VERB 2 0 "aus" 1 "ein" /end COMPU_VTAB
/begin COMPU_METHOD FORMULA_0328 "FORMULA_0328" TAB_VERB "%3.0" "-" COMPU_TAB_REF FORMULA_0328_VTAB /end COMPU_METHOD
/begin COMPU_VTAB FORMULA_0328_VTAB "FORMULA_0328_VTAB" TAB_VERB 4 0 "Inaktiv" 1 "HUD ein" 2 "NotAcpt" 3 "Ein+NotAcpt" /end COMPU_VTAB
/begin COMPU_METHOD FORMULA_0329 "FORMULA_0329" RAT_FUNC "%6.1" "km/h" COEFFS 0 10 0 0 0 1 /end COMPU_METHOD
/begin COMPU_METHOD FORMULA_0330 "FORMULA_0330" TAB_VERB "%3.0" "-" COMPU_TAB_REF FORMULA_0330_VTAB /end COMPU_METHOD
/begin COMPU_VTAB FORMULA_0330_VTAB "FORMULA_0330_VTAB" TAB_VERB 13 0 "Verriegelt" 1 "Aus" 2 "Ein / Aus" 3 "Passiv" 4 "Abschalt Rampe" 5 "Wiederaufnahme" 6 "Set" 7 "Konstantfahrt" 8 "Tipp plus" 9 "Tipp minus" 10 "Beschleunigung" 11 "Verzoegern" 12 "Ueberholen" DEFAULT_VALUE "undef" /end COMPU_VTAB
/begin COMPU_METHOD FORMULA_0331 "FORMULA_0331" TAB_VERB "%4.1" "-" COMPU_TAB_REF FORMULA_0331_VTAB /end COMPU_METHOD
/begin COMPU_VTAB FORMULA_0331_VTAB "FORMULA_0331_VTAB" TAB_VERB 2 0 "SA freigegeben" 1 "SA gesperrt" /end COMPU_VTAB
/begin COMPU_METHOD FORMULA_0332 "FORMULA_0332" TAB_VERB "%3.0" "-" COMPU_TAB_REF FORMULA_0332_VTAB /end COMPU_METHOD
/begin COMPU_VTAB FORMULA_0332_VTAB "FORMULA_0332_VTAB" TAB_VERB 4 0 "keine" 1 "Bank1" 2 "Bank2" 3 "Bank1+2" /end COMPU_VTAB
/begin COMPU_METHOD FORMULA_0333 "FORMULA_0333" RAT_FUNC "%7.2" "�C" COEFFS 0 20 5463 0 0 1 /end COMPU_METHOD
/begin COMPU_METHOD FORMULA_0334 "FORMULA_0334" TAB_VERB "%5.2" "-" COMPU_TAB_REF FORMULA_0334_VTAB /end COMPU_METHOD
/begin COMPU_VTAB FORMULA_0334_VTAB "FORMULA_0334_VTAB" TAB_VERB 1 0 "Abregeln_B1" DEFAULT_VALUE "Aufregeln_B1" /end COMPU_VTAB
/begin COMPU_METHOD FORMULA_0335 "FORMULA_0335" TAB_VERB "%5.2" "-" COMPU_TAB_REF FORMULA_0335_VTAB /end COMPU_METHOD
/begin COMPU_VTAB FORMULA_0335_VTAB "FORMULA_0335_VTAB" TAB_VERB 1 0 "Abregeln_B2" DEFAULT_VALUE "Aufregeln_B2" /end COMPU_VTAB
/begin COMPU_METHOD FORMULA_0336 "FORMULA_0336" TAB_VERB "%5.2" "-" COMPU_TAB_REF FORMULA_0336_VTAB /end COMPU_METHOD
/begin COMPU_VTAB FORMULA_0336_VTAB "FORMULA_0336_VTAB" TAB_VERB 1 0 "No_Grad_B1" DEFAULT_VALUE "Gradient_B1" /end COMPU_VTAB
/begin COMPU_METHOD FORMULA_0337 "FORMULA_0337" TAB_VERB "%5.2" "-" COMPU_TAB_REF FORMULA_0337_VTAB /end COMPU_METHOD
/begin COMPU_VTAB FORMULA_0337_VTAB "FORMULA_0337_VTAB" TAB_VERB 1 0 "No_Grad_B2" DEFAULT_VALUE "Gradient_B2" /end COMPU_VTAB
/begin COMPU_METHOD FORMULA_0338 "FORMULA_0338" TAB_VERB "%5.2" "-" COMPU_TAB_REF FORMULA_0338_VTAB /end COMPU_METHOD
/begin COMPU_VTAB FORMULA_0338_VTAB "FORMULA_0338_VTAB" TAB_VERB 1 0 "No_Init_B1" DEFAULT_VALUE "Init_B1" /end COMPU_VTAB
/begin COMPU_METHOD FORMULA_0339 "FORMULA_0339" TAB_VERB "%5.2" "-" COMPU_TAB_REF FORMULA_0339_VTAB /end COMPU_METHOD
/begin COMPU_VTAB FORMULA_0339_VTAB "FORMULA_0339_VTAB" TAB_VERB 1 0 "No_Init_B2" DEFAULT_VALUE "Init_B2" /end COMPU_VTAB
/begin COMPU_METHOD FORMULA_0340 "FORMULA_0340" RAT_FUNC "%11.4" "�C" COEFFS 0 10240 2797056 0 0 1 /end COMPU_METHOD
/begin COMPU_METHOD FORMULA_0341 "FORMULA_0341" TAB_VERB "%3.0" "-" COMPU_TAB_REF FORMULA_0341_VTAB /end COMPU_METHOD
/begin COMPU_VTAB FORMULA_0341_VTAB "FORMULA_0341_VTAB" TAB_VERB 4 0 "Lampe aus" 1 "Lampe gelb" 2 "Lampe rot" 3 "Lampe rot" /end COMPU_VTAB
/begin COMPU_METHOD FORMULA_0342 "FORMULA_0342" TAB_VERB "%3.0" "-" COMPU_TAB_REF FORMULA_0342_VTAB /end COMPU_METHOD
/begin COMPU_VTAB FORMULA_0342_VTAB "FORMULA_0342_VTAB" TAB_VERB 2 0 "Inaktiv" 1 "Aktiv" /end COMPU_VTAB
/begin COMPU_METHOD FORMULA_0343 "FORMULA_0343" TAB_VERB "%4.1" "-" COMPU_TAB_REF FORMULA_0343_VTAB /end COMPU_METHOD
/begin COMPU_VTAB FORMULA_0343_VTAB "FORMULA_0343_VTAB" TAB_VERB 2 0 "gesperrt" 1 "senden" /end COMPU_VTAB
/begin COMPU_METHOD FORMULA_0344 "FORMULA_0344" TAB_VERB "%5.0" "-" COMPU_TAB_REF FORMULA_0344_VTAB /end COMPU_METHOD
/begin COMPU_VTAB FORMULA_0344_VTAB "FORMULA_0344_VTAB" TAB_VERB 1 0 "keine aus" DEFAULT_VALUE "Mind. eine abgesch." /end COMPU_VTAB
/begin COMPU_METHOD FORMULA_0345 "FORMULA_0345" TAB_VERB "%3.0" "-" COMPU_TAB_REF FORMULA_0345_VTAB /end COMPU_METHOD
/begin COMPU_VTAB FORMULA_0345_VTAB "FORMULA_0345_VTAB" TAB_VERB 3 0 "nichts" 1 "postiv" 2 "negativ" /end COMPU_VTAB
/* ------------------ Abschnitt erzeugt aus ipk.dat ------------------ */
/begin COMPU_METHOD FORMULA_0346 "FORMULA_0346" TAB_VERB "%5.2" "-" COMPU_TAB_REF FORMULA_0346_VTAB /end COMPU_METHOD
/begin COMPU_VTAB FORMULA_0346_VTAB "FORMULA_0346_VTAB" TAB_VERB 4 0 "ok" 1 "no send/busy" 2 "csum nok" 4 "Stackbereich" DEFAULT_VALUE "ungueltig" /end COMPU_VTAB
/begin COMPU_METHOD FORMULA_0347 "FORMULA_0347" RAT_FUNC "%8.1" "ms" COEFFS 0 1000 0 0 0 1 /end COMPU_METHOD
/begin COMPU_METHOD FORMULA_0664 "FORMULA_0664" RAT_FUNC "%5.2" "s" COEFFS 0 0 2.56 0 1 0 /end COMPU_METHOD
/* ------------------ Abschnitt erzeugt aus hfm.dat ------------------ */
/begin COMPU_METHOD FORMULA_0719 "FORMULA_0719" RAT_FUNC "%6.3" "s" COEFFS 0 0 2.56 0 1 0 /end COMPU_METHOD
/begin COMPU_METHOD FORMULA_0720 "FORMULA_0720" TAB_VERB "%5.2" "-" COMPU_TAB_REF FORMULA_0720_VTAB /end COMPU_METHOD
/begin COMPU_VTAB FORMULA_0720_VTAB "FORMULA_0720_VTAB" TAB_VERB 3 0 "S85_BG2" 1 "S85_BG3" 2 "S65" DEFAULT_VALUE "ungueltig" /end COMPU_VTAB
/begin COMPU_METHOD FORMULA_0721 "FORMULA_0721" TAB_VERB "%5.2" "-" COMPU_TAB_REF FORMULA_0721_VTAB /end COMPU_METHOD
/begin COMPU_VTAB FORMULA_0721_VTAB "FORMULA_0721_VTAB" TAB_VERB 2 0 "Keine Popelung" 1 "Mit Popelung" DEFAULT_VALUE "ungueltig" /end COMPU_VTAB
/begin COMPU_METHOD FORMULA_0722 "FORMULA_0722" TAB_VERB "%5.2" "-" COMPU_TAB_REF FORMULA_0722_VTAB /end COMPU_METHOD
/begin COMPU_VTAB FORMULA_0722_VTAB "FORMULA_0722_VTAB" TAB_VERB 2 0 "aus mzyl_sek_aq_mvac" 1 "aus mvac_ml_sr" /end COMPU_VTAB
/* ------------------ Abschnitt erzeugt aus inj_tb.dat ------------------ */
/begin COMPU_METHOD FORMULA_0723 "FORMULA_0723" TAB_VERB "%3.0" "-" COMPU_TAB_REF FORMULA_0723_VTAB /end COMPU_METHOD
/begin COMPU_VTAB FORMULA_0723_VTAB "FORMULA_0723_VTAB" TAB_VERB 5 0 "Inaktiv" 1 "Aktiv" 2 "TPU-Stop" 4 "ECU-Stop" 8 "Trig-Stop" /end COMPU_VTAB
/begin COMPU_METHOD FORMULA_0724 "FORMULA_0724" RAT_FUNC "%5.0" "us" COEFFS 0 1 0 0 0 10 /end COMPU_METHOD
/begin COMPU_METHOD FORMULA_0725 "FORMULA_0725" RAT_FUNC "%5.0" "Hz" COEFFS 0 1 0 0 0 1 /end COMPU_METHOD
/begin COMPU_METHOD FORMULA_0726 "FORMULA_0726" TAB_VERB "%5.2" "-" COMPU_TAB_REF FORMULA_0726_VTAB /end COMPU_METHOD
/begin COMPU_VTAB FORMULA_0726_VTAB "FORMULA_0726_VTAB" TAB_VERB 2 0 "ITB aus" 1 "ITB ein" DEFAULT_VALUE "undef" /end COMPU_VTAB
/* ------------------ Abschnitt erzeugt aus glob.dat ------------------ */
/begin MEASUREMENT lam_soll_b1 "ausgegebenes SOLL-Lambda" UWORD FORMULA_0025 0 0 0.0 3.9990 ECU_ADDRESS 0x3F87A8 /end MEASUREMENT
/begin MEASUREMENT lam_soll_b2 "ausgegebenes SOLL-Lambda" UWORD FORMULA_0025 0 0 0.0 3.9990 ECU_ADDRESS 0x3F87AA /end MEASUREMENT
/begin MEASUREMENT lam_reg_f_b1 "Regeleingriff" UWORD FORMULA_0024 0 0 0.0 1.9990 ECU_ADDRESS 0x3F87AC /end MEASUREMENT
/begin MEASUREMENT lam_reg_f_b2 "Regeleingriff" UWORD FORMULA_0024 0 0 0.0 1.9990 ECU_ADDRESS 0x3F87AE /end MEASUREMENT
/begin MEASUREMENT lam_reg_st_b1 "LA-Regler-Status" UWORD FORMULA_0083 0 0 0.0 65535.0000 ECU_ADDRESS 0x3F87B0 /end MEASUREMENT
/begin MEASUREMENT lam_reg_st_b2 "LA-Regler-Status" UWORD FORMULA_0083 0 0 0.0 65535.0000 ECU_ADDRESS 0x3F87B2 /end MEASUREMENT
/begin MEASUREMENT lam_regler_st_b1 "LA-Regler-Status" UWORD FORMULA_0084 0 0 0.0 65535.0 ECU_ADDRESS 0x3F87B0 BIT_MASK 0x7 /end MEASUREMENT
/begin MEASUREMENT lam_regler_st_b2 "LA-Regler-Status" UWORD FORMULA_0084 0 0 0.0 65535.0 ECU_ADDRESS 0x3F87B2 BIT_MASK 0x7 /end MEASUREMENT
/begin MEASUREMENT lam_reg_stat_b1 "LA-Regler Position" UWORD FORMULA_0085 0 0 0.0 65535.0 ECU_ADDRESS 0x3F87B0 BIT_MASK 0x8 /end MEASUREMENT
/begin MEASUREMENT lam_reg_stat_b2 "LA-Regler Position" UWORD FORMULA_0085 0 0 0.0 65535.0 ECU_ADDRESS 0x3F87B2 BIT_MASK 0x8 /end MEASUREMENT
/begin MEASUREMENT lam_wf_verz_b1 "WF-Verzoegerung" UWORD FORMULA_0086 0 0 0.0 65535.0 ECU_ADDRESS 0x3F87B0 BIT_MASK 0x10 /end MEASUREMENT
/begin MEASUREMENT lam_wf_verz_b2 "WF-Verzoegerung" UWORD FORMULA_0086 0 0 0.0 65535.0 ECU_ADDRESS 0x3F87B2 BIT_MASK 0x10 /end MEASUREMENT
/begin MEASUREMENT lam_ti_min_b1 "min. TI fuer LA-Regelung" UWORD FORMULA_0087 0 0 0.0 65535.0 ECU_ADDRESS 0x3F87B0 BIT_MASK 0x20 /end MEASUREMENT
/begin MEASUREMENT lam_ti_min_b2 "min. TI fuer LA-Regelung" UWORD FORMULA_0087 0 0 0.0 65535.0 ECU_ADDRESS 0x3F87B2 BIT_MASK 0x20 /end MEASUREMENT
/begin MEASUREMENT lam_reg_min_b1 "min. Reglereingriff" UWORD FORMULA_0088 0 0 0.0 65535.0 ECU_ADDRESS 0x3F87B0 BIT_MASK 0x40 /end MEASUREMENT
/begin MEASUREMENT lam_reg_min_b2 "min. Reglereingriff" UWORD FORMULA_0088 0 0 0.0 65535.0 ECU_ADDRESS 0x3F87B2 BIT_MASK 0x40 /end MEASUREMENT
/begin MEASUREMENT lam_reg_max_b1 "max. Reglereingriff" UWORD FORMULA_0089 0 0 0.0 65535.0 ECU_ADDRESS 0x3F87B0 BIT_MASK 0x80 /end MEASUREMENT
/begin MEASUREMENT lam_reg_max_b2 "max. Reglereingriff" UWORD FORMULA_0089 0 0 0.0 65535.0 ECU_ADDRESS 0x3F87B2 BIT_MASK 0x80 /end MEASUREMENT
/begin MEASUREMENT lam_reg_reset_sa_b1 "LA-Regler RESET - SA" UWORD FORMULA_0090 0 0 0.0 65535.0 ECU_ADDRESS 0x3F87B0 BIT_MASK 0x100 /end MEASUREMENT
/begin MEASUREMENT lam_reg_reset_sa_b2 "LA-Regler RESET - SA" UWORD FORMULA_0090 0 0 0.0 65535.0 ECU_ADDRESS 0x3F87B2 BIT_MASK 0x100 /end MEASUREMENT
/begin MEASUREMENT lam_reg_reset_slp_b1 "LA-Regler-RESET - SLP" UWORD FORMULA_0091 0 0 0.0 65535.0 ECU_ADDRESS 0x3F87B0 BIT_MASK 0x200 /end MEASUREMENT
/begin MEASUREMENT lam_reg_reset_slp_b2 "LA-Regler-RESET - SLP" UWORD FORMULA_0091 0 0 0.0 65535.0 ECU_ADDRESS 0x3F87B2 BIT_MASK 0x200 /end MEASUREMENT
/begin MEASUREMENT lam_reg_stat_trim_b1 "LA-Regler Position fuer TRIM-Regelung" UWORD FORMULA_0092 0 0 0.0 65535.0 ECU_ADDRESS 0x3F87B0 BIT_MASK 0x400 /end MEASUREMENT
/begin MEASUREMENT lam_reg_stat_trim_b2 "LA-Regler Position fuer TRIM-Regelung" UWORD FORMULA_0092 0 0 0.0 65535.0 ECU_ADDRESS 0x3F87B2 BIT_MASK 0x400 /end MEASUREMENT
/begin MEASUREMENT lam_ist_mw_b1 "Mittelwert IST-Lambda" UWORD FORMULA_0025 0 0 0.0 3.9990 ECU_ADDRESS 0x3F87B4 /end MEASUREMENT
/begin MEASUREMENT lam_ist_mw_b2 "Mittelwert IST-Lambda" UWORD FORMULA_0025 0 0 0.0 3.9990 ECU_ADDRESS 0x3F87B6 /end MEASUREMENT
/begin MEASUREMENT lam_ist_ers_b1 "LAM-IST - Ersatz" UWORD FORMULA_0025 0 0 0.0 3.9990 ECU_ADDRESS 0x3F87B8 /end MEASUREMENT
/begin MEASUREMENT lam_ist_ers_b2 "LAM-IST - Ersatz" UWORD FORMULA_0025 0 0 0.0 3.9990 ECU_ADDRESS 0x3F87BA /end MEASUREMENT
/begin MEASUREMENT lam_soll_wl "SOLL-Lambda - Warmlauf" UWORD FORMULA_0025 0 0 0.0 3.9990 ECU_ADDRESS 0x3F87BC /end MEASUREMENT
/begin MEASUREMENT lam_soll_ms_kat_b1 "gespeicherte Sauerstoffmasse im KAT" SWORD FORMULA_0093 0 0 -3276.8000 3276.7000 ECU_ADDRESS 0x3F87BE /end MEASUREMENT
/begin MEASUREMENT lam_soll_ms_kat_b2 "gespeicherte Sauerstoffmasse im KAT" SWORD FORMULA_0093 0 0 -3276.8000 3276.7000 ECU_ADDRESS 0x3F87C0 /end MEASUREMENT
/begin MEASUREMENT lam_soll_puls_st_b1 "Status-Pulsgenerator" UWORD FORMULA_0083 0 0 0.0 65535.0000 ECU_ADDRESS 0x3F87C2 /end MEASUREMENT
/begin MEASUREMENT lam_soll_puls_st_b2 "Status-Pulsgenerator" UWORD FORMULA_0083 0 0 0.0 65535.0000 ECU_ADDRESS 0x3F87C4 /end MEASUREMENT
/begin MEASUREMENT lam_soll_puls_adapt_mager_b1 "Adaption MAGER" UWORD FORMULA_0094 0 0 0.0 65535.0 ECU_ADDRESS 0x3F87C2 BIT_MASK 0x1 /end MEASUREMENT
/begin MEASUREMENT lam_soll_puls_adapt_mager_b2 "Adaption MAGER" UWORD FORMULA_0094 0 0 0.0 65535.0 ECU_ADDRESS 0x3F87C4 BIT_MASK 0x1 /end MEASUREMENT
/begin MEASUREMENT lam_soll_puls_adapt_fett_b1 "Adaption FETT" UWORD FORMULA_0095 0 0 0.0 65535.0 ECU_ADDRESS 0x3F87C2 BIT_MASK 0x2 /end MEASUREMENT
/begin MEASUREMENT lam_soll_puls_adapt_fett_b2 "Adaption FETT" UWORD FORMULA_0095 0 0 0.0 65535.0 ECU_ADDRESS 0x3F87C4 BIT_MASK 0x2 /end MEASUREMENT
/begin MEASUREMENT lam_soll_puls_b1 "Pulsgenerator" UWORD FORMULA_0096 0 0 0.0 65535.0 ECU_ADDRESS 0x3F87C2 BIT_MASK 0x4 /end MEASUREMENT
/begin MEASUREMENT lam_soll_puls_b2 "Pulsgenerator" UWORD FORMULA_0096 0 0 0.0 65535.0 ECU_ADDRESS 0x3F87C4 BIT_MASK 0x4 /end MEASUREMENT
/begin MEASUREMENT lam_soll_puls_freigabe_b1 "Freigabe Pulsgenerator" UWORD FORMULA_0097 0 0 0.0 65535.0 ECU_ADDRESS 0x3F87C2 BIT_MASK 0x8 /end MEASUREMENT
/begin MEASUREMENT lam_soll_puls_freigabe_b2 "Freigabe Pulsgenerator" UWORD FORMULA_0097 0 0 0.0 65535.0 ECU_ADDRESS 0x3F87C4 BIT_MASK 0x8 /end MEASUREMENT
/begin MEASUREMENT lam_soll_puls_fett_betrieb_b1 "FETT-Betrieb" UWORD FORMULA_0098 0 0 0.0 65535.0 ECU_ADDRESS 0x3F87C2 BIT_MASK 0x20 /end MEASUREMENT
/begin MEASUREMENT lam_soll_puls_fett_betrieb_b2 "FETT-Betrieb" UWORD FORMULA_0098 0 0 0.0 65535.0 ECU_ADDRESS 0x3F87C4 BIT_MASK 0x20 /end MEASUREMENT
/begin MEASUREMENT lam_soll_puls_lam_filt_b1 "LAM-SOLL-Filterung" UWORD FORMULA_0099 0 0 0.0 65535.0 ECU_ADDRESS 0x3F87C2 BIT_MASK 0x40 /end MEASUREMENT
/begin MEASUREMENT lam_soll_puls_lam_filt_b2 "LAM-SOLL-Filterung" UWORD FORMULA_0099 0 0 0.0 65535.0 ECU_ADDRESS 0x3F87C4 BIT_MASK 0x40 /end MEASUREMENT
/begin MEASUREMENT lam_soll_puls_ausr_b1 "O2-Ausraeumfunktion" UWORD FORMULA_0100 0 0 0.0 65535.0 ECU_ADDRESS 0x3F87C2 BIT_MASK 0x80 /end MEASUREMENT
/begin MEASUREMENT lam_soll_puls_ausr_b2 "O2-Ausraeumfunktion" UWORD FORMULA_0100 0 0 0.0 65535.0 ECU_ADDRESS 0x3F87C4 BIT_MASK 0x80 /end MEASUREMENT
/begin MEASUREMENT lam_soll_puls_ausr_sl_b1 "O2-Ausraeumfunktion nach SLP" UWORD FORMULA_0101 0 0 0.0 65535.0 ECU_ADDRESS 0x3F87C2 BIT_MASK 0x100 /end MEASUREMENT
/begin MEASUREMENT lam_soll_puls_ausr_sl_b2 "O2-Ausraeumfunktion nach SLP" UWORD FORMULA_0101 0 0 0.0 65535.0 ECU_ADDRESS 0x3F87C4 BIT_MASK 0x100 /end MEASUREMENT
/begin MEASUREMENT lam_soll_puls_ausr_sl_trig_b1 "Trigger O2-Ausraeumfunktion nach SLP" UWORD FORMULA_0102 0 0 0.0 65535.0 ECU_ADDRESS 0x3F87C2 BIT_MASK 0x200 /end MEASUREMENT
/begin MEASUREMENT lam_soll_puls_ausr_sl_trig_b2 "Trigger O2-Ausraeumfunktion nach SLP" UWORD FORMULA_0102 0 0 0.0 65535.0 ECU_ADDRESS 0x3F87C4 BIT_MASK 0x200 /end MEASUREMENT
/begin MEASUREMENT lam_delta_lim_b1 "begrenzte Regelabweichung" SWORD FORMULA_0025 0 0 -2.0000 1.9999 ECU_ADDRESS 0x3F87C6 /end MEASUREMENT
/begin MEASUREMENT lam_delta_lim_b2 "begrenzte Regelabweichung" SWORD FORMULA_0025 0 0 -2.0000 1.9999 ECU_ADDRESS 0x3F87C8 /end MEASUREMENT
/begin MEASUREMENT lavk_obd_dyn_st_b1 "dynamische LA-VKAT-Diagnose" UWORD FORMULA_0083 0 0 0.0 65535.0000 ECU_ADDRESS 0x3F87CA /end MEASUREMENT
/begin MEASUREMENT lavk_obd_dyn_st_b2 "dynamische LA-VKAT-Diagnose" UWORD FORMULA_0083 0 0 0.0 65535.0000 ECU_ADDRESS 0x3F87CC /end MEASUREMENT
/begin MEASUREMENT lavk_obd_dyn_zustand_b1 "Zustand - dynamische LA-VKAT-Diagnose" UWORD FORMULA_0103 0 0 0.0 65535.0 ECU_ADDRESS 0x3F87CA BIT_MASK 0x1F /end MEASUREMENT
/begin MEASUREMENT lavk_obd_dyn_zustand_b2 "Zustand - dynamische LA-VKAT-Diagnose" UWORD FORMULA_0103 0 0 0.0 65535.0 ECU_ADDRESS 0x3F87CC BIT_MASK 0x1F /end MEASUREMENT
/begin MEASUREMENT lavk_obd_dyn_max_b1 "Ermittlung max. LA-Wert" UWORD FORMULA_0104 0 0 0.0 65535.0 ECU_ADDRESS 0x3F87CA BIT_MASK 0x20 /end MEASUREMENT
/begin MEASUREMENT lavk_obd_dyn_max_b2 "Ermittlung max. LA-Wert" UWORD FORMULA_0104 0 0 0.0 65535.0 ECU_ADDRESS 0x3F87CC BIT_MASK 0x20 /end MEASUREMENT
/begin MEASUREMENT lavk_obd_dyn_min_b1 "Ermittlung min. LA-Wert" UWORD FORMULA_0105 0 0 0.0 65535.0 ECU_ADDRESS 0x3F87CA BIT_MASK 0x40 /end MEASUREMENT
/begin MEASUREMENT lavk_obd_dyn_min_b2 "Ermittlung min. LA-Wert" UWORD FORMULA_0105 0 0 0.0 65535.0 ECU_ADDRESS 0x3F87CC BIT_MASK 0x40 /end MEASUREMENT
/begin MEASUREMENT lavk_obd_dyn_io_verz_b1 "Verzoegerung Fehlerheilung" UWORD FORMULA_0106 0 0 0.0 65535.0 ECU_ADDRESS 0x3F87CA BIT_MASK 0x100 /end MEASUREMENT
/begin MEASUREMENT lavk_obd_dyn_io_verz_b2 "Verzoegerung Fehlerheilung" UWORD FORMULA_0106 0 0 0.0 65535.0 ECU_ADDRESS 0x3F87CC BIT_MASK 0x100 /end MEASUREMENT
/begin MEASUREMENT lavk_obd_dyn_exd_fett__b1 "LAM-SOLL-OFFS bei ext. Ansteuerung f. Freigabe" UWORD FORMULA_0107 0 0 0.0 65535.0 ECU_ADDRESS 0x3F87CA BIT_MASK 0x400 /end MEASUREMENT
/begin MEASUREMENT lavk_obd_dyn_exd_fett__b2 "LAM-SOLL-OFFS bei ext. Ansteuerung f. Freigabe" UWORD FORMULA_0107 0 0 0.0 65535.0 ECU_ADDRESS 0x3F87CC BIT_MASK 0x400 /end MEASUREMENT
/begin MEASUREMENT lavk_obd_dyn_exd_b1 "Externe Ansteuerung" UWORD FORMULA_0108 0 0 0.0 65535.0 ECU_ADDRESS 0x3F87CA BIT_MASK 0x800 /end MEASUREMENT
/begin MEASUREMENT lavk_obd_dyn_exd_b2 "Externe Ansteuerung" UWORD FORMULA_0108 0 0 0.0 65535.0 ECU_ADDRESS 0x3F87CC BIT_MASK 0x800 /end MEASUREMENT
/begin MEASUREMENT rf_b1 "relative Fuellung" SWORD FORMULA_0007 0 0 0.0 2.0000 ECU_ADDRESS 0x3F87CE /end MEASUREMENT
/begin MEASUREMENT rf_b2 "relative Fuellung" SWORD FORMULA_0007 0 0 0.0 2.0000 ECU_ADDRESS 0x3F87D0 /end MEASUREMENT
/begin MEASUREMENT rg_x_b1 "Restgasgehalt" SWORD FORMULA_0109 0 0 -0.5000 0.5000 ECU_ADDRESS 0x3F87D2 /end MEASUREMENT
/begin MEASUREMENT rg_x_b2 "Restgasgehalt" SWORD FORMULA_0109 0 0 -0.5000 0.5000 ECU_ADDRESS 0x3F87D4 /end MEASUREMENT
/begin MEASUREMENT rg_x_m "gem. Restgasgehalt" SWORD FORMULA_0109 0 0 -0.5000 0.5000 ECU_ADDRESS 0x3F87D6 /end MEASUREMENT
/begin MEASUREMENT rg_x_m_stat "gem. Restgasgehalt" SWORD FORMULA_0109 0 0 -0.5000 0.5000 ECU_ADDRESS 0x3F87D8 /end MEASUREMENT
/begin MEASUREMENT nw_st "Synchronisationsstatus Nockenwelle" UBYTE FORMULA_0110 0 0 0.0 255.0 ECU_ADDRESS 0x3F87DA /end MEASUREMENT
/begin MEASUREMENT ti_tpu_st "TI-TPU-Status" UWORD FORMULA_0010 0 0 0.0 65535.0000 ECU_ADDRESS 0x3F87DC /end MEASUREMENT
/begin MEASUREMENT ti_ausblend_ist_b1 "Zyl-Ausblendung pro Bank" UBYTE FORMULA_0003 0 0 0.0 255.0000 ECU_ADDRESS 0x3F87DE /end MEASUREMENT
/begin MEASUREMENT ti_ausblend_ist_b2 "Zyl-Ausblendung pro Bank" UBYTE FORMULA_0003 0 0 0.0 255.0000 ECU_ADDRESS 0x3F87DF /end MEASUREMENT
/begin MEASUREMENT ti_rf_max "max. rf aus TI" SWORD FORMULA_0007 0 0 0.0 2.0000 ECU_ADDRESS 0x3F87E0 /end MEASUREMENT
/begin MEASUREMENT ti_pks_up_st "TI-PKS-UP-Status" UWORD FORMULA_0083 0 0 0.0 65535.0000 ECU_ADDRESS 0x3F87E2 /end MEASUREMENT
/begin MEASUREMENT diag_ev_tz_st "Bankabschaltung bei EV-/TZ-Fehlern" UWORD FORMULA_0010 0 0 0.0 65535.0000 ECU_ADDRESS 0x3F87E4 /end MEASUREMENT
/begin MEASUREMENT ti_ev_ed_b1 "EV-Treiberdiag." UWORD FORMULA_0010 0 0 0.0 65535.0000 ECU_ADDRESS 0x3F87E6 /end MEASUREMENT
/begin MEASUREMENT ti_ev_ed_b2 "EV-Treiberdiag." UWORD FORMULA_0010 0 0 0.0 65535.0000 ECU_ADDRESS 0x3F87E8 /end MEASUREMENT
/begin MEASUREMENT van_ist_E1 "Istposition" SWORD FORMULA_0111 0 0 50.0000 160.0000 ECU_ADDRESS 0x3F87EA /end MEASUREMENT
/begin MEASUREMENT van_ist_A1 "Istposition" SWORD FORMULA_0111 0 0 50.0000 160.0000 ECU_ADDRESS 0x3F87EC /end MEASUREMENT
/begin MEASUREMENT van_ist_E2 "Istposition" SWORD FORMULA_0111 0 0 50.0000 160.0000 ECU_ADDRESS 0x3F87EE /end MEASUREMENT
/begin MEASUREMENT van_ist_A2 "Istposition" SWORD FORMULA_0111 0 0 50.0000 160.0000 ECU_ADDRESS 0x3F87F0 /end MEASUREMENT
/begin MEASUREMENT van_soll_E1 "Sollwert" SWORD FORMULA_0111 0 0 50.0000 160.0000 ECU_ADDRESS 0x3F87F2 /end MEASUREMENT
/begin MEASUREMENT van_soll_A1 "Sollwert" SWORD FORMULA_0111 0 0 50.0000 160.0000 ECU_ADDRESS 0x3F87F4 /end MEASUREMENT
/begin MEASUREMENT van_soll_E2 "Sollwert" SWORD FORMULA_0111 0 0 50.0000 160.0000 ECU_ADDRESS 0x3F87F6 /end MEASUREMENT
/begin MEASUREMENT van_soll_A2 "Sollwert" SWORD FORMULA_0111 0 0 50.0000 160.0000 ECU_ADDRESS 0x3F87F8 /end MEASUREMENT
/begin MEASUREMENT ml_b1 "Luftmassenstrom" SWORD FORMULA_0112 0 0 -100.0000 1400.0000 ECU_ADDRESS 0x3F87FA /end MEASUREMENT
/begin MEASUREMENT ml_b2 "Luftmassenstrom" SWORD FORMULA_0112 0 0 -100.0000 1400.0000 ECU_ADDRESS 0x3F87FC /end MEASUREMENT
/begin MEASUREMENT mzyl_ml_b1 "Luftmassenstrom" SWORD FORMULA_0113 0 0 -500.0000 1500.0000 ECU_ADDRESS 0x3F87FE /end MEASUREMENT
/begin MEASUREMENT mzyl_ml_b2 "Luftmassenstrom" SWORD FORMULA_0113 0 0 -500.0000 1500.0000 ECU_ADDRESS 0x3F8800 /end MEASUREMENT
/begin MEASUREMENT rg_m_delta_ist_stat_b1 "Differenz Ist zu Stat" SWORD FORMULA_0113 0 0 -500.0000 1500.0000 ECU_ADDRESS 0x3F8802 /end MEASUREMENT
/begin MEASUREMENT rg_m_delta_ist_stat_b2 "Differenz Ist zu Stat" SWORD FORMULA_0113 0 0 -500.0000 1500.0000 ECU_ADDRESS 0x3F8804 /end MEASUREMENT
/begin MEASUREMENT rf_m "relative Fuellung Mittel zwischen Bank 1 und 2" SWORD FORMULA_0007 0 0 0.0 2.0000 ECU_ADDRESS 0x3F8806 /end MEASUREMENT
/begin MEASUREMENT ml_ges "Luftmassenstrom Bank 1 und 2" SWORD FORMULA_0112 0 0 -100.0000 1400.0000 ECU_ADDRESS 0x3F8808 /end MEASUREMENT
/begin MEASUREMENT rps_zyl_nr "Zylinder-RPS" UBYTE FORMULA_0003 0 0 0.0 255.0000 ECU_ADDRESS 0x3F880A /end MEASUREMENT
/begin MEASUREMENT rps_ionen_st "Status Ionen-RPS" UWORD FORMULA_0010 0 0 0.0 65535.0000 ECU_ADDRESS 0x3F880C /end MEASUREMENT
/begin MEASUREMENT rps_ionen_stufe "Stufe Ionen-RPS" UWORD FORMULA_0010 0 0 0.0 65535.0000 ECU_ADDRESS 0x3F880E /end MEASUREMENT
/begin MEASUREMENT rps_auss_st "Status Aussetzer-RPS" UWORD FORMULA_0010 0 0 0.0 65535.0000 ECU_ADDRESS 0x3F8810 /end MEASUREMENT
/begin MEASUREMENT n "Motordrehzahl" SWORD FORMULA_0006 0 0 0.0 10000.0000 ECU_ADDRESS 0x3F8812 /end MEASUREMENT
/begin MEASUREMENT n_grad_segment "Drehzahlgradient" SWORD FORMULA_0114 0 0 -10000.0000 10000.0000 ECU_ADDRESS 0x3F8814 /end MEASUREMENT
/begin MEASUREMENT n_grad_asp "Drehzahlgradient (Arbeitsspiel)" SWORD FORMULA_0114 0 0 -10000.0000 10000.0000 ECU_ADDRESS 0x3F8816 /end MEASUREMENT
/begin MEASUREMENT lam_soll_vl_max "Soll-Lambda bei max VL" UWORD FORMULA_0025 0 0 0.0 3.9990 ECU_ADDRESS 0x3F8818 /end MEASUREMENT
/begin MEASUREMENT nw_asp_cnt_ml "720� Arbeitsspielzaehler seit Motorstart." ULONG FORMULA_0000 0 0 0.0 4294967295.0000 ECU_ADDRESS 0x3F881C /end MEASUREMENT
/begin MEASUREMENT nw_asp_cnt "720� Arbeitsspielzaehler." ULONG FORMULA_0000 0 0 0.0 4294967295.0000 ECU_ADDRESS 0x3F8820 /end MEASUREMENT
/begin MEASUREMENT psau_rel_b1 "relativer Saugrohrdruck Bank" SWORD FORMULA_0115 0 0 0.0 120.0000 ECU_ADDRESS 0x3F8824 /end MEASUREMENT
/begin MEASUREMENT psau_rel_b2 "relativer Saugrohrdruck Bank" SWORD FORMULA_0115 0 0 0.0 120.0000 ECU_ADDRESS 0x3F8826 /end MEASUREMENT
/begin MEASUREMENT rg_x_delta_b1 "Differenz zwischen Stat. Restgmasse und Modell" SWORD FORMULA_0109 0 0 -0.5000 0.5000 ECU_ADDRESS 0x3F8828 /end MEASUREMENT
/begin MEASUREMENT rg_x_delta_b2 "Differenz zwischen Stat. Restgmasse und Modell" SWORD FORMULA_0109 0 0 -0.5000 0.5000 ECU_ADDRESS 0x3F882A /end MEASUREMENT
/begin MEASUREMENT rf_aq_b1 "rf aus aq bestimmt" SWORD FORMULA_0007 0 0 0.0 2.0000 ECU_ADDRESS 0x3F882C /end MEASUREMENT
/begin MEASUREMENT rf_aq_b2 "rf aus aq bestimmt" SWORD FORMULA_0007 0 0 0.0 2.0000 ECU_ADDRESS 0x3F882E /end MEASUREMENT
/begin MEASUREMENT rf_hfm_b1 "relative Fuellung aus HFM" SWORD FORMULA_0007 0 0 0.0 2.0000 ECU_ADDRESS 0x3F8830 /end MEASUREMENT
/begin MEASUREMENT rf_hfm_b2 "relative Fuellung aus HFM" SWORD FORMULA_0007 0 0 0.0 2.0000 ECU_ADDRESS 0x3F8832 /end MEASUREMENT
/begin MEASUREMENT rf_psau_b1 "relative Fuellung aus PSAU" SWORD FORMULA_0007 0 0 0.0 2.0000 ECU_ADDRESS 0x3F8834 /end MEASUREMENT
/begin MEASUREMENT rf_psau_b2 "relative Fuellung aus PSAU" SWORD FORMULA_0007 0 0 0.0 2.0000 ECU_ADDRESS 0x3F8836 /end MEASUREMENT
/begin MEASUREMENT rf_pt_korr_e2 "Korrektur der relativen Fuellung" UWORD FORMULA_0075 0 0 0.0 4.0000 ECU_ADDRESS 0x3F8838 /end MEASUREMENT
/begin MEASUREMENT rf_e2_b1 "relative Fuellung Ebene 2" SWORD FORMULA_0007 0 0 0.0 2.0000 ECU_ADDRESS 0x3F883A /end MEASUREMENT
/begin MEASUREMENT rf_e2_b2 "relative Fuellung Ebene 2" SWORD FORMULA_0007 0 0 0.0 2.0000 ECU_ADDRESS 0x3F883C /end MEASUREMENT
/begin MEASUREMENT rf_e2_m "relative Fuellung Ebene 2 Mittelwert" SWORD FORMULA_0007 0 0 0.0 2.0000 ECU_ADDRESS 0x3F883E /end MEASUREMENT
/begin MEASUREMENT te_tv_b1 "auszugebendes TE-Tastverhaeltnis" UWORD FORMULA_0001 0 0 0.0 100.0000 ECU_ADDRESS 0x3F8840 /end MEASUREMENT
/begin MEASUREMENT te_tv_b2 "auszugebendes TE-Tastverhaeltnis" UWORD FORMULA_0001 0 0 0.0 100.0000 ECU_ADDRESS 0x3F8842 /end MEASUREMENT
/begin MEASUREMENT sa_we_st "SAWE-Status" UBYTE FORMULA_0116 0 0 0.0 255.0 ECU_ADDRESS 0x3F8888 /end MEASUREMENT
/begin MEASUREMENT sa_n_we "Drehzahlschwelle fuer Wiedereinsetzdrehzahl" SWORD FORMULA_0006 0 0 0.0 10000.0000 ECU_ADDRESS 0x3F888A /end MEASUREMENT
/begin MEASUREMENT sa_aktive_time "SA aktive Zeit" UWORD FORMULA_0117 0 0 0.0 325.0000 ECU_ADDRESS 0x3F888C /end MEASUREMENT
/begin MEASUREMENT pks_ist "Kraftstoffdruck, absolut, gefiltert" SWORD FORMULA_0118 0 0 0.0 10.0000 ECU_ADDRESS 0x3F888E /end MEASUREMENT
/begin MEASUREMENT pks_ist_obd_mode_1_2 "Ausgabe SCAN_TOOL" UBYTE FORMULA_0119 0 0 0.0 7.6500 ECU_ADDRESS 0x3F8890 /end MEASUREMENT
/begin MEASUREMENT pks_rel "Kraftstoffdruck, relativ" SWORD FORMULA_0118 0 0 0.0 10.0000 ECU_ADDRESS 0x3F8892 /end MEASUREMENT
/begin MEASUREMENT B_genoff_copy "Kopie von (St_ugenkor0 & 0x08)" UBYTE FORMULA_0033 0 0 0.0 255.0000 ECU_ADDRESS 0x3F8894 /end MEASUREMENT
/begin MEASUREMENT B_oztemp_bsd_ok "Status FI_QLT (vorh. j/n)" UBYTE FORMULA_0033 0 0 0.0 255.0000 ECU_ADDRESS 0x3F8895 /end MEASUREMENT
/begin MEASUREMENT B_oztemp_obd_ok "QLT-Temperatur gemessen (Incl. Wartezeit nach B_oztemp)" UBYTE FORMULA_0120 0 0 0.0 255.0 ECU_ADDRESS 0x3F8896 /end MEASUREMENT
/begin MEASUREMENT Md_gennm_copy "gefiltertes Generatormoment absolut" SWORD FORMULA_0121 0 0 -3276.8000 3276.7000 ECU_ADDRESS 0x3F8898 /end MEASUREMENT
/begin MEASUREMENT N_idlgspec_copy "Anforderung LL-Anhebung" UBYTE FORMULA_0003 0 0 0.0 255.0000 ECU_ADDRESS 0x3F889A /end MEASUREMENT
/begin MEASUREMENT Nslb_copy "N_soll Korrektur von Ladebilanz Batterie" SWORD FORMULA_0006 0 0 -32768.0000 32767.0000 ECU_ADDRESS 0x3F889C /end MEASUREMENT
/begin MEASUREMENT rps_cfg "Auswahl RPS-Modell" UBYTE FORMULA_0003 0 0 0.0 255.0000 ECU_ADDRESS 0x3F889E /end MEASUREMENT
/begin MEASUREMENT rps_rec1_cnt "Rec1-Fehlerzaehler" UBYTE FORMULA_0003 0 0 0.0 255.0000 ECU_ADDRESS 0x3F889F /end MEASUREMENT
/begin MEASUREMENT rps_rec2_cnt "Rec2-Fehlerzaehler" UBYTE FORMULA_0003 0 0 0.0 255.0000 ECU_ADDRESS 0x3F88A0 /end MEASUREMENT
/begin MEASUREMENT rps_llr_st "Status LLR-RPS" UBYTE FORMULA_0003 0 0 0.0 255.0000 ECU_ADDRESS 0x3F88A1 /end MEASUREMENT
/begin MEASUREMENT rps_llr_md_p "P-Anteil LLR-RPS" SWORD FORMULA_0009 0 0 -100.0000 1000.0000 ECU_ADDRESS 0x3F88A2 /end MEASUREMENT
/begin MEASUREMENT rps_llr_md_i "I-Anteil LLR-RPS" SWORD FORMULA_0009 0 0 -100.0000 1000.0000 ECU_ADDRESS 0x3F88A4 /end MEASUREMENT
/begin MEASUREMENT rps_llr_md_tz "TZ-Anteil LLR-RPS" SWORD FORMULA_0009 0 0 -100.0000 1000.0000 ECU_ADDRESS 0x3F88A6 /end MEASUREMENT
/begin MEASUREMENT rps_llr_md_ad "Adaptionswert LLR-RPS" SWORD FORMULA_0009 0 0 -100.0000 1000.0000 ECU_ADDRESS 0x3F88A8 /end MEASUREMENT
/begin MEASUREMENT rps_llr_n_soll "Sollwert LLR-RPS" SWORD FORMULA_0006 0 0 0.0 10000.0000 ECU_ADDRESS 0x3F88AA /end MEASUREMENT
/begin MEASUREMENT rps_kupp_min_filter "RPS-Minimalmoment gefiltert" SWORD FORMULA_0009 0 0 -100.0000 1000.0000 ECU_ADDRESS 0x3F88AC /end MEASUREMENT
/begin MEASUREMENT rps_kupp_wunsch_filter "RPS-Wunschmoment gefiltert" SWORD FORMULA_0009 0 0 -100.0000 1000.0000 ECU_ADDRESS 0x3F88AE /end MEASUREMENT
/begin MEASUREMENT rps_kupp_wunsch_fil_roh "RPS-Wunschmoment gefiltert-roh" SWORD FORMULA_0009 0 0 -100.0000 1000.0000 ECU_ADDRESS 0x3F88B0 /end MEASUREMENT
/begin MEASUREMENT rps_dyn_fil_st "RPS-Status Dynamikfilter" UWORD FORMULA_0010 0 0 0.0 65535.0000 ECU_ADDRESS 0x3F88B2 /end MEASUREMENT
/begin MEASUREMENT rps_evap_tv "RPS-Tastverh�ltnis" SWORD FORMULA_0022 0 0 -100.0000 100.0000 ECU_ADDRESS 0x3F88B4 /end MEASUREMENT
/begin MEASUREMENT rps_msa_st "RPS-Riemenstarter Status" UBYTE FORMULA_0122 0 0 0.0 255.0 ECU_ADDRESS 0x3F88B6 /end MEASUREMENT
/begin MEASUREMENT rps_msa_diag_st "RPS-Riemenstarter Diag" ULONG FORMULA_0000 0 0 0.0 4294967295.0000 ECU_ADDRESS 0x3F88B8 /end MEASUREMENT
/begin MEASUREMENT sk_hw_pwg1s_ad "AD-Wandlerwert PWG1 des Slaveprozessors" SWORD FORMULA_0123 0 0 0.0 1023.0000 ECU_ADDRESS 0x3F88BC /end MEASUREMENT
/begin MEASUREMENT can_s_tns "Schalter Tag/Nachtbeleuchtung" UBYTE FORMULA_0003 0 0 0.0 255.0000 ECU_ADDRESS 0x3F88BE /end MEASUREMENT
/begin MEASUREMENT cbs_reset_st "Erkennung CBS-Reset" UBYTE FORMULA_0124 0 0 0.0 255.0 ECU_ADDRESS 0x3F88BF BIT_MASK 0x1 /end MEASUREMENT
/begin MEASUREMENT can_st_atemp "Empfangsstatus ATemp" UWORD FORMULA_0125 0 0 0.0 65535.0 ECU_ADDRESS 0x3F88C0 /end MEASUREMENT
/begin MEASUREMENT can_st_empf "Empfangsstatus aktuell" UWORD FORMULA_0010 0 0 0.0 65535.0000 ECU_ADDRESS 0x3F88C2 /end MEASUREMENT
/begin MEASUREMENT can_st_empf_hys "Empfangsstatus pro SG-Zyklus" UWORD FORMULA_0010 0 0 0.0 65535.0000 ECU_ADDRESS 0x3F88C4 /end MEASUREMENT
/begin MEASUREMENT can_st_torqdsc "Empfangsstatus TorqDSC" UWORD FORMULA_0125 0 0 0.0 65535.0 ECU_ADDRESS 0x3F88C6 /end MEASUREMENT
/begin MEASUREMENT can_st_dsc "Empfangsstatus DSC" UWORD FORMULA_0125 0 0 0.0 65535.0 ECU_ADDRESS 0x3F88C8 /end MEASUREMENT
/begin MEASUREMENT can_st_vrad "Empfangsstatus vRad" UWORD FORMULA_0125 0 0 0.0 65535.0 ECU_ADDRESS 0x3F88CA /end MEASUREMENT
/begin MEASUREMENT can_st_klst "Empfangsstatus Klemmenstatus" UWORD FORMULA_0125 0 0 0.0 65535.0 ECU_ADDRESS 0x3F88CC /end MEASUREMENT
/begin MEASUREMENT can_st_vfzg "Empfangsstatus vFzg" UWORD FORMULA_0125 0 0 0.0 65535.0 ECU_ADDRESS 0x3F88CE /end MEASUREMENT
/begin MEASUREMENT can_st_stkombi "Empfangsstatus StatusKombi" UWORD FORMULA_0125 0 0 0.0 65535.0 ECU_ADDRESS 0x3F88D0 /end MEASUREMENT
/begin MEASUREMENT can_st_kkos "Empfangsstatus KKOS" UBYTE FORMULA_0126 0 0 0.0 255.0 ECU_ADDRESS 0x3F88D2 /end MEASUREMENT
/begin MEASUREMENT can_kkos_st "Stati KKOS" UBYTE FORMULA_0003 0 0 0.0 255.0000 ECU_ADDRESS 0x3F88D3 /end MEASUREMENT
/begin MEASUREMENT can_kkos_st_nll "Stati KKOS - n_ll" UBYTE FORMULA_0127 0 0 0.0 255.0 ECU_ADDRESS 0x3F88D3 BIT_MASK 0x7 /end MEASUREMENT
/begin MEASUREMENT can_kkos_st_zh "Stati KKOS - ZH" UBYTE FORMULA_0128 0 0 0.0 255.0 ECU_ADDRESS 0x3F88D3 BIT_MASK 0x60 /end MEASUREMENT
/begin MEASUREMENT can_kkos_md "Md-Aufnahme KKOS" SWORD FORMULA_0129 0 0 -100.0000 1000.0000 ECU_ADDRESS 0x3F88D4 /end MEASUREMENT
/begin MEASUREMENT v_rad_vl "v-Rad vorne-links" SWORD FORMULA_0078 0 0 -80.0000 360.0000 ECU_ADDRESS 0x3F88D6 /end MEASUREMENT
/begin MEASUREMENT v_rad_vr "v-Rad vorne-rechts" SWORD FORMULA_0078 0 0 -80.0000 360.0000 ECU_ADDRESS 0x3F88D8 /end MEASUREMENT
/begin MEASUREMENT v_rad_hl "v-Rad hinten-links" SWORD FORMULA_0078 0 0 -80.0000 360.0000 ECU_ADDRESS 0x3F88DA /end MEASUREMENT
/begin MEASUREMENT v_rad_hr "v-Rad hinten-rechts" SWORD FORMULA_0078 0 0 -80.0000 360.0000 ECU_ADDRESS 0x3F88DC /end MEASUREMENT
/begin MEASUREMENT v_vorne "v-Vorderachse" SWORD FORMULA_0078 0 0 -80.0000 360.0000 ECU_ADDRESS 0x3F88DE /end MEASUREMENT
/begin MEASUREMENT v_hinten "v-Hinterachse" SWORD FORMULA_0078 0 0 -80.0000 360.0000 ECU_ADDRESS 0x3F88E0 /end MEASUREMENT
/begin MEASUREMENT can_v_st "v-CAN-Status" UWORD FORMULA_0130 0 0 0.0 65535.0 ECU_ADDRESS 0x3F88E2 /end MEASUREMENT
/begin MEASUREMENT can_fzg_st "Fzg-Zustand" UBYTE FORMULA_0131 0 0 0.0 255.0 ECU_ADDRESS 0x3F88E4 /end MEASUREMENT
/begin MEASUREMENT can_ax "Laengsbeschleunigung (roh)" SWORD FORMULA_0132 0 0 -20.0000 20.0000 ECU_ADDRESS 0x3F88E6 /end MEASUREMENT
/begin MEASUREMENT can_ay "Querbeschleunigung (roh)" SWORD FORMULA_0132 0 0 -20.0000 20.0000 ECU_ADDRESS 0x3F88E8 /end MEASUREMENT
/begin MEASUREMENT can_a_st "A-Status" UBYTE FORMULA_0133 0 0 0.0 255.0 ECU_ADDRESS 0x3F88EA /end MEASUREMENT
/begin MEASUREMENT can_dsc_eingr "DSC-Eingriff" UBYTE FORMULA_0134 0 0 0.0 255.0 ECU_ADDRESS 0x3F88EB /end MEASUREMENT
/begin MEASUREMENT can_dsc_md_soll_pos "DSC-Sollmoment positiv" SWORD FORMULA_0129 0 0 -100.0000 1000.0000 ECU_ADDRESS 0x3F88EC /end MEASUREMENT
/begin MEASUREMENT can_dsc_md_soll "DSC-Sollmoment" SWORD FORMULA_0129 0 0 -100.0000 1000.0000 ECU_ADDRESS 0x3F88EE /end MEASUREMENT
/begin MEASUREMENT can_dsc_st "DSC-Status" UBYTE FORMULA_0135 0 0 0.0 255.0 ECU_ADDRESS 0x3F88F0 /end MEASUREMENT
/begin MEASUREMENT can_dsc_reg "Regelungs-Status" UBYTE FORMULA_0136 0 0 0.0 255.0 ECU_ADDRESS 0x3F88F1 /end MEASUREMENT
/begin MEASUREMENT can_brp_st "Bremsdruck-Status" UBYTE FORMULA_0137 0 0 0.0 255.0 ECU_ADDRESS 0x3F88F2 /end MEASUREMENT
/begin MEASUREMENT can_brp "Bremsdruck" UBYTE FORMULA_0138 0 0 0.0 200.0000 ECU_ADDRESS 0x3F88F3 /end MEASUREMENT
/begin MEASUREMENT can_lrw_st "Lenkradwinkel Status" UBYTE FORMULA_0139 0 0 0.0 255.0 ECU_ADDRESS 0x3F88F4 /end MEASUREMENT
/begin MEASUREMENT can_brp_grad "Gradient Bremsdruck" SWORD FORMULA_0140 0 0 -5000.0000 5000.0000 ECU_ADDRESS 0x3F88F6 /end MEASUREMENT
/begin MEASUREMENT can_lrw "Lenkradwinkel" SWORD FORMULA_0141 0 0 -1440.1536 1440.1096 ECU_ADDRESS 0x3F88F8 /end MEASUREMENT
/begin MEASUREMENT can_lrw_v "Lenkradwinkel-Geschw" SWORD FORMULA_0142 0 0 -1440.1536 1440.1096 ECU_ADDRESS 0x3F88FA /end MEASUREMENT
/begin MEASUREMENT can_klst_s "Klemmenstatus" UBYTE FORMULA_0143 0 0 0.0 255.0 ECU_ADDRESS 0x3F88FC /end MEASUREMENT
/begin MEASUREMENT can_no_key "Schluesselnummer" UBYTE FORMULA_0003 0 0 0.0 255.0000 ECU_ADDRESS 0x3F88FD /end MEASUREMENT
/begin MEASUREMENT can_st_vehmod "Empfangsstatus VehMode" UWORD FORMULA_0125 0 0 0.0 65535.0 ECU_ADDRESS 0x3F88FE /end MEASUREMENT
/begin MEASUREMENT can_vehmod "VehMode" UBYTE FORMULA_0003 0 0 0.0 255.0000 ECU_ADDRESS 0x3F8900 /end MEASUREMENT
/begin MEASUREMENT can_st_bedfgr "Empfangsstatus BedFgr" UWORD FORMULA_0125 0 0 0.0 65535.0 ECU_ADDRESS 0x3F8902 /end MEASUREMENT
/begin MEASUREMENT can_bedfgr "FGR-Taster" UBYTE FORMULA_0144 0 0 0.0 255.0 ECU_ADDRESS 0x3F8904 /end MEASUREMENT
/begin MEASUREMENT kl87_st "KL87-Status" UBYTE FORMULA_0145 0 0 0.0 255.0 ECU_ADDRESS 0x3F8905 /end MEASUREMENT
/begin MEASUREMENT zust_tmot_start "tmot im Zustand START" SWORD FORMULA_0023 0 0 -50.0000 170.0000 ECU_ADDRESS 0x3F8906 /end MEASUREMENT
/begin MEASUREMENT zust_tka_start "tka im Zustand START" SWORD FORMULA_0023 0 0 -50.0000 170.0000 ECU_ADDRESS 0x3F8908 /end MEASUREMENT
/begin MEASUREMENT zustand_motor "Betriebszustand der Motorsteuerung" UWORD FORMULA_0019 0 0 0.0 65535.0 ECU_ADDRESS 0x3F890A /end MEASUREMENT
/begin MEASUREMENT sl_zwd_tv "Tastverh. LLS fuer SL" SWORD FORMULA_0146 0 0 0.0 100.0000 ECU_ADDRESS 0x3F890E /end MEASUREMENT
/begin MEASUREMENT mvac_aq_bre "AQ-Offset LL-Steller Bank 2" UWORD FORMULA_0147 0 0 0.0 6500.0000 ECU_ADDRESS 0x3F8910 /end MEASUREMENT
/begin MEASUREMENT mvac_rf_sr "Fuellung MVAC" SWORD FORMULA_0007 0 0 0.0 2.0000 ECU_ADDRESS 0x3F8914 /end MEASUREMENT
/begin MEASUREMENT kva_can "Letzter Kraftstoffverbrauch in ul (0xFFFF = Fehler)" UWORD FORMULA_0148 0 0 0.0 65.5350 ECU_ADDRESS 0x3F8916 /end MEASUREMENT
/begin MEASUREMENT v_max_delta "Delta zur Maximalgeschwindigkeit" SWORD FORMULA_0078 0 0 -80.0000 360.0000 ECU_ADDRESS 0x3F8918 /end MEASUREMENT
/begin MEASUREMENT sl_ml_hfm "gefilterter SLP-Luftmassenstrom" SWORD FORMULA_0112 0 0 -100.0000 1400.0000 ECU_ADDRESS 0x3F891A /end MEASUREMENT
/begin MEASUREMENT hfm_ml_b1_obd_mode_1_2 "Ausgabe SCAN_TOOL" UWORD FORMULA_0053 0 0 0.0 655.3500 ECU_ADDRESS 0x3F891C /end MEASUREMENT
/begin MEASUREMENT time_ms "Zeit seit Motor steht" ULONG FORMULA_0149 0 0 0.0 71582788.2500 ECU_ADDRESS 0x3F8920 /end MEASUREMENT
/begin MEASUREMENT mvac_p_modell "Absolutdruck(Modell) im Mastervac" SWORD FORMULA_0077 0 0 0.0 1200.0000 ECU_ADDRESS 0x3F8924 /end MEASUREMENT
/begin MEASUREMENT mvac_pdiff_um "Differenzdruck(Modell) Mastervac/Umgebung" SWORD FORMULA_0077 0 0 -1100.0000 200.0000 ECU_ADDRESS 0x3F8926 /end MEASUREMENT
/begin MEASUREMENT mvac_p_mess "berechneter Absolutdruck(Sensor) im Mastervac" SWORD FORMULA_0077 0 0 0.0 1200.0000 ECU_ADDRESS 0x3F8928 /end MEASUREMENT
/begin MEASUREMENT mvac_p "gemessener Differenzdruck(Senor) Mastervac/Umgebung" SWORD FORMULA_0077 0 0 -1100.0000 200.0000 ECU_ADDRESS 0x3F892A /end MEASUREMENT
/begin MEASUREMENT mvac_ed_st "MVAC-Fehler" UBYTE FORMULA_0150 0 0 0.0 255.0 ECU_ADDRESS 0x3F892C /end MEASUREMENT
/begin MEASUREMENT kat_obd_zust_st_b1 "KAT-Diagnose Zustandsautomat" UWORD FORMULA_0151 0 0 0.0 65535.0 ECU_ADDRESS 0x3F8930 BIT_MASK 0x1F /end MEASUREMENT
/begin MEASUREMENT kat_obd_zust_st_b2 "KAT-Diagnose Zustandsautomat" UWORD FORMULA_0151 0 0 0.0 65535.0 ECU_ADDRESS 0x3F8932 BIT_MASK 0x1F /end MEASUREMENT
/begin MEASUREMENT zust_md_rel_tl_vl "rel. �bergangsmoment TL-VL" SWORD FORMULA_0001 0 0 0.0 100.0000 ECU_ADDRESS 0x3F8934 /end MEASUREMENT
/begin MEASUREMENT time_ml "3HaxenSchnurrZeit" ULONG FORMULA_0152 0 0 0.0 655.0000 ECU_ADDRESS 0x3F8938 /end MEASUREMENT
/begin MEASUREMENT time_ll "Zeit seit Eintritt LL" ULONG FORMULA_0152 0 0 0.0 655.0000 ECU_ADDRESS 0x3F893C /end MEASUREMENT
/begin MEASUREMENT time_kl15_on "Zeit seit Kl15 an" ULONG FORMULA_0152 0 0 0.0 655.0000 ECU_ADDRESS 0x3F8940 /end MEASUREMENT
/begin MEASUREMENT time_kl15_off "Zeit seit Kl15 aus" ULONG FORMULA_0152 0 0 0.0 655.0000 ECU_ADDRESS 0x3F8944 /end MEASUREMENT
/begin MEASUREMENT time_sa "Zeit seit SA" ULONG FORMULA_0152 0 0 0.0 655.0000 ECU_ADDRESS 0x3F8948 /end MEASUREMENT
/begin MEASUREMENT time_vl "Zeit seit Eintritt in VL" ULONG FORMULA_0152 0 0 0.0 655.0000 ECU_ADDRESS 0x3F894C /end MEASUREMENT
/begin MEASUREMENT n_begr_egas "Drehzahlbegrenzung ueber Momenteneingriff" SWORD FORMULA_0006 0 0 0.0 10000.0000 ECU_ADDRESS 0x3F8950 /end MEASUREMENT
/begin MEASUREMENT n_begr_st "Statusvariable Drehzahlbegrenzung" UBYTE FORMULA_0153 0 0 0.0 8.0 ECU_ADDRESS 0x3F8952 /end MEASUREMENT
/begin MEASUREMENT n_dyn_st "Statusvariable Drehzahldynamik" UBYTE FORMULA_0154 0 0 0.0 8.0 ECU_ADDRESS 0x3F8953 /end MEASUREMENT
/begin MEASUREMENT schalter_st_inj "Schalterstatus" UWORD FORMULA_0083 0 0 0.0 65535.0000 ECU_ADDRESS 0x3F8954 /end MEASUREMENT
/begin MEASUREMENT schalter_bls_inj "Schalterstatus" UWORD FORMULA_0155 0 0 0.0 65535.0 ECU_ADDRESS 0x3F8954 BIT_MASK 0x1 /end MEASUREMENT
/begin MEASUREMENT schalter_kupplung "Schalterstatus" UWORD FORMULA_0156 0 0 0.0 65535.0 ECU_ADDRESS 0x3F8954 BIT_MASK 0x2 /end MEASUREMENT
/begin MEASUREMENT schalter_getriebe "Schalterstatus" UWORD FORMULA_0157 0 0 0.0 65535.0 ECU_ADDRESS 0x3F8954 BIT_MASK 0x24 /end MEASUREMENT
/begin MEASUREMENT schalter_wakeup_inj "Schalterstatus" UWORD FORMULA_0158 0 0 0.0 65535.0 ECU_ADDRESS 0x3F8954 BIT_MASK 0x8 /end MEASUREMENT
/begin MEASUREMENT schalter_power "Schalterstatus" UWORD FORMULA_0159 0 0 0.0 65535.0 ECU_ADDRESS 0x3F8954 BIT_MASK 0x10 /end MEASUREMENT
/begin MEASUREMENT schalter_schaltung "Schalterstatus" UWORD FORMULA_0160 0 0 0.0 65535.0 ECU_ADDRESS 0x3F8954 BIT_MASK 0x40 /end MEASUREMENT
/begin MEASUREMENT schalter_poel "Schalterstatus" UWORD FORMULA_0161 0 0 0.0 65535.0 ECU_ADDRESS 0x3F8954 BIT_MASK 0x80 /end MEASUREMENT
/begin MEASUREMENT schalter_zustand_poel "Schalterstatus" UWORD FORMULA_0162 0 0 0.0 65535.0 ECU_ADDRESS 0x3F8954 BIT_MASK 0x100 /end MEASUREMENT
/begin MEASUREMENT schalter_kraft_hs "Kraftschluss beim Handschalter" UWORD FORMULA_0163 0 0 0.0 65535.0 ECU_ADDRESS 0x3F8954 BIT_MASK 0x200 /end MEASUREMENT
/begin MEASUREMENT schalter_st_inj_e2 "Schalterstatus Ebene 2" UWORD FORMULA_0083 0 0 0.0 65535.0000 ECU_ADDRESS 0x3F8956 /end MEASUREMENT
/begin MEASUREMENT schalter_bls_inj_e2 "Schalterstatus Ebene 2" UWORD FORMULA_0155 0 0 0.0 65535.0 ECU_ADDRESS 0x3F8956 BIT_MASK 0x1 /end MEASUREMENT
/begin MEASUREMENT schalter_kupplung_e2 "Schalterstatus Ebene 2" UWORD FORMULA_0156 0 0 0.0 65535.0 ECU_ADDRESS 0x3F8956 BIT_MASK 0x2 /end MEASUREMENT
/begin MEASUREMENT schalter_getriebe_e2 "Schalterstatus Ebene 2" UWORD FORMULA_0157 0 0 0.0 65535.0 ECU_ADDRESS 0x3F8956 BIT_MASK 0x24 /end MEASUREMENT
/begin MEASUREMENT schalter_wakeup_inj_e2 "Schalterstatus Ebene 2" UWORD FORMULA_0158 0 0 0.0 65535.0 ECU_ADDRESS 0x3F8956 BIT_MASK 0x8 /end MEASUREMENT
/begin MEASUREMENT schalter_power_e2 "Schalterstatus Ebene 2" UWORD FORMULA_0159 0 0 0.0 65535.0 ECU_ADDRESS 0x3F8956 BIT_MASK 0x10 /end MEASUREMENT
/begin MEASUREMENT schalter_schaltung_e2 "Schalterstatus Ebene 2" UWORD FORMULA_0160 0 0 0.0 65535.0 ECU_ADDRESS 0x3F8956 BIT_MASK 0x40 /end MEASUREMENT
/begin MEASUREMENT schalter_poel_e2 "Schalterstatus Ebene 2" UWORD FORMULA_0161 0 0 0.0 65535.0 ECU_ADDRESS 0x3F8956 BIT_MASK 0x80 /end MEASUREMENT
/begin MEASUREMENT schalter_zustand_poel_e2 "Schalterstatus Ebene 2" UWORD FORMULA_0162 0 0 0.0 65535.0 ECU_ADDRESS 0x3F8956 BIT_MASK 0x100 /end MEASUREMENT
/begin MEASUREMENT schalter_kraft_hs_e2 "Kraftschluss beim Handschalter Ebene 2" UWORD FORMULA_0163 0 0 0.0 65535.0 ECU_ADDRESS 0x3F8956 BIT_MASK 0x200 /end MEASUREMENT
/begin MEASUREMENT pksr_b_ekp2 "Einschaltzustand EKP2" UBYTE FORMULA_0164 0 0 0.0 255.0 ECU_ADDRESS 0x3F8958 /end MEASUREMENT
/begin MEASUREMENT pctrl_t_inj "Werte fuer die Prozessorkontrolle" ULONG FORMULA_0000 0 0 0.0 4294967295.0000 ECU_ADDRESS 0x3F895C /end MEASUREMENT
/begin MEASUREMENT nwm_state "Zustand vom NWM" UBYTE FORMULA_0165 0 0 0.0 255.0 ECU_ADDRESS 0x3F8960 /end MEASUREMENT
/begin MEASUREMENT can_flags "Allg. CAN-Flags" UBYTE FORMULA_0003 0 0 0.0 255.0000 ECU_ADDRESS 0x3F8961 /end MEASUREMENT
/begin MEASUREMENT can_flags_mm "Allg. CAN-Flags" UBYTE FORMULA_0166 0 0 0.0 255.0 ECU_ADDRESS 0x3F8961 BIT_MASK 0x2 /end MEASUREMENT
/begin MEASUREMENT can_flags_obd_ed "Allg. CAN-Flags" UBYTE FORMULA_0167 0 0 0.0 255.0 ECU_ADDRESS 0x3F8961 BIT_MASK 0x40 /end MEASUREMENT
/begin MEASUREMENT mdrv_st "MDRV-Status (CAN)" UBYTE FORMULA_0168 0 0 0.0 255.0 ECU_ADDRESS 0x3F8962 /end MEASUREMENT
/begin MEASUREMENT mdrv_st_dme "MDRV-Status" UBYTE FORMULA_0169 0 0 0.0 255.0 ECU_ADDRESS 0x3F8963 /end MEASUREMENT
/begin MEASUREMENT toel_can "gefilterte Motoroeltemperatur (0xFF = Fehler)." UBYTE FORMULA_0170 0 0 -48.0000 170.0000 ECU_ADDRESS 0x3F8964 /end MEASUREMENT
/begin MEASUREMENT dwf_n_orange "oranger Drehzahlbereich" UBYTE FORMULA_0171 0 0 0.0 12750.0000 ECU_ADDRESS 0x3F8965 /end MEASUREMENT
/begin MEASUREMENT sk_egas_off_inj "SK-Egasstufe" UBYTE FORMULA_0172 0 0 0.0 255.0 ECU_ADDRESS 0x3F8966 /end MEASUREMENT
/begin MEASUREMENT sk_md_begr_inj "SK-Begrenzungsstufe" UBYTE FORMULA_0172 0 0 0.0 255.0 ECU_ADDRESS 0x3F8967 /end MEASUREMENT
/begin MEASUREMENT sk_md_eingr_inj "SK-Md-Eingriff" UBYTE FORMULA_0003 0 0 0.0 255.0000 ECU_ADDRESS 0x3F8968 /end MEASUREMENT
/begin MEASUREMENT sk_tz_eingr_inj "SK-TZ-Eingriff" UBYTE FORMULA_0173 0 0 0.0 255.0 ECU_ADDRESS 0x3F8968 BIT_MASK 0x1 /end MEASUREMENT
/begin MEASUREMENT sk_ti_eingr_inj "SK-TI-Eingriff" UBYTE FORMULA_0174 0 0 0.0 255.0 ECU_ADDRESS 0x3F8968 BIT_MASK 0x2 /end MEASUREMENT
/begin MEASUREMENT sk_lam_st_inj_b1 "SK-LAM-Eingriff" UBYTE FORMULA_0175 0 0 0.0 255.0 ECU_ADDRESS 0x3F8969 /end MEASUREMENT
/begin MEASUREMENT sk_lam_st_inj_b2 "SK-LAM-Eingriff" UBYTE FORMULA_0176 0 0 0.0 255.0 ECU_ADDRESS 0x3F8969 /end MEASUREMENT
/begin MEASUREMENT sk_van_st_inj "SK-Vanos-Eingriff" UBYTE FORMULA_0177 0 0 0.0 255.0 ECU_ADDRESS 0x3F896A /end MEASUREMENT
/begin MEASUREMENT sk_eingr_st_inj "SK-Eingriff" UBYTE FORMULA_0003 0 0 0.0 255.0000 ECU_ADDRESS 0x3F896B /end MEASUREMENT
/begin MEASUREMENT sk_pks_st_inj "SK-Eingriff PKS" UBYTE FORMULA_0178 0 0 0.0 255.0 ECU_ADDRESS 0x3F896B BIT_MASK 0x1 /end MEASUREMENT
/begin MEASUREMENT sk_llra_st_inj "SK-Eingriff LLRA" UBYTE FORMULA_0179 0 0 0.0 255.0 ECU_ADDRESS 0x3F896B BIT_MASK 0x2 /end MEASUREMENT
/begin MEASUREMENT sk_fra_st_inj "SK-Eingriff FRA" UBYTE FORMULA_0180 0 0 0.0 255.0 ECU_ADDRESS 0x3F896B BIT_MASK 0x4 /end MEASUREMENT
/begin MEASUREMENT sk_kh_st_inj "SK-Eingriff KH" UBYTE FORMULA_0181 0 0 0.0 255.0 ECU_ADDRESS 0x3F896B BIT_MASK 0x8 /end MEASUREMENT
/begin MEASUREMENT sk_mzyl_st_inj "SK-Eingriff MZYL" UBYTE FORMULA_0182 0 0 0.0 255.0 ECU_ADDRESS 0x3F896B BIT_MASK 0x30 /end MEASUREMENT
/begin MEASUREMENT sk_fr_st_inj "SK-Eingriff FR" UBYTE FORMULA_0183 0 0 0.0 255.0 ECU_ADDRESS 0x3F896B BIT_MASK 0x40 /end MEASUREMENT
/begin MEASUREMENT sk_ti_zyl_off_inj "SK-Ausblendungen" UWORD FORMULA_0184 0 0 0.0 65535.0 ECU_ADDRESS 0x3F896C /end MEASUREMENT
/begin MEASUREMENT te_st "allgemeiner TE-Status" UWORD FORMULA_0083 0 0 0.0 65535.0000 ECU_ADDRESS 0x3F896E /end MEASUREMENT
/begin MEASUREMENT te_st_zul "TE-Funktion" UWORD FORMULA_0185 0 0 0.0 65535.0 ECU_ADDRESS 0x3F896E BIT_MASK 0x2 /end MEASUREMENT
/begin MEASUREMENT te_not_spuelen "NOTLAUF-SPUELEN" UWORD FORMULA_0186 0 0 0.0 65535.0 ECU_ADDRESS 0x3F896E BIT_MASK 0x4 /end MEASUREMENT
/begin MEASUREMENT te_spuelen_abbr "Abbruch SPUELEN" UWORD FORMULA_0187 0 0 0.0 65535.0 ECU_ADDRESS 0x3F896E BIT_MASK 0x8 /end MEASUREMENT
/begin MEASUREMENT te_spuelen_stop "STOP-SPUELEN" UWORD FORMULA_0188 0 0 0.0 65535.0 ECU_ADDRESS 0x3F896E BIT_MASK 0x10 /end MEASUREMENT
/begin MEASUREMENT te_spuelen_dauer "DAUER-SPUELEN" UWORD FORMULA_0189 0 0 0.0 65535.0 ECU_ADDRESS 0x3F896E BIT_MASK 0x20 /end MEASUREMENT
/begin MEASUREMENT te_n_stat1 "n-Stationaer Bank1" UWORD FORMULA_0190 0 0 0.0 65535.0 ECU_ADDRESS 0x3F896E BIT_MASK 0x40 /end MEASUREMENT
/begin MEASUREMENT te_n_stat2 "n-Stationaer Bank2" UWORD FORMULA_0191 0 0 0.0 65535.0 ECU_ADDRESS 0x3F896E BIT_MASK 0x80 /end MEASUREMENT
/begin MEASUREMENT te_rf_stat1 "rf-Stationaer Bank1" UWORD FORMULA_0192 0 0 0.0 65535.0 ECU_ADDRESS 0x3F896E BIT_MASK 0x100 /end MEASUREMENT
/begin MEASUREMENT te_rf_stat2 "rf-Stationaer Bank2" UWORD FORMULA_0102 0 0 0.0 65535.0 ECU_ADDRESS 0x3F896E BIT_MASK 0x200 /end MEASUREMENT
/begin MEASUREMENT te_van_stat1 "VAN-Stationaer Bank1" UWORD FORMULA_0193 0 0 0.0 65535.0 ECU_ADDRESS 0x3F896E BIT_MASK 0x400 /end MEASUREMENT
/begin MEASUREMENT te_van_stat2 "VAN-Stationaer Bank2" UWORD FORMULA_0194 0 0 0.0 65535.0 ECU_ADDRESS 0x3F896E BIT_MASK 0x800 /end MEASUREMENT
/begin MEASUREMENT te_diag_sh_to_x_sperren_b1 "TE_TV aufgrund elektr. Diag. sperren" UWORD FORMULA_0195 0 0 0.0 65535.0 ECU_ADDRESS 0x3F896E BIT_MASK 0x2000 /end MEASUREMENT
/begin MEASUREMENT te_diag_sh_to_x_sperren_b2 "TE_TV aufgrund elektr. Diag. sperren" UWORD FORMULA_0196 0 0 0.0 65535.0 ECU_ADDRESS 0x3F896E BIT_MASK 0x4000 /end MEASUREMENT
/begin MEASUREMENT te_zust_st "TE-Zustandsautomat" UWORD FORMULA_0197 0 0 0.0 65535.0 ECU_ADDRESS 0x3F8970 BIT_MASK 0x1F /end MEASUREMENT
/begin MEASUREMENT sls_obdh_st "Status des SL-Systems" UWORD FORMULA_0198 0 0 0.0 65535.0 ECU_ADDRESS 0x3F8972 /end MEASUREMENT
/begin MEASUREMENT zustand_fahrzeug "Fahrzeugzustand" UWORD FORMULA_0199 0 0 0.0 65535.0 ECU_ADDRESS 0x3F8974 /end MEASUREMENT
/begin MEASUREMENT zust_time_st "Zustandsstatus fuer CAN Zeiten" UBYTE FORMULA_0200 0 0 0.0 255.0 ECU_ADDRESS 0x3F8976 /end MEASUREMENT
/begin MEASUREMENT te_rf_ist_1of2_ "Fuellung aus Tankentlueftung" SWORD FORMULA_0007 0 0 0.0 2.0000 ECU_ADDRESS 0x3F8978 /end MEASUREMENT
/begin MEASUREMENT te_rf_ist_2of2_ "Fuellung aus Tankentlueftung" SWORD FORMULA_0007 0 0 0.0 2.0000 ECU_ADDRESS 0x3F897A /end MEASUREMENT
/begin MEASUREMENT elup_st "Status ELUP" UBYTE FORMULA_0201 0 0 0.0 255.0 ECU_ADDRESS 0x3F897C /end MEASUREMENT
/begin MEASUREMENT pksr_exd_zust_pl "Zustand Statemaschine Prueflauf" UWORD FORMULA_0202 0 0 0.0 65535.0 ECU_ADDRESS 0x3F897E /end MEASUREMENT
/begin MEASUREMENT rf_dyn "PT1 gefilterter Wert fuer dir rf Dynamik Erkennung" SWORD FORMULA_0007 0 0 0.0 2.0000 ECU_ADDRESS 0x3F899C /end MEASUREMENT
/begin MEASUREMENT rf_dyn_delta "Delta gefiltert zum ungefiltertem" SWORD FORMULA_0203 0 0 -3.2768 3.2767 ECU_ADDRESS 0x3F899E /end MEASUREMENT
/begin MEASUREMENT rf_fil_b1 "PT1 gefiltertes rf." SWORD FORMULA_0007 0 0 0.0 2.0000 ECU_ADDRESS 0x3F89A0 /end MEASUREMENT
/begin MEASUREMENT rf_fil_b2 "PT1 gefiltertes rf." SWORD FORMULA_0007 0 0 0.0 2.0000 ECU_ADDRESS 0x3F89A2 /end MEASUREMENT
/begin MEASUREMENT rf_grad_b1 "Rf Gradient." SWORD FORMULA_0204 0 0 -200.0000 200.0000 ECU_ADDRESS 0x3F89A4 /end MEASUREMENT
/begin MEASUREMENT rf_grad_b2 "Rf Gradient." SWORD FORMULA_0204 0 0 -200.0000 200.0000 ECU_ADDRESS 0x3F89A6 /end MEASUREMENT
/begin MEASUREMENT pumg "Gefilterter Messwert" SWORD FORMULA_0077 0 0 400.0000 1200.0000 ECU_ADDRESS 0x3F89A8 /end MEASUREMENT
/begin MEASUREMENT tumg "Umgebungstemperatur" SWORD FORMULA_0023 0 0 -50.0000 170.0000 ECU_ADDRESS 0x3F89B4 /end MEASUREMENT
/begin MEASUREMENT tumg_st "Status Umgebungstemperatur" UBYTE FORMULA_0205 0 0 0.0 255.0 ECU_ADDRESS 0x3F89B6 /end MEASUREMENT
/begin MEASUREMENT time_st "Status Zeiten" UBYTE FORMULA_0206 0 0 0.0 255.0 ECU_ADDRESS 0x3F89B7 /end MEASUREMENT
/begin MEASUREMENT time_rel "Relativzeit" ULONG FORMULA_0149 0 0 0.0 71582788.2500 ECU_ADDRESS 0x3F89B8 /end MEASUREMENT
/begin MEASUREMENT time_abs "Absolutzeit seit 1.1.2000" UWORD FORMULA_0207 0 0 0.0 65535.0000 ECU_ADDRESS 0x3F89BC /end MEASUREMENT
/begin MEASUREMENT can_fst_sum "Fuellstand Tank" UWORD FORMULA_0079 0 0 0.0 127.5000 ECU_ADDRESS 0x3F89BE /end MEASUREMENT
/begin MEASUREMENT can_kmst_st "Status km-Stand" UBYTE FORMULA_0208 0 0 0.0 255.0 ECU_ADDRESS 0x3F89C0 /end MEASUREMENT
/begin MEASUREMENT Oz_tempr "Rohwert �ltemperaturmessung vom Sensor" UBYTE FORMULA_0209 0 0 -54.3000 173.3999 ECU_ADDRESS 0x3F89C1 /end MEASUREMENT
/begin MEASUREMENT toel_roh_obd "Motoroeltemperatur-Rohwert vom Sensor" SWORD FORMULA_0023 0 0 -50.0000 170.0000 ECU_ADDRESS 0x3F89C2 /end MEASUREMENT
/begin MEASUREMENT slp_st "SLP Status" UWORD FORMULA_0210 0 0 0.0 65535.0 ECU_ADDRESS 0x3F89C4 /end MEASUREMENT
/begin MEASUREMENT slv_st "SLV Status" UBYTE FORMULA_0211 0 0 0.0 255.0 ECU_ADDRESS 0x3F89C6 /end MEASUREMENT
/begin MEASUREMENT v_tacho "Tachogeschwindigkeit" SWORD FORMULA_0078 0 0 -80.0000 360.0000 ECU_ADDRESS 0x3F89C8 /end MEASUREMENT
/begin MEASUREMENT can_stkombi_fgr "FGR-Info vom Kombi" UBYTE FORMULA_0212 0 0 0.0 255.0 ECU_ADDRESS 0x3F89CA /end MEASUREMENT
/begin MEASUREMENT can_stkombi_s "Schalter-Infos vom Kombi" UBYTE FORMULA_0003 0 0 0.0 255.0000 ECU_ADDRESS 0x3F89CB /end MEASUREMENT
/begin MEASUREMENT B_CAN_KOMBI_MIL "HMIL-Info vom Kombi" UBYTE FORMULA_0213 0 0 0.0 255.0 ECU_ADDRESS 0x3F89CB BIT_MASK 0x2 /end MEASUREMENT
/begin MEASUREMENT B_CAN_HBR "Handbremse" UBYTE FORMULA_0214 0 0 0.0 255.0 ECU_ADDRESS 0x3F89CB BIT_MASK 0x4 /end MEASUREMENT
/begin MEASUREMENT B_CAN_ANHAENGER "Anhaenger" UBYTE FORMULA_0215 0 0 0.0 255.0 ECU_ADDRESS 0x3F89CB BIT_MASK 0x8 /end MEASUREMENT
/begin MEASUREMENT van_exd_n_soll "Van Prueflauf LLR-Sollwert" SWORD FORMULA_0006 0 0 0.0 10000.0000 ECU_ADDRESS 0x3F89CC /end MEASUREMENT
/begin MEASUREMENT B_TE_OBD_START_EXD "Start ueber Tester" UBYTE FORMULA_0216 0 0 0.0 255.0 ECU_ADDRESS 0x3F89CE BIT_MASK 0x1 /end MEASUREMENT
/begin MEASUREMENT B_TE_OBD_PRE_CHECK "TEV-Check laeuft (bald)" UBYTE FORMULA_0217 0 0 0.0 255.0 ECU_ADDRESS 0x3F89CE BIT_MASK 0x2 /end MEASUREMENT
/begin MEASUREMENT B_TE_OBD_CHECK "TEV-Check laeuft" UBYTE FORMULA_0218 0 0 0.0 255.0 ECU_ADDRESS 0x3F89CE BIT_MASK 0x4 /end MEASUREMENT
/begin MEASUREMENT B_TE_OBD_ABBRUCH "Abbruch der LL-Messung" UBYTE FORMULA_0219 0 0 0.0 255.0 ECU_ADDRESS 0x3F89CE BIT_MASK 0x8 /end MEASUREMENT
/begin MEASUREMENT B_TE_OBD_S_BLS_OLD "Merker Bremslichtschalter" UBYTE FORMULA_0220 0 0 0.0 255.0 ECU_ADDRESS 0x3F89CE BIT_MASK 0x10 /end MEASUREMENT
/begin MEASUREMENT B_TE_OBD_KKOS_ABSCH "Abwurf KKOS wegen Fehlmessung TE_OBD" UBYTE FORMULA_0221 0 0 0.0 255.0 ECU_ADDRESS 0x3F89CE BIT_MASK 0x20 /end MEASUREMENT
/begin MEASUREMENT B_TE_OBD_LAM_REG_OFF "Abwurf Lambda Regler wegen TE_OBD" UBYTE FORMULA_0222 0 0 0.0 255.0 ECU_ADDRESS 0x3F89CE BIT_MASK 0x40 /end MEASUREMENT
/begin MEASUREMENT B_TE_OBD_KKOS_FAIL "Merker Fehler mit KKOS" UBYTE FORMULA_0223 0 0 0.0 255.0 ECU_ADDRESS 0x3F89CE BIT_MASK 0x80 /end MEASUREMENT
/begin MEASUREMENT te_obd_flags "Flags der TE_OBD" UBYTE FORMULA_0003 0 0 0.0 255.0000 ECU_ADDRESS 0x3F89CE /end MEASUREMENT
/begin MEASUREMENT lavk_obd_act_exd_n_soll "Prueflauf - angeforderte Drehzahl" SWORD FORMULA_0006 0 0 0.0 10000.0000 ECU_ADDRESS 0x3F89D0 /end MEASUREMENT
/begin MEASUREMENT lavk_obd_dyn_kat_exd_n_soll "Prueflauf - angeforderte Drehzahl" SWORD FORMULA_0006 0 0 0.0 10000.0000 ECU_ADDRESS 0x3F89D2 /end MEASUREMENT
/begin MEASUREMENT hdw_inj_st "" UBYTE FORMULA_0003 0 0 0.0 255.0000 ECU_ADDRESS 0x3F89D4 /end MEASUREMENT
/begin MEASUREMENT hdw_inj "" ULONG FORMULA_0000 0 0 0.0 4294967295.0000 ECU_ADDRESS 0x3F89D8 /end MEASUREMENT
/begin MEASUREMENT pksr_exd_md_fw_st "100Proz FW-Anforderungsstatus von PKSR" UWORD FORMULA_0010 0 0 0.0 65535.0000 ECU_ADDRESS 0x3F89DC /end MEASUREMENT
/begin MEASUREMENT sk_tr_req "Angefragte Testrechnung vom INJ" UBYTE FORMULA_0003 0 0 0.0 255.0000 ECU_ADDRESS 0x3F89DE /end MEASUREMENT
/begin MEASUREMENT sw_confg_betriebsmode_exd "vom Tester eingestellter Betriebsmode" UBYTE FORMULA_0224 0 0 0.0 255.0 ECU_ADDRESS 0x3F89DF /end MEASUREMENT
/begin MEASUREMENT ssp_st "Status SSP" UBYTE FORMULA_0225 0 0 0.0 255.0 ECU_ADDRESS 0x3F89E0 BIT_MASK 0x3 /end MEASUREMENT
/begin MEASUREMENT ssp_diag_st "Status SSP-Funktionscheck" UBYTE FORMULA_0226 0 0 0.0 255.0 ECU_ADDRESS 0x3F89E1 /end MEASUREMENT
/begin MEASUREMENT elup_ed_st "ELUP-Fehler" UBYTE FORMULA_0150 0 0 0.0 255.0 ECU_ADDRESS 0x3F89E2 /end MEASUREMENT
/begin MEASUREMENT tgetr "Getriebetemperatur" SWORD FORMULA_0023 0 0 -50.0000 190.0000 ECU_ADDRESS 0x3F89E4 /end MEASUREMENT
/begin MEASUREMENT can_toma_st "Status RadToleranz" UBYTE FORMULA_0227 0 0 0.0 255.0 ECU_ADDRESS 0x3F89E6 /end MEASUREMENT
/begin MEASUREMENT start_rl_atic39_dpr "Treiberinfo vom Startrelais" UBYTE FORMULA_0228 0 0 0.0 15.0 ECU_ADDRESS 0x3F89E8 BIT_MASK 0xF /end MEASUREMENT
/begin MEASUREMENT rf_pt_korr "Korrektur der relativen Fuellung" UWORD FORMULA_0075 0 0 0.0 4.0000 ECU_ADDRESS 0x3F89EA /end MEASUREMENT
/begin MEASUREMENT rf_pt_korr_zyl "Korrektur der relativen Fuellung im Zylinder" UWORD FORMULA_0075 0 0 0.0 4.0000 ECU_ADDRESS 0x3F89EC /end MEASUREMENT
/begin MEASUREMENT ti_zyl_tz "Zylinder selektive Abschaltung von TI und TZ" UWORD FORMULA_0083 0 0 0.0 65535.0000 ECU_ADDRESS 0x3F89EE /end MEASUREMENT
/begin MEASUREMENT van_exd_st "Diagnosestatus Vanos" UBYTE FORMULA_0229 0 0 0.0 255.0 ECU_ADDRESS 0x3F89F0 /end MEASUREMENT
/begin MEASUREMENT B_VAN_SK "Notprogramm wegen Vanos" UBYTE FORMULA_0230 0 0 0.0 255.0 ECU_ADDRESS 0x3F89F1 BIT_MASK 0x1 /end MEASUREMENT
/begin MEASUREMENT van_sk_st "Status Notprogramm wegen Vanos" UBYTE FORMULA_0003 0 0 0.0 255.0000 ECU_ADDRESS 0x3F89F1 /end MEASUREMENT
/begin MEASUREMENT ccp_fp_st_inj "Status CCP-FP" UBYTE FORMULA_0231 0 0 0.0 255.0 ECU_ADDRESS 0x3F89F2 /end MEASUREMENT
/begin MEASUREMENT kwp_fp_st_inj "Status KWP-FP" UBYTE FORMULA_0003 0 0 0.0 255.0000 ECU_ADDRESS 0x3F89F3 /end MEASUREMENT
/begin MEASUREMENT exd_tester_timeout "Testertimeout" UBYTE FORMULA_0232 0 0 0.0 255.0000 ECU_ADDRESS 0x3F89F4 /end MEASUREMENT
/begin MEASUREMENT mdrv_st_dsc_akt "MDRV-Status DSC (CAN)" UBYTE FORMULA_0233 0 0 0.0 255.0 ECU_ADDRESS 0x3F89F5 /end MEASUREMENT
/begin MEASUREMENT mdrv_st_mod_smg_akt "MDRV-Status SMG (CAN)" UBYTE FORMULA_0234 0 0 0.0 255.0 ECU_ADDRESS 0x3F89F6 /end MEASUREMENT
/begin MEASUREMENT mdrv_st_stg_smg_akt "MDRV-Status Drivelogic (CAN)" UBYTE FORMULA_0235 0 0 0.0 255.0 ECU_ADDRESS 0x3F89F7 /end MEASUREMENT
/begin MEASUREMENT mdrv_st_mod_eng_akt "MDRV-Status Motor (CAN)" UBYTE FORMULA_0236 0 0 0.0 255.0 ECU_ADDRESS 0x3F89F8 /end MEASUREMENT
/begin MEASUREMENT mdrv_st_mod_edck_akt "MDRV-Status EDCK (CAN)" UBYTE FORMULA_0237 0 0 0.0 255.0 ECU_ADDRESS 0x3F89F9 /end MEASUREMENT
/begin MEASUREMENT mdrv_st_mod_albv_akt "MDRV-Status aLBV (CAN)" UBYTE FORMULA_0237 0 0 0.0 255.0 ECU_ADDRESS 0x3F89FA /end MEASUREMENT
/begin MEASUREMENT mdrv_st_mod_hud_akt "MDRV-Status HUD (CAN)" UBYTE FORMULA_0238 0 0 0.0 255.0 ECU_ADDRESS 0x3F89FB /end MEASUREMENT
/begin MEASUREMENT v_max_schw_direkt "Maximalgeschwindigkeit" SWORD FORMULA_0078 0 0 -80.0000 360.0000 ECU_ADDRESS 0x3F89FC /end MEASUREMENT
/begin MEASUREMENT v_max_schw_can "Maximalgeschwindigkeit" SWORD FORMULA_0078 0 0 -80.0000 360.0000 ECU_ADDRESS 0x3F89FE /end MEASUREMENT
/begin MEASUREMENT v_max_anh_st "Status v_max-Anhebung durch CAS bzw. Nachruestung" UBYTE FORMULA_0239 0 0 0.0 255.0 ECU_ADDRESS 0x3F8A00 /end MEASUREMENT
/begin MEASUREMENT can_gang_r "Empfangsstatus StatR" UBYTE FORMULA_0240 0 0 0.0 255.0 ECU_ADDRESS 0x3F8A01 /end MEASUREMENT
/begin MEASUREMENT rps_tz_offs_1of10_ "RPS-TZ-Offset" SWORD FORMULA_0111 0 0 -50.0000 60.0000 ECU_ADDRESS 0x3F8A02 /end MEASUREMENT
/begin MEASUREMENT rps_tz_offs_2of10_ "RPS-TZ-Offset" SWORD FORMULA_0111 0 0 -50.0000 60.0000 ECU_ADDRESS 0x3F8A04 /end MEASUREMENT
/begin MEASUREMENT rps_tz_offs_3of10_ "RPS-TZ-Offset" SWORD FORMULA_0111 0 0 -50.0000 60.0000 ECU_ADDRESS 0x3F8A06 /end MEASUREMENT
/begin MEASUREMENT rps_tz_offs_4of10_ "RPS-TZ-Offset" SWORD FORMULA_0111 0 0 -50.0000 60.0000 ECU_ADDRESS 0x3F8A08 /end MEASUREMENT
/begin MEASUREMENT rps_tz_offs_5of10_ "RPS-TZ-Offset" SWORD FORMULA_0111 0 0 -50.0000 60.0000 ECU_ADDRESS 0x3F8A0A /end MEASUREMENT
/begin MEASUREMENT rps_tz_offs_6of10_ "RPS-TZ-Offset" SWORD FORMULA_0111 0 0 -50.0000 60.0000 ECU_ADDRESS 0x3F8A0C /end MEASUREMENT
/begin MEASUREMENT rps_tz_offs_7of10_ "RPS-TZ-Offset" SWORD FORMULA_0111 0 0 -50.0000 60.0000 ECU_ADDRESS 0x3F8A0E /end MEASUREMENT
/begin MEASUREMENT rps_tz_offs_8of10_ "RPS-TZ-Offset" SWORD FORMULA_0111 0 0 -50.0000 60.0000 ECU_ADDRESS 0x3F8A10 /end MEASUREMENT
/begin MEASUREMENT rps_tz_offs_9of10_ "RPS-TZ-Offset" SWORD FORMULA_0111 0 0 -50.0000 60.0000 ECU_ADDRESS 0x3F8A12 /end MEASUREMENT
/begin MEASUREMENT rps_tz_offs_10of10_ "RPS-TZ-Offset" SWORD FORMULA_0111 0 0 -50.0000 60.0000 ECU_ADDRESS 0x3F8A14 /end MEASUREMENT
/begin MEASUREMENT msg_rec_cc "Status" UBYTE FORMULA_0003 0 0 0.0 255.0000 ECU_ADDRESS 0x3F8A16 /end MEASUREMENT
/begin MEASUREMENT msg_rec_cc_dsc "Status - DSC" UBYTE FORMULA_0241 0 0 0.0 255.0 ECU_ADDRESS 0x3F8A16 BIT_MASK 0x1 /end MEASUREMENT
/begin MEASUREMENT can_obd_tumg_ed "Fehlerart Tumg" UBYTE FORMULA_0242 0 0 0.0 255.0 ECU_ADDRESS 0x3F8A17 /end MEASUREMENT
/begin MEASUREMENT can_obd_fst_li_ed "Fehlerart Fst links" UBYTE FORMULA_0242 0 0 0.0 255.0 ECU_ADDRESS 0x3F8A18 /end MEASUREMENT
/begin MEASUREMENT can_obd_fst_re_ed "Fehlerart Fst rechts" UBYTE FORMULA_0242 0 0 0.0 255.0 ECU_ADDRESS 0x3F8A19 /end MEASUREMENT
/begin MEASUREMENT can_obd_tumg_roh "Rohdaten Tumg" UBYTE FORMULA_0033 0 0 0.0 255.0000 ECU_ADDRESS 0x3F8A1A /end MEASUREMENT
/begin MEASUREMENT can_obd_fst_li_roh "Rohdaten Fst links" UWORD FORMULA_0083 0 0 0.0 65535.0000 ECU_ADDRESS 0x3F8A1C /end MEASUREMENT
/begin MEASUREMENT can_obd_fst_re_roh "Rohdaten Fst rechts" UWORD FORMULA_0083 0 0 0.0 65535.0000 ECU_ADDRESS 0x3F8A1E /end MEASUREMENT
/begin MEASUREMENT k2KB_req_inj "KWP" UBYTE FORMULA_0003 0 0 0.0 255.0000 ECU_ADDRESS 0x3F8A20 /end MEASUREMENT
/begin MEASUREMENT tz_zyl_ti "Zylinder selektive Abschaltung der Einspritzung" UWORD FORMULA_0083 0 0 0.0 65535.0000 ECU_ADDRESS 0x3F8544 /end MEASUREMENT
/begin MEASUREMENT ka_dtz_sum_all "Summenzuendwinkelverstellung KA" SWORD FORMULA_0111 0 0 -100.0000 100.0000 ECU_ADDRESS 0x3F8546 /end MEASUREMENT
/begin MEASUREMENT ka_dtz_sum_b1 "Summenzuendwinkelverstellung KA pro Bank" SWORD FORMULA_0111 0 0 -100.0000 100.0000 ECU_ADDRESS 0x3F8548 /end MEASUREMENT
/begin MEASUREMENT ka_dtz_sum_b2 "Summenzuendwinkelverstellung KA pro Bank" SWORD FORMULA_0111 0 0 -100.0000 100.0000 ECU_ADDRESS 0x3F854A /end MEASUREMENT
/begin MEASUREMENT ka_tz_nv_sum_all "Summenklopfadaptionrueckziehwinkel KA" SLONG FORMULA_0243 0 0 -100.0000 100.0000 ECU_ADDRESS 0x3F854C /end MEASUREMENT
/begin MEASUREMENT ka_tz_nv_sum_b1 "Summenklopfadaptionrueckziehwinkel KA pro Bank" SLONG FORMULA_0243 0 0 -100.0000 100.0000 ECU_ADDRESS 0x3F8550 /end MEASUREMENT
/begin MEASUREMENT ka_tz_nv_sum_b2 "Summenklopfadaptionrueckziehwinkel KA pro Bank" SLONG FORMULA_0243 0 0 -100.0000 100.0000 ECU_ADDRESS 0x3F8554 /end MEASUREMENT
/begin MEASUREMENT kr_dtz_sum_b1 "Bankselektiver Klopfregelungseingriffsumme." SLONG FORMULA_0244 0 0 -100.0000 100.0000 ECU_ADDRESS 0x3F8558 /end MEASUREMENT
/begin MEASUREMENT kr_dtz_sum_b2 "Bankselektiver Klopfregelungseingriffsumme." SLONG FORMULA_0244 0 0 -100.0000 100.0000 ECU_ADDRESS 0x3F855C /end MEASUREMENT
/begin MEASUREMENT tz_ve_mw "mittlerer Zuendwinkel ohne Momenteneingriff" SWORD FORMULA_0111 0 0 -50.0000 60.0000 ECU_ADDRESS 0x3F8560 /end MEASUREMENT
/begin MEASUREMENT auss_lp_int_sum_b1 "Summe TP-Integral-Leitwert im Aussetzerfenster." SWORD FORMULA_0245 0 0 0.0 20.0000 ECU_ADDRESS 0x3F8562 /end MEASUREMENT
/begin MEASUREMENT auss_lp_int_sum_b2 "Summe TP-Integral-Leitwert im Aussetzerfenster." SWORD FORMULA_0245 0 0 0.0 20.0000 ECU_ADDRESS 0x3F8564 /end MEASUREMENT
/begin MEASUREMENT auss_st_b1 "Zustandsvariable Aussetzererkennung." UWORD FORMULA_0246 0 0 0.0 65535.0 ECU_ADDRESS 0x3F8566 BIT_MASK 0x187 /end MEASUREMENT
/begin MEASUREMENT auss_st_b2 "Zustandsvariable Aussetzererkennung." UWORD FORMULA_0246 0 0 0.0 65535.0 ECU_ADDRESS 0x3F8568 BIT_MASK 0x187 /end MEASUREMENT
/begin MEASUREMENT auss_st_ti_b1 "Zustandsvariable Verbrennungsaussetzererkennung." UWORD FORMULA_0247 0 0 0.0 65535.0 ECU_ADDRESS 0x3F8566 BIT_MASK 0xF5FF /end MEASUREMENT
/begin MEASUREMENT auss_st_ti_b2 "Zustandsvariable Verbrennungsaussetzererkennung." UWORD FORMULA_0247 0 0 0.0 65535.0 ECU_ADDRESS 0x3F8568 BIT_MASK 0xF5FF /end MEASUREMENT
/begin MEASUREMENT auss_st_ns_b1 "Zustandsvariable Nebenschlusserkennung." UWORD FORMULA_0248 0 0 0.0 65535.0 ECU_ADDRESS 0x3F8566 BIT_MASK 0xBBFF /end MEASUREMENT
/begin MEASUREMENT auss_st_ns_b2 "Zustandsvariable Nebenschlusserkennung." UWORD FORMULA_0248 0 0 0.0 65535.0 ECU_ADDRESS 0x3F8568 BIT_MASK 0xBBFF /end MEASUREMENT
/begin MEASUREMENT auss_nw_sync_b1 "Zaehler NW Sync Ok ueber Ionenstrom." UBYTE FORMULA_0003 0 0 0.0 255.0000 ECU_ADDRESS 0x3F856A /end MEASUREMENT
/begin MEASUREMENT auss_nw_sync_b2 "Zaehler NW Sync Ok ueber Ionenstrom." UBYTE FORMULA_0003 0 0 0.0 255.0000 ECU_ADDRESS 0x3F856B /end MEASUREMENT
/begin MEASUREMENT tz_grad_b1 "Zuendwinkelgradient pro Bank" SWORD FORMULA_0249 0 0 -100.0000 100.0000 ECU_ADDRESS 0x3F856C /end MEASUREMENT
/begin MEASUREMENT tz_grad_b2 "Zuendwinkelgradient pro Bank" SWORD FORMULA_0249 0 0 -100.0000 100.0000 ECU_ADDRESS 0x3F856E /end MEASUREMENT
/begin MEASUREMENT md_kupp_ist_ve "Moment an der Kupplung vor Eingriff" SWORD FORMULA_0009 0 0 -100.0000 1000.0000 ECU_ADDRESS 0x3F8570 /end MEASUREMENT
/begin MEASUREMENT md_kupp_ist "Moment an der Kupplung" SWORD FORMULA_0009 0 0 -100.0000 1000.0000 ECU_ADDRESS 0x3F8572 /end MEASUREMENT
/begin MEASUREMENT md_ind_ne "ind. Moment nach Eingriff" SWORD FORMULA_0009 0 0 -100.0000 1000.0000 ECU_ADDRESS 0x3F8574 /end MEASUREMENT
/begin MEASUREMENT md_kkos_fil "MD-Anf KKOS nach Filter" SWORD FORMULA_0009 0 0 -100.0000 1000.0000 ECU_ADDRESS 0x3F8576 /end MEASUREMENT
/begin MEASUREMENT md_tz_soll_mittel "mittlerer Soll-TZ" SWORD FORMULA_0111 0 0 -50.0000 60.0000 ECU_ADDRESS 0x3F8578 /end MEASUREMENT
/begin MEASUREMENT auss_erk "Zustandsvariable Aussetzererkennung." UWORD FORMULA_0250 0 0 0.0 4095.0 ECU_ADDRESS 0x3F857A /end MEASUREMENT
/begin MEASUREMENT auss_erk_zyl1 "Aussetzererkennung Zylinder 1." UWORD FORMULA_0251 0 0 0.0 1.0 ECU_ADDRESS 0x3F857A BIT_MASK 0x1 /end MEASUREMENT
/begin MEASUREMENT auss_erk_zyl2 "Aussetzererkennung Zylinder 2." UWORD FORMULA_0252 0 0 0.0 1.0 ECU_ADDRESS 0x3F857A BIT_MASK 0x2 /end MEASUREMENT
/begin MEASUREMENT auss_erk_zyl3 "Aussetzererkennung Zylinder 3." UWORD FORMULA_0253 0 0 0.0 1.0 ECU_ADDRESS 0x3F857A BIT_MASK 0x4 /end MEASUREMENT
/begin MEASUREMENT auss_erk_zyl4 "Aussetzererkennung Zylinder 4." UWORD FORMULA_0254 0 0 0.0 1.0 ECU_ADDRESS 0x3F857A BIT_MASK 0x8 /end MEASUREMENT
/begin MEASUREMENT auss_erk_zyl5 "Aussetzererkennung Zylinder 5." UWORD FORMULA_0255 0 0 0.0 1.0 ECU_ADDRESS 0x3F857A BIT_MASK 0x10 /end MEASUREMENT
/begin MEASUREMENT auss_erk_zyl6 "Aussetzererkennung Zylinder 6." UWORD FORMULA_0256 0 0 0.0 1.0 ECU_ADDRESS 0x3F857A BIT_MASK 0x20 /end MEASUREMENT
/begin MEASUREMENT auss_erk_zyl7 "Aussetzererkennung Zylinder 7." UWORD FORMULA_0257 0 0 0.0 1.0 ECU_ADDRESS 0x3F857A BIT_MASK 0x40 /end MEASUREMENT
/begin MEASUREMENT auss_erk_zyl8 "Aussetzererkennung Zylinder 8." UWORD FORMULA_0258 0 0 0.0 1.0 ECU_ADDRESS 0x3F857A BIT_MASK 0x80 /end MEASUREMENT
/begin MEASUREMENT auss_erk_zyl9 "Aussetzererkennung Zylinder 9." UWORD FORMULA_0259 0 0 0.0 1.0 ECU_ADDRESS 0x3F857A BIT_MASK 0x100 /end MEASUREMENT
/begin MEASUREMENT auss_erk_zyl10 "Aussetzererkennung Zylinder 10." UWORD FORMULA_0260 0 0 0.0 1.0 ECU_ADDRESS 0x3F857A BIT_MASK 0x200 /end MEASUREMENT
/begin MEASUREMENT kh_lam_soll_b1 "SOLL-Lambda - KAT-Heizen" UWORD FORMULA_0025 0 0 0.0 3.9990 ECU_ADDRESS 0x3F857C /end MEASUREMENT
/begin MEASUREMENT kh_lam_soll_b2 "SOLL-Lambda - KAT-Heizen" UWORD FORMULA_0025 0 0 0.0 3.9990 ECU_ADDRESS 0x3F857E /end MEASUREMENT
/begin MEASUREMENT tz_diag_tpu_err "Tigger fuer Fehleranfilterung bei TPU Dauerbestromung." UWORD FORMULA_0010 0 0 0.0 65535.0000 ECU_ADDRESS 0x3F8580 /end MEASUREMENT
/begin MEASUREMENT llr_state "LLR-Zustand" UBYTE FORMULA_0261 0 0 0.0 255.0 ECU_ADDRESS 0x3F85A6 /end MEASUREMENT
/begin MEASUREMENT llr_flags "LLR-Flags" UBYTE FORMULA_0003 0 0 0.0 255.0000 ECU_ADDRESS 0x3F85A7 /end MEASUREMENT
/begin MEASUREMENT B_LLR_EINGEREGELT "Status eingeregelt" UBYTE FORMULA_0262 0 0 0.0 255.0 ECU_ADDRESS 0x3F85A7 BIT_MASK 0x1 /end MEASUREMENT
/begin MEASUREMENT B_LLR_MIN_BEGR "Begrenzung Min-Moment" UBYTE FORMULA_0263 0 0 0.0 255.0 ECU_ADDRESS 0x3F85A7 BIT_MASK 0x2 /end MEASUREMENT
/begin MEASUREMENT B_LLR_GRUNDDREHZAHL "Grunddrehzahl aktiv" UBYTE FORMULA_0264 0 0 0.0 255.0 ECU_ADDRESS 0x3F85A7 BIT_MASK 0x4 /end MEASUREMENT
/begin MEASUREMENT uext_pin_111_219_514 "Versorgungsspannung" UWORD FORMULA_0265 0 0 0.0 6.6665 ECU_ADDRESS 0x3F85A8 /end MEASUREMENT
/begin MEASUREMENT uext_pin_124_512 "Versorgungsspannung" UWORD FORMULA_0265 0 0 0.0 6.6665 ECU_ADDRESS 0x3F85AA /end MEASUREMENT
/begin MEASUREMENT uext_korr_pin_111_219_514 "Korrekturfaktor fuer UEXT" UWORD FORMULA_0075 0 0 0.0 4.0000 ECU_ADDRESS 0x3F85AC /end MEASUREMENT
/begin MEASUREMENT uext_korr_pin_124_512 "Korrekturfaktor fuer UEXT" UWORD FORMULA_0075 0 0 0.0 4.0000 ECU_ADDRESS 0x3F85AE /end MEASUREMENT
/begin MEASUREMENT pwg_kd_st "Kickdown-Status" UBYTE FORMULA_0003 0 0 0.0 255.0000 ECU_ADDRESS 0x3F85B0 BIT_MASK 0x1 /end MEASUREMENT
/begin MEASUREMENT pwg_kd_st_kickdown "Kickdown-Status" UBYTE FORMULA_0266 0 0 0.0 255.0 ECU_ADDRESS 0x3F85B0 BIT_MASK 0x1 /end MEASUREMENT
/begin MEASUREMENT pwg_mode "Ausgabezustand der Pedalwertgebererfassung" UBYTE FORMULA_0267 0 0 0.0 255.0 ECU_ADDRESS 0x3F85B1 /end MEASUREMENT
/begin MEASUREMENT pwg_soll "Ausgegebener Pedalwert fuer andere Module" SWORD FORMULA_0001 0 0 -10.0000 120.0000 ECU_ADDRESS 0x3F85B2 /end MEASUREMENT
/begin MEASUREMENT pwg1_abs_obd_mode_1_2 "Ausgabe SCAN_TOOL" UBYTE FORMULA_0065 0 0 0.0 100.0000 ECU_ADDRESS 0x3F85B4 /end MEASUREMENT
/begin MEASUREMENT pwg2_abs_obd_mode_1_2 "Ausgabe SCAN_TOOL" UBYTE FORMULA_0065 0 0 0.0 100.0000 ECU_ADDRESS 0x3F85B5 /end MEASUREMENT
/begin MEASUREMENT md_fw_rel "rel. Wunschmoment" SWORD FORMULA_0001 0 0 0.0 100.0000 ECU_ADDRESS 0x3F85BA /end MEASUREMENT
/begin MEASUREMENT md_wunsch_rel "Ergebnis der Max-Auswahl" SWORD FORMULA_0001 0 0 0.0 100.0000 ECU_ADDRESS 0x3F85BC /end MEASUREMENT
/begin MEASUREMENT md_kupp_wunsch "Wunschmoment" SWORD FORMULA_0009 0 0 -100.0000 1000.0000 ECU_ADDRESS 0x3F85BE /end MEASUREMENT
/begin MEASUREMENT md_kupp_wunsch_begr "begrenztes Wunschmoment fuer CAN" SWORD FORMULA_0009 0 0 -100.0000 1000.0000 ECU_ADDRESS 0x3F85C0 /end MEASUREMENT
/begin MEASUREMENT md_kupp_wunsch_filter_rel "gefiltertes Wunschmoment" SWORD FORMULA_0001 0 0 0.0 100.0000 ECU_ADDRESS 0x3F85C2 /end MEASUREMENT
/begin MEASUREMENT md_kupp_wunsch_tz "Wunschmoment fuer den Zuendwinkelpfad" SWORD FORMULA_0009 0 0 -100.0000 1000.0000 ECU_ADDRESS 0x3F85C4 /end MEASUREMENT
/begin MEASUREMENT md_max_fak_power "Powerfaktor" UWORD FORMULA_0075 0 0 0.0 4.0000 ECU_ADDRESS 0x3F85C6 /end MEASUREMENT
/begin MEASUREMENT md_st "MD-Stati" UWORD FORMULA_0010 0 0 0.0 65535.0000 ECU_ADDRESS 0x3F85C8 /end MEASUREMENT
/begin MEASUREMENT md_nbegr_t "Zeit im Begrenzer" UWORD FORMULA_0117 0 0 0.0 325.0000 ECU_ADDRESS 0x3F85CA /end MEASUREMENT
/begin MEASUREMENT md_can_begr_st "MD-Begrenzungen" UBYTE FORMULA_0268 0 0 0.0 255.0 ECU_ADDRESS 0x3F85CC /end MEASUREMENT
/begin MEASUREMENT md_dsc_sperr_st "Sperre DSC-Eingriff" UBYTE FORMULA_0269 0 0 0.0 255.0 ECU_ADDRESS 0x3F85CD /end MEASUREMENT
/begin MEASUREMENT md_can_kkos_max "max. Moment fuer KKOS" SWORD FORMULA_0009 0 0 -100.0000 1000.0000 ECU_ADDRESS 0x3F85CE /end MEASUREMENT
/begin MEASUREMENT md_vbegr_st "Status v-Begrenzung" UBYTE FORMULA_0270 0 0 0.0 255.0 ECU_ADDRESS 0x3F85D0 /end MEASUREMENT
/begin MEASUREMENT md_nbegr_st "Status n-Begrenzung" UBYTE FORMULA_0271 0 0 0.0 255.0 ECU_ADDRESS 0x3F85D1 /end MEASUREMENT
/begin MEASUREMENT md_fw_bls "Eingriff BLS-Fahrerwunsch" UBYTE FORMULA_0272 0 0 0.0 255.0 ECU_ADDRESS 0x3F85D2 /end MEASUREMENT
/begin MEASUREMENT egas_soll_dk_b1 "DK-Sollwert" SWORD FORMULA_0001 0 0 -10.0000 120.0000 ECU_ADDRESS 0x3F85D4 /end MEASUREMENT
/begin MEASUREMENT egas_soll_dk_b2 "DK-Sollwert" SWORD FORMULA_0001 0 0 -10.0000 120.0000 ECU_ADDRESS 0x3F85D6 /end MEASUREMENT
/begin MEASUREMENT egas_soll_lls_b1 "LLS-Sollwert" SWORD FORMULA_0001 0 0 -10.0000 120.0000 ECU_ADDRESS 0x3F85D8 /end MEASUREMENT
/begin MEASUREMENT egas_soll_lls_b2 "LLS-Sollwert" SWORD FORMULA_0001 0 0 -10.0000 120.0000 ECU_ADDRESS 0x3F85DA /end MEASUREMENT
/begin MEASUREMENT egas_ist_dk_b1 "Istwert (CAN)" SWORD FORMULA_0001 0 0 -10.0000 120.0000 ECU_ADDRESS 0x3F85DC /end MEASUREMENT
/begin MEASUREMENT egas_ist_dk_b2 "Istwert (CAN)" SWORD FORMULA_0001 0 0 -10.0000 120.0000 ECU_ADDRESS 0x3F85DE /end MEASUREMENT
/begin MEASUREMENT egas_ist_lls_b1 "Istwert (CAN)" SWORD FORMULA_0001 0 0 -10.0000 120.0000 ECU_ADDRESS 0x3F85E0 /end MEASUREMENT
/begin MEASUREMENT egas_ist_lls_b2 "Istwert (CAN)" SWORD FORMULA_0001 0 0 -10.0000 120.0000 ECU_ADDRESS 0x3F85E2 /end MEASUREMENT
/begin MEASUREMENT egas_wdk1_abs_obd_mode_1_2 "Ausgabe SCAN_TOOL" UBYTE FORMULA_0065 0 0 0.0 100.0000 ECU_ADDRESS 0x3F85E4 /end MEASUREMENT
/begin MEASUREMENT egas_st_b1 "DPR-Status" UBYTE FORMULA_0003 0 0 0.0 255.0000 ECU_ADDRESS 0x3F85E5 /end MEASUREMENT
/begin MEASUREMENT egas_st_b2 "DPR-Status" UBYTE FORMULA_0003 0 0 0.0 255.0000 ECU_ADDRESS 0x3F85E6 /end MEASUREMENT
/begin MEASUREMENT egas_st_ft_b1 "Status Federntest" UBYTE FORMULA_0273 0 0 0.0 255.0 ECU_ADDRESS 0x3F85E5 BIT_MASK 0x1 /end MEASUREMENT
/begin MEASUREMENT egas_st_ft_b2 "Status Federntest" UBYTE FORMULA_0273 0 0 0.0 255.0 ECU_ADDRESS 0x3F85E6 BIT_MASK 0x1 /end MEASUREMENT
/begin MEASUREMENT egas_st_dk_b1 "Status Klappen" UBYTE FORMULA_0274 0 0 0.0 255.0 ECU_ADDRESS 0x3F85E5 BIT_MASK 0xC /end MEASUREMENT
/begin MEASUREMENT egas_st_dk_b2 "Status Klappen" UBYTE FORMULA_0274 0 0 0.0 255.0 ECU_ADDRESS 0x3F85E6 BIT_MASK 0xC /end MEASUREMENT
/begin MEASUREMENT egas_sk_ti_st "SK-Ausblendmaske vom Egas" UWORD FORMULA_0010 0 0 0.0 65535.0000 ECU_ADDRESS 0x3F85E8 /end MEASUREMENT
/begin MEASUREMENT egas_aq_soll_roh_1of2_ "AQ-Soll Rohwert" UWORD FORMULA_0147 0 0 0.0 6500.0000 ECU_ADDRESS 0x3F85EA /end MEASUREMENT
/begin MEASUREMENT egas_aq_soll_roh_2of2_ "AQ-Soll Rohwert" UWORD FORMULA_0147 0 0 0.0 6500.0000 ECU_ADDRESS 0x3F85EC /end MEASUREMENT
/begin MEASUREMENT aq_rf_b1 "Fuellung aus inv. Ipol gefiltert mit alle korrekturen" SWORD FORMULA_0007 0 0 0.0 2.0000 ECU_ADDRESS 0x3F85EE /end MEASUREMENT
/begin MEASUREMENT aq_rf_b2 "Fuellung aus inv. Ipol gefiltert mit alle korrekturen" SWORD FORMULA_0007 0 0 0.0 2.0000 ECU_ADDRESS 0x3F85F0 /end MEASUREMENT
/begin MEASUREMENT md_dsc_freig_st "DSC-Freigabe" UBYTE FORMULA_0275 0 0 0.0 255.0 ECU_ADDRESS 0x3F85F2 /end MEASUREMENT
/begin MEASUREMENT dr_rel_b1 "relative Drosselung" SWORD FORMULA_0115 0 0 0.0 199.9938 ECU_ADDRESS 0x3F85F4 /end MEASUREMENT
/begin MEASUREMENT dr_rel_b2 "relative Drosselung" SWORD FORMULA_0115 0 0 0.0 199.9938 ECU_ADDRESS 0x3F85F6 /end MEASUREMENT
/begin MEASUREMENT aq_rel_1of2_ "relative Oeffnungsquerschnitt" UWORD FORMULA_0115 0 0 0.0 200.0000 ECU_ADDRESS 0x3F85F8 /end MEASUREMENT
/begin MEASUREMENT aq_rel_2of2_ "relative Oeffnungsquerschnitt" UWORD FORMULA_0115 0 0 0.0 200.0000 ECU_ADDRESS 0x3F85FA /end MEASUREMENT
/begin MEASUREMENT md_ml_soll "Soll-Luftmasse" SWORD FORMULA_0112 0 0 -100.0000 1400.0000 ECU_ADDRESS 0x3F85FC /end MEASUREMENT
/begin MEASUREMENT dr_rel_grad_b1 "dr_rel gradient" SWORD FORMULA_0276 0 0 -655000.0000 655000.0000 ECU_ADDRESS 0x3F85FE /end MEASUREMENT
/begin MEASUREMENT dr_rel_grad_b2 "dr_rel gradient" SWORD FORMULA_0276 0 0 -655000.0000 655000.0000 ECU_ADDRESS 0x3F8600 /end MEASUREMENT
/begin MEASUREMENT evap_wdk_ist_b1 "Istwert-EVAP" SWORD FORMULA_0001 0 0 -10.0000 120.0000 ECU_ADDRESS 0x3F8602 /end MEASUREMENT
/begin MEASUREMENT evap_wdk_ist_b2 "Istwert-EVAP" SWORD FORMULA_0001 0 0 -10.0000 120.0000 ECU_ADDRESS 0x3F8604 /end MEASUREMENT
/begin MEASUREMENT ub "Spannungswert U_KL87" SWORD FORMULA_0008 0 0 0.0 28.0000 ECU_ADDRESS 0x3F8606 /end MEASUREMENT
/begin MEASUREMENT ub_roh "Rohwert der U_KL87-Erfassung" SWORD FORMULA_0277 0 0 0.0 28.0000 ECU_ADDRESS 0x3F8608 /end MEASUREMENT
/begin MEASUREMENT u_wakeup "Spannungswert Wakeup" SWORD FORMULA_0008 0 0 0.0 28.0000 ECU_ADDRESS 0x3F860A /end MEASUREMENT
/begin MEASUREMENT smg_ax_mess_filter "ax_mess gefiltert" SWORD FORMULA_0132 0 0 -20.0000 20.0000 ECU_ADDRESS 0x3F860C /end MEASUREMENT
/begin MEASUREMENT smg_can_error "Fehlerbits" UBYTE FORMULA_0278 0 0 0.0 255.0 ECU_ADDRESS 0x3F860E /end MEASUREMENT
/begin MEASUREMENT smg_can_n_getr_ziel "Getriebezieldrehzahl" SWORD FORMULA_0006 0 0 0.0 10000.0000 ECU_ADDRESS 0x3F8610 /end MEASUREMENT
/begin MEASUREMENT smg_can_n_getr_ein "Getriebeeingangsdrehzahl" SWORD FORMULA_0006 0 0 0.0 10000.0000 ECU_ADDRESS 0x3F8612 /end MEASUREMENT
/begin MEASUREMENT smg_can_prog_info "Programminfo" UBYTE FORMULA_0279 0 0 0.0 255.0000 ECU_ADDRESS 0x3F8614 /end MEASUREMENT
/begin MEASUREMENT smg_can_flags "Allg. CAN-Flags" UBYTE FORMULA_0003 0 0 0.0 255.0000 ECU_ADDRESS 0x3F8615 /end MEASUREMENT
/begin MEASUREMENT smg_can_flags_kl87 "KL87 durch SMG ein" UBYTE FORMULA_0280 0 0 0.0 255.0 ECU_ADDRESS 0x3F8615 BIT_MASK 0x1 /end MEASUREMENT
/begin MEASUREMENT smg_can_flags_mm "Status MM-SMG" UBYTE FORMULA_0281 0 0 0.0 255.0 ECU_ADDRESS 0x3F8615 BIT_MASK 0x2 /end MEASUREMENT
/begin MEASUREMENT egas_ist_wdk_b1 "Istwert (analog)" SWORD FORMULA_0001 0 0 -10.0000 120.0000 ECU_ADDRESS 0x3F8616 /end MEASUREMENT
/begin MEASUREMENT egas_ist_wdk_b2 "Istwert (analog)" SWORD FORMULA_0001 0 0 -10.0000 120.0000 ECU_ADDRESS 0x3F8618 /end MEASUREMENT
/begin MEASUREMENT egas_wdk_adapt_b1 "Adaptionsstatus" UBYTE FORMULA_0282 0 0 0.0 255.0 ECU_ADDRESS 0x3F861A /end MEASUREMENT
/begin MEASUREMENT egas_wdk_adapt_b2 "Adaptionsstatus" UBYTE FORMULA_0282 0 0 0.0 255.0 ECU_ADDRESS 0x3F861B /end MEASUREMENT
/begin MEASUREMENT smg_st_mot "SMG-Motoreingriff" UBYTE FORMULA_0283 0 0 0.0 255.0 ECU_ADDRESS 0x3F861C BIT_MASK 0xF /end MEASUREMENT
/begin MEASUREMENT smg_st_mot_ti "SMG-TI-Eingriff" UBYTE FORMULA_0284 0 0 0.0 255.0 ECU_ADDRESS 0x3F861C BIT_MASK 0x20 /end MEASUREMENT
/begin MEASUREMENT smg_st_mot_tl "SMG-TL-Eingriff" UBYTE FORMULA_0285 0 0 0.0 255.0 ECU_ADDRESS 0x3F861C BIT_MASK 0x40 /end MEASUREMENT
/begin MEASUREMENT smg_st_mot_sa "SMG-SA-Sperre" UBYTE FORMULA_0286 0 0 0.0 255.0 ECU_ADDRESS 0x3F861C BIT_MASK 0x80 /end MEASUREMENT
/begin MEASUREMENT smg_can_modul "Modulstatus" UBYTE FORMULA_0287 0 0 0.0 255.0 ECU_ADDRESS 0x3F861D /end MEASUREMENT
/begin MEASUREMENT aq_eingeregelt_st "Status AQ eingeregelt" UBYTE FORMULA_0003 0 0 0.0 255.0000 ECU_ADDRESS 0x3F861E /end MEASUREMENT
/begin MEASUREMENT egas_aq_soll_grad_b1 "Gradient AQ-Soll" SWORD FORMULA_0020 0 0 -30000.0000 30000.0000 ECU_ADDRESS 0x3F8620 /end MEASUREMENT
/begin MEASUREMENT egas_aq_soll_grad_b2 "Gradient AQ-Soll" SWORD FORMULA_0020 0 0 -30000.0000 30000.0000 ECU_ADDRESS 0x3F8622 /end MEASUREMENT
/begin MEASUREMENT egas_aq_soll_b1 "AQ-Soll mit Fuellungsadaption und sek. Einfluessen" UWORD FORMULA_0147 0 0 0.0 6500.0000 ECU_ADDRESS 0x3F8624 /end MEASUREMENT
/begin MEASUREMENT egas_aq_soll_b2 "AQ-Soll mit Fuellungsadaption und sek. Einfluessen" UWORD FORMULA_0147 0 0 0.0 6500.0000 ECU_ADDRESS 0x3F8626 /end MEASUREMENT
/begin MEASUREMENT mzyl_sek_rf_ssp "rf gesamt ueber SSP" SWORD FORMULA_0007 0 0 0.0 2.0000 ECU_ADDRESS 0x3F8628 /end MEASUREMENT
/begin MEASUREMENT mzyl_sek_rf_mvac_1of2_ "Sek. rf ueber MVAC" SWORD FORMULA_0007 0 0 0.0 2.0000 ECU_ADDRESS 0x3F862A /end MEASUREMENT
/begin MEASUREMENT mzyl_sek_rf_mvac_2of2_ "Sek. rf ueber MVAC" SWORD FORMULA_0007 0 0 0.0 2.0000 ECU_ADDRESS 0x3F862C /end MEASUREMENT
/begin MEASUREMENT md_ind_tz_st "Status Sollmoment-TZ" UBYTE FORMULA_0288 0 0 0.0 255.0 ECU_ADDRESS 0x3F862E /end MEASUREMENT
/begin MEASUREMENT md_ind_ml_st "Status Sollmoment-Luft" UBYTE FORMULA_0288 0 0 0.0 255.0 ECU_ADDRESS 0x3F862F /end MEASUREMENT
/begin MEASUREMENT md_kupp_wunsch_ml "Wunschmoment fuer den Luftpfad" SWORD FORMULA_0009 0 0 -100.0000 1000.0000 ECU_ADDRESS 0x3F8630 /end MEASUREMENT
/begin MEASUREMENT md_kupp_min_filter "SAWE-Filter bei min Moment" SWORD FORMULA_0009 0 0 -100.0000 1000.0000 ECU_ADDRESS 0x3F8632 /end MEASUREMENT
/begin MEASUREMENT at_sa_sperre "Anti-Trampeln Schubabschaltungssperre" UBYTE FORMULA_0289 0 0 0.0 255.0 ECU_ADDRESS 0x3F8634 /end MEASUREMENT
/begin MEASUREMENT n_getr_ein "Getriebeeingangsdrehzahl" SWORD FORMULA_0006 0 0 0.0 12000.0000 ECU_ADDRESS 0x3F8636 /end MEASUREMENT
/begin MEASUREMENT n_getr_abtrieb "Getriebeabtriebsdrehzahl" SWORD FORMULA_0006 0 0 0.0 12000.0000 ECU_ADDRESS 0x3F8638 /end MEASUREMENT
/begin MEASUREMENT j_gesamt "ges. Tr�gheitsmoment" UWORD FORMULA_0290 0 0 0.0 120.0000 ECU_ADDRESS 0x3F863A /end MEASUREMENT
/begin MEASUREMENT schalter_st_ign "Schalterstatus" UWORD FORMULA_0083 0 0 0.0 65535.0000 ECU_ADDRESS 0x3F863C /end MEASUREMENT
/begin MEASUREMENT schalter_bls_ign "Schalterstatus" UWORD FORMULA_0155 0 0 0.0 65535.0 ECU_ADDRESS 0x3F863C BIT_MASK 0x1 /end MEASUREMENT
/begin MEASUREMENT schalter_blts "Schalterstatus" UWORD FORMULA_0291 0 0 0.0 65535.0 ECU_ADDRESS 0x3F863C BIT_MASK 0x2 /end MEASUREMENT
/begin MEASUREMENT schalter_wakeup_ign "Schalterstatus" UWORD FORMULA_0292 0 0 0.0 65535.0 ECU_ADDRESS 0x3F863C BIT_MASK 0x4 /end MEASUREMENT
/begin MEASUREMENT schalter_kl87 "Schalterstatus" UWORD FORMULA_0293 0 0 0.0 65535.0 ECU_ADDRESS 0x3F863C BIT_MASK 0x8 /end MEASUREMENT
/begin MEASUREMENT s_kraftschluss_smg "Kraftschluss beim SMG" UWORD FORMULA_0294 0 0 0.0 65535.0 ECU_ADDRESS 0x3F863C BIT_MASK 0x20 /end MEASUREMENT
/begin MEASUREMENT schalter_st_ign_e2 "Schalterstatus Ebene 2" UWORD FORMULA_0083 0 0 0.0 65535.0000 ECU_ADDRESS 0x3F863E /end MEASUREMENT
/begin MEASUREMENT schalter_bls_ign_e2 "Schalterstatus Ebene 2" UWORD FORMULA_0155 0 0 0.0 65535.0 ECU_ADDRESS 0x3F863E BIT_MASK 0x1 /end MEASUREMENT
/begin MEASUREMENT schalter_blts_e2 "Schalterstatus Ebene 2" UWORD FORMULA_0291 0 0 0.0 65535.0 ECU_ADDRESS 0x3F863E BIT_MASK 0x2 /end MEASUREMENT
/begin MEASUREMENT schalter_wakeup_ign_e2 "Schalterstatus Ebene 2" UWORD FORMULA_0292 0 0 0.0 65535.0 ECU_ADDRESS 0x3F863E BIT_MASK 0x4 /end MEASUREMENT
/begin MEASUREMENT schalter_kl87_e2 "Schalterstatus Ebene 2" UWORD FORMULA_0293 0 0 0.0 65535.0 ECU_ADDRESS 0x3F863E BIT_MASK 0x8 /end MEASUREMENT
/begin MEASUREMENT s_kraftschluss_smg_e2 "Kraftschluss beim SMG Ebene 2" UWORD FORMULA_0294 0 0 0.0 65535.0 ECU_ADDRESS 0x3F863E BIT_MASK 0x20 /end MEASUREMENT
/begin MEASUREMENT md_kupp_min "Minimalmoment an der Kupplung" SWORD FORMULA_0009 0 0 -100.0000 1000.0000 ECU_ADDRESS 0x3F8640 /end MEASUREMENT
/begin MEASUREMENT pctrl_t_ign "Werte fuer die Prozessorkontrolle" ULONG FORMULA_0000 0 0 0.0 4294967295.0000 ECU_ADDRESS 0x3F8644 /end MEASUREMENT
/begin MEASUREMENT toel_start_ok "Bedingung Oeltemperatur gemessen" UBYTE FORMULA_0003 0 0 0.0 255.0000 ECU_ADDRESS 0x3F8648 /end MEASUREMENT
/begin MEASUREMENT tz_min_b1 "minimal zulaessiger Zuendwinkel" SWORD FORMULA_0111 0 0 -50.0000 60.0000 ECU_ADDRESS 0x3F864A /end MEASUREMENT
/begin MEASUREMENT tz_min_b2 "minimal zulaessiger Zuendwinkel" SWORD FORMULA_0111 0 0 -50.0000 60.0000 ECU_ADDRESS 0x3F864C /end MEASUREMENT
/begin MEASUREMENT kh_van_fakt_kf_Einlass "Gewichtungsfaktor Kennfeld-KH" UWORD FORMULA_0295 0 0 0.0 2.0000 ECU_ADDRESS 0x3F864E /end MEASUREMENT
/begin MEASUREMENT kh_van_fakt_kf_Auslass "Gewichtungsfaktor Kennfeld-KH" UWORD FORMULA_0295 0 0 0.0 2.0000 ECU_ADDRESS 0x3F8650 /end MEASUREMENT
/begin MEASUREMENT kh_van_soll_offs_E1 "Restgas Katheiz Offset" SWORD FORMULA_0111 0 0 -80.0000 80.0000 ECU_ADDRESS 0x3F8652 /end MEASUREMENT
/begin MEASUREMENT kh_van_soll_offs_A1 "Restgas Katheiz Offset" SWORD FORMULA_0111 0 0 -80.0000 80.0000 ECU_ADDRESS 0x3F8654 /end MEASUREMENT
/begin MEASUREMENT kh_van_soll_offs_E2 "Restgas Katheiz Offset" SWORD FORMULA_0111 0 0 -80.0000 80.0000 ECU_ADDRESS 0x3F8656 /end MEASUREMENT
/begin MEASUREMENT kh_van_soll_offs_A2 "Restgas Katheiz Offset" SWORD FORMULA_0111 0 0 -80.0000 80.0000 ECU_ADDRESS 0x3F8658 /end MEASUREMENT
/begin MEASUREMENT kh_st "Katheizstatus Aktiv bzw. Inaktiv" UWORD FORMULA_0296 0 0 0.0 65535.0 ECU_ADDRESS 0x3F865A BIT_MASK 0x93D /end MEASUREMENT
/begin MEASUREMENT kh_st_xx "Katheizstatus Bitfeld" UWORD FORMULA_0083 0 0 0.0 65535.0000 ECU_ADDRESS 0x3F865A /end MEASUREMENT
/begin MEASUREMENT B_KH_ST_TKAT "Katheizstatusbit fuer Kattemperatur" UWORD FORMULA_0297 0 0 0.0 65535.0 ECU_ADDRESS 0x3F865A BIT_MASK 0x1 /end MEASUREMENT
/begin MEASUREMENT B_KH_ST_SMG "Katheizstatusbit fuer SMG" UWORD FORMULA_0298 0 0 0.0 65535.0 ECU_ADDRESS 0x3F865A BIT_MASK 0x2 /end MEASUREMENT
/begin MEASUREMENT B_KH_ST_RF "Katheizstatusbit fuer rf-Schwelle" UWORD FORMULA_0299 0 0 0.0 65535.0 ECU_ADDRESS 0x3F865A BIT_MASK 0x4 /end MEASUREMENT
/begin MEASUREMENT B_KH_ST_N "Katheizstatusbit fur Drehzahlschwelle" UWORD FORMULA_0300 0 0 0.0 65535.0 ECU_ADDRESS 0x3F865A BIT_MASK 0x8 /end MEASUREMENT
/begin MEASUREMENT B_KH_ST_T_ML "Katheizstatusbit fuer Zeit Motor laeuft" UWORD FORMULA_0301 0 0 0.0 65535.0 ECU_ADDRESS 0x3F865A BIT_MASK 0x10 /end MEASUREMENT
/begin MEASUREMENT B_KH_ST_SK "Katheizstatusbit fuer SK" UWORD FORMULA_0302 0 0 0.0 65535.0 ECU_ADDRESS 0x3F865A BIT_MASK 0x20 /end MEASUREMENT
/begin MEASUREMENT B_KH_ST_EINGRIFF "Katheizstatusbit fuer noch vorhandene Eingriffe" UWORD FORMULA_0303 0 0 0.0 65535.0 ECU_ADDRESS 0x3F865A BIT_MASK 0x40 /end MEASUREMENT
/begin MEASUREMENT B_KH_VAN "Vanos Katheizen" UWORD FORMULA_0304 0 0 0.0 65535.0 ECU_ADDRESS 0x3F865A BIT_MASK 0x80 /end MEASUREMENT
/begin MEASUREMENT B_KH_ST_VTKAT "Sperrbedinung fuer v ungleich 0 und TKAT erreicht" UWORD FORMULA_0305 0 0 0.0 65535.0 ECU_ADDRESS 0x3F865A BIT_MASK 0x100 /end MEASUREMENT
/begin MEASUREMENT B_KH_ST_VTKAT_ZYKLUS "Zyklusflag fuer v ungleich 0 und TKAT erreicht" UWORD FORMULA_0306 0 0 0.0 65535.0 ECU_ADDRESS 0x3F865A BIT_MASK 0x200 /end MEASUREMENT
/begin MEASUREMENT B_KH_ST_TKAT_ZYKLUS "Zyklusflag fuer TKAT Schwelle erreicht" UWORD FORMULA_0307 0 0 0.0 65535.0 ECU_ADDRESS 0x3F865A BIT_MASK 0x400 /end MEASUREMENT
/begin MEASUREMENT B_KH_ST_PKSR_PL_ZYKLUS "KH Bit fuer kein PKSR Prueflauf" UWORD FORMULA_0308 0 0 0.0 65535.0 ECU_ADDRESS 0x3F865A BIT_MASK 0x800 /end MEASUREMENT
/begin MEASUREMENT smg_st_dme "DME-Status" UBYTE FORMULA_0309 0 0 0.0 255.0 ECU_ADDRESS 0x3F865C /end MEASUREMENT
/begin MEASUREMENT smg_schaltart "Schaltart" UWORD FORMULA_0010 0 0 0.0 65535.0000 ECU_ADDRESS 0x3F865E /end MEASUREMENT
/begin MEASUREMENT smg_schaltart_zs "Schaltart (Zug-Schub-Hoch)" UWORD FORMULA_0310 0 0 0.0 65535.0 ECU_ADDRESS 0x3F865E BIT_MASK 0x1 /end MEASUREMENT
/begin MEASUREMENT smg_schaltart_hr "Schaltart (Zug-Schub-Hoch)" UWORD FORMULA_0311 0 0 0.0 65535.0 ECU_ADDRESS 0x3F865E BIT_MASK 0x6 /end MEASUREMENT
/begin MEASUREMENT smg_schaltart_automat "Schaltart (Automat)" UWORD FORMULA_0312 0 0 0.0 65535.0 ECU_ADDRESS 0x3F865E BIT_MASK 0x8 /end MEASUREMENT
/begin MEASUREMENT smg_schaltart_eingr "Schaltart (Eingriff)" UWORD FORMULA_0313 0 0 0.0 65535.0 ECU_ADDRESS 0x3F865E BIT_MASK 0x20 /end MEASUREMENT
/begin MEASUREMENT smg_schaltart_aks "Schaltart (AKS)" UWORD FORMULA_0314 0 0 0.0 65535.0 ECU_ADDRESS 0x3F865E BIT_MASK 0x40 /end MEASUREMENT
/begin MEASUREMENT smg_schaltart_rs "Schaltart (Rennstart)" UWORD FORMULA_0315 0 0 0.0 65535.0 ECU_ADDRESS 0x3F865E BIT_MASK 0x80 /end MEASUREMENT
/begin MEASUREMENT smg_schaltart_lw "Schaltart (Lastwechsel)" UWORD FORMULA_0316 0 0 0.0 65535.0 ECU_ADDRESS 0x3F865E BIT_MASK 0x200 /end MEASUREMENT
/begin MEASUREMENT smg_n_getr_anschluss "gerechnete Ziel-Drehzahl am Getriebeeingang im naechsten Gang" SWORD FORMULA_0006 0 0 0.0 10000.0000 ECU_ADDRESS 0x3F8660 /end MEASUREMENT
/begin MEASUREMENT smg_t_abregel "Abregelzeit" UBYTE FORMULA_0317 0 0 0.0 2.5500 ECU_ADDRESS 0x3F8662 /end MEASUREMENT
/begin MEASUREMENT smg_t_aufregel "Aufregelzeit" UBYTE FORMULA_0317 0 0 0.0 2.5500 ECU_ADDRESS 0x3F8663 /end MEASUREMENT
/begin MEASUREMENT smg_sk_mode "SK-Mode SMG" UBYTE FORMULA_0012 0 0 0.0 255.0 ECU_ADDRESS 0x3F8664 /end MEASUREMENT
/begin MEASUREMENT md_sk_mode "SK-Mode Momentenmanager" UBYTE FORMULA_0012 0 0 0.0 255.0 ECU_ADDRESS 0x3F8665 /end MEASUREMENT
/begin MEASUREMENT gang_n_verh "Getriebeeingangsdrehzahl / Getriebeabtriebsdrehzahl" SWORD FORMULA_0075 0 0 -32.0000 31.9990 ECU_ADDRESS 0x3F8666 /end MEASUREMENT
/begin MEASUREMENT gang_berech "berechneter Gang inkl. R und N" SBYTE FORMULA_0318 0 0 -1.0000 10.0000 ECU_ADDRESS 0x3F8668 /end MEASUREMENT
/begin MEASUREMENT gang_berech_st "Status berechneter Gang" UWORD FORMULA_0083 0 0 0.0 65535.0000 ECU_ADDRESS 0x3F866A /end MEASUREMENT
/begin MEASUREMENT gang_berech_st_unbek "berechneter Gang unbekannt" UWORD FORMULA_0319 0 0 0.0 65535.0 ECU_ADDRESS 0x3F866A BIT_MASK 0x1 /end MEASUREMENT
/begin MEASUREMENT gang_berech_st_ungerade "berechneter Gang ungerade" UWORD FORMULA_0320 0 0 0.0 65535.0 ECU_ADDRESS 0x3F866A BIT_MASK 0x2 /end MEASUREMENT
/begin MEASUREMENT gang_berech_st_gerade "berechneter Gang gerade" UWORD FORMULA_0321 0 0 0.0 65535.0 ECU_ADDRESS 0x3F866A BIT_MASK 0x4 /end MEASUREMENT
/begin MEASUREMENT gang_berech_st_aktion "Aktion am Schalthebel" UWORD FORMULA_0322 0 0 0.0 65535.0 ECU_ADDRESS 0x3F866A BIT_MASK 0x8 /end MEASUREMENT
/begin MEASUREMENT gang_berech_st_plaus "berechneter Gang plausibel" UWORD FORMULA_0323 0 0 0.0 65535.0 ECU_ADDRESS 0x3F866A BIT_MASK 0x10 /end MEASUREMENT
/begin MEASUREMENT gang_berech_st_neu "Gang neu berechnen" UWORD FORMULA_0324 0 0 0.0 65535.0 ECU_ADDRESS 0x3F866A BIT_MASK 0x20 /end MEASUREMENT
/begin MEASUREMENT gang_berech_st_uebern "Gang neu berechnen" UWORD FORMULA_0325 0 0 0.0 65535.0 ECU_ADDRESS 0x3F866A BIT_MASK 0x40 /end MEASUREMENT
/begin MEASUREMENT gang_berech_kl_i "Getriebeuebersetzungsverhaeltnis aus Kennlinie" SWORD FORMULA_0075 0 0 -32.0000 31.9990 ECU_ADDRESS 0x3F866C /end MEASUREMENT
/begin MEASUREMENT gang_berech_kl_i_dist "Abstand Getriebeuebersetzungsverhaeltnis naechster Gang" SWORD FORMULA_0075 0 0 -32.0000 31.9990 ECU_ADDRESS 0x3F866E /end MEASUREMENT
/begin MEASUREMENT gang "Gang" SBYTE FORMULA_0318 0 0 -1.0000 10.0000 ECU_ADDRESS 0x3F8670 /end MEASUREMENT
/begin MEASUREMENT gang_ks "Gang mit Kraftschluss" SBYTE FORMULA_0318 0 0 -1.0000 10.0000 ECU_ADDRESS 0x3F8671 /end MEASUREMENT
/begin MEASUREMENT gang_can "Gang CAN Botschaftswert fuer Kombi" SBYTE FORMULA_0318 0 0 -1.0000 10.0000 ECU_ADDRESS 0x3F8672 /end MEASUREMENT
/begin MEASUREMENT egas_sk_mode "SK-Mode Egas" UBYTE FORMULA_0012 0 0 0.0 255.0 ECU_ADDRESS 0x3F8673 /end MEASUREMENT
/begin MEASUREMENT sk_egas_off_ign "SK-Egasstufe" UBYTE FORMULA_0172 0 0 0.0 255.0 ECU_ADDRESS 0x3F8674 /end MEASUREMENT
/begin MEASUREMENT sk_md_begr_ign "SK-Begrenzungsstufe" UBYTE FORMULA_0172 0 0 0.0 255.0 ECU_ADDRESS 0x3F8675 /end MEASUREMENT
/begin MEASUREMENT sk_md_eingr_ign "SK-Md-Eingriff" UBYTE FORMULA_0003 0 0 0.0 255.0000 ECU_ADDRESS 0x3F8676 /end MEASUREMENT
/begin MEASUREMENT sk_tz_eingr_ign "SK-TZ-Eingriff" UBYTE FORMULA_0173 0 0 0.0 255.0 ECU_ADDRESS 0x3F8676 BIT_MASK 0x1 /end MEASUREMENT
/begin MEASUREMENT sk_ti_eingr_ign "SK-TI-Eingriff" UBYTE FORMULA_0174 0 0 0.0 255.0 ECU_ADDRESS 0x3F8676 BIT_MASK 0x2 /end MEASUREMENT
/begin MEASUREMENT sk_lam_st_ign_b1 "SK-LAM-Eingriff" UBYTE FORMULA_0175 0 0 0.0 255.0 ECU_ADDRESS 0x3F8677 /end MEASUREMENT
/begin MEASUREMENT sk_lam_st_ign_b2 "SK-LAM-Eingriff" UBYTE FORMULA_0176 0 0 0.0 255.0 ECU_ADDRESS 0x3F8677 /end MEASUREMENT
/begin MEASUREMENT sk_van_st_ign "SK-Vanos-Eingriff" UBYTE FORMULA_0177 0 0 0.0 255.0 ECU_ADDRESS 0x3F8678 /end MEASUREMENT
/begin MEASUREMENT sk_eingr_st_ign "SK-Eingriff" UBYTE FORMULA_0003 0 0 0.0 255.0000 ECU_ADDRESS 0x3F8679 /end MEASUREMENT
/begin MEASUREMENT sk_pks_st_ign "SK-Eingriff PKS" UBYTE FORMULA_0178 0 0 0.0 255.0 ECU_ADDRESS 0x3F8679 BIT_MASK 0x1 /end MEASUREMENT
/begin MEASUREMENT sk_llra_st_ign "SK-Eingriff LLRA" UBYTE FORMULA_0179 0 0 0.0 255.0 ECU_ADDRESS 0x3F8679 BIT_MASK 0x2 /end MEASUREMENT
/begin MEASUREMENT sk_fra_st_ign "SK-Eingriff FRA" UBYTE FORMULA_0180 0 0 0.0 255.0 ECU_ADDRESS 0x3F8679 BIT_MASK 0x4 /end MEASUREMENT
/begin MEASUREMENT sk_kh_st_ign "SK-Eingriff KH" UBYTE FORMULA_0181 0 0 0.0 255.0 ECU_ADDRESS 0x3F8679 BIT_MASK 0x8 /end MEASUREMENT
/begin MEASUREMENT sk_mzyl_st_ign "SK-Eingriff MZYL" UBYTE FORMULA_0182 0 0 0.0 255.0 ECU_ADDRESS 0x3F8679 BIT_MASK 0x30 /end MEASUREMENT
/begin MEASUREMENT sk_fr_st_ign "SK-Eingriff FR" UBYTE FORMULA_0183 0 0 0.0 255.0 ECU_ADDRESS 0x3F8679 BIT_MASK 0x40 /end MEASUREMENT
/begin MEASUREMENT sk_ti_zyl_off_ign "SK-Ausblendungen" UWORD FORMULA_0184 0 0 0.0 65535.0 ECU_ADDRESS 0x3F867A /end MEASUREMENT
/begin MEASUREMENT fgr_status_kombi "FGR Status zum Kombi" UBYTE FORMULA_0326 0 0 0.0 255.0 ECU_ADDRESS 0x3F867C /end MEASUREMENT
/begin MEASUREMENT fgr_anzeige_kombi "FGR Anzeige im Kombi ein-/ausschalten" UBYTE FORMULA_0327 0 0 0.0 255.0 ECU_ADDRESS 0x3F867D /end MEASUREMENT
/begin MEASUREMENT fgr_status_hud "FGR Status HUD" UBYTE FORMULA_0328 0 0 0.0 255.0 ECU_ADDRESS 0x3F867E /end MEASUREMENT
/begin MEASUREMENT fgr_v_kombi "FGR Geschwindigkeit zum Kombi" SWORD FORMULA_0329 0 0 0.0 360.0000 ECU_ADDRESS 0x3F8680 /end MEASUREMENT
/begin MEASUREMENT fgr_status "Fgr Status" UBYTE FORMULA_0330 0 0 0.0 255.0 ECU_ADDRESS 0x3F8682 /end MEASUREMENT
/begin MEASUREMENT v_direkt "diskrete Geschwindigkeit" SWORD FORMULA_0078 0 0 -80.0000 360.0000 ECU_ADDRESS 0x3F8684 /end MEASUREMENT
/begin MEASUREMENT fgr_sa_sperre "Fgr SA Sperre" UBYTE FORMULA_0331 0 0 0.0 255.0 ECU_ADDRESS 0x3F8686 /end MEASUREMENT
/begin MEASUREMENT sk_tr_resp "Beantwortete Testrechnung vom IGN" UBYTE FORMULA_0003 0 0 0.0 255.0000 ECU_ADDRESS 0x3F8687 /end MEASUREMENT
/begin MEASUREMENT sk_tr_result "Ergebnis vom IGN" UWORD FORMULA_0010 0 0 0.0 65535.0000 ECU_ADDRESS 0x3F8688 /end MEASUREMENT
/begin MEASUREMENT md_sk_ti_st "Freigabemaske fuer Einspritzkanaele" UWORD FORMULA_0010 0 0 0.0 65535.0000 ECU_ADDRESS 0x3F868A /end MEASUREMENT
/begin MEASUREMENT n_e2 "Motordrehzahl der Ebene 2." SWORD FORMULA_0006 0 0 0.0 10000.0000 ECU_ADDRESS 0x3F868C /end MEASUREMENT
/begin MEASUREMENT smg_ax_berg "Steigung" SWORD FORMULA_0132 0 0 -20.0000 20.0000 ECU_ADDRESS 0x3F868E /end MEASUREMENT
/begin MEASUREMENT fr_einger_st "Status FR eingeregelt" UBYTE FORMULA_0332 0 0 0.0 255.0 ECU_ADDRESS 0x3F8690 /end MEASUREMENT
/begin MEASUREMENT afz "Laengsbeschleunigung Fahrzeug" SWORD FORMULA_0132 0 0 -50.0000 50.0000 ECU_ADDRESS 0x3F8692 /end MEASUREMENT
/begin MEASUREMENT afz_berg "Laengsbeschleunigung Fahrbahnneigung" SWORD FORMULA_0132 0 0 -50.0000 50.0000 ECU_ADDRESS 0x3F8694 /end MEASUREMENT
/begin MEASUREMENT fr_reg_out_1of2_ "Korrekturfaktor FR-Regler" UWORD FORMULA_0024 0 0 0.5000 1.5000 ECU_ADDRESS 0x3F8696 /end MEASUREMENT
/begin MEASUREMENT fr_reg_out_2of2_ "Korrekturfaktor FR-Regler" UWORD FORMULA_0024 0 0 0.5000 1.5000 ECU_ADDRESS 0x3F8698 /end MEASUREMENT
/begin MEASUREMENT tabg_filter_b1 "Gefilterter Messwert der Abgastemperatur" SWORD FORMULA_0333 0 0 -50.0000 1250.0000 ECU_ADDRESS 0x3F86A0 /end MEASUREMENT
/begin MEASUREMENT tabg_filter_b2 "Gefilterter Messwert der Abgastemperatur" SWORD FORMULA_0333 0 0 -50.0000 1250.0000 ECU_ADDRESS 0x3F86A2 /end MEASUREMENT
/begin MEASUREMENT tabg_lw_b1 "Abgastemperatur Ladungswechsel" SWORD FORMULA_0023 0 0 -50.0000 1250.0000 ECU_ADDRESS 0x3F86A4 /end MEASUREMENT
/begin MEASUREMENT tabg_lw_b2 "Abgastemperatur Ladungswechsel" SWORD FORMULA_0023 0 0 -50.0000 1250.0000 ECU_ADDRESS 0x3F86A6 /end MEASUREMENT
/begin MEASUREMENT tabg_vkat_b1 "Abgastemperatur vorm Kat" SWORD FORMULA_0023 0 0 -50.0000 1250.0000 ECU_ADDRESS 0x3F86A8 /end MEASUREMENT
/begin MEASUREMENT tabg_vkat_b2 "Abgastemperatur vorm Kat" SWORD FORMULA_0023 0 0 -50.0000 1250.0000 ECU_ADDRESS 0x3F86AA /end MEASUREMENT
/begin MEASUREMENT tabg_nkat_b1 "Abgastemperatur nach dem Kat" SWORD FORMULA_0023 0 0 -50.0000 1250.0000 ECU_ADDRESS 0x3F86AC /end MEASUREMENT
/begin MEASUREMENT tabg_nkat_b2 "Abgastemperatur nach dem Kat" SWORD FORMULA_0023 0 0 -50.0000 1250.0000 ECU_ADDRESS 0x3F86AE /end MEASUREMENT
/begin MEASUREMENT tabg_kat_b1 "Abgastemperatur im Kat" SWORD FORMULA_0023 0 0 -50.0000 1250.0000 ECU_ADDRESS 0x3F86B0 /end MEASUREMENT
/begin MEASUREMENT tabg_kat_b2 "Abgastemperatur im Kat" SWORD FORMULA_0023 0 0 -50.0000 1250.0000 ECU_ADDRESS 0x3F86B2 /end MEASUREMENT
/begin MEASUREMENT tabg_lw_verh_b1 "Verhaeltnis der Ladungswechseltemperaturen" UWORD FORMULA_0075 0 0 0.0 4.0000 ECU_ADDRESS 0x3F86B4 /end MEASUREMENT
/begin MEASUREMENT tabg_lw_verh_b2 "Verhaeltnis der Ladungswechseltemperaturen" UWORD FORMULA_0075 0 0 0.0 4.0000 ECU_ADDRESS 0x3F86B6 /end MEASUREMENT
/begin MEASUREMENT tabg_lw_verh_wurzel_b1 "Wurzel-Verhaeltnis der Ladungswechseltemperaturen" UWORD FORMULA_0075 0 0 0.0 4.0000 ECU_ADDRESS 0x3F86B8 /end MEASUREMENT
/begin MEASUREMENT tabg_lw_verh_wurzel_b2 "Wurzel-Verhaeltnis der Ladungswechseltemperaturen" UWORD FORMULA_0075 0 0 0.0 4.0000 ECU_ADDRESS 0x3F86BA /end MEASUREMENT
/begin MEASUREMENT tabg_st "TABG-Status" UBYTE FORMULA_0033 0 0 0.0 255.0000 ECU_ADDRESS 0x3F86BC /end MEASUREMENT
/begin MEASUREMENT tabg_st_aufregeln_b1 "Kat-Enthalpie Bank 1" UBYTE FORMULA_0334 0 0 0.0 255.0 ECU_ADDRESS 0x3F86BC BIT_MASK 0x1 /end MEASUREMENT
/begin MEASUREMENT tabg_st_aufregeln_b2 "Kat-Enthalpie Bank 2" UBYTE FORMULA_0335 0 0 0.0 255.0 ECU_ADDRESS 0x3F86BC BIT_MASK 0x2 /end MEASUREMENT
/begin MEASUREMENT tabg_st_kat_obd_grad_b1 "Kattemperaturgradient Bank 1" UBYTE FORMULA_0336 0 0 0.0 255.0 ECU_ADDRESS 0x3F86BC BIT_MASK 0x4 /end MEASUREMENT
/begin MEASUREMENT tabg_st_kat_obd_grad_b2 "Kattemperaturgradient Bank 2" UBYTE FORMULA_0337 0 0 0.0 255.0 ECU_ADDRESS 0x3F86BC BIT_MASK 0x8 /end MEASUREMENT
/begin MEASUREMENT tabg_st_init_b1 "CAN-Init Bank 1" UBYTE FORMULA_0338 0 0 0.0 255.0 ECU_ADDRESS 0x3F86BC BIT_MASK 0x40 /end MEASUREMENT
/begin MEASUREMENT tabg_st_init_b2 "CAN-Init Bank 2" UBYTE FORMULA_0339 0 0 0.0 255.0 ECU_ADDRESS 0x3F86BC BIT_MASK 0x80 /end MEASUREMENT
/begin MEASUREMENT tan_obd_mode_1_2 "Ausgabe SCAN_TOOL" UBYTE FORMULA_0057 0 0 -40.0000 215.0000 ECU_ADDRESS 0x3F86BD /end MEASUREMENT
/begin MEASUREMENT tan_b1 "Ansauglufttemperatur" SWORD FORMULA_0023 0 0 -50.0000 170.0000 ECU_ADDRESS 0x3F86BE /end MEASUREMENT
/begin MEASUREMENT tan_b2 "Ansauglufttemperatur" SWORD FORMULA_0023 0 0 -50.0000 170.0000 ECU_ADDRESS 0x3F86C0 /end MEASUREMENT
/begin MEASUREMENT tan_mw "Mittelwert der Ansauglufttemperatur" SWORD FORMULA_0023 0 0 -50.0000 170.0000 ECU_ADDRESS 0x3F86C2 /end MEASUREMENT
/begin MEASUREMENT tan_e2 "Ansauglufttemperatur Ebene 2" SWORD FORMULA_0023 0 0 -50.0000 170.0000 ECU_ADDRESS 0x3F86C4 /end MEASUREMENT
/begin MEASUREMENT tdme "Steuergeraetetemperatur" SWORD FORMULA_0023 0 0 -50.0000 170.0000 ECU_ADDRESS 0x3F86C6 /end MEASUREMENT
/begin MEASUREMENT tka "Kuehlwasseraustrittstemperatur" SWORD FORMULA_0023 0 0 -50.0000 170.0000 ECU_ADDRESS 0x3F86C8 /end MEASUREMENT
/begin MEASUREMENT tmot "Motortemperatur-Kuehlwasser" SWORD FORMULA_0023 0 0 -50.0000 170.0000 ECU_ADDRESS 0x3F86CA /end MEASUREMENT
/begin MEASUREMENT tmot_modell "OBD-Modelltemperatur" SLONG FORMULA_0340 0 0 -50.0000 170.0000 ECU_ADDRESS 0x3F86CC /end MEASUREMENT
/begin MEASUREMENT tmot_sta "Status Uebertemperaturanzeige" UBYTE FORMULA_0341 0 0 0.0 255.0 ECU_ADDRESS 0x3F86D0 BIT_MASK 0x3 /end MEASUREMENT
/begin MEASUREMENT tmot_sta_zws "Status Zwangsschaltung" UBYTE FORMULA_0342 0 0 0.0 255.0 ECU_ADDRESS 0x3F86D0 BIT_MASK 0x4 /end MEASUREMENT
/begin MEASUREMENT tmot_obd_mode_1_2 "Ausgabe SCAN_TOOL" UBYTE FORMULA_0057 0 0 -40.0000 215.0000 ECU_ADDRESS 0x3F86D1 /end MEASUREMENT
/begin MEASUREMENT toel "Temperatur am Oelfilterkopf" SWORD FORMULA_0023 0 0 -50.0000 170.0000 ECU_ADDRESS 0x3F86D4 /end MEASUREMENT
/begin MEASUREMENT toel_modell "Oeltemperaturmodell am Oelfilterkopf" SWORD FORMULA_0023 0 0 -50.0000 170.0000 ECU_ADDRESS 0x3F86D6 /end MEASUREMENT
/begin MEASUREMENT tsgrw_m "Mittelwert Saugrohrwandtemperatur" SWORD FORMULA_0023 0 0 -50.0000 170.0000 ECU_ADDRESS 0x3F86D8 /end MEASUREMENT
/begin MEASUREMENT tsgrw_b1 "Saugrohrwandtemperatur" SWORD FORMULA_0023 0 0 -50.0000 170.0000 ECU_ADDRESS 0x3F86DA /end MEASUREMENT
/begin MEASUREMENT tsgrw_b2 "Saugrohrwandtemperatur" SWORD FORMULA_0023 0 0 -50.0000 170.0000 ECU_ADDRESS 0x3F86DC /end MEASUREMENT
/begin MEASUREMENT tumg_ersatz "Ersatzwert der Umgebungstemperatur" SWORD FORMULA_0023 0 0 -50.0000 170.0000 ECU_ADDRESS 0x3F86DE /end MEASUREMENT
/begin MEASUREMENT llr_n_soll "Leerlaufdrehzahl" SWORD FORMULA_0006 0 0 0.0 10000.0000 ECU_ADDRESS 0x3F86E0 /end MEASUREMENT
/begin MEASUREMENT hdw_ign_st "" UBYTE FORMULA_0003 0 0 0.0 255.0000 ECU_ADDRESS 0x3F86E2 /end MEASUREMENT
/begin MEASUREMENT hdw_ign "" ULONG FORMULA_0000 0 0 0.0 4294967295.0000 ECU_ADDRESS 0x3F86E4 /end MEASUREMENT
/begin MEASUREMENT tabg_nkat_modell_b1 "Abgastemperaturmodell nach dem Kat" SWORD FORMULA_0023 0 0 -50.0000 1250.0000 ECU_ADDRESS 0x3F86E8 /end MEASUREMENT
/begin MEASUREMENT tabg_nkat_modell_b2 "Abgastemperaturmodell nach dem Kat" SWORD FORMULA_0023 0 0 -50.0000 1250.0000 ECU_ADDRESS 0x3F86EA /end MEASUREMENT
/begin MEASUREMENT kw_diag "AD-Wert Kurbelwellendiagnose" SWORD FORMULA_0123 0 0 0.0 1023.0000 ECU_ADDRESS 0x3F86EC /end MEASUREMENT
/begin MEASUREMENT fgr_cc_message "Fgr CC-Message senden " UBYTE FORMULA_0343 0 0 0.0 255.0 ECU_ADDRESS 0x3F86EE /end MEASUREMENT
/begin MEASUREMENT start_rl_diag_dpr "Bestaetigung der Treiberinfo" UBYTE FORMULA_0003 0 0 0.0 255.0000 ECU_ADDRESS 0x3F86F0 /end MEASUREMENT
/begin MEASUREMENT md_kupp_max "Maximalmoment an der Kupplung" SWORD FORMULA_0009 0 0 -100.0000 1000.0000 ECU_ADDRESS 0x3F86F2 /end MEASUREMENT
/begin MEASUREMENT md_kupp_max_can "CAN-Maximalmoment an der Kupplung" SWORD FORMULA_0009 0 0 -100.0000 1000.0000 ECU_ADDRESS 0x3F86F4 /end MEASUREMENT
/begin MEASUREMENT md_ind_schlepp_ist "Schleppmoment (aktuell)" SWORD FORMULA_0009 0 0 -100.0000 1000.0000 ECU_ADDRESS 0x3F86F6 /end MEASUREMENT
/begin MEASUREMENT md_ind_schlepp_min "Schleppmoment bei MIN" SWORD FORMULA_0009 0 0 -100.0000 1000.0000 ECU_ADDRESS 0x3F86F8 /end MEASUREMENT
/begin MEASUREMENT md_ind_opt_la_rg_zw_min "Moment mit LA/RG bei min. ZW" SWORD FORMULA_0009 0 0 -100.0000 1000.0000 ECU_ADDRESS 0x3F86FA /end MEASUREMENT
/begin MEASUREMENT md_rf_max "rf_max mit pt-Korr" SWORD FORMULA_0007 0 0 0.0 2.0000 ECU_ADDRESS 0x3F86FC /end MEASUREMENT
/begin MEASUREMENT md_rf_max_roh "rf_max" SWORD FORMULA_0007 0 0 0.0 2.0000 ECU_ADDRESS 0x3F86FE /end MEASUREMENT
/begin MEASUREMENT md_rf_min_pt "rf_min mit Komp." SWORD FORMULA_0007 0 0 0.0 2.0000 ECU_ADDRESS 0x3F8700 /end MEASUREMENT
/begin MEASUREMENT md_rf_soll_pt "Soll-rf mit pt-Korr" SWORD FORMULA_0007 0 0 0.0 2.0000 ECU_ADDRESS 0x3F8702 /end MEASUREMENT
/begin MEASUREMENT auss_obd_zyl_off "Abgeschaltene Zylinder." UWORD FORMULA_0344 0 0 0.0 65535.0 ECU_ADDRESS 0x3F8704 /end MEASUREMENT
/begin MEASUREMENT ccp_fp_st_ign "Status CCP-FP" UBYTE FORMULA_0231 0 0 0.0 255.0 ECU_ADDRESS 0x3F8706 /end MEASUREMENT
/begin MEASUREMENT kwp_fp_st_ign "Status KWP-FP" UBYTE FORMULA_0003 0 0 0.0 255.0000 ECU_ADDRESS 0x3F8707 /end MEASUREMENT
/begin MEASUREMENT egas_aq_max_kf "AQ-Soll bei rf_max" UWORD FORMULA_0147 0 0 0.0 6500.0000 ECU_ADDRESS 0x3F8708 /end MEASUREMENT
/begin MEASUREMENT egas_rec_dk_r_hw_vers_b1 "HW-Version" UWORD FORMULA_0010 0 0 0.0 65535.0000 ECU_ADDRESS 0x3F870A /end MEASUREMENT
/begin MEASUREMENT egas_rec_dk_r_hw_vers_b2 "HW-Version" UWORD FORMULA_0010 0 0 0.0 65535.0000 ECU_ADDRESS 0x3F870C /end MEASUREMENT
/begin MEASUREMENT k2KB_resp_ign "KWP" UBYTE FORMULA_0345 0 0 0.0 255.0 ECU_ADDRESS 0x3F870E /end MEASUREMENT
/begin MEASUREMENT k2KB_sid_ign "KWP" UBYTE FORMULA_0003 0 0 0.0 255.0000 ECU_ADDRESS 0x3F870F /end MEASUREMENT
/begin MEASUREMENT k2KB_bytes_ign "KWP" UWORD FORMULA_0010 0 0 0.0 65535.0000 ECU_ADDRESS 0x3F8710 /end MEASUREMENT
/* ------------------ Abschnitt erzeugt aus ipk.dat ------------------ */
/begin CHARACTERISTIC K_IPK_INJ_T_SYNC_MAX "Wartezeit INJ auf IGN" VALUE 0x72DD8 TKW_VV_VV_UL 100.0 FORMULA_0347 0.0 500.0000 FORMAT "%4.1" /end CHARACTERISTIC
/begin MEASUREMENT ipk_error_segm.type "Fehlertype" UBYTE FORMULA_0346 0 0 0.0 255.0 ECU_ADDRESS 0x3FC217 /end MEASUREMENT
/begin MEASUREMENT ipk_error_5ms.type "Fehlertype" UBYTE FORMULA_0346 0 0 0.0 255.0 ECU_ADDRESS 0x3FC219 /end MEASUREMENT
/begin MEASUREMENT ipk_error_10ms.type "Fehlertype" UBYTE FORMULA_0346 0 0 0.0 255.0 ECU_ADDRESS 0x3FC21B /end MEASUREMENT
/begin MEASUREMENT ipk_error_100ms.type "Fehlertype" UBYTE FORMULA_0346 0 0 0.0 255.0 ECU_ADDRESS 0x3FC21D /end MEASUREMENT
/begin MEASUREMENT ipk_error_bgnd.type "Fehlertype" UBYTE FORMULA_0346 0 0 0.0 255.0 ECU_ADDRESS 0x3FC21F /end MEASUREMENT
/begin MEASUREMENT ipk_error_kwp.type "Fehlertype" UBYTE FORMULA_0346 0 0 0.0 255.0 ECU_ADDRESS 0x3FC221 /end MEASUREMENT
/begin MEASUREMENT ipk_error_segm.cnt "Fehlerzaehler" UBYTE FORMULA_0003 0 0 0.0 255.0000 ECU_ADDRESS 0x3FC218 /end MEASUREMENT
/begin MEASUREMENT ipk_error_5ms.cnt "Fehlerzaehler" UBYTE FORMULA_0003 0 0 0.0 255.0000 ECU_ADDRESS 0x3FC21A /end MEASUREMENT
/begin MEASUREMENT ipk_error_10ms.cnt "Fehlerzaehler" UBYTE FORMULA_0003 0 0 0.0 255.0000 ECU_ADDRESS 0x3FC21C /end MEASUREMENT
/begin MEASUREMENT ipk_error_100ms.cnt "Fehlerzaehler" UBYTE FORMULA_0003 0 0 0.0 255.0000 ECU_ADDRESS 0x3FC21E /end MEASUREMENT
/begin MEASUREMENT ipk_error_bgnd.cnt "Fehlerzaehler" UBYTE FORMULA_0003 0 0 0.0 255.0000 ECU_ADDRESS 0x3FC220 /end MEASUREMENT
/begin MEASUREMENT ipk_error_kwp.cnt "Fehlerzaehler" UBYTE FORMULA_0003 0 0 0.0 255.0000 ECU_ADDRESS 0x3FC222 /end MEASUREMENT
/* ------------------ Abschnitt erzeugt aus hfm.dat ------------------ */
/begin CHARACTERISTIC K_HFM_DIAG_ML_MAX "MAX ML fuer Diagnose " VALUE 0x7231A TKW_VV_VV_SW 100.0 FORMULA_0112 -50.0000 1400.0000 FORMAT "%4.1" /end CHARACTERISTIC
/begin CHARACTERISTIC K_HFM_DIAG_ML_MIN "MAX ML fuer Diagnose " VALUE 0x7231C TKW_VV_VV_SW 100.0 FORMULA_0112 -50.0000 1400.0000 FORMAT "%4.1" /end CHARACTERISTIC
/begin CHARACTERISTIC K_HFM_ERSATZ "Ersatzwert fuer HFM" VALUE 0x7231E TKW_VV_VV_SW 100.0 FORMULA_0112 -50.0000 1400.0000 FORMAT "%4.1" /end CHARACTERISTIC
/begin CHARACTERISTIC K_HFM_KL_CFG "Auswahl HFM KL" VALUE 0x72320 TKW_VV_VV_UB 100.0 FORMULA_0720 0.0 255.0 /end CHARACTERISTIC
/begin CHARACTERISTIC K_HFM_N_RF_KORR_CFG "HFM Popel KF Aktivierung" VALUE 0x72321 TKW_VV_VV_UB 100.0 FORMULA_0721 0.0 255.0 /end CHARACTERISTIC
/begin CHARACTERISTIC K_HFM_SSP_FAK_1of2_ "Bankselektiver Faktor Einrechnung SSP" VALUE 0x72322 TKW_VV_VV_SW 100.0 FORMULA_0075 -4.0000 4.0000 FORMAT "%6.3" /end CHARACTERISTIC
/begin CHARACTERISTIC K_HFM_SSP_FAK_2of2_ "Bankselektiver Faktor Einrechnung SSP" VALUE 0x72324 TKW_VV_VV_SW 100.0 FORMULA_0075 -4.0000 4.0000 FORMAT "%6.3" /end CHARACTERISTIC
/begin CHARACTERISTIC K_HFM_OBD_DYN_DELTA_RF "rf Differnez fuer Dynamikerkennung | EN: rf Differnez fuer Dynamikerkennung" VALUE 0x72326 TKW_VV_VV_SW 100.0 FORMULA_0007 0.0 2.0000 FORMAT "%6.3" /end CHARACTERISTIC
/begin CHARACTERISTIC K_HFM_OBD_DYN_RF_T "Sperrzeit fuer Ruecknahme rf-Dynamik" VALUE 0x72328 TKW_VV_VV_UW 100.0 FORMULA_0021 0.0 655.3500 FORMAT "%5.2" /end CHARACTERISTIC
/begin CHARACTERISTIC K_HFM_MVAC_CFG "Konfig fuer Einrechnung MVAC" VALUE 0x7232A TKW_VV_VV_UB 100.0 FORMULA_0722 0.0 255.0 /end CHARACTERISTIC
/begin CHARACTERISTIC KL_HFM_ANZ_SEG_N "Anzahl der Seg. fuer die MW" CURVE 0x7232C TKL_SW_VV_UW 100.0 FORMULA_0083 1.0000 6.0000 /begin AXIS_DESCR STD_AXIS n FORMULA_0006 4 0.0 10000.0000 /end AXIS_DESCR FORMAT "%5.2" /end CHARACTERISTIC
/begin CHARACTERISTIC KL_RF_TAN_KORR "-" CURVE 0x7233E TKL_SW_VV_UW 100.0 FORMULA_0075 0.0 4.0000
 /begin AXIS_DESCR STD_AXIS temperatur FORMULA_0023 8 -50.0000 170.0000 FORMAT "%4.1" /end AXIS_DESCR
 FORMAT "%6.3" /end CHARACTERISTIC
/begin CHARACTERISTIC KL_RF_TANZYL_KORR "-" CURVE 0x72360 TKL_SW_VV_UW 100.0 FORMULA_0075 0.0 4.0000
 /begin AXIS_DESCR STD_AXIS temperatur FORMULA_0023 8 -50.0000 170.0000 FORMAT "%4.1" /end AXIS_DESCR
 FORMAT "%6.3" /end CHARACTERISTIC
/begin CHARACTERISTIC KL_RF_PUMG_KORR "Korrekturfaktor in Abh. vom Luftdruck" CURVE 0x72382 TKL_SW_VV_UW 100.0 FORMULA_0075 0.0 4.0000
 /begin AXIS_DESCR STD_AXIS pumg FORMULA_0077 8 400.0000 1200.0000 FORMAT "%4.1" /end AXIS_DESCR
 FORMAT "%6.3" /end CHARACTERISTIC
/begin CHARACTERISTIC KL_HFM_KORR_ML_FZG "ML Korrektur im FZG" CURVE 0x723A4 TKL_SW_VV_UW 100.0 FORMULA_0075 0.0 4.0000
 /begin AXIS_DESCR STD_AXIS ml FORMULA_0112 8 -100.0000 1400.0000 FORMAT "%4.1" /end AXIS_DESCR
 FORMAT "%6.3" /end CHARACTERISTIC
/begin CHARACTERISTIC KL_HFM_KORR_ML_PST "ML Korrektur im PST" CURVE 0x723C6 TKL_SW_VV_UW 100.0 FORMULA_0075 0.0 4.0000
 /begin AXIS_DESCR STD_AXIS ml FORMULA_0112 8 -100.0000 1400.0000 FORMAT "%4.1" /end AXIS_DESCR
 FORMAT "%6.3" /end CHARACTERISTIC
/begin CHARACTERISTIC KL_HFM_FAK_S65_B1 "Faktor fuer Aufteileung des HFM am S65" CURVE 0x723E8 TKL_SW_VV_UW 100.0 FORMULA_0075 0.0 4.0000 /begin AXIS_DESCR STD_AXIS n FORMULA_0006 4 0.0 10000.0000 /end AXIS_DESCR FORMAT "%6.3" /end CHARACTERISTIC
/begin CHARACTERISTIC KL_HFM_FAK_S65_B2 "Faktor fuer Aufteileung des HFM am S65" CURVE 0x723FA TKL_SW_VV_UW 100.0 FORMULA_0075 0.0 4.0000 /begin AXIS_DESCR STD_AXIS n FORMULA_0006 4 0.0 10000.0000 /end AXIS_DESCR FORMAT "%6.3" /end CHARACTERISTIC
/begin CHARACTERISTIC KF_HFM_KORR_ML_TAN "ml Korrektur ueber TAN und ml" MAP 0x7240C TKF_SW_SW_UW 100.0 FORMULA_0075 0.0 4.0000
 /begin AXIS_DESCR STD_AXIS ml FORMULA_0112 4 -100.0000 1400.0000 FORMAT "%4.1" /end AXIS_DESCR
 /begin AXIS_DESCR STD_AXIS temperatur FORMULA_0023 4 -50.0000 170.0000 FORMAT "%4.1" /end AXIS_DESCR
 FORMAT "%6.3" /end CHARACTERISTIC
/begin CHARACTERISTIC KF_HFM_KORR_N_RF "HFM Popel KF" MAP 0x7243E TKF_SW_SW_UW 100.0 FORMULA_0075 0.0 4.0000 /begin AXIS_DESCR STD_AXIS n FORMULA_0006 6 0.0 10000.0000 /end AXIS_DESCR /begin AXIS_DESCR STD_AXIS rf_m FORMULA_0007 6 0.0 2.0000 FORMAT "%6.3" /end AXIS_DESCR FORMAT "%6.3" /end CHARACTERISTIC
/begin CHARACTERISTIC KF_HFM_TAU "Filterkonstanten fuer die HFM Erfassung" MAP 0x724A0 TKF_SW_SW_UB 100.0 FORMULA_0664 0.0101 2.5600 /begin AXIS_DESCR STD_AXIS n FORMULA_0006 4 0.0 10000.0000 /end AXIS_DESCR
 /begin AXIS_DESCR STD_AXIS egas_aq_soll_grad_b1 FORMULA_0020 6 -30000.0000 30000.0000 /end AXIS_DESCR
/end CHARACTERISTIC
/begin MEASUREMENT hfm_b1.tan_korr "TAN Korrektur" UWORD FORMULA_0075 0 0 0.0 4.0000 ECU_ADDRESS 0x3FC01A /end MEASUREMENT
/begin MEASUREMENT hfm_b2.tan_korr "TAN Korrektur" UWORD FORMULA_0075 0 0 0.0 4.0000 ECU_ADDRESS 0x3FC0CA /end MEASUREMENT
/begin MEASUREMENT hfm_b1.ad "letzter im Segment erfasster AD-Wert" SWORD FORMULA_0123 0 0 0.0 1023.0000 ECU_ADDRESS 0x3FC01C /end MEASUREMENT
/begin MEASUREMENT hfm_b2.ad "letzter im Segment erfasster AD-Wert" SWORD FORMULA_0123 0 0 0.0 1023.0000 ECU_ADDRESS 0x3FC0CC /end MEASUREMENT
/begin MEASUREMENT hfm_b1.phy "letzter im Segment erfasster ML-Wert" SWORD FORMULA_0112 0 0 -100.0000 1400.0000 ECU_ADDRESS 0x3FC01E /end MEASUREMENT
/begin MEASUREMENT hfm_b2.phy "letzter im Segment erfasster ML-Wert" SWORD FORMULA_0112 0 0 -100.0000 1400.0000 ECU_ADDRESS 0x3FC0CE /end MEASUREMENT
/begin MEASUREMENT ml_hfm_roh_b1 "gefilteter u. gemittelter Luftmassenstrom HFM" SWORD FORMULA_0112 0 0 -100.0000 1400.0000 ECU_ADDRESS 0x3FC020 /end MEASUREMENT
/begin MEASUREMENT ml_hfm_roh_b2 "gefilteter u. gemittelter Luftmassenstrom HFM" SWORD FORMULA_0112 0 0 -100.0000 1400.0000 ECU_ADDRESS 0x3FC0D0 /end MEASUREMENT
/begin MEASUREMENT ml_hfm_b1 "Luftmassenstrom HFM inkl. aller Korr" SWORD FORMULA_0112 0 0 -100.0000 1400.0000 ECU_ADDRESS 0x3FC022 /end MEASUREMENT
/begin MEASUREMENT ml_hfm_b2 "Luftmassenstrom HFM inkl. aller Korr" SWORD FORMULA_0112 0 0 -100.0000 1400.0000 ECU_ADDRESS 0x3FC0D2 /end MEASUREMENT
/begin MEASUREMENT mzyl_hfm_b1 "Ges.masse Zyl" SWORD FORMULA_0113 0 0 -500.0000 1500.0000 ECU_ADDRESS 0x3FC024 /end MEASUREMENT
/begin MEASUREMENT mzyl_hfm_b2 "Ges.masse Zyl" SWORD FORMULA_0113 0 0 -500.0000 1500.0000 ECU_ADDRESS 0x3FC0D4 /end MEASUREMENT
/begin MEASUREMENT hfm_b1.trig_lost "Verlohrene Samples aufsummiert ueber ganze Laufzeit" SBYTE FORMULA_0033 0 0 -128.0000 127.0000 ECU_ADDRESS 0x3FC026 /end MEASUREMENT
/begin MEASUREMENT hfm_b2.trig_lost "Verlohrene Samples aufsummiert ueber ganze Laufzeit" SBYTE FORMULA_0033 0 0 -128.0000 127.0000 ECU_ADDRESS 0x3FC0D6 /end MEASUREMENT
/begin MEASUREMENT hfm_b1.trig_seg "Samples per Segment" UBYTE FORMULA_0033 0 0 0.0 255.0000 ECU_ADDRESS 0x3FC027 /end MEASUREMENT
/begin MEASUREMENT hfm_b2.trig_seg "Samples per Segment" UBYTE FORMULA_0033 0 0 0.0 255.0000 ECU_ADDRESS 0x3FC0D7 /end MEASUREMENT
/begin MEASUREMENT hfm_5ms_ad_1of2_ "Eingelesener Spannungswert 5ms" SWORD FORMULA_0123 0 0 0.0 1023.0000 ECU_ADDRESS 0x3FC17A /end MEASUREMENT
/begin MEASUREMENT hfm_5ms_ad_2of2_ "Eingelesener Spannungswert 5ms" SWORD FORMULA_0123 0 0 0.0 1023.0000 ECU_ADDRESS 0x3FC17C /end MEASUREMENT
/begin MEASUREMENT hfm_ml_5ms_b1 "Luftmassenstrom aus HFM" SWORD FORMULA_0112 0 0 -100.0000 1400.0000 ECU_ADDRESS 0x3FC17E /end MEASUREMENT
/begin MEASUREMENT hfm_ml_5ms_b2 "Luftmassenstrom aus HFM" SWORD FORMULA_0112 0 0 -100.0000 1400.0000 ECU_ADDRESS 0x3FC180 /end MEASUREMENT
/begin MEASUREMENT hfm_tau "Filtertaukonstante" UBYTE FORMULA_0719 0 0 0.0101 2.5600 ECU_ADDRESS 0x3FC182 /end MEASUREMENT
/begin MEASUREMENT hfm_seg_tau "Filtertaukonstante fuer die Segmentberech." UBYTE FORMULA_0719 0 0 0.0101 2.5600 ECU_ADDRESS 0x3FC183 /end MEASUREMENT
/begin MEASUREMENT hfm_tpu_trig_error "Summe Fehltriggerungen TPU -> QADC" SBYTE FORMULA_0033 0 0 -128.0000 127.0000 ECU_ADDRESS 0x3FC184 /end MEASUREMENT
/begin MEASUREMENT hfm_qadc_trig_error "Summe Fehltriggerungen read QADC" SBYTE FORMULA_0033 0 0 -128.0000 127.0000 ECU_ADDRESS 0x3FC185 /end MEASUREMENT
/begin MEASUREMENT hfm_sek_ml_mvac_1of2_ "Luftmassenstrom aus MVAC" SWORD FORMULA_0112 0 0 -100.0000 1400.0000 ECU_ADDRESS 0x3FC186 /end MEASUREMENT
/begin MEASUREMENT hfm_sek_ml_mvac_2of2_ "Luftmassenstrom aus MVAC" SWORD FORMULA_0112 0 0 -100.0000 1400.0000 ECU_ADDRESS 0x3FC188 /end MEASUREMENT
/begin MEASUREMENT hfm_sek_ml_ssp_1of2_ "Wirksame HFM-Korrektur aus SSP" SWORD FORMULA_0112 0 0 -100.0000 1400.0000 ECU_ADDRESS 0x3FC18A /end MEASUREMENT
/begin MEASUREMENT hfm_sek_ml_ssp_2of2_ "Wirksame HFM-Korrektur aus SSP" SWORD FORMULA_0112 0 0 -100.0000 1400.0000 ECU_ADDRESS 0x3FC18C /end MEASUREMENT
/* ------------------ Abschnitt erzeugt aus inj_tb.dat ------------------ */
/begin CHARACTERISTIC K_ITB_CFG "Konfiguration" VALUE 0x72DD4 TKW_VV_VV_UB 100.0 FORMULA_0726 0.0 255.0 /end CHARACTERISTIC
/begin MEASUREMENT injt_status_mc "Status" UBYTE FORMULA_0003 0 0 0.0 255.0000 ECU_ADDRESS 0x3FC1EC /end MEASUREMENT
/begin MEASUREMENT injt_status_tb "Status" UBYTE FORMULA_0723 0 0 0.0 255.0 ECU_ADDRESS 0x3FC1ED /end MEASUREMENT
/begin MEASUREMENT injt_run "Run-Bit" UBYTE FORMULA_0003 0 0 0.0 255.0000 ECU_ADDRESS 0x3FC1EE /end MEASUREMENT
/begin MEASUREMENT injt_time "Injection Time" UWORD FORMULA_0724 0 0 0.0 655350.0000 ECU_ADDRESS 0x3FC1F0 /end MEASUREMENT
/begin MEASUREMENT injt_freq "Frequenz" UWORD FORMULA_0725 0 0 0.0 65535.0000 ECU_ADDRESS 0x3FC1F2 /end MEASUREMENT
/begin MEASUREMENT injt_pulse_count "Sollanzahl der Impulse" UWORD FORMULA_0010 0 0 0.0 65535.0000 ECU_ADDRESS 0x3FC1F4 /end MEASUREMENT
/begin MEASUREMENT injt_pulse_rem "Istanzahl der Impulse" UWORD FORMULA_0010 0 0 0.0 65535.0000 ECU_ADDRESS 0x3FC1F6 /end MEASUREMENT
/begin MEASUREMENT injt_pf_avg "gem. Druck" SWORD FORMULA_0118 0 0 0.0 10.0000 ECU_ADDRESS 0x3FC1F8 /end MEASUREMENT
/begin MEASUREMENT injt_pf_min "min. Druck" SWORD FORMULA_0118 0 0 0.0 10.0000 ECU_ADDRESS 0x3FC1FA /end MEASUREMENT
/begin MEASUREMENT injt_pf_max "max. Druck" SWORD FORMULA_0118 0 0 0.0 10.0000 ECU_ADDRESS 0x3FC1FC /end MEASUREMENT
/begin MEASUREMENT injt_pf_dev "Std-Abw. Druck" SWORD FORMULA_0118 0 0 0.0 10.0000 ECU_ADDRESS 0x3FC1FE /end MEASUREMENT
/begin MEASUREMENT injt_tf_avg "gem. Temperatur" SWORD FORMULA_0023 0 0 -50.0000 170.0000 ECU_ADDRESS 0x3FC200 /end MEASUREMENT
/begin MEASUREMENT injt_tf_min "min. Temperatur" SWORD FORMULA_0023 0 0 -50.0000 170.0000 ECU_ADDRESS 0x3FC202 /end MEASUREMENT
/begin MEASUREMENT injt_tf_max "gem. Temperatur" SWORD FORMULA_0023 0 0 -50.0000 170.0000 ECU_ADDRESS 0x3FC204 /end MEASUREMENT
/begin MEASUREMENT injt_tf_dev "Std-Abw. Temperatur" SWORD FORMULA_0076 0 0 -1000.0000 1000.0000 ECU_ADDRESS 0x3FC206 /end MEASUREMENT
/begin MEASUREMENT injt_ub_avg "gem. Ub" SWORD FORMULA_0008 0 0 0.0 28.0000 ECU_ADDRESS 0x3FC208 /end MEASUREMENT
/begin MEASUREMENT injt_ub_min "min. Ub" SWORD FORMULA_0008 0 0 0.0 28.0000 ECU_ADDRESS 0x3FC20A /end MEASUREMENT
/begin MEASUREMENT injt_ub_max "max. Ub" SWORD FORMULA_0008 0 0 0.0 28.0000 ECU_ADDRESS 0x3FC20C /end MEASUREMENT
/begin MEASUREMENT injt_ub_dev "Std-Abw. Ub" SWORD FORMULA_0008 0 0 0.0 28.0000 ECU_ADDRESS 0x3FC20E /end MEASUREMENT
/begin MEASUREMENT injt_mask "Zylindermaske" UWORD FORMULA_0010 0 0 0.0 65535.0000 ECU_ADDRESS 0x3FC210 /end MEASUREMENT
/begin MEASUREMENT injt_sample_cnt "Sampling Counter" UWORD FORMULA_0010 0 0 0.0 65535.0000 ECU_ADDRESS 0x3FC212 /end MEASUREMENT
/begin MEASUREMENT injt_timeout "Timeout" UWORD FORMULA_0117 0 0 0.0 325.0000 ECU_ADDRESS 0x3FC214 /end MEASUREMENT
/begin FUNCTION Global "" /begin DEF_CHARACTERISTIC /end DEF_CHARACTERISTIC /begin REF_CHARACTERISTIC /end REF_CHARACTERISTIC /begin IN_MEASUREMENT /end IN_MEASUREMENT
 /begin OUT_MEASUREMENT B_CAN_ANHAENGER B_CAN_HBR B_CAN_KOMBI_MIL B_KH_ST_EINGRIFF B_KH_ST_N B_KH_ST_PKSR_PL_ZYKLUS B_KH_ST_RF B_KH_ST_SK B_KH_ST_SMG B_KH_ST_TKAT B_KH_ST_TKAT_ZYKLUS B_KH_ST_T_ML B_KH_ST_VTKAT B_KH_ST_VTKAT_ZYKLUS B_KH_VAN B_LLR_EINGEREGELT B_LLR_GRUNDDREHZAHL B_LLR_MIN_BEGR B_TE_OBD_ABBRUCH B_TE_OBD_CHECK B_TE_OBD_KKOS_ABSCH B_TE_OBD_KKOS_FAIL B_TE_OBD_LAM_REG_OFF B_TE_OBD_PRE_CHECK B_TE_OBD_START_EXD B_TE_OBD_S_BLS_OLD B_VAN_SK B_genoff_copy B_oztemp_bsd_ok B_oztemp_obd_ok Md_gennm_copy N_idlgspec_copy Nslb_copy Oz_tempr afz afz_berg aq_eingeregelt_st aq_rel_1of2_ aq_rel_2of2_ aq_rf_b1 aq_rf_b2 at_sa_sperre auss_erk auss_erk_zyl1 auss_erk_zyl10 auss_erk_zyl2 auss_erk_zyl3 auss_erk_zyl4 auss_erk_zyl5 auss_erk_zyl6 auss_erk_zyl7 auss_erk_zyl8 auss_erk_zyl9 auss_lp_int_sum_b1 auss_lp_int_sum_b2 auss_nw_sync_b1 auss_nw_sync_b2 auss_obd_zyl_off auss_st_b1 auss_st_b2 auss_st_ns_b1 auss_st_ns_b2 auss_st_ti_b1 auss_st_ti_b2 can_a_st can_ax can_ay can_bedfgr can_brp can_brp_grad can_brp_st can_dsc_eingr can_dsc_md_soll can_dsc_md_soll_pos can_dsc_reg can_dsc_st can_flags can_flags_mm can_flags_obd_ed can_fst_sum can_fzg_st can_gang_r can_kkos_md can_kkos_st can_kkos_st_nll can_kkos_st_zh can_klst_s can_kmst_st can_lrw can_lrw_st can_lrw_v can_no_key can_obd_fst_li_ed can_obd_fst_li_roh can_obd_fst_re_ed can_obd_fst_re_roh can_obd_tumg_ed can_obd_tumg_roh can_s_tns can_st_atemp can_st_bedfgr can_st_dsc can_st_empf can_st_empf_hys can_st_kkos can_st_klst can_st_stkombi can_st_torqdsc can_st_vehmod can_st_vfzg can_st_vrad can_stkombi_fgr can_stkombi_s can_toma_st can_v_st can_vehmod cbs_reset_st ccp_fp_st_ign ccp_fp_st_inj diag_ev_tz_st dr_rel_b1 dr_rel_b2 dr_rel_grad_b1 dr_rel_grad_b2 dwf_n_orange egas_aq_max_kf egas_aq_soll_b1 egas_aq_soll_b2 egas_aq_soll_grad_b1 egas_aq_soll_grad_b2 egas_aq_soll_roh_1of2_ egas_aq_soll_roh_2of2_ egas_ist_dk_b1 egas_ist_dk_b2 egas_ist_lls_b1 egas_ist_lls_b2 egas_ist_wdk_b1 egas_ist_wdk_b2 egas_rec_dk_r_hw_vers_b1 egas_rec_dk_r_hw_vers_b2 egas_sk_mode egas_sk_ti_st egas_soll_dk_b1 egas_soll_dk_b2 egas_soll_lls_b1 egas_soll_lls_b2 egas_st_b1 egas_st_b2 egas_st_dk_b1 egas_st_dk_b2 egas_st_ft_b1 egas_st_ft_b2 egas_wdk1_abs_obd_mode_1_2 egas_wdk_adapt_b1 egas_wdk_adapt_b2 elup_ed_st elup_st evap_wdk_ist_b1 evap_wdk_ist_b2 exd_tester_timeout fgr_anzeige_kombi fgr_cc_message fgr_sa_sperre fgr_status fgr_status_hud fgr_status_kombi fgr_v_kombi fr_einger_st fr_reg_out_1of2_ fr_reg_out_2of2_ gang gang_berech gang_berech_kl_i gang_berech_kl_i_dist gang_berech_st gang_berech_st_aktion gang_berech_st_gerade gang_berech_st_neu gang_berech_st_plaus gang_berech_st_uebern gang_berech_st_unbek gang_berech_st_ungerade gang_can gang_ks gang_n_verh hdw_ign hdw_ign_st hdw_inj hdw_inj_st hfm_ml_b1_obd_mode_1_2 j_gesamt k2KB_bytes_ign k2KB_req_inj k2KB_resp_ign k2KB_sid_ign ka_dtz_sum_all ka_dtz_sum_b1 ka_dtz_sum_b2 ka_tz_nv_sum_all ka_tz_nv_sum_b1 ka_tz_nv_sum_b2 kat_obd_zust_st_b1 kat_obd_zust_st_b2 kh_lam_soll_b1 kh_lam_soll_b2 kh_st kh_st_xx kh_van_fakt_kf_Auslass kh_van_fakt_kf_Einlass kh_van_soll_offs_A1 kh_van_soll_offs_A2 kh_van_soll_offs_E1 kh_van_soll_offs_E2 kl87_st kr_dtz_sum_b1 kr_dtz_sum_b2 kva_can kw_diag kwp_fp_st_ign kwp_fp_st_inj lam_delta_lim_b1 lam_delta_lim_b2 lam_ist_ers_b1 lam_ist_ers_b2 lam_ist_mw_b1 lam_ist_mw_b2 lam_reg_f_b1 lam_reg_f_b2 lam_reg_max_b1 lam_reg_max_b2 lam_reg_min_b1 lam_reg_min_b2 lam_reg_reset_sa_b1 lam_reg_reset_sa_b2 lam_reg_reset_slp_b1 lam_reg_reset_slp_b2 lam_reg_st_b1 lam_reg_st_b2 lam_reg_stat_b1 lam_reg_stat_b2 lam_reg_stat_trim_b1 lam_reg_stat_trim_b2 lam_regler_st_b1 lam_regler_st_b2 lam_soll_b1 lam_soll_b2 lam_soll_ms_kat_b1 lam_soll_ms_kat_b2 lam_soll_puls_adapt_fett_b1 lam_soll_puls_adapt_fett_b2 lam_soll_puls_adapt_mager_b1 lam_soll_puls_adapt_mager_b2 lam_soll_puls_ausr_b1 lam_soll_puls_ausr_b2 lam_soll_puls_ausr_sl_b1 lam_soll_puls_ausr_sl_b2 lam_soll_puls_ausr_sl_trig_b1 lam_soll_puls_ausr_sl_trig_b2 lam_soll_puls_b1 lam_soll_puls_b2 lam_soll_puls_fett_betrieb_b1 lam_soll_puls_fett_betrieb_b2 lam_soll_puls_freigabe_b1 lam_soll_puls_freigabe_b2 lam_soll_puls_lam_filt_b1 lam_soll_puls_lam_filt_b2 lam_soll_puls_st_b1 lam_soll_puls_st_b2 lam_soll_vl_max lam_soll_wl lam_ti_min_b1 lam_ti_min_b2 lam_wf_verz_b1 lam_wf_verz_b2 lavk_obd_act_exd_n_soll lavk_obd_dyn_exd_b1 lavk_obd_dyn_exd_b2 lavk_obd_dyn_exd_fett__b1 lavk_obd_dyn_exd_fett__b2 lavk_obd_dyn_io_verz_b1 lavk_obd_dyn_io_verz_b2 lavk_obd_dyn_kat_exd_n_soll lavk_obd_dyn_max_b1 lavk_obd_dyn_max_b2 lavk_obd_dyn_min_b1 lavk_obd_dyn_min_b2 lavk_obd_dyn_st_b1 lavk_obd_dyn_st_b2 lavk_obd_dyn_zustand_b1 lavk_obd_dyn_zustand_b2 llr_flags llr_n_soll llr_state md_can_begr_st md_can_kkos_max md_dsc_freig_st md_dsc_sperr_st md_fw_bls md_fw_rel md_ind_ml_st md_ind_ne md_ind_opt_la_rg_zw_min md_ind_schlepp_ist md_ind_schlepp_min md_ind_tz_st md_kkos_fil md_kupp_ist md_kupp_ist_ve md_kupp_max md_kupp_max_can md_kupp_min md_kupp_min_filter md_kupp_wunsch md_kupp_wunsch_begr md_kupp_wunsch_filter_rel md_kupp_wunsch_ml md_kupp_wunsch_tz md_max_fak_power md_ml_soll md_nbegr_st md_nbegr_t md_rf_max md_rf_max_roh md_rf_min_pt md_rf_soll_pt md_sk_mode md_sk_ti_st md_st md_tz_soll_mittel md_vbegr_st md_wunsch_rel mdrv_st mdrv_st_dme mdrv_st_dsc_akt mdrv_st_mod_albv_akt mdrv_st_mod_edck_akt mdrv_st_mod_eng_akt mdrv_st_mod_hud_akt mdrv_st_mod_smg_akt mdrv_st_stg_smg_akt ml_b1 ml_b2 ml_ges msg_rec_cc msg_rec_cc_dsc mvac_aq_bre mvac_ed_st mvac_p mvac_p_mess mvac_p_modell mvac_pdiff_um mvac_rf_sr mzyl_ml_b1 mzyl_ml_b2 mzyl_sek_rf_mvac_1of2_ mzyl_sek_rf_mvac_2of2_ mzyl_sek_rf_ssp n n_begr_egas n_begr_st n_dyn_st n_e2 n_getr_abtrieb n_getr_ein n_grad_asp n_grad_segment nw_asp_cnt nw_asp_cnt_ml nw_st nwm_state pctrl_t_ign pctrl_t_inj pks_ist pks_ist_obd_mode_1_2 pks_rel pksr_b_ekp2 pksr_exd_md_fw_st pksr_exd_zust_pl psau_rel_b1 psau_rel_b2 pumg pwg1_abs_obd_mode_1_2 pwg2_abs_obd_mode_1_2 pwg_kd_st pwg_kd_st_kickdown pwg_mode pwg_soll rf_aq_b1 rf_aq_b2 rf_b1 rf_b2 rf_dyn rf_dyn_delta rf_e2_b1 rf_e2_b2 rf_e2_m rf_fil_b1 rf_fil_b2 rf_grad_b1 rf_grad_b2 rf_hfm_b1 rf_hfm_b2 rf_m rf_psau_b1 rf_psau_b2 rf_pt_korr rf_pt_korr_e2 rf_pt_korr_zyl rg_m_delta_ist_stat_b1 rg_m_delta_ist_stat_b2 rg_x_b1 rg_x_b2 rg_x_delta_b1 rg_x_delta_b2 rg_x_m rg_x_m_stat rps_auss_st rps_cfg rps_dyn_fil_st rps_evap_tv rps_ionen_st rps_ionen_stufe rps_kupp_min_filter rps_kupp_wunsch_fil_roh rps_kupp_wunsch_filter rps_llr_md_ad rps_llr_md_i rps_llr_md_p rps_llr_md_tz rps_llr_n_soll rps_llr_st rps_msa_diag_st rps_msa_st rps_rec1_cnt rps_rec2_cnt rps_tz_offs_10of10_ rps_tz_offs_1of10_ rps_tz_offs_2of10_ rps_tz_offs_3of10_ rps_tz_offs_4of10_ rps_tz_offs_5of10_ rps_tz_offs_6of10_ rps_tz_offs_7of10_ rps_tz_offs_8of10_ rps_tz_offs_9of10_ rps_zyl_nr s_kraftschluss_smg s_kraftschluss_smg_e2 sa_aktive_time sa_n_we sa_we_st schalter_bls_ign schalter_bls_ign_e2 schalter_bls_inj schalter_bls_inj_e2 schalter_blts schalter_blts_e2 schalter_getriebe schalter_getriebe_e2 schalter_kl87 schalter_kl87_e2 schalter_kraft_hs schalter_kraft_hs_e2 schalter_kupplung schalter_kupplung_e2 schalter_poel schalter_poel_e2 schalter_power schalter_power_e2 schalter_schaltung schalter_schaltung_e2 schalter_st_ign schalter_st_ign_e2 schalter_st_inj schalter_st_inj_e2 schalter_wakeup_ign schalter_wakeup_ign_e2 schalter_wakeup_inj schalter_wakeup_inj_e2 schalter_zustand_poel schalter_zustand_poel_e2 sk_egas_off_ign sk_egas_off_inj sk_eingr_st_ign sk_eingr_st_inj sk_fr_st_ign sk_fr_st_inj sk_fra_st_ign sk_fra_st_inj sk_hw_pwg1s_ad sk_kh_st_ign sk_kh_st_inj sk_lam_st_ign_b1 sk_lam_st_ign_b2 sk_lam_st_inj_b1 sk_lam_st_inj_b2 sk_llra_st_ign sk_llra_st_inj sk_md_begr_ign sk_md_begr_inj sk_md_eingr_ign sk_md_eingr_inj sk_mzyl_st_ign sk_mzyl_st_inj sk_pks_st_ign sk_pks_st_inj sk_ti_eingr_ign sk_ti_eingr_inj sk_ti_zyl_off_ign sk_ti_zyl_off_inj sk_tr_req sk_tr_resp sk_tr_result sk_tz_eingr_ign sk_tz_eingr_inj sk_van_st_ign sk_van_st_inj sl_ml_hfm sl_zwd_tv slp_st sls_obdh_st slv_st smg_ax_berg smg_ax_mess_filter smg_can_error smg_can_flags smg_can_flags_kl87 smg_can_flags_mm smg_can_modul smg_can_n_getr_ein smg_can_n_getr_ziel smg_can_prog_info smg_n_getr_anschluss smg_schaltart smg_schaltart_aks smg_schaltart_automat smg_schaltart_eingr smg_schaltart_hr smg_schaltart_lw smg_schaltart_rs smg_schaltart_zs smg_sk_mode smg_st_dme smg_st_mot smg_st_mot_sa smg_st_mot_ti smg_st_mot_tl smg_t_abregel smg_t_aufregel ssp_diag_st ssp_st start_rl_atic39_dpr start_rl_diag_dpr sw_confg_betriebsmode_exd tabg_filter_b1 tabg_filter_b2 tabg_kat_b1 tabg_kat_b2 tabg_lw_b1 tabg_lw_b2 tabg_lw_verh_b1 tabg_lw_verh_b2 tabg_lw_verh_wurzel_b1 tabg_lw_verh_wurzel_b2 tabg_nkat_b1 tabg_nkat_b2 tabg_nkat_modell_b1 tabg_nkat_modell_b2 tabg_st tabg_st_aufregeln_b1 tabg_st_aufregeln_b2 tabg_st_init_b1 tabg_st_init_b2 tabg_st_kat_obd_grad_b1 tabg_st_kat_obd_grad_b2 tabg_vkat_b1 tabg_vkat_b2 tan_b1 tan_b2 tan_e2 tan_mw tan_obd_mode_1_2 tdme te_diag_sh_to_x_sperren_b1 te_diag_sh_to_x_sperren_b2 te_n_stat1 te_n_stat2 te_not_spuelen te_obd_flags te_rf_ist_1of2_ te_rf_ist_2of2_ te_rf_stat1 te_rf_stat2 te_spuelen_abbr te_spuelen_dauer te_spuelen_stop te_st te_st_zul te_tv_b1 te_tv_b2 te_van_stat1 te_van_stat2 te_zust_st tgetr ti_ausblend_ist_b1 ti_ausblend_ist_b2 ti_ev_ed_b1 ti_ev_ed_b2 ti_pks_up_st ti_rf_max ti_tpu_st ti_zyl_tz time_abs time_kl15_off time_kl15_on time_ll time_ml time_ms time_rel time_sa time_st time_vl tka tmot tmot_modell tmot_obd_mode_1_2 tmot_sta tmot_sta_zws toel toel_can toel_modell toel_roh_obd toel_start_ok tsgrw_b1 tsgrw_b2 tsgrw_m tumg tumg_ersatz tumg_st tz_diag_tpu_err tz_grad_b1 tz_grad_b2 tz_min_b1 tz_min_b2 tz_ve_mw tz_zyl_ti u_wakeup ub ub_roh uext_korr_pin_111_219_514 uext_korr_pin_124_512 uext_pin_111_219_514 uext_pin_124_512 v_direkt v_hinten v_max_anh_st v_max_delta v_max_schw_can v_max_schw_direkt v_rad_hl v_rad_hr v_rad_vl v_rad_vr v_tacho v_vorne van_exd_n_soll van_exd_st van_ist_A1 van_ist_A2 van_ist_E1 van_ist_E2 van_sk_st van_soll_A1 van_soll_A2 van_soll_E1 van_soll_E2 zust_md_rel_tl_vl zust_time_st zust_tka_start zust_tmot_start zustand_fahrzeug zustand_motor /end OUT_MEASUREMENT
/end FUNCTION
/begin FUNCTION HFM ""
 /begin DEF_CHARACTERISTIC KF_HFM_KORR_ML_TAN KF_HFM_KORR_N_RF KF_HFM_TAU KL_HFM_ANZ_SEG_N KL_HFM_FAK_S65_B1 KL_HFM_FAK_S65_B2 KL_HFM_KORR_ML_FZG KL_HFM_KORR_ML_PST KL_RF_PUMG_KORR KL_RF_TANZYL_KORR KL_RF_TAN_KORR K_HFM_DIAG_ML_MAX K_HFM_DIAG_ML_MIN K_HFM_ERSATZ K_HFM_KL_CFG K_HFM_MVAC_CFG K_HFM_N_RF_KORR_CFG K_HFM_OBD_DYN_DELTA_RF K_HFM_OBD_DYN_RF_T K_HFM_SSP_FAK_1of2_ K_HFM_SSP_FAK_2of2_ /end DEF_CHARACTERISTIC
 /begin REF_CHARACTERISTIC /end REF_CHARACTERISTIC
 /begin IN_MEASUREMENT /end IN_MEASUREMENT
 /begin OUT_MEASUREMENT hfm_5ms_ad_1of2_ hfm_5ms_ad_2of2_ hfm_b1.ad hfm_b1.phy hfm_b1.tan_korr hfm_b1.trig_lost hfm_b1.trig_seg hfm_b2.ad hfm_b2.phy hfm_b2.tan_korr hfm_b2.trig_lost hfm_b2.trig_seg hfm_ml_5ms_b1 hfm_ml_5ms_b2 hfm_qadc_trig_error hfm_seg_tau hfm_sek_ml_mvac_1of2_ hfm_sek_ml_mvac_2of2_ hfm_sek_ml_ssp_1of2_ hfm_sek_ml_ssp_2of2_ hfm_tau hfm_tpu_trig_error ml_hfm_b1 ml_hfm_b2 ml_hfm_roh_b1 ml_hfm_roh_b2 mzyl_hfm_b1 mzyl_hfm_b2 /end OUT_MEASUREMENT
/end FUNCTION
/begin FUNCTION INJ-TB "" /begin DEF_CHARACTERISTIC K_ITB_CFG /end DEF_CHARACTERISTIC /begin REF_CHARACTERISTIC /end REF_CHARACTERISTIC /begin IN_MEASUREMENT /end IN_MEASUREMENT
 /begin OUT_MEASUREMENT injt_freq injt_mask injt_pf_avg injt_pf_dev injt_pf_max injt_pf_min injt_pulse_count injt_pulse_rem injt_run injt_sample_cnt injt_status_mc injt_status_tb injt_tf_avg injt_tf_dev injt_tf_max injt_tf_min injt_time injt_timeout injt_ub_avg injt_ub_dev injt_ub_max injt_ub_min /end OUT_MEASUREMENT
/end FUNCTION
/begin FUNCTION Inter_Prozessor_Kommunikation "" /begin DEF_CHARACTERISTIC K_IPK_INJ_T_SYNC_MAX /end DEF_CHARACTERISTIC /begin REF_CHARACTERISTIC /end REF_CHARACTERISTIC /begin IN_MEASUREMENT /end IN_MEASUREMENT
 /begin OUT_MEASUREMENT ipk_error_100ms.cnt ipk_error_100ms.type ipk_error_10ms.cnt ipk_error_10ms.type ipk_error_5ms.cnt ipk_error_5ms.type ipk_error_bgnd.cnt ipk_error_bgnd.type ipk_error_kwp.cnt ipk_error_kwp.type ipk_error_segm.cnt ipk_error_segm.type /end OUT_MEASUREMENT
/end FUNCTION
/begin FUNCTION KFIPOL "" /begin DEF_CHARACTERISTIC /end DEF_CHARACTERISTIC /begin REF_CHARACTERISTIC /end REF_CHARACTERISTIC /begin IN_MEASUREMENT /end IN_MEASUREMENT /begin OUT_MEASUREMENT /end OUT_MEASUREMENT /end FUNCTION
/begin RECORD_LAYOUT TKW_VV_VV_UB FNC_VALUES 1 UBYTE COLUMN_DIR DIRECT /end RECORD_LAYOUT
/begin RECORD_LAYOUT TKW_VV_VV_UW FNC_VALUES 1 UWORD COLUMN_DIR DIRECT /end RECORD_LAYOUT
/begin RECORD_LAYOUT TKW_VV_VV_SW FNC_VALUES 1 SWORD COLUMN_DIR DIRECT /end RECORD_LAYOUT
/begin RECORD_LAYOUT TKW_VV_VV_UL FNC_VALUES 1 ULONG COLUMN_DIR DIRECT /end RECORD_LAYOUT
/begin RECORD_LAYOUT TKL_SW_VV_UW NO_AXIS_PTS_X 1 UBYTE RESERVED 2 BYTE AXIS_PTS_X 3 SWORD INDEX_INCR DIRECT FNC_VALUES 4 UWORD COLUMN_DIR DIRECT /end RECORD_LAYOUT
/begin RECORD_LAYOUT TKF_SW_SW_UB NO_AXIS_PTS_X 1 UBYTE NO_AXIS_PTS_Y 2 UBYTE AXIS_PTS_X 3 SWORD INDEX_INCR DIRECT AXIS_PTS_Y 4 SWORD INDEX_INCR DIRECT FNC_VALUES 5 UBYTE COLUMN_DIR DIRECT /end RECORD_LAYOUT
/begin RECORD_LAYOUT TKF_SW_SW_UW NO_AXIS_PTS_X 1 UBYTE NO_AXIS_PTS_Y 2 UBYTE AXIS_PTS_X 3 SWORD INDEX_INCR DIRECT AXIS_PTS_Y 4 SWORD INDEX_INCR DIRECT FNC_VALUES 5 UWORD COLUMN_DIR DIRECT /end RECORD_LAYOUT
/end MODULE
/end PROJECT
