/begin PROJECT MSS65-inj-V452 "MSS65 INJ - V452.01-B204.00, data set 0569Q60Z160E"
/begin HEADER "" VERSION "V452.01-B204.00" /end HEADER
/begin MODULE _MSS65-inj "MSS65 INJ - V452.01-B204.00, calibration xxxxxxxx"
/begin MOD_COMMON "" BYTE_ORDER MSB_FIRST /* Default byteorder (Motorola) */ /end MOD_COMMON
/* TPU KW FORMELN ------------------------------------------------------------------------*/
/begin COMPU_METHOD FORMULA_KW1 "FORMULA_KW1" RAT_FUNC "%5.0" "-" COEFFS 0 256 128 0 0 1 /end COMPU_METHOD
/begin COMPU_METHOD FORMULA_KW2 "FORMULA_KW2" RAT_FUNC "%5.0" "-" COEFFS 0 64 0 0 0 1 /end COMPU_METHOD
/begin COMPU_METHOD FORMULA_KW3 "FORMULA_KW3" TAB_VERB "%5.0" "-" COMPU_TAB_REF FORMULA_KW3_VTAB /end COMPU_METHOD
/begin COMPU_VTAB FORMULA_KW3_VTAB "FORMULA_KW3_VTAB" TAB_VERB 13 0 "ini" 1 "1st edge" 2 "second edge" 3 "wait teeth" 4 "search gap" 5 "1st missing required" 6 "last tooth until gap" 7 "1st missing tooth" 8 "2nd missing tooth" 9 "1st tooth after gap" 10 "2nd tooth after gap" 11 "tooth 2..56, 62..116" 12 "gap required" DEFAULT_VALUE "1 undefined" /end COMPU_VTAB
/begin COMPU_METHOD FORMULA_KW4 "FORMULA_KW4" RAT_FUNC "%5.0" "-" COEFFS 0 1 0 0 0 1 /end COMPU_METHOD
/begin COMPU_METHOD FORMULA_KW5 "FORMULA_KW5" RAT_FUNC "%5.0" "Upm" COEFFS 0 0 27344 0 1 0 /end COMPU_METHOD
/begin COMPU_METHOD FORMULA_KW6 "FORMULA_KW6" RAT_FUNC "%6.4" "�" COEFFS 0 1 0 0 0 0.00004291534423828125 /end COMPU_METHOD
/begin COMPU_METHOD FORMULA_KW8 "FORMULA_KW8" RAT_FUNC "%9.2" "ms" COEFFS 0 7000 0 0 0 1 /end COMPU_METHOD
/begin COMPU_METHOD FORMULA_KW9 "FORMULA_KW9" RAT_FUNC "%7.2" "ms" COEFFS 0 1 0 0 0 2.34057 /end COMPU_METHOD
/begin COMPU_METHOD FORMULA_KW10 "FORMULA_KW10" RAT_FUNC "%7.2" "�" COEFFS 0 1 0 0 0 0.01098633 /end COMPU_METHOD
/begin COMPU_METHOD FORMULA_KW11 "FORMULA_KW11" RAT_FUNC "%7.2" "ms" COEFFS 0 7000 0 0 0 1 /end COMPU_METHOD
/begin COMPU_METHOD FORMULA_KW12 "FORMULA_KW12" RAT_FUNC "%9.2" "ms" COEFFS 0 7000 0 0 0 256 /end COMPU_METHOD
/begin COMPU_METHOD FORMULA_KW13 "FORMULA_KW13" RAT_FUNC "%12.2" "ms" COEFFS 0 840000 0 0 0 1 /end COMPU_METHOD
/* TPU KW A ------------------------------------------------------------------------------*/
/begin MEASUREMENT tpu_a_kw_irq "Interrupt request." UWORD FORMULA_KW1 0 0 0.0 255.0000 ECU_ADDRESS 0x304100 /begin FUNCTION_LIST TPU /end FUNCTION_LIST BIT_MASK 0xFF00 /end MEASUREMENT
/begin MEASUREMENT tpu_a_kw_state "Zustand." UWORD FORMULA_KW3 0 0 0.0 15.0 ECU_ADDRESS 0x304100 /begin FUNCTION_LIST TPU /end FUNCTION_LIST BIT_MASK 0x000F /end MEASUREMENT
/begin MEASUREMENT tpu_a_kw_irq_ack "Interruptquittierung." UWORD FORMULA_KW1 0 0 0.0 255.0000 ECU_ADDRESS 0x304102 /begin FUNCTION_LIST TPU /end FUNCTION_LIST BIT_MASK 0xFF00 /end MEASUREMENT
/begin MEASUREMENT tpu_a_kw_irq_zahn "Interruptzahn." UWORD FORMULA_KW4 0 0 0.0 119.0000 ECU_ADDRESS 0x304102 /begin FUNCTION_LIST TPU /end FUNCTION_LIST BIT_MASK 0x00FF /end MEASUREMENT
/begin MEASUREMENT tpu_a_kw_time_out "Unterdrehzahl." UWORD FORMULA_KW5 0 0 4.0000 10000.0000 ECU_ADDRESS 0x304104 /begin FUNCTION_LIST TPU /end FUNCTION_LIST /end MEASUREMENT
/begin MEASUREMENT tpu_a_kw_link "Link-Vektor." UWORD FORMULA_KW4 0 0 0.0 65535.0000 ECU_ADDRESS 0x304106 /begin FUNCTION_LIST TPU /end FUNCTION_LIST /end MEASUREMENT
/begin MEASUREMENT tpu_a_kw_segm_start "Segmentstart." UWORD FORMULA_KW1 0 0 0.0 119.0000 ECU_ADDRESS 0x304108 /begin FUNCTION_LIST TPU /end FUNCTION_LIST BIT_MASK 0xFF00 /end MEASUREMENT
/begin MEASUREMENT tpu_a_kw_segm_length "Segmentlaenge." UWORD FORMULA_KW4 0 0 0.0 119.0000 ECU_ADDRESS 0x304108 /begin FUNCTION_LIST TPU /end FUNCTION_LIST BIT_MASK 0x00FF /end MEASUREMENT
/begin MEASUREMENT tpu_a_kw_max_teeth_unsync "Max Anzahl Flanken zur Lueckensuche." UWORD FORMULA_KW1 0 0 0.0 127.0000 ECU_ADDRESS 0x30410A /begin FUNCTION_LIST TPU /end FUNCTION_LIST BIT_MASK 0xFF00 /end MEASUREMENT
/begin MEASUREMENT tpu_a_kw_cnt_cor "Feinaufloesung vom Zahnzaehler." UWORD FORMULA_KW6 0 0 0.0 42747.6900 ECU_ADDRESS 0x30410A /begin FUNCTION_LIST TPU /end FUNCTION_LIST BIT_MASK 0xFF00 /end MEASUREMENT
/begin MEASUREMENT tpu_a_kw_wait_teeth "Zahnentprellung vor Lueckensuche." UWORD FORMULA_KW4 0 0 0.0 127.0000 ECU_ADDRESS 0x30410A /begin FUNCTION_LIST TPU /end FUNCTION_LIST BIT_MASK 0x00FF /end MEASUREMENT
/begin MEASUREMENT tpu_a_kw_next_segm_tooth "Naechster Segmentzahn." UWORD FORMULA_KW4 0 0 0.0 119.0000 ECU_ADDRESS 0x30410A /begin FUNCTION_LIST TPU /end FUNCTION_LIST BIT_MASK 0x00FF /end MEASUREMENT
/begin MEASUREMENT tpu_a_kw_cnt_720 "720� Zahnzaehler." UWORD FORMULA_KW1 0 0 0.0 119.0000 ECU_ADDRESS 0x30410C /begin FUNCTION_LIST TPU /end FUNCTION_LIST BIT_MASK 0xFF00 /end MEASUREMENT
/begin MEASUREMENT tpu_a_kw_segm_zeit "Segmentzeitpunkt." ULONG FORMULA_KW8 0 0 0.0 2396.7450 ECU_ADDRESS 0x30410C /begin FUNCTION_LIST TPU /end FUNCTION_LIST BIT_MASK 0x00FFFFFF /end MEASUREMENT
/begin MEASUREMENT tpu_a_htu "Hight-Time-Updater." UWORD FORMULA_KW9 0 0 0.0 2394.4031 ECU_ADDRESS 0x304110 /begin FUNCTION_LIST TPU /end FUNCTION_LIST /end MEASUREMENT
/begin MEASUREMENT tpu_a_kw_count "Kurbelwellenposition." UWORD FORMULA_KW10 0 0 0.0 719.9890 ECU_ADDRESS 0x304112 /begin FUNCTION_LIST TPU /end FUNCTION_LIST /end MEASUREMENT
/begin MEASUREMENT tpu_a_kw_last_period_low "16 lsb der letzten Periode." UWORD FORMULA_KW11 0 0 0.0 9.3621 ECU_ADDRESS 0x304114 /begin FUNCTION_LIST TPU /end FUNCTION_LIST /end MEASUREMENT
/begin MEASUREMENT tpu_a_kw_last_period_high "8 msb der letzten Periode." UWORD FORMULA_KW12 0 0 0.0 255.0000 ECU_ADDRESS 0x304116 /begin FUNCTION_LIST TPU /end FUNCTION_LIST BIT_MASK 0xFF00 /end MEASUREMENT
/begin MEASUREMENT tpu_a_kw_prev_period "Vorhergehende Periode." ULONG FORMULA_KW8 0 0 0.0 2396.7450 ECU_ADDRESS 0x304116 /begin FUNCTION_LIST TPU /end FUNCTION_LIST BIT_MASK 0x00FFFFFF /end MEASUREMENT
/begin MEASUREMENT tpu_a_kw_norm_period "normierte Periode." ULONG FORMULA_KW13 0 0 0.0 2396.7450 ECU_ADDRESS 0x30411A /begin FUNCTION_LIST TPU /end FUNCTION_LIST BIT_MASK 0xFFFFFF00 /end MEASUREMENT
/begin MEASUREMENT tpu_a_kw_last_event_time "Zeitpunkt vom letzten Ereignis." ULONG FORMULA_KW8 0 0 0.0 2396.7450 ECU_ADDRESS 0x30411C /begin FUNCTION_LIST TPU /end FUNCTION_LIST BIT_MASK 0x00FFFFFF /end MEASUREMENT
/begin MEASUREMENT tpu_a_kw_last_trans_time "Zeitpunkt letzter Zahnflanke." ULONG FORMULA_KW8 0 0 0.0 2396.7450 ECU_ADDRESS 0x3041DA /begin FUNCTION_LIST TPU /end FUNCTION_LIST BIT_MASK 0x00FFFFFF /end MEASUREMENT
/* TPU KW B ------------------------------------------------------------------------------*/
/begin MEASUREMENT tpu_b_kw_irq "Interrupt request." UWORD FORMULA_KW1 0 0 0.0 255.0000 ECU_ADDRESS 0x304500 /begin FUNCTION_LIST TPU /end FUNCTION_LIST BIT_MASK 0xFF00 /end MEASUREMENT
/begin MEASUREMENT tpu_b_kw_nw_lev "A-NW Pegel bei IRQ-Zahn." UWORD FORMULA_KW2 0 0 0.0 3.0000 ECU_ADDRESS 0x304500 /begin FUNCTION_LIST TPU /end FUNCTION_LIST BIT_MASK 0x00C0 /end MEASUREMENT
/begin MEASUREMENT tpu_b_kw_state "Zustand." UWORD FORMULA_KW3 0 0 0.0 15.0 ECU_ADDRESS 0x304500 /begin FUNCTION_LIST TPU /end FUNCTION_LIST BIT_MASK 0x000F /end MEASUREMENT
/begin MEASUREMENT tpu_b_kw_irq_ack "Interruptquittierung." UWORD FORMULA_KW1 0 0 0.0 255.0000 ECU_ADDRESS 0x304502 /begin FUNCTION_LIST TPU /end FUNCTION_LIST BIT_MASK 0xFF00 /end MEASUREMENT
/begin MEASUREMENT tpu_b_kw_irq_zahn "Interruptzahn." UWORD FORMULA_KW4 0 0 0.0 119.0000 ECU_ADDRESS 0x304502 /begin FUNCTION_LIST TPU /end FUNCTION_LIST BIT_MASK 0x00FF /end MEASUREMENT
/begin MEASUREMENT tpu_b_kw_time_out "Unterdrehzahl." UWORD FORMULA_KW5 0 0 4.0000 10000.0000 ECU_ADDRESS 0x304504 /begin FUNCTION_LIST TPU /end FUNCTION_LIST /end MEASUREMENT
/begin MEASUREMENT tpu_b_kw_link "Link-Vektor." UWORD FORMULA_KW4 0 0 0.0 65535.0000 ECU_ADDRESS 0x304506 /begin FUNCTION_LIST TPU /end FUNCTION_LIST /end MEASUREMENT
/begin MEASUREMENT tpu_b_kw_segm_start "Segmentstart." UWORD FORMULA_KW1 0 0 0.0 119.0000 ECU_ADDRESS 0x304508 /begin FUNCTION_LIST TPU /end FUNCTION_LIST BIT_MASK 0xFF00 /end MEASUREMENT
/begin MEASUREMENT tpu_b_kw_segm_length "Segmentlaenge." UWORD FORMULA_KW4 0 0 0.0 119.0000 ECU_ADDRESS 0x304508 /begin FUNCTION_LIST TPU /end FUNCTION_LIST BIT_MASK 0x00FF /end MEASUREMENT
/begin MEASUREMENT tpu_b_kw_max_teeth_unsync "Max Anzahl Flanken zur Lueckensuche." UWORD FORMULA_KW1 0 0 0.0 127.0000 ECU_ADDRESS 0x30450A /begin FUNCTION_LIST TPU /end FUNCTION_LIST BIT_MASK 0xFF00 /end MEASUREMENT
/begin MEASUREMENT tpu_b_kw_cnt_cor "Feinaufloesung vom Zahnzaehler." UWORD FORMULA_KW6 0 0 0.0 42747.6900 ECU_ADDRESS 0x30450A /begin FUNCTION_LIST TPU /end FUNCTION_LIST BIT_MASK 0xFF00 /end MEASUREMENT
/begin MEASUREMENT tpu_b_kw_wait_teeth "Zahnentprellung vor Lueckensuche." UWORD FORMULA_KW4 0 0 0.0 127.0000 ECU_ADDRESS 0x30450A /begin FUNCTION_LIST TPU /end FUNCTION_LIST BIT_MASK 0x00FF /end MEASUREMENT
/begin MEASUREMENT tpu_b_kw_next_segm_tooth "Naechster Segmentzahn." UWORD FORMULA_KW4 0 0 0.0 119.0000 ECU_ADDRESS 0x30450A /begin FUNCTION_LIST TPU /end FUNCTION_LIST BIT_MASK 0x00FF /end MEASUREMENT
/begin MEASUREMENT tpu_b_kw_cnt_720 "720� Zahnzaehler." UWORD FORMULA_KW1 0 0 0.0 119.0000 ECU_ADDRESS 0x30450C /begin FUNCTION_LIST TPU /end FUNCTION_LIST BIT_MASK 0xFF00 /end MEASUREMENT
/begin MEASUREMENT tpu_b_kw_segm_zeit "Segmentzeitpunkt." ULONG FORMULA_KW8 0 0 0.0 2396.7450 ECU_ADDRESS 0x30450C /begin FUNCTION_LIST TPU /end FUNCTION_LIST BIT_MASK 0x00FFFFFF /end MEASUREMENT
/begin MEASUREMENT tpu_b_htu "Hight-Time-Updater." UWORD FORMULA_KW9 0 0 0.0 2394.4031 ECU_ADDRESS 0x304510 /begin FUNCTION_LIST TPU /end FUNCTION_LIST /end MEASUREMENT
/begin MEASUREMENT tpu_b_kw_count "Kurbelwellenposition." UWORD FORMULA_KW10 0 0 0.0 719.9890 ECU_ADDRESS 0x304512 /begin FUNCTION_LIST TPU /end FUNCTION_LIST /end MEASUREMENT
/begin MEASUREMENT tpu_b_kw_last_period_low "16 lsb der letzten Periode." UWORD FORMULA_KW11 0 0 0.0 9.3621 ECU_ADDRESS 0x304514 /begin FUNCTION_LIST TPU /end FUNCTION_LIST /end MEASUREMENT
/begin MEASUREMENT tpu_b_kw_last_period_high "8 msb der letzten Periode." UWORD FORMULA_KW12 0 0 0.0 255.0000 ECU_ADDRESS 0x304516 /begin FUNCTION_LIST TPU /end FUNCTION_LIST BIT_MASK 0xFF00 /end MEASUREMENT
/begin MEASUREMENT tpu_b_kw_prev_period "Vorhergehende Periode." ULONG FORMULA_KW8 0 0 0.0 2396.7450 ECU_ADDRESS 0x304516 /begin FUNCTION_LIST TPU /end FUNCTION_LIST BIT_MASK 0x00FFFFFF /end MEASUREMENT
/begin MEASUREMENT tpu_b_kw_norm_period "normierte Periode." ULONG FORMULA_KW13 0 0 0.0 2396.7450 ECU_ADDRESS 0x30451A /begin FUNCTION_LIST TPU /end FUNCTION_LIST BIT_MASK 0xFFFFFF00 /end MEASUREMENT
/begin MEASUREMENT tpu_b_kw_last_event_time "Zeitpunkt vom letzten Ereignis." ULONG FORMULA_KW8 0 0 0.0 2396.7450 ECU_ADDRESS 0x30451C /begin FUNCTION_LIST TPU /end FUNCTION_LIST BIT_MASK 0x00FFFFFF /end MEASUREMENT
/begin MEASUREMENT tpu_b_kw_last_trans_time "Zeitpunkt letzter Zahnflanke." ULONG FORMULA_KW8 0 0 0.0 2396.7450 ECU_ADDRESS 0x3045DA /begin FUNCTION_LIST TPU /end FUNCTION_LIST BIT_MASK 0x00FFFFFF /end MEASUREMENT
/* TPU PWM FORMELN -----------------------------------------------------------------------*/
/begin COMPU_METHOD FORMULA_PWM1 "FORMULA_PWM1" RAT_FUNC "%7.2" "ms" COEFFS 0 7000 0 0 0 1 /end COMPU_METHOD
/* TPU PWM -------------------------------------------------------------------------------*/
/begin MEASUREMENT tpu_pwm_active_time_tev1 "TPU PWM active time." UWORD FORMULA_PWM1 0 0 0.0 9.3621 ECU_ADDRESS 0x3045A0 /begin FUNCTION_LIST TPU /end FUNCTION_LIST /end MEASUREMENT
/begin MEASUREMENT tpu_pwm_period_tev1 "TPU PWM period." UWORD FORMULA_PWM1 0 0 0.0 9.3621 ECU_ADDRESS 0x3045A2 /begin FUNCTION_LIST TPU /end FUNCTION_LIST /end MEASUREMENT
/begin MEASUREMENT tpu_pwm_passive_time_tev1 "TPU PWM passive time." UWORD FORMULA_PWM1 0 0 0.0 9.3621 ECU_ADDRESS 0x3045A4 /begin FUNCTION_LIST TPU /end FUNCTION_LIST /end MEASUREMENT
/begin MEASUREMENT tpu_pwm_active_time_tev2 "TPU PWM active time." UWORD FORMULA_PWM1 0 0 0.0 9.3621 ECU_ADDRESS 0x3045B0 /begin FUNCTION_LIST TPU /end FUNCTION_LIST /end MEASUREMENT
/begin MEASUREMENT tpu_pwm_period_tev2 "TPU PWM period." UWORD FORMULA_PWM1 0 0 0.0 9.3621 ECU_ADDRESS 0x3045B2 /begin FUNCTION_LIST TPU /end FUNCTION_LIST /end MEASUREMENT
/begin MEASUREMENT tpu_pwm_passive_time_tev2 "TPU PWM passive time." UWORD FORMULA_PWM1 0 0 0.0 9.3621 ECU_ADDRESS 0x3045B4 /begin FUNCTION_LIST TPU /end FUNCTION_LIST /end MEASUREMENT
/begin MEASUREMENT tpu_pwm_active_time_elue "TPU PWM active time." UWORD FORMULA_PWM1 0 0 0.0 9.3621 ECU_ADDRESS 0x3045C0 /begin FUNCTION_LIST TPU /end FUNCTION_LIST /end MEASUREMENT
/begin MEASUREMENT tpu_pwm_period_elue "TPU PWM period." UWORD FORMULA_PWM1 0 0 0.0 9.3621 ECU_ADDRESS 0x3045C2 /begin FUNCTION_LIST TPU /end FUNCTION_LIST /end MEASUREMENT
/begin MEASUREMENT tpu_pwm_passive_time_elue "TPU PWM passive time." UWORD FORMULA_PWM1 0 0 0.0 9.3621 ECU_ADDRESS 0x3045C4 /begin FUNCTION_LIST TPU /end FUNCTION_LIST /end MEASUREMENT
/* TPU DIO FORMELN -----------------------------------------------------------------------*/
/begin COMPU_METHOD FORMULA_DIO1 "FORMULA_DIO1" TAB_VERB "%5.0" "-" COMPU_TAB_REF FORMULA_DIO1_VTAB /end COMPU_METHOD
/begin COMPU_VTAB FORMULA_DIO1_VTAB "FORMULA_DIO1_VTAB" TAB_VERB 5 0x04 "in rising edge" 0x08 "in falling edge" 0x0C "in both edges" 0xE1 "out pin high" 0xE2 "out pin low" DEFAULT_VALUE "1 undefined" /end COMPU_VTAB
/begin COMPU_METHOD FORMULA_DIO2 "FORMULA_DIO2" RAT_FUNC "%5.0" "-" COEFFS 0 1 0 0 0 1 /end COMPU_METHOD
/begin COMPU_METHOD FORMULA_DIO3 "FORMULA_DIO3" RAT_FUNC "%7.2" "ms" COEFFS 0 7000 0 0 0 1 /end COMPU_METHOD
/* TPU DIO -------------------------------------------------------------------------------*/
/begin MEASUREMENT tpu_dio_config_kw_gap "TPU DIO config." UWORD FORMULA_DIO1 0 0 0.0 511.0000 ECU_ADDRESS 0x3045D0 /begin FUNCTION_LIST TPU /end FUNCTION_LIST BIT_MASK 0x001FF /end MEASUREMENT
/begin MEASUREMENT tpu_dio_pin_level_kw_gap "TPU DIO pin level." UWORD FORMULA_DIO2 0 0 0.0 1.0000 ECU_ADDRESS 0x3045D0 /begin FUNCTION_LIST TPU /end FUNCTION_LIST BIT_MASK 0x0001 /end MEASUREMENT
/begin MEASUREMENT tpu_dio_pulse_time_kw_gap "TPU DIO pulse time." UWORD FORMULA_DIO3 0 0 0.0 9.3621 ECU_ADDRESS 0x3045D2 /begin FUNCTION_LIST TPU /end FUNCTION_LIST BIT_MASK 0x7FFF /end MEASUREMENT
/begin MEASUREMENT tpu_dio_irq_cnt_kw_gap "TPU DIO interrupt counter." UWORD FORMULA_DIO2 0 0 0.0 65535.0000 ECU_ADDRESS 0x3045D2 /begin FUNCTION_LIST TPU /end FUNCTION_LIST /end MEASUREMENT
/* TPU ATP FORMELN -----------------------------------------------------------------------*/
/begin COMPU_METHOD FORMULA_ATP1 "FORMULA_ATP1" RAT_FUNC "%7.2" "�" COEFFS 0 1 0 0 0 0.01098633 /end COMPU_METHOD
/begin COMPU_METHOD FORMULA_ATP2 "FORMULA_ATP2" RAT_FUNC "%7.2" "ms" COEFFS 0 7000 0 0 0 1 /end COMPU_METHOD
/begin COMPU_METHOD FORMULA_ATP3 "FORMULA_ATP3" RAT_FUNC "%5.0" "-" COEFFS 0 1 0 0 0 1 /end COMPU_METHOD
/* TPU ATP -------------------------------------------------------------------------------*/
/begin MEASUREMENT tpu_atp_angle_etrig7 "TPU ATP next trigger angle." UWORD FORMULA_ATP1 0 0 0.0 719.9890 ECU_ADDRESS 0x3045F0 /begin FUNCTION_LIST TPU /end FUNCTION_LIST /end MEASUREMENT
/begin MEASUREMENT tpu_atp_period_etrig7 "TPU ATP angle period." UWORD FORMULA_ATP1 0 0 0.0 719.9890 ECU_ADDRESS 0x3045F2 /begin FUNCTION_LIST TPU /end FUNCTION_LIST /end MEASUREMENT
/begin MEASUREMENT tpu_atp_time_etrig7 "TPU ATP trigger time." UWORD FORMULA_ATP2 0 0 0.0 9.3621 ECU_ADDRESS 0x3045F4 /begin FUNCTION_LIST TPU /end FUNCTION_LIST /end MEASUREMENT
/begin MEASUREMENT tpu_atp_cnt_etrig7 "TPU ATP counter." UWORD FORMULA_ATP3 0 0 0.0 65535.0000 ECU_ADDRESS 0x3045F6 /begin FUNCTION_LIST TPU /end FUNCTION_LIST /end MEASUREMENT
/* TPU KW FORMELN ------------------------------------------------------------------------*/
/begin COMPU_METHOD FORMULA_NW1 "FORMULA_NW1" RAT_FUNC "%9.2" "ms" COEFFS 0 7000 0 0 0 1 /end COMPU_METHOD
/begin COMPU_METHOD FORMULA_NW2 "FORMULA_NW2" RAT_FUNC "%12.2" "ms" COEFFS 0 840000 0 0 0 1 /end COMPU_METHOD
/begin COMPU_METHOD FORMULA_NW3 "FORMULA_NW3" RAT_FUNC "%5.0" "-" COEFFS 0 256 128 0 0 1 /end COMPU_METHOD
/begin COMPU_METHOD FORMULA_NW4 "FORMULA_NW4" RAT_FUNC "%5.0" "-" COEFFS 0 32768 0 0 0 1 /end COMPU_METHOD
/* TPU NW --------------------------------------------------------------------------------*/
/begin MEASUREMENT tpu_nw_last_trans_time_e1 "Zeitpunkt letzter Zahnflanke der NW." ULONG FORMULA_NW1 0 0 0.0 2396.7450 ECU_ADDRESS 0x304520 /begin FUNCTION_LIST TPU /end FUNCTION_LIST BIT_MASK 0x00FFFFFF /end MEASUREMENT
/begin MEASUREMENT tpu_nw_kw_last_trans_time_e1 "Zeitpunkt letzter Zahnflanke der KW." ULONG FORMULA_NW1 0 0 0.0 2396.7450 ECU_ADDRESS 0x304526 /begin FUNCTION_LIST TPU /end FUNCTION_LIST BIT_MASK 0x00FFFFFF /end MEASUREMENT
/begin MEASUREMENT tpu_nw_kw_norm_period_e1 "normierte Periode der KW." ULONG FORMULA_NW2 0 0 0.0 2396.7450 ECU_ADDRESS 0x304524 /begin FUNCTION_LIST TPU /end FUNCTION_LIST BIT_MASK 0xFFFFFF00 /end MEASUREMENT
/begin MEASUREMENT tpu_nw_kw_cnt_720_e1 "720� Zahnzaehler der KW." UWORD FORMULA_NW3 0 0 0.0 119.0000 ECU_ADDRESS 0x304520 /begin FUNCTION_LIST TPU /end FUNCTION_LIST BIT_MASK 0x7F00 /end MEASUREMENT
/begin MEASUREMENT tpu_nw_pin_level_e1 "TPU NW pin level." UWORD FORMULA_NW4 0 0 0.0 1.0000 ECU_ADDRESS 0x304520 /begin FUNCTION_LIST TPU /end FUNCTION_LIST BIT_MASK 0x8000 /end MEASUREMENT
/begin MEASUREMENT tpu_nw_last_trans_time_a1 "Zeitpunkt letzter Zahnflanke der NW." ULONG FORMULA_NW1 0 0 0.0 2396.7450 ECU_ADDRESS 0x304530 /begin FUNCTION_LIST TPU /end FUNCTION_LIST BIT_MASK 0x00FFFFFF /end MEASUREMENT
/begin MEASUREMENT tpu_nw_kw_last_trans_time_a1 "Zeitpunkt letzter Zahnflanke der KW." ULONG FORMULA_NW1 0 0 0.0 2396.7450 ECU_ADDRESS 0x304536 /begin FUNCTION_LIST TPU /end FUNCTION_LIST BIT_MASK 0x00FFFFFF /end MEASUREMENT
/begin MEASUREMENT tpu_nw_kw_norm_period_a1 "normierte Periode der KW." ULONG FORMULA_NW2 0 0 0.0 2396.7450 ECU_ADDRESS 0x304534 /begin FUNCTION_LIST TPU /end FUNCTION_LIST BIT_MASK 0xFFFFFF00 /end MEASUREMENT
/begin MEASUREMENT tpu_nw_kw_cnt_720_a1 "720� Zahnzaehler der KW." UWORD FORMULA_NW3 0 0 0.0 119.0000 ECU_ADDRESS 0x304530 /begin FUNCTION_LIST TPU /end FUNCTION_LIST BIT_MASK 0x7F00 /end MEASUREMENT
/begin MEASUREMENT tpu_nw_pin_level_a1 "TPU NW pin level." UWORD FORMULA_NW4 0 0 0.0 1.0000 ECU_ADDRESS 0x304530 /begin FUNCTION_LIST TPU /end FUNCTION_LIST BIT_MASK 0x8000 /end MEASUREMENT
/begin MEASUREMENT tpu_nw_last_trans_time_e2 "Zeitpunkt letzter Zahnflanke der NW." ULONG FORMULA_NW1 0 0 0.0 2396.7450 ECU_ADDRESS 0x304540 /begin FUNCTION_LIST TPU /end FUNCTION_LIST BIT_MASK 0x00FFFFFF /end MEASUREMENT
/begin MEASUREMENT tpu_nw_kw_last_trans_time_e2 "Zeitpunkt letzter Zahnflanke der KW." ULONG FORMULA_NW1 0 0 0.0 2396.7450 ECU_ADDRESS 0x304546 /begin FUNCTION_LIST TPU /end FUNCTION_LIST BIT_MASK 0x00FFFFFF /end MEASUREMENT
/begin MEASUREMENT tpu_nw_kw_norm_period_e2 "normierte Periode der KW." ULONG FORMULA_NW2 0 0 0.0 2396.7450 ECU_ADDRESS 0x304544 /begin FUNCTION_LIST TPU /end FUNCTION_LIST BIT_MASK 0xFFFFFF00 /end MEASUREMENT
/begin MEASUREMENT tpu_nw_kw_cnt_720_e2 "720� Zahnzaehler der KW." UWORD FORMULA_NW3 0 0 0.0 119.0000 ECU_ADDRESS 0x304540 /begin FUNCTION_LIST TPU /end FUNCTION_LIST BIT_MASK 0x7F00 /end MEASUREMENT
/begin MEASUREMENT tpu_nw_pin_level_e2 "TPU NW pin level." UWORD FORMULA_NW4 0 0 0.0 1.0000 ECU_ADDRESS 0x304540 /begin FUNCTION_LIST TPU /end FUNCTION_LIST BIT_MASK 0x8000 /end MEASUREMENT
/begin MEASUREMENT tpu_nw_last_trans_time_a2 "Zeitpunkt letzter Zahnflanke der NW." ULONG FORMULA_NW1 0 0 0.0 2396.7450 ECU_ADDRESS 0x304550 /begin FUNCTION_LIST TPU /end FUNCTION_LIST BIT_MASK 0x00FFFFFF /end MEASUREMENT
/begin MEASUREMENT tpu_nw_kw_last_trans_time_a2 "Zeitpunkt letzter Zahnflanke der KW." ULONG FORMULA_NW1 0 0 0.0 2396.7450 ECU_ADDRESS 0x304556 /begin FUNCTION_LIST TPU /end FUNCTION_LIST BIT_MASK 0x00FFFFFF /end MEASUREMENT
/begin MEASUREMENT tpu_nw_kw_norm_period_a2 "normierte Periode der KW." ULONG FORMULA_NW2 0 0 0.0 2396.7450 ECU_ADDRESS 0x304554 /begin FUNCTION_LIST TPU /end FUNCTION_LIST BIT_MASK 0xFFFFFF00 /end MEASUREMENT
/begin MEASUREMENT tpu_nw_kw_cnt_720_a2 "720� Zahnzaehler der KW." UWORD FORMULA_NW3 0 0 0.0 119.0000 ECU_ADDRESS 0x304550 /begin FUNCTION_LIST TPU /end FUNCTION_LIST BIT_MASK 0x7F00 /end MEASUREMENT
/begin MEASUREMENT tpu_nw_pin_level_a2 "TPU NW pin level." UWORD FORMULA_NW4 0 0 0.0 1.0000 ECU_ADDRESS 0x304550 /begin FUNCTION_LIST TPU /end FUNCTION_LIST BIT_MASK 0x8000 /end MEASUREMENT
/* TPU INJ FORMELN -----------------------------------------------------------------------*/
/begin COMPU_METHOD FORMULA_INJ1 "FORMULA_INJ1" RAT_FUNC "%7.2" "�" COEFFS 0 1 0 0 0 0.01098633 /end COMPU_METHOD
/begin COMPU_METHOD FORMULA_INJ2 "FORMULA_INJ2" RAT_FUNC "%7.2" "ms" COEFFS 0 7000 0 0 0 1 /end COMPU_METHOD
/begin COMPU_METHOD FORMULA_INJ3 "FORMULA_INJ3" RAT_FUNC "%9.2" "ms" COEFFS 0 1750 0 0 0 1 /end COMPU_METHOD
/begin COMPU_METHOD FORMULA_INJ4 "FORMULA_INJ4" RAT_FUNC "%7.0" "-" COEFFS 0 1 0 0 0 1 /end COMPU_METHOD
/begin COMPU_METHOD FORMULA_INJ5 "FORMULA_INJ5" RAT_FUNC "%5.0" "-" COEFFS 0 32768 0 0 0 1 /end COMPU_METHOD
/begin COMPU_METHOD FORMULA_INJ6 "FORMULA_INJ6" RAT_FUNC "%5.0" "-" COEFFS 0 16384 0 0 0 1 /end COMPU_METHOD
/begin COMPU_METHOD FORMULA_INJ7 "FORMULA_INJ7" RAT_FUNC "%5.0" "-" COEFFS 0 128 0 0 0 1 /end COMPU_METHOD
/begin COMPU_METHOD FORMULA_INJ8 "FORMULA_INJ8" RAT_FUNC "%5.0" "-" COEFFS 0 64 0 0 0 1 /end COMPU_METHOD
/begin COMPU_METHOD FORMULA_INJ9 "FORMULA_INJ9" RAT_FUNC "%9.2" "ms" COEFFS 0 7000 0 0 0 256 /end COMPU_METHOD
/begin COMPU_METHOD FORMULA_INJ10 "FORMULA_INJ10" RAT_FUNC "%9.2" "ms" COEFFS 0 7000 0 0 0 1 /end COMPU_METHOD
/begin COMPU_METHOD FORMULA_INJ11 "FORMULA_INJ11" RAT_FUNC "%9.2" "ms" COEFFS 0 7000 0 0 0 256 /end COMPU_METHOD
/* TPU INJ Globale Parameter -------------------------------------------------------------*/
/begin MEASUREMENT tpu_inj_end_angle_b1 "TPU INJ end angle." UWORD FORMULA_INJ1 0 0 0.0 719.9890 ECU_ADDRESS 0x3041E0 /begin FUNCTION_LIST TPU /end FUNCTION_LIST /end MEASUREMENT
/begin MEASUREMENT tpu_inj_phase_angle_b1 "TPU INJ phase angle." UWORD FORMULA_INJ1 0 0 0.0 719.9890 ECU_ADDRESS 0x3041E2 /begin FUNCTION_LIST TPU /end FUNCTION_LIST /end MEASUREMENT
/begin MEASUREMENT tpu_inj_min_time_b1 "TPU INJ min time." UWORD FORMULA_INJ2 0 0 0.0 9.3621 ECU_ADDRESS 0x3041E4 /begin FUNCTION_LIST TPU /end FUNCTION_LIST /end MEASUREMENT
/begin MEASUREMENT tpu_inj_offset_time_b1 "TPU INJ offset time." UWORD FORMULA_INJ2 0 0 0.0 9.3621 ECU_ADDRESS 0x3041E6 /begin FUNCTION_LIST TPU /end FUNCTION_LIST /end MEASUREMENT
/begin MEASUREMENT tpu_inj_min_off_time_b1 "TPU INJ min off time." UWORD FORMULA_INJ2 0 0 0.0 9.3621 ECU_ADDRESS 0x3041E8 /begin FUNCTION_LIST TPU /end FUNCTION_LIST /end MEASUREMENT
/begin MEASUREMENT tpu_inj_end_angle_b2 "TPU INJ end angle." UWORD FORMULA_INJ1 0 0 0.0 719.9890 ECU_ADDRESS 0x3041F0 /begin FUNCTION_LIST TPU /end FUNCTION_LIST /end MEASUREMENT
/begin MEASUREMENT tpu_inj_phase_angle_b2 "TPU INJ phase angle." UWORD FORMULA_INJ1 0 0 0.0 719.9890 ECU_ADDRESS 0x3041F2 /begin FUNCTION_LIST TPU /end FUNCTION_LIST /end MEASUREMENT
/begin MEASUREMENT tpu_inj_min_time_b2 "TPU INJ min time." UWORD FORMULA_INJ2 0 0 0.0 9.3621 ECU_ADDRESS 0x3041F4 /begin FUNCTION_LIST TPU /end FUNCTION_LIST /end MEASUREMENT
/begin MEASUREMENT tpu_inj_offset_time_b2 "TPU INJ offset time." UWORD FORMULA_INJ2 0 0 0.0 9.3621 ECU_ADDRESS 0x3041F6 /begin FUNCTION_LIST TPU /end FUNCTION_LIST /end MEASUREMENT
/begin MEASUREMENT tpu_inj_min_off_time_b2 "TPU INJ min off time." UWORD FORMULA_INJ2 0 0 0.0 9.3621 ECU_ADDRESS 0x3041F8 /begin FUNCTION_LIST TPU /end FUNCTION_LIST /end MEASUREMENT
/* TPU INJ Parameter Zylinder 1 ----------------------------------------------------------*/
/begin MEASUREMENT tpu_inj_tdc_angle_high_zyl1 "TPU INJ MSB OT Lage." UWORD FORMULA_INJ1 0 0 0.0 719.9890 ECU_ADDRESS 0x304120 /begin FUNCTION_LIST TPU /end FUNCTION_LIST BIT_MASK 0xFF00 /end MEASUREMENT
/begin MEASUREMENT tpu_inj_tdc_angle_low_zyl1 "TPU INJ LSB OT Lage." UWORD FORMULA_INJ1 0 0 0.0 719.9890 ECU_ADDRESS 0x304126 /begin FUNCTION_LIST TPU /end FUNCTION_LIST BIT_MASK 0x00FF /end MEASUREMENT
/begin MEASUREMENT tpu_inj_demand_time_zyl1 "TPU INJ demand time." ULONG FORMULA_INJ10 0 0 0.0 40.0000 ECU_ADDRESS 0x304120 /begin FUNCTION_LIST TPU /end FUNCTION_LIST BIT_MASK 0x00FFFFFF /end MEASUREMENT
/begin MEASUREMENT tpu_inj_end_angle_zyl1 "TPU INJ end angle." UWORD FORMULA_INJ1 0 0 0.0 719.9890 ECU_ADDRESS 0x304124 /begin FUNCTION_LIST TPU /end FUNCTION_LIST /end MEASUREMENT
/begin MEASUREMENT tpu_inj_start_time_high_zyl1 "TPU INJ start time high." UWORD FORMULA_INJ11 0 0 0.0 2396.7450 ECU_ADDRESS 0x304126 /begin FUNCTION_LIST TPU /end FUNCTION_LIST BIT_MASK 0xFF00 /end MEASUREMENT
/begin MEASUREMENT tpu_inj_start_time_low_zyl1 "TPU INJ start time low." UWORD FORMULA_INJ2 0 0 0.0 9.3621 ECU_ADDRESS 0x304128 /begin FUNCTION_LIST TPU /end FUNCTION_LIST /end MEASUREMENT
/begin MEASUREMENT tpu_inj_temp_zyl1 "TPU INJ temp." UWORD FORMULA_INJ4 0 0 0.0 65535.0000 ECU_ADDRESS 0x304128 /begin FUNCTION_LIST TPU /end FUNCTION_LIST /end MEASUREMENT
/begin MEASUREMENT tpu_inj_main_zyl1 "TPU INJ main." UWORD FORMULA_INJ5 0 0 0.0 1.0000 ECU_ADDRESS 0x30412A /begin FUNCTION_LIST TPU /end FUNCTION_LIST BIT_MASK 0x8000 /end MEASUREMENT
/begin MEASUREMENT tpu_inj_first_zyl1 "TPU INJ first." UWORD FORMULA_INJ6 0 0 0.0 1.0000 ECU_ADDRESS 0x30412A /begin FUNCTION_LIST TPU /end FUNCTION_LIST BIT_MASK 0x4000 /end MEASUREMENT
/begin MEASUREMENT tpu_inj_out_time_low_zyl1 "TPU INJ out time low." UWORD FORMULA_INJ3 0 0 0.0 40.0000 ECU_ADDRESS 0x30412A /begin FUNCTION_LIST TPU /end FUNCTION_LIST BIT_MASK 0x3FFF /end MEASUREMENT
/begin MEASUREMENT tpu_inj_out_time_high_zyl1 "TPU INJ out time high." UWORD FORMULA_INJ9 0 0 0.0 40.0000 ECU_ADDRESS 0x30412C /begin FUNCTION_LIST TPU /end FUNCTION_LIST BIT_MASK 0xFF00 /end MEASUREMENT
/begin MEASUREMENT tpu_inj_min_off_zyl1 "TPU INJ min off." UWORD FORMULA_INJ7 0 0 0.0 1.0000 ECU_ADDRESS 0x30412C /begin FUNCTION_LIST TPU /end FUNCTION_LIST BIT_MASK 0x0080 /end MEASUREMENT
/begin MEASUREMENT tpu_inj_miss_zyl1 "TPU INJ miss." UWORD FORMULA_INJ8 0 0 0.0 1.0000 ECU_ADDRESS 0x30412C /begin FUNCTION_LIST TPU /end FUNCTION_LIST BIT_MASK 0x0040 /end MEASUREMENT
/begin MEASUREMENT tpu_inj_copy_time_zyl1 "TPU INJ copy time." ULONG FORMULA_INJ3 0 0 0.0 40.0000 ECU_ADDRESS 0x30412C /begin FUNCTION_LIST TPU /end FUNCTION_LIST BIT_MASK 0x003FFFFF /end MEASUREMENT
/* TPU INJ Parameter Zylinder 2 ----------------------------------------------------------*/
/begin MEASUREMENT tpu_inj_tdc_angle_high_zyl2 "TPU INJ MSB OT Lage." UWORD FORMULA_INJ1 0 0 0.0 719.9890 ECU_ADDRESS 0x304130 /begin FUNCTION_LIST TPU /end FUNCTION_LIST BIT_MASK 0xFF00 /end MEASUREMENT
/begin MEASUREMENT tpu_inj_tdc_angle_low_zyl2 "TPU INJ LSB OT Lage." UWORD FORMULA_INJ1 0 0 0.0 719.9890 ECU_ADDRESS 0x304136 /begin FUNCTION_LIST TPU /end FUNCTION_LIST BIT_MASK 0x00FF /end MEASUREMENT
/begin MEASUREMENT tpu_inj_demand_time_zyl2 "TPU INJ demand time." ULONG FORMULA_INJ10 0 0 0.0 40.0000 ECU_ADDRESS 0x304130 /begin FUNCTION_LIST TPU /end FUNCTION_LIST BIT_MASK 0x00FFFFFF /end MEASUREMENT
/begin MEASUREMENT tpu_inj_end_angle_zyl2 "TPU INJ end angle." UWORD FORMULA_INJ1 0 0 0.0 719.9890 ECU_ADDRESS 0x304134 /begin FUNCTION_LIST TPU /end FUNCTION_LIST /end MEASUREMENT
/begin MEASUREMENT tpu_inj_start_time_high_zyl2 "TPU INJ start time high." UWORD FORMULA_INJ11 0 0 0.0 2396.7450 ECU_ADDRESS 0x304136 /begin FUNCTION_LIST TPU /end FUNCTION_LIST BIT_MASK 0xFF00 /end MEASUREMENT
/begin MEASUREMENT tpu_inj_start_time_low_zyl2 "TPU INJ start time low." UWORD FORMULA_INJ2 0 0 0.0 9.3621 ECU_ADDRESS 0x304138 /begin FUNCTION_LIST TPU /end FUNCTION_LIST /end MEASUREMENT
/begin MEASUREMENT tpu_inj_temp_zyl2 "TPU INJ temp." UWORD FORMULA_INJ4 0 0 0.0 65535.0000 ECU_ADDRESS 0x304138 /begin FUNCTION_LIST TPU /end FUNCTION_LIST /end MEASUREMENT
/begin MEASUREMENT tpu_inj_main_zyl2 "TPU INJ main." UWORD FORMULA_INJ5 0 0 0.0 1.0000 ECU_ADDRESS 0x30413A /begin FUNCTION_LIST TPU /end FUNCTION_LIST BIT_MASK 0x8000 /end MEASUREMENT
/begin MEASUREMENT tpu_inj_first_zyl2 "TPU INJ first." UWORD FORMULA_INJ6 0 0 0.0 1.0000 ECU_ADDRESS 0x30413A /begin FUNCTION_LIST TPU /end FUNCTION_LIST BIT_MASK 0x4000 /end MEASUREMENT
/begin MEASUREMENT tpu_inj_out_time_low_zyl2 "TPU INJ out time low." UWORD FORMULA_INJ3 0 0 0.0 40.0000 ECU_ADDRESS 0x30413A /begin FUNCTION_LIST TPU /end FUNCTION_LIST BIT_MASK 0x3FFF /end MEASUREMENT
/begin MEASUREMENT tpu_inj_out_time_high_zyl2 "TPU INJ out time high." UWORD FORMULA_INJ9 0 0 0.0 40.0000 ECU_ADDRESS 0x30413C /begin FUNCTION_LIST TPU /end FUNCTION_LIST BIT_MASK 0xFF00 /end MEASUREMENT
/begin MEASUREMENT tpu_inj_min_off_zyl2 "TPU INJ min off." UWORD FORMULA_INJ7 0 0 0.0 1.0000 ECU_ADDRESS 0x30413C /begin FUNCTION_LIST TPU /end FUNCTION_LIST BIT_MASK 0x0080 /end MEASUREMENT
/begin MEASUREMENT tpu_inj_miss_zyl2 "TPU INJ miss." UWORD FORMULA_INJ8 0 0 0.0 1.0000 ECU_ADDRESS 0x30413C /begin FUNCTION_LIST TPU /end FUNCTION_LIST BIT_MASK 0x0040 /end MEASUREMENT
/begin MEASUREMENT tpu_inj_copy_time_zyl2 "TPU INJ copy time." ULONG FORMULA_INJ3 0 0 0.0 40.0000 ECU_ADDRESS 0x30413C /begin FUNCTION_LIST TPU /end FUNCTION_LIST BIT_MASK 0x003FFFFF /end MEASUREMENT
/* TPU INJ Parameter Zylinder 3 ----------------------------------------------------------*/
/begin MEASUREMENT tpu_inj_tdc_angle_high_zyl3 "TPU INJ MSB OT Lage." UWORD FORMULA_INJ1 0 0 0.0 719.9890 ECU_ADDRESS 0x304140 /begin FUNCTION_LIST TPU /end FUNCTION_LIST BIT_MASK 0xFF00 /end MEASUREMENT
/begin MEASUREMENT tpu_inj_tdc_angle_low_zyl3 "TPU INJ LSB OT Lage." UWORD FORMULA_INJ1 0 0 0.0 719.9890 ECU_ADDRESS 0x304146 /begin FUNCTION_LIST TPU /end FUNCTION_LIST BIT_MASK 0x00FF /end MEASUREMENT
/begin MEASUREMENT tpu_inj_demand_time_zyl3 "TPU INJ demand time." ULONG FORMULA_INJ10 0 0 0.0 40.0000 ECU_ADDRESS 0x304140 /begin FUNCTION_LIST TPU /end FUNCTION_LIST BIT_MASK 0x00FFFFFF /end MEASUREMENT
/begin MEASUREMENT tpu_inj_end_angle_zyl3 "TPU INJ end angle." UWORD FORMULA_INJ1 0 0 0.0 719.9890 ECU_ADDRESS 0x304144 /begin FUNCTION_LIST TPU /end FUNCTION_LIST /end MEASUREMENT
/begin MEASUREMENT tpu_inj_start_time_high_zyl3 "TPU INJ start time high." UWORD FORMULA_INJ11 0 0 0.0 2396.7450 ECU_ADDRESS 0x304146 /begin FUNCTION_LIST TPU /end FUNCTION_LIST BIT_MASK 0xFF00 /end MEASUREMENT
/begin MEASUREMENT tpu_inj_start_time_low_zyl3 "TPU INJ start time low." UWORD FORMULA_INJ2 0 0 0.0 9.3621 ECU_ADDRESS 0x304148 /begin FUNCTION_LIST TPU /end FUNCTION_LIST /end MEASUREMENT
/begin MEASUREMENT tpu_inj_temp_zyl3 "TPU INJ temp." UWORD FORMULA_INJ4 0 0 0.0 65535.0000 ECU_ADDRESS 0x304148 /begin FUNCTION_LIST TPU /end FUNCTION_LIST /end MEASUREMENT
/begin MEASUREMENT tpu_inj_main_zyl3 "TPU INJ main." UWORD FORMULA_INJ5 0 0 0.0 1.0000 ECU_ADDRESS 0x30414A /begin FUNCTION_LIST TPU /end FUNCTION_LIST BIT_MASK 0x8000 /end MEASUREMENT
/begin MEASUREMENT tpu_inj_first_zyl3 "TPU INJ first." UWORD FORMULA_INJ6 0 0 0.0 1.0000 ECU_ADDRESS 0x30414A /begin FUNCTION_LIST TPU /end FUNCTION_LIST BIT_MASK 0x4000 /end MEASUREMENT
/begin MEASUREMENT tpu_inj_out_time_low_zyl3 "TPU INJ out time low." UWORD FORMULA_INJ3 0 0 0.0 40.0000 ECU_ADDRESS 0x30414A /begin FUNCTION_LIST TPU /end FUNCTION_LIST BIT_MASK 0x3FFF /end MEASUREMENT
/begin MEASUREMENT tpu_inj_out_time_high_zyl3 "TPU INJ out time high." UWORD FORMULA_INJ9 0 0 0.0 40.0000 ECU_ADDRESS 0x30414C /begin FUNCTION_LIST TPU /end FUNCTION_LIST BIT_MASK 0xFF00 /end MEASUREMENT
/begin MEASUREMENT tpu_inj_min_off_zyl3 "TPU INJ min off." UWORD FORMULA_INJ7 0 0 0.0 1.0000 ECU_ADDRESS 0x30414C /begin FUNCTION_LIST TPU /end FUNCTION_LIST BIT_MASK 0x0080 /end MEASUREMENT
/begin MEASUREMENT tpu_inj_miss_zyl3 "TPU INJ miss." UWORD FORMULA_INJ8 0 0 0.0 1.0000 ECU_ADDRESS 0x30414C /begin FUNCTION_LIST TPU /end FUNCTION_LIST BIT_MASK 0x0040 /end MEASUREMENT
/begin MEASUREMENT tpu_inj_copy_time_zyl3 "TPU INJ copy time." ULONG FORMULA_INJ3 0 0 0.0 40.0000 ECU_ADDRESS 0x30414C /begin FUNCTION_LIST TPU /end FUNCTION_LIST BIT_MASK 0x003FFFFF /end MEASUREMENT
/* TPU INJ Parameter Zylinder 4 ----------------------------------------------------------*/
/begin MEASUREMENT tpu_inj_tdc_angle_high_zyl4 "TPU INJ MSB OT Lage." UWORD FORMULA_INJ1 0 0 0.0 719.9890 ECU_ADDRESS 0x304150 /begin FUNCTION_LIST TPU /end FUNCTION_LIST BIT_MASK 0xFF00 /end MEASUREMENT
/begin MEASUREMENT tpu_inj_tdc_angle_low_zyl4 "TPU INJ LSB OT Lage." UWORD FORMULA_INJ1 0 0 0.0 719.9890 ECU_ADDRESS 0x304156 /begin FUNCTION_LIST TPU /end FUNCTION_LIST BIT_MASK 0x00FF /end MEASUREMENT
/begin MEASUREMENT tpu_inj_demand_time_zyl4 "TPU INJ demand time." ULONG FORMULA_INJ10 0 0 0.0 40.0000 ECU_ADDRESS 0x304150 /begin FUNCTION_LIST TPU /end FUNCTION_LIST BIT_MASK 0x00FFFFFF /end MEASUREMENT
/begin MEASUREMENT tpu_inj_end_angle_zyl4 "TPU INJ end angle." UWORD FORMULA_INJ1 0 0 0.0 719.9890 ECU_ADDRESS 0x304154 /begin FUNCTION_LIST TPU /end FUNCTION_LIST /end MEASUREMENT
/begin MEASUREMENT tpu_inj_start_time_high_zyl4 "TPU INJ start time high." UWORD FORMULA_INJ11 0 0 0.0 2396.7450 ECU_ADDRESS 0x304156 /begin FUNCTION_LIST TPU /end FUNCTION_LIST BIT_MASK 0xFF00 /end MEASUREMENT
/begin MEASUREMENT tpu_inj_start_time_low_zyl4 "TPU INJ start time low." UWORD FORMULA_INJ2 0 0 0.0 9.3621 ECU_ADDRESS 0x304158 /begin FUNCTION_LIST TPU /end FUNCTION_LIST /end MEASUREMENT
/begin MEASUREMENT tpu_inj_temp_zyl4 "TPU INJ temp." UWORD FORMULA_INJ4 0 0 0.0 65535.0000 ECU_ADDRESS 0x304158 /begin FUNCTION_LIST TPU /end FUNCTION_LIST /end MEASUREMENT
/begin MEASUREMENT tpu_inj_main_zyl4 "TPU INJ main." UWORD FORMULA_INJ5 0 0 0.0 1.0000 ECU_ADDRESS 0x30415A /begin FUNCTION_LIST TPU /end FUNCTION_LIST BIT_MASK 0x8000 /end MEASUREMENT
/begin MEASUREMENT tpu_inj_first_zyl4 "TPU INJ first." UWORD FORMULA_INJ6 0 0 0.0 1.0000 ECU_ADDRESS 0x30415A /begin FUNCTION_LIST TPU /end FUNCTION_LIST BIT_MASK 0x4000 /end MEASUREMENT
/begin MEASUREMENT tpu_inj_out_time_low_zyl4 "TPU INJ out time low." UWORD FORMULA_INJ3 0 0 0.0 40.0000 ECU_ADDRESS 0x30415A /begin FUNCTION_LIST TPU /end FUNCTION_LIST BIT_MASK 0x3FFF /end MEASUREMENT
/begin MEASUREMENT tpu_inj_out_time_high_zyl4 "TPU INJ out time high." UWORD FORMULA_INJ9 0 0 0.0 40.0000 ECU_ADDRESS 0x30415C /begin FUNCTION_LIST TPU /end FUNCTION_LIST BIT_MASK 0xFF00 /end MEASUREMENT
/begin MEASUREMENT tpu_inj_min_off_zyl4 "TPU INJ min off." UWORD FORMULA_INJ7 0 0 0.0 1.0000 ECU_ADDRESS 0x30415C /begin FUNCTION_LIST TPU /end FUNCTION_LIST BIT_MASK 0x0080 /end MEASUREMENT
/begin MEASUREMENT tpu_inj_miss_zyl4 "TPU INJ miss." UWORD FORMULA_INJ8 0 0 0.0 1.0000 ECU_ADDRESS 0x30415C /begin FUNCTION_LIST TPU /end FUNCTION_LIST BIT_MASK 0x0040 /end MEASUREMENT
/begin MEASUREMENT tpu_inj_copy_time_zyl4 "TPU INJ copy time." ULONG FORMULA_INJ3 0 0 0.0 40.0000 ECU_ADDRESS 0x30415C /begin FUNCTION_LIST TPU /end FUNCTION_LIST BIT_MASK 0x003FFFFF /end MEASUREMENT
/* TPU INJ Parameter Zylinder 5 ----------------------------------------------------------*/
/begin MEASUREMENT tpu_inj_tdc_angle_high_zyl5 "TPU INJ MSB OT Lage." UWORD FORMULA_INJ1 0 0 0.0 719.9890 ECU_ADDRESS 0x304160 /begin FUNCTION_LIST TPU /end FUNCTION_LIST BIT_MASK 0xFF00 /end MEASUREMENT
/begin MEASUREMENT tpu_inj_tdc_angle_low_zyl5 "TPU INJ LSB OT Lage." UWORD FORMULA_INJ1 0 0 0.0 719.9890 ECU_ADDRESS 0x304166 /begin FUNCTION_LIST TPU /end FUNCTION_LIST BIT_MASK 0x00FF /end MEASUREMENT
/begin MEASUREMENT tpu_inj_demand_time_zyl5 "TPU INJ demand time." ULONG FORMULA_INJ10 0 0 0.0 40.0000 ECU_ADDRESS 0x304160 /begin FUNCTION_LIST TPU /end FUNCTION_LIST BIT_MASK 0x00FFFFFF /end MEASUREMENT
/begin MEASUREMENT tpu_inj_end_angle_zyl5 "TPU INJ end angle." UWORD FORMULA_INJ1 0 0 0.0 719.9890 ECU_ADDRESS 0x304164 /begin FUNCTION_LIST TPU /end FUNCTION_LIST /end MEASUREMENT
/begin MEASUREMENT tpu_inj_start_time_high_zyl5 "TPU INJ start time high." UWORD FORMULA_INJ11 0 0 0.0 2396.7450 ECU_ADDRESS 0x304166 /begin FUNCTION_LIST TPU /end FUNCTION_LIST BIT_MASK 0xFF00 /end MEASUREMENT
/begin MEASUREMENT tpu_inj_start_time_low_zyl5 "TPU INJ start time low." UWORD FORMULA_INJ2 0 0 0.0 9.3621 ECU_ADDRESS 0x304168 /begin FUNCTION_LIST TPU /end FUNCTION_LIST /end MEASUREMENT
/begin MEASUREMENT tpu_inj_temp_zyl5 "TPU INJ temp." UWORD FORMULA_INJ4 0 0 0.0 65535.0000 ECU_ADDRESS 0x304168 /begin FUNCTION_LIST TPU /end FUNCTION_LIST /end MEASUREMENT
/begin MEASUREMENT tpu_inj_main_zyl5 "TPU INJ main." UWORD FORMULA_INJ5 0 0 0.0 1.0000 ECU_ADDRESS 0x30416A /begin FUNCTION_LIST TPU /end FUNCTION_LIST BIT_MASK 0x8000 /end MEASUREMENT
/begin MEASUREMENT tpu_inj_first_zyl5 "TPU INJ first." UWORD FORMULA_INJ6 0 0 0.0 1.0000 ECU_ADDRESS 0x30416A /begin FUNCTION_LIST TPU /end FUNCTION_LIST BIT_MASK 0x4000 /end MEASUREMENT
/begin MEASUREMENT tpu_inj_out_time_low_zyl5 "TPU INJ out time low." UWORD FORMULA_INJ3 0 0 0.0 40.0000 ECU_ADDRESS 0x30416A /begin FUNCTION_LIST TPU /end FUNCTION_LIST BIT_MASK 0x3FFF /end MEASUREMENT
/begin MEASUREMENT tpu_inj_out_time_high_zyl5 "TPU INJ out time high." UWORD FORMULA_INJ9 0 0 0.0 40.0000 ECU_ADDRESS 0x30416C /begin FUNCTION_LIST TPU /end FUNCTION_LIST BIT_MASK 0xFF00 /end MEASUREMENT
/begin MEASUREMENT tpu_inj_min_off_zyl5 "TPU INJ min off." UWORD FORMULA_INJ7 0 0 0.0 1.0000 ECU_ADDRESS 0x30416C /begin FUNCTION_LIST TPU /end FUNCTION_LIST BIT_MASK 0x0080 /end MEASUREMENT
/begin MEASUREMENT tpu_inj_miss_zyl5 "TPU INJ miss." UWORD FORMULA_INJ8 0 0 0.0 1.0000 ECU_ADDRESS 0x30416C /begin FUNCTION_LIST TPU /end FUNCTION_LIST BIT_MASK 0x0040 /end MEASUREMENT
/begin MEASUREMENT tpu_inj_copy_time_zyl5 "TPU INJ copy time." ULONG FORMULA_INJ3 0 0 0.0 40.0000 ECU_ADDRESS 0x30416C /begin FUNCTION_LIST TPU /end FUNCTION_LIST BIT_MASK 0x003FFFFF /end MEASUREMENT
/* TPU INJ Parameter Zylinder 6 ----------------------------------------------------------*/
/begin MEASUREMENT tpu_inj_tdc_angle_high_zyl6 "TPU INJ MSB OT Lage." UWORD FORMULA_INJ1 0 0 0.0 719.9890 ECU_ADDRESS 0x304170 /begin FUNCTION_LIST TPU /end FUNCTION_LIST BIT_MASK 0xFF00 /end MEASUREMENT
/begin MEASUREMENT tpu_inj_tdc_angle_low_zyl6 "TPU INJ LSB OT Lage." UWORD FORMULA_INJ1 0 0 0.0 719.9890 ECU_ADDRESS 0x304176 /begin FUNCTION_LIST TPU /end FUNCTION_LIST BIT_MASK 0x00FF /end MEASUREMENT
/begin MEASUREMENT tpu_inj_demand_time_zyl6 "TPU INJ demand time." ULONG FORMULA_INJ10 0 0 0.0 40.0000 ECU_ADDRESS 0x304170 /begin FUNCTION_LIST TPU /end FUNCTION_LIST BIT_MASK 0x00FFFFFF /end MEASUREMENT
/begin MEASUREMENT tpu_inj_end_angle_zyl6 "TPU INJ end angle." UWORD FORMULA_INJ1 0 0 0.0 719.9890 ECU_ADDRESS 0x304174 /begin FUNCTION_LIST TPU /end FUNCTION_LIST /end MEASUREMENT
/begin MEASUREMENT tpu_inj_start_time_high_zyl6 "TPU INJ start time high." UWORD FORMULA_INJ11 0 0 0.0 2396.7450 ECU_ADDRESS 0x304176 /begin FUNCTION_LIST TPU /end FUNCTION_LIST BIT_MASK 0xFF00 /end MEASUREMENT
/begin MEASUREMENT tpu_inj_start_time_low_zyl6 "TPU INJ start time low." UWORD FORMULA_INJ2 0 0 0.0 9.3621 ECU_ADDRESS 0x304178 /begin FUNCTION_LIST TPU /end FUNCTION_LIST /end MEASUREMENT
/begin MEASUREMENT tpu_inj_temp_zyl6 "TPU INJ temp." UWORD FORMULA_INJ4 0 0 0.0 65535.0000 ECU_ADDRESS 0x304178 /begin FUNCTION_LIST TPU /end FUNCTION_LIST /end MEASUREMENT
/begin MEASUREMENT tpu_inj_main_zyl6 "TPU INJ main." UWORD FORMULA_INJ5 0 0 0.0 1.0000 ECU_ADDRESS 0x30417A /begin FUNCTION_LIST TPU /end FUNCTION_LIST BIT_MASK 0x8000 /end MEASUREMENT
/begin MEASUREMENT tpu_inj_first_zyl6 "TPU INJ first." UWORD FORMULA_INJ6 0 0 0.0 1.0000 ECU_ADDRESS 0x30417A /begin FUNCTION_LIST TPU /end FUNCTION_LIST BIT_MASK 0x4000 /end MEASUREMENT
/begin MEASUREMENT tpu_inj_out_time_low_zyl6 "TPU INJ out time low." UWORD FORMULA_INJ3 0 0 0.0 40.0000 ECU_ADDRESS 0x30417A /begin FUNCTION_LIST TPU /end FUNCTION_LIST BIT_MASK 0x3FFF /end MEASUREMENT
/begin MEASUREMENT tpu_inj_out_time_high_zyl6 "TPU INJ out time high." UWORD FORMULA_INJ9 0 0 0.0 40.0000 ECU_ADDRESS 0x30417C /begin FUNCTION_LIST TPU /end FUNCTION_LIST BIT_MASK 0xFF00 /end MEASUREMENT
/begin MEASUREMENT tpu_inj_min_off_zyl6 "TPU INJ min off." UWORD FORMULA_INJ7 0 0 0.0 1.0000 ECU_ADDRESS 0x30417C /begin FUNCTION_LIST TPU /end FUNCTION_LIST BIT_MASK 0x0080 /end MEASUREMENT
/begin MEASUREMENT tpu_inj_miss_zyl6 "TPU INJ miss." UWORD FORMULA_INJ8 0 0 0.0 1.0000 ECU_ADDRESS 0x30417C /begin FUNCTION_LIST TPU /end FUNCTION_LIST BIT_MASK 0x0040 /end MEASUREMENT
/begin MEASUREMENT tpu_inj_copy_time_zyl6 "TPU INJ copy time." ULONG FORMULA_INJ3 0 0 0.0 40.0000 ECU_ADDRESS 0x30417C /begin FUNCTION_LIST TPU /end FUNCTION_LIST BIT_MASK 0x003FFFFF /end MEASUREMENT
/* TPU INJ Parameter Zylinder 7 ----------------------------------------------------------*/
/begin MEASUREMENT tpu_inj_tdc_angle_high_zyl7 "TPU INJ MSB OT Lage." UWORD FORMULA_INJ1 0 0 0.0 719.9890 ECU_ADDRESS 0x304180 /begin FUNCTION_LIST TPU /end FUNCTION_LIST BIT_MASK 0xFF00 /end MEASUREMENT
/begin MEASUREMENT tpu_inj_tdc_angle_low_zyl7 "TPU INJ LSB OT Lage." UWORD FORMULA_INJ1 0 0 0.0 719.9890 ECU_ADDRESS 0x304186 /begin FUNCTION_LIST TPU /end FUNCTION_LIST BIT_MASK 0x00FF /end MEASUREMENT
/begin MEASUREMENT tpu_inj_demand_time_zyl7 "TPU INJ demand time." ULONG FORMULA_INJ10 0 0 0.0 40.0000 ECU_ADDRESS 0x304180 /begin FUNCTION_LIST TPU /end FUNCTION_LIST BIT_MASK 0x00FFFFFF /end MEASUREMENT
/begin MEASUREMENT tpu_inj_end_angle_zyl7 "TPU INJ end angle." UWORD FORMULA_INJ1 0 0 0.0 719.9890 ECU_ADDRESS 0x304184 /begin FUNCTION_LIST TPU /end FUNCTION_LIST /end MEASUREMENT
/begin MEASUREMENT tpu_inj_start_time_high_zyl7 "TPU INJ start time high." UWORD FORMULA_INJ11 0 0 0.0 2396.7450 ECU_ADDRESS 0x304186 /begin FUNCTION_LIST TPU /end FUNCTION_LIST BIT_MASK 0xFF00 /end MEASUREMENT
/begin MEASUREMENT tpu_inj_start_time_low_zyl7 "TPU INJ start time low." UWORD FORMULA_INJ2 0 0 0.0 9.3621 ECU_ADDRESS 0x304188 /begin FUNCTION_LIST TPU /end FUNCTION_LIST /end MEASUREMENT
/begin MEASUREMENT tpu_inj_temp_zyl7 "TPU INJ temp." UWORD FORMULA_INJ4 0 0 0.0 65535.0000 ECU_ADDRESS 0x304188 /begin FUNCTION_LIST TPU /end FUNCTION_LIST /end MEASUREMENT
/begin MEASUREMENT tpu_inj_main_zyl7 "TPU INJ main." UWORD FORMULA_INJ5 0 0 0.0 1.0000 ECU_ADDRESS 0x30418A /begin FUNCTION_LIST TPU /end FUNCTION_LIST BIT_MASK 0x8000 /end MEASUREMENT
/begin MEASUREMENT tpu_inj_first_zyl7 "TPU INJ first." UWORD FORMULA_INJ6 0 0 0.0 1.0000 ECU_ADDRESS 0x30418A /begin FUNCTION_LIST TPU /end FUNCTION_LIST BIT_MASK 0x4000 /end MEASUREMENT
/begin MEASUREMENT tpu_inj_out_time_low_zyl7 "TPU INJ out time low." UWORD FORMULA_INJ3 0 0 0.0 40.0000 ECU_ADDRESS 0x30418A /begin FUNCTION_LIST TPU /end FUNCTION_LIST BIT_MASK 0x3FFF /end MEASUREMENT
/begin MEASUREMENT tpu_inj_out_time_high_zyl7 "TPU INJ out time high." UWORD FORMULA_INJ9 0 0 0.0 40.0000 ECU_ADDRESS 0x30418C /begin FUNCTION_LIST TPU /end FUNCTION_LIST BIT_MASK 0xFF00 /end MEASUREMENT
/begin MEASUREMENT tpu_inj_min_off_zyl7 "TPU INJ min off." UWORD FORMULA_INJ7 0 0 0.0 1.0000 ECU_ADDRESS 0x30418C /begin FUNCTION_LIST TPU /end FUNCTION_LIST BIT_MASK 0x0080 /end MEASUREMENT
/begin MEASUREMENT tpu_inj_miss_zyl7 "TPU INJ miss." UWORD FORMULA_INJ8 0 0 0.0 1.0000 ECU_ADDRESS 0x30418C /begin FUNCTION_LIST TPU /end FUNCTION_LIST BIT_MASK 0x0040 /end MEASUREMENT
/begin MEASUREMENT tpu_inj_copy_time_zyl7 "TPU INJ copy time." ULONG FORMULA_INJ3 0 0 0.0 40.0000 ECU_ADDRESS 0x30418C /begin FUNCTION_LIST TPU /end FUNCTION_LIST BIT_MASK 0x003FFFFF /end MEASUREMENT
/* TPU INJ Parameter Zylinder 8 ----------------------------------------------------------*/
/begin MEASUREMENT tpu_inj_tdc_angle_high_zyl8 "TPU INJ MSB OT Lage." UWORD FORMULA_INJ1 0 0 0.0 719.9890 ECU_ADDRESS 0x304190 /begin FUNCTION_LIST TPU /end FUNCTION_LIST BIT_MASK 0xFF00 /end MEASUREMENT
/begin MEASUREMENT tpu_inj_tdc_angle_low_zyl8 "TPU INJ LSB OT Lage." UWORD FORMULA_INJ1 0 0 0.0 719.9890 ECU_ADDRESS 0x304196 /begin FUNCTION_LIST TPU /end FUNCTION_LIST BIT_MASK 0x00FF /end MEASUREMENT
/begin MEASUREMENT tpu_inj_demand_time_zyl8 "TPU INJ demand time." ULONG FORMULA_INJ10 0 0 0.0 40.0000 ECU_ADDRESS 0x304190 /begin FUNCTION_LIST TPU /end FUNCTION_LIST BIT_MASK 0x00FFFFFF /end MEASUREMENT
/begin MEASUREMENT tpu_inj_end_angle_zyl8 "TPU INJ end angle." UWORD FORMULA_INJ1 0 0 0.0 719.9890 ECU_ADDRESS 0x304194 /begin FUNCTION_LIST TPU /end FUNCTION_LIST /end MEASUREMENT
/begin MEASUREMENT tpu_inj_start_time_high_zyl8 "TPU INJ start time high." UWORD FORMULA_INJ11 0 0 0.0 2396.7450 ECU_ADDRESS 0x304196 /begin FUNCTION_LIST TPU /end FUNCTION_LIST BIT_MASK 0xFF00 /end MEASUREMENT
/begin MEASUREMENT tpu_inj_start_time_low_zyl8 "TPU INJ start time low." UWORD FORMULA_INJ2 0 0 0.0 9.3621 ECU_ADDRESS 0x304198 /begin FUNCTION_LIST TPU /end FUNCTION_LIST /end MEASUREMENT
/begin MEASUREMENT tpu_inj_temp_zyl8 "TPU INJ temp." UWORD FORMULA_INJ4 0 0 0.0 65535.0000 ECU_ADDRESS 0x304198 /begin FUNCTION_LIST TPU /end FUNCTION_LIST /end MEASUREMENT
/begin MEASUREMENT tpu_inj_main_zyl8 "TPU INJ main." UWORD FORMULA_INJ5 0 0 0.0 1.0000 ECU_ADDRESS 0x30419A /begin FUNCTION_LIST TPU /end FUNCTION_LIST BIT_MASK 0x8000 /end MEASUREMENT
/begin MEASUREMENT tpu_inj_first_zyl8 "TPU INJ first." UWORD FORMULA_INJ6 0 0 0.0 1.0000 ECU_ADDRESS 0x30419A /begin FUNCTION_LIST TPU /end FUNCTION_LIST BIT_MASK 0x4000 /end MEASUREMENT
/begin MEASUREMENT tpu_inj_out_time_low_zyl8 "TPU INJ out time low." UWORD FORMULA_INJ3 0 0 0.0 40.0000 ECU_ADDRESS 0x30419A /begin FUNCTION_LIST TPU /end FUNCTION_LIST BIT_MASK 0x3FFF /end MEASUREMENT
/begin MEASUREMENT tpu_inj_out_time_high_zyl8 "TPU INJ out time high." UWORD FORMULA_INJ9 0 0 0.0 40.0000 ECU_ADDRESS 0x30419C /begin FUNCTION_LIST TPU /end FUNCTION_LIST BIT_MASK 0xFF00 /end MEASUREMENT
/begin MEASUREMENT tpu_inj_min_off_zyl8 "TPU INJ min off." UWORD FORMULA_INJ7 0 0 0.0 1.0000 ECU_ADDRESS 0x30419C /begin FUNCTION_LIST TPU /end FUNCTION_LIST BIT_MASK 0x0080 /end MEASUREMENT
/begin MEASUREMENT tpu_inj_miss_zyl8 "TPU INJ miss." UWORD FORMULA_INJ8 0 0 0.0 1.0000 ECU_ADDRESS 0x30419C /begin FUNCTION_LIST TPU /end FUNCTION_LIST BIT_MASK 0x0040 /end MEASUREMENT
/begin MEASUREMENT tpu_inj_copy_time_zyl8 "TPU INJ copy time." ULONG FORMULA_INJ3 0 0 0.0 40.0000 ECU_ADDRESS 0x30419C /begin FUNCTION_LIST TPU /end FUNCTION_LIST BIT_MASK 0x003FFFFF /end MEASUREMENT
/* TPU INJ Parameter Zylinder 9 ----------------------------------------------------------*/
/begin MEASUREMENT tpu_inj_tdc_angle_high_zyl9 "TPU INJ MSB OT Lage." UWORD FORMULA_INJ1 0 0 0.0 719.9890 ECU_ADDRESS 0x3041A0 /begin FUNCTION_LIST TPU /end FUNCTION_LIST BIT_MASK 0xFF00 /end MEASUREMENT
/begin MEASUREMENT tpu_inj_tdc_angle_low_zyl9 "TPU INJ LSB OT Lage." UWORD FORMULA_INJ1 0 0 0.0 719.9890 ECU_ADDRESS 0x3041A6 /begin FUNCTION_LIST TPU /end FUNCTION_LIST BIT_MASK 0x00FF /end MEASUREMENT
/begin MEASUREMENT tpu_inj_demand_time_zyl9 "TPU INJ demand time." ULONG FORMULA_INJ10 0 0 0.0 40.0000 ECU_ADDRESS 0x3041A0 /begin FUNCTION_LIST TPU /end FUNCTION_LIST BIT_MASK 0x00FFFFFF /end MEASUREMENT
/begin MEASUREMENT tpu_inj_end_angle_zyl9 "TPU INJ end angle." UWORD FORMULA_INJ1 0 0 0.0 719.9890 ECU_ADDRESS 0x3041A4 /begin FUNCTION_LIST TPU /end FUNCTION_LIST /end MEASUREMENT
/begin MEASUREMENT tpu_inj_start_time_high_zyl9 "TPU INJ start time high." UWORD FORMULA_INJ11 0 0 0.0 2396.7450 ECU_ADDRESS 0x3041A6 /begin FUNCTION_LIST TPU /end FUNCTION_LIST BIT_MASK 0xFF00 /end MEASUREMENT
/begin MEASUREMENT tpu_inj_start_time_low_zyl9 "TPU INJ start time low." UWORD FORMULA_INJ2 0 0 0.0 9.3621 ECU_ADDRESS 0x3041A8 /begin FUNCTION_LIST TPU /end FUNCTION_LIST /end MEASUREMENT
/begin MEASUREMENT tpu_inj_temp_zyl9 "TPU INJ temp." UWORD FORMULA_INJ4 0 0 0.0 65535.0000 ECU_ADDRESS 0x3041A8 /begin FUNCTION_LIST TPU /end FUNCTION_LIST /end MEASUREMENT
/begin MEASUREMENT tpu_inj_main_zyl9 "TPU INJ main." UWORD FORMULA_INJ5 0 0 0.0 1.0000 ECU_ADDRESS 0x3041AA /begin FUNCTION_LIST TPU /end FUNCTION_LIST BIT_MASK 0x8000 /end MEASUREMENT
/begin MEASUREMENT tpu_inj_first_zyl9 "TPU INJ first." UWORD FORMULA_INJ6 0 0 0.0 1.0000 ECU_ADDRESS 0x3041AA /begin FUNCTION_LIST TPU /end FUNCTION_LIST BIT_MASK 0x4000 /end MEASUREMENT
/begin MEASUREMENT tpu_inj_out_time_low_zyl9 "TPU INJ out time low." UWORD FORMULA_INJ3 0 0 0.0 40.0000 ECU_ADDRESS 0x3041AA /begin FUNCTION_LIST TPU /end FUNCTION_LIST BIT_MASK 0x3FFF /end MEASUREMENT
/begin MEASUREMENT tpu_inj_out_time_high_zyl9 "TPU INJ out time high." UWORD FORMULA_INJ9 0 0 0.0 40.0000 ECU_ADDRESS 0x3041AC /begin FUNCTION_LIST TPU /end FUNCTION_LIST BIT_MASK 0xFF00 /end MEASUREMENT
/begin MEASUREMENT tpu_inj_min_off_zyl9 "TPU INJ min off." UWORD FORMULA_INJ7 0 0 0.0 1.0000 ECU_ADDRESS 0x3041AC /begin FUNCTION_LIST TPU /end FUNCTION_LIST BIT_MASK 0x0080 /end MEASUREMENT
/begin MEASUREMENT tpu_inj_miss_zyl9 "TPU INJ miss." UWORD FORMULA_INJ8 0 0 0.0 1.0000 ECU_ADDRESS 0x3041AC /begin FUNCTION_LIST TPU /end FUNCTION_LIST BIT_MASK 0x0040 /end MEASUREMENT
/begin MEASUREMENT tpu_inj_copy_time_zyl9 "TPU INJ copy time." ULONG FORMULA_INJ3 0 0 0.0 40.0000 ECU_ADDRESS 0x3041AC /begin FUNCTION_LIST TPU /end FUNCTION_LIST BIT_MASK 0x003FFFFF /end MEASUREMENT
/* TPU INJ Parameter Zylinder 10 ---------------------------------------------------------*/
/begin MEASUREMENT tpu_inj_tdc_angle_high_zyl10 "TPU INJ MSB OT Lage." UWORD FORMULA_INJ1 0 0 0.0 719.9890 ECU_ADDRESS 0x3041B0 /begin FUNCTION_LIST TPU /end FUNCTION_LIST BIT_MASK 0xFF00 /end MEASUREMENT
/begin MEASUREMENT tpu_inj_tdc_angle_low_zyl10 "TPU INJ LSB OT Lage." UWORD FORMULA_INJ1 0 0 0.0 719.9890 ECU_ADDRESS 0x3041B6 /begin FUNCTION_LIST TPU /end FUNCTION_LIST BIT_MASK 0x00FF /end MEASUREMENT
/begin MEASUREMENT tpu_inj_demand_time_zyl10 "TPU INJ demand time." ULONG FORMULA_INJ10 0 0 0.0 40.0000 ECU_ADDRESS 0x3041B0 /begin FUNCTION_LIST TPU /end FUNCTION_LIST BIT_MASK 0x00FFFFFF /end MEASUREMENT
/begin MEASUREMENT tpu_inj_end_angle_zyl10 "TPU INJ end angle." UWORD FORMULA_INJ1 0 0 0.0 719.9890 ECU_ADDRESS 0x3041B4 /begin FUNCTION_LIST TPU /end FUNCTION_LIST /end MEASUREMENT
/begin MEASUREMENT tpu_inj_start_time_high_zyl10 "TPU INJ start time high." UWORD FORMULA_INJ11 0 0 0.0 2396.7450 ECU_ADDRESS 0x3041B6 /begin FUNCTION_LIST TPU /end FUNCTION_LIST BIT_MASK 0xFF00 /end MEASUREMENT
/begin MEASUREMENT tpu_inj_start_time_low_zyl10 "TPU INJ start time low." UWORD FORMULA_INJ2 0 0 0.0 9.3621 ECU_ADDRESS 0x3041B8 /begin FUNCTION_LIST TPU /end FUNCTION_LIST /end MEASUREMENT
/begin MEASUREMENT tpu_inj_temp_zyl10 "TPU INJ temp." UWORD FORMULA_INJ4 0 0 0.0 65535.0000 ECU_ADDRESS 0x3041B8 /begin FUNCTION_LIST TPU /end FUNCTION_LIST /end MEASUREMENT
/begin MEASUREMENT tpu_inj_main_zyl10 "TPU INJ main." UWORD FORMULA_INJ5 0 0 0.0 1.0000 ECU_ADDRESS 0x3041BA /begin FUNCTION_LIST TPU /end FUNCTION_LIST BIT_MASK 0x8000 /end MEASUREMENT
/begin MEASUREMENT tpu_inj_first_zyl10 "TPU INJ first." UWORD FORMULA_INJ6 0 0 0.0 1.0000 ECU_ADDRESS 0x3041BA /begin FUNCTION_LIST TPU /end FUNCTION_LIST BIT_MASK 0x4000 /end MEASUREMENT
/begin MEASUREMENT tpu_inj_out_time_low_zyl10 "TPU INJ out time low." UWORD FORMULA_INJ3 0 0 0.0 40.0000 ECU_ADDRESS 0x3041BA /begin FUNCTION_LIST TPU /end FUNCTION_LIST BIT_MASK 0x3FFF /end MEASUREMENT
/begin MEASUREMENT tpu_inj_out_time_high_zyl10 "TPU INJ out time high." UWORD FORMULA_INJ9 0 0 0.0 40.0000 ECU_ADDRESS 0x3041BC /begin FUNCTION_LIST TPU /end FUNCTION_LIST BIT_MASK 0xFF00 /end MEASUREMENT
/begin MEASUREMENT tpu_inj_min_off_zyl10 "TPU INJ min off." UWORD FORMULA_INJ7 0 0 0.0 1.0000 ECU_ADDRESS 0x3041BC /begin FUNCTION_LIST TPU /end FUNCTION_LIST BIT_MASK 0x0080 /end MEASUREMENT
/begin MEASUREMENT tpu_inj_miss_zyl10 "TPU INJ miss." UWORD FORMULA_INJ8 0 0 0.0 1.0000 ECU_ADDRESS 0x3041BC /begin FUNCTION_LIST TPU /end FUNCTION_LIST BIT_MASK 0x0040 /end MEASUREMENT
/begin MEASUREMENT tpu_inj_copy_time_zyl10 "TPU INJ copy time." ULONG FORMULA_INJ3 0 0 0.0 40.0000 ECU_ADDRESS 0x3041BC /begin FUNCTION_LIST TPU /end FUNCTION_LIST BIT_MASK 0x003FFFFF /end MEASUREMENT
/* ------------------ Abschnitt erzeugt aus adapt_common.dat ------------------ */
/begin COMPU_METHOD FORMULA_0000 "FORMULA_0000" RAT_FUNC "%7.0" "-" COEFFS 0 1 0 0 0 1 /end COMPU_METHOD
/begin COMPU_METHOD FORMULA_0001 "FORMULA_0001" RAT_FUNC "%6.1" "%" COEFFS 0 10 0 0 0 1 /end COMPU_METHOD
/begin COMPU_METHOD FORMULA_0003 "FORMULA_0003" RAT_FUNC "%3.0" "-" COEFFS 0 1 0 0 0 1 /end COMPU_METHOD
/begin COMPU_METHOD FORMULA_0006 "FORMULA_0006" RAT_FUNC "%5.0" "Upm" COEFFS 0 1 0 0 0 1 /end COMPU_METHOD
/begin COMPU_METHOD FORMULA_0007 "FORMULA_0007" RAT_FUNC "%8.3" "-" COEFFS 0 10000 0 0 0 1 /end COMPU_METHOD
/begin COMPU_METHOD FORMULA_0008 "FORMULA_0008" RAT_FUNC "%6.1" "V" COEFFS 0 10 0 0 0 1 /end COMPU_METHOD
/begin COMPU_METHOD FORMULA_0010 "FORMULA_0010" RAT_FUNC "%5.0" "-" COEFFS 0 1 0 0 0 1 /end COMPU_METHOD
/begin COMPU_METHOD FORMULA_0021 "FORMULA_0021" RAT_FUNC "%7.2" "s" COEFFS 0 100 0 0 0 1 /end COMPU_METHOD
/begin COMPU_METHOD FORMULA_0022 "FORMULA_0022" RAT_FUNC "%7.2" "%" COEFFS 0 100 0 0 0 1 /end COMPU_METHOD
/* ------------------ Abschnitt erzeugt aus adapt_glob.dat ------------------ */
/begin COMPU_METHOD FORMULA_0023 "FORMULA_0023" RAT_FUNC "%6.1" "�C" COEFFS 0 10 2732 0 0 1 /end COMPU_METHOD
/begin COMPU_METHOD FORMULA_0024 "FORMULA_0024" RAT_FUNC "%9.4" "-" COEFFS 0 32768 0 0 0 1 /end COMPU_METHOD
/begin COMPU_METHOD FORMULA_0025 "FORMULA_0025" RAT_FUNC "%8.3" "-" COEFFS 0 16384 0 0 0 1 /end COMPU_METHOD
/begin COMPU_METHOD FORMULA_0073 "FORMULA_0073" RAT_FUNC "%6.1" "s" COEFFS 0 10 0 0 0 1 /end COMPU_METHOD
/begin COMPU_METHOD FORMULA_0075 "FORMULA_0075" RAT_FUNC "%8.3" "-" COEFFS 0 1024 0 0 0 1 /end COMPU_METHOD
/begin COMPU_METHOD FORMULA_0076 "FORMULA_0076" RAT_FUNC "%6.1" "Kelvin" COEFFS 0 10 0 0 0 1 /end COMPU_METHOD
/begin COMPU_METHOD FORMULA_0077 "FORMULA_0077" RAT_FUNC "%6.1" "mbar" COEFFS 0 16 0 0 0 1 /end COMPU_METHOD
/begin COMPU_METHOD FORMULA_0111 "FORMULA_0111" RAT_FUNC "%6.1" "�KW" COEFFS 0 10 0 0 0 1 /end COMPU_METHOD
/begin COMPU_METHOD FORMULA_0112 "FORMULA_0112" RAT_FUNC "%6.1" "kg/h" COEFFS 0 10 0 0 0 1 /end COMPU_METHOD
/begin COMPU_METHOD FORMULA_0115 "FORMULA_0115" RAT_FUNC "%7.2" "%" COEFFS 0 16384 0 0 0 100 /end COMPU_METHOD
/begin COMPU_METHOD FORMULA_0118 "FORMULA_0118" RAT_FUNC "%8.3" "bar" COEFFS 0 1000 0 0 0 1 /end COMPU_METHOD
/begin COMPU_METHOD FORMULA_0121 "FORMULA_0121" RAT_FUNC "%7.2" "Nm" COEFFS 0 10 0 0 0 1 /end COMPU_METHOD
/begin COMPU_METHOD FORMULA_0129 "FORMULA_0129" RAT_FUNC "%6.1" "Nm" COEFFS 0 2 0 0 0 1 /end COMPU_METHOD
/begin COMPU_METHOD FORMULA_0141 "FORMULA_0141" RAT_FUNC "%7.2" "Grad" COEFFS 0 1 0 0 0 0.04395 /end COMPU_METHOD
/begin COMPU_METHOD FORMULA_0190 "FORMULA_0190" TAB_VERB "%7.2" "-" COMPU_TAB_REF FORMULA_0190_VTAB /end COMPU_METHOD
/begin COMPU_VTAB FORMULA_0190_VTAB "FORMULA_0190_VTAB" TAB_VERB 2 0 "no" 1 "yes" /end COMPU_VTAB
/begin COMPU_METHOD FORMULA_0191 "FORMULA_0191" TAB_VERB "%7.2" "-" COMPU_TAB_REF FORMULA_0191_VTAB /end COMPU_METHOD
/begin COMPU_VTAB FORMULA_0191_VTAB "FORMULA_0191_VTAB" TAB_VERB 2 0 "no" 1 "yes" /end COMPU_VTAB
/begin COMPU_METHOD FORMULA_0295 "FORMULA_0295" RAT_FUNC "%9.4" "-" COEFFS 0 16384 0 0 0 1 /end COMPU_METHOD
/* ------------------ Abschnitt erzeugt aus tpu_kw.dat ------------------ */
/begin COMPU_METHOD FORMULA_0402 "FORMULA_0402" TAB_VERB "%3.0" "-" COMPU_TAB_REF FORMULA_0402_VTAB /end COMPU_METHOD
/begin COMPU_VTAB FORMULA_0402_VTAB "FORMULA_0402_VTAB" TAB_VERB 5 0 "sync - 720� Mode" 1 "sync - 360� Mode" 129 "suche Luecke" 161 "Zahnentprellung laeuft" 225 "nicht sync." /end COMPU_VTAB
/begin COMPU_METHOD FORMULA_0403 "FORMULA_0403" RAT_FUNC "%3.0" "-" COEFFS 0 -1 1 0 0 -1 /end COMPU_METHOD
/begin COMPU_METHOD FORMULA_0404 "FORMULA_0404" TAB_VERB "%3.0" "-" COMPU_TAB_REF FORMULA_0404_VTAB /end COMPU_METHOD
/begin COMPU_VTAB FORMULA_0404_VTAB "FORMULA_0404_VTAB" TAB_VERB 1 0 "Kein Interrupt." DEFAULT_VALUE "Mind. Einfachinterrupt." /end COMPU_VTAB
/begin COMPU_METHOD FORMULA_0405 "FORMULA_0405" TAB_VERB "%3.0" "-" COMPU_TAB_REF FORMULA_0405_VTAB /end COMPU_METHOD
/begin COMPU_VTAB FORMULA_0405_VTAB "FORMULA_0405_VTAB" TAB_VERB 1 0 "nein." DEFAULT_VALUE "aktiv." /end COMPU_VTAB
/begin COMPU_METHOD FORMULA_0406 "FORMULA_0406" TAB_VERB "%3.0" "-" COMPU_TAB_REF FORMULA_0406_VTAB /end COMPU_METHOD
/begin COMPU_VTAB FORMULA_0406_VTAB "FORMULA_0406_VTAB" TAB_VERB 1 0 "nein." DEFAULT_VALUE "aktiv." /end COMPU_VTAB
/begin COMPU_METHOD FORMULA_0407 "FORMULA_0407" TAB_VERB "%3.0" "-" COMPU_TAB_REF FORMULA_0407_VTAB /end COMPU_METHOD
/begin COMPU_VTAB FORMULA_0407_VTAB "FORMULA_0407_VTAB" TAB_VERB 1 0 "nein." DEFAULT_VALUE "aktiv." /end COMPU_VTAB
/begin COMPU_METHOD FORMULA_0408 "FORMULA_0408" TAB_VERB "%3.0" "-" COMPU_TAB_REF FORMULA_0408_VTAB /end COMPU_METHOD
/begin COMPU_VTAB FORMULA_0408_VTAB "FORMULA_0408_VTAB" TAB_VERB 1 0 "nein." DEFAULT_VALUE "aktiv." /end COMPU_VTAB
/begin COMPU_METHOD FORMULA_0409 "FORMULA_0409" TAB_VERB "%3.0" "-" COMPU_TAB_REF FORMULA_0409_VTAB /end COMPU_METHOD
/begin COMPU_VTAB FORMULA_0409_VTAB "FORMULA_0409_VTAB" TAB_VERB 1 0 "nein." DEFAULT_VALUE "aktiv." /end COMPU_VTAB
/begin COMPU_METHOD FORMULA_0410 "FORMULA_0410" TAB_VERB "%3.0" "-" COMPU_TAB_REF FORMULA_0410_VTAB /end COMPU_METHOD
/begin COMPU_VTAB FORMULA_0410_VTAB "FORMULA_0410_VTAB" TAB_VERB 1 0 "nein." DEFAULT_VALUE "aktiv." /end COMPU_VTAB
/begin COMPU_METHOD FORMULA_0411 "FORMULA_0411" TAB_VERB "%3.0" "-" COMPU_TAB_REF FORMULA_0411_VTAB /end COMPU_METHOD
/begin COMPU_VTAB FORMULA_0411_VTAB "FORMULA_0411_VTAB" TAB_VERB 1 0 "nein." DEFAULT_VALUE "aktiv." /end COMPU_VTAB
/begin COMPU_METHOD FORMULA_0412 "FORMULA_0412" TAB_VERB "%3.0" "-" COMPU_TAB_REF FORMULA_0412_VTAB /end COMPU_METHOD
/begin COMPU_VTAB FORMULA_0412_VTAB "FORMULA_0412_VTAB" TAB_VERB 1 0 "nein." DEFAULT_VALUE "aktiv." /end COMPU_VTAB
/begin COMPU_METHOD FORMULA_0413 "FORMULA_0413" RAT_FUNC "%5.0" "Upm" COEFFS 0 0 27344 0 1 0 /end COMPU_METHOD
/* ------------------ Abschnitt erzeugt aus dgen.dat ------------------ */
/begin COMPU_METHOD FORMULA_0458 "FORMULA_0458" RAT_FUNC "%4.1" "s" COEFFS 0 10 0 0 0 1 /end COMPU_METHOD
/begin COMPU_METHOD FORMULA_0556 "FORMULA_0556" RAT_FUNC "%9.4" "-" COEFFS 0 10000 0 0 0 1 /end COMPU_METHOD
/begin COMPU_METHOD FORMULA_0561 "FORMULA_0561" RAT_FUNC "%8.3" "kg/h" COEFFS 0 1000 0 0 0 1 /end COMPU_METHOD
/begin COMPU_METHOD FORMULA_0600 "FORMULA_0600" RAT_FUNC "%7.2" "min" COEFFS 0 60 0 0 0 1 /end COMPU_METHOD
/begin COMPU_METHOD FORMULA_0643 "FORMULA_0643" RAT_FUNC "%5.2" "" COEFFS 0 128 0 0 0 1 /end COMPU_METHOD
/begin COMPU_METHOD FORMULA_0655 "FORMULA_0655" RAT_FUNC "%5.2" "-" COEFFS 0 32 0 0 0 1 /end COMPU_METHOD
/begin COMPU_METHOD FORMULA_0664 "FORMULA_0664" RAT_FUNC "%5.2" "s" COEFFS 0 0 2.56 0 1 0 /end COMPU_METHOD
/begin COMPU_METHOD FORMULA_0709 "FORMULA_0709" RAT_FUNC "%6.1" "%" COEFFS 0 100 0 0 0 1 /end COMPU_METHOD
/* ------------------ Abschnitt erzeugt aus kva.dat ------------------ */
/begin COMPU_METHOD FORMULA_0746 "FORMULA_0746" RAT_FUNC "%6.1" "l/h" COEFFS 0 8 0 0 0 1 /end COMPU_METHOD
/begin COMPU_METHOD FORMULA_0752 "FORMULA_0752" RAT_FUNC "%7.2" "mg" COEFFS 0 64 0 0 0 1 /end COMPU_METHOD
/begin COMPU_METHOD FORMULA_0786 "FORMULA_0786" RAT_FUNC "%7.2" "ms" COEFFS 0 1000 0 0 0 1 /end COMPU_METHOD
/begin COMPU_METHOD FORMULA_0805 "FORMULA_0805" RAT_FUNC "%7.2" "-" COEFFS 0 128 0 0 0 1 /end COMPU_METHOD
/begin COMPU_METHOD FORMULA_0839 "FORMULA_0839" TAB_VERB "%5.2" "-" COMPU_TAB_REF FORMULA_0839_VTAB /end COMPU_METHOD
/begin COMPU_VTAB FORMULA_0839_VTAB "FORMULA_0839_VTAB" TAB_VERB 2 0 "inaktiv" 1 "aktiv" /end COMPU_VTAB
/begin COMPU_METHOD FORMULA_0998 "FORMULA_0998" RAT_FUNC "%7.2" "ms" COEFFS 0 100 0 0 0 1 /end COMPU_METHOD
/* ------------------ Abschnitt erzeugt aus nw.dat ------------------ */
/begin COMPU_METHOD FORMULA_1005 "FORMULA_1005" TAB_VERB "%3.0" "-" COMPU_TAB_REF FORMULA_1005_VTAB /end COMPU_METHOD
/begin COMPU_VTAB FORMULA_1005_VTAB "FORMULA_1005_VTAB" TAB_VERB 2 0 "Schnellsync." 1 "sichere Sync." /end COMPU_VTAB
/begin COMPU_METHOD FORMULA_1034 "FORMULA_1034" RAT_FUNC "%8.3" "-" COEFFS 0 1000 0 0 0 1 /end COMPU_METHOD
/begin COMPU_METHOD FORMULA_1059 "FORMULA_1059" RAT_FUNC "%7.2" "s" COEFFS 0 0 6553.5 0 1 0 /end COMPU_METHOD
/begin COMPU_METHOD FORMULA_1082 "FORMULA_1082" RAT_FUNC "%6.1" "Hz" COEFFS 0 10 0 0 0 1 /end COMPU_METHOD
/* ------------------ Abschnitt erzeugt aus tanzyl.dat ------------------ */
/begin COMPU_METHOD FORMULA_1129 "FORMULA_1129" TAB_VERB "%3.0" "-" COMPU_TAB_REF FORMULA_1129_VTAB /end COMPU_METHOD
/begin COMPU_VTAB FORMULA_1129_VTAB "FORMULA_1129_VTAB" TAB_VERB 2 0 "Modellierung" 255 "Initialisierung" /end COMPU_VTAB
/begin COMPU_METHOD FORMULA_1130 "FORMULA_1130" TAB_VERB "%3.0" "-" COMPU_TAB_REF FORMULA_1130_VTAB /end COMPU_METHOD
/begin COMPU_VTAB FORMULA_1130_VTAB "FORMULA_1130_VTAB" TAB_VERB 4 0 "In tumg, Out tanzyl" 1 "In tumg, Out tan_mw" 2 "In tan_mw, Out tanzyl" 3 "In tan_mw, Out tan_mw" DEFAULT_VALUE "undefiniert" /end COMPU_VTAB
/* ------------------ Abschnitt erzeugt aus te.dat ------------------ */
/begin COMPU_METHOD FORMULA_1131 "FORMULA_1131" TAB_VERB "%5.2" "-" COMPU_TAB_REF FORMULA_1131_VTAB /end COMPU_METHOD
/begin COMPU_VTAB FORMULA_1131_VTAB "FORMULA_1131_VTAB" TAB_VERB 2 0 "nein" 1 "ja" /end COMPU_VTAB
/begin COMPU_METHOD FORMULA_1132 "FORMULA_1132" TAB_VERB "%5.2" "-" COMPU_TAB_REF FORMULA_1132_VTAB /end COMPU_METHOD
/begin COMPU_VTAB FORMULA_1132_VTAB "FORMULA_1132_VTAB" TAB_VERB 2 0 "nein -" 1 "ja" /end COMPU_VTAB
/begin COMPU_METHOD FORMULA_1133 "FORMULA_1133" TAB_VERB "%5.2" "-" COMPU_TAB_REF FORMULA_1133_VTAB /end COMPU_METHOD
/begin COMPU_VTAB FORMULA_1133_VTAB "FORMULA_1133_VTAB" TAB_VERB 2 0 "nein" 1 "ja" /end COMPU_VTAB
/begin COMPU_METHOD FORMULA_1134 "FORMULA_1134" TAB_VERB "%5.2" "-" COMPU_TAB_REF FORMULA_1134_VTAB /end COMPU_METHOD
/begin COMPU_VTAB FORMULA_1134_VTAB "FORMULA_1134_VTAB" TAB_VERB 8 0 "keine" 1 "LAM_REG" 2 "TI_MIN" 3 "LAM_REG+TI_MIN" 4 "LAM_DELTA" 5 "LAM_REG+LAM_DELTA" 6 "TI_MIN+LAM_DELTA" 7 "LAM_REG+TI_MIN+LAM_DELTA" DEFAULT_VALUE "undef" /end COMPU_VTAB
/begin COMPU_METHOD FORMULA_1135 "FORMULA_1135" TAB_VERB "%7.2" "-" COMPU_TAB_REF FORMULA_1135_VTAB /end COMPU_METHOD
/begin COMPU_VTAB FORMULA_1135_VTAB "FORMULA_1135_VTAB" TAB_VERB 4 1 "INI" 2 "RESET" 4 "LERNEN" 8 "RED.LERNEN" DEFAULT_VALUE "nicht verf." /end COMPU_VTAB
/begin COMPU_METHOD FORMULA_1136 "FORMULA_1136" TAB_VERB "%7.2" "-" COMPU_TAB_REF FORMULA_1136_VTAB /end COMPU_METHOD
/begin COMPU_VTAB FORMULA_1136_VTAB "FORMULA_1136_VTAB" TAB_VERB 2 0 "-" 1 "aktiviert" /end COMPU_VTAB
/begin COMPU_METHOD FORMULA_1137 "FORMULA_1137" TAB_VERB "%7.2" "-" COMPU_TAB_REF FORMULA_1137_VTAB /end COMPU_METHOD
/begin COMPU_VTAB FORMULA_1137_VTAB "FORMULA_1137_VTAB" TAB_VERB 2 0 "-" 1 "aktiviert" /end COMPU_VTAB
/begin COMPU_METHOD FORMULA_1138 "FORMULA_1138" RAT_FUNC "%9.4" "1/100ms" COEFFS 0 32768 0 0 0 1 /end COMPU_METHOD
/begin COMPU_METHOD FORMULA_1139 "FORMULA_1139" RAT_FUNC "%8.3" "m3/kg" COEFFS 0 1000 0 0 0 1 /end COMPU_METHOD
/begin COMPU_METHOD FORMULA_1140 "FORMULA_1140" RAT_FUNC "%5.0" "(kg/(m2*s))2" COEFFS 0 1 0 0 0 9 /end COMPU_METHOD
/begin COMPU_METHOD FORMULA_1141 "FORMULA_1141" RAT_FUNC "%5.0" "kg/(m2*s)" COEFFS 0 1 0 0 0 1 /end COMPU_METHOD
/begin COMPU_METHOD FORMULA_1142 "FORMULA_1142" RAT_FUNC "%7.2" "10exp-3" COEFFS 0 65 0 0 0 1 /end COMPU_METHOD
/begin COMPU_METHOD FORMULA_1143 "FORMULA_1143" RAT_FUNC "%8.3" "J/kg*K" COEFFS 0 1 0 0 0 1 /end COMPU_METHOD
/begin COMPU_METHOD FORMULA_1144 "FORMULA_1144" RAT_FUNC "%9.4" "-" COEFFS 0 1000 0 0 0 1 /end COMPU_METHOD
/begin COMPU_METHOD FORMULA_1145 "FORMULA_1145" RAT_FUNC "%8.3" "l/min" COEFFS 0 500 0 0 0 1 /end COMPU_METHOD
/begin COMPU_METHOD FORMULA_1146 "FORMULA_1146" RAT_FUNC "%9.2" "l" COEFFS 0 300000 0 0 0 1 /end COMPU_METHOD
/begin COMPU_METHOD FORMULA_1147 "FORMULA_1147" RAT_FUNC "%8.3" "qmm" COEFFS 0 1000 0 0 0 1 /end COMPU_METHOD
/begin COMPU_METHOD FORMULA_1148 "FORMULA_1148" TAB_VERB "%5.2" "-" COMPU_TAB_REF FORMULA_1148_VTAB /end COMPU_METHOD
/begin COMPU_VTAB FORMULA_1148_VTAB "FORMULA_1148_VTAB" TAB_VERB 3 0 "TE inaktiv" 1 "TE aktiv" 2 "te_mks=0 bei TE_OBD" /end COMPU_VTAB
/begin COMPU_METHOD FORMULA_1149 "FORMULA_1149" TAB_VERB "%5.2" "-" COMPU_TAB_REF FORMULA_1149_VTAB /end COMPU_METHOD
/begin COMPU_VTAB FORMULA_1149_VTAB "FORMULA_1149_VTAB" TAB_VERB 2 0 "applikativ" 1 "errechnet" /end COMPU_VTAB
/begin COMPU_METHOD FORMULA_1150 "FORMULA_1150" TAB_VERB "%5.2" "-" COMPU_TAB_REF FORMULA_1150_VTAB /end COMPU_METHOD
/begin COMPU_VTAB FORMULA_1150_VTAB "FORMULA_1150_VTAB" TAB_VERB 2 0 "APPL-Wert" 1 "KF-Wert" /end COMPU_VTAB
/begin COMPU_METHOD FORMULA_1151 "FORMULA_1151" TAB_VERB "%7.2" "-" COMPU_TAB_REF FORMULA_1151_VTAB /end COMPU_METHOD
/begin COMPU_VTAB FORMULA_1151_VTAB "FORMULA_1151_VTAB" TAB_VERB 2 0 "Rampen-Wert" 1 "Appl-Wert" /end COMPU_VTAB
/begin COMPU_METHOD FORMULA_1152 "FORMULA_1152" RAT_FUNC "%5.0" "kg/(m2*s)" COEFFS 0 1 0 0 0 3 /end COMPU_METHOD
/* ------------------ Abschnitt erzeugt aus te_obd.dat ------------------ */
/begin COMPU_METHOD FORMULA_1153 "FORMULA_1153" RAT_FUNC "%7.2" "nSs" COEFFS 0 1 0 0 0 0.00061 /end COMPU_METHOD
/begin COMPU_METHOD FORMULA_1154 "FORMULA_1154" RAT_FUNC "%7.2" "kg/h" COEFFS 0 640 0 0 0 1 /end COMPU_METHOD
/begin COMPU_METHOD FORMULA_1155 "FORMULA_1155" TAB_VERB "%5.2" "-" COMPU_TAB_REF FORMULA_1155_VTAB /end COMPU_METHOD
/begin COMPU_VTAB FORMULA_1155_VTAB "FORMULA_1155_VTAB" TAB_VERB 6 0 "AUS" 1 "MESSEN" 2 "DEFEKT" 3 "OK_LAM" 4 "OK_AUSS" 5 "OK_LL" /end COMPU_VTAB
/begin COMPU_METHOD FORMULA_1156 "FORMULA_1156" TAB_VERB "%5.2" "-" COMPU_TAB_REF FORMULA_1156_VTAB /end COMPU_METHOD
/begin COMPU_VTAB FORMULA_1156_VTAB "FORMULA_1156_VTAB" TAB_VERB 28 0 "AUS" 1 "WAIT_TOEL" 2 "WAIT_KATH" 3 "WAIT_TESTER" 4 "WAIT_LRW" 5 "WAIT_V" 6 "WAIT_KKOS" 7 "WAIT_GEN" 8 "WAIT_BLS" 9 "WAIT_ML" 10 "WAIT_LL" 11 "WAIT_UB" 12 "WAIT_FEHLER" 13 "WAIT_DMTL" 14 "WAIT_LAM" 15 "WAIT_TZ" 16 "WAIT_PRUEFSTAND" 17 "WAIT_LLR" 18 "START_DELAY" 19 "PRE_SCHL" 20 "PRE_ZU" 21 "TEV_OEFFNEN" 22 "TEV_OFFEN" 23 "TEV_SCHLIESSEN" 24 "TEV_ZU" 25 "ABBRUCH" 26 "FERTIG" 27 "NEUSTART" /end COMPU_VTAB
/begin COMPU_METHOD FORMULA_1157 "FORMULA_1157" TAB_VERB "%5.2" "-" COMPU_TAB_REF FORMULA_1157_VTAB /end COMPU_METHOD
/begin COMPU_VTAB FORMULA_1157_VTAB "FORMULA_1157_VTAB" TAB_VERB 5 0 "ohne_KKOS_Abwurf LAA_reset" 1 "LAA_freeze" 2 "KKOS_Abwurf" 3 "KKOS_Abwurf LAA_freeze" 4 "RESET" DEFAULT_VALUE "undef." /end COMPU_VTAB
/begin COMPU_METHOD FORMULA_1158 "FORMULA_1158" RAT_FUNC "%6.1" "%/100ms" COEFFS 0 10 0 0 0 1 /end COMPU_METHOD
/* ------------------ Abschnitt erzeugt aus tksm.dat ------------------ */
/begin COMPU_METHOD FORMULA_1189 "FORMULA_1189" TAB_VERB "%3.0" "-" COMPU_TAB_REF FORMULA_1189_VTAB /end COMPU_METHOD
/begin COMPU_VTAB FORMULA_1189_VTAB "FORMULA_1189_VTAB" TAB_VERB 2 0 "Quelle ist Modell" 1 "Quelle ist tmot" DEFAULT_VALUE "undefiniert" /end COMPU_VTAB
/* ------------------ Abschnitt erzeugt aus tz_diag.dat ------------------ */
/begin COMPU_METHOD FORMULA_1190 "FORMULA_1190" RAT_FUNC "%3.0" "seg" COEFFS 0 1 0 0 0 2 /end COMPU_METHOD
/* ------------------ Abschnitt erzeugt aus tpu_code.dat ------------------ */
/begin MEASUREMENT tpu_code_status "TPU MicroCode Status." UWORD FORMULA_0010 0 0 0.0 65535.0000 ECU_ADDRESS 0x3FD46E /end MEASUREMENT
/begin MEASUREMENT tpu_a.TPUMCR "TPU3 Module Configuration Register." UWORD FORMULA_0010 0 0 0.0 65535.0000 ECU_ADDRESS 0x304000 /end MEASUREMENT
/begin MEASUREMENT tpu_a.TICR "TPU3 Interrupt Configuration Register." UWORD FORMULA_0010 0 0 0.0 65535.0000 ECU_ADDRESS 0x304008 /end MEASUREMENT
/begin MEASUREMENT tpu_a.CIER "Channel Interrupt Enable Register." UWORD FORMULA_0010 0 0 0.0 65535.0000 ECU_ADDRESS 0x30400A /end MEASUREMENT
/begin MEASUREMENT tpu_a.CFSR01 "Channel Funktion Selection Register 0,1." ULONG FORMULA_0000 0 0 0.0 4294967295.0000 ECU_ADDRESS 0x30400C /end MEASUREMENT
/begin MEASUREMENT tpu_a.CFSR23 "Channel Funktion Selection Register 2,3." ULONG FORMULA_0000 0 0 0.0 4294967295.0000 ECU_ADDRESS 0x304010 /end MEASUREMENT
/begin MEASUREMENT tpu_a.HSQR "Host Sequence Register 0,1." ULONG FORMULA_0000 0 0 0.0 4294967295.0000 ECU_ADDRESS 0x304014 /end MEASUREMENT
/begin MEASUREMENT tpu_a.HSRR "Host Service Request Register 0,1." ULONG FORMULA_0000 0 0 0.0 4294967295.0000 ECU_ADDRESS 0x304018 /end MEASUREMENT
/begin MEASUREMENT tpu_a.CPR "Channel Priority Register 0,1." ULONG FORMULA_0000 0 0 0.0 4294967295.0000 ECU_ADDRESS 0x30401C /end MEASUREMENT
/begin MEASUREMENT tpu_a.CISR "Channel Interrupt Status Register." UWORD FORMULA_0010 0 0 0.0 65535.0000 ECU_ADDRESS 0x304020 /end MEASUREMENT
/begin MEASUREMENT tpu_a.TPUMCR2 "TPU Module Configuration Register 2." UWORD FORMULA_0010 0 0 0.0 65535.0000 ECU_ADDRESS 0x304028 /end MEASUREMENT
/begin MEASUREMENT tpu_a.TPUMCR3 "TPU Module Configuration Register 3." UWORD FORMULA_0010 0 0 0.0 65535.0000 ECU_ADDRESS 0x30402A /end MEASUREMENT
/begin MEASUREMENT tpu_b.TPUMCR "TPU3 Module Configuration Register." UWORD FORMULA_0010 0 0 0.0 65535.0000 ECU_ADDRESS 0x304400 /end MEASUREMENT
/begin MEASUREMENT tpu_b.TICR "TPU3 Interrupt Configuration Register." UWORD FORMULA_0010 0 0 0.0 65535.0000 ECU_ADDRESS 0x304408 /end MEASUREMENT
/begin MEASUREMENT tpu_b.CIER "Channel Interrupt Enable Register." UWORD FORMULA_0010 0 0 0.0 65535.0000 ECU_ADDRESS 0x30440A /end MEASUREMENT
/begin MEASUREMENT tpu_b.CFSR01 "Channel Funktion Selection Register 0,1." ULONG FORMULA_0000 0 0 0.0 4294967295.0000 ECU_ADDRESS 0x30440C /end MEASUREMENT
/begin MEASUREMENT tpu_b.CFSR23 "Channel Funktion Selection Register 2,3." ULONG FORMULA_0000 0 0 0.0 4294967295.0000 ECU_ADDRESS 0x304410 /end MEASUREMENT
/begin MEASUREMENT tpu_b.HSQR "Host Sequence Register 0,1." ULONG FORMULA_0000 0 0 0.0 4294967295.0000 ECU_ADDRESS 0x304414 /end MEASUREMENT
/begin MEASUREMENT tpu_b.HSRR "Host Service Request Register 0,1." ULONG FORMULA_0000 0 0 0.0 4294967295.0000 ECU_ADDRESS 0x304418 /end MEASUREMENT
/begin MEASUREMENT tpu_b.CPR "Channel Priority Register 0,1." ULONG FORMULA_0000 0 0 0.0 4294967295.0000 ECU_ADDRESS 0x30441C /end MEASUREMENT
/begin MEASUREMENT tpu_b.CISR "Channel Interrupt Status Register." UWORD FORMULA_0010 0 0 0.0 65535.0000 ECU_ADDRESS 0x304420 /end MEASUREMENT
/begin MEASUREMENT tpu_b.TPUMCR2 "TPU Module Configuration Register 2." UWORD FORMULA_0010 0 0 0.0 65535.0000 ECU_ADDRESS 0x304428 /end MEASUREMENT
/begin MEASUREMENT tpu_b.TPUMCR3 "TPU Module Configuration Register 3." UWORD FORMULA_0010 0 0 0.0 65535.0000 ECU_ADDRESS 0x30442A /end MEASUREMENT
/* ------------------ Abschnitt erzeugt aus tpu_kw.dat ------------------ */
/begin CHARACTERISTIC K_TPU_KW_N_MIN "Unterdrehzahl. | EN: Under-speed" VALUE 0x781DA TKW_VV_VV_UW 100.0 FORMULA_0413 4.0000 10000.0000 /end CHARACTERISTIC
/begin CHARACTERISTIC K_TPU_KW_SYNC_ZAHN "KW Interruptzahn zur NW Sync. | EN: Crankshaft interrupt tooth for camshaft sync" VALUE 0x781DC TKW_VV_VV_UB 100.0 FORMULA_0003 0.0 59.0000 /end CHARACTERISTIC
/begin MEASUREMENT tpu_st_a "Status TPU Synchronisation" UBYTE FORMULA_0402 0 0 0.0 255.0 ECU_ADDRESS 0x3FD470 /end MEASUREMENT
/begin MEASUREMENT tpu_st_b "Status TPU Synchronisation" UBYTE FORMULA_0402 0 0 0.0 255.0 ECU_ADDRESS 0x3FD471 /end MEASUREMENT
/begin MEASUREMENT tpu_zyl "aktueller Zylinder" UBYTE FORMULA_0403 0 0 1.0000 12.0000 ECU_ADDRESS 0x3FD472 /end MEASUREMENT
/begin MEASUREMENT tpu_zyl_p2 "zwei Zylinder in der Zukunft" UBYTE FORMULA_0403 0 0 1.0000 12.0000 ECU_ADDRESS 0x3FD473 /end MEASUREMENT
/begin MEASUREMENT tpu_bank "aktuelle Bank" UBYTE FORMULA_0403 0 0 1.0000 2.0000 ECU_ADDRESS 0x3FD474 /end MEASUREMENT
/begin MEASUREMENT tpu_zyl_bank "aktueller Zylinder der Bank" UBYTE FORMULA_0403 0 0 1.0000 2.0000 ECU_ADDRESS 0x3FD475 /end MEASUREMENT
/begin MEASUREMENT tpu_index "Segmentindex fuer den Gesamtmotor" UBYTE FORMULA_0003 0 0 0.0 11.0000 ECU_ADDRESS 0x3FD476 /end MEASUREMENT
/begin MEASUREMENT tpu_kw_rot "Rotation." UBYTE FORMULA_0003 0 0 0.0 1.0000 ECU_ADDRESS 0x3FD477 /end MEASUREMENT
/begin MEASUREMENT tpu_idx_a "Segmentindex auf TPU" UBYTE FORMULA_0003 0 0 0.0 5.0000 ECU_ADDRESS 0x3FD478 /end MEASUREMENT
/begin MEASUREMENT tpu_idx_b "Segmentindex auf TPU" UBYTE FORMULA_0003 0 0 0.0 5.0000 ECU_ADDRESS 0x3FD479 /end MEASUREMENT
/begin MEASUREMENT tpu_kw_nw_sync_cnt_a "Umsynchronisationszaehler" UBYTE FORMULA_0003 0 0 0.0 255.0000 ECU_ADDRESS 0x3FD47A /end MEASUREMENT
/begin MEASUREMENT tpu_kw_nw_sync_cnt_b "Umsynchronisationszaehler" UBYTE FORMULA_0003 0 0 0.0 255.0000 ECU_ADDRESS 0x3FD47B /end MEASUREMENT
/begin MEASUREMENT tpu_kw_irq_a "Letzte KW Interruptart." UBYTE FORMULA_0404 0 0 0.0 255.0 ECU_ADDRESS 0x3FD47C /end MEASUREMENT
/begin MEASUREMENT tpu_kw_irq_b "Letzte KW Interruptart." UBYTE FORMULA_0404 0 0 0.0 255.0 ECU_ADDRESS 0x3FD47D /end MEASUREMENT
/begin MEASUREMENT tpu_kw_irq_tooth_a "Zahninterrupt." UBYTE FORMULA_0405 0 0 0.0 255.0 ECU_ADDRESS 0x3FD47C BIT_MASK 0x80 /end MEASUREMENT
/begin MEASUREMENT tpu_kw_irq_tooth_b "Zahninterrupt." UBYTE FORMULA_0405 0 0 0.0 255.0 ECU_ADDRESS 0x3FD47D BIT_MASK 0x80 /end MEASUREMENT
/begin MEASUREMENT tpu_kw_irq_segm_a "Segmentinterrupt." UBYTE FORMULA_0406 0 0 0.0 255.0 ECU_ADDRESS 0x3FD47C BIT_MASK 0x40 /end MEASUREMENT
/begin MEASUREMENT tpu_kw_irq_segm_b "Segmentinterrupt." UBYTE FORMULA_0406 0 0 0.0 255.0 ECU_ADDRESS 0x3FD47D BIT_MASK 0x40 /end MEASUREMENT
/begin MEASUREMENT tpu_kw_irq_mess_a "Messfensterinterrupt (LU)." UBYTE FORMULA_0407 0 0 0.0 255.0 ECU_ADDRESS 0x3FD47C BIT_MASK 0x20 /end MEASUREMENT
/begin MEASUREMENT tpu_kw_irq_mess_b "Messfensterinterrupt (LU)." UBYTE FORMULA_0407 0 0 0.0 255.0 ECU_ADDRESS 0x3FD47D BIT_MASK 0x20 /end MEASUREMENT
/begin MEASUREMENT tpu_kw_irq_n_min_a "Unterdrehzahlinterrupt." UBYTE FORMULA_0408 0 0 0.0 255.0 ECU_ADDRESS 0x3FD47C BIT_MASK 0x10 /end MEASUREMENT
/begin MEASUREMENT tpu_kw_irq_n_min_b "Unterdrehzahlinterrupt." UBYTE FORMULA_0408 0 0 0.0 255.0 ECU_ADDRESS 0x3FD47D BIT_MASK 0x10 /end MEASUREMENT
/begin MEASUREMENT tpu_kw_irq_error_a "Fehlerinterrupt." UBYTE FORMULA_0409 0 0 0.0 255.0 ECU_ADDRESS 0x3FD47C BIT_MASK 0x8 /end MEASUREMENT
/begin MEASUREMENT tpu_kw_irq_error_b "Fehlerinterrupt." UBYTE FORMULA_0409 0 0 0.0 255.0 ECU_ADDRESS 0x3FD47D BIT_MASK 0x8 /end MEASUREMENT
/begin MEASUREMENT tpu_kw_irq_pre_sync_a "Pre-Sync-Interrupt (Start Lueckensuche)." UBYTE FORMULA_0410 0 0 0.0 255.0 ECU_ADDRESS 0x3FD47C BIT_MASK 0x4 /end MEASUREMENT
/begin MEASUREMENT tpu_kw_irq_pre_sync_b "Pre-Sync-Interrupt (Start Lueckensuche)." UBYTE FORMULA_0410 0 0 0.0 255.0 ECU_ADDRESS 0x3FD47D BIT_MASK 0x4 /end MEASUREMENT
/begin MEASUREMENT tpu_kw_irq_sync_a "Sync-Interrupt (Luecke gefunden)." UBYTE FORMULA_0411 0 0 0.0 255.0 ECU_ADDRESS 0x3FD47C BIT_MASK 0x2 /end MEASUREMENT
/begin MEASUREMENT tpu_kw_irq_sync_b "Sync-Interrupt (Luecke gefunden)." UBYTE FORMULA_0411 0 0 0.0 255.0 ECU_ADDRESS 0x3FD47D BIT_MASK 0x2 /end MEASUREMENT
/begin MEASUREMENT tpu_kw_irq_info_a "Infointerrupt (+/- ein Zahn)." UBYTE FORMULA_0412 0 0 0.0 255.0 ECU_ADDRESS 0x3FD47C BIT_MASK 0x1 /end MEASUREMENT
/begin MEASUREMENT tpu_kw_irq_info_b "Infointerrupt (+/- ein Zahn)." UBYTE FORMULA_0412 0 0 0.0 255.0 ECU_ADDRESS 0x3FD47D BIT_MASK 0x1 /end MEASUREMENT
/begin MEASUREMENT tpu_kw_irq_zahn_a "Zahnnummer TPU bei Eintritt in ISR." UBYTE FORMULA_0003 0 0 0.0 255.0000 ECU_ADDRESS 0x3FD47E /end MEASUREMENT
/begin MEASUREMENT tpu_kw_irq_zahn_b "Zahnnummer TPU bei Eintritt in ISR." UBYTE FORMULA_0003 0 0 0.0 255.0000 ECU_ADDRESS 0x3FD47F /end MEASUREMENT
/begin MEASUREMENT tpu_kw_irq_cnt_a "TPU Interruptzaehler." UBYTE FORMULA_0003 0 0 0.0 255.0000 ECU_ADDRESS 0x3FD480 /end MEASUREMENT
/begin MEASUREMENT tpu_kw_irq_cnt_b "TPU Interruptzaehler." UBYTE FORMULA_0003 0 0 0.0 255.0000 ECU_ADDRESS 0x3FD481 /end MEASUREMENT
/begin MEASUREMENT tpu_kw_irq_segm_cnt_a "Anzahl Segmentinterrupts." UBYTE FORMULA_0003 0 0 0.0 255.0000 ECU_ADDRESS 0x3FD482 /end MEASUREMENT
/begin MEASUREMENT tpu_kw_irq_segm_cnt_b "Anzahl Segmentinterrupts." UBYTE FORMULA_0003 0 0 0.0 255.0000 ECU_ADDRESS 0x3FD483 /end MEASUREMENT
/begin MEASUREMENT tpu_kw_irq_tooth_cnt_a "Zahninterruptzaehler." UBYTE FORMULA_0003 0 0 0.0 255.0000 ECU_ADDRESS 0x3FD484 /end MEASUREMENT
/begin MEASUREMENT tpu_kw_irq_tooth_cnt_b "Zahninterruptzaehler." UBYTE FORMULA_0003 0 0 0.0 255.0000 ECU_ADDRESS 0x3FD485 /end MEASUREMENT
/* ------------------ Abschnitt erzeugt aus nw.dat ------------------ */
/begin CHARACTERISTIC K_NW_CONFIG "Konfigurationsparameter fuer NW-Synchronisation" VALUE 0x74D40 TKW_VV_VV_UB 100.0 FORMULA_1005 0.0 255.0 /end CHARACTERISTIC
/begin CHARACTERISTIC K_NW_IO "Anzahl NW-Impulse fuer erneute NW-Synchronisation | EN: Anzahl NW-Impulse fuer erneute NW-Synchronisation" VALUE 0x74D41 TKW_VV_VV_UB 100.0 FORMULA_0003 0.0 255.0000 /end CHARACTERISTIC
/begin CHARACTERISTIC K_NW_SYNC_ION_IO "Anzahl guter Verbrennungen fuer NW-Synchronisation ueber Ionenstrom | EN: Anzahl guter Verbrennungen fuer NW-Synchronisation ueber Ionenstrom" VALUE 0x74D42 TKW_VV_VV_UB 100.0 FORMULA_0003 0.0 255.0000 /end CHARACTERISTIC
/begin CHARACTERISTIC K_NW_MFMIN_1of2_ "Untergrenze NW-Messfenster | EN: Untergrenze NW-Messfenster" VALUE 0x74D43 TKW_VV_VV_UB 100.0 FORMULA_0003 0.0 255.0000 /end CHARACTERISTIC
/begin CHARACTERISTIC K_NW_MFMIN_2of2_ "Untergrenze NW-Messfenster | EN: Untergrenze NW-Messfenster" VALUE 0x74D44 TKW_VV_VV_UB 100.0 FORMULA_0003 0.0 255.0000 /end CHARACTERISTIC
/begin CHARACTERISTIC K_NW_MFMAX_1of2_ "Obergrenze NW-Messfenster | EN: Obergrenze NW-Messfenster" VALUE 0x74D45 TKW_VV_VV_UB 100.0 FORMULA_0003 0.0 255.0000 /end CHARACTERISTIC
/begin CHARACTERISTIC K_NW_MFMAX_2of2_ "Obergrenze NW-Messfenster | EN: Obergrenze NW-Messfenster" VALUE 0x74D46 TKW_VV_VV_UB 100.0 FORMULA_0003 0.0 255.0000 /end CHARACTERISTIC
/begin CHARACTERISTIC K_NW_NIO "Schwelle fehlende/falsche NW-Impulse fuer NW-Desynchronisation | EN: Schwelle fehlende/falsche NW-Impulse fuer NW-Desynchronisation" VALUE 0x74D47 TKW_VV_VV_UB 100.0 FORMULA_0003 0.0 255.0000 /end CHARACTERISTIC
/begin CHARACTERISTIC K_NW_NIO_INC "Inkremente fuer NW-Fehlerzaehler | EN: Inkremente fuer NW-Fehlerzaehler" VALUE 0x74D48 TKW_VV_VV_UB 100.0 FORMULA_0003 0.0 255.0000 /end CHARACTERISTIC
/begin CHARACTERISTIC K_NW_IO_ASP "nach x korrekten Arbeitsspielen kein Rueckschalten in 360�-Mode | EN: nach x korrekten Arbeitsspielen kein Rueckschalten in 360ï¿½-Mode" VALUE 0x74D4A TKW_VV_VV_UW 100.0 FORMULA_0010 2.0000 65535.0000 /end CHARACTERISTIC
/begin MEASUREMENT tpu_nw_pos_b1 "Position des NW-Impulses" UBYTE FORMULA_0003 0 0 0.0 255.0000 ECU_ADDRESS 0x3FCAE4 /end MEASUREMENT
/begin MEASUREMENT tpu_nw_pos_b2 "Position des NW-Impulses" UBYTE FORMULA_0003 0 0 0.0 255.0000 ECU_ADDRESS 0x3FCAE5 /end MEASUREMENT
/* ------------------ Abschnitt erzeugt aus tanzyl.dat ------------------ */
/begin CHARACTERISTIC K_TANZYL_CFG "Definition der Quelle und Ausgabe von tanzyl | EN: 0 In tan_mw, Out tanzyl 0x1 In tan_mw, Out tanzyl_delta 0x2 In tumg, Out tanzyl 0x3 In tumg, Out tan" VALUE 0x76DCA TKW_VV_VV_UB 100.0 FORMULA_1130 0.0 255.0 /end CHARACTERISTIC
/begin CHARACTERISTIC K_TANZYL_MR_TAU "Filterkonstante fuer Motorraumtemperatur | EN: Filterkonstante fuer Motor-raumtemperatur" VALUE 0x76DCC TKW_VV_VV_UW 100.0 FORMULA_1059 0.1000 6553.5000 FORMAT "%5.2" /end CHARACTERISTIC
/begin CHARACTERISTIC KL_TANZYL_ML_GES_TAU "Luftmassenstrom zu tau | EN: Air mass flow to time constant" CURVE 0x76DCE TKL_SW_VV_UW 100.0 FORMULA_1059 0.1000 6553.5000
 /begin AXIS_DESCR STD_AXIS ml_ges FORMULA_0112 6 -100.0000 1400.0000 FORMAT "%4.1" /end AXIS_DESCR
 FORMAT "%5.2" /end CHARACTERISTIC
/begin CHARACTERISTIC KL_TANZYL_ML_GES_RATIO "Faktor Luftmassenstrom fuer TANZYL-Modell" CURVE 0x76DE8 TKL_SW_VV_UW 100.0 FORMULA_0295 0.0 2.0000
 /begin AXIS_DESCR STD_AXIS ml_ges FORMULA_0112 6 -100.0000 1400.0000 FORMAT "%4.1" /end AXIS_DESCR
 FORMAT "%7.4" /end CHARACTERISTIC
/begin CHARACTERISTIC KL_TANZYL_ABREG "Abregung ueber Zeit | EN: Ramp-down over time" CURVE 0x76E02 TKL_UW_VV_UW 100.0 FORMULA_0295 0.0 2.0000
 /begin AXIS_DESCR STD_AXIS time_ms FORMULA_0600 6 0.0 1092.2500 FORMAT "%5.2" /end AXIS_DESCR
 FORMAT "%7.4" /end CHARACTERISTIC
/begin CHARACTERISTIC KL_TANZYL_MR_ABREG "Abregung ueber Temperatur Motorraum" CURVE 0x76E1C TKL_UW_VV_UW 100.0 FORMULA_0295 0.0 2.0000
 /begin AXIS_DESCR STD_AXIS time_ms FORMULA_0600 6 0.0 1092.2500 FORMAT "%5.2" /end AXIS_DESCR
 FORMAT "%7.4" /end CHARACTERISTIC
/begin CHARACTERISTIC KL_TANZYL_MR_TUMG_KAL "Wichtung von Differenz tm - tumg" CURVE 0x76E36 TKL_SW_VV_UW 100.0 FORMULA_0295 0.0 2.0000
 /begin AXIS_DESCR STD_AXIS tumg FORMULA_0023 6 -50.0000 170.0000 FORMAT "%4.1" /end AXIS_DESCR
 FORMAT "%7.4" /end CHARACTERISTIC
/begin MEASUREMENT tanzyl_mr "Temperatur Motorraum TANZYL-Modell" SWORD FORMULA_0023 0 0 -50.0000 170.0000 ECU_ADDRESS 0x3FD0DC /end MEASUREMENT
/begin MEASUREMENT tanzyl_mr_tumg_delta "Temperaturdifferenz Motorraum zu Umgebung" SWORD FORMULA_0023 0 0 -50.0000 170.0000 ECU_ADDRESS 0x3FD0DE /end MEASUREMENT
/begin MEASUREMENT tanzyl_raw "Ansaugtemperatur im Zylinder Modell ungefiltert" SWORD FORMULA_0023 0 0 -50.0000 170.0000 ECU_ADDRESS 0x3FD0E0 /end MEASUREMENT
/begin MEASUREMENT tanzyl_loc "Lokale Ansaugtemperatur im Zylinder Modell gefiltert" SWORD FORMULA_0023 0 0 -50.0000 170.0000 ECU_ADDRESS 0x3FD0E2 /end MEASUREMENT
/begin MEASUREMENT tanzyl "Ansaugtemperatur im Zylinder vom Modell" SWORD FORMULA_0023 0 0 -50.0000 170.0000 ECU_ADDRESS 0x3FD0E4 /end MEASUREMENT
/begin MEASUREMENT tanzyl_ml_ges_tau "Temperatur tau TANZYL-Modell" UWORD FORMULA_1059 0 0 0.1000 6553.5000 ECU_ADDRESS 0x3FD0E6 /end MEASUREMENT
/begin MEASUREMENT tanzyl_ml_ges_ratio "Faktor Luftmassenstrom fuer TANZYL-Modell" UWORD FORMULA_0295 0 0 0.0 2.0000 ECU_ADDRESS 0x3FD0E8 /end MEASUREMENT
/begin MEASUREMENT tanzyl_mr_tumg_kal "Wichtung von Differenz tm - tumg" UWORD FORMULA_0295 0 0 0.0 2.0000 ECU_ADDRESS 0x3FD0EA /end MEASUREMENT
/begin MEASUREMENT tanzyl_mr_abreg "Abregung ueber Temperatur Motorraum" UWORD FORMULA_0295 0 0 0.0 2.0000 ECU_ADDRESS 0x3FD0EC /end MEASUREMENT
/begin MEASUREMENT tanzyl_abreg "Abregung ueber Zeit" UWORD FORMULA_0295 0 0 0.0 2.0000 ECU_ADDRESS 0x3FD0EE /end MEASUREMENT
/begin MEASUREMENT tanzyl_st "Status Modell Ansaugtemperatur im Zylinder" UBYTE FORMULA_1129 0 0 0.0 2.0 ECU_ADDRESS 0x3FD0F0 /end MEASUREMENT
/begin MEASUREMENT tanzyl_mr_stat "Motorraumtemperatur Zielwert" SWORD FORMULA_0023 0 0 -50.0000 170.0000 ECU_ADDRESS 0x3FD0F2 /end MEASUREMENT
/begin MEASUREMENT tanzyl_mr_off "Offset Motorraumtemperatur bei Start" SWORD FORMULA_0076 0 0 -1000.0000 1000.0000 ECU_ADDRESS 0x3FD0F4 /end MEASUREMENT
/* ------------------ Abschnitt erzeugt aus te.dat ------------------ */
/begin CHARACTERISTIC K_TE_A_MIN "min. Querschnittsflaeche TEV | EN: min. Querschnittsflaeche TEV" VALUE 0x76E52 TKW_VV_VV_UW 100.0 FORMULA_1147 0.0 65.5350 FORMAT "%6.3" /end CHARACTERISTIC
/begin CHARACTERISTIC K_TE_C_AKF_HYS "Hys.-C-AKF-Schwelle f. Dauer-SPUELEN" VALUE 0x76E54 TKW_VV_VV_UW 100.0 FORMULA_0556 0.0 2.0000 FORMAT "%7.4" /end CHARACTERISTIC
/begin CHARACTERISTIC K_TE_C_AKF_MAX "Abbruch Spuelen, wenn c_akf groesser" VALUE 0x76E56 TKW_VV_VV_UW 100.0 FORMULA_0556 0.0 6.0000 FORMAT "%7.4" /end CHARACTERISTIC
/begin CHARACTERISTIC K_TE_C_AKF_MAX_HYS "Abbruch-C-AKF-Schwelle f. Dauer-SPUELEN" VALUE 0x76E58 TKW_VV_VV_UW 100.0 FORMULA_0556 0.0 2.0000 FORMAT "%7.4" /end CHARACTERISTIC
/begin CHARACTERISTIC K_TE_C_AKF_MIN "Abbruch Spuelen, wenn c_akf kleiner" VALUE 0x76E5A TKW_VV_VV_UW 100.0 FORMULA_0556 0.0 2.0000 FORMAT "%7.4" /end CHARACTERISTIC
/begin CHARACTERISTIC K_TE_C_AKF_DYN_DELTA_RF "Dynamikschwelle RF f�r c_akf-Filter stoppen" VALUE 0x76E5C TKW_VV_VV_SW 100.0 FORMULA_0007 0.0 2.0000 FORMAT "%6.3" /end CHARACTERISTIC
/begin CHARACTERISTIC K_TE_C_AKF_RESET "RESET C-AKF-Zustandsautomat | EN: 0 inaktiv 1 aktiv RESET C -AKF- Zustandsautomat" VALUE 0x76E5E TKW_VV_VV_UB 100.0 FORMULA_0839 0.0 1.0 /end CHARACTERISTIC
/begin CHARACTERISTIC K_TE_C_APPL "RESET C-AKF-Konzentration | EN: RESET C -AKF-Konzentration" VALUE 0x76E60 TKW_VV_VV_UW 100.0 FORMULA_0556 0.0 6.0000 FORMAT "%7.4" /end CHARACTERISTIC
/begin CHARACTERISTIC K_TE_C_LERN_RED_TAU "Filterkonstante c_akf reduziertes Lernen | EN: Filterkonstante c_akf r e-duziertes Lernen" VALUE 0x76E62 TKW_VV_VV_UW 100.0 FORMULA_1059 0.1000 6553.5000 FORMAT "%5.2" /end CHARACTERISTIC
/begin CHARACTERISTIC K_TE_C_LERN_TAU "Filterkonstante c_akf normal | EN: Filterkonstante c_akf no r-mal" VALUE 0x76E64 TKW_VV_VV_UW 100.0 FORMULA_1059 0.1000 6553.5000 FORMAT "%5.2" /end CHARACTERISTIC
/begin CHARACTERISTIC K_TE_C_MAX "max. AKF-Konzentration | EN: max. fuer te_c_akf_vor_filt" VALUE 0x76E66 TKW_VV_VV_UW 100.0 FORMULA_0556 0.0 6.0000 FORMAT "%7.4" /end CHARACTERISTIC
/begin CHARACTERISTIC K_TE_C_MIN "min. AKF-Konzentration | EN: min. fuer te_c_akf_roh" VALUE 0x76E68 TKW_VV_VV_UW 100.0 FORMULA_0556 0.0 2.0000 FORMAT "%7.4" /end CHARACTERISTIC
/begin CHARACTERISTIC K_TE_C_T_SPUEL_MIN "min. SPUEL-Zeit f. K_TE_C_LERN_TAU | EN: min. SPUEL -Zeit f. K_TE_C_LERN_TAU" VALUE 0x76E6A TKW_VV_VV_UW 100.0 FORMULA_0021 0.0 655.0000 FORMAT "%5.2" /end CHARACTERISTIC
/begin CHARACTERISTIC K_TE_C_T_SPUEL_MAX "max. SPUEL-Zeit f. K_TE_C_LERN_TAU | EN: max. SPUEL -Zeit f. K_TE_C_LERN_TAU" VALUE 0x76E6C TKW_VV_VV_UW 100.0 FORMULA_0021 0.0 655.0000 FORMAT "%5.2" /end CHARACTERISTIC
/begin CHARACTERISTIC K_TE_C_ML_SOLL_MG_MIN "min. te_ml_soll_mg fuer C_AKF-Uebernahme | EN: min. te_ml_soll_mg fuer C_AKF-Uebernahme" VALUE 0x76E6E TKW_VV_VV_UW 100.0 FORMULA_0752 0.0 1023.9843 FORMAT "%5.2" /end CHARACTERISTIC
/begin CHARACTERISTIC K_TE_C_STAT_DELTA "max. C-Abweichung f. eingependelte Adapt. | EN: max. C -Abweichung f. eingependelte Adapt." VALUE 0x76E70 TKW_VV_VV_UW 100.0 FORMULA_0556 0.0 2.0000 FORMAT "%7.4" /end CHARACTERISTIC
/begin CHARACTERISTIC K_TE_C_STAT_T "min. Zeit f. eingependelte Adapt. | EN: min. Zeit f. eingependelte Adapt." VALUE 0x76E72 TKW_VV_VV_UW 100.0 FORMULA_0021 0.0 655.0000 FORMAT "%5.2" /end CHARACTERISTIC
/begin CHARACTERISTIC K_TE_C_X_MIN "min. Spuelluftanteil - zu Uebergang LERNEN | EN: min. Spuelluftanteil -  zu Uebergang LERNEN" VALUE 0x76E74 TKW_VV_VV_UW 100.0 FORMULA_0024 0.0 1.9999 FORMAT "%7.4" /end CHARACTERISTIC
/begin CHARACTERISTIC K_TE_CFG "Freigabe TE" VALUE 0x76E76 TKW_VV_VV_UB 100.0 FORMULA_1148 0.0 2.0 /end CHARACTERISTIC
/begin CHARACTERISTIC K_TE_DR_REL_MAX_SYNC "n-Schwelle f. sychn. Ansteuerfrequenz" VALUE 0x76E78 TKW_VV_VV_SW 100.0 FORMULA_0115 0.0 199.9938 FORMAT "%5.2" /end CHARACTERISTIC
/begin CHARACTERISTIC K_TE_DYN_DELTA_RF "RF-Delta f. Sperre c_akf-Filterung | EN: RF-Delta f. Sperre c_akf -Filterung" VALUE 0x76E7A TKW_VV_VV_SW 100.0 FORMULA_0007 0.0 2.0000 FORMAT "%6.3" /end CHARACTERISTIC
/begin CHARACTERISTIC K_TE_DYN_RF_T "Sperrzeit c_akf-Filterung nach rf-Dynamik | EN: Sperrzeit c_akf -Filterung nach rf-Dynamik" VALUE 0x76E7C TKW_VV_VV_UW 100.0 FORMULA_0021 0.0 655.0000 FORMAT "%5.2" /end CHARACTERISTIC
/begin CHARACTERISTIC K_TE_GW_F_KATD "Verlaeng. Schliessrampe bei Katdiag | EN: Verlaeng. Schliessrampe bei Katdiag" VALUE 0x76E7E TKW_VV_VV_UB 100.0 FORMULA_0655 0.0 7.9687 /end CHARACTERISTIC
/begin CHARACTERISTIC K_TE_GW_LAA_FETT "LAA_F_TE-Fett-Schwelle f. GW" VALUE 0x76E80 TKW_VV_VV_SW 100.0 FORMULA_0024 -1.0000 0.9999 FORMAT "%7.4" /end CHARACTERISTIC
/begin CHARACTERISTIC K_TE_GW_LAM_DELTA_FETT "LAM_Delta_F-Fett-Schwelle f. GW" VALUE 0x76E82 TKW_VV_VV_SW 100.0 FORMULA_0025 -2.0000 1.9999 FORMAT "%6.3" /end CHARACTERISTIC
/begin CHARACTERISTIC K_TE_GW_LAM_DELTA_MAGER "LAM_Delta-Mager-Schwelle f. GW | EN: LAM_Delta-Mager-Schwelle f. GW" VALUE 0x76E84 TKW_VV_VV_SW 100.0 FORMULA_0025 -2.0000 1.9999 FORMAT "%6.3" /end CHARACTERISTIC
/begin CHARACTERISTIC K_TE_GW_LAM_DELTA_HYS "LAM_Delta_F-Hysterese f. GW | EN: LAM_Delta_F-Hysterese f. GW" VALUE 0x76E86 TKW_VV_VV_UW 100.0 FORMULA_0025 0.0 3.9990 FORMAT "%6.3" /end CHARACTERISTIC
/begin CHARACTERISTIC K_TE_GW_LAM_REG_FETT "LAM-REG-Fett-Schwelle f. GW | EN: LAM-REG-Fett-Schwelle f. GW" VALUE 0x76E88 TKW_VV_VV_UW 100.0 FORMULA_0024 0.0 1.9990 FORMAT "%7.4" /end CHARACTERISTIC
/begin CHARACTERISTIC K_TE_GW_LAM_REG_MAGER "LAM-REG-Mager-Schwelle f. GW | EN: LAM-REG-Mager-Schwelle f. GW" VALUE 0x76E8A TKW_VV_VV_UW 100.0 FORMULA_0024 0.0 1.9990 FORMAT "%7.4" /end CHARACTERISTIC
/begin CHARACTERISTIC K_TE_GW_LAM_REG_HYS "LAM-REG-Hysterese f. GW | EN: LAM-REG-Hysterese f. GW" VALUE 0x76E8C TKW_VV_VV_UW 100.0 FORMULA_0024 0.0 1.9990 FORMAT "%7.4" /end CHARACTERISTIC
/begin CHARACTERISTIC K_TE_LAA_F_TE_MCS "MCS-Faktor fuer laa_f_te | EN: 0 inaktiv 1 aktiv MCS-Faktor fuer laa_f_te" VALUE 0x76E8E TKW_VV_VV_UB 100.0 FORMULA_0839 0.0 1.0 /end CHARACTERISTIC
/begin CHARACTERISTIC K_TE_LAM_SOLL_MAX "max. LA-SOLL-Schwelle f. TE-Freigabe | EN: max. LA-SOLL-Schwelle f. TE-Freigabe" VALUE 0x76E90 TKW_VV_VV_UW 100.0 FORMULA_0025 0.0 3.9990 FORMAT "%6.3" /end CHARACTERISTIC
/begin CHARACTERISTIC K_TE_LAM_SOLL_MIN "min. LA-SOLL-Schwelle f. TE-Freigabe | EN: min. LA- SOLL-Schwelle f. TE-Freigabe" VALUE 0x76E92 TKW_VV_VV_UW 100.0 FORMULA_0025 0.0 3.9990 FORMAT "%6.3" /end CHARACTERISTIC
/begin CHARACTERISTIC K_TE_M_MAX_ML_CFG "TE_M_MAX_ML - Auswahl" VALUE 0x76E94 TKW_VV_VV_UB 100.0 FORMULA_1149 0.0 1.0 /end CHARACTERISTIC
/begin CHARACTERISTIC K_TE_MKS_F_MAX "max Wert fuer te_mks_f | EN: max Wert fuer te_mks_f" VALUE 0x76E96 TKW_VV_VV_UW 100.0 FORMULA_1142 0.0 1008.2307 FORMAT "%5.2" /end CHARACTERISTIC
/begin CHARACTERISTIC K_TE_MKS_F_AEBG_SCHW_NEG "Schwelle fuer neg. Rampe | EN: Schwelle te_lam_ges fuer neg. Rampe" VALUE 0x76E98 TKW_VV_VV_SW 100.0 FORMULA_0024 0.0 0.9999 FORMAT "%7.4" /end CHARACTERISTIC
/begin CHARACTERISTIC K_TE_MKS_F_AEBG_SCHW_POS "Schwelle fuer pos. Rampe | EN: Schwelle te_lam_ges fuer pos. Rampe" VALUE 0x76E9A TKW_VV_VV_SW 100.0 FORMULA_0024 -1.0000 0.0 FORMAT "%7.4" /end CHARACTERISTIC
/begin CHARACTERISTIC K_TE_MKS_F_NEG "neg. Grad. f. Aenderungsbegr. Faktor auf TE | EN: max. Lambda -Aenderung je Sekunde" VALUE 0x76E9C TKW_VV_VV_UW 100.0 FORMULA_1142 0.0 1008.2307 FORMAT "%5.2" /end CHARACTERISTIC
/begin CHARACTERISTIC K_TE_MKS_F_POS "pos. Grad. f. Aenderungsbegr. Faktor auf TE | EN: max. Lambda- Aenderung je Sekunde" VALUE 0x76E9E TKW_VV_VV_UW 100.0 FORMULA_1142 0.0 1008.2307 FORMAT "%5.2" /end CHARACTERISTIC
/begin CHARACTERISTIC K_TE_MKS_LAM_WICHT "Wichtungsfaktor auf lam_delta fuer te_mks_f-Berechnung" VALUE 0x76EA0 TKW_VV_VV_UB 100.0 FORMULA_0643 0.0 1.9921 /end CHARACTERISTIC
/begin CHARACTERISTIC K_TE_MZYL_SEC_F "Wicht-Fakor auf te_ml_soll fuer sec. Einfluss te_ml_ist | EN: Wicht-Fakor auf te_ml_soll fuer sec. Einfluss te_ml_ist" VALUE 0x76EA1 TKW_VV_VV_UB 100.0 FORMULA_0643 0.0 1.9921 /end CHARACTERISTIC
/begin CHARACTERISTIC K_TE_N_DYN_DELTA "N-Delta f. Erkennung N-stat." VALUE 0x76EA2 TKW_VV_VV_SW 100.0 FORMULA_0006 0.0 10000.0000 /end CHARACTERISTIC
/begin CHARACTERISTIC K_TE_N_MAX_SYNC1 "n-Schwelle f. sychn. Ansteuerfrequenz" VALUE 0x76EA4 TKW_VV_VV_SW 100.0 FORMULA_0006 0.0 10000.0000 /end CHARACTERISTIC
/begin CHARACTERISTIC K_TE_R_C3H8 "Gaskonstante C3H8 | EN: Gaskonstante C3H8" VALUE 0x76EA6 TKW_VV_VV_UW 100.0 FORMULA_1143 0.0 65535.0000 FORMAT "%6.3" /end CHARACTERISTIC
/begin CHARACTERISTIC K_TE_R_LUFT "Gaskonstante LUFT | EN: Gaskonstante LUFT" VALUE 0x76EA8 TKW_VV_VV_UW 100.0 FORMULA_1143 0.0 65535.0000 FORMAT "%6.3" /end CHARACTERISTIC
/begin CHARACTERISTIC K_TE_RESET_CFG "RESET TE-Zustandsautomat" VALUE 0x76EAA TKW_VV_VV_UB 100.0 FORMULA_0839 0.0 1.0 /end CHARACTERISTIC
/begin CHARACTERISTIC K_TE_RF_DYN_DELTA "RF-Delta f. Erkennung RF-stat." VALUE 0x76EAC TKW_VV_VV_SW 100.0 FORMULA_0007 0.0 2.0000 FORMAT "%6.3" /end CHARACTERISTIC
/begin CHARACTERISTIC K_TE_STOECH "stoechometrischer Faktor | EN: stoechometrischer Faktor" VALUE 0x76EAE TKW_VV_VV_UW 100.0 FORMULA_0805 0.0 511.9921 FORMAT "%5.2" /end CHARACTERISTIC
/begin CHARACTERISTIC K_TE_T_LAA "TE-LAA Zeit | EN: TE_LAA und SPUELEN_WARTE_LAA Zeit" VALUE 0x76EB0 TKW_VV_VV_UW 100.0 FORMULA_0021 0.0 655.0000 FORMAT "%5.2" /end CHARACTERISTIC
/begin CHARACTERISTIC K_TE_T_LAA_HS_INI "ununterbrech. TE-LAA aus HS" VALUE 0x76EB2 TKW_VV_VV_UW 100.0 FORMULA_0021 0.0 655.0000 FORMAT "%5.2" /end CHARACTERISTIC
/begin CHARACTERISTIC K_TE_T_LAA_INI "ununterbrech. TE-LAA | EN: TE_LAA_INI-Zeit Norma l-start" VALUE 0x76EB4 TKW_VV_VV_UW 100.0 FORMULA_0021 0.0 655.0000 FORMAT "%5.2" /end CHARACTERISTIC
/begin CHARACTERISTIC K_TE_T_LANG "min te_t_spuel fuer Ueberg. in TE_LAA | EN: min te_t_spuel fuer Ueberg. in TE_LAA" VALUE 0x76EB6 TKW_VV_VV_UW 100.0 FORMULA_0021 0.0 655.0000 FORMAT "%5.2" /end CHARACTERISTIC
/begin CHARACTERISTIC K_TE_T_MIN "min. te_t_spuel bei B_TE_ABBR fuer Uebergang in TE_LAA | EN: min. te_t_spuel bei B_TE_ABBR fuer Uebe r- gang in TE_LAA" VALUE 0x76EB8 TKW_VV_VV_UW 100.0 FORMULA_0021 0.0 655.0000 FORMAT "%5.2" /end CHARACTERISTIC
/begin CHARACTERISTIC K_TE_T_ML_LANG "time_ml fuer Uebergang TE-SPUELEN LANG" VALUE 0x76EBA TKW_VV_VV_UW 100.0 FORMULA_0021 0.0 655.0000 FORMAT "%5.2" /end CHARACTERISTIC
/begin CHARACTERISTIC K_TE_T_NORM "max. te_t_spuel bei TE-SPUELEN KURZ | EN: max. te_t_spuel bei SPUELEN_KURZ" VALUE 0x76EBC TKW_VV_VV_UW 100.0 FORMULA_0021 0.0 655.0000 FORMAT "%5.2" /end CHARACTERISTIC
/begin CHARACTERISTIC K_TE_T_SPUEL_INI "ununterbrech. TE-SPUELEN | EN: ununterbrech. TE -SPUELEN" VALUE 0x76EBE TKW_VV_VV_UW 100.0 FORMULA_0021 0.0 655.0000 FORMAT "%5.2" /end CHARACTERISTIC
/begin CHARACTERISTIC K_TE_TAN_MIN_LL "TAN-Schwelle im LL fuer ABBRUCH TE" VALUE 0x76EC0 TKW_VV_VV_SW 100.0 FORMULA_0023 -50.0000 170.0000 FORMAT "%4.1" /end CHARACTERISTIC
/begin CHARACTERISTIC K_TE_TI_MIN_DIFF "Min Abstand ti_tpu zu ti_bj.min | EN: Min Abstand ti_tpu zu ti_bj.min" VALUE 0x76EC2 TKW_VV_VV_UW 100.0 FORMULA_0786 0.0 65.5350 FORMAT "%5.2" /end CHARACTERISTIC
/begin CHARACTERISTIC K_TE_TMOT "TMOT-Schwelle f. Freigabe | EN: TMOT-Schwelle f. Freig a-be" VALUE 0x76EC4 TKW_VV_VV_SW 100.0 FORMULA_0023 -50.0000 170.0000 FORMAT "%4.1" /end CHARACTERISTIC
/begin CHARACTERISTIC K_TE_TMOT_START_HS "min. tmot_start Heisstarterkennung | EN: min. tmot_start Heisstarterkennung" VALUE 0x76EC6 TKW_VV_VV_SW 100.0 FORMULA_0023 -50.0000 170.0000 FORMAT "%4.1" /end CHARACTERISTIC
/begin CHARACTERISTIC K_TE_TMOT_START_LANG "min. tmot_start f. TE-SPUELEN-LANG" VALUE 0x76EC8 TKW_VV_VV_SW 100.0 FORMULA_0023 -50.0000 170.0000 FORMAT "%4.1" /end CHARACTERISTIC
/begin CHARACTERISTIC K_TE_TV_MIN "min. Tastverhaeltnis TEV | EN: Freigabe TE" VALUE 0x76ECA TKW_VV_VV_UW 100.0 FORMULA_0001 0.0 100.0000 FORMAT "%4.1" /end CHARACTERISTIC
/begin CHARACTERISTIC K_TE_TV_MAX "max. Tastverhaeltnis TEV | EN: max. Tastverhaeltnis TEV" VALUE 0x76ECC TKW_VV_VV_UW 100.0 FORMULA_0001 0.0 100.0000 FORMAT "%4.1" /end CHARACTERISTIC
/begin CHARACTERISTIC K_TE_VAN_DYN_DELTA "VAN_VO-Delta f. Erkennung VAN-VO-stat." VALUE 0x76ECE TKW_VV_VV_SW 100.0 FORMULA_0111 -80.0000 80.0000 FORMAT "%4.1" /end CHARACTERISTIC
/begin CHARACTERISTIC K_TE_X_MKS_APPL "applikativer Soll-MKS-Anteil" VALUE 0x76ED0 TKW_VV_VV_UW 100.0 FORMULA_0024 0.0 1.9999 FORMAT "%7.4" /end CHARACTERISTIC
/begin CHARACTERISTIC K_TE_X_MKS_CFG "te_x_mks - Auswahl | EN: te_x_mks - Auswahl" VALUE 0x76ED2 TKW_VV_VV_UB 100.0 FORMULA_1150 0.0 1.0 /end CHARACTERISTIC
/begin CHARACTERISTIC K_TE_X_ML_SOLL_APPL "applikatives te_x_ml_soll" VALUE 0x76ED4 TKW_VV_VV_UW 100.0 FORMULA_0024 0.0 1.9999 FORMAT "%7.4" /end CHARACTERISTIC
/begin CHARACTERISTIC K_TE_X_ML_SOLL_CFG "te_x_ml_soll - Auswahl | EN: 0 Rampe B1,B2 1 Appl B1, Rampe B2 2 Rampe B1, Appl B2 3 Appl B1,B2 te_x_ml_soll - Auswahl" VALUE 0x76ED6 TKW_VV_VV_UW 100.0 FORMULA_1151 0.0 1.0 FORMAT "%5.2" /end CHARACTERISTIC
/begin CHARACTERISTIC K_TE_X_ML_SOLL_MAX "max. Spuelluftanteil f. System | EN: max. Spuelluftanteil f. System" VALUE 0x76ED8 TKW_VV_VV_UW 100.0 FORMULA_0024 0.0 1.9999 FORMAT "%7.4" /end CHARACTERISTIC
/begin CHARACTERISTIC K_TE_X_ML_SOLL_MIN "min. gewuenschter Durchsatz | EN: min. gewuenschter Durchsatz" VALUE 0x76EDA TKW_VV_VV_UW 100.0 FORMULA_0024 0.0 1.9999 FORMAT "%7.4" /end CHARACTERISTIC
/begin CHARACTERISTIC K_TE_X_ML_SOLL_GW_MIN "min. Durchsatz bei Grenzwertregelung" VALUE 0x76EDC TKW_VV_VV_UW 100.0 FORMULA_0024 0.0 1.9999 FORMAT "%7.4" /end CHARACTERISTIC
/begin CHARACTERISTIC K_TE_ZU_GW "TEV Zufahrtzeit - Grenzwert" VALUE 0x76EDE TKW_VV_VV_UW 100.0 FORMULA_0073 0.0 6553.5000 FORMAT "%4.1" /end CHARACTERISTIC
/begin CHARACTERISTIC K_TE_ZU_LERN "TEV Zufahrtzeit - LERNEN | EN: TEV Zufahrtzeit - LERNEN" VALUE 0x76EE0 TKW_VV_VV_UW 100.0 FORMULA_0073 0.0 6553.5000 FORMAT "%4.1" /end CHARACTERISTIC
/begin CHARACTERISTIC K_TE_ZU_NORM "TEV Zufahrtzeit - Normalbetrieb | EN: TEV Zufahrtzeit - Normal-betrieb" VALUE 0x76EE2 TKW_VV_VV_UW 100.0 FORMULA_0073 0.0 6553.5000 FORMAT "%4.1" /end CHARACTERISTIC
/begin CHARACTERISTIC K_TE_ZU_SA "TEV Zufahrtzeit - B_ZUST_SA | EN: TEV Zufahrtzeit -  B_ZUST_SA" VALUE 0x76EE4 TKW_VV_VV_UW 100.0 FORMULA_0073 0.0 6553.5000 FORMAT "%4.1" /end CHARACTERISTIC
/begin CHARACTERISTIC KL_TE_FREQ "Ansteuerfrequenz TE" CURVE 0x76EE6 TKL_SW_VV_UW 100.0 FORMULA_1082 10.0000 50.0000 /begin AXIS_DESCR STD_AXIS n FORMULA_0006 10 0.0 10000.0000 /end AXIS_DESCR FORMAT "%4.1" /end CHARACTERISTIC
/begin CHARACTERISTIC KL_TE_GW_F "Verlaengerung d. Rampenzeit | EN: Extension of ramp time" CURVE 0x76F10 TKL_UW_VV_UW 100.0 FORMULA_0075 0.0 4.0000 /begin AXIS_DESCR STD_AXIS ml FORMULA_0112 5 0.0 3276.8000 FORMAT "%4.1" /end AXIS_DESCR FORMAT "%6.3" /end CHARACTERISTIC
/begin CHARACTERISTIC KL_TE_GW_TI_MIN "Grenzwert ti_min-Regelung | EN: Limit for ti_min control" CURVE 0x76F26 TKL_UW_VV_UW 100.0 FORMULA_0073 0.0 6553.5000
 /begin AXIS_DESCR STD_AXIS te_ti_min_diff FORMULA_0786 5 0.0 65.5350 FORMAT "%5.2" /end AXIS_DESCR
 FORMAT "%4.1" /end CHARACTERISTIC
/begin CHARACTERISTIC KL_TE_MKS_XSI "Ausflusskoeffizient - MKS | EN: Discharge coefficient - injection with clutch closed" CURVE 0x76F3C TKL_SW_VV_UW 100.0 FORMULA_1034 0.0 65.5350
 /begin AXIS_DESCR STD_AXIS psau_rel FORMULA_0115 14 0.0 120.0000 FORMAT "%5.2" /end AXIS_DESCR
 FORMAT "%6.3" /end CHARACTERISTIC
/begin CHARACTERISTIC KL_TE_ML_XSI "Ausflusskoeffizient - ML | EN: Discharge coefficient - air mass" CURVE 0x76F76 TKL_SW_VV_UW 100.0 FORMULA_1034 0.0 65.5350
 /begin AXIS_DESCR STD_AXIS psau_rel FORMULA_0115 14 0.0 120.0000 FORMAT "%5.2" /end AXIS_DESCR
 FORMAT "%6.3" /end CHARACTERISTIC
/begin CHARACTERISTIC KL_TE_SYNC_FREQ "segm.synch. Ansteuerfrequenz | EN: Segment-synchronous drive frequency" CURVE 0x76FB0 TKL_SW_VV_UW 100.0 FORMULA_1082 10.0000 50.0000 /begin AXIS_DESCR STD_AXIS n FORMULA_0006 2 0.0 10000.0000 /end AXIS_DESCR FORMAT "%4.1" /end CHARACTERISTIC
/begin CHARACTERISTIC KL_TE_T_BEGIN_MIN "Verzoegerungszeit - TE-Freigabe | EN: Delay time - purge enable" CURVE 0x76FBA TKL_SW_VV_UW 100.0 FORMULA_0021 0.0 655.0000
 /begin AXIS_DESCR STD_AXIS tmot_start FORMULA_0023 6 -50.0000 170.0000 FORMAT "%4.1" /end AXIS_DESCR
 FORMAT "%5.2" /end CHARACTERISTIC
/begin CHARACTERISTIC KL_TE_TI_MIN "TE - TI-Min | EN: Purge - minimum injection time" CURVE 0x76FD4 TKL_SW_VV_UW 100.0 FORMULA_0752 0.0 1023.9843 /begin AXIS_DESCR STD_AXIS pks_ist FORMULA_0118 5 0.0 10.0000 FORMAT "%6.3" /end AXIS_DESCR FORMAT "%5.2" /end CHARACTERISTIC
/begin CHARACTERISTIC KL_TE_YPS_SQRT "Darstellung Wurzel-Stroemungsgeschwindigkeit | EN: Square-root representation of flow velocity" CURVE 0x76FEA TKL_UW_VV_UW 100.0 FORMULA_1152 0.0 196605.0000
 /begin AXIS_DESCR STD_AXIS te_ml_mks_yps_quad FORMULA_1140 10 0.0 589815.0000 /end AXIS_DESCR
/end CHARACTERISTIC
/begin CHARACTERISTIC KF_TE_ANZUGSZEIT "Anzugszeit TEV | EN: Pull-in time, purge valve" MAP 0x77014 TKF_UW_UW_UW 100.0 FORMULA_0998 0.0 655.3500
 /begin AXIS_DESCR STD_AXIS te_freq FORMULA_1082 5 10.0000 50.0000 FORMAT "%4.1" /end AXIS_DESCR
 /begin AXIS_DESCR STD_AXIS ub FORMULA_0008 5 0.0 28.0000 FORMAT "%4.1" /end AXIS_DESCR
 FORMAT "%5.2" /end CHARACTERISTIC
/begin CHARACTERISTIC KF_TE_GW_RAMPEN "betriebspunktabh. Rampenzeit | EN: Operating-point-dependent ramp time" MAP 0x7705C TKF_SW_SW_UW 100.0 FORMULA_0073 0.0 6553.5000
 /begin AXIS_DESCR STD_AXIS te_lam_delta FORMULA_0025 9 -2.0000 1.9999 FORMAT "%6.3" /end AXIS_DESCR
 /begin AXIS_DESCR STD_AXIS te_c_akf FORMULA_0556 5 0.0 2.0000 FORMAT "%7.4" /end AXIS_DESCR
 FORMAT "%4.1" /end CHARACTERISTIC
/begin CHARACTERISTIC KF_TE_M_MAX_ML "max. Durchfluss Luft bei 100% tv und Normbed." MAP 0x770D4 TKF_SW_SW_UW 100.0 FORMULA_0561 0.0 65.5350
 /begin AXIS_DESCR STD_AXIS te_psau_diff FORMULA_0077 12 0.0 2000.0000 FORMAT "%4.1" /end AXIS_DESCR
 /begin AXIS_DESCR STD_AXIS n FORMULA_0006 8 0.0 10000.0000 /end AXIS_DESCR
 FORMAT "%6.3" /end CHARACTERISTIC
/begin CHARACTERISTIC KF_TE_TV_NORM "normiertes Tastverhaeltnis | EN: Normalised duty cycle" MAP 0x771BE TKF_UW_UW_UW 100.0 FORMULA_0001 0.0 100.0000
 /begin AXIS_DESCR STD_AXIS te_tv_rel FORMULA_1144 11 0.0 65.5350 FORMAT "%7.4" /end AXIS_DESCR
 /begin AXIS_DESCR STD_AXIS te_freq FORMULA_1082 5 10.0000 50.0000 FORMAT "%4.1" /end AXIS_DESCR
 FORMAT "%4.1" /end CHARACTERISTIC
/begin CHARACTERISTIC KF_TE_X_SOLL_KATD "Spuelluftanteil bei Katdiagnose" MAP 0x7724E TKF_SW_SW_UW 100.0 FORMULA_0024 0.0 1.9999 /begin AXIS_DESCR STD_AXIS n FORMULA_0006 8 0.0 10000.0000 /end AXIS_DESCR
 /begin AXIS_DESCR STD_AXIS psau.asp FORMULA_0077 8 0.0 2000.0000 FORMAT "%4.1" /end AXIS_DESCR
 FORMAT "%7.4" /end CHARACTERISTIC
/begin CHARACTERISTIC KF_TE_X_SOLL_MKS "betriebspunktabh. Kraftstoffanteil | EN: betriebspunktabh. Kraftstof f-anteil" MAP 0x772F0 TKF_SW_SW_UW 100.0 FORMULA_0024 0.0 1.9999 /begin AXIS_DESCR STD_AXIS n FORMULA_0006 8 0.0 10000.0000 /end AXIS_DESCR
 /begin AXIS_DESCR STD_AXIS psau.asp FORMULA_0077 8 0.0 2000.0000 FORMAT "%4.1" /end AXIS_DESCR
 FORMAT "%7.4" /end CHARACTERISTIC
/begin CHARACTERISTIC KF_TE_X_SOLL_N_PSAU "Spuelluftanteil im Normalbetrieb" MAP 0x77392 TKF_SW_SW_UW 100.0 FORMULA_0024 0.0 1.9999 /begin AXIS_DESCR STD_AXIS n FORMULA_0006 8 0.0 10000.0000 /end AXIS_DESCR
 /begin AXIS_DESCR STD_AXIS psau.asp FORMULA_0077 8 0.0 2000.0000 FORMAT "%4.1" /end AXIS_DESCR
 FORMAT "%7.4" /end CHARACTERISTIC
/begin CHARACTERISTIC KF_TE_X_SOLL_NOT "Spuelluftanteil bei NOTLAUF | EN: Spuelluftanteil bei NOTLAUF" MAP 0x77434 TKF_SW_SW_UW 100.0 FORMULA_0024 0.0 1.9999 /begin AXIS_DESCR STD_AXIS n FORMULA_0006 8 0.0 10000.0000 /end AXIS_DESCR
 /begin AXIS_DESCR STD_AXIS psau.asp FORMULA_0077 8 0.0 2000.0000 FORMAT "%4.1" /end AXIS_DESCR
 FORMAT "%7.4" /end CHARACTERISTIC
/begin MEASUREMENT B_TE_LAM_REG_BEGR_b1 "Lambda Regler Begrenzung" UBYTE FORMULA_1131 0 0 0.0 255.0 ECU_ADDRESS 0x3FD100 BIT_MASK 0x1 /end MEASUREMENT
/begin MEASUREMENT B_TE_LAM_REG_BEGR_b2 "Lambda Regler Begrenzung" UBYTE FORMULA_1131 0 0 0.0 255.0 ECU_ADDRESS 0x3FD101 BIT_MASK 0x1 /end MEASUREMENT
/begin MEASUREMENT B_TE_TI_MIN_BEGR_b1 "TI-min Begrenzung" UBYTE FORMULA_1132 0 0 0.0 255.0 ECU_ADDRESS 0x3FD100 BIT_MASK 0x2 /end MEASUREMENT
/begin MEASUREMENT B_TE_TI_MIN_BEGR_b2 "TI-min Begrenzung" UBYTE FORMULA_1132 0 0 0.0 255.0 ECU_ADDRESS 0x3FD101 BIT_MASK 0x2 /end MEASUREMENT
/begin MEASUREMENT B_TE_LAM_DELTA_BEGR_b1 "Lambda Soll-Ist Abweichung Begrenzung" UBYTE FORMULA_1133 0 0 0.0 255.0 ECU_ADDRESS 0x3FD100 BIT_MASK 0x4 /end MEASUREMENT
/begin MEASUREMENT B_TE_LAM_DELTA_BEGR_b2 "Lambda Soll-Ist Abweichung Begrenzung" UBYTE FORMULA_1133 0 0 0.0 255.0 ECU_ADDRESS 0x3FD101 BIT_MASK 0x4 /end MEASUREMENT
/begin MEASUREMENT te_begr_st_b1 "TE-Begrenzungsflags" UBYTE FORMULA_1134 0 0 0.0 255.0 ECU_ADDRESS 0x3FD100 /end MEASUREMENT
/begin MEASUREMENT te_begr_st_b2 "TE-Begrenzungsflags" UBYTE FORMULA_1134 0 0 0.0 255.0 ECU_ADDRESS 0x3FD101 /end MEASUREMENT
/begin MEASUREMENT te_c_akf_st "" UWORD FORMULA_1135 0 0 0.0 65535.0 ECU_ADDRESS 0x3FD102 BIT_MASK 0xF /end MEASUREMENT
/begin MEASUREMENT te_c_akf_mess1 "Zeitstempel f. Adaption Bank1" UWORD FORMULA_1136 0 0 0.0 65535.0 ECU_ADDRESS 0x3FD102 BIT_MASK 0x10 /end MEASUREMENT
/begin MEASUREMENT te_c_akf_mess2 "Zeitstempel f. Adaption Bank2" UWORD FORMULA_1137 0 0 0.0 65535.0 ECU_ADDRESS 0x3FD102 BIT_MASK 0x20 /end MEASUREMENT
/begin MEASUREMENT te_c_akf_adapt_bank1 "C-AKF einadaptiert - Bank1" UWORD FORMULA_0190 0 0 0.0 65535.0 ECU_ADDRESS 0x3FD102 BIT_MASK 0x40 /end MEASUREMENT
/begin MEASUREMENT te_c_akf_adapt_bank2 "C-AKF einadaptiert - Bank2" UWORD FORMULA_0191 0 0 0.0 65535.0 ECU_ADDRESS 0x3FD102 BIT_MASK 0x80 /end MEASUREMENT
/begin MEASUREMENT te_c_akf "Konzentration - AKF" UWORD FORMULA_0556 0 0 0.0 2.0000 ECU_ADDRESS 0x3FD104 /end MEASUREMENT
/begin MEASUREMENT te_c_akf_roh_b1 "errechnete AKF-Konzentration - Version 1" UWORD FORMULA_0556 0 0 0.0 2.0000 ECU_ADDRESS 0x3FD106 /end MEASUREMENT
/begin MEASUREMENT te_c_akf_roh_b2 "errechnete AKF-Konzentration - Version 1" UWORD FORMULA_0556 0 0 0.0 2.0000 ECU_ADDRESS 0x3FD108 /end MEASUREMENT
/begin MEASUREMENT te_c_akf_tau "Filterkonstante Konzentration - AKF" UWORD FORMULA_1059 0 0 0.1000 6553.5000 ECU_ADDRESS 0x3FD10A /end MEASUREMENT
/begin MEASUREMENT te_c_akf_vor_filt "Gemeinsame Konzentration Filterung" UWORD FORMULA_0556 0 0 0.0 2.0000 ECU_ADDRESS 0x3FD10C /end MEASUREMENT
/begin MEASUREMENT te_d_x_ml_soll_neg_b1 "neg. Gradient - Aenderungsbegrenzung" UWORD FORMULA_1138 0 0 0.0 1.9999 ECU_ADDRESS 0x3FD10E /end MEASUREMENT
/begin MEASUREMENT te_d_x_ml_soll_neg_b2 "neg. Gradient - Aenderungsbegrenzung" UWORD FORMULA_1138 0 0 0.0 1.9999 ECU_ADDRESS 0x3FD110 /end MEASUREMENT
/begin MEASUREMENT te_d_x_ml_soll_pos_b1 "pos. Gradient - Aenderungsbegrenzung" UWORD FORMULA_1138 0 0 0.0 1.9999 ECU_ADDRESS 0x3FD112 /end MEASUREMENT
/begin MEASUREMENT te_d_x_ml_soll_pos_b2 "pos. Gradient - Aenderungsbegrenzung" UWORD FORMULA_1138 0 0 0.0 1.9999 ECU_ADDRESS 0x3FD114 /end MEASUREMENT
/begin MEASUREMENT te_freq "TE-Ansteuerfrequenz" UWORD FORMULA_1082 0 0 10.0000 50.0000 ECU_ADDRESS 0x3FD116 /end MEASUREMENT
/begin MEASUREMENT te_m_max_b1 "Masse Gemisch bei 100%tv = te_m_mks + te_m_ml" UWORD FORMULA_0561 0 0 0.0 65.5350 ECU_ADDRESS 0x3FD118 /end MEASUREMENT
/begin MEASUREMENT te_m_max_b2 "Masse Gemisch bei 100%tv = te_m_mks + te_m_ml" UWORD FORMULA_0561 0 0 0.0 65.5350 ECU_ADDRESS 0x3FD11A /end MEASUREMENT
/begin MEASUREMENT te_m_max_mks_b1 "max. Durchfluss Masse Kraftstoffdampf bei 100% tv" UWORD FORMULA_0561 0 0 0.0 65.5350 ECU_ADDRESS 0x3FD11C /end MEASUREMENT
/begin MEASUREMENT te_m_max_mks_b2 "max. Durchfluss Masse Kraftstoffdampf bei 100% tv" UWORD FORMULA_0561 0 0 0.0 65.5350 ECU_ADDRESS 0x3FD11E /end MEASUREMENT
/begin MEASUREMENT te_m_max_ml_b1 "max. Durchfluss Masse Luft bei 100% tv" UWORD FORMULA_0561 0 0 0.0 65.5350 ECU_ADDRESS 0x3FD120 /end MEASUREMENT
/begin MEASUREMENT te_m_max_ml_b2 "max. Durchfluss Masse Luft bei 100% tv" UWORD FORMULA_0561 0 0 0.0 65.5350 ECU_ADDRESS 0x3FD122 /end MEASUREMENT
/begin MEASUREMENT te_m_ml_b1 "Masse Luft bei 100% tv entspr. c_akf" UWORD FORMULA_0561 0 0 0.0 65.5350 ECU_ADDRESS 0x3FD124 /end MEASUREMENT
/begin MEASUREMENT te_m_ml_b2 "Masse Luft bei 100% tv entspr. c_akf" UWORD FORMULA_0561 0 0 0.0 65.5350 ECU_ADDRESS 0x3FD126 /end MEASUREMENT
/begin MEASUREMENT te_m_mks_b1 "Masse Kraftstoffdampf bei 100% tv entspr. c_akf" UWORD FORMULA_0561 0 0 0.0 65.5350 ECU_ADDRESS 0x3FD128 /end MEASUREMENT
/begin MEASUREMENT te_m_mks_b2 "Masse Kraftstoffdampf bei 100% tv entspr. c_akf" UWORD FORMULA_0561 0 0 0.0 65.5350 ECU_ADDRESS 0x3FD12A /end MEASUREMENT
/begin MEASUREMENT te_lam_delta_b1 "Diff. aus lam_ist_mw - lam_soll" SWORD FORMULA_0025 0 0 -2.0000 1.9999 ECU_ADDRESS 0x3FD12C /end MEASUREMENT
/begin MEASUREMENT te_lam_delta_b2 "Diff. aus lam_ist_mw - lam_soll" SWORD FORMULA_0025 0 0 -2.0000 1.9999 ECU_ADDRESS 0x3FD12E /end MEASUREMENT
/begin MEASUREMENT te_ml_soll_b1 "SOLL-Massenstrom aus TE auf Luft normiert" UWORD FORMULA_0561 0 0 0.0 65.5350 ECU_ADDRESS 0x3FD130 /end MEASUREMENT
/begin MEASUREMENT te_ml_soll_b2 "SOLL-Massenstrom aus TE auf Luft normiert" UWORD FORMULA_0561 0 0 0.0 65.5350 ECU_ADDRESS 0x3FD132 /end MEASUREMENT
/begin MEASUREMENT te_ml_soll_mg_b1 "SOLL-Massenstrom aus TE auf Luft normiert" UWORD FORMULA_0752 0 0 0.0 1023.9843 ECU_ADDRESS 0x3FD134 /end MEASUREMENT
/begin MEASUREMENT te_ml_soll_mg_b2 "SOLL-Massenstrom aus TE auf Luft normiert" UWORD FORMULA_0752 0 0 0.0 1023.9843 ECU_ADDRESS 0x3FD136 /end MEASUREMENT
/begin MEASUREMENT te_ml_ist_b1 "Luftmassenstrom aus te_ml_soll und c_akf" SWORD FORMULA_0112 0 0 -100.0000 1400.0000 ECU_ADDRESS 0x3FD138 /end MEASUREMENT
/begin MEASUREMENT te_ml_ist_b2 "Luftmassenstrom aus te_ml_soll und c_akf" SWORD FORMULA_0112 0 0 -100.0000 1400.0000 ECU_ADDRESS 0x3FD13A /end MEASUREMENT
/begin MEASUREMENT te_ml_min_b1 "min. angesaugter Luftmassenstrom" UWORD FORMULA_0112 0 0 0.0 1400.0000 ECU_ADDRESS 0x3FD13C /end MEASUREMENT
/begin MEASUREMENT te_ml_min_b2 "min. angesaugter Luftmassenstrom" UWORD FORMULA_0112 0 0 0.0 1400.0000 ECU_ADDRESS 0x3FD13E /end MEASUREMENT
/begin MEASUREMENT te_ml_nue_b1 "Wichte - Luft" UWORD FORMULA_1139 0 0 0.0 65.5350 ECU_ADDRESS 0x3FD140 /end MEASUREMENT
/begin MEASUREMENT te_ml_nue_b2 "Wichte - Luft" UWORD FORMULA_1139 0 0 0.0 65.5350 ECU_ADDRESS 0x3FD142 /end MEASUREMENT
/begin MEASUREMENT te_mks_nue_b1 "Wichte - MKS" UWORD FORMULA_1139 0 0 0.0 65.5350 ECU_ADDRESS 0x3FD144 /end MEASUREMENT
/begin MEASUREMENT te_mks_nue_b2 "Wichte - MKS" UWORD FORMULA_1139 0 0 0.0 65.5350 ECU_ADDRESS 0x3FD146 /end MEASUREMENT
/begin MEASUREMENT te_ml_yps_quad_b1 "(te_ml_yps)2 - Luft" UWORD FORMULA_1140 0 0 0.0 589815.0000 ECU_ADDRESS 0x3FD148 /end MEASUREMENT
/begin MEASUREMENT te_ml_yps_quad_b2 "(te_ml_yps)2 - Luft" UWORD FORMULA_1140 0 0 0.0 589815.0000 ECU_ADDRESS 0x3FD14A /end MEASUREMENT
/begin MEASUREMENT te_mks_yps_quad_b1 "(te_mks_yps)2 - MKS" UWORD FORMULA_1140 0 0 0.0 589815.0000 ECU_ADDRESS 0x3FD14C /end MEASUREMENT
/begin MEASUREMENT te_mks_yps_quad_b2 "(te_mks_yps)2 - MKS" UWORD FORMULA_1140 0 0 0.0 589815.0000 ECU_ADDRESS 0x3FD14E /end MEASUREMENT
/begin MEASUREMENT te_mks_xsi_b1 "Ausflusskoeffizient - MKS" UWORD FORMULA_1034 0 0 0.0 65.5350 ECU_ADDRESS 0x3FD150 /end MEASUREMENT
/begin MEASUREMENT te_mks_xsi_b2 "Ausflusskoeffizient - MKS" UWORD FORMULA_1034 0 0 0.0 65.5350 ECU_ADDRESS 0x3FD152 /end MEASUREMENT
/begin MEASUREMENT te_mks_yps_b1 "Stroemungsgeschwindigkeit - MKS" UWORD FORMULA_1141 0 0 0.0 65535.0000 ECU_ADDRESS 0x3FD154 /end MEASUREMENT
/begin MEASUREMENT te_mks_yps_b2 "Stroemungsgeschwindigkeit - MKS" UWORD FORMULA_1141 0 0 0.0 65535.0000 ECU_ADDRESS 0x3FD156 /end MEASUREMENT
/begin MEASUREMENT te_ml_xsi_b1 "Ausflusskoeffizient - Luft" UWORD FORMULA_1034 0 0 0.0 65.5350 ECU_ADDRESS 0x3FD158 /end MEASUREMENT
/begin MEASUREMENT te_ml_xsi_b2 "Ausflusskoeffizient - Luft" UWORD FORMULA_1034 0 0 0.0 65.5350 ECU_ADDRESS 0x3FD15A /end MEASUREMENT
/begin MEASUREMENT te_ml_yps_b1 "Stroemungsgeschwindigkeit - Luft" UWORD FORMULA_1141 0 0 0.0 65535.0000 ECU_ADDRESS 0x3FD15C /end MEASUREMENT
/begin MEASUREMENT te_ml_yps_b2 "Stroemungsgeschwindigkeit - Luft" UWORD FORMULA_1141 0 0 0.0 65535.0000 ECU_ADDRESS 0x3FD15E /end MEASUREMENT
/begin MEASUREMENT te_mzyl_ohne_b1 "adaptierter angesaugter Luftmassenstrom ohne TE" UWORD FORMULA_0752 0 0 0.0 1023.9843 ECU_ADDRESS 0x3FD160 /end MEASUREMENT
/begin MEASUREMENT te_mzyl_ohne_b2 "adaptierter angesaugter Luftmassenstrom ohne TE" UWORD FORMULA_0752 0 0 0.0 1023.9843 ECU_ADDRESS 0x3FD162 /end MEASUREMENT
/begin MEASUREMENT te_ml_zyl_real_b1 "mzyl aus TI berechnet" UWORD FORMULA_0752 0 0 0.0 1023.9843 ECU_ADDRESS 0x3FD164 /end MEASUREMENT
/begin MEASUREMENT te_ml_zyl_real_b2 "mzyl aus TI berechnet" UWORD FORMULA_0752 0 0 0.0 1023.9843 ECU_ADDRESS 0x3FD166 /end MEASUREMENT
/begin MEASUREMENT te_mzyl_diff_b1 "Differenz te_mzyl_ohne - te_ml_zyl_real" UWORD FORMULA_0752 0 0 0.0 1023.9843 ECU_ADDRESS 0x3FD168 /end MEASUREMENT
/begin MEASUREMENT te_mzyl_diff_b2 "Differenz te_mzyl_ohne - te_ml_zyl_real" UWORD FORMULA_0752 0 0 0.0 1023.9843 ECU_ADDRESS 0x3FD16A /end MEASUREMENT
/begin MEASUREMENT te_mks_f_b1 "Faktor auf Kraftstoffmasse aus TE" UWORD FORMULA_1142 0 0 0.0 1008.2307 ECU_ADDRESS 0x3FD16C /end MEASUREMENT
/begin MEASUREMENT te_mks_f_b2 "Faktor auf Kraftstoffmasse aus TE" UWORD FORMULA_1142 0 0 0.0 1008.2307 ECU_ADDRESS 0x3FD16E /end MEASUREMENT
/begin MEASUREMENT te_mks_f_ist_b1 "Aenderungsbegr. Faktor auf Kraftstoffmasse aus TE" UWORD FORMULA_1142 0 0 0.0 1008.2307 ECU_ADDRESS 0x3FD170 /end MEASUREMENT
/begin MEASUREMENT te_mks_f_ist_b2 "Aenderungsbegr. Faktor auf Kraftstoffmasse aus TE" UWORD FORMULA_1142 0 0 0.0 1008.2307 ECU_ADDRESS 0x3FD172 /end MEASUREMENT
/begin MEASUREMENT te_mks_ist_b1 "aktuelle MKS aus TE" UWORD FORMULA_0752 0 0 0.0 1023.9843 ECU_ADDRESS 0x3FD174 /end MEASUREMENT
/begin MEASUREMENT te_mks_ist_b2 "aktuelle MKS aus TE" UWORD FORMULA_0752 0 0 0.0 1023.9843 ECU_ADDRESS 0x3FD176 /end MEASUREMENT
/begin MEASUREMENT te_mks_aktiv_b1 "aktiv auszugebende MKS aus TE" UWORD FORMULA_0752 0 0 0.0 1023.9843 ECU_ADDRESS 0x3FD178 /end MEASUREMENT
/begin MEASUREMENT te_mks_aktiv_b2 "aktiv auszugebende MKS aus TE" UWORD FORMULA_0752 0 0 0.0 1023.9843 ECU_ADDRESS 0x3FD17A /end MEASUREMENT
/begin MEASUREMENT te_mks_b1 "begrenzte auszugebende MKS aus TE" UWORD FORMULA_0752 0 0 0.0 1023.9843 ECU_ADDRESS 0x3FD17C /end MEASUREMENT
/begin MEASUREMENT te_mks_b2 "begrenzte auszugebende MKS aus TE" UWORD FORMULA_0752 0 0 0.0 1023.9843 ECU_ADDRESS 0x3FD17E /end MEASUREMENT
/begin MEASUREMENT te_n_stat_b1 "n, bei der LAA stationaer" SWORD FORMULA_0006 0 0 0.0 10000.0000 ECU_ADDRESS 0x3FD180 /end MEASUREMENT
/begin MEASUREMENT te_n_stat_b2 "n, bei der LAA stationaer" SWORD FORMULA_0006 0 0 0.0 10000.0000 ECU_ADDRESS 0x3FD182 /end MEASUREMENT
/begin MEASUREMENT te_n_stat_min_b1 "min. n-Schwelle fuer LAA stationaer" SWORD FORMULA_0006 0 0 0.0 10000.0000 ECU_ADDRESS 0x3FD184 /end MEASUREMENT
/begin MEASUREMENT te_n_stat_min_b2 "min. n-Schwelle fuer LAA stationaer" SWORD FORMULA_0006 0 0 0.0 10000.0000 ECU_ADDRESS 0x3FD186 /end MEASUREMENT
/begin MEASUREMENT te_n_stat_max_b1 "max. n-Schwelle fuer LAA stationaer" SWORD FORMULA_0006 0 0 0.0 10000.0000 ECU_ADDRESS 0x3FD188 /end MEASUREMENT
/begin MEASUREMENT te_n_stat_max_b2 "max. n-Schwelle fuer LAA stationaer" SWORD FORMULA_0006 0 0 0.0 10000.0000 ECU_ADDRESS 0x3FD18A /end MEASUREMENT
/begin MEASUREMENT te_psau_diff_b1 "Diff. aus pumg - psau_asp" SWORD FORMULA_0077 0 0 0.0 2000.0000 ECU_ADDRESS 0x3FD18C /end MEASUREMENT
/begin MEASUREMENT te_psau_diff_b2 "Diff. aus pumg - psau_asp" SWORD FORMULA_0077 0 0 0.0 2000.0000 ECU_ADDRESS 0x3FD18E /end MEASUREMENT
/begin MEASUREMENT te_r_gemisch_b1 "MISCH-Gaskonstante" UWORD FORMULA_1143 0 0 0.0 65535.0000 ECU_ADDRESS 0x3FD190 /end MEASUREMENT
/begin MEASUREMENT te_r_gemisch_b2 "MISCH-Gaskonstante" UWORD FORMULA_1143 0 0 0.0 65535.0000 ECU_ADDRESS 0x3FD192 /end MEASUREMENT
/begin MEASUREMENT te_rf_stat_b1 "rf, bei der LAA stationaer" SWORD FORMULA_0007 0 0 0.0 2.0000 ECU_ADDRESS 0x3FD194 /end MEASUREMENT
/begin MEASUREMENT te_rf_stat_b2 "rf, bei der LAA stationaer" SWORD FORMULA_0007 0 0 0.0 2.0000 ECU_ADDRESS 0x3FD196 /end MEASUREMENT
/begin MEASUREMENT te_rf_stat_min_b1 "min. rf-Schwelle fuer LAA stationaer" SWORD FORMULA_0007 0 0 0.0 2.0000 ECU_ADDRESS 0x3FD198 /end MEASUREMENT
/begin MEASUREMENT te_rf_stat_min_b2 "min. rf-Schwelle fuer LAA stationaer" SWORD FORMULA_0007 0 0 0.0 2.0000 ECU_ADDRESS 0x3FD19A /end MEASUREMENT
/begin MEASUREMENT te_rf_stat_max_b1 "max. rf-Schwelle fuer LAA stationaer" SWORD FORMULA_0007 0 0 0.0 2.0000 ECU_ADDRESS 0x3FD19C /end MEASUREMENT
/begin MEASUREMENT te_rf_stat_max_b2 "max. rf-Schwelle fuer LAA stationaer" SWORD FORMULA_0007 0 0 0.0 2.0000 ECU_ADDRESS 0x3FD19E /end MEASUREMENT
/begin MEASUREMENT te_t_spuel "SPUEL-Zeit" UWORD FORMULA_0021 0 0 0.0 655.0000 ECU_ADDRESS 0x3FD1A0 /end MEASUREMENT
/begin MEASUREMENT te_t_laa_ini "TE-LAA-INI-Zeit - ununterbrechbar" UWORD FORMULA_0021 0 0 0.0 655.0000 ECU_ADDRESS 0x3FD1A2 /end MEASUREMENT
/begin MEASUREMENT te_t_laa "TE-LAA-Zeit" UWORD FORMULA_0021 0 0 0.0 655.0000 ECU_ADDRESS 0x3FD1A4 /end MEASUREMENT
/begin MEASUREMENT te_tv_rel_b1 "Verhaeltnis te_ml_soll/te_m_max_ml" UWORD FORMULA_1144 0 0 0.0 65.5350 ECU_ADDRESS 0x3FD1A6 /end MEASUREMENT
/begin MEASUREMENT te_tv_rel_b2 "Verhaeltnis te_ml_soll/te_m_max_ml" UWORD FORMULA_1144 0 0 0.0 65.5350 ECU_ADDRESS 0x3FD1A8 /end MEASUREMENT
/begin MEASUREMENT te_ti_min_diff_b1 "Abstand ti_tpu zu ti_bj.min" UWORD FORMULA_0786 0 0 0.0 65.5350 ECU_ADDRESS 0x3FD1AA /end MEASUREMENT
/begin MEASUREMENT te_ti_min_diff_b2 "Abstand ti_tpu zu ti_bj.min" UWORD FORMULA_0786 0 0 0.0 65.5350 ECU_ADDRESS 0x3FD1AC /end MEASUREMENT
/begin MEASUREMENT te_tv_norm_b1 "normierte Tastverhaeltnis" UWORD FORMULA_0001 0 0 0.0 100.0000 ECU_ADDRESS 0x3FD1AE /end MEASUREMENT
/begin MEASUREMENT te_tv_norm_b2 "normierte Tastverhaeltnis" UWORD FORMULA_0001 0 0 0.0 100.0000 ECU_ADDRESS 0x3FD1B0 /end MEASUREMENT
/begin MEASUREMENT te_tv_offs "ub-abhaengiger TV-Offset" UWORD FORMULA_0001 0 0 0.0 100.0000 ECU_ADDRESS 0x3FD1B2 /end MEASUREMENT
/begin MEASUREMENT te_tv_roh_b1 "ub-gewichtetes TV" UWORD FORMULA_0001 0 0 0.0 100.0000 ECU_ADDRESS 0x3FD1B4 /end MEASUREMENT
/begin MEASUREMENT te_tv_roh_b2 "ub-gewichtetes TV" UWORD FORMULA_0001 0 0 0.0 100.0000 ECU_ADDRESS 0x3FD1B6 /end MEASUREMENT
/begin MEASUREMENT te_van_vo_stat_b1 "Ventil_Ueberschneidung fuer LAA-stationaer" SWORD FORMULA_0111 0 0 -80.0000 80.0000 ECU_ADDRESS 0x3FD1B8 /end MEASUREMENT
/begin MEASUREMENT te_van_vo_stat_b2 "Ventil_Ueberschneidung fuer LAA-stationaer" SWORD FORMULA_0111 0 0 -80.0000 80.0000 ECU_ADDRESS 0x3FD1BA /end MEASUREMENT
/begin MEASUREMENT te_van_vo_stat_min_b1 "min. Ventil_Ueberschneidung fuer LAA-stationaer" SWORD FORMULA_0111 0 0 -80.0000 80.0000 ECU_ADDRESS 0x3FD1BC /end MEASUREMENT
/begin MEASUREMENT te_van_vo_stat_min_b2 "min. Ventil_Ueberschneidung fuer LAA-stationaer" SWORD FORMULA_0111 0 0 -80.0000 80.0000 ECU_ADDRESS 0x3FD1BE /end MEASUREMENT
/begin MEASUREMENT te_van_vo_stat_max_b1 "max. Ventil_Ueberschneidung fuer LAA stationaer" SWORD FORMULA_0111 0 0 -80.0000 80.0000 ECU_ADDRESS 0x3FD1C0 /end MEASUREMENT
/begin MEASUREMENT te_van_vo_stat_max_b2 "max. Ventil_Ueberschneidung fuer LAA stationaer" SWORD FORMULA_0111 0 0 -80.0000 80.0000 ECU_ADDRESS 0x3FD1C2 /end MEASUREMENT
/begin MEASUREMENT te_ventil_exd_timeout "Tester Ansteuerzeit" UBYTE FORMULA_0458 0 0 0.0 25.5000 ECU_ADDRESS 0x3FD1C4 /end MEASUREMENT
/begin MEASUREMENT te_vol_b1 "aktueller Volumenstrom durch TE" UWORD FORMULA_1145 0 0 0.0 131.0700 ECU_ADDRESS 0x3FD1C6 /end MEASUREMENT
/begin MEASUREMENT te_vol_b2 "aktueller Volumenstrom durch TE" UWORD FORMULA_1145 0 0 0.0 131.0700 ECU_ADDRESS 0x3FD1C8 /end MEASUREMENT
/begin MEASUREMENT te_vol_max_b1 "max. Volumenstrom bei 100% Ansteuerung" UWORD FORMULA_1145 0 0 0.0 131.0700 ECU_ADDRESS 0x3FD1CA /end MEASUREMENT
/begin MEASUREMENT te_vol_max_b2 "max. Volumenstrom bei 100% Ansteuerung" UWORD FORMULA_1145 0 0 0.0 131.0700 ECU_ADDRESS 0x3FD1CC /end MEASUREMENT
/begin MEASUREMENT te_vol_sum "Summe Volumenstrom in Motorlauf" ULONG FORMULA_1146 0 0 0.0 14316.5576 ECU_ADDRESS 0x3FD1D0 /end MEASUREMENT
/begin MEASUREMENT te_x_mks_b1 "Soll-MKS-Anteil aus n und psau" UWORD FORMULA_0024 0 0 0.0 1.9999 ECU_ADDRESS 0x3FD1D4 /end MEASUREMENT
/begin MEASUREMENT te_x_mks_b2 "Soll-MKS-Anteil aus n und psau" UWORD FORMULA_0024 0 0 0.0 1.9999 ECU_ADDRESS 0x3FD1D6 /end MEASUREMENT
/begin MEASUREMENT te_x_mks_betrieb_b1 "MKS-Anteil auf Luft-Anteil norm, mit ti_min-Begr." UWORD FORMULA_0024 0 0 0.0 1.9999 ECU_ADDRESS 0x3FD1D8 /end MEASUREMENT
/begin MEASUREMENT te_x_mks_betrieb_b2 "MKS-Anteil auf Luft-Anteil norm, mit ti_min-Begr." UWORD FORMULA_0024 0 0 0.0 1.9999 ECU_ADDRESS 0x3FD1DA /end MEASUREMENT
/begin MEASUREMENT te_x_ml_betrieb_b1 "moeglicher Luftmassenanteil bei 100% tv" UWORD FORMULA_0024 0 0 0.0 0.1000 ECU_ADDRESS 0x3FD1DC /end MEASUREMENT
/begin MEASUREMENT te_x_ml_betrieb_b2 "moeglicher Luftmassenanteil bei 100% tv" UWORD FORMULA_0024 0 0 0.0 0.1000 ECU_ADDRESS 0x3FD1DE /end MEASUREMENT
/begin MEASUREMENT te_x_ml_gw_neg_b1 "Abregelzeit" UWORD FORMULA_0073 0 0 0.0 6553.5000 ECU_ADDRESS 0x3FD1E0 /end MEASUREMENT
/begin MEASUREMENT te_x_ml_gw_neg_b2 "Abregelzeit" UWORD FORMULA_0073 0 0 0.0 6553.5000 ECU_ADDRESS 0x3FD1E2 /end MEASUREMENT
/begin MEASUREMENT te_x_ml_gw_pos_b1 "Aufregelzeit" UWORD FORMULA_0073 0 0 0.0 6553.5000 ECU_ADDRESS 0x3FD1E4 /end MEASUREMENT
/begin MEASUREMENT te_x_ml_gw_pos_b2 "Aufregelzeit" UWORD FORMULA_0073 0 0 0.0 6553.5000 ECU_ADDRESS 0x3FD1E6 /end MEASUREMENT
/begin MEASUREMENT te_x_ml_max_b1 "max. zulaessiger Spuelluftanteil" UWORD FORMULA_0024 0 0 0.0 0.1000 ECU_ADDRESS 0x3FD1E8 /end MEASUREMENT
/begin MEASUREMENT te_x_ml_max_b2 "max. zulaessiger Spuelluftanteil" UWORD FORMULA_0024 0 0 0.0 0.1000 ECU_ADDRESS 0x3FD1EA /end MEASUREMENT
/begin MEASUREMENT te_x_ml_min_b1 "min. Auswahl des zulaessigen Spuelluftanteils" UWORD FORMULA_0024 0 0 0.0 0.1000 ECU_ADDRESS 0x3FD1EC /end MEASUREMENT
/begin MEASUREMENT te_x_ml_min_b2 "min. Auswahl des zulaessigen Spuelluftanteils" UWORD FORMULA_0024 0 0 0.0 0.1000 ECU_ADDRESS 0x3FD1EE /end MEASUREMENT
/begin MEASUREMENT te_x_ml_n_psau_b1 "Soll-Luftmassenanteil aus n und psau" UWORD FORMULA_0024 0 0 0.0 0.1000 ECU_ADDRESS 0x3FD1F0 /end MEASUREMENT
/begin MEASUREMENT te_x_ml_n_psau_b2 "Soll-Luftmassenanteil aus n und psau" UWORD FORMULA_0024 0 0 0.0 0.1000 ECU_ADDRESS 0x3FD1F2 /end MEASUREMENT
/begin MEASUREMENT te_x_ml_soll_b1 "ausgegebener Spuelluftanteil" UWORD FORMULA_0024 0 0 0.0 0.1000 ECU_ADDRESS 0x3FD1F4 /end MEASUREMENT
/begin MEASUREMENT te_x_ml_soll_b2 "ausgegebener Spuelluftanteil" UWORD FORMULA_0024 0 0 0.0 0.1000 ECU_ADDRESS 0x3FD1F6 /end MEASUREMENT
/begin MEASUREMENT te_x_ml_soll_aebg_b1 "Aenderungsbegr. Soll-Spuelluftanteil" UWORD FORMULA_0024 0 0 0.0 0.1000 ECU_ADDRESS 0x3FD1F8 /end MEASUREMENT
/begin MEASUREMENT te_x_ml_soll_aebg_b2 "Aenderungsbegr. Soll-Spuelluftanteil" UWORD FORMULA_0024 0 0 0.0 0.1000 ECU_ADDRESS 0x3FD1FA /end MEASUREMENT
/begin MEASUREMENT te_x_ml_ziel_b1 "gewuenschter Spuelluftanteil" UWORD FORMULA_0024 0 0 0.0 0.1000 ECU_ADDRESS 0x3FD1FC /end MEASUREMENT
/begin MEASUREMENT te_x_ml_ziel_b2 "gewuenschter Spuelluftanteil" UWORD FORMULA_0024 0 0 0.0 0.1000 ECU_ADDRESS 0x3FD1FE /end MEASUREMENT
/* ------------------ Abschnitt erzeugt aus te_obd.dat ------------------ */
/begin CHARACTERISTIC K_TE_OBD_AUSS_DELTA "min. auss_lp_int-Reaktion fuer OK | EN: min. auss_int -Reaktion fuer OK" VALUE 0x774D6 TKW_VV_VV_SW 100.0 FORMULA_0709 -200.0000 200.0000 FORMAT "%4.1" /end CHARACTERISTIC
/begin CHARACTERISTIC K_TE_OBD_AUSS_DELTA_NEG "min. negative auss_lp_int-Reaktion fuer OK | EN: min. negative auss_lp_int -Reaktion fuer OK" VALUE 0x774D8 TKW_VV_VV_SW 100.0 FORMULA_0709 -200.0000 200.0000 FORMAT "%4.1" /end CHARACTERISTIC
/begin CHARACTERISTIC K_TE_OBD_AUSS_TAU "Filterzeitkonstante fur auss_lp_int_sum | EN: Filterzeitkonstante fur auss_lp_int_sum" VALUE 0x774DA TKW_VV_VV_UB 100.0 FORMULA_0664 0.0101 2.5600 /end CHARACTERISTIC
/begin CHARACTERISTIC K_TE_OBD_ML_TAU "Filterzeitkonstante fur ml_hfm_roh | EN: Filterzeitkonstante fur ml_hfm_roh" VALUE 0x774DB TKW_VV_VV_UB 100.0 FORMULA_0664 0.0101 2.5600 /end CHARACTERISTIC
/begin CHARACTERISTIC K_TE_OBD_ANZ "max. Anzahl der Durchlaeufe  | EN: 0   max. Anzahl der Durchlaeufe" VALUE 0x774DC TKW_VV_VV_UB 100.0 FORMULA_0003 0.0 255.0000 /end CHARACTERISTIC
/begin CHARACTERISTIC K_TE_OBD_CFG "KKOS-Abwurf / laa_f_bx-Freeze | EN: 0x0 oh- ne_KKOS_Abwurf LAA_reset 0x1 LAA_freeze 0x2 KKOS_Abwurf 0x3 KKOS_Abwurf LAA_freeze 0x4 RESET" VALUE 0x774DD TKW_VV_VV_UB 100.0 FORMULA_1157 0.0 255.0 /end CHARACTERISTIC
/begin CHARACTERISTIC K_TE_OBD_LAM_DELTA "min. Reaktion lam_ist_mw fuer OK | EN: min. Reaktion lam_ist_mw fuer OK" VALUE 0x774DE TKW_VV_VV_UW 100.0 FORMULA_0025 0.0 3.9990 FORMAT "%6.3" /end CHARACTERISTIC
/begin CHARACTERISTIC K_TE_OBD_LAM_FREIG "max. Regelabweichung Reglerfreigabe  | EN: Maximum control error for controller enable" VALUE 0x774E0 TKW_VV_VV_UW 100.0 FORMULA_0025 0.0 3.9990 FORMAT "%6.3" /end CHARACTERISTIC
/begin CHARACTERISTIC K_TE_OBD_LL_DELAY "Wartezeit nach Erreichen LL | EN: Wait time after reaching idle [s]" VALUE 0x774E2 TKW_VV_VV_UB 100.0 FORMULA_0458 0.0 25.5000 /end CHARACTERISTIC
/begin CHARACTERISTIC K_TE_OBD_LL_DELTA "min. ml/n -Reaktion beim Oeffnen fuer OK | EN: Minimum air mass/rpm reaction on opening for OK [%]" VALUE 0x774E4 TKW_VV_VV_SW 100.0 FORMULA_0022 -50.0000 50.0000 FORMAT "%5.2" /end CHARACTERISTIC
/begin CHARACTERISTIC K_TE_OBD_LL_OK "Gesamt-Anzahl noetiger o.K. Reaktionen" VALUE 0x774E6 TKW_VV_VV_UB 100.0 FORMULA_0003 0.0 255.0000 /end CHARACTERISTIC
/begin CHARACTERISTIC K_TE_OBD_LAM_OK "Anzahl noetiger LAM-Reaktionen | EN: Number of required lambda reactions" VALUE 0x774E7 TKW_VV_VV_UB 100.0 FORMULA_0003 0.0 255.0000 /end CHARACTERISTIC
/begin CHARACTERISTIC K_TE_OBD_LL_ZU_DELTA "min. ml/n-Reaktion beim Schliessen fuer OK | EN: Minimum air mass/rpm reaction on closing for OK [%]" VALUE 0x774E8 TKW_VV_VV_SW 100.0 FORMULA_0022 -50.0000 50.0000 FORMAT "%5.2" /end CHARACTERISTIC
/begin CHARACTERISTIC K_TE_OBD_LRW_ABBR "Lenkwinkel-Aenderung fuer Abbruch | EN: Steering-angle change for abort" VALUE 0x774EA TKW_VV_VV_SW 100.0 FORMULA_0141 0.0 1440.1096 FORMAT "%5.2" /end CHARACTERISTIC
/begin CHARACTERISTIC K_TE_OBD_MD_GEN_ABBR "Generatormoment-Aenderung fuer Abbruch | EN: Generator-torque change for abort [Nm]" VALUE 0x774EC TKW_VV_VV_SW 100.0 FORMULA_0121 -3276.8000 3276.7000 FORMAT "%5.2" /end CHARACTERISTIC
/begin CHARACTERISTIC K_TE_OBD_MD_KKOS_ABBR "Md-Aenderung KKOS fuer Abbruch | EN: A/C compressor torque change for abort [Nm]" VALUE 0x774EE TKW_VV_VV_SW 100.0 FORMULA_0129 -100.0000 1000.0000 FORMAT "%4.1" /end CHARACTERISTIC
/begin CHARACTERISTIC K_TE_OBD_ML_MAX "Max. Luftmasse ml_ges | EN: Maximum air mass ml_ges [kg/h]" VALUE 0x774F0 TKW_VV_VV_SW 100.0 FORMULA_0112 -100.0000 1400.0000 FORMAT "%4.1" /end CHARACTERISTIC
/begin CHARACTERISTIC K_TE_OBD_N_SOLL_ABBR "Aenderung llr_n_soll fuer Abbruch | EN: Aenderung llr_n_soll fuer Abbruch" VALUE 0x774F2 TKW_VV_VV_SW 100.0 FORMULA_0006 0.0 10000.0000 /end CHARACTERISTIC
/begin CHARACTERISTIC K_TE_OBD_RAMPE_ABBRUCH "Abbruchrampe TEV | EN: Abbruchrampe TEV" VALUE 0x774F4 TKW_VV_VV_UW 100.0 FORMULA_1158 0.0 100.0000 FORMAT "%4.1" /end CHARACTERISTIC
/begin CHARACTERISTIC K_TE_OBD_RAMPE_ZU "Abregelrampe TEV | EN: Abregelrampe TEV" VALUE 0x774F6 TKW_VV_VV_UW 100.0 FORMULA_1158 0.0 100.0000 FORMAT "%4.1" /end CHARACTERISTIC
/begin CHARACTERISTIC K_TE_OBD_T_LAM_REG_OFF "Max. Sperrzeit Lam-Reg | EN: Max. Sperrzeit Lam-Reg" VALUE 0x774F8 TKW_VV_VV_UB 100.0 FORMULA_0458 0.0 25.5000 /end CHARACTERISTIC
/begin CHARACTERISTIC K_TE_OBD_T_MESS_OFFEN "Max. Messzeit bei offenen TEV | EN: Max. Messzeit bei offenen TEV" VALUE 0x774F9 TKW_VV_VV_UB 100.0 FORMULA_0458 0.0 25.5000 /end CHARACTERISTIC
/begin CHARACTERISTIC K_TE_OBD_T_MESS_ZU "Max. Messzeit bei geschl. TEV | EN: Max. Messzeit bei geschl. TEV" VALUE 0x774FA TKW_VV_VV_UB 100.0 FORMULA_0458 0.0 25.5000 /end CHARACTERISTIC
/begin CHARACTERISTIC K_TE_OBD_T_ML_MIN "Mindest-Motorlaufzeit | EN: Mindest-Motorlaufzeit" VALUE 0x774FC TKW_VV_VV_UW 100.0 FORMULA_0021 0.0 655.0000 FORMAT "%5.2" /end CHARACTERISTIC
/begin CHARACTERISTIC K_TE_OBD_TOEL_MIN "Mindest toel_modell | EN: Mindest toel_modell" VALUE 0x774FE TKW_VV_VV_SW 100.0 FORMULA_0023 -50.0000 170.0000 FORMAT "%4.1" /end CHARACTERISTIC
/begin CHARACTERISTIC K_TE_OBD_TOEL_MIN_EXD "Mindest toel_modell f�r ext. Diagnose | EN: Mindest toel_modell für ext. Diagnose" VALUE 0x77500 TKW_VV_VV_SW 100.0 FORMULA_0023 -50.0000 170.0000 FORMAT "%4.1" /end CHARACTERISTIC
/begin CHARACTERISTIC K_TE_OBD_TV_MAX "Maximale Oeffnung TEV | EN: Maximum purge-valve opening [%]" VALUE 0x77502 TKW_VV_VV_UW 100.0 FORMULA_0001 0.0 100.0000 FORMAT "%4.1" /end CHARACTERISTIC
/begin CHARACTERISTIC K_TE_OBD_TZ_ABBR "Zuendwinkelaenderung fuer Abbruch | EN: Ignition-angle change for abort [°KW]" VALUE 0x77504 TKW_VV_VV_SW 100.0 FORMULA_0111 -50.0000 60.0000 FORMAT "%4.1" /end CHARACTERISTIC
/begin CHARACTERISTIC K_TE_OBD_UB_ABBR "Spannungsaenderung fuer Abbruch | EN: Voltage change for abort [V]" VALUE 0x77506 TKW_VV_VV_SW 100.0 FORMULA_0008 0.0 28.0000 FORMAT "%4.1" /end CHARACTERISTIC
/begin CHARACTERISTIC KL_TE_OBD_RAMPE "Oeffnungsverlauf beim TEV-Check | EN: Opening profile during purge-valve check" CURVE 0x77508 TKL_UW_VV_UW 100.0 FORMULA_1158 0.0 100.0000
 /begin AXIS_DESCR STD_AXIS te_obd_tv FORMULA_0001 5 0.0 100.0000 FORMAT "%4.1" /end AXIS_DESCR
 FORMAT "%4.1" /end CHARACTERISTIC
/begin MEASUREMENT te_obd_auss_delta_b1 "Auss-Integral Reaktion" SWORD FORMULA_0709 0 0 -200.0000 200.0000 ECU_ADDRESS 0x3FD200 /end MEASUREMENT
/begin MEASUREMENT te_obd_auss_delta_b2 "Auss-Integral Reaktion" SWORD FORMULA_0709 0 0 -200.0000 200.0000 ECU_ADDRESS 0x3FD202 /end MEASUREMENT
/begin MEASUREMENT te_obd_auss_filt_b1 "gefilt. Auss-Integral-Leitwert" SWORD FORMULA_1153 0 0 0.0 10.0000 ECU_ADDRESS 0x3FD204 /end MEASUREMENT
/begin MEASUREMENT te_obd_auss_filt_b2 "gefilt. Auss-Integral-Leitwert" SWORD FORMULA_1153 0 0 0.0 10.0000 ECU_ADDRESS 0x3FD206 /end MEASUREMENT
/begin MEASUREMENT te_obd_auss_ok_b1 "Anzahl der Integrale OK-Erkennungen" UBYTE FORMULA_0003 0 0 0.0 255.0000 ECU_ADDRESS 0x3FD208 /end MEASUREMENT
/begin MEASUREMENT te_obd_auss_ok_b2 "Anzahl der Integrale OK-Erkennungen" UBYTE FORMULA_0003 0 0 0.0 255.0000 ECU_ADDRESS 0x3FD209 /end MEASUREMENT
/begin MEASUREMENT te_obd_auss_start_b1 "gefilt. Auss-Integral bei Messbeginn" SWORD FORMULA_1153 0 0 0.0 10.0000 ECU_ADDRESS 0x3FD20A /end MEASUREMENT
/begin MEASUREMENT te_obd_auss_start_b2 "gefilt. Auss-Integral bei Messbeginn" SWORD FORMULA_1153 0 0 0.0 10.0000 ECU_ADDRESS 0x3FD20C /end MEASUREMENT
/begin MEASUREMENT te_obd_kkos_md_start "Md-Aufnahme Klimakompressor" SWORD FORMULA_0129 0 0 -100.0000 1000.0000 ECU_ADDRESS 0x3FD20E /end MEASUREMENT
/begin MEASUREMENT te_obd_lam_min_b1 "Minimalwert Lambda bei Messung" UWORD FORMULA_0025 0 0 0.0 3.9990 ECU_ADDRESS 0x3FD210 /end MEASUREMENT
/begin MEASUREMENT te_obd_lam_min_b2 "Minimalwert Lambda bei Messung" UWORD FORMULA_0025 0 0 0.0 3.9990 ECU_ADDRESS 0x3FD212 /end MEASUREMENT
/begin MEASUREMENT te_obd_lam_max_b1 "Maximalwert Lambda bei Messung" UWORD FORMULA_0025 0 0 0.0 3.9990 ECU_ADDRESS 0x3FD214 /end MEASUREMENT
/begin MEASUREMENT te_obd_lam_max_b2 "Maximalwert Lambda bei Messung" UWORD FORMULA_0025 0 0 0.0 3.9990 ECU_ADDRESS 0x3FD216 /end MEASUREMENT
/begin MEASUREMENT te_obd_lam_ok_b1 "Anzahl der Lambda OK-Erkennungen" UBYTE FORMULA_0003 0 0 0.0 255.0000 ECU_ADDRESS 0x3FD218 /end MEASUREMENT
/begin MEASUREMENT te_obd_lam_ok_b2 "Anzahl der Lambda OK-Erkennungen" UBYTE FORMULA_0003 0 0 0.0 255.0000 ECU_ADDRESS 0x3FD219 /end MEASUREMENT
/begin MEASUREMENT te_obd_ll_cnt "Anzahl der LL Durchlaeufe" UBYTE FORMULA_0003 0 0 0.0 255.0000 ECU_ADDRESS 0x3FD21A /end MEASUREMENT
/begin MEASUREMENT te_obd_ll_delta "ml/n-Reaktion auf TEV-Aktion" SWORD FORMULA_0022 0 0 -50.0000 50.0000 ECU_ADDRESS 0x3FD21C /end MEASUREMENT
/begin MEASUREMENT te_obd_ll_ok "Anzahl der ml/n OK-Erkennungen" UBYTE FORMULA_0003 0 0 0.0 255.0000 ECU_ADDRESS 0x3FD21E /end MEASUREMENT
/begin MEASUREMENT te_obd_lrw_start "CAN: Lenkradwinkel" SWORD FORMULA_0141 0 0 -1440.1536 1440.1096 ECU_ADDRESS 0x3FD220 /end MEASUREMENT
/begin MEASUREMENT te_obd_md_gen_start "Generatormoment bei Messbeginn" SWORD FORMULA_0121 0 0 -3276.8000 3276.7000 ECU_ADDRESS 0x3FD222 /end MEASUREMENT
/begin MEASUREMENT te_obd_ml_alt "Wert vor te_tv-Veraenderung" SWORD FORMULA_0112 0 0 -100.0000 1400.0000 ECU_ADDRESS 0x3FD224 /end MEASUREMENT
/begin MEASUREMENT te_obd_ml_filt "gefilterte hfm_ml_roh" SWORD FORMULA_1154 0 0 0.0 50.0000 ECU_ADDRESS 0x3FD226 /end MEASUREMENT
/begin MEASUREMENT te_obd_n_alt "Wert vor te_tv-Veraenderung" SWORD FORMULA_0006 0 0 0.0 10000.0000 ECU_ADDRESS 0x3FD228 /end MEASUREMENT
/begin MEASUREMENT te_obd_n_soll "Leerlaufdrehzahl" SWORD FORMULA_0006 0 0 0.0 10000.0000 ECU_ADDRESS 0x3FD22A /end MEASUREMENT
/begin MEASUREMENT te_obd_result_b1 "Ergebnis TEV Funktions-Check" UBYTE FORMULA_1155 0 0 0.0 255.0 ECU_ADDRESS 0x3FD22C /end MEASUREMENT
/begin MEASUREMENT te_obd_result_b2 "Ergebnis TEV Funktions-Check" UBYTE FORMULA_1155 0 0 0.0 255.0 ECU_ADDRESS 0x3FD22D /end MEASUREMENT
/begin MEASUREMENT te_obd_st "Zustand TEV OBD Funktions-Check" UBYTE FORMULA_1156 0 0 0.0 255.0 ECU_ADDRESS 0x3FD22E /end MEASUREMENT
/begin MEASUREMENT te_obd_t_dly "Restzeit im LL bis Messbeginn" UBYTE FORMULA_0458 0 0 0.0 25.5000 ECU_ADDRESS 0x3FD22F /end MEASUREMENT
/begin MEASUREMENT te_obd_t_lam_reg_off "verbleibende Lam-Reg Sperrzeit" UBYTE FORMULA_0458 0 0 0.0 25.5000 ECU_ADDRESS 0x3FD230 /end MEASUREMENT
/begin MEASUREMENT te_obd_t_mess "Rest-Messzeit bei te_tv Endwert" UBYTE FORMULA_0458 0 0 0.0 25.5000 ECU_ADDRESS 0x3FD231 /end MEASUREMENT
/begin MEASUREMENT te_obd_tv_b1 "Tastverhaeltnis vom Funktions-Check" UWORD FORMULA_0001 0 0 0.0 100.0000 ECU_ADDRESS 0x3FD232 /end MEASUREMENT
/begin MEASUREMENT te_obd_tv_b2 "Tastverhaeltnis vom Funktions-Check" UWORD FORMULA_0001 0 0 0.0 100.0000 ECU_ADDRESS 0x3FD234 /end MEASUREMENT
/begin MEASUREMENT te_obd_tz_start "Mittl. Zuendwinkel bei Mess-Beginn" SWORD FORMULA_0111 0 0 -50.0000 60.0000 ECU_ADDRESS 0x3FD236 /end MEASUREMENT
/begin MEASUREMENT te_obd_ub_start "Ub bei Mess-Beginn" SWORD FORMULA_0008 0 0 0.0 28.0000 ECU_ADDRESS 0x3FD238 /end MEASUREMENT
/* ------------------ Abschnitt erzeugt aus tksm.dat ------------------ */
/begin CHARACTERISTIC K_TKSM_CFG "Definition der Quelle von tksm" VALUE 0x78154 TKW_VV_VV_UB 100.0 FORMULA_1189 0.0 255.0 /end CHARACTERISTIC
/begin CHARACTERISTIC K_TKSM_MR_TAU "Filterkonstante fuer Motorraumtemperatur | EN: Filter constant for engine-bay temperature [s]" VALUE 0x78156 TKW_VV_VV_UW 100.0 FORMULA_1059 0.1000 6553.5000 FORMAT "%5.2" /end CHARACTERISTIC
/begin CHARACTERISTIC KL_TKSM_Q_MOT_TAU "Kraftstoffverbrauch zu tau | EN: Fuel consumption to time constant" CURVE 0x78158 TKL_SW_VV_UW 100.0 FORMULA_1059 0.1000 6553.5000
 /begin AXIS_DESCR STD_AXIS kva_q_mot FORMULA_0746 6 0.0 256.0000 FORMAT "%4.1" /end AXIS_DESCR
 FORMAT "%5.2" /end CHARACTERISTIC
/begin CHARACTERISTIC KL_TKSM_Q_MOT_RATIO "Faktor Kraftstoffverbrauch fuer TKSM-Modell | EN: Fuel consumption factor for fuel-temperature model" CURVE 0x78172 TKL_SW_VV_UW 100.0 FORMULA_0295 0.0 2.0000
 /begin AXIS_DESCR STD_AXIS kva_q_mot FORMULA_0746 6 0.0 256.0000 FORMAT "%4.1" /end AXIS_DESCR
 FORMAT "%7.4" /end CHARACTERISTIC
/begin CHARACTERISTIC KL_TKSM_ABREG "Abregung ueber Zeit | EN: Ramp-down over time" CURVE 0x7818C TKL_UW_VV_UW 100.0 FORMULA_0295 0.0 2.0000
 /begin AXIS_DESCR STD_AXIS time_ms FORMULA_0600 6 0.0 1092.2500 FORMAT "%5.2" /end AXIS_DESCR
 FORMAT "%7.4" /end CHARACTERISTIC
/begin CHARACTERISTIC KL_TKSM_MR_ABREG "Abregung ueber Temperatur Motorraum | EN: Ramp-down over engine-bay temperature" CURVE 0x781A6 TKL_UW_VV_UW 100.0 FORMULA_0295 0.0 2.0000
 /begin AXIS_DESCR STD_AXIS time_ms FORMULA_0600 6 0.0 1092.2500 FORMAT "%5.2" /end AXIS_DESCR
 FORMAT "%7.4" /end CHARACTERISTIC
/begin CHARACTERISTIC KL_TKSM_MR_TUMG_KAL "Wichtung von Differenz tm - tumg | EN: Weighting of difference tm - tumg" CURVE 0x781C0 TKL_SW_VV_UW 100.0 FORMULA_0295 0.0 2.0000
 /begin AXIS_DESCR STD_AXIS tumg FORMULA_0023 6 -50.0000 170.0000 FORMAT "%4.1" /end AXIS_DESCR
 FORMAT "%7.4" /end CHARACTERISTIC
/begin MEASUREMENT tksm_mr "Temperatur Motorraum TKSM-Modell" SWORD FORMULA_0023 0 0 -50.0000 170.0000 ECU_ADDRESS 0x3FD454 /end MEASUREMENT
/begin MEASUREMENT tksm_mr_tumg_delta "Temperaturdifferenz Motorraum zu Umgebung" SWORD FORMULA_0023 0 0 -50.0000 170.0000 ECU_ADDRESS 0x3FD456 /end MEASUREMENT
/begin MEASUREMENT tksm_raw "Kraftstofftemperatur Modell ungefiltert" SWORD FORMULA_0023 0 0 -50.0000 170.0000 ECU_ADDRESS 0x3FD458 /end MEASUREMENT
/begin MEASUREMENT tksm_loc "Lokale Kraftstofftemperatur Modell gefiltert" SWORD FORMULA_0023 0 0 -50.0000 170.0000 ECU_ADDRESS 0x3FD45A /end MEASUREMENT
/begin MEASUREMENT tksm "Kraftstofftemperatur vom Modell" SWORD FORMULA_0023 0 0 -50.0000 170.0000 ECU_ADDRESS 0x3FD45C /end MEASUREMENT
/begin MEASUREMENT tksm_q_mot_tau "Temperatur tau TKSM-Modell" UWORD FORMULA_1059 0 0 0.1000 6553.5000 ECU_ADDRESS 0x3FD45E /end MEASUREMENT
/begin MEASUREMENT tksm_q_mot_ratio "Faktor Kraftstoffverbrauch fuer TKSM-Modell" UWORD FORMULA_0295 0 0 0.0 2.0000 ECU_ADDRESS 0x3FD460 /end MEASUREMENT
/begin MEASUREMENT tksm_mr_tumg_kal "Wichtung von Differenz tm - tumg" UWORD FORMULA_0295 0 0 0.0 2.0000 ECU_ADDRESS 0x3FD462 /end MEASUREMENT
/begin MEASUREMENT tksm_mr_abreg "Abregung ueber Temperatur Motorraum" UWORD FORMULA_0295 0 0 0.0 2.0000 ECU_ADDRESS 0x3FD464 /end MEASUREMENT
/begin MEASUREMENT tksm_abreg "Abregung ueber Zeit" UWORD FORMULA_0295 0 0 0.0 2.0000 ECU_ADDRESS 0x3FD466 /end MEASUREMENT
/begin MEASUREMENT tksm_st "Status Modell Kraftstofftemperatur" UBYTE FORMULA_1129 0 0 0.0 2.0 ECU_ADDRESS 0x3FD468 /end MEASUREMENT
/begin MEASUREMENT tksm_mr_stat "Motorraumtemperatur Zielwert" SWORD FORMULA_0023 0 0 -50.0000 170.0000 ECU_ADDRESS 0x3FD46A /end MEASUREMENT
/begin MEASUREMENT tksm_mr_off "Offset Motorraumtemperatur bei Start" SWORD FORMULA_0076 0 0 -1000.0000 1000.0000 ECU_ADDRESS 0x3FD46C /end MEASUREMENT
/* ------------------ Abschnitt erzeugt aus tpu_code_inj.dat ------------------ */
/begin MEASUREMENT tpu_a_pram_1of16_1of8_ "Parameter RAM." UWORD FORMULA_0010 0 0 0.0 65535.0000 ECU_ADDRESS 0x304100 /end MEASUREMENT
/begin MEASUREMENT tpu_a_pram_1of16_2of8_ "Parameter RAM." UWORD FORMULA_0010 0 0 0.0 65535.0000 ECU_ADDRESS 0x304102 /end MEASUREMENT
/begin MEASUREMENT tpu_a_pram_1of16_3of8_ "Parameter RAM." UWORD FORMULA_0010 0 0 0.0 65535.0000 ECU_ADDRESS 0x304104 /end MEASUREMENT
/begin MEASUREMENT tpu_a_pram_1of16_4of8_ "Parameter RAM." UWORD FORMULA_0010 0 0 0.0 65535.0000 ECU_ADDRESS 0x304106 /end MEASUREMENT
/begin MEASUREMENT tpu_a_pram_1of16_5of8_ "Parameter RAM." UWORD FORMULA_0010 0 0 0.0 65535.0000 ECU_ADDRESS 0x304108 /end MEASUREMENT
/begin MEASUREMENT tpu_a_pram_1of16_6of8_ "Parameter RAM." UWORD FORMULA_0010 0 0 0.0 65535.0000 ECU_ADDRESS 0x30410A /end MEASUREMENT
/begin MEASUREMENT tpu_a_pram_1of16_7of8_ "Parameter RAM." UWORD FORMULA_0010 0 0 0.0 65535.0000 ECU_ADDRESS 0x30410C /end MEASUREMENT
/begin MEASUREMENT tpu_a_pram_1of16_8of8_ "Parameter RAM." UWORD FORMULA_0010 0 0 0.0 65535.0000 ECU_ADDRESS 0x30410E /end MEASUREMENT
/begin MEASUREMENT tpu_a_pram_2of16_1of8_ "Parameter RAM." UWORD FORMULA_0010 0 0 0.0 65535.0000 ECU_ADDRESS 0x304110 /end MEASUREMENT
/begin MEASUREMENT tpu_a_pram_2of16_2of8_ "Parameter RAM." UWORD FORMULA_0010 0 0 0.0 65535.0000 ECU_ADDRESS 0x304112 /end MEASUREMENT
/begin MEASUREMENT tpu_a_pram_2of16_3of8_ "Parameter RAM." UWORD FORMULA_0010 0 0 0.0 65535.0000 ECU_ADDRESS 0x304114 /end MEASUREMENT
/begin MEASUREMENT tpu_a_pram_2of16_4of8_ "Parameter RAM." UWORD FORMULA_0010 0 0 0.0 65535.0000 ECU_ADDRESS 0x304116 /end MEASUREMENT
/begin MEASUREMENT tpu_a_pram_2of16_5of8_ "Parameter RAM." UWORD FORMULA_0010 0 0 0.0 65535.0000 ECU_ADDRESS 0x304118 /end MEASUREMENT
/begin MEASUREMENT tpu_a_pram_2of16_6of8_ "Parameter RAM." UWORD FORMULA_0010 0 0 0.0 65535.0000 ECU_ADDRESS 0x30411A /end MEASUREMENT
/begin MEASUREMENT tpu_a_pram_2of16_7of8_ "Parameter RAM." UWORD FORMULA_0010 0 0 0.0 65535.0000 ECU_ADDRESS 0x30411C /end MEASUREMENT
/begin MEASUREMENT tpu_a_pram_2of16_8of8_ "Parameter RAM." UWORD FORMULA_0010 0 0 0.0 65535.0000 ECU_ADDRESS 0x30411E /end MEASUREMENT
/begin MEASUREMENT tpu_a_pram_3of16_1of8_ "Parameter RAM." UWORD FORMULA_0010 0 0 0.0 65535.0000 ECU_ADDRESS 0x304120 /end MEASUREMENT
/begin MEASUREMENT tpu_a_pram_3of16_2of8_ "Parameter RAM." UWORD FORMULA_0010 0 0 0.0 65535.0000 ECU_ADDRESS 0x304122 /end MEASUREMENT
/begin MEASUREMENT tpu_a_pram_3of16_3of8_ "Parameter RAM." UWORD FORMULA_0010 0 0 0.0 65535.0000 ECU_ADDRESS 0x304124 /end MEASUREMENT
/begin MEASUREMENT tpu_a_pram_3of16_4of8_ "Parameter RAM." UWORD FORMULA_0010 0 0 0.0 65535.0000 ECU_ADDRESS 0x304126 /end MEASUREMENT
/begin MEASUREMENT tpu_a_pram_3of16_5of8_ "Parameter RAM." UWORD FORMULA_0010 0 0 0.0 65535.0000 ECU_ADDRESS 0x304128 /end MEASUREMENT
/begin MEASUREMENT tpu_a_pram_3of16_6of8_ "Parameter RAM." UWORD FORMULA_0010 0 0 0.0 65535.0000 ECU_ADDRESS 0x30412A /end MEASUREMENT
/begin MEASUREMENT tpu_a_pram_3of16_7of8_ "Parameter RAM." UWORD FORMULA_0010 0 0 0.0 65535.0000 ECU_ADDRESS 0x30412C /end MEASUREMENT
/begin MEASUREMENT tpu_a_pram_3of16_8of8_ "Parameter RAM." UWORD FORMULA_0010 0 0 0.0 65535.0000 ECU_ADDRESS 0x30412E /end MEASUREMENT
/begin MEASUREMENT tpu_a_pram_4of16_1of8_ "Parameter RAM." UWORD FORMULA_0010 0 0 0.0 65535.0000 ECU_ADDRESS 0x304130 /end MEASUREMENT
/begin MEASUREMENT tpu_a_pram_4of16_2of8_ "Parameter RAM." UWORD FORMULA_0010 0 0 0.0 65535.0000 ECU_ADDRESS 0x304132 /end MEASUREMENT
/begin MEASUREMENT tpu_a_pram_4of16_3of8_ "Parameter RAM." UWORD FORMULA_0010 0 0 0.0 65535.0000 ECU_ADDRESS 0x304134 /end MEASUREMENT
/begin MEASUREMENT tpu_a_pram_4of16_4of8_ "Parameter RAM." UWORD FORMULA_0010 0 0 0.0 65535.0000 ECU_ADDRESS 0x304136 /end MEASUREMENT
/begin MEASUREMENT tpu_a_pram_4of16_5of8_ "Parameter RAM." UWORD FORMULA_0010 0 0 0.0 65535.0000 ECU_ADDRESS 0x304138 /end MEASUREMENT
/begin MEASUREMENT tpu_a_pram_4of16_6of8_ "Parameter RAM." UWORD FORMULA_0010 0 0 0.0 65535.0000 ECU_ADDRESS 0x30413A /end MEASUREMENT
/begin MEASUREMENT tpu_a_pram_4of16_7of8_ "Parameter RAM." UWORD FORMULA_0010 0 0 0.0 65535.0000 ECU_ADDRESS 0x30413C /end MEASUREMENT
/begin MEASUREMENT tpu_a_pram_4of16_8of8_ "Parameter RAM." UWORD FORMULA_0010 0 0 0.0 65535.0000 ECU_ADDRESS 0x30413E /end MEASUREMENT
/begin MEASUREMENT tpu_a_pram_5of16_1of8_ "Parameter RAM." UWORD FORMULA_0010 0 0 0.0 65535.0000 ECU_ADDRESS 0x304140 /end MEASUREMENT
/begin MEASUREMENT tpu_a_pram_5of16_2of8_ "Parameter RAM." UWORD FORMULA_0010 0 0 0.0 65535.0000 ECU_ADDRESS 0x304142 /end MEASUREMENT
/begin MEASUREMENT tpu_a_pram_5of16_3of8_ "Parameter RAM." UWORD FORMULA_0010 0 0 0.0 65535.0000 ECU_ADDRESS 0x304144 /end MEASUREMENT
/begin MEASUREMENT tpu_a_pram_5of16_4of8_ "Parameter RAM." UWORD FORMULA_0010 0 0 0.0 65535.0000 ECU_ADDRESS 0x304146 /end MEASUREMENT
/begin MEASUREMENT tpu_a_pram_5of16_5of8_ "Parameter RAM." UWORD FORMULA_0010 0 0 0.0 65535.0000 ECU_ADDRESS 0x304148 /end MEASUREMENT
/begin MEASUREMENT tpu_a_pram_5of16_6of8_ "Parameter RAM." UWORD FORMULA_0010 0 0 0.0 65535.0000 ECU_ADDRESS 0x30414A /end MEASUREMENT
/begin MEASUREMENT tpu_a_pram_5of16_7of8_ "Parameter RAM." UWORD FORMULA_0010 0 0 0.0 65535.0000 ECU_ADDRESS 0x30414C /end MEASUREMENT
/begin MEASUREMENT tpu_a_pram_5of16_8of8_ "Parameter RAM." UWORD FORMULA_0010 0 0 0.0 65535.0000 ECU_ADDRESS 0x30414E /end MEASUREMENT
/begin MEASUREMENT tpu_a_pram_6of16_1of8_ "Parameter RAM." UWORD FORMULA_0010 0 0 0.0 65535.0000 ECU_ADDRESS 0x304150 /end MEASUREMENT
/begin MEASUREMENT tpu_a_pram_6of16_2of8_ "Parameter RAM." UWORD FORMULA_0010 0 0 0.0 65535.0000 ECU_ADDRESS 0x304152 /end MEASUREMENT
/begin MEASUREMENT tpu_a_pram_6of16_3of8_ "Parameter RAM." UWORD FORMULA_0010 0 0 0.0 65535.0000 ECU_ADDRESS 0x304154 /end MEASUREMENT
/begin MEASUREMENT tpu_a_pram_6of16_4of8_ "Parameter RAM." UWORD FORMULA_0010 0 0 0.0 65535.0000 ECU_ADDRESS 0x304156 /end MEASUREMENT
/begin MEASUREMENT tpu_a_pram_6of16_5of8_ "Parameter RAM." UWORD FORMULA_0010 0 0 0.0 65535.0000 ECU_ADDRESS 0x304158 /end MEASUREMENT
/begin MEASUREMENT tpu_a_pram_6of16_6of8_ "Parameter RAM." UWORD FORMULA_0010 0 0 0.0 65535.0000 ECU_ADDRESS 0x30415A /end MEASUREMENT
/begin MEASUREMENT tpu_a_pram_6of16_7of8_ "Parameter RAM." UWORD FORMULA_0010 0 0 0.0 65535.0000 ECU_ADDRESS 0x30415C /end MEASUREMENT
/begin MEASUREMENT tpu_a_pram_6of16_8of8_ "Parameter RAM." UWORD FORMULA_0010 0 0 0.0 65535.0000 ECU_ADDRESS 0x30415E /end MEASUREMENT
/begin MEASUREMENT tpu_a_pram_7of16_1of8_ "Parameter RAM." UWORD FORMULA_0010 0 0 0.0 65535.0000 ECU_ADDRESS 0x304160 /end MEASUREMENT
/begin MEASUREMENT tpu_a_pram_7of16_2of8_ "Parameter RAM." UWORD FORMULA_0010 0 0 0.0 65535.0000 ECU_ADDRESS 0x304162 /end MEASUREMENT
/begin MEASUREMENT tpu_a_pram_7of16_3of8_ "Parameter RAM." UWORD FORMULA_0010 0 0 0.0 65535.0000 ECU_ADDRESS 0x304164 /end MEASUREMENT
/begin MEASUREMENT tpu_a_pram_7of16_4of8_ "Parameter RAM." UWORD FORMULA_0010 0 0 0.0 65535.0000 ECU_ADDRESS 0x304166 /end MEASUREMENT
/begin MEASUREMENT tpu_a_pram_7of16_5of8_ "Parameter RAM." UWORD FORMULA_0010 0 0 0.0 65535.0000 ECU_ADDRESS 0x304168 /end MEASUREMENT
/begin MEASUREMENT tpu_a_pram_7of16_6of8_ "Parameter RAM." UWORD FORMULA_0010 0 0 0.0 65535.0000 ECU_ADDRESS 0x30416A /end MEASUREMENT
/begin MEASUREMENT tpu_a_pram_7of16_7of8_ "Parameter RAM." UWORD FORMULA_0010 0 0 0.0 65535.0000 ECU_ADDRESS 0x30416C /end MEASUREMENT
/begin MEASUREMENT tpu_a_pram_7of16_8of8_ "Parameter RAM." UWORD FORMULA_0010 0 0 0.0 65535.0000 ECU_ADDRESS 0x30416E /end MEASUREMENT
/begin MEASUREMENT tpu_a_pram_8of16_1of8_ "Parameter RAM." UWORD FORMULA_0010 0 0 0.0 65535.0000 ECU_ADDRESS 0x304170 /end MEASUREMENT
/begin MEASUREMENT tpu_a_pram_8of16_2of8_ "Parameter RAM." UWORD FORMULA_0010 0 0 0.0 65535.0000 ECU_ADDRESS 0x304172 /end MEASUREMENT
/begin MEASUREMENT tpu_a_pram_8of16_3of8_ "Parameter RAM." UWORD FORMULA_0010 0 0 0.0 65535.0000 ECU_ADDRESS 0x304174 /end MEASUREMENT
/begin MEASUREMENT tpu_a_pram_8of16_4of8_ "Parameter RAM." UWORD FORMULA_0010 0 0 0.0 65535.0000 ECU_ADDRESS 0x304176 /end MEASUREMENT
/begin MEASUREMENT tpu_a_pram_8of16_5of8_ "Parameter RAM." UWORD FORMULA_0010 0 0 0.0 65535.0000 ECU_ADDRESS 0x304178 /end MEASUREMENT
/begin MEASUREMENT tpu_a_pram_8of16_6of8_ "Parameter RAM." UWORD FORMULA_0010 0 0 0.0 65535.0000 ECU_ADDRESS 0x30417A /end MEASUREMENT
/begin MEASUREMENT tpu_a_pram_8of16_7of8_ "Parameter RAM." UWORD FORMULA_0010 0 0 0.0 65535.0000 ECU_ADDRESS 0x30417C /end MEASUREMENT
/begin MEASUREMENT tpu_a_pram_8of16_8of8_ "Parameter RAM." UWORD FORMULA_0010 0 0 0.0 65535.0000 ECU_ADDRESS 0x30417E /end MEASUREMENT
/begin MEASUREMENT tpu_a_pram_9of16_1of8_ "Parameter RAM." UWORD FORMULA_0010 0 0 0.0 65535.0000 ECU_ADDRESS 0x304180 /end MEASUREMENT
/begin MEASUREMENT tpu_a_pram_9of16_2of8_ "Parameter RAM." UWORD FORMULA_0010 0 0 0.0 65535.0000 ECU_ADDRESS 0x304182 /end MEASUREMENT
/begin MEASUREMENT tpu_a_pram_9of16_3of8_ "Parameter RAM." UWORD FORMULA_0010 0 0 0.0 65535.0000 ECU_ADDRESS 0x304184 /end MEASUREMENT
/begin MEASUREMENT tpu_a_pram_9of16_4of8_ "Parameter RAM." UWORD FORMULA_0010 0 0 0.0 65535.0000 ECU_ADDRESS 0x304186 /end MEASUREMENT
/begin MEASUREMENT tpu_a_pram_9of16_5of8_ "Parameter RAM." UWORD FORMULA_0010 0 0 0.0 65535.0000 ECU_ADDRESS 0x304188 /end MEASUREMENT
/begin MEASUREMENT tpu_a_pram_9of16_6of8_ "Parameter RAM." UWORD FORMULA_0010 0 0 0.0 65535.0000 ECU_ADDRESS 0x30418A /end MEASUREMENT
/begin MEASUREMENT tpu_a_pram_9of16_7of8_ "Parameter RAM." UWORD FORMULA_0010 0 0 0.0 65535.0000 ECU_ADDRESS 0x30418C /end MEASUREMENT
/begin MEASUREMENT tpu_a_pram_9of16_8of8_ "Parameter RAM." UWORD FORMULA_0010 0 0 0.0 65535.0000 ECU_ADDRESS 0x30418E /end MEASUREMENT
/begin MEASUREMENT tpu_a_pram_10of16_1of8_ "Parameter RAM." UWORD FORMULA_0010 0 0 0.0 65535.0000 ECU_ADDRESS 0x304190 /end MEASUREMENT
/begin MEASUREMENT tpu_a_pram_10of16_2of8_ "Parameter RAM." UWORD FORMULA_0010 0 0 0.0 65535.0000 ECU_ADDRESS 0x304192 /end MEASUREMENT
/begin MEASUREMENT tpu_a_pram_10of16_3of8_ "Parameter RAM." UWORD FORMULA_0010 0 0 0.0 65535.0000 ECU_ADDRESS 0x304194 /end MEASUREMENT
/begin MEASUREMENT tpu_a_pram_10of16_4of8_ "Parameter RAM." UWORD FORMULA_0010 0 0 0.0 65535.0000 ECU_ADDRESS 0x304196 /end MEASUREMENT
/begin MEASUREMENT tpu_a_pram_10of16_5of8_ "Parameter RAM." UWORD FORMULA_0010 0 0 0.0 65535.0000 ECU_ADDRESS 0x304198 /end MEASUREMENT
/begin MEASUREMENT tpu_a_pram_10of16_6of8_ "Parameter RAM." UWORD FORMULA_0010 0 0 0.0 65535.0000 ECU_ADDRESS 0x30419A /end MEASUREMENT
/begin MEASUREMENT tpu_a_pram_10of16_7of8_ "Parameter RAM." UWORD FORMULA_0010 0 0 0.0 65535.0000 ECU_ADDRESS 0x30419C /end MEASUREMENT
/begin MEASUREMENT tpu_a_pram_10of16_8of8_ "Parameter RAM." UWORD FORMULA_0010 0 0 0.0 65535.0000 ECU_ADDRESS 0x30419E /end MEASUREMENT
/begin MEASUREMENT tpu_a_pram_11of16_1of8_ "Parameter RAM." UWORD FORMULA_0010 0 0 0.0 65535.0000 ECU_ADDRESS 0x3041A0 /end MEASUREMENT
/begin MEASUREMENT tpu_a_pram_11of16_2of8_ "Parameter RAM." UWORD FORMULA_0010 0 0 0.0 65535.0000 ECU_ADDRESS 0x3041A2 /end MEASUREMENT
/begin MEASUREMENT tpu_a_pram_11of16_3of8_ "Parameter RAM." UWORD FORMULA_0010 0 0 0.0 65535.0000 ECU_ADDRESS 0x3041A4 /end MEASUREMENT
/begin MEASUREMENT tpu_a_pram_11of16_4of8_ "Parameter RAM." UWORD FORMULA_0010 0 0 0.0 65535.0000 ECU_ADDRESS 0x3041A6 /end MEASUREMENT
/begin MEASUREMENT tpu_a_pram_11of16_5of8_ "Parameter RAM." UWORD FORMULA_0010 0 0 0.0 65535.0000 ECU_ADDRESS 0x3041A8 /end MEASUREMENT
/begin MEASUREMENT tpu_a_pram_11of16_6of8_ "Parameter RAM." UWORD FORMULA_0010 0 0 0.0 65535.0000 ECU_ADDRESS 0x3041AA /end MEASUREMENT
/begin MEASUREMENT tpu_a_pram_11of16_7of8_ "Parameter RAM." UWORD FORMULA_0010 0 0 0.0 65535.0000 ECU_ADDRESS 0x3041AC /end MEASUREMENT
/begin MEASUREMENT tpu_a_pram_11of16_8of8_ "Parameter RAM." UWORD FORMULA_0010 0 0 0.0 65535.0000 ECU_ADDRESS 0x3041AE /end MEASUREMENT
/begin MEASUREMENT tpu_a_pram_12of16_1of8_ "Parameter RAM." UWORD FORMULA_0010 0 0 0.0 65535.0000 ECU_ADDRESS 0x3041B0 /end MEASUREMENT
/begin MEASUREMENT tpu_a_pram_12of16_2of8_ "Parameter RAM." UWORD FORMULA_0010 0 0 0.0 65535.0000 ECU_ADDRESS 0x3041B2 /end MEASUREMENT
/begin MEASUREMENT tpu_a_pram_12of16_3of8_ "Parameter RAM." UWORD FORMULA_0010 0 0 0.0 65535.0000 ECU_ADDRESS 0x3041B4 /end MEASUREMENT
/begin MEASUREMENT tpu_a_pram_12of16_4of8_ "Parameter RAM." UWORD FORMULA_0010 0 0 0.0 65535.0000 ECU_ADDRESS 0x3041B6 /end MEASUREMENT
/begin MEASUREMENT tpu_a_pram_12of16_5of8_ "Parameter RAM." UWORD FORMULA_0010 0 0 0.0 65535.0000 ECU_ADDRESS 0x3041B8 /end MEASUREMENT
/begin MEASUREMENT tpu_a_pram_12of16_6of8_ "Parameter RAM." UWORD FORMULA_0010 0 0 0.0 65535.0000 ECU_ADDRESS 0x3041BA /end MEASUREMENT
/begin MEASUREMENT tpu_a_pram_12of16_7of8_ "Parameter RAM." UWORD FORMULA_0010 0 0 0.0 65535.0000 ECU_ADDRESS 0x3041BC /end MEASUREMENT
/begin MEASUREMENT tpu_a_pram_12of16_8of8_ "Parameter RAM." UWORD FORMULA_0010 0 0 0.0 65535.0000 ECU_ADDRESS 0x3041BE /end MEASUREMENT
/begin MEASUREMENT tpu_a_pram_13of16_1of8_ "Parameter RAM." UWORD FORMULA_0010 0 0 0.0 65535.0000 ECU_ADDRESS 0x3041C0 /end MEASUREMENT
/begin MEASUREMENT tpu_a_pram_13of16_2of8_ "Parameter RAM." UWORD FORMULA_0010 0 0 0.0 65535.0000 ECU_ADDRESS 0x3041C2 /end MEASUREMENT
/begin MEASUREMENT tpu_a_pram_13of16_3of8_ "Parameter RAM." UWORD FORMULA_0010 0 0 0.0 65535.0000 ECU_ADDRESS 0x3041C4 /end MEASUREMENT
/begin MEASUREMENT tpu_a_pram_13of16_4of8_ "Parameter RAM." UWORD FORMULA_0010 0 0 0.0 65535.0000 ECU_ADDRESS 0x3041C6 /end MEASUREMENT
/begin MEASUREMENT tpu_a_pram_13of16_5of8_ "Parameter RAM." UWORD FORMULA_0010 0 0 0.0 65535.0000 ECU_ADDRESS 0x3041C8 /end MEASUREMENT
/begin MEASUREMENT tpu_a_pram_13of16_6of8_ "Parameter RAM." UWORD FORMULA_0010 0 0 0.0 65535.0000 ECU_ADDRESS 0x3041CA /end MEASUREMENT
/begin MEASUREMENT tpu_a_pram_13of16_7of8_ "Parameter RAM." UWORD FORMULA_0010 0 0 0.0 65535.0000 ECU_ADDRESS 0x3041CC /end MEASUREMENT
/begin MEASUREMENT tpu_a_pram_13of16_8of8_ "Parameter RAM." UWORD FORMULA_0010 0 0 0.0 65535.0000 ECU_ADDRESS 0x3041CE /end MEASUREMENT
/begin MEASUREMENT tpu_a_pram_14of16_1of8_ "Parameter RAM." UWORD FORMULA_0010 0 0 0.0 65535.0000 ECU_ADDRESS 0x3041D0 /end MEASUREMENT
/begin MEASUREMENT tpu_a_pram_14of16_2of8_ "Parameter RAM." UWORD FORMULA_0010 0 0 0.0 65535.0000 ECU_ADDRESS 0x3041D2 /end MEASUREMENT
/begin MEASUREMENT tpu_a_pram_14of16_3of8_ "Parameter RAM." UWORD FORMULA_0010 0 0 0.0 65535.0000 ECU_ADDRESS 0x3041D4 /end MEASUREMENT
/begin MEASUREMENT tpu_a_pram_14of16_4of8_ "Parameter RAM." UWORD FORMULA_0010 0 0 0.0 65535.0000 ECU_ADDRESS 0x3041D6 /end MEASUREMENT
/begin MEASUREMENT tpu_a_pram_14of16_5of8_ "Parameter RAM." UWORD FORMULA_0010 0 0 0.0 65535.0000 ECU_ADDRESS 0x3041D8 /end MEASUREMENT
/begin MEASUREMENT tpu_a_pram_14of16_6of8_ "Parameter RAM." UWORD FORMULA_0010 0 0 0.0 65535.0000 ECU_ADDRESS 0x3041DA /end MEASUREMENT
/begin MEASUREMENT tpu_a_pram_14of16_7of8_ "Parameter RAM." UWORD FORMULA_0010 0 0 0.0 65535.0000 ECU_ADDRESS 0x3041DC /end MEASUREMENT
/begin MEASUREMENT tpu_a_pram_14of16_8of8_ "Parameter RAM." UWORD FORMULA_0010 0 0 0.0 65535.0000 ECU_ADDRESS 0x3041DE /end MEASUREMENT
/begin MEASUREMENT tpu_a_pram_15of16_1of8_ "Parameter RAM." UWORD FORMULA_0010 0 0 0.0 65535.0000 ECU_ADDRESS 0x3041E0 /end MEASUREMENT
/begin MEASUREMENT tpu_a_pram_15of16_2of8_ "Parameter RAM." UWORD FORMULA_0010 0 0 0.0 65535.0000 ECU_ADDRESS 0x3041E2 /end MEASUREMENT
/begin MEASUREMENT tpu_a_pram_15of16_3of8_ "Parameter RAM." UWORD FORMULA_0010 0 0 0.0 65535.0000 ECU_ADDRESS 0x3041E4 /end MEASUREMENT
/begin MEASUREMENT tpu_a_pram_15of16_4of8_ "Parameter RAM." UWORD FORMULA_0010 0 0 0.0 65535.0000 ECU_ADDRESS 0x3041E6 /end MEASUREMENT
/begin MEASUREMENT tpu_a_pram_15of16_5of8_ "Parameter RAM." UWORD FORMULA_0010 0 0 0.0 65535.0000 ECU_ADDRESS 0x3041E8 /end MEASUREMENT
/begin MEASUREMENT tpu_a_pram_15of16_6of8_ "Parameter RAM." UWORD FORMULA_0010 0 0 0.0 65535.0000 ECU_ADDRESS 0x3041EA /end MEASUREMENT
/begin MEASUREMENT tpu_a_pram_15of16_7of8_ "Parameter RAM." UWORD FORMULA_0010 0 0 0.0 65535.0000 ECU_ADDRESS 0x3041EC /end MEASUREMENT
/begin MEASUREMENT tpu_a_pram_15of16_8of8_ "Parameter RAM." UWORD FORMULA_0010 0 0 0.0 65535.0000 ECU_ADDRESS 0x3041EE /end MEASUREMENT
/begin MEASUREMENT tpu_a_pram_16of16_1of8_ "Parameter RAM." UWORD FORMULA_0010 0 0 0.0 65535.0000 ECU_ADDRESS 0x3041F0 /end MEASUREMENT
/begin MEASUREMENT tpu_a_pram_16of16_2of8_ "Parameter RAM." UWORD FORMULA_0010 0 0 0.0 65535.0000 ECU_ADDRESS 0x3041F2 /end MEASUREMENT
/begin MEASUREMENT tpu_a_pram_16of16_3of8_ "Parameter RAM." UWORD FORMULA_0010 0 0 0.0 65535.0000 ECU_ADDRESS 0x3041F4 /end MEASUREMENT
/begin MEASUREMENT tpu_a_pram_16of16_4of8_ "Parameter RAM." UWORD FORMULA_0010 0 0 0.0 65535.0000 ECU_ADDRESS 0x3041F6 /end MEASUREMENT
/begin MEASUREMENT tpu_a_pram_16of16_5of8_ "Parameter RAM." UWORD FORMULA_0010 0 0 0.0 65535.0000 ECU_ADDRESS 0x3041F8 /end MEASUREMENT
/begin MEASUREMENT tpu_a_pram_16of16_6of8_ "Parameter RAM." UWORD FORMULA_0010 0 0 0.0 65535.0000 ECU_ADDRESS 0x3041FA /end MEASUREMENT
/begin MEASUREMENT tpu_a_pram_16of16_7of8_ "Parameter RAM." UWORD FORMULA_0010 0 0 0.0 65535.0000 ECU_ADDRESS 0x3041FC /end MEASUREMENT
/begin MEASUREMENT tpu_a_pram_16of16_8of8_ "Parameter RAM." UWORD FORMULA_0010 0 0 0.0 65535.0000 ECU_ADDRESS 0x3041FE /end MEASUREMENT
/begin MEASUREMENT tpu_b_pram_1of16_1of8_ "Parameter RAM." UWORD FORMULA_0010 0 0 0.0 65535.0000 ECU_ADDRESS 0x304500 /end MEASUREMENT
/begin MEASUREMENT tpu_b_pram_1of16_2of8_ "Parameter RAM." UWORD FORMULA_0010 0 0 0.0 65535.0000 ECU_ADDRESS 0x304502 /end MEASUREMENT
/begin MEASUREMENT tpu_b_pram_1of16_3of8_ "Parameter RAM." UWORD FORMULA_0010 0 0 0.0 65535.0000 ECU_ADDRESS 0x304504 /end MEASUREMENT
/begin MEASUREMENT tpu_b_pram_1of16_4of8_ "Parameter RAM." UWORD FORMULA_0010 0 0 0.0 65535.0000 ECU_ADDRESS 0x304506 /end MEASUREMENT
/begin MEASUREMENT tpu_b_pram_1of16_5of8_ "Parameter RAM." UWORD FORMULA_0010 0 0 0.0 65535.0000 ECU_ADDRESS 0x304508 /end MEASUREMENT
/begin MEASUREMENT tpu_b_pram_1of16_6of8_ "Parameter RAM." UWORD FORMULA_0010 0 0 0.0 65535.0000 ECU_ADDRESS 0x30450A /end MEASUREMENT
/begin MEASUREMENT tpu_b_pram_1of16_7of8_ "Parameter RAM." UWORD FORMULA_0010 0 0 0.0 65535.0000 ECU_ADDRESS 0x30450C /end MEASUREMENT
/begin MEASUREMENT tpu_b_pram_1of16_8of8_ "Parameter RAM." UWORD FORMULA_0010 0 0 0.0 65535.0000 ECU_ADDRESS 0x30450E /end MEASUREMENT
/begin MEASUREMENT tpu_b_pram_2of16_1of8_ "Parameter RAM." UWORD FORMULA_0010 0 0 0.0 65535.0000 ECU_ADDRESS 0x304510 /end MEASUREMENT
/begin MEASUREMENT tpu_b_pram_2of16_2of8_ "Parameter RAM." UWORD FORMULA_0010 0 0 0.0 65535.0000 ECU_ADDRESS 0x304512 /end MEASUREMENT
/begin MEASUREMENT tpu_b_pram_2of16_3of8_ "Parameter RAM." UWORD FORMULA_0010 0 0 0.0 65535.0000 ECU_ADDRESS 0x304514 /end MEASUREMENT
/begin MEASUREMENT tpu_b_pram_2of16_4of8_ "Parameter RAM." UWORD FORMULA_0010 0 0 0.0 65535.0000 ECU_ADDRESS 0x304516 /end MEASUREMENT
/begin MEASUREMENT tpu_b_pram_2of16_5of8_ "Parameter RAM." UWORD FORMULA_0010 0 0 0.0 65535.0000 ECU_ADDRESS 0x304518 /end MEASUREMENT
/begin MEASUREMENT tpu_b_pram_2of16_6of8_ "Parameter RAM." UWORD FORMULA_0010 0 0 0.0 65535.0000 ECU_ADDRESS 0x30451A /end MEASUREMENT
/begin MEASUREMENT tpu_b_pram_2of16_7of8_ "Parameter RAM." UWORD FORMULA_0010 0 0 0.0 65535.0000 ECU_ADDRESS 0x30451C /end MEASUREMENT
/begin MEASUREMENT tpu_b_pram_2of16_8of8_ "Parameter RAM." UWORD FORMULA_0010 0 0 0.0 65535.0000 ECU_ADDRESS 0x30451E /end MEASUREMENT
/begin MEASUREMENT tpu_b_pram_3of16_1of8_ "Parameter RAM." UWORD FORMULA_0010 0 0 0.0 65535.0000 ECU_ADDRESS 0x304520 /end MEASUREMENT
/begin MEASUREMENT tpu_b_pram_3of16_2of8_ "Parameter RAM." UWORD FORMULA_0010 0 0 0.0 65535.0000 ECU_ADDRESS 0x304522 /end MEASUREMENT
/begin MEASUREMENT tpu_b_pram_3of16_3of8_ "Parameter RAM." UWORD FORMULA_0010 0 0 0.0 65535.0000 ECU_ADDRESS 0x304524 /end MEASUREMENT
/begin MEASUREMENT tpu_b_pram_3of16_4of8_ "Parameter RAM." UWORD FORMULA_0010 0 0 0.0 65535.0000 ECU_ADDRESS 0x304526 /end MEASUREMENT
/begin MEASUREMENT tpu_b_pram_3of16_5of8_ "Parameter RAM." UWORD FORMULA_0010 0 0 0.0 65535.0000 ECU_ADDRESS 0x304528 /end MEASUREMENT
/begin MEASUREMENT tpu_b_pram_3of16_6of8_ "Parameter RAM." UWORD FORMULA_0010 0 0 0.0 65535.0000 ECU_ADDRESS 0x30452A /end MEASUREMENT
/begin MEASUREMENT tpu_b_pram_3of16_7of8_ "Parameter RAM." UWORD FORMULA_0010 0 0 0.0 65535.0000 ECU_ADDRESS 0x30452C /end MEASUREMENT
/begin MEASUREMENT tpu_b_pram_3of16_8of8_ "Parameter RAM." UWORD FORMULA_0010 0 0 0.0 65535.0000 ECU_ADDRESS 0x30452E /end MEASUREMENT
/begin MEASUREMENT tpu_b_pram_4of16_1of8_ "Parameter RAM." UWORD FORMULA_0010 0 0 0.0 65535.0000 ECU_ADDRESS 0x304530 /end MEASUREMENT
/begin MEASUREMENT tpu_b_pram_4of16_2of8_ "Parameter RAM." UWORD FORMULA_0010 0 0 0.0 65535.0000 ECU_ADDRESS 0x304532 /end MEASUREMENT
/begin MEASUREMENT tpu_b_pram_4of16_3of8_ "Parameter RAM." UWORD FORMULA_0010 0 0 0.0 65535.0000 ECU_ADDRESS 0x304534 /end MEASUREMENT
/begin MEASUREMENT tpu_b_pram_4of16_4of8_ "Parameter RAM." UWORD FORMULA_0010 0 0 0.0 65535.0000 ECU_ADDRESS 0x304536 /end MEASUREMENT
/begin MEASUREMENT tpu_b_pram_4of16_5of8_ "Parameter RAM." UWORD FORMULA_0010 0 0 0.0 65535.0000 ECU_ADDRESS 0x304538 /end MEASUREMENT
/begin MEASUREMENT tpu_b_pram_4of16_6of8_ "Parameter RAM." UWORD FORMULA_0010 0 0 0.0 65535.0000 ECU_ADDRESS 0x30453A /end MEASUREMENT
/begin MEASUREMENT tpu_b_pram_4of16_7of8_ "Parameter RAM." UWORD FORMULA_0010 0 0 0.0 65535.0000 ECU_ADDRESS 0x30453C /end MEASUREMENT
/begin MEASUREMENT tpu_b_pram_4of16_8of8_ "Parameter RAM." UWORD FORMULA_0010 0 0 0.0 65535.0000 ECU_ADDRESS 0x30453E /end MEASUREMENT
/begin MEASUREMENT tpu_b_pram_5of16_1of8_ "Parameter RAM." UWORD FORMULA_0010 0 0 0.0 65535.0000 ECU_ADDRESS 0x304540 /end MEASUREMENT
/begin MEASUREMENT tpu_b_pram_5of16_2of8_ "Parameter RAM." UWORD FORMULA_0010 0 0 0.0 65535.0000 ECU_ADDRESS 0x304542 /end MEASUREMENT
/begin MEASUREMENT tpu_b_pram_5of16_3of8_ "Parameter RAM." UWORD FORMULA_0010 0 0 0.0 65535.0000 ECU_ADDRESS 0x304544 /end MEASUREMENT
/begin MEASUREMENT tpu_b_pram_5of16_4of8_ "Parameter RAM." UWORD FORMULA_0010 0 0 0.0 65535.0000 ECU_ADDRESS 0x304546 /end MEASUREMENT
/begin MEASUREMENT tpu_b_pram_5of16_5of8_ "Parameter RAM." UWORD FORMULA_0010 0 0 0.0 65535.0000 ECU_ADDRESS 0x304548 /end MEASUREMENT
/begin MEASUREMENT tpu_b_pram_5of16_6of8_ "Parameter RAM." UWORD FORMULA_0010 0 0 0.0 65535.0000 ECU_ADDRESS 0x30454A /end MEASUREMENT
/begin MEASUREMENT tpu_b_pram_5of16_7of8_ "Parameter RAM." UWORD FORMULA_0010 0 0 0.0 65535.0000 ECU_ADDRESS 0x30454C /end MEASUREMENT
/begin MEASUREMENT tpu_b_pram_5of16_8of8_ "Parameter RAM." UWORD FORMULA_0010 0 0 0.0 65535.0000 ECU_ADDRESS 0x30454E /end MEASUREMENT
/begin MEASUREMENT tpu_b_pram_6of16_1of8_ "Parameter RAM." UWORD FORMULA_0010 0 0 0.0 65535.0000 ECU_ADDRESS 0x304550 /end MEASUREMENT
/begin MEASUREMENT tpu_b_pram_6of16_2of8_ "Parameter RAM." UWORD FORMULA_0010 0 0 0.0 65535.0000 ECU_ADDRESS 0x304552 /end MEASUREMENT
/begin MEASUREMENT tpu_b_pram_6of16_3of8_ "Parameter RAM." UWORD FORMULA_0010 0 0 0.0 65535.0000 ECU_ADDRESS 0x304554 /end MEASUREMENT
/begin MEASUREMENT tpu_b_pram_6of16_4of8_ "Parameter RAM." UWORD FORMULA_0010 0 0 0.0 65535.0000 ECU_ADDRESS 0x304556 /end MEASUREMENT
/begin MEASUREMENT tpu_b_pram_6of16_5of8_ "Parameter RAM." UWORD FORMULA_0010 0 0 0.0 65535.0000 ECU_ADDRESS 0x304558 /end MEASUREMENT
/begin MEASUREMENT tpu_b_pram_6of16_6of8_ "Parameter RAM." UWORD FORMULA_0010 0 0 0.0 65535.0000 ECU_ADDRESS 0x30455A /end MEASUREMENT
/begin MEASUREMENT tpu_b_pram_6of16_7of8_ "Parameter RAM." UWORD FORMULA_0010 0 0 0.0 65535.0000 ECU_ADDRESS 0x30455C /end MEASUREMENT
/begin MEASUREMENT tpu_b_pram_6of16_8of8_ "Parameter RAM." UWORD FORMULA_0010 0 0 0.0 65535.0000 ECU_ADDRESS 0x30455E /end MEASUREMENT
/begin MEASUREMENT tpu_b_pram_7of16_1of8_ "Parameter RAM." UWORD FORMULA_0010 0 0 0.0 65535.0000 ECU_ADDRESS 0x304560 /end MEASUREMENT
/begin MEASUREMENT tpu_b_pram_7of16_2of8_ "Parameter RAM." UWORD FORMULA_0010 0 0 0.0 65535.0000 ECU_ADDRESS 0x304562 /end MEASUREMENT
/begin MEASUREMENT tpu_b_pram_7of16_3of8_ "Parameter RAM." UWORD FORMULA_0010 0 0 0.0 65535.0000 ECU_ADDRESS 0x304564 /end MEASUREMENT
/begin MEASUREMENT tpu_b_pram_7of16_4of8_ "Parameter RAM." UWORD FORMULA_0010 0 0 0.0 65535.0000 ECU_ADDRESS 0x304566 /end MEASUREMENT
/begin MEASUREMENT tpu_b_pram_7of16_5of8_ "Parameter RAM." UWORD FORMULA_0010 0 0 0.0 65535.0000 ECU_ADDRESS 0x304568 /end MEASUREMENT
/begin MEASUREMENT tpu_b_pram_7of16_6of8_ "Parameter RAM." UWORD FORMULA_0010 0 0 0.0 65535.0000 ECU_ADDRESS 0x30456A /end MEASUREMENT
/begin MEASUREMENT tpu_b_pram_7of16_7of8_ "Parameter RAM." UWORD FORMULA_0010 0 0 0.0 65535.0000 ECU_ADDRESS 0x30456C /end MEASUREMENT
/begin MEASUREMENT tpu_b_pram_7of16_8of8_ "Parameter RAM." UWORD FORMULA_0010 0 0 0.0 65535.0000 ECU_ADDRESS 0x30456E /end MEASUREMENT
/begin MEASUREMENT tpu_b_pram_8of16_1of8_ "Parameter RAM." UWORD FORMULA_0010 0 0 0.0 65535.0000 ECU_ADDRESS 0x304570 /end MEASUREMENT
/begin MEASUREMENT tpu_b_pram_8of16_2of8_ "Parameter RAM." UWORD FORMULA_0010 0 0 0.0 65535.0000 ECU_ADDRESS 0x304572 /end MEASUREMENT
/begin MEASUREMENT tpu_b_pram_8of16_3of8_ "Parameter RAM." UWORD FORMULA_0010 0 0 0.0 65535.0000 ECU_ADDRESS 0x304574 /end MEASUREMENT
/begin MEASUREMENT tpu_b_pram_8of16_4of8_ "Parameter RAM." UWORD FORMULA_0010 0 0 0.0 65535.0000 ECU_ADDRESS 0x304576 /end MEASUREMENT
/begin MEASUREMENT tpu_b_pram_8of16_5of8_ "Parameter RAM." UWORD FORMULA_0010 0 0 0.0 65535.0000 ECU_ADDRESS 0x304578 /end MEASUREMENT
/begin MEASUREMENT tpu_b_pram_8of16_6of8_ "Parameter RAM." UWORD FORMULA_0010 0 0 0.0 65535.0000 ECU_ADDRESS 0x30457A /end MEASUREMENT
/begin MEASUREMENT tpu_b_pram_8of16_7of8_ "Parameter RAM." UWORD FORMULA_0010 0 0 0.0 65535.0000 ECU_ADDRESS 0x30457C /end MEASUREMENT
/begin MEASUREMENT tpu_b_pram_8of16_8of8_ "Parameter RAM." UWORD FORMULA_0010 0 0 0.0 65535.0000 ECU_ADDRESS 0x30457E /end MEASUREMENT
/begin MEASUREMENT tpu_b_pram_9of16_1of8_ "Parameter RAM." UWORD FORMULA_0010 0 0 0.0 65535.0000 ECU_ADDRESS 0x304580 /end MEASUREMENT
/begin MEASUREMENT tpu_b_pram_9of16_2of8_ "Parameter RAM." UWORD FORMULA_0010 0 0 0.0 65535.0000 ECU_ADDRESS 0x304582 /end MEASUREMENT
/begin MEASUREMENT tpu_b_pram_9of16_3of8_ "Parameter RAM." UWORD FORMULA_0010 0 0 0.0 65535.0000 ECU_ADDRESS 0x304584 /end MEASUREMENT
/begin MEASUREMENT tpu_b_pram_9of16_4of8_ "Parameter RAM." UWORD FORMULA_0010 0 0 0.0 65535.0000 ECU_ADDRESS 0x304586 /end MEASUREMENT
/begin MEASUREMENT tpu_b_pram_9of16_5of8_ "Parameter RAM." UWORD FORMULA_0010 0 0 0.0 65535.0000 ECU_ADDRESS 0x304588 /end MEASUREMENT
/begin MEASUREMENT tpu_b_pram_9of16_6of8_ "Parameter RAM." UWORD FORMULA_0010 0 0 0.0 65535.0000 ECU_ADDRESS 0x30458A /end MEASUREMENT
/begin MEASUREMENT tpu_b_pram_9of16_7of8_ "Parameter RAM." UWORD FORMULA_0010 0 0 0.0 65535.0000 ECU_ADDRESS 0x30458C /end MEASUREMENT
/begin MEASUREMENT tpu_b_pram_9of16_8of8_ "Parameter RAM." UWORD FORMULA_0010 0 0 0.0 65535.0000 ECU_ADDRESS 0x30458E /end MEASUREMENT
/begin MEASUREMENT tpu_b_pram_10of16_1of8_ "Parameter RAM." UWORD FORMULA_0010 0 0 0.0 65535.0000 ECU_ADDRESS 0x304590 /end MEASUREMENT
/begin MEASUREMENT tpu_b_pram_10of16_2of8_ "Parameter RAM." UWORD FORMULA_0010 0 0 0.0 65535.0000 ECU_ADDRESS 0x304592 /end MEASUREMENT
/begin MEASUREMENT tpu_b_pram_10of16_3of8_ "Parameter RAM." UWORD FORMULA_0010 0 0 0.0 65535.0000 ECU_ADDRESS 0x304594 /end MEASUREMENT
/begin MEASUREMENT tpu_b_pram_10of16_4of8_ "Parameter RAM." UWORD FORMULA_0010 0 0 0.0 65535.0000 ECU_ADDRESS 0x304596 /end MEASUREMENT
/begin MEASUREMENT tpu_b_pram_10of16_5of8_ "Parameter RAM." UWORD FORMULA_0010 0 0 0.0 65535.0000 ECU_ADDRESS 0x304598 /end MEASUREMENT
/begin MEASUREMENT tpu_b_pram_10of16_6of8_ "Parameter RAM." UWORD FORMULA_0010 0 0 0.0 65535.0000 ECU_ADDRESS 0x30459A /end MEASUREMENT
/begin MEASUREMENT tpu_b_pram_10of16_7of8_ "Parameter RAM." UWORD FORMULA_0010 0 0 0.0 65535.0000 ECU_ADDRESS 0x30459C /end MEASUREMENT
/begin MEASUREMENT tpu_b_pram_10of16_8of8_ "Parameter RAM." UWORD FORMULA_0010 0 0 0.0 65535.0000 ECU_ADDRESS 0x30459E /end MEASUREMENT
/begin MEASUREMENT tpu_b_pram_11of16_1of8_ "Parameter RAM." UWORD FORMULA_0010 0 0 0.0 65535.0000 ECU_ADDRESS 0x3045A0 /end MEASUREMENT
/begin MEASUREMENT tpu_b_pram_11of16_2of8_ "Parameter RAM." UWORD FORMULA_0010 0 0 0.0 65535.0000 ECU_ADDRESS 0x3045A2 /end MEASUREMENT
/begin MEASUREMENT tpu_b_pram_11of16_3of8_ "Parameter RAM." UWORD FORMULA_0010 0 0 0.0 65535.0000 ECU_ADDRESS 0x3045A4 /end MEASUREMENT
/begin MEASUREMENT tpu_b_pram_11of16_4of8_ "Parameter RAM." UWORD FORMULA_0010 0 0 0.0 65535.0000 ECU_ADDRESS 0x3045A6 /end MEASUREMENT
/begin MEASUREMENT tpu_b_pram_11of16_5of8_ "Parameter RAM." UWORD FORMULA_0010 0 0 0.0 65535.0000 ECU_ADDRESS 0x3045A8 /end MEASUREMENT
/begin MEASUREMENT tpu_b_pram_11of16_6of8_ "Parameter RAM." UWORD FORMULA_0010 0 0 0.0 65535.0000 ECU_ADDRESS 0x3045AA /end MEASUREMENT
/begin MEASUREMENT tpu_b_pram_11of16_7of8_ "Parameter RAM." UWORD FORMULA_0010 0 0 0.0 65535.0000 ECU_ADDRESS 0x3045AC /end MEASUREMENT
/begin MEASUREMENT tpu_b_pram_11of16_8of8_ "Parameter RAM." UWORD FORMULA_0010 0 0 0.0 65535.0000 ECU_ADDRESS 0x3045AE /end MEASUREMENT
/begin MEASUREMENT tpu_b_pram_12of16_1of8_ "Parameter RAM." UWORD FORMULA_0010 0 0 0.0 65535.0000 ECU_ADDRESS 0x3045B0 /end MEASUREMENT
/begin MEASUREMENT tpu_b_pram_12of16_2of8_ "Parameter RAM." UWORD FORMULA_0010 0 0 0.0 65535.0000 ECU_ADDRESS 0x3045B2 /end MEASUREMENT
/begin MEASUREMENT tpu_b_pram_12of16_3of8_ "Parameter RAM." UWORD FORMULA_0010 0 0 0.0 65535.0000 ECU_ADDRESS 0x3045B4 /end MEASUREMENT
/begin MEASUREMENT tpu_b_pram_12of16_4of8_ "Parameter RAM." UWORD FORMULA_0010 0 0 0.0 65535.0000 ECU_ADDRESS 0x3045B6 /end MEASUREMENT
/begin MEASUREMENT tpu_b_pram_12of16_5of8_ "Parameter RAM." UWORD FORMULA_0010 0 0 0.0 65535.0000 ECU_ADDRESS 0x3045B8 /end MEASUREMENT
/begin MEASUREMENT tpu_b_pram_12of16_6of8_ "Parameter RAM." UWORD FORMULA_0010 0 0 0.0 65535.0000 ECU_ADDRESS 0x3045BA /end MEASUREMENT
/begin MEASUREMENT tpu_b_pram_12of16_7of8_ "Parameter RAM." UWORD FORMULA_0010 0 0 0.0 65535.0000 ECU_ADDRESS 0x3045BC /end MEASUREMENT
/begin MEASUREMENT tpu_b_pram_12of16_8of8_ "Parameter RAM." UWORD FORMULA_0010 0 0 0.0 65535.0000 ECU_ADDRESS 0x3045BE /end MEASUREMENT
/begin MEASUREMENT tpu_b_pram_13of16_1of8_ "Parameter RAM." UWORD FORMULA_0010 0 0 0.0 65535.0000 ECU_ADDRESS 0x3045C0 /end MEASUREMENT
/begin MEASUREMENT tpu_b_pram_13of16_2of8_ "Parameter RAM." UWORD FORMULA_0010 0 0 0.0 65535.0000 ECU_ADDRESS 0x3045C2 /end MEASUREMENT
/begin MEASUREMENT tpu_b_pram_13of16_3of8_ "Parameter RAM." UWORD FORMULA_0010 0 0 0.0 65535.0000 ECU_ADDRESS 0x3045C4 /end MEASUREMENT
/begin MEASUREMENT tpu_b_pram_13of16_4of8_ "Parameter RAM." UWORD FORMULA_0010 0 0 0.0 65535.0000 ECU_ADDRESS 0x3045C6 /end MEASUREMENT
/begin MEASUREMENT tpu_b_pram_13of16_5of8_ "Parameter RAM." UWORD FORMULA_0010 0 0 0.0 65535.0000 ECU_ADDRESS 0x3045C8 /end MEASUREMENT
/begin MEASUREMENT tpu_b_pram_13of16_6of8_ "Parameter RAM." UWORD FORMULA_0010 0 0 0.0 65535.0000 ECU_ADDRESS 0x3045CA /end MEASUREMENT
/begin MEASUREMENT tpu_b_pram_13of16_7of8_ "Parameter RAM." UWORD FORMULA_0010 0 0 0.0 65535.0000 ECU_ADDRESS 0x3045CC /end MEASUREMENT
/begin MEASUREMENT tpu_b_pram_13of16_8of8_ "Parameter RAM." UWORD FORMULA_0010 0 0 0.0 65535.0000 ECU_ADDRESS 0x3045CE /end MEASUREMENT
/begin MEASUREMENT tpu_b_pram_14of16_1of8_ "Parameter RAM." UWORD FORMULA_0010 0 0 0.0 65535.0000 ECU_ADDRESS 0x3045D0 /end MEASUREMENT
/begin MEASUREMENT tpu_b_pram_14of16_2of8_ "Parameter RAM." UWORD FORMULA_0010 0 0 0.0 65535.0000 ECU_ADDRESS 0x3045D2 /end MEASUREMENT
/begin MEASUREMENT tpu_b_pram_14of16_3of8_ "Parameter RAM." UWORD FORMULA_0010 0 0 0.0 65535.0000 ECU_ADDRESS 0x3045D4 /end MEASUREMENT
/begin MEASUREMENT tpu_b_pram_14of16_4of8_ "Parameter RAM." UWORD FORMULA_0010 0 0 0.0 65535.0000 ECU_ADDRESS 0x3045D6 /end MEASUREMENT
/begin MEASUREMENT tpu_b_pram_14of16_5of8_ "Parameter RAM." UWORD FORMULA_0010 0 0 0.0 65535.0000 ECU_ADDRESS 0x3045D8 /end MEASUREMENT
/begin MEASUREMENT tpu_b_pram_14of16_6of8_ "Parameter RAM." UWORD FORMULA_0010 0 0 0.0 65535.0000 ECU_ADDRESS 0x3045DA /end MEASUREMENT
/begin MEASUREMENT tpu_b_pram_14of16_7of8_ "Parameter RAM." UWORD FORMULA_0010 0 0 0.0 65535.0000 ECU_ADDRESS 0x3045DC /end MEASUREMENT
/begin MEASUREMENT tpu_b_pram_14of16_8of8_ "Parameter RAM." UWORD FORMULA_0010 0 0 0.0 65535.0000 ECU_ADDRESS 0x3045DE /end MEASUREMENT
/begin MEASUREMENT tpu_b_pram_15of16_1of8_ "Parameter RAM." UWORD FORMULA_0010 0 0 0.0 65535.0000 ECU_ADDRESS 0x3045E0 /end MEASUREMENT
/begin MEASUREMENT tpu_b_pram_15of16_2of8_ "Parameter RAM." UWORD FORMULA_0010 0 0 0.0 65535.0000 ECU_ADDRESS 0x3045E2 /end MEASUREMENT
/begin MEASUREMENT tpu_b_pram_15of16_3of8_ "Parameter RAM." UWORD FORMULA_0010 0 0 0.0 65535.0000 ECU_ADDRESS 0x3045E4 /end MEASUREMENT
/begin MEASUREMENT tpu_b_pram_15of16_4of8_ "Parameter RAM." UWORD FORMULA_0010 0 0 0.0 65535.0000 ECU_ADDRESS 0x3045E6 /end MEASUREMENT
/begin MEASUREMENT tpu_b_pram_15of16_5of8_ "Parameter RAM." UWORD FORMULA_0010 0 0 0.0 65535.0000 ECU_ADDRESS 0x3045E8 /end MEASUREMENT
/begin MEASUREMENT tpu_b_pram_15of16_6of8_ "Parameter RAM." UWORD FORMULA_0010 0 0 0.0 65535.0000 ECU_ADDRESS 0x3045EA /end MEASUREMENT
/begin MEASUREMENT tpu_b_pram_15of16_7of8_ "Parameter RAM." UWORD FORMULA_0010 0 0 0.0 65535.0000 ECU_ADDRESS 0x3045EC /end MEASUREMENT
/begin MEASUREMENT tpu_b_pram_15of16_8of8_ "Parameter RAM." UWORD FORMULA_0010 0 0 0.0 65535.0000 ECU_ADDRESS 0x3045EE /end MEASUREMENT
/begin MEASUREMENT tpu_b_pram_16of16_1of8_ "Parameter RAM." UWORD FORMULA_0010 0 0 0.0 65535.0000 ECU_ADDRESS 0x3045F0 /end MEASUREMENT
/begin MEASUREMENT tpu_b_pram_16of16_2of8_ "Parameter RAM." UWORD FORMULA_0010 0 0 0.0 65535.0000 ECU_ADDRESS 0x3045F2 /end MEASUREMENT
/begin MEASUREMENT tpu_b_pram_16of16_3of8_ "Parameter RAM." UWORD FORMULA_0010 0 0 0.0 65535.0000 ECU_ADDRESS 0x3045F4 /end MEASUREMENT
/begin MEASUREMENT tpu_b_pram_16of16_4of8_ "Parameter RAM." UWORD FORMULA_0010 0 0 0.0 65535.0000 ECU_ADDRESS 0x3045F6 /end MEASUREMENT
/begin MEASUREMENT tpu_b_pram_16of16_5of8_ "Parameter RAM." UWORD FORMULA_0010 0 0 0.0 65535.0000 ECU_ADDRESS 0x3045F8 /end MEASUREMENT
/begin MEASUREMENT tpu_b_pram_16of16_6of8_ "Parameter RAM." UWORD FORMULA_0010 0 0 0.0 65535.0000 ECU_ADDRESS 0x3045FA /end MEASUREMENT
/begin MEASUREMENT tpu_b_pram_16of16_7of8_ "Parameter RAM." UWORD FORMULA_0010 0 0 0.0 65535.0000 ECU_ADDRESS 0x3045FC /end MEASUREMENT
/begin MEASUREMENT tpu_b_pram_16of16_8of8_ "Parameter RAM." UWORD FORMULA_0010 0 0 0.0 65535.0000 ECU_ADDRESS 0x3045FE /end MEASUREMENT
/* ------------------ Abschnitt erzeugt aus tz_diag.dat ------------------ */
/begin CHARACTERISTIC K_TZ_DIAG_MAX_BESTR "Schwelle fuer Fehlereintrag" VALUE 0x781DD TKW_VV_VV_UB 100.0 FORMULA_1190 0.0 255.0000 /end CHARACTERISTIC
/begin MEASUREMENT tz_diag_tr_ctr_zyl1 "Zaehler fuer Bestromungsueberwachung der Treiber" UBYTE FORMULA_1190 0 0 0.0 255.0000 ECU_ADDRESS 0x3FD486 /end MEASUREMENT
/begin MEASUREMENT tz_diag_tr_ctr_zyl2 "Zaehler fuer Bestromungsueberwachung der Treiber" UBYTE FORMULA_1190 0 0 0.0 255.0000 ECU_ADDRESS 0x3FD487 /end MEASUREMENT
/begin MEASUREMENT tz_diag_tr_ctr_zyl3 "Zaehler fuer Bestromungsueberwachung der Treiber" UBYTE FORMULA_1190 0 0 0.0 255.0000 ECU_ADDRESS 0x3FD488 /end MEASUREMENT
/begin MEASUREMENT tz_diag_tr_ctr_zyl4 "Zaehler fuer Bestromungsueberwachung der Treiber" UBYTE FORMULA_1190 0 0 0.0 255.0000 ECU_ADDRESS 0x3FD489 /end MEASUREMENT
/begin MEASUREMENT tz_diag_tr_ctr_zyl5 "Zaehler fuer Bestromungsueberwachung der Treiber" UBYTE FORMULA_1190 0 0 0.0 255.0000 ECU_ADDRESS 0x3FD48A /end MEASUREMENT
/begin MEASUREMENT tz_diag_tr_ctr_zyl6 "Zaehler fuer Bestromungsueberwachung der Treiber" UBYTE FORMULA_1190 0 0 0.0 255.0000 ECU_ADDRESS 0x3FD48B /end MEASUREMENT
/begin MEASUREMENT tz_diag_tr_ctr_zyl7 "Zaehler fuer Bestromungsueberwachung der Treiber" UBYTE FORMULA_1190 0 0 0.0 255.0000 ECU_ADDRESS 0x3FD48C /end MEASUREMENT
/begin MEASUREMENT tz_diag_tr_ctr_zyl8 "Zaehler fuer Bestromungsueberwachung der Treiber" UBYTE FORMULA_1190 0 0 0.0 255.0000 ECU_ADDRESS 0x3FD48D /end MEASUREMENT
/begin MEASUREMENT tz_diag_tr_ctr_zyl9 "Zaehler fuer Bestromungsueberwachung der Treiber" UBYTE FORMULA_1190 0 0 0.0 255.0000 ECU_ADDRESS 0x3FD48E /end MEASUREMENT
/begin MEASUREMENT tz_diag_tr_ctr_zyl10 "Zaehler fuer Bestromungsueberwachung der Treiber" UBYTE FORMULA_1190 0 0 0.0 255.0000 ECU_ADDRESS 0x3FD48F /end MEASUREMENT
/begin FUNCTION TE ""
 /begin DEF_CHARACTERISTIC KF_TE_ANZUGSZEIT KF_TE_GW_RAMPEN KF_TE_M_MAX_ML KF_TE_TV_NORM KF_TE_X_SOLL_KATD KF_TE_X_SOLL_MKS KF_TE_X_SOLL_NOT KF_TE_X_SOLL_N_PSAU KL_TE_FREQ KL_TE_GW_F KL_TE_GW_TI_MIN KL_TE_MKS_XSI KL_TE_ML_XSI KL_TE_SYNC_FREQ KL_TE_TI_MIN KL_TE_T_BEGIN_MIN KL_TE_YPS_SQRT K_TE_A_MIN K_TE_CFG K_TE_C_AKF_DYN_DELTA_RF K_TE_C_AKF_HYS K_TE_C_AKF_MAX K_TE_C_AKF_MAX_HYS K_TE_C_AKF_MIN K_TE_C_AKF_RESET K_TE_C_APPL K_TE_C_LERN_RED_TAU K_TE_C_LERN_TAU K_TE_C_MAX K_TE_C_MIN K_TE_C_ML_SOLL_MG_MIN K_TE_C_STAT_DELTA K_TE_C_STAT_T K_TE_C_T_SPUEL_MAX K_TE_C_T_SPUEL_MIN K_TE_C_X_MIN K_TE_DR_REL_MAX_SYNC K_TE_DYN_DELTA_RF K_TE_DYN_RF_T K_TE_GW_F_KATD K_TE_GW_LAA_FETT K_TE_GW_LAM_DELTA_FETT K_TE_GW_LAM_DELTA_HYS K_TE_GW_LAM_DELTA_MAGER K_TE_GW_LAM_REG_FETT K_TE_GW_LAM_REG_HYS K_TE_GW_LAM_REG_MAGER K_TE_LAA_F_TE_MCS K_TE_LAM_SOLL_MAX K_TE_LAM_SOLL_MIN K_TE_MKS_F_AEBG_SCHW_NEG K_TE_MKS_F_AEBG_SCHW_POS K_TE_MKS_F_MAX K_TE_MKS_F_NEG K_TE_MKS_F_POS K_TE_MKS_LAM_WICHT K_TE_MZYL_SEC_F K_TE_M_MAX_ML_CFG K_TE_N_DYN_DELTA K_TE_N_MAX_SYNC1 K_TE_RESET_CFG K_TE_RF_DYN_DELTA K_TE_R_C3H8 K_TE_R_LUFT K_TE_STOECH K_TE_TAN_MIN_LL K_TE_TI_MIN_DIFF K_TE_TMOT K_TE_TMOT_START_HS K_TE_TMOT_START_LANG K_TE_TV_MAX K_TE_TV_MIN K_TE_T_LAA K_TE_T_LAA_HS_INI K_TE_T_LAA_INI K_TE_T_LANG K_TE_T_MIN K_TE_T_ML_LANG K_TE_T_NORM K_TE_T_SPUEL_INI K_TE_VAN_DYN_DELTA K_TE_X_MKS_APPL K_TE_X_MKS_CFG K_TE_X_ML_SOLL_APPL K_TE_X_ML_SOLL_CFG K_TE_X_ML_SOLL_GW_MIN K_TE_X_ML_SOLL_MAX K_TE_X_ML_SOLL_MIN K_TE_ZU_GW K_TE_ZU_LERN K_TE_ZU_NORM K_TE_ZU_SA /end DEF_CHARACTERISTIC
 /begin REF_CHARACTERISTIC /end REF_CHARACTERISTIC
 /begin IN_MEASUREMENT /end IN_MEASUREMENT
 /begin OUT_MEASUREMENT B_TE_LAM_DELTA_BEGR_b1 B_TE_LAM_DELTA_BEGR_b2 B_TE_LAM_REG_BEGR_b1 B_TE_LAM_REG_BEGR_b2 B_TE_TI_MIN_BEGR_b1 B_TE_TI_MIN_BEGR_b2 te_begr_st_b1 te_begr_st_b2 te_c_akf te_c_akf_adapt_bank1 te_c_akf_adapt_bank2 te_c_akf_mess1 te_c_akf_mess2 te_c_akf_roh_b1 te_c_akf_roh_b2 te_c_akf_st te_c_akf_tau te_c_akf_vor_filt te_d_x_ml_soll_neg_b1 te_d_x_ml_soll_neg_b2 te_d_x_ml_soll_pos_b1 te_d_x_ml_soll_pos_b2 te_freq te_lam_delta_b1 te_lam_delta_b2 te_m_max_b1 te_m_max_b2 te_m_max_mks_b1 te_m_max_mks_b2 te_m_max_ml_b1 te_m_max_ml_b2 te_m_mks_b1 te_m_mks_b2 te_m_ml_b1 te_m_ml_b2 te_mks_aktiv_b1 te_mks_aktiv_b2 te_mks_b1 te_mks_b2 te_mks_f_b1 te_mks_f_b2 te_mks_f_ist_b1 te_mks_f_ist_b2 te_mks_ist_b1 te_mks_ist_b2 te_mks_nue_b1 te_mks_nue_b2 te_mks_xsi_b1 te_mks_xsi_b2 te_mks_yps_b1 te_mks_yps_b2 te_mks_yps_quad_b1 te_mks_yps_quad_b2 te_ml_ist_b1 te_ml_ist_b2 te_ml_min_b1 te_ml_min_b2 te_ml_nue_b1 te_ml_nue_b2 te_ml_soll_b1 te_ml_soll_b2 te_ml_soll_mg_b1 te_ml_soll_mg_b2 te_ml_xsi_b1 te_ml_xsi_b2 te_ml_yps_b1 te_ml_yps_b2 te_ml_yps_quad_b1 te_ml_yps_quad_b2 te_ml_zyl_real_b1 te_ml_zyl_real_b2 te_mzyl_diff_b1 te_mzyl_diff_b2 te_mzyl_ohne_b1 te_mzyl_ohne_b2 te_n_stat_b1 te_n_stat_b2 te_n_stat_max_b1 te_n_stat_max_b2 te_n_stat_min_b1 te_n_stat_min_b2 te_psau_diff_b1 te_psau_diff_b2 te_r_gemisch_b1 te_r_gemisch_b2 te_rf_stat_b1 te_rf_stat_b2 te_rf_stat_max_b1 te_rf_stat_max_b2 te_rf_stat_min_b1 te_rf_stat_min_b2 te_t_laa te_t_laa_ini te_t_spuel te_ti_min_diff_b1 te_ti_min_diff_b2 te_tv_norm_b1 te_tv_norm_b2 te_tv_offs te_tv_rel_b1 te_tv_rel_b2 te_tv_roh_b1 te_tv_roh_b2 te_van_vo_stat_b1 te_van_vo_stat_b2 te_van_vo_stat_max_b1 te_van_vo_stat_max_b2 te_van_vo_stat_min_b1 te_van_vo_stat_min_b2 te_ventil_exd_timeout te_vol_b1 te_vol_b2 te_vol_max_b1 te_vol_max_b2 te_vol_sum te_x_mks_b1 te_x_mks_b2 te_x_mks_betrieb_b1 te_x_mks_betrieb_b2 te_x_ml_betrieb_b1 te_x_ml_betrieb_b2 te_x_ml_gw_neg_b1 te_x_ml_gw_neg_b2 te_x_ml_gw_pos_b1 te_x_ml_gw_pos_b2 te_x_ml_max_b1 te_x_ml_max_b2 te_x_ml_min_b1 te_x_ml_min_b2 te_x_ml_n_psau_b1 te_x_ml_n_psau_b2 te_x_ml_soll_aebg_b1 te_x_ml_soll_aebg_b2 te_x_ml_soll_b1 te_x_ml_soll_b2 te_x_ml_ziel_b1 te_x_ml_ziel_b2 /end OUT_MEASUREMENT
/end FUNCTION
/begin FUNCTION TE_OBD ""
 /begin DEF_CHARACTERISTIC KL_TE_OBD_RAMPE K_TE_OBD_ANZ K_TE_OBD_AUSS_DELTA K_TE_OBD_AUSS_DELTA_NEG K_TE_OBD_AUSS_TAU K_TE_OBD_CFG K_TE_OBD_LAM_DELTA K_TE_OBD_LAM_FREIG K_TE_OBD_LAM_OK K_TE_OBD_LL_DELAY K_TE_OBD_LL_DELTA K_TE_OBD_LL_OK K_TE_OBD_LL_ZU_DELTA K_TE_OBD_LRW_ABBR K_TE_OBD_MD_GEN_ABBR K_TE_OBD_MD_KKOS_ABBR K_TE_OBD_ML_MAX K_TE_OBD_ML_TAU K_TE_OBD_N_SOLL_ABBR K_TE_OBD_RAMPE_ABBRUCH K_TE_OBD_RAMPE_ZU K_TE_OBD_TOEL_MIN K_TE_OBD_TOEL_MIN_EXD K_TE_OBD_TV_MAX K_TE_OBD_TZ_ABBR K_TE_OBD_T_LAM_REG_OFF K_TE_OBD_T_MESS_OFFEN K_TE_OBD_T_MESS_ZU K_TE_OBD_T_ML_MIN K_TE_OBD_UB_ABBR /end DEF_CHARACTERISTIC
 /begin REF_CHARACTERISTIC /end REF_CHARACTERISTIC
 /begin IN_MEASUREMENT /end IN_MEASUREMENT
 /begin OUT_MEASUREMENT te_obd_auss_delta_b1 te_obd_auss_delta_b2 te_obd_auss_filt_b1 te_obd_auss_filt_b2 te_obd_auss_ok_b1 te_obd_auss_ok_b2 te_obd_auss_start_b1 te_obd_auss_start_b2 te_obd_kkos_md_start te_obd_lam_max_b1 te_obd_lam_max_b2 te_obd_lam_min_b1 te_obd_lam_min_b2 te_obd_lam_ok_b1 te_obd_lam_ok_b2 te_obd_ll_cnt te_obd_ll_delta te_obd_ll_ok te_obd_lrw_start te_obd_md_gen_start te_obd_ml_alt te_obd_ml_filt te_obd_n_alt te_obd_n_soll te_obd_result_b1 te_obd_result_b2 te_obd_st te_obd_t_dly te_obd_t_lam_reg_off te_obd_t_mess te_obd_tv_b1 te_obd_tv_b2 te_obd_tz_start te_obd_ub_start /end OUT_MEASUREMENT
/end FUNCTION
/begin FUNCTION TKS ""
 /begin DEF_CHARACTERISTIC KL_TANZYL_ABREG KL_TANZYL_ML_GES_RATIO KL_TANZYL_ML_GES_TAU KL_TANZYL_MR_ABREG KL_TANZYL_MR_TUMG_KAL KL_TKSM_ABREG KL_TKSM_MR_ABREG KL_TKSM_MR_TUMG_KAL KL_TKSM_Q_MOT_RATIO KL_TKSM_Q_MOT_TAU K_TANZYL_CFG K_TANZYL_MR_TAU K_TKSM_CFG K_TKSM_MR_TAU /end DEF_CHARACTERISTIC
 /begin REF_CHARACTERISTIC /end REF_CHARACTERISTIC
 /begin IN_MEASUREMENT /end IN_MEASUREMENT
 /begin OUT_MEASUREMENT tanzyl tanzyl_abreg tanzyl_loc tanzyl_ml_ges_ratio tanzyl_ml_ges_tau tanzyl_mr tanzyl_mr_abreg tanzyl_mr_off tanzyl_mr_stat tanzyl_mr_tumg_delta tanzyl_mr_tumg_kal tanzyl_raw tanzyl_st tksm tksm_abreg tksm_loc tksm_mr tksm_mr_abreg tksm_mr_off tksm_mr_stat tksm_mr_tumg_delta tksm_mr_tumg_kal tksm_q_mot_ratio tksm_q_mot_tau tksm_raw tksm_st /end OUT_MEASUREMENT
/end FUNCTION
/begin FUNCTION TPU ""
 /begin DEF_CHARACTERISTIC K_NW_CONFIG K_NW_IO K_NW_IO_ASP K_NW_MFMAX_1of2_ K_NW_MFMAX_2of2_ K_NW_MFMIN_1of2_ K_NW_MFMIN_2of2_ K_NW_NIO K_NW_NIO_INC K_NW_SYNC_ION_IO K_TPU_KW_N_MIN K_TPU_KW_SYNC_ZAHN /end DEF_CHARACTERISTIC
 /begin REF_CHARACTERISTIC /end REF_CHARACTERISTIC
 /begin IN_MEASUREMENT /end IN_MEASUREMENT
 /begin OUT_MEASUREMENT tpu_a.CFSR01 tpu_a.CFSR23 tpu_a.CIER tpu_a.CISR tpu_a.CPR tpu_a.HSQR tpu_a.HSRR tpu_a.TICR tpu_a.TPUMCR tpu_a.TPUMCR2 tpu_a.TPUMCR3 tpu_a_pram_10of16_1of8_ tpu_a_pram_10of16_2of8_ tpu_a_pram_10of16_3of8_ tpu_a_pram_10of16_4of8_ tpu_a_pram_10of16_5of8_ tpu_a_pram_10of16_6of8_ tpu_a_pram_10of16_7of8_ tpu_a_pram_10of16_8of8_ tpu_a_pram_11of16_1of8_ tpu_a_pram_11of16_2of8_ tpu_a_pram_11of16_3of8_ tpu_a_pram_11of16_4of8_ tpu_a_pram_11of16_5of8_ tpu_a_pram_11of16_6of8_ tpu_a_pram_11of16_7of8_ tpu_a_pram_11of16_8of8_ tpu_a_pram_12of16_1of8_ tpu_a_pram_12of16_2of8_ tpu_a_pram_12of16_3of8_ tpu_a_pram_12of16_4of8_ tpu_a_pram_12of16_5of8_ tpu_a_pram_12of16_6of8_ tpu_a_pram_12of16_7of8_ tpu_a_pram_12of16_8of8_ tpu_a_pram_13of16_1of8_ tpu_a_pram_13of16_2of8_ tpu_a_pram_13of16_3of8_ tpu_a_pram_13of16_4of8_ tpu_a_pram_13of16_5of8_ tpu_a_pram_13of16_6of8_ tpu_a_pram_13of16_7of8_ tpu_a_pram_13of16_8of8_ tpu_a_pram_14of16_1of8_ tpu_a_pram_14of16_2of8_ tpu_a_pram_14of16_3of8_ tpu_a_pram_14of16_4of8_ tpu_a_pram_14of16_5of8_ tpu_a_pram_14of16_6of8_ tpu_a_pram_14of16_7of8_ tpu_a_pram_14of16_8of8_ tpu_a_pram_15of16_1of8_ tpu_a_pram_15of16_2of8_ tpu_a_pram_15of16_3of8_ tpu_a_pram_15of16_4of8_ tpu_a_pram_15of16_5of8_ tpu_a_pram_15of16_6of8_ tpu_a_pram_15of16_7of8_ tpu_a_pram_15of16_8of8_ tpu_a_pram_16of16_1of8_ tpu_a_pram_16of16_2of8_ tpu_a_pram_16of16_3of8_ tpu_a_pram_16of16_4of8_ tpu_a_pram_16of16_5of8_ tpu_a_pram_16of16_6of8_ tpu_a_pram_16of16_7of8_ tpu_a_pram_16of16_8of8_ tpu_a_pram_1of16_1of8_ tpu_a_pram_1of16_2of8_ tpu_a_pram_1of16_3of8_ tpu_a_pram_1of16_4of8_ tpu_a_pram_1of16_5of8_ tpu_a_pram_1of16_6of8_ tpu_a_pram_1of16_7of8_ tpu_a_pram_1of16_8of8_ tpu_a_pram_2of16_1of8_ tpu_a_pram_2of16_2of8_ tpu_a_pram_2of16_3of8_ tpu_a_pram_2of16_4of8_ tpu_a_pram_2of16_5of8_ tpu_a_pram_2of16_6of8_ tpu_a_pram_2of16_7of8_ tpu_a_pram_2of16_8of8_ tpu_a_pram_3of16_1of8_ tpu_a_pram_3of16_2of8_ tpu_a_pram_3of16_3of8_ tpu_a_pram_3of16_4of8_ tpu_a_pram_3of16_5of8_ tpu_a_pram_3of16_6of8_ tpu_a_pram_3of16_7of8_ tpu_a_pram_3of16_8of8_ tpu_a_pram_4of16_1of8_ tpu_a_pram_4of16_2of8_ tpu_a_pram_4of16_3of8_ tpu_a_pram_4of16_4of8_ tpu_a_pram_4of16_5of8_ tpu_a_pram_4of16_6of8_ tpu_a_pram_4of16_7of8_ tpu_a_pram_4of16_8of8_ tpu_a_pram_5of16_1of8_ tpu_a_pram_5of16_2of8_ tpu_a_pram_5of16_3of8_ tpu_a_pram_5of16_4of8_ tpu_a_pram_5of16_5of8_ tpu_a_pram_5of16_6of8_ tpu_a_pram_5of16_7of8_ tpu_a_pram_5of16_8of8_ tpu_a_pram_6of16_1of8_ tpu_a_pram_6of16_2of8_ tpu_a_pram_6of16_3of8_ tpu_a_pram_6of16_4of8_ tpu_a_pram_6of16_5of8_ tpu_a_pram_6of16_6of8_ tpu_a_pram_6of16_7of8_ tpu_a_pram_6of16_8of8_ tpu_a_pram_7of16_1of8_ tpu_a_pram_7of16_2of8_ tpu_a_pram_7of16_3of8_ tpu_a_pram_7of16_4of8_ tpu_a_pram_7of16_5of8_ tpu_a_pram_7of16_6of8_ tpu_a_pram_7of16_7of8_ tpu_a_pram_7of16_8of8_ tpu_a_pram_8of16_1of8_ tpu_a_pram_8of16_2of8_ tpu_a_pram_8of16_3of8_ tpu_a_pram_8of16_4of8_ tpu_a_pram_8of16_5of8_ tpu_a_pram_8of16_6of8_ tpu_a_pram_8of16_7of8_ tpu_a_pram_8of16_8of8_ tpu_a_pram_9of16_1of8_ tpu_a_pram_9of16_2of8_ tpu_a_pram_9of16_3of8_ tpu_a_pram_9of16_4of8_ tpu_a_pram_9of16_5of8_ tpu_a_pram_9of16_6of8_ tpu_a_pram_9of16_7of8_ tpu_a_pram_9of16_8of8_ tpu_b.CFSR01 tpu_b.CFSR23 tpu_b.CIER tpu_b.CISR tpu_b.CPR tpu_b.HSQR tpu_b.HSRR tpu_b.TICR tpu_b.TPUMCR tpu_b.TPUMCR2 tpu_b.TPUMCR3 tpu_b_pram_10of16_1of8_ tpu_b_pram_10of16_2of8_ tpu_b_pram_10of16_3of8_ tpu_b_pram_10of16_4of8_ tpu_b_pram_10of16_5of8_ tpu_b_pram_10of16_6of8_ tpu_b_pram_10of16_7of8_ tpu_b_pram_10of16_8of8_ tpu_b_pram_11of16_1of8_ tpu_b_pram_11of16_2of8_ tpu_b_pram_11of16_3of8_ tpu_b_pram_11of16_4of8_ tpu_b_pram_11of16_5of8_ tpu_b_pram_11of16_6of8_ tpu_b_pram_11of16_7of8_ tpu_b_pram_11of16_8of8_ tpu_b_pram_12of16_1of8_ tpu_b_pram_12of16_2of8_ tpu_b_pram_12of16_3of8_ tpu_b_pram_12of16_4of8_ tpu_b_pram_12of16_5of8_ tpu_b_pram_12of16_6of8_ tpu_b_pram_12of16_7of8_ tpu_b_pram_12of16_8of8_ tpu_b_pram_13of16_1of8_ tpu_b_pram_13of16_2of8_ tpu_b_pram_13of16_3of8_ tpu_b_pram_13of16_4of8_ tpu_b_pram_13of16_5of8_ tpu_b_pram_13of16_6of8_ tpu_b_pram_13of16_7of8_ tpu_b_pram_13of16_8of8_ tpu_b_pram_14of16_1of8_ tpu_b_pram_14of16_2of8_ tpu_b_pram_14of16_3of8_ tpu_b_pram_14of16_4of8_ tpu_b_pram_14of16_5of8_ tpu_b_pram_14of16_6of8_ tpu_b_pram_14of16_7of8_ tpu_b_pram_14of16_8of8_ tpu_b_pram_15of16_1of8_ tpu_b_pram_15of16_2of8_ tpu_b_pram_15of16_3of8_ tpu_b_pram_15of16_4of8_ tpu_b_pram_15of16_5of8_ tpu_b_pram_15of16_6of8_ tpu_b_pram_15of16_7of8_ tpu_b_pram_15of16_8of8_ tpu_b_pram_16of16_1of8_ tpu_b_pram_16of16_2of8_ tpu_b_pram_16of16_3of8_ tpu_b_pram_16of16_4of8_ tpu_b_pram_16of16_5of8_ tpu_b_pram_16of16_6of8_ tpu_b_pram_16of16_7of8_ tpu_b_pram_16of16_8of8_ tpu_b_pram_1of16_1of8_ tpu_b_pram_1of16_2of8_ tpu_b_pram_1of16_3of8_ tpu_b_pram_1of16_4of8_ tpu_b_pram_1of16_5of8_ tpu_b_pram_1of16_6of8_ tpu_b_pram_1of16_7of8_ tpu_b_pram_1of16_8of8_ tpu_b_pram_2of16_1of8_ tpu_b_pram_2of16_2of8_ tpu_b_pram_2of16_3of8_ tpu_b_pram_2of16_4of8_ tpu_b_pram_2of16_5of8_ tpu_b_pram_2of16_6of8_ tpu_b_pram_2of16_7of8_ tpu_b_pram_2of16_8of8_ tpu_b_pram_3of16_1of8_ tpu_b_pram_3of16_2of8_ tpu_b_pram_3of16_3of8_ tpu_b_pram_3of16_4of8_ tpu_b_pram_3of16_5of8_ tpu_b_pram_3of16_6of8_ tpu_b_pram_3of16_7of8_ tpu_b_pram_3of16_8of8_ tpu_b_pram_4of16_1of8_ tpu_b_pram_4of16_2of8_ tpu_b_pram_4of16_3of8_ tpu_b_pram_4of16_4of8_ tpu_b_pram_4of16_5of8_ tpu_b_pram_4of16_6of8_ tpu_b_pram_4of16_7of8_ tpu_b_pram_4of16_8of8_ tpu_b_pram_5of16_1of8_ tpu_b_pram_5of16_2of8_ tpu_b_pram_5of16_3of8_ tpu_b_pram_5of16_4of8_ tpu_b_pram_5of16_5of8_ tpu_b_pram_5of16_6of8_ tpu_b_pram_5of16_7of8_ tpu_b_pram_5of16_8of8_ tpu_b_pram_6of16_1of8_ tpu_b_pram_6of16_2of8_ tpu_b_pram_6of16_3of8_ tpu_b_pram_6of16_4of8_ tpu_b_pram_6of16_5of8_ tpu_b_pram_6of16_6of8_ tpu_b_pram_6of16_7of8_ tpu_b_pram_6of16_8of8_ tpu_b_pram_7of16_1of8_ tpu_b_pram_7of16_2of8_ tpu_b_pram_7of16_3of8_ tpu_b_pram_7of16_4of8_ tpu_b_pram_7of16_5of8_ tpu_b_pram_7of16_6of8_ tpu_b_pram_7of16_7of8_ tpu_b_pram_7of16_8of8_ tpu_b_pram_8of16_1of8_ tpu_b_pram_8of16_2of8_ tpu_b_pram_8of16_3of8_ tpu_b_pram_8of16_4of8_ tpu_b_pram_8of16_5of8_ tpu_b_pram_8of16_6of8_ tpu_b_pram_8of16_7of8_ tpu_b_pram_8of16_8of8_ tpu_b_pram_9of16_1of8_ tpu_b_pram_9of16_2of8_ tpu_b_pram_9of16_3of8_ tpu_b_pram_9of16_4of8_ tpu_b_pram_9of16_5of8_ tpu_b_pram_9of16_6of8_ tpu_b_pram_9of16_7of8_ tpu_b_pram_9of16_8of8_ tpu_bank tpu_code_status tpu_idx_a tpu_idx_b tpu_index tpu_kw_irq_a tpu_kw_irq_b tpu_kw_irq_cnt_a tpu_kw_irq_cnt_b tpu_kw_irq_error_a tpu_kw_irq_error_b tpu_kw_irq_info_a tpu_kw_irq_info_b tpu_kw_irq_mess_a tpu_kw_irq_mess_b tpu_kw_irq_n_min_a tpu_kw_irq_n_min_b tpu_kw_irq_pre_sync_a tpu_kw_irq_pre_sync_b tpu_kw_irq_segm_a tpu_kw_irq_segm_b tpu_kw_irq_segm_cnt_a tpu_kw_irq_segm_cnt_b tpu_kw_irq_sync_a tpu_kw_irq_sync_b tpu_kw_irq_tooth_a tpu_kw_irq_tooth_b tpu_kw_irq_tooth_cnt_a tpu_kw_irq_tooth_cnt_b tpu_kw_irq_zahn_a tpu_kw_irq_zahn_b tpu_kw_nw_sync_cnt_a tpu_kw_nw_sync_cnt_b tpu_kw_rot tpu_nw_pos_b1 tpu_nw_pos_b2 tpu_st_a tpu_st_b tpu_zyl tpu_zyl_bank tpu_zyl_p2 /end OUT_MEASUREMENT
/end FUNCTION
/begin FUNCTION TZ_DIAG "" /begin DEF_CHARACTERISTIC K_TZ_DIAG_MAX_BESTR /end DEF_CHARACTERISTIC /begin REF_CHARACTERISTIC /end REF_CHARACTERISTIC /begin IN_MEASUREMENT /end IN_MEASUREMENT
 /begin OUT_MEASUREMENT tz_diag_tr_ctr_zyl1 tz_diag_tr_ctr_zyl10 tz_diag_tr_ctr_zyl2 tz_diag_tr_ctr_zyl3 tz_diag_tr_ctr_zyl4 tz_diag_tr_ctr_zyl5 tz_diag_tr_ctr_zyl6 tz_diag_tr_ctr_zyl7 tz_diag_tr_ctr_zyl8 tz_diag_tr_ctr_zyl9 /end OUT_MEASUREMENT
/end FUNCTION
/begin RECORD_LAYOUT TKW_VV_VV_UB FNC_VALUES 1 UBYTE COLUMN_DIR DIRECT /end RECORD_LAYOUT
/begin RECORD_LAYOUT TKW_VV_VV_UW FNC_VALUES 1 UWORD COLUMN_DIR DIRECT /end RECORD_LAYOUT
/begin RECORD_LAYOUT TKW_VV_VV_SW FNC_VALUES 1 SWORD COLUMN_DIR DIRECT /end RECORD_LAYOUT
/begin RECORD_LAYOUT TKL_UW_VV_UW NO_AXIS_PTS_X 1 UBYTE RESERVED 2 BYTE AXIS_PTS_X 3 UWORD INDEX_INCR DIRECT FNC_VALUES 4 UWORD COLUMN_DIR DIRECT /end RECORD_LAYOUT
/begin RECORD_LAYOUT TKL_SW_VV_UW NO_AXIS_PTS_X 1 UBYTE RESERVED 2 BYTE AXIS_PTS_X 3 SWORD INDEX_INCR DIRECT FNC_VALUES 4 UWORD COLUMN_DIR DIRECT /end RECORD_LAYOUT
/begin RECORD_LAYOUT TKF_UW_UW_UW NO_AXIS_PTS_X 1 UBYTE NO_AXIS_PTS_Y 2 UBYTE AXIS_PTS_X 3 UWORD INDEX_INCR DIRECT AXIS_PTS_Y 4 UWORD INDEX_INCR DIRECT FNC_VALUES 5 UWORD COLUMN_DIR DIRECT /end RECORD_LAYOUT
/begin RECORD_LAYOUT TKF_SW_SW_UW NO_AXIS_PTS_X 1 UBYTE NO_AXIS_PTS_Y 2 UBYTE AXIS_PTS_X 3 SWORD INDEX_INCR DIRECT AXIS_PTS_Y 4 SWORD INDEX_INCR DIRECT FNC_VALUES 5 UWORD COLUMN_DIR DIRECT /end RECORD_LAYOUT
/end MODULE
/end PROJECT
