/begin PROJECT MSS65-inj-V452 "MSS65 INJ - V452.01-B204.00, data set 0569Q60Z160E"
/begin HEADER "" VERSION "V452.01-B204.00" /end HEADER
/begin MODULE _MSS65-inj "MSS65 INJ - V452.01-B204.00, calibration xxxxxxxx"
/begin MOD_COMMON "" BYTE_ORDER MSB_FIRST /* Default byteorder (Motorola) */ /end MOD_COMMON
/* ------------------ Abschnitt erzeugt aus adapt_common.dat ------------------ */
/begin COMPU_METHOD FORMULA_0000 "FORMULA_0000" RAT_FUNC "%7.0" "-" COEFFS 0 1 0 0 0 1 /end COMPU_METHOD
/begin COMPU_METHOD FORMULA_0003 "FORMULA_0003" RAT_FUNC "%3.0" "-" COEFFS 0 1 0 0 0 1 /end COMPU_METHOD
/begin COMPU_METHOD FORMULA_0010 "FORMULA_0010" RAT_FUNC "%5.0" "-" COEFFS 0 1 0 0 0 1 /end COMPU_METHOD
/begin COMPU_METHOD FORMULA_0033 "FORMULA_0033" RAT_FUNC "%5.2" "-" COEFFS 0 1 0 0 0 1 /end COMPU_METHOD
/* ------------------ Abschnitt erzeugt aus ed_glob.dat ------------------ */
/begin COMPU_METHOD FORMULA_0042 "FORMULA_0042" TAB_VERB "%5.2" "-" COMPU_TAB_REF FORMULA_0042_VTAB /end COMPU_METHOD
/begin COMPU_VTAB FORMULA_0042_VTAB "FORMULA_0042_VTAB" TAB_VERB 1 0 "kein WUC" DEFAULT_VALUE "Warmcycle" /end COMPU_VTAB
/begin COMPU_METHOD FORMULA_0043 "FORMULA_0043" TAB_VERB "%5.2" "-" COMPU_TAB_REF FORMULA_0043_VTAB /end COMPU_METHOD
/begin COMPU_VTAB FORMULA_0043_VTAB "FORMULA_0043_VTAB" TAB_VERB 1 0 "Kein Cycle" DEFAULT_VALUE "Rate-Based-DCY" /end COMPU_VTAB
/begin COMPU_METHOD FORMULA_0044 "FORMULA_0044" TAB_VERB "%5.2" "-" COMPU_TAB_REF FORMULA_0044_VTAB /end COMPU_METHOD
/begin COMPU_VTAB FORMULA_0044_VTAB "FORMULA_0044_VTAB" TAB_VERB 1 0 "Kein RBM-EVAP" DEFAULT_VALUE "RBM-EVAP" /end COMPU_VTAB
/begin COMPU_METHOD FORMULA_0045 "FORMULA_0045" TAB_VERB "%5.2" "-" COMPU_TAB_REF FORMULA_0045_VTAB /end COMPU_METHOD
/begin COMPU_VTAB FORMULA_0045_VTAB "FORMULA_0045_VTAB" TAB_VERB 1 0 "Kein RBM-SLP" DEFAULT_VALUE "RBM-SLP" /end COMPU_VTAB
/begin COMPU_METHOD FORMULA_0046 "FORMULA_0046" TAB_VERB "%5.2" "-" COMPU_TAB_REF FORMULA_0046_VTAB /end COMPU_METHOD
/begin COMPU_VTAB FORMULA_0046_VTAB "FORMULA_0046_VTAB" TAB_VERB 1 0 "Kein Abbruch" DEFAULT_VALUE "Abbruch" /end COMPU_VTAB
/begin COMPU_METHOD FORMULA_0047 "FORMULA_0047" TAB_VERB "%5.2" "-" COMPU_TAB_REF FORMULA_0047_VTAB /end COMPU_METHOD
/begin COMPU_VTAB FORMULA_0047_VTAB "FORMULA_0047_VTAB" TAB_VERB 1 0 "Kein CSS-DEN" DEFAULT_VALUE "CSS-DEN" /end COMPU_VTAB
/begin COMPU_METHOD FORMULA_0048 "FORMULA_0048" TAB_VERB "%5.2" "-" COMPU_TAB_REF FORMULA_0048_VTAB /end COMPU_METHOD
/begin COMPU_VTAB FORMULA_0048_VTAB "FORMULA_0048_VTAB" TAB_VERB 1 0 "Kein CSS-NUM" DEFAULT_VALUE "CSS-NUM" /end COMPU_VTAB
/begin COMPU_METHOD FORMULA_0073 "FORMULA_0073" RAT_FUNC "%6.1" "s" COEFFS 0 10 0 0 0 1 /end COMPU_METHOD
/begin MEASUREMENT ed_st_nv "Status-Eigendiagnose" UBYTE FORMULA_0033 0 0 0.0 255.0000 ECU_ADDRESS 0x3F9860 /end MEASUREMENT
/begin MEASUREMENT ed_st_nv_wuc "Warmupcycleerkennung" UBYTE FORMULA_0042 0 0 0.0 255.0 ECU_ADDRESS 0x3F9860 BIT_MASK 0x1 /end MEASUREMENT
/begin MEASUREMENT ed_st_nv_rbm_dcy "Rate-Based-DCY" UBYTE FORMULA_0043 0 0 0.0 255.0 ECU_ADDRESS 0x3F9860 BIT_MASK 0x2 /end MEASUREMENT
/begin MEASUREMENT ed_st_nv_rbm_evap "RBM-EVAP-Bedingung" UBYTE FORMULA_0044 0 0 0.0 255.0 ECU_ADDRESS 0x3F9860 BIT_MASK 0x4 /end MEASUREMENT
/begin MEASUREMENT ed_st_nv_rbm_slp "RBM-SLP-Bedingung" UBYTE FORMULA_0045 0 0 0.0 255.0 ECU_ADDRESS 0x3F9860 BIT_MASK 0x8 /end MEASUREMENT
/begin MEASUREMENT ed_st_nv_rbm_abbruch "Abbruch des RBM" UBYTE FORMULA_0046 0 0 0.0 255.0 ECU_ADDRESS 0x3F9860 BIT_MASK 0x10 /end MEASUREMENT
/begin MEASUREMENT ed_st_nv_css_den "CSS-Denominator" UBYTE FORMULA_0047 0 0 0.0 255.0 ECU_ADDRESS 0x3F9860 BIT_MASK 0x20 /end MEASUREMENT
/begin MEASUREMENT ed_st_nv_css_num "CSS-Numerator" UBYTE FORMULA_0048 0 0 0.0 255.0 ECU_ADDRESS 0x3F9860 BIT_MASK 0x40 /end MEASUREMENT
/begin MEASUREMENT ed_scdn_st_nv "Welche Fehler muessen mit similar Conditions behandelt werden" ULONG FORMULA_0000 0 0 0.0 4294967295.0000 ECU_ADDRESS 0x3F986C /end MEASUREMENT
/begin MEASUREMENT ed_rbm_sk_tr_inj.numerator_nv "Diagnosezyklen" UWORD FORMULA_0010 0 0 0.0 65535.0000 ECU_ADDRESS 0x3F9DB0 /end MEASUREMENT
/begin MEASUREMENT ed_rbm_pumg.numerator_nv "Diagnosezyklen" UWORD FORMULA_0010 0 0 0.0 65535.0000 ECU_ADDRESS 0x3F9DB4 /end MEASUREMENT
/begin MEASUREMENT ed_rbm_hfm1.numerator_nv "Diagnosezyklen" UWORD FORMULA_0010 0 0 0.0 65535.0000 ECU_ADDRESS 0x3F9DB8 /end MEASUREMENT
/begin MEASUREMENT ed_rbm_hfm2.numerator_nv "Diagnosezyklen" UWORD FORMULA_0010 0 0 0.0 65535.0000 ECU_ADDRESS 0x3F9DBC /end MEASUREMENT
/begin MEASUREMENT ed_rbm_psau1.numerator_nv "Diagnosezyklen" UWORD FORMULA_0010 0 0 0.0 65535.0000 ECU_ADDRESS 0x3F9DC0 /end MEASUREMENT
/begin MEASUREMENT ed_rbm_psau2.numerator_nv "Diagnosezyklen" UWORD FORMULA_0010 0 0 0.0 65535.0000 ECU_ADDRESS 0x3F9DC4 /end MEASUREMENT
/begin MEASUREMENT ed_rbm_van_hall_e1.numerator_nv "Diagnosezyklen" UWORD FORMULA_0010 0 0 0.0 65535.0000 ECU_ADDRESS 0x3F9DC8 /end MEASUREMENT
/begin MEASUREMENT ed_rbm_van_hall_a1.numerator_nv "Diagnosezyklen" UWORD FORMULA_0010 0 0 0.0 65535.0000 ECU_ADDRESS 0x3F9DCC /end MEASUREMENT
/begin MEASUREMENT ed_rbm_van_hall_e2.numerator_nv "Diagnosezyklen" UWORD FORMULA_0010 0 0 0.0 65535.0000 ECU_ADDRESS 0x3F9DD0 /end MEASUREMENT
/begin MEASUREMENT ed_rbm_van_hall_a2.numerator_nv "Diagnosezyklen" UWORD FORMULA_0010 0 0 0.0 65535.0000 ECU_ADDRESS 0x3F9DD4 /end MEASUREMENT
/begin MEASUREMENT ed_rbm_van_regl_e1.numerator_nv "Diagnosezyklen" UWORD FORMULA_0010 0 0 0.0 65535.0000 ECU_ADDRESS 0x3F9DD8 /end MEASUREMENT
/begin MEASUREMENT ed_rbm_van_regl_a1.numerator_nv "Diagnosezyklen" UWORD FORMULA_0010 0 0 0.0 65535.0000 ECU_ADDRESS 0x3F9DDC /end MEASUREMENT
/begin MEASUREMENT ed_rbm_van_regl_e2.numerator_nv "Diagnosezyklen" UWORD FORMULA_0010 0 0 0.0 65535.0000 ECU_ADDRESS 0x3F9DE0 /end MEASUREMENT
/begin MEASUREMENT ed_rbm_van_regl_a2.numerator_nv "Diagnosezyklen" UWORD FORMULA_0010 0 0 0.0 65535.0000 ECU_ADDRESS 0x3F9DE4 /end MEASUREMENT
/begin MEASUREMENT ed_rbm_nw1_sync.numerator_nv "Diagnosezyklen" UWORD FORMULA_0010 0 0 0.0 65535.0000 ECU_ADDRESS 0x3F9DE8 /end MEASUREMENT
/begin MEASUREMENT ed_rbm_nw2_sync.numerator_nv "Diagnosezyklen" UWORD FORMULA_0010 0 0 0.0 65535.0000 ECU_ADDRESS 0x3F9DEC /end MEASUREMENT
/begin MEASUREMENT ed_rbm_pctrl_inj.numerator_nv "Diagnosezyklen" UWORD FORMULA_0010 0 0 0.0 65535.0000 ECU_ADDRESS 0x3F9DF0 /end MEASUREMENT
/begin MEASUREMENT ed_rbm_pt_statdkg.numerator_nv "Diagnosezyklen" UWORD FORMULA_0010 0 0 0.0 65535.0000 ECU_ADDRESS 0x3F9DF4 /end MEASUREMENT
/begin MEASUREMENT ed_rbm_pks.numerator_nv "Diagnosezyklen" UWORD FORMULA_0010 0 0 0.0 65535.0000 ECU_ADDRESS 0x3F9DF8 /end MEASUREMENT
/begin MEASUREMENT ed_rbm_pt_statr.numerator_nv "Diagnosezyklen" UWORD FORMULA_0010 0 0 0.0 65535.0000 ECU_ADDRESS 0x3F9DFC /end MEASUREMENT
/begin MEASUREMENT ed_rbm_lavk1.numerator_nv "Diagnosezyklen" UWORD FORMULA_0010 0 0 0.0 65535.0000 ECU_ADDRESS 0x3F9E00 /end MEASUREMENT
/begin MEASUREMENT ed_rbm_lavk2.numerator_nv "Diagnosezyklen" UWORD FORMULA_0010 0 0 0.0 65535.0000 ECU_ADDRESS 0x3F9E04 /end MEASUREMENT
/begin MEASUREMENT ed_rbm_lavk1_obd_plau.numerator_nv "Diagnosezyklen" UWORD FORMULA_0010 0 0 0.0 65535.0000 ECU_ADDRESS 0x3F9E08 /end MEASUREMENT
/begin MEASUREMENT ed_rbm_lavk2_obd_plau.numerator_nv "Diagnosezyklen" UWORD FORMULA_0010 0 0 0.0 65535.0000 ECU_ADDRESS 0x3F9E0C /end MEASUREMENT
/begin MEASUREMENT ed_rbm_lavk1_obd_sa.numerator_nv "Diagnosezyklen" UWORD FORMULA_0010 0 0 0.0 65535.0000 ECU_ADDRESS 0x3F9E10 /end MEASUREMENT
/begin MEASUREMENT ed_rbm_lavk2_obd_sa.numerator_nv "Diagnosezyklen" UWORD FORMULA_0010 0 0 0.0 65535.0000 ECU_ADDRESS 0x3F9E14 /end MEASUREMENT
/begin MEASUREMENT ed_rbm_lank1.numerator_nv "Diagnosezyklen" UWORD FORMULA_0010 0 0 0.0 65535.0000 ECU_ADDRESS 0x3F9E18 /end MEASUREMENT
/begin MEASUREMENT ed_rbm_lank2.numerator_nv "Diagnosezyklen" UWORD FORMULA_0010 0 0 0.0 65535.0000 ECU_ADDRESS 0x3F9E1C /end MEASUREMENT
/begin MEASUREMENT ed_rbm_lshnk1.numerator_nv "Diagnosezyklen" UWORD FORMULA_0010 0 0 0.0 65535.0000 ECU_ADDRESS 0x3F9E20 /end MEASUREMENT
/begin MEASUREMENT ed_rbm_lshnk2.numerator_nv "Diagnosezyklen" UWORD FORMULA_0010 0 0 0.0 65535.0000 ECU_ADDRESS 0x3F9E24 /end MEASUREMENT
/begin MEASUREMENT ed_rbm_pt_busoff.numerator_nv "Diagnosezyklen" UWORD FORMULA_0010 0 0 0.0 65535.0000 ECU_ADDRESS 0x3F9E28 /end MEASUREMENT
/begin MEASUREMENT ed_rbm_pt_torqdsc.numerator_nv "Diagnosezyklen" UWORD FORMULA_0010 0 0 0.0 65535.0000 ECU_ADDRESS 0x3F9E2C /end MEASUREMENT
/begin MEASUREMENT ed_rbm_pt_stdsc.numerator_nv "Diagnosezyklen" UWORD FORMULA_0010 0 0 0.0 65535.0000 ECU_ADDRESS 0x3F9E30 /end MEASUREMENT
/begin MEASUREMENT ed_rbm_pt_vrad.numerator_nv "Diagnosezyklen" UWORD FORMULA_0010 0 0 0.0 65535.0000 ECU_ADDRESS 0x3F9E34 /end MEASUREMENT
/begin MEASUREMENT ed_rbm_pt_vfzg.numerator_nv "Diagnosezyklen" UWORD FORMULA_0010 0 0 0.0 65535.0000 ECU_ADDRESS 0x3F9E38 /end MEASUREMENT
/begin MEASUREMENT ed_rbm_pt_atemp.numerator_nv "Diagnosezyklen" UWORD FORMULA_0010 0 0 0.0 65535.0000 ECU_ADDRESS 0x3F9E3C /end MEASUREMENT
/begin MEASUREMENT ed_rbm_pt_klst.numerator_nv "Diagnosezyklen" UWORD FORMULA_0010 0 0 0.0 65535.0000 ECU_ADDRESS 0x3F9E40 /end MEASUREMENT
/begin MEASUREMENT ed_rbm_pt_kkos.numerator_nv "Diagnosezyklen" UWORD FORMULA_0010 0 0 0.0 65535.0000 ECU_ADDRESS 0x3F9E44 /end MEASUREMENT
/begin MEASUREMENT ed_rbm_pt_lrw.numerator_nv "Diagnosezyklen" UWORD FORMULA_0010 0 0 0.0 65535.0000 ECU_ADDRESS 0x3F9E48 /end MEASUREMENT
/begin MEASUREMENT ed_rbm_fplau1.numerator_nv "Diagnosezyklen" UWORD FORMULA_0010 0 0 0.0 65535.0000 ECU_ADDRESS 0x3F9E4C /end MEASUREMENT
/begin MEASUREMENT ed_rbm_fplau2.numerator_nv "Diagnosezyklen" UWORD FORMULA_0010 0 0 0.0 65535.0000 ECU_ADDRESS 0x3F9E50 /end MEASUREMENT
/begin MEASUREMENT ed_rbm_sl_ml_hfm.numerator_nv "Diagnosezyklen" UWORD FORMULA_0010 0 0 0.0 65535.0000 ECU_ADDRESS 0x3F9E54 /end MEASUREMENT
/begin MEASUREMENT ed_rbm_lank1_obd_s.numerator_nv "Diagnosezyklen" UWORD FORMULA_0010 0 0 0.0 65535.0000 ECU_ADDRESS 0x3F9E58 /end MEASUREMENT
/begin MEASUREMENT ed_rbm_lank2_obd_s.numerator_nv "Diagnosezyklen" UWORD FORMULA_0010 0 0 0.0 65535.0000 ECU_ADDRESS 0x3F9E5C /end MEASUREMENT
/begin MEASUREMENT ed_rbm_lavk1_obd_tl.numerator_nv "Diagnosezyklen" UWORD FORMULA_0010 0 0 0.0 65535.0000 ECU_ADDRESS 0x3F9E60 /end MEASUREMENT
/begin MEASUREMENT ed_rbm_lavk2_obd_tl.numerator_nv "Diagnosezyklen" UWORD FORMULA_0010 0 0 0.0 65535.0000 ECU_ADDRESS 0x3F9E64 /end MEASUREMENT
/begin MEASUREMENT ed_rbm_lshvk1.numerator_nv "Diagnosezyklen" UWORD FORMULA_0010 0 0 0.0 65535.0000 ECU_ADDRESS 0x3F9E68 /end MEASUREMENT
/begin MEASUREMENT ed_rbm_lshvk2.numerator_nv "Diagnosezyklen" UWORD FORMULA_0010 0 0 0.0 65535.0000 ECU_ADDRESS 0x3F9E6C /end MEASUREMENT
/begin MEASUREMENT ed_rbm_lsrvk1_obd_reg.numerator_nv "Diagnosezyklen" UWORD FORMULA_0010 0 0 0.0 65535.0000 ECU_ADDRESS 0x3F9E70 /end MEASUREMENT
/begin MEASUREMENT ed_rbm_lsrvk2_obd_reg.numerator_nv "Diagnosezyklen" UWORD FORMULA_0010 0 0 0.0 65535.0000 ECU_ADDRESS 0x3F9E74 /end MEASUREMENT
/begin MEASUREMENT ed_rbm_lshvk1_r.numerator_nv "Diagnosezyklen" UWORD FORMULA_0010 0 0 0.0 65535.0000 ECU_ADDRESS 0x3F9E78 /end MEASUREMENT
/begin MEASUREMENT ed_rbm_lshvk2_r.numerator_nv "Diagnosezyklen" UWORD FORMULA_0010 0 0 0.0 65535.0000 ECU_ADDRESS 0x3F9E7C /end MEASUREMENT
/begin MEASUREMENT ed_rbm_lsrvk1_obd_start.numerator_nv "Diagnosezyklen" UWORD FORMULA_0010 0 0 0.0 65535.0000 ECU_ADDRESS 0x3F9E80 /end MEASUREMENT
/begin MEASUREMENT ed_rbm_lsrvk2_obd_start.numerator_nv "Diagnosezyklen" UWORD FORMULA_0010 0 0 0.0 65535.0000 ECU_ADDRESS 0x3F9E84 /end MEASUREMENT
/begin MEASUREMENT ed_rbm_lsrvk1_obd_ref.numerator_nv "Diagnosezyklen" UWORD FORMULA_0010 0 0 0.0 65535.0000 ECU_ADDRESS 0x3F9E88 /end MEASUREMENT
/begin MEASUREMENT ed_rbm_lsrvk2_obd_ref.numerator_nv "Diagnosezyklen" UWORD FORMULA_0010 0 0 0.0 65535.0000 ECU_ADDRESS 0x3F9E8C /end MEASUREMENT
/begin MEASUREMENT ed_rbm_lavk1_diag.numerator_nv "Diagnosezyklen" UWORD FORMULA_0010 0 0 0.0 65535.0000 ECU_ADDRESS 0x3F9E90 /end MEASUREMENT
/begin MEASUREMENT ed_rbm_lavk2_diag.numerator_nv "Diagnosezyklen" UWORD FORMULA_0010 0 0 0.0 65535.0000 ECU_ADDRESS 0x3F9E94 /end MEASUREMENT
/begin MEASUREMENT ed_rbm_lavk1_ia_openload.numerator_nv "Diagnosezyklen" UWORD FORMULA_0010 0 0 0.0 65535.0000 ECU_ADDRESS 0x3F9E98 /end MEASUREMENT
/begin MEASUREMENT ed_rbm_lavk2_ia_openload.numerator_nv "Diagnosezyklen" UWORD FORMULA_0010 0 0 0.0 65535.0000 ECU_ADDRESS 0x3F9E9C /end MEASUREMENT
/begin MEASUREMENT ed_rbm_pt_grb.numerator_nv "Diagnosezyklen" UWORD FORMULA_0010 0 0 0.0 65535.0000 ECU_ADDRESS 0x3F9EA0 /end MEASUREMENT
/begin MEASUREMENT ed_rbm_pt_grb2.numerator_nv "Diagnosezyklen" UWORD FORMULA_0010 0 0 0.0 65535.0000 ECU_ADDRESS 0x3F9EA4 /end MEASUREMENT
/begin MEASUREMENT ed_rbm_lavk1_un_openload.numerator_nv "Diagnosezyklen" UWORD FORMULA_0010 0 0 0.0 65535.0000 ECU_ADDRESS 0x3F9EA8 /end MEASUREMENT
/begin MEASUREMENT ed_rbm_lavk2_un_openload.numerator_nv "Diagnosezyklen" UWORD FORMULA_0010 0 0 0.0 65535.0000 ECU_ADDRESS 0x3F9EAC /end MEASUREMENT
/begin MEASUREMENT ed_rbm_lavk1_ip_openload.numerator_nv "Diagnosezyklen" UWORD FORMULA_0010 0 0 0.0 65535.0000 ECU_ADDRESS 0x3F9EB0 /end MEASUREMENT
/begin MEASUREMENT ed_rbm_lavk2_ip_openload.numerator_nv "Diagnosezyklen" UWORD FORMULA_0010 0 0 0.0 65535.0000 ECU_ADDRESS 0x3F9EB4 /end MEASUREMENT
/begin MEASUREMENT ed_rbm_tz1.numerator_nv "Diagnosezyklen" UWORD FORMULA_0010 0 0 0.0 65535.0000 ECU_ADDRESS 0x3F9EBC /end MEASUREMENT
/begin MEASUREMENT ed_rbm_tz2.numerator_nv "Diagnosezyklen" UWORD FORMULA_0010 0 0 0.0 65535.0000 ECU_ADDRESS 0x3F9EC0 /end MEASUREMENT
/begin MEASUREMENT ed_rbm_tz3.numerator_nv "Diagnosezyklen" UWORD FORMULA_0010 0 0 0.0 65535.0000 ECU_ADDRESS 0x3F9EC4 /end MEASUREMENT
/begin MEASUREMENT ed_rbm_tz4.numerator_nv "Diagnosezyklen" UWORD FORMULA_0010 0 0 0.0 65535.0000 ECU_ADDRESS 0x3F9EC8 /end MEASUREMENT
/begin MEASUREMENT ed_rbm_tz5.numerator_nv "Diagnosezyklen" UWORD FORMULA_0010 0 0 0.0 65535.0000 ECU_ADDRESS 0x3F9ECC /end MEASUREMENT
/begin MEASUREMENT ed_rbm_tz6.numerator_nv "Diagnosezyklen" UWORD FORMULA_0010 0 0 0.0 65535.0000 ECU_ADDRESS 0x3F9ED0 /end MEASUREMENT
/begin MEASUREMENT ed_rbm_tz7.numerator_nv "Diagnosezyklen" UWORD FORMULA_0010 0 0 0.0 65535.0000 ECU_ADDRESS 0x3F9ED4 /end MEASUREMENT
/begin MEASUREMENT ed_rbm_tz8.numerator_nv "Diagnosezyklen" UWORD FORMULA_0010 0 0 0.0 65535.0000 ECU_ADDRESS 0x3F9ED8 /end MEASUREMENT
/begin MEASUREMENT ed_rbm_tz9.numerator_nv "Diagnosezyklen" UWORD FORMULA_0010 0 0 0.0 65535.0000 ECU_ADDRESS 0x3F9EDC /end MEASUREMENT
/begin MEASUREMENT ed_rbm_tz10.numerator_nv "Diagnosezyklen" UWORD FORMULA_0010 0 0 0.0 65535.0000 ECU_ADDRESS 0x3F9EE0 /end MEASUREMENT
/begin MEASUREMENT ed_rbm_lam1_reg.numerator_nv "Diagnosezyklen" UWORD FORMULA_0010 0 0 0.0 65535.0000 ECU_ADDRESS 0x3F9EE4 /end MEASUREMENT
/begin MEASUREMENT ed_rbm_lam2_reg.numerator_nv "Diagnosezyklen" UWORD FORMULA_0010 0 0 0.0 65535.0000 ECU_ADDRESS 0x3F9EE8 /end MEASUREMENT
/begin MEASUREMENT ed_rbm_van_anschl_e1.numerator_nv "Diagnosezyklen" UWORD FORMULA_0010 0 0 0.0 65535.0000 ECU_ADDRESS 0x3F9EEC /end MEASUREMENT
/begin MEASUREMENT ed_rbm_van_anschl_a1.numerator_nv "Diagnosezyklen" UWORD FORMULA_0010 0 0 0.0 65535.0000 ECU_ADDRESS 0x3F9EF0 /end MEASUREMENT
/begin MEASUREMENT ed_rbm_van_anschl_e2.numerator_nv "Diagnosezyklen" UWORD FORMULA_0010 0 0 0.0 65535.0000 ECU_ADDRESS 0x3F9EF4 /end MEASUREMENT
/begin MEASUREMENT ed_rbm_van_anschl_a2.numerator_nv "Diagnosezyklen" UWORD FORMULA_0010 0 0 0.0 65535.0000 ECU_ADDRESS 0x3F9EF8 /end MEASUREMENT
/begin MEASUREMENT ed_rbm_van_vent_e1.numerator_nv "Diagnosezyklen" UWORD FORMULA_0010 0 0 0.0 65535.0000 ECU_ADDRESS 0x3F9EFC /end MEASUREMENT
/begin MEASUREMENT ed_rbm_van_vent_a1.numerator_nv "Diagnosezyklen" UWORD FORMULA_0010 0 0 0.0 65535.0000 ECU_ADDRESS 0x3F9F00 /end MEASUREMENT
/begin MEASUREMENT ed_rbm_van_vent_e2.numerator_nv "Diagnosezyklen" UWORD FORMULA_0010 0 0 0.0 65535.0000 ECU_ADDRESS 0x3F9F04 /end MEASUREMENT
/begin MEASUREMENT ed_rbm_van_vent_a2.numerator_nv "Diagnosezyklen" UWORD FORMULA_0010 0 0 0.0 65535.0000 ECU_ADDRESS 0x3F9F08 /end MEASUREMENT
/begin MEASUREMENT ed_rbm_ev6.numerator_nv "Diagnosezyklen" UWORD FORMULA_0010 0 0 0.0 65535.0000 ECU_ADDRESS 0x3F9F20 /end MEASUREMENT
/begin MEASUREMENT ed_rbm_ev7.numerator_nv "Diagnosezyklen" UWORD FORMULA_0010 0 0 0.0 65535.0000 ECU_ADDRESS 0x3F9F24 /end MEASUREMENT
/begin MEASUREMENT ed_rbm_ev8.numerator_nv "Diagnosezyklen" UWORD FORMULA_0010 0 0 0.0 65535.0000 ECU_ADDRESS 0x3F9F28 /end MEASUREMENT
/begin MEASUREMENT ed_rbm_ev9.numerator_nv "Diagnosezyklen" UWORD FORMULA_0010 0 0 0.0 65535.0000 ECU_ADDRESS 0x3F9F2C /end MEASUREMENT
/begin MEASUREMENT ed_rbm_lavk1_obd_dyn.numerator_nv "Diagnosezyklen" UWORD FORMULA_0010 0 0 0.0 65535.0000 ECU_ADDRESS 0x3F9F34 /end MEASUREMENT
/begin MEASUREMENT ed_rbm_lavk2_obd_dyn.numerator_nv "Diagnosezyklen" UWORD FORMULA_0010 0 0 0.0 65535.0000 ECU_ADDRESS 0x3F9F38 /end MEASUREMENT
/begin MEASUREMENT ed_rbm_pt_crash.numerator_nv "Diagnosezyklen" UWORD FORMULA_0010 0 0 0.0 65535.0000 ECU_ADDRESS 0x3F9F3C /end MEASUREMENT
/begin MEASUREMENT ed_rbm_pt_vehmod.numerator_nv "Diagnosezyklen" UWORD FORMULA_0010 0 0 0.0 65535.0000 ECU_ADDRESS 0x3F9F40 /end MEASUREMENT
/begin MEASUREMENT ed_rbm_pt_bedfgr.numerator_nv "Diagnosezyklen" UWORD FORMULA_0010 0 0 0.0 65535.0000 ECU_ADDRESS 0x3F9F44 /end MEASUREMENT
/begin MEASUREMENT ed_rbm_lavk1_trim.numerator_nv "Diagnosezyklen" UWORD FORMULA_0010 0 0 0.0 65535.0000 ECU_ADDRESS 0x3F9F60 /end MEASUREMENT
/begin MEASUREMENT ed_rbm_lavk2_trim.numerator_nv "Diagnosezyklen" UWORD FORMULA_0010 0 0 0.0 65535.0000 ECU_ADDRESS 0x3F9F64 /end MEASUREMENT
/begin MEASUREMENT ed_rbm_rlu87.numerator_nv "Diagnosezyklen" UWORD FORMULA_0010 0 0 0.0 65535.0000 ECU_ADDRESS 0x3F9F68 /end MEASUREMENT
/begin MEASUREMENT ed_rbm_ssp.numerator_nv "Diagnosezyklen" UWORD FORMULA_0010 0 0 0.0 65535.0000 ECU_ADDRESS 0x3F9F70 /end MEASUREMENT
/begin MEASUREMENT ed_rbm_td.numerator_nv "Diagnosezyklen" UWORD FORMULA_0010 0 0 0.0 65535.0000 ECU_ADDRESS 0x3F9F74 /end MEASUREMENT
/begin MEASUREMENT ed_rbm_rlslp.numerator_nv "Diagnosezyklen" UWORD FORMULA_0010 0 0 0.0 65535.0000 ECU_ADDRESS 0x3F9F78 /end MEASUREMENT
/begin MEASUREMENT ed_rbm_slv.numerator_nv "Diagnosezyklen" UWORD FORMULA_0010 0 0 0.0 65535.0000 ECU_ADDRESS 0x3F9F7C /end MEASUREMENT
/begin MEASUREMENT ed_rbm_pt_km.numerator_nv "Diagnosezyklen" UWORD FORMULA_0010 0 0 0.0 65535.0000 ECU_ADDRESS 0x3F9F80 /end MEASUREMENT
/begin MEASUREMENT ed_rbm_pt_kombi.numerator_nv "Diagnosezyklen" UWORD FORMULA_0010 0 0 0.0 65535.0000 ECU_ADDRESS 0x3F9F84 /end MEASUREMENT
/begin MEASUREMENT ed_rbm_pks_ll.numerator_nv "Diagnosezyklen" UWORD FORMULA_0010 0 0 0.0 65535.0000 ECU_ADDRESS 0x3F9F88 /end MEASUREMENT
/begin MEASUREMENT ed_rbm_pks_tl.numerator_nv "Diagnosezyklen" UWORD FORMULA_0010 0 0 0.0 65535.0000 ECU_ADDRESS 0x3F9F8C /end MEASUREMENT
/begin MEASUREMENT ed_rbm_pks_q.numerator_nv "Diagnosezyklen" UWORD FORMULA_0010 0 0 0.0 65535.0000 ECU_ADDRESS 0x3F9F90 /end MEASUREMENT
/begin MEASUREMENT ed_rbm_kat_obd1.numerator_nv "Diagnosezyklen" UWORD FORMULA_0010 0 0 0.0 65535.0000 ECU_ADDRESS 0x3F9F94 /end MEASUREMENT
/begin MEASUREMENT ed_rbm_kat_obd2.numerator_nv "Diagnosezyklen" UWORD FORMULA_0010 0 0 0.0 65535.0000 ECU_ADDRESS 0x3F9F98 /end MEASUREMENT
/begin MEASUREMENT ed_rbm_van_dsv.numerator_nv "Diagnosezyklen" UWORD FORMULA_0010 0 0 0.0 65535.0000 ECU_ADDRESS 0x3F9F9C /end MEASUREMENT
/begin MEASUREMENT ed_rbm_fi_gen.numerator_nv "Diagnosezyklen" UWORD FORMULA_0010 0 0 0.0 65535.0000 ECU_ADDRESS 0x3F9FA0 /end MEASUREMENT
/begin MEASUREMENT ed_rbm_fi_bsd.numerator_nv "Diagnosezyklen" UWORD FORMULA_0010 0 0 0.0 65535.0000 ECU_ADDRESS 0x3F9FA4 /end MEASUREMENT
/begin MEASUREMENT ed_rbm_fi_qlt.numerator_nv "Diagnosezyklen" UWORD FORMULA_0010 0 0 0.0 65535.0000 ECU_ADDRESS 0x3F9FA8 /end MEASUREMENT
/begin MEASUREMENT ed_rbm_fi_ibs1.numerator_nv "Diagnosezyklen" UWORD FORMULA_0010 0 0 0.0 65535.0000 ECU_ADDRESS 0x3F9FAC /end MEASUREMENT
/begin MEASUREMENT ed_rbm_fi_ibs2.numerator_nv "Diagnosezyklen" UWORD FORMULA_0010 0 0 0.0 65535.0000 ECU_ADDRESS 0x3F9FB0 /end MEASUREMENT
/begin MEASUREMENT ed_rbm_fi_ibs3.numerator_nv "Diagnosezyklen" UWORD FORMULA_0010 0 0 0.0 65535.0000 ECU_ADDRESS 0x3F9FB4 /end MEASUREMENT
/begin MEASUREMENT ed_rbm_fi_pmbn.numerator_nv "Diagnosezyklen" UWORD FORMULA_0010 0 0 0.0 65535.0000 ECU_ADDRESS 0x3F9FB8 /end MEASUREMENT
/begin MEASUREMENT ed_rbm_fi_pmbatt.numerator_nv "Diagnosezyklen" UWORD FORMULA_0010 0 0 0.0 65535.0000 ECU_ADDRESS 0x3F9FBC /end MEASUREMENT
/begin MEASUREMENT ed_rbm_mvac_drucksensor.numerator_nv "Diagnosezyklen" UWORD FORMULA_0010 0 0 0.0 65535.0000 ECU_ADDRESS 0x3F9FC0 /end MEASUREMENT
/begin MEASUREMENT ed_rbm_pt_bedat.numerator_nv "Diagnosezyklen" UWORD FORMULA_0010 0 0 0.0 65535.0000 ECU_ADDRESS 0x3F9FC4 /end MEASUREMENT
/begin MEASUREMENT ed_rbm_sk_manager_inj.numerator_nv "Diagnosezyklen" UWORD FORMULA_0010 0 0 0.0 65535.0000 ECU_ADDRESS 0x3F9FC8 /end MEASUREMENT
/begin MEASUREMENT ed_rbm_ssp_diag.numerator_nv "Diagnosezyklen" UWORD FORMULA_0010 0 0 0.0 65535.0000 ECU_ADDRESS 0x3F9FCC /end MEASUREMENT
/begin MEASUREMENT ed_rbm_ews_sci.numerator_nv "Diagnosezyklen" UWORD FORMULA_0010 0 0 0.0 65535.0000 ECU_ADDRESS 0x3F9FD0 /end MEASUREMENT
/begin MEASUREMENT ed_rbm_ews_man.numerator_nv "Diagnosezyklen" UWORD FORMULA_0010 0 0 0.0 65535.0000 ECU_ADDRESS 0x3F9FD4 /end MEASUREMENT
/begin MEASUREMENT ed_rbm_fi_bsd_0.numerator_nv "Diagnosezyklen" UWORD FORMULA_0010 0 0 0.0 65535.0000 ECU_ADDRESS 0x3F9FD8 /end MEASUREMENT
/begin MEASUREMENT ed_rbm_fi_bsd_6.numerator_nv "Diagnosezyklen" UWORD FORMULA_0010 0 0 0.0 65535.0000 ECU_ADDRESS 0x3F9FDC /end MEASUREMENT
/begin MEASUREMENT ed_rbm_fi_bsdglob.numerator_nv "Diagnosezyklen" UWORD FORMULA_0010 0 0 0.0 65535.0000 ECU_ADDRESS 0x3F9FE0 /end MEASUREMENT
/begin MEASUREMENT ed_rbm_fi_pmruhverl.numerator_nv "Diagnosezyklen" UWORD FORMULA_0010 0 0 0.0 65535.0000 ECU_ADDRESS 0x3F9FE4 /end MEASUREMENT
/begin MEASUREMENT ed_rbm_fi_toens.numerator_nv "Diagnosezyklen" UWORD FORMULA_0010 0 0 0.0 65535.0000 ECU_ADDRESS 0x3F9FE8 /end MEASUREMENT
/begin MEASUREMENT ed_rbm_sg_inj.numerator_nv "Diagnosezyklen" UWORD FORMULA_0010 0 0 0.0 65535.0000 ECU_ADDRESS 0x3F9FF0 /end MEASUREMENT
/begin MEASUREMENT ed_rbm_s_poel_diag.numerator_nv "Diagnosezyklen" UWORD FORMULA_0010 0 0 0.0 65535.0000 ECU_ADDRESS 0x3F9FFC /end MEASUREMENT
/begin MEASUREMENT ed_rbm_te_obd_1.numerator_nv "Diagnosezyklen" UWORD FORMULA_0010 0 0 0.0 65535.0000 ECU_ADDRESS 0x3FA000 /end MEASUREMENT
/begin MEASUREMENT ed_rbm_te_obd_2.numerator_nv "Diagnosezyklen" UWORD FORMULA_0010 0 0 0.0 65535.0000 ECU_ADDRESS 0x3FA004 /end MEASUREMENT
/begin MEASUREMENT ed_rbm_tev1.numerator_nv "Diagnosezyklen" UWORD FORMULA_0010 0 0 0.0 65535.0000 ECU_ADDRESS 0x3FA008 /end MEASUREMENT
/begin MEASUREMENT ed_rbm_tev2.numerator_nv "Diagnosezyklen" UWORD FORMULA_0010 0 0 0.0 65535.0000 ECU_ADDRESS 0x3FA00C /end MEASUREMENT
/begin MEASUREMENT ed_rbm_kw.numerator_nv "Diagnosezyklen" UWORD FORMULA_0010 0 0 0.0 65535.0000 ECU_ADDRESS 0x3FA014 /end MEASUREMENT
/begin MEASUREMENT ed_rbm_la1_adapt.numerator_nv "Diagnosezyklen" UWORD FORMULA_0010 0 0 0.0 65535.0000 ECU_ADDRESS 0x3FA018 /end MEASUREMENT
/begin MEASUREMENT ed_rbm_la2_adapt.numerator_nv "Diagnosezyklen" UWORD FORMULA_0010 0 0 0.0 65535.0000 ECU_ADDRESS 0x3FA01C /end MEASUREMENT
/begin MEASUREMENT ed_rbm_kge1.numerator_nv "Diagnosezyklen" UWORD FORMULA_0010 0 0 0.0 65535.0000 ECU_ADDRESS 0x3FA020 /end MEASUREMENT
/begin MEASUREMENT ed_rbm_kge2.numerator_nv "Diagnosezyklen" UWORD FORMULA_0010 0 0 0.0 65535.0000 ECU_ADDRESS 0x3FA024 /end MEASUREMENT
/begin MEASUREMENT ed_rbm_fst.numerator_nv "Diagnosezyklen" UWORD FORMULA_0010 0 0 0.0 65535.0000 ECU_ADDRESS 0x3FA028 /end MEASUREMENT
/begin MEASUREMENT ed_rbm_slp.numerator_nv "Diagnosezyklen" UWORD FORMULA_0010 0 0 0.0 65535.0000 ECU_ADDRESS 0x3FA02C /end MEASUREMENT
/begin MEASUREMENT ed_rbm_sl_durchs_b1.numerator_nv "Diagnosezyklen" UWORD FORMULA_0010 0 0 0.0 65535.0000 ECU_ADDRESS 0x3FA030 /end MEASUREMENT
/begin MEASUREMENT ed_rbm_sl_durchs_b2.numerator_nv "Diagnosezyklen" UWORD FORMULA_0010 0 0 0.0 65535.0000 ECU_ADDRESS 0x3FA034 /end MEASUREMENT
/begin MEASUREMENT ed_rbm_sl_durchs_hstrang.numerator_nv "Diagnosezyklen" UWORD FORMULA_0010 0 0 0.0 65535.0000 ECU_ADDRESS 0x3FA038 /end MEASUREMENT
/begin MEASUREMENT ed_rbm_fetrawe.numerator_nv "Diagnosezyklen" UWORD FORMULA_0010 0 0 0.0 65535.0000 ECU_ADDRESS 0x3FA03C /end MEASUREMENT
/begin MEASUREMENT ed_rbm_s_getr_hs.numerator_nv "Diagnosezyklen" UWORD FORMULA_0010 0 0 0.0 65535.0000 ECU_ADDRESS 0x3FA040 /end MEASUREMENT
/begin MEASUREMENT ed_rbm_s_kupp_hs.numerator_nv "Diagnosezyklen" UWORD FORMULA_0010 0 0 0.0 65535.0000 ECU_ADDRESS 0x3FA044 /end MEASUREMENT
/begin MEASUREMENT ed_rbm_van_druck.numerator_nv "Diagnosezyklen" UWORD FORMULA_0010 0 0 0.0 65535.0000 ECU_ADDRESS 0x3FA048 /end MEASUREMENT
/begin MEASUREMENT ed_rbm_pt_statanh.numerator_nv "Diagnosezyklen" UWORD FORMULA_0010 0 0 0.0 65535.0000 ECU_ADDRESS 0x3FA054 /end MEASUREMENT
/begin MEASUREMENT ed_rbm_ksd1.numerator_nv "Diagnosezyklen" UWORD FORMULA_0010 0 0 0.0 65535.0000 ECU_ADDRESS 0x3FA058 /end MEASUREMENT
/begin MEASUREMENT ed_rbm_ksd2.numerator_nv "Diagnosezyklen" UWORD FORMULA_0010 0 0 0.0 65535.0000 ECU_ADDRESS 0x3FA05C /end MEASUREMENT
/begin MEASUREMENT ed_rbm_kats_b1.numerator_nv "Diagnosezyklen" UWORD FORMULA_0010 0 0 0.0 65535.0000 ECU_ADDRESS 0x3FA060 /end MEASUREMENT
/begin MEASUREMENT ed_rbm_kats_b2.numerator_nv "Diagnosezyklen" UWORD FORMULA_0010 0 0 0.0 65535.0000 ECU_ADDRESS 0x3FA064 /end MEASUREMENT
/begin MEASUREMENT ed_rbm_pt_statgrb.numerator_nv "Diagnosezyklen" UWORD FORMULA_0010 0 0 0.0 65535.0000 ECU_ADDRESS 0x3FA068 /end MEASUREMENT
/begin MEASUREMENT ed_rbm_pt_anfradmom.numerator_nv "Diagnosezyklen" UWORD FORMULA_0010 0 0 0.0 65535.0000 ECU_ADDRESS 0x3FA06C /end MEASUREMENT
/begin MEASUREMENT ed_rbm_fst_geber.numerator_nv "Diagnosezyklen" UWORD FORMULA_0010 0 0 0.0 65535.0000 ECU_ADDRESS 0x3FA070 /end MEASUREMENT
/begin MEASUREMENT ed_rbm_tank_leer.numerator_nv "Diagnosezyklen" UWORD FORMULA_0010 0 0 0.0 65535.0000 ECU_ADDRESS 0x3FA074 /end MEASUREMENT
/begin MEASUREMENT ed_rbm_pt_toma.numerator_nv "Diagnosezyklen" UWORD FORMULA_0010 0 0 0.0 65535.0000 ECU_ADDRESS 0x3FA078 /end MEASUREMENT
/begin MEASUREMENT ed_rbm_pumg_obd.numerator_nv "Diagnosezyklen" UWORD FORMULA_0010 0 0 0.0 65535.0000 ECU_ADDRESS 0x3FA080 /end MEASUREMENT
/begin MEASUREMENT ed_rbm_sl_ml_hfm_obd.numerator_nv "Diagnosezyklen" UWORD FORMULA_0010 0 0 0.0 65535.0000 ECU_ADDRESS 0x3FA084 /end MEASUREMENT
/begin MEASUREMENT ed_rbm_la1_trim_ad.numerator_nv "Diagnosezyklen" UWORD FORMULA_0010 0 0 0.0 65535.0000 ECU_ADDRESS 0x3FA088 /end MEASUREMENT
/begin MEASUREMENT ed_rbm_la2_trim_ad.numerator_nv "Diagnosezyklen" UWORD FORMULA_0010 0 0 0.0 65535.0000 ECU_ADDRESS 0x3FA08C /end MEASUREMENT
/begin MEASUREMENT ed_rbm_lank1_openload.numerator_nv "Diagnosezyklen" UWORD FORMULA_0010 0 0 0.0 65535.0000 ECU_ADDRESS 0x3FA090 /end MEASUREMENT
/begin MEASUREMENT ed_rbm_lank2_openload.numerator_nv "Diagnosezyklen" UWORD FORMULA_0010 0 0 0.0 65535.0000 ECU_ADDRESS 0x3FA094 /end MEASUREMENT
/begin MEASUREMENT ed_rbm_lank1_obd_we.numerator_nv "Diagnosezyklen" UWORD FORMULA_0010 0 0 0.0 65535.0000 ECU_ADDRESS 0x3FA098 /end MEASUREMENT
/begin MEASUREMENT ed_rbm_lank2_obd_we.numerator_nv "Diagnosezyklen" UWORD FORMULA_0010 0 0 0.0 65535.0000 ECU_ADDRESS 0x3FA09C /end MEASUREMENT
/begin MEASUREMENT ed_rbm_lshnk1_r.numerator_nv "Diagnosezyklen" UWORD FORMULA_0010 0 0 0.0 65535.0000 ECU_ADDRESS 0x3FA0A0 /end MEASUREMENT
/begin MEASUREMENT ed_rbm_lshnk2_r.numerator_nv "Diagnosezyklen" UWORD FORMULA_0010 0 0 0.0 65535.0000 ECU_ADDRESS 0x3FA0A4 /end MEASUREMENT
/begin MEASUREMENT ed_rbm_pks_modell.numerator_nv "Diagnosezyklen" UWORD FORMULA_0010 0 0 0.0 65535.0000 ECU_ADDRESS 0x3FA0A8 /end MEASUREMENT
/begin MEASUREMENT ed_rbm_pks_paufbau.numerator_nv "Diagnosezyklen" UWORD FORMULA_0010 0 0 0.0 65535.0000 ECU_ADDRESS 0x3FA0AC /end MEASUREMENT
/begin MEASUREMENT ed_rbm_pks_adapt_anschl.numerator_nv "Diagnosezyklen" UWORD FORMULA_0010 0 0 0.0 65535.0000 ECU_ADDRESS 0x3FA0B0 /end MEASUREMENT
/begin MEASUREMENT ed_rbm_tgetr_hs.numerator_nv "Diagnosezyklen" UWORD FORMULA_0010 0 0 0.0 65535.0000 ECU_ADDRESS 0x3FA0B4 /end MEASUREMENT
/begin MEASUREMENT ed_rbm_lavk_atic42.numerator_nv "Diagnosezyklen" UWORD FORMULA_0010 0 0 0.0 65535.0000 ECU_ADDRESS 0x3FA0B8 /end MEASUREMENT
/begin MEASUREMENT ed_rbm_pt_ax.numerator_nv "Diagnosezyklen" UWORD FORMULA_0010 0 0 0.0 65535.0000 ECU_ADDRESS 0x3FA0BC /end MEASUREMENT
/begin MEASUREMENT ed_rbm_pt_obd_ed.numerator_nv "Diagnosezyklen" UWORD FORMULA_0010 0 0 0.0 65535.0000 ECU_ADDRESS 0x3FA0C0 /end MEASUREMENT
/begin MEASUREMENT ed_rbm_fst_geber_li.numerator_nv "Diagnosezyklen" UWORD FORMULA_0010 0 0 0.0 65535.0000 ECU_ADDRESS 0x3FA0C4 /end MEASUREMENT
/begin MEASUREMENT ed_rbm_fst_geber_re.numerator_nv "Diagnosezyklen" UWORD FORMULA_0010 0 0 0.0 65535.0000 ECU_ADDRESS 0x3FA0C8 /end MEASUREMENT
/begin MEASUREMENT ed_rbm_lank1_obd_slope.numerator_nv "Diagnosezyklen" UWORD FORMULA_0010 0 0 0.0 65535.0000 ECU_ADDRESS 0x3FA0CC /end MEASUREMENT
/begin MEASUREMENT ed_rbm_lank2_obd_slope.numerator_nv "Diagnosezyklen" UWORD FORMULA_0010 0 0 0.0 65535.0000 ECU_ADDRESS 0x3FA0D0 /end MEASUREMENT
/begin MEASUREMENT ed_rbm_mvac_obd.numerator_nv "Diagnosezyklen" UWORD FORMULA_0010 0 0 0.0 65535.0000 ECU_ADDRESS 0x3FA0D4 /end MEASUREMENT
/begin MEASUREMENT ed_rbm_lavk2_atic42.numerator_nv "Diagnosezyklen" UWORD FORMULA_0010 0 0 0.0 65535.0000 ECU_ADDRESS 0x3FA0DC /end MEASUREMENT
/begin MEASUREMENT ed_rbm_index_204_inj.numerator_nv "Diagnosezyklen" UWORD FORMULA_0010 0 0 0.0 65535.0000 ECU_ADDRESS 0x3FA0E0 /end MEASUREMENT
/begin MEASUREMENT ed_rbm_index_205_inj.numerator_nv "Diagnosezyklen" UWORD FORMULA_0010 0 0 0.0 65535.0000 ECU_ADDRESS 0x3FA0E4 /end MEASUREMENT
/begin MEASUREMENT ed_rbm_index_206_inj.numerator_nv "Diagnosezyklen" UWORD FORMULA_0010 0 0 0.0 65535.0000 ECU_ADDRESS 0x3FA0E8 /end MEASUREMENT
/begin MEASUREMENT ed_rbm_index_207_inj.numerator_nv "Diagnosezyklen" UWORD FORMULA_0010 0 0 0.0 65535.0000 ECU_ADDRESS 0x3FA0EC /end MEASUREMENT
/begin MEASUREMENT ed_rbm_index_208_inj.numerator_nv "Diagnosezyklen" UWORD FORMULA_0010 0 0 0.0 65535.0000 ECU_ADDRESS 0x3FA0F0 /end MEASUREMENT
/begin MEASUREMENT ed_rbm_index_209_inj.numerator_nv "Diagnosezyklen" UWORD FORMULA_0010 0 0 0.0 65535.0000 ECU_ADDRESS 0x3FA0F4 /end MEASUREMENT
/begin MEASUREMENT ed_rbm_index_210_inj.numerator_nv "Diagnosezyklen" UWORD FORMULA_0010 0 0 0.0 65535.0000 ECU_ADDRESS 0x3FA0F8 /end MEASUREMENT
/begin MEASUREMENT ed_rbm_index_211_inj.numerator_nv "Diagnosezyklen" UWORD FORMULA_0010 0 0 0.0 65535.0000 ECU_ADDRESS 0x3FA0FC /end MEASUREMENT
/begin MEASUREMENT ed_rbm_index_212_inj.numerator_nv "Diagnosezyklen" UWORD FORMULA_0010 0 0 0.0 65535.0000 ECU_ADDRESS 0x3FA100 /end MEASUREMENT
/begin MEASUREMENT ed_rbm_index_213_inj.numerator_nv "Diagnosezyklen" UWORD FORMULA_0010 0 0 0.0 65535.0000 ECU_ADDRESS 0x3FA104 /end MEASUREMENT
/begin MEASUREMENT ed_rbm_index_214_inj.numerator_nv "Diagnosezyklen" UWORD FORMULA_0010 0 0 0.0 65535.0000 ECU_ADDRESS 0x3FA108 /end MEASUREMENT
/begin MEASUREMENT ed_rbm_index_215_inj.numerator_nv "Diagnosezyklen" UWORD FORMULA_0010 0 0 0.0 65535.0000 ECU_ADDRESS 0x3FA10C /end MEASUREMENT
/begin MEASUREMENT ed_rbm_index_216_inj.numerator_nv "Diagnosezyklen" UWORD FORMULA_0010 0 0 0.0 65535.0000 ECU_ADDRESS 0x3FA110 /end MEASUREMENT
/begin MEASUREMENT ed_rbm_index_217_inj.numerator_nv "Diagnosezyklen" UWORD FORMULA_0010 0 0 0.0 65535.0000 ECU_ADDRESS 0x3FA114 /end MEASUREMENT
/begin MEASUREMENT ed_rbm_index_218_inj.numerator_nv "Diagnosezyklen" UWORD FORMULA_0010 0 0 0.0 65535.0000 ECU_ADDRESS 0x3FA118 /end MEASUREMENT
/begin MEASUREMENT ed_rbm_index_219_inj.numerator_nv "Diagnosezyklen" UWORD FORMULA_0010 0 0 0.0 65535.0000 ECU_ADDRESS 0x3FA11C /end MEASUREMENT
/begin MEASUREMENT ed_rbm_index_220_inj.numerator_nv "Diagnosezyklen" UWORD FORMULA_0010 0 0 0.0 65535.0000 ECU_ADDRESS 0x3FA120 /end MEASUREMENT
/begin MEASUREMENT ed_rbm_index_221_inj.numerator_nv "Diagnosezyklen" UWORD FORMULA_0010 0 0 0.0 65535.0000 ECU_ADDRESS 0x3FA124 /end MEASUREMENT
/begin MEASUREMENT ed_rbm_index_222_inj.numerator_nv "Diagnosezyklen" UWORD FORMULA_0010 0 0 0.0 65535.0000 ECU_ADDRESS 0x3FA128 /end MEASUREMENT
/begin MEASUREMENT ed_rbm_index_223_inj.numerator_nv "Diagnosezyklen" UWORD FORMULA_0010 0 0 0.0 65535.0000 ECU_ADDRESS 0x3FA12C /end MEASUREMENT
/begin MEASUREMENT ed_rbm_sk_tr_inj.denominator_nv "Fahrzyklen" UWORD FORMULA_0010 0 0 0.0 65535.0000 ECU_ADDRESS 0x3F9DB2 /end MEASUREMENT
/begin MEASUREMENT ed_rbm_pumg.denominator_nv "Fahrzyklen" UWORD FORMULA_0010 0 0 0.0 65535.0000 ECU_ADDRESS 0x3F9DB6 /end MEASUREMENT
/begin MEASUREMENT ed_rbm_hfm1.denominator_nv "Fahrzyklen" UWORD FORMULA_0010 0 0 0.0 65535.0000 ECU_ADDRESS 0x3F9DBA /end MEASUREMENT
/begin MEASUREMENT ed_rbm_hfm2.denominator_nv "Fahrzyklen" UWORD FORMULA_0010 0 0 0.0 65535.0000 ECU_ADDRESS 0x3F9DBE /end MEASUREMENT
/begin MEASUREMENT ed_rbm_psau1.denominator_nv "Fahrzyklen" UWORD FORMULA_0010 0 0 0.0 65535.0000 ECU_ADDRESS 0x3F9DC2 /end MEASUREMENT
/begin MEASUREMENT ed_rbm_psau2.denominator_nv "Fahrzyklen" UWORD FORMULA_0010 0 0 0.0 65535.0000 ECU_ADDRESS 0x3F9DC6 /end MEASUREMENT
/begin MEASUREMENT ed_rbm_van_hall_e1.denominator_nv "Fahrzyklen" UWORD FORMULA_0010 0 0 0.0 65535.0000 ECU_ADDRESS 0x3F9DCA /end MEASUREMENT
/begin MEASUREMENT ed_rbm_van_hall_a1.denominator_nv "Fahrzyklen" UWORD FORMULA_0010 0 0 0.0 65535.0000 ECU_ADDRESS 0x3F9DCE /end MEASUREMENT
/begin MEASUREMENT ed_rbm_van_hall_e2.denominator_nv "Fahrzyklen" UWORD FORMULA_0010 0 0 0.0 65535.0000 ECU_ADDRESS 0x3F9DD2 /end MEASUREMENT
/begin MEASUREMENT ed_rbm_van_hall_a2.denominator_nv "Fahrzyklen" UWORD FORMULA_0010 0 0 0.0 65535.0000 ECU_ADDRESS 0x3F9DD6 /end MEASUREMENT
/begin MEASUREMENT ed_rbm_van_regl_e1.denominator_nv "Fahrzyklen" UWORD FORMULA_0010 0 0 0.0 65535.0000 ECU_ADDRESS 0x3F9DDA /end MEASUREMENT
/begin MEASUREMENT ed_rbm_van_regl_a1.denominator_nv "Fahrzyklen" UWORD FORMULA_0010 0 0 0.0 65535.0000 ECU_ADDRESS 0x3F9DDE /end MEASUREMENT
/begin MEASUREMENT ed_rbm_van_regl_e2.denominator_nv "Fahrzyklen" UWORD FORMULA_0010 0 0 0.0 65535.0000 ECU_ADDRESS 0x3F9DE2 /end MEASUREMENT
/begin MEASUREMENT ed_rbm_van_regl_a2.denominator_nv "Fahrzyklen" UWORD FORMULA_0010 0 0 0.0 65535.0000 ECU_ADDRESS 0x3F9DE6 /end MEASUREMENT
/begin MEASUREMENT ed_rbm_nw1_sync.denominator_nv "Fahrzyklen" UWORD FORMULA_0010 0 0 0.0 65535.0000 ECU_ADDRESS 0x3F9DEA /end MEASUREMENT
/begin MEASUREMENT ed_rbm_nw2_sync.denominator_nv "Fahrzyklen" UWORD FORMULA_0010 0 0 0.0 65535.0000 ECU_ADDRESS 0x3F9DEE /end MEASUREMENT
/begin MEASUREMENT ed_rbm_pctrl_inj.denominator_nv "Fahrzyklen" UWORD FORMULA_0010 0 0 0.0 65535.0000 ECU_ADDRESS 0x3F9DF2 /end MEASUREMENT
/begin MEASUREMENT ed_rbm_pt_statdkg.denominator_nv "Fahrzyklen" UWORD FORMULA_0010 0 0 0.0 65535.0000 ECU_ADDRESS 0x3F9DF6 /end MEASUREMENT
/begin MEASUREMENT ed_rbm_pks.denominator_nv "Fahrzyklen" UWORD FORMULA_0010 0 0 0.0 65535.0000 ECU_ADDRESS 0x3F9DFA /end MEASUREMENT
/begin MEASUREMENT ed_rbm_pt_statr.denominator_nv "Fahrzyklen" UWORD FORMULA_0010 0 0 0.0 65535.0000 ECU_ADDRESS 0x3F9DFE /end MEASUREMENT
/begin MEASUREMENT ed_rbm_lavk1.denominator_nv "Fahrzyklen" UWORD FORMULA_0010 0 0 0.0 65535.0000 ECU_ADDRESS 0x3F9E02 /end MEASUREMENT
/begin MEASUREMENT ed_rbm_lavk2.denominator_nv "Fahrzyklen" UWORD FORMULA_0010 0 0 0.0 65535.0000 ECU_ADDRESS 0x3F9E06 /end MEASUREMENT
/begin MEASUREMENT ed_rbm_lavk1_obd_plau.denominator_nv "Fahrzyklen" UWORD FORMULA_0010 0 0 0.0 65535.0000 ECU_ADDRESS 0x3F9E0A /end MEASUREMENT
/begin MEASUREMENT ed_rbm_lavk2_obd_plau.denominator_nv "Fahrzyklen" UWORD FORMULA_0010 0 0 0.0 65535.0000 ECU_ADDRESS 0x3F9E0E /end MEASUREMENT
/begin MEASUREMENT ed_rbm_lavk1_obd_sa.denominator_nv "Fahrzyklen" UWORD FORMULA_0010 0 0 0.0 65535.0000 ECU_ADDRESS 0x3F9E12 /end MEASUREMENT
/begin MEASUREMENT ed_rbm_lavk2_obd_sa.denominator_nv "Fahrzyklen" UWORD FORMULA_0010 0 0 0.0 65535.0000 ECU_ADDRESS 0x3F9E16 /end MEASUREMENT
/begin MEASUREMENT ed_rbm_lank1.denominator_nv "Fahrzyklen" UWORD FORMULA_0010 0 0 0.0 65535.0000 ECU_ADDRESS 0x3F9E1A /end MEASUREMENT
/begin MEASUREMENT ed_rbm_lank2.denominator_nv "Fahrzyklen" UWORD FORMULA_0010 0 0 0.0 65535.0000 ECU_ADDRESS 0x3F9E1E /end MEASUREMENT
/begin MEASUREMENT ed_rbm_lshnk1.denominator_nv "Fahrzyklen" UWORD FORMULA_0010 0 0 0.0 65535.0000 ECU_ADDRESS 0x3F9E22 /end MEASUREMENT
/begin MEASUREMENT ed_rbm_lshnk2.denominator_nv "Fahrzyklen" UWORD FORMULA_0010 0 0 0.0 65535.0000 ECU_ADDRESS 0x3F9E26 /end MEASUREMENT
/begin MEASUREMENT ed_rbm_pt_busoff.denominator_nv "Fahrzyklen" UWORD FORMULA_0010 0 0 0.0 65535.0000 ECU_ADDRESS 0x3F9E2A /end MEASUREMENT
/begin MEASUREMENT ed_rbm_pt_torqdsc.denominator_nv "Fahrzyklen" UWORD FORMULA_0010 0 0 0.0 65535.0000 ECU_ADDRESS 0x3F9E2E /end MEASUREMENT
/begin MEASUREMENT ed_rbm_pt_stdsc.denominator_nv "Fahrzyklen" UWORD FORMULA_0010 0 0 0.0 65535.0000 ECU_ADDRESS 0x3F9E32 /end MEASUREMENT
/begin MEASUREMENT ed_rbm_pt_vrad.denominator_nv "Fahrzyklen" UWORD FORMULA_0010 0 0 0.0 65535.0000 ECU_ADDRESS 0x3F9E36 /end MEASUREMENT
/begin MEASUREMENT ed_rbm_pt_vfzg.denominator_nv "Fahrzyklen" UWORD FORMULA_0010 0 0 0.0 65535.0000 ECU_ADDRESS 0x3F9E3A /end MEASUREMENT
/begin MEASUREMENT ed_rbm_pt_atemp.denominator_nv "Fahrzyklen" UWORD FORMULA_0010 0 0 0.0 65535.0000 ECU_ADDRESS 0x3F9E3E /end MEASUREMENT
/begin MEASUREMENT ed_rbm_pt_klst.denominator_nv "Fahrzyklen" UWORD FORMULA_0010 0 0 0.0 65535.0000 ECU_ADDRESS 0x3F9E42 /end MEASUREMENT
/begin MEASUREMENT ed_rbm_pt_kkos.denominator_nv "Fahrzyklen" UWORD FORMULA_0010 0 0 0.0 65535.0000 ECU_ADDRESS 0x3F9E46 /end MEASUREMENT
/begin MEASUREMENT ed_rbm_pt_lrw.denominator_nv "Fahrzyklen" UWORD FORMULA_0010 0 0 0.0 65535.0000 ECU_ADDRESS 0x3F9E4A /end MEASUREMENT
/begin MEASUREMENT ed_rbm_fplau1.denominator_nv "Fahrzyklen" UWORD FORMULA_0010 0 0 0.0 65535.0000 ECU_ADDRESS 0x3F9E4E /end MEASUREMENT
/begin MEASUREMENT ed_rbm_fplau2.denominator_nv "Fahrzyklen" UWORD FORMULA_0010 0 0 0.0 65535.0000 ECU_ADDRESS 0x3F9E52 /end MEASUREMENT
/begin MEASUREMENT ed_rbm_sl_ml_hfm.denominator_nv "Fahrzyklen" UWORD FORMULA_0010 0 0 0.0 65535.0000 ECU_ADDRESS 0x3F9E56 /end MEASUREMENT
/begin MEASUREMENT ed_rbm_lank1_obd_s.denominator_nv "Fahrzyklen" UWORD FORMULA_0010 0 0 0.0 65535.0000 ECU_ADDRESS 0x3F9E5A /end MEASUREMENT
/begin MEASUREMENT ed_rbm_lank2_obd_s.denominator_nv "Fahrzyklen" UWORD FORMULA_0010 0 0 0.0 65535.0000 ECU_ADDRESS 0x3F9E5E /end MEASUREMENT
/begin MEASUREMENT ed_rbm_lavk1_obd_tl.denominator_nv "Fahrzyklen" UWORD FORMULA_0010 0 0 0.0 65535.0000 ECU_ADDRESS 0x3F9E62 /end MEASUREMENT
/begin MEASUREMENT ed_rbm_lavk2_obd_tl.denominator_nv "Fahrzyklen" UWORD FORMULA_0010 0 0 0.0 65535.0000 ECU_ADDRESS 0x3F9E66 /end MEASUREMENT
/begin MEASUREMENT ed_rbm_lshvk1.denominator_nv "Fahrzyklen" UWORD FORMULA_0010 0 0 0.0 65535.0000 ECU_ADDRESS 0x3F9E6A /end MEASUREMENT
/begin MEASUREMENT ed_rbm_lshvk2.denominator_nv "Fahrzyklen" UWORD FORMULA_0010 0 0 0.0 65535.0000 ECU_ADDRESS 0x3F9E6E /end MEASUREMENT
/begin MEASUREMENT ed_rbm_lsrvk1_obd_reg.denominator_nv "Fahrzyklen" UWORD FORMULA_0010 0 0 0.0 65535.0000 ECU_ADDRESS 0x3F9E72 /end MEASUREMENT
/begin MEASUREMENT ed_rbm_lsrvk2_obd_reg.denominator_nv "Fahrzyklen" UWORD FORMULA_0010 0 0 0.0 65535.0000 ECU_ADDRESS 0x3F9E76 /end MEASUREMENT
/begin MEASUREMENT ed_rbm_lshvk1_r.denominator_nv "Fahrzyklen" UWORD FORMULA_0010 0 0 0.0 65535.0000 ECU_ADDRESS 0x3F9E7A /end MEASUREMENT
/begin MEASUREMENT ed_rbm_lshvk2_r.denominator_nv "Fahrzyklen" UWORD FORMULA_0010 0 0 0.0 65535.0000 ECU_ADDRESS 0x3F9E7E /end MEASUREMENT
/begin MEASUREMENT ed_rbm_lsrvk1_obd_start.denominator_nv "Fahrzyklen" UWORD FORMULA_0010 0 0 0.0 65535.0000 ECU_ADDRESS 0x3F9E82 /end MEASUREMENT
/begin MEASUREMENT ed_rbm_lsrvk2_obd_start.denominator_nv "Fahrzyklen" UWORD FORMULA_0010 0 0 0.0 65535.0000 ECU_ADDRESS 0x3F9E86 /end MEASUREMENT
/begin MEASUREMENT ed_rbm_lsrvk1_obd_ref.denominator_nv "Fahrzyklen" UWORD FORMULA_0010 0 0 0.0 65535.0000 ECU_ADDRESS 0x3F9E8A /end MEASUREMENT
/begin MEASUREMENT ed_rbm_lsrvk2_obd_ref.denominator_nv "Fahrzyklen" UWORD FORMULA_0010 0 0 0.0 65535.0000 ECU_ADDRESS 0x3F9E8E /end MEASUREMENT
/begin MEASUREMENT ed_rbm_lavk1_diag.denominator_nv "Fahrzyklen" UWORD FORMULA_0010 0 0 0.0 65535.0000 ECU_ADDRESS 0x3F9E92 /end MEASUREMENT
/begin MEASUREMENT ed_rbm_lavk2_diag.denominator_nv "Fahrzyklen" UWORD FORMULA_0010 0 0 0.0 65535.0000 ECU_ADDRESS 0x3F9E96 /end MEASUREMENT
/begin MEASUREMENT ed_rbm_lavk1_ia_openload.denominator_nv "Fahrzyklen" UWORD FORMULA_0010 0 0 0.0 65535.0000 ECU_ADDRESS 0x3F9E9A /end MEASUREMENT
/begin MEASUREMENT ed_rbm_lavk2_ia_openload.denominator_nv "Fahrzyklen" UWORD FORMULA_0010 0 0 0.0 65535.0000 ECU_ADDRESS 0x3F9E9E /end MEASUREMENT
/begin MEASUREMENT ed_rbm_pt_grb.denominator_nv "Fahrzyklen" UWORD FORMULA_0010 0 0 0.0 65535.0000 ECU_ADDRESS 0x3F9EA2 /end MEASUREMENT
/begin MEASUREMENT ed_rbm_pt_grb2.denominator_nv "Fahrzyklen" UWORD FORMULA_0010 0 0 0.0 65535.0000 ECU_ADDRESS 0x3F9EA6 /end MEASUREMENT
/begin MEASUREMENT ed_rbm_lavk1_un_openload.denominator_nv "Fahrzyklen" UWORD FORMULA_0010 0 0 0.0 65535.0000 ECU_ADDRESS 0x3F9EAA /end MEASUREMENT
/begin MEASUREMENT ed_rbm_lavk2_un_openload.denominator_nv "Fahrzyklen" UWORD FORMULA_0010 0 0 0.0 65535.0000 ECU_ADDRESS 0x3F9EAE /end MEASUREMENT
/begin MEASUREMENT ed_rbm_lavk1_ip_openload.denominator_nv "Fahrzyklen" UWORD FORMULA_0010 0 0 0.0 65535.0000 ECU_ADDRESS 0x3F9EB2 /end MEASUREMENT
/begin MEASUREMENT ed_rbm_lavk2_ip_openload.denominator_nv "Fahrzyklen" UWORD FORMULA_0010 0 0 0.0 65535.0000 ECU_ADDRESS 0x3F9EB6 /end MEASUREMENT
/begin MEASUREMENT ed_rbm_tz1.denominator_nv "Fahrzyklen" UWORD FORMULA_0010 0 0 0.0 65535.0000 ECU_ADDRESS 0x3F9EBE /end MEASUREMENT
/begin MEASUREMENT ed_rbm_tz2.denominator_nv "Fahrzyklen" UWORD FORMULA_0010 0 0 0.0 65535.0000 ECU_ADDRESS 0x3F9EC2 /end MEASUREMENT
/begin MEASUREMENT ed_rbm_tz3.denominator_nv "Fahrzyklen" UWORD FORMULA_0010 0 0 0.0 65535.0000 ECU_ADDRESS 0x3F9EC6 /end MEASUREMENT
/begin MEASUREMENT ed_rbm_tz4.denominator_nv "Fahrzyklen" UWORD FORMULA_0010 0 0 0.0 65535.0000 ECU_ADDRESS 0x3F9ECA /end MEASUREMENT
/begin MEASUREMENT ed_rbm_tz5.denominator_nv "Fahrzyklen" UWORD FORMULA_0010 0 0 0.0 65535.0000 ECU_ADDRESS 0x3F9ECE /end MEASUREMENT
/begin MEASUREMENT ed_rbm_tz6.denominator_nv "Fahrzyklen" UWORD FORMULA_0010 0 0 0.0 65535.0000 ECU_ADDRESS 0x3F9ED2 /end MEASUREMENT
/begin MEASUREMENT ed_rbm_tz7.denominator_nv "Fahrzyklen" UWORD FORMULA_0010 0 0 0.0 65535.0000 ECU_ADDRESS 0x3F9ED6 /end MEASUREMENT
/begin MEASUREMENT ed_rbm_tz8.denominator_nv "Fahrzyklen" UWORD FORMULA_0010 0 0 0.0 65535.0000 ECU_ADDRESS 0x3F9EDA /end MEASUREMENT
/begin MEASUREMENT ed_rbm_tz9.denominator_nv "Fahrzyklen" UWORD FORMULA_0010 0 0 0.0 65535.0000 ECU_ADDRESS 0x3F9EDE /end MEASUREMENT
/begin MEASUREMENT ed_rbm_tz10.denominator_nv "Fahrzyklen" UWORD FORMULA_0010 0 0 0.0 65535.0000 ECU_ADDRESS 0x3F9EE2 /end MEASUREMENT
/begin MEASUREMENT ed_rbm_lam1_reg.denominator_nv "Fahrzyklen" UWORD FORMULA_0010 0 0 0.0 65535.0000 ECU_ADDRESS 0x3F9EE6 /end MEASUREMENT
/begin MEASUREMENT ed_rbm_lam2_reg.denominator_nv "Fahrzyklen" UWORD FORMULA_0010 0 0 0.0 65535.0000 ECU_ADDRESS 0x3F9EEA /end MEASUREMENT
/begin MEASUREMENT ed_rbm_van_anschl_e1.denominator_nv "Fahrzyklen" UWORD FORMULA_0010 0 0 0.0 65535.0000 ECU_ADDRESS 0x3F9EEE /end MEASUREMENT
/begin MEASUREMENT ed_rbm_van_anschl_a1.denominator_nv "Fahrzyklen" UWORD FORMULA_0010 0 0 0.0 65535.0000 ECU_ADDRESS 0x3F9EF2 /end MEASUREMENT
/begin MEASUREMENT ed_rbm_van_anschl_e2.denominator_nv "Fahrzyklen" UWORD FORMULA_0010 0 0 0.0 65535.0000 ECU_ADDRESS 0x3F9EF6 /end MEASUREMENT
/begin MEASUREMENT ed_rbm_van_anschl_a2.denominator_nv "Fahrzyklen" UWORD FORMULA_0010 0 0 0.0 65535.0000 ECU_ADDRESS 0x3F9EFA /end MEASUREMENT
/begin MEASUREMENT ed_rbm_van_vent_e1.denominator_nv "Fahrzyklen" UWORD FORMULA_0010 0 0 0.0 65535.0000 ECU_ADDRESS 0x3F9EFE /end MEASUREMENT
/begin MEASUREMENT ed_rbm_van_vent_a1.denominator_nv "Fahrzyklen" UWORD FORMULA_0010 0 0 0.0 65535.0000 ECU_ADDRESS 0x3F9F02 /end MEASUREMENT
/begin MEASUREMENT ed_rbm_van_vent_e2.denominator_nv "Fahrzyklen" UWORD FORMULA_0010 0 0 0.0 65535.0000 ECU_ADDRESS 0x3F9F06 /end MEASUREMENT
/begin MEASUREMENT ed_rbm_van_vent_a2.denominator_nv "Fahrzyklen" UWORD FORMULA_0010 0 0 0.0 65535.0000 ECU_ADDRESS 0x3F9F0A /end MEASUREMENT
/begin MEASUREMENT ed_rbm_ev7.denominator_nv "Fahrzyklen" UWORD FORMULA_0010 0 0 0.0 65535.0000 ECU_ADDRESS 0x3F9F26 /end MEASUREMENT
/begin MEASUREMENT ed_rbm_ev8.denominator_nv "Fahrzyklen" UWORD FORMULA_0010 0 0 0.0 65535.0000 ECU_ADDRESS 0x3F9F2A /end MEASUREMENT
/begin MEASUREMENT ed_rbm_ev9.denominator_nv "Fahrzyklen" UWORD FORMULA_0010 0 0 0.0 65535.0000 ECU_ADDRESS 0x3F9F2E /end MEASUREMENT
/begin MEASUREMENT ed_rbm_lavk1_obd_dyn.denominator_nv "Fahrzyklen" UWORD FORMULA_0010 0 0 0.0 65535.0000 ECU_ADDRESS 0x3F9F36 /end MEASUREMENT
/begin MEASUREMENT ed_rbm_lavk2_obd_dyn.denominator_nv "Fahrzyklen" UWORD FORMULA_0010 0 0 0.0 65535.0000 ECU_ADDRESS 0x3F9F3A /end MEASUREMENT
/begin MEASUREMENT ed_rbm_pt_crash.denominator_nv "Fahrzyklen" UWORD FORMULA_0010 0 0 0.0 65535.0000 ECU_ADDRESS 0x3F9F3E /end MEASUREMENT
/begin MEASUREMENT ed_rbm_pt_vehmod.denominator_nv "Fahrzyklen" UWORD FORMULA_0010 0 0 0.0 65535.0000 ECU_ADDRESS 0x3F9F42 /end MEASUREMENT
/begin MEASUREMENT ed_rbm_pt_bedfgr.denominator_nv "Fahrzyklen" UWORD FORMULA_0010 0 0 0.0 65535.0000 ECU_ADDRESS 0x3F9F46 /end MEASUREMENT
/begin MEASUREMENT ed_rbm_lavk1_trim.denominator_nv "Fahrzyklen" UWORD FORMULA_0010 0 0 0.0 65535.0000 ECU_ADDRESS 0x3F9F62 /end MEASUREMENT
/begin MEASUREMENT ed_rbm_lavk2_trim.denominator_nv "Fahrzyklen" UWORD FORMULA_0010 0 0 0.0 65535.0000 ECU_ADDRESS 0x3F9F66 /end MEASUREMENT
/begin MEASUREMENT ed_rbm_rlu87.denominator_nv "Fahrzyklen" UWORD FORMULA_0010 0 0 0.0 65535.0000 ECU_ADDRESS 0x3F9F6A /end MEASUREMENT
/begin MEASUREMENT ed_rbm_ssp.denominator_nv "Fahrzyklen" UWORD FORMULA_0010 0 0 0.0 65535.0000 ECU_ADDRESS 0x3F9F72 /end MEASUREMENT
/begin MEASUREMENT ed_rbm_td.denominator_nv "Fahrzyklen" UWORD FORMULA_0010 0 0 0.0 65535.0000 ECU_ADDRESS 0x3F9F76 /end MEASUREMENT
/begin MEASUREMENT ed_rbm_rlslp.denominator_nv "Fahrzyklen" UWORD FORMULA_0010 0 0 0.0 65535.0000 ECU_ADDRESS 0x3F9F7A /end MEASUREMENT
/begin MEASUREMENT ed_rbm_slv.denominator_nv "Fahrzyklen" UWORD FORMULA_0010 0 0 0.0 65535.0000 ECU_ADDRESS 0x3F9F7E /end MEASUREMENT
/begin MEASUREMENT ed_rbm_pt_km.denominator_nv "Fahrzyklen" UWORD FORMULA_0010 0 0 0.0 65535.0000 ECU_ADDRESS 0x3F9F82 /end MEASUREMENT
/begin MEASUREMENT ed_rbm_pt_kombi.denominator_nv "Fahrzyklen" UWORD FORMULA_0010 0 0 0.0 65535.0000 ECU_ADDRESS 0x3F9F86 /end MEASUREMENT
/begin MEASUREMENT ed_rbm_pks_ll.denominator_nv "Fahrzyklen" UWORD FORMULA_0010 0 0 0.0 65535.0000 ECU_ADDRESS 0x3F9F8A /end MEASUREMENT
/begin MEASUREMENT ed_rbm_pks_tl.denominator_nv "Fahrzyklen" UWORD FORMULA_0010 0 0 0.0 65535.0000 ECU_ADDRESS 0x3F9F8E /end MEASUREMENT
/begin MEASUREMENT ed_rbm_pks_q.denominator_nv "Fahrzyklen" UWORD FORMULA_0010 0 0 0.0 65535.0000 ECU_ADDRESS 0x3F9F92 /end MEASUREMENT
/begin MEASUREMENT ed_rbm_kat_obd1.denominator_nv "Fahrzyklen" UWORD FORMULA_0010 0 0 0.0 65535.0000 ECU_ADDRESS 0x3F9F96 /end MEASUREMENT
/begin MEASUREMENT ed_rbm_kat_obd2.denominator_nv "Fahrzyklen" UWORD FORMULA_0010 0 0 0.0 65535.0000 ECU_ADDRESS 0x3F9F9A /end MEASUREMENT
/begin MEASUREMENT ed_rbm_van_dsv.denominator_nv "Fahrzyklen" UWORD FORMULA_0010 0 0 0.0 65535.0000 ECU_ADDRESS 0x3F9F9E /end MEASUREMENT
/begin MEASUREMENT ed_rbm_fi_gen.denominator_nv "Fahrzyklen" UWORD FORMULA_0010 0 0 0.0 65535.0000 ECU_ADDRESS 0x3F9FA2 /end MEASUREMENT
/begin MEASUREMENT ed_rbm_fi_bsd.denominator_nv "Fahrzyklen" UWORD FORMULA_0010 0 0 0.0 65535.0000 ECU_ADDRESS 0x3F9FA6 /end MEASUREMENT
/begin MEASUREMENT ed_rbm_fi_qlt.denominator_nv "Fahrzyklen" UWORD FORMULA_0010 0 0 0.0 65535.0000 ECU_ADDRESS 0x3F9FAA /end MEASUREMENT
/begin MEASUREMENT ed_rbm_fi_ibs1.denominator_nv "Fahrzyklen" UWORD FORMULA_0010 0 0 0.0 65535.0000 ECU_ADDRESS 0x3F9FAE /end MEASUREMENT
/begin MEASUREMENT ed_rbm_fi_ibs2.denominator_nv "Fahrzyklen" UWORD FORMULA_0010 0 0 0.0 65535.0000 ECU_ADDRESS 0x3F9FB2 /end MEASUREMENT
/begin MEASUREMENT ed_rbm_fi_ibs3.denominator_nv "Fahrzyklen" UWORD FORMULA_0010 0 0 0.0 65535.0000 ECU_ADDRESS 0x3F9FB6 /end MEASUREMENT
/begin MEASUREMENT ed_rbm_fi_pmbn.denominator_nv "Fahrzyklen" UWORD FORMULA_0010 0 0 0.0 65535.0000 ECU_ADDRESS 0x3F9FBA /end MEASUREMENT
/begin MEASUREMENT ed_rbm_fi_pmbatt.denominator_nv "Fahrzyklen" UWORD FORMULA_0010 0 0 0.0 65535.0000 ECU_ADDRESS 0x3F9FBE /end MEASUREMENT
/begin MEASUREMENT ed_rbm_mvac_drucksensor.denominator_nv "Fahrzyklen" UWORD FORMULA_0010 0 0 0.0 65535.0000 ECU_ADDRESS 0x3F9FC2 /end MEASUREMENT
/begin MEASUREMENT ed_rbm_pt_bedat.denominator_nv "Fahrzyklen" UWORD FORMULA_0010 0 0 0.0 65535.0000 ECU_ADDRESS 0x3F9FC6 /end MEASUREMENT
/begin MEASUREMENT ed_rbm_sk_manager_inj.denominator_nv "Fahrzyklen" UWORD FORMULA_0010 0 0 0.0 65535.0000 ECU_ADDRESS 0x3F9FCA /end MEASUREMENT
/begin MEASUREMENT ed_rbm_ssp_diag.denominator_nv "Fahrzyklen" UWORD FORMULA_0010 0 0 0.0 65535.0000 ECU_ADDRESS 0x3F9FCE /end MEASUREMENT
/begin MEASUREMENT ed_rbm_ews_sci.denominator_nv "Fahrzyklen" UWORD FORMULA_0010 0 0 0.0 65535.0000 ECU_ADDRESS 0x3F9FD2 /end MEASUREMENT
/begin MEASUREMENT ed_rbm_ews_man.denominator_nv "Fahrzyklen" UWORD FORMULA_0010 0 0 0.0 65535.0000 ECU_ADDRESS 0x3F9FD6 /end MEASUREMENT
/begin MEASUREMENT ed_rbm_fi_bsd_0.denominator_nv "Fahrzyklen" UWORD FORMULA_0010 0 0 0.0 65535.0000 ECU_ADDRESS 0x3F9FDA /end MEASUREMENT
/begin MEASUREMENT ed_rbm_fi_bsd_6.denominator_nv "Fahrzyklen" UWORD FORMULA_0010 0 0 0.0 65535.0000 ECU_ADDRESS 0x3F9FDE /end MEASUREMENT
/begin MEASUREMENT ed_rbm_fi_bsdglob.denominator_nv "Fahrzyklen" UWORD FORMULA_0010 0 0 0.0 65535.0000 ECU_ADDRESS 0x3F9FE2 /end MEASUREMENT
/begin MEASUREMENT ed_rbm_fi_pmruhverl.denominator_nv "Fahrzyklen" UWORD FORMULA_0010 0 0 0.0 65535.0000 ECU_ADDRESS 0x3F9FE6 /end MEASUREMENT
/begin MEASUREMENT ed_rbm_fi_toens.denominator_nv "Fahrzyklen" UWORD FORMULA_0010 0 0 0.0 65535.0000 ECU_ADDRESS 0x3F9FEA /end MEASUREMENT
/begin MEASUREMENT ed_rbm_sg_inj.denominator_nv "Fahrzyklen" UWORD FORMULA_0010 0 0 0.0 65535.0000 ECU_ADDRESS 0x3F9FF2 /end MEASUREMENT
/begin MEASUREMENT ed_rbm_s_poel_diag.denominator_nv "Fahrzyklen" UWORD FORMULA_0010 0 0 0.0 65535.0000 ECU_ADDRESS 0x3F9FFE /end MEASUREMENT
/begin MEASUREMENT ed_rbm_te_obd_1.denominator_nv "Fahrzyklen" UWORD FORMULA_0010 0 0 0.0 65535.0000 ECU_ADDRESS 0x3FA002 /end MEASUREMENT
/begin MEASUREMENT ed_rbm_te_obd_2.denominator_nv "Fahrzyklen" UWORD FORMULA_0010 0 0 0.0 65535.0000 ECU_ADDRESS 0x3FA006 /end MEASUREMENT
/begin MEASUREMENT ed_rbm_tev1.denominator_nv "Fahrzyklen" UWORD FORMULA_0010 0 0 0.0 65535.0000 ECU_ADDRESS 0x3FA00A /end MEASUREMENT
/begin MEASUREMENT ed_rbm_tev2.denominator_nv "Fahrzyklen" UWORD FORMULA_0010 0 0 0.0 65535.0000 ECU_ADDRESS 0x3FA00E /end MEASUREMENT
/begin MEASUREMENT ed_rbm_kw.denominator_nv "Fahrzyklen" UWORD FORMULA_0010 0 0 0.0 65535.0000 ECU_ADDRESS 0x3FA016 /end MEASUREMENT
/begin MEASUREMENT ed_rbm_la1_adapt.denominator_nv "Fahrzyklen" UWORD FORMULA_0010 0 0 0.0 65535.0000 ECU_ADDRESS 0x3FA01A /end MEASUREMENT
/begin MEASUREMENT ed_rbm_la2_adapt.denominator_nv "Fahrzyklen" UWORD FORMULA_0010 0 0 0.0 65535.0000 ECU_ADDRESS 0x3FA01E /end MEASUREMENT
/begin MEASUREMENT ed_rbm_kge1.denominator_nv "Fahrzyklen" UWORD FORMULA_0010 0 0 0.0 65535.0000 ECU_ADDRESS 0x3FA022 /end MEASUREMENT
/begin MEASUREMENT ed_rbm_kge2.denominator_nv "Fahrzyklen" UWORD FORMULA_0010 0 0 0.0 65535.0000 ECU_ADDRESS 0x3FA026 /end MEASUREMENT
/begin MEASUREMENT ed_rbm_fst.denominator_nv "Fahrzyklen" UWORD FORMULA_0010 0 0 0.0 65535.0000 ECU_ADDRESS 0x3FA02A /end MEASUREMENT
/begin MEASUREMENT ed_rbm_slp.denominator_nv "Fahrzyklen" UWORD FORMULA_0010 0 0 0.0 65535.0000 ECU_ADDRESS 0x3FA02E /end MEASUREMENT
/begin MEASUREMENT ed_rbm_sl_durchs_b1.denominator_nv "Fahrzyklen" UWORD FORMULA_0010 0 0 0.0 65535.0000 ECU_ADDRESS 0x3FA032 /end MEASUREMENT
/begin MEASUREMENT ed_rbm_sl_durchs_b2.denominator_nv "Fahrzyklen" UWORD FORMULA_0010 0 0 0.0 65535.0000 ECU_ADDRESS 0x3FA036 /end MEASUREMENT
/begin MEASUREMENT ed_rbm_sl_durchs_hstrang.denominator_nv "Fahrzyklen" UWORD FORMULA_0010 0 0 0.0 65535.0000 ECU_ADDRESS 0x3FA03A /end MEASUREMENT
/begin MEASUREMENT ed_rbm_fetrawe.denominator_nv "Fahrzyklen" UWORD FORMULA_0010 0 0 0.0 65535.0000 ECU_ADDRESS 0x3FA03E /end MEASUREMENT
/begin MEASUREMENT ed_rbm_s_getr_hs.denominator_nv "Fahrzyklen" UWORD FORMULA_0010 0 0 0.0 65535.0000 ECU_ADDRESS 0x3FA042 /end MEASUREMENT
/begin MEASUREMENT ed_rbm_s_kupp_hs.denominator_nv "Fahrzyklen" UWORD FORMULA_0010 0 0 0.0 65535.0000 ECU_ADDRESS 0x3FA046 /end MEASUREMENT
/begin MEASUREMENT ed_rbm_van_druck.denominator_nv "Fahrzyklen" UWORD FORMULA_0010 0 0 0.0 65535.0000 ECU_ADDRESS 0x3FA04A /end MEASUREMENT
/begin MEASUREMENT ed_rbm_pt_statanh.denominator_nv "Fahrzyklen" UWORD FORMULA_0010 0 0 0.0 65535.0000 ECU_ADDRESS 0x3FA056 /end MEASUREMENT
/begin MEASUREMENT ed_rbm_ksd1.denominator_nv "Fahrzyklen" UWORD FORMULA_0010 0 0 0.0 65535.0000 ECU_ADDRESS 0x3FA05A /end MEASUREMENT
/begin MEASUREMENT ed_rbm_ksd2.denominator_nv "Fahrzyklen" UWORD FORMULA_0010 0 0 0.0 65535.0000 ECU_ADDRESS 0x3FA05E /end MEASUREMENT
/begin MEASUREMENT ed_rbm_kats_b1.denominator_nv "Fahrzyklen" UWORD FORMULA_0010 0 0 0.0 65535.0000 ECU_ADDRESS 0x3FA062 /end MEASUREMENT
/begin MEASUREMENT ed_rbm_kats_b2.denominator_nv "Fahrzyklen" UWORD FORMULA_0010 0 0 0.0 65535.0000 ECU_ADDRESS 0x3FA066 /end MEASUREMENT
/begin MEASUREMENT ed_rbm_pt_statgrb.denominator_nv "Fahrzyklen" UWORD FORMULA_0010 0 0 0.0 65535.0000 ECU_ADDRESS 0x3FA06A /end MEASUREMENT
/begin MEASUREMENT ed_rbm_pt_anfradmom.denominator_nv "Fahrzyklen" UWORD FORMULA_0010 0 0 0.0 65535.0000 ECU_ADDRESS 0x3FA06E /end MEASUREMENT
/begin MEASUREMENT ed_rbm_fst_geber.denominator_nv "Fahrzyklen" UWORD FORMULA_0010 0 0 0.0 65535.0000 ECU_ADDRESS 0x3FA072 /end MEASUREMENT
/begin MEASUREMENT ed_rbm_tank_leer.denominator_nv "Fahrzyklen" UWORD FORMULA_0010 0 0 0.0 65535.0000 ECU_ADDRESS 0x3FA076 /end MEASUREMENT
/begin MEASUREMENT ed_rbm_pt_toma.denominator_nv "Fahrzyklen" UWORD FORMULA_0010 0 0 0.0 65535.0000 ECU_ADDRESS 0x3FA07A /end MEASUREMENT
/begin MEASUREMENT ed_rbm_pumg_obd.denominator_nv "Fahrzyklen" UWORD FORMULA_0010 0 0 0.0 65535.0000 ECU_ADDRESS 0x3FA082 /end MEASUREMENT
/begin MEASUREMENT ed_rbm_sl_ml_hfm_obd.denominator_nv "Fahrzyklen" UWORD FORMULA_0010 0 0 0.0 65535.0000 ECU_ADDRESS 0x3FA086 /end MEASUREMENT
/begin MEASUREMENT ed_rbm_la1_trim_ad.denominator_nv "Fahrzyklen" UWORD FORMULA_0010 0 0 0.0 65535.0000 ECU_ADDRESS 0x3FA08A /end MEASUREMENT
/begin MEASUREMENT ed_rbm_la2_trim_ad.denominator_nv "Fahrzyklen" UWORD FORMULA_0010 0 0 0.0 65535.0000 ECU_ADDRESS 0x3FA08E /end MEASUREMENT
/begin MEASUREMENT ed_rbm_lank1_openload.denominator_nv "Fahrzyklen" UWORD FORMULA_0010 0 0 0.0 65535.0000 ECU_ADDRESS 0x3FA092 /end MEASUREMENT
/begin MEASUREMENT ed_rbm_lank2_openload.denominator_nv "Fahrzyklen" UWORD FORMULA_0010 0 0 0.0 65535.0000 ECU_ADDRESS 0x3FA096 /end MEASUREMENT
/begin MEASUREMENT ed_rbm_lank1_obd_we.denominator_nv "Fahrzyklen" UWORD FORMULA_0010 0 0 0.0 65535.0000 ECU_ADDRESS 0x3FA09A /end MEASUREMENT
/begin MEASUREMENT ed_rbm_lank2_obd_we.denominator_nv "Fahrzyklen" UWORD FORMULA_0010 0 0 0.0 65535.0000 ECU_ADDRESS 0x3FA09E /end MEASUREMENT
/begin MEASUREMENT ed_rbm_lshnk1_r.denominator_nv "Fahrzyklen" UWORD FORMULA_0010 0 0 0.0 65535.0000 ECU_ADDRESS 0x3FA0A2 /end MEASUREMENT
/begin MEASUREMENT ed_rbm_lshnk2_r.denominator_nv "Fahrzyklen" UWORD FORMULA_0010 0 0 0.0 65535.0000 ECU_ADDRESS 0x3FA0A6 /end MEASUREMENT
/begin MEASUREMENT ed_rbm_pks_modell.denominator_nv "Fahrzyklen" UWORD FORMULA_0010 0 0 0.0 65535.0000 ECU_ADDRESS 0x3FA0AA /end MEASUREMENT
/begin MEASUREMENT ed_rbm_pks_paufbau.denominator_nv "Fahrzyklen" UWORD FORMULA_0010 0 0 0.0 65535.0000 ECU_ADDRESS 0x3FA0AE /end MEASUREMENT
/begin MEASUREMENT ed_rbm_pks_adapt_anschl.denominator_nv "Fahrzyklen" UWORD FORMULA_0010 0 0 0.0 65535.0000 ECU_ADDRESS 0x3FA0B2 /end MEASUREMENT
/begin MEASUREMENT ed_rbm_tgetr_hs.denominator_nv "Fahrzyklen" UWORD FORMULA_0010 0 0 0.0 65535.0000 ECU_ADDRESS 0x3FA0B6 /end MEASUREMENT
/begin MEASUREMENT ed_rbm_lavk_atic42.denominator_nv "Fahrzyklen" UWORD FORMULA_0010 0 0 0.0 65535.0000 ECU_ADDRESS 0x3FA0BA /end MEASUREMENT
/begin MEASUREMENT ed_rbm_pt_ax.denominator_nv "Fahrzyklen" UWORD FORMULA_0010 0 0 0.0 65535.0000 ECU_ADDRESS 0x3FA0BE /end MEASUREMENT
/begin MEASUREMENT ed_rbm_pt_obd_ed.denominator_nv "Fahrzyklen" UWORD FORMULA_0010 0 0 0.0 65535.0000 ECU_ADDRESS 0x3FA0C2 /end MEASUREMENT
/begin MEASUREMENT ed_rbm_fst_geber_li.denominator_nv "Fahrzyklen" UWORD FORMULA_0010 0 0 0.0 65535.0000 ECU_ADDRESS 0x3FA0C6 /end MEASUREMENT
/begin MEASUREMENT ed_rbm_fst_geber_re.denominator_nv "Fahrzyklen" UWORD FORMULA_0010 0 0 0.0 65535.0000 ECU_ADDRESS 0x3FA0CA /end MEASUREMENT
/begin MEASUREMENT ed_rbm_lank1_obd_slope.denominator_nv "Fahrzyklen" UWORD FORMULA_0010 0 0 0.0 65535.0000 ECU_ADDRESS 0x3FA0CE /end MEASUREMENT
/begin MEASUREMENT ed_rbm_lank2_obd_slope.denominator_nv "Fahrzyklen" UWORD FORMULA_0010 0 0 0.0 65535.0000 ECU_ADDRESS 0x3FA0D2 /end MEASUREMENT
/begin MEASUREMENT ed_rbm_mvac_obd.denominator_nv "Fahrzyklen" UWORD FORMULA_0010 0 0 0.0 65535.0000 ECU_ADDRESS 0x3FA0D6 /end MEASUREMENT
/begin MEASUREMENT ed_rbm_lavk2_atic42.denominator_nv "Fahrzyklen" UWORD FORMULA_0010 0 0 0.0 65535.0000 ECU_ADDRESS 0x3FA0DE /end MEASUREMENT
/begin MEASUREMENT ed_rbm_index_204_inj.denominator_nv "Fahrzyklen" UWORD FORMULA_0010 0 0 0.0 65535.0000 ECU_ADDRESS 0x3FA0E2 /end MEASUREMENT
/begin MEASUREMENT ed_rbm_index_205_inj.denominator_nv "Fahrzyklen" UWORD FORMULA_0010 0 0 0.0 65535.0000 ECU_ADDRESS 0x3FA0E6 /end MEASUREMENT
/begin MEASUREMENT ed_rbm_index_206_inj.denominator_nv "Fahrzyklen" UWORD FORMULA_0010 0 0 0.0 65535.0000 ECU_ADDRESS 0x3FA0EA /end MEASUREMENT
/begin MEASUREMENT ed_rbm_index_207_inj.denominator_nv "Fahrzyklen" UWORD FORMULA_0010 0 0 0.0 65535.0000 ECU_ADDRESS 0x3FA0EE /end MEASUREMENT
/begin MEASUREMENT ed_rbm_index_208_inj.denominator_nv "Fahrzyklen" UWORD FORMULA_0010 0 0 0.0 65535.0000 ECU_ADDRESS 0x3FA0F2 /end MEASUREMENT
/begin MEASUREMENT ed_rbm_index_209_inj.denominator_nv "Fahrzyklen" UWORD FORMULA_0010 0 0 0.0 65535.0000 ECU_ADDRESS 0x3FA0F6 /end MEASUREMENT
/begin MEASUREMENT ed_rbm_index_210_inj.denominator_nv "Fahrzyklen" UWORD FORMULA_0010 0 0 0.0 65535.0000 ECU_ADDRESS 0x3FA0FA /end MEASUREMENT
/begin MEASUREMENT ed_rbm_index_211_inj.denominator_nv "Fahrzyklen" UWORD FORMULA_0010 0 0 0.0 65535.0000 ECU_ADDRESS 0x3FA0FE /end MEASUREMENT
/begin MEASUREMENT ed_rbm_index_212_inj.denominator_nv "Fahrzyklen" UWORD FORMULA_0010 0 0 0.0 65535.0000 ECU_ADDRESS 0x3FA102 /end MEASUREMENT
/begin MEASUREMENT ed_rbm_index_213_inj.denominator_nv "Fahrzyklen" UWORD FORMULA_0010 0 0 0.0 65535.0000 ECU_ADDRESS 0x3FA106 /end MEASUREMENT
/begin MEASUREMENT ed_rbm_index_214_inj.denominator_nv "Fahrzyklen" UWORD FORMULA_0010 0 0 0.0 65535.0000 ECU_ADDRESS 0x3FA10A /end MEASUREMENT
/begin MEASUREMENT ed_rbm_index_215_inj.denominator_nv "Fahrzyklen" UWORD FORMULA_0010 0 0 0.0 65535.0000 ECU_ADDRESS 0x3FA10E /end MEASUREMENT
/begin MEASUREMENT ed_rbm_index_216_inj.denominator_nv "Fahrzyklen" UWORD FORMULA_0010 0 0 0.0 65535.0000 ECU_ADDRESS 0x3FA112 /end MEASUREMENT
/begin MEASUREMENT ed_rbm_index_217_inj.denominator_nv "Fahrzyklen" UWORD FORMULA_0010 0 0 0.0 65535.0000 ECU_ADDRESS 0x3FA116 /end MEASUREMENT
/begin MEASUREMENT ed_rbm_index_218_inj.denominator_nv "Fahrzyklen" UWORD FORMULA_0010 0 0 0.0 65535.0000 ECU_ADDRESS 0x3FA11A /end MEASUREMENT
/begin MEASUREMENT ed_rbm_index_219_inj.denominator_nv "Fahrzyklen" UWORD FORMULA_0010 0 0 0.0 65535.0000 ECU_ADDRESS 0x3FA11E /end MEASUREMENT
/begin MEASUREMENT ed_rbm_index_220_inj.denominator_nv "Fahrzyklen" UWORD FORMULA_0010 0 0 0.0 65535.0000 ECU_ADDRESS 0x3FA122 /end MEASUREMENT
/begin MEASUREMENT ed_rbm_index_221_inj.denominator_nv "Fahrzyklen" UWORD FORMULA_0010 0 0 0.0 65535.0000 ECU_ADDRESS 0x3FA126 /end MEASUREMENT
/begin MEASUREMENT ed_rbm_index_222_inj.denominator_nv "Fahrzyklen" UWORD FORMULA_0010 0 0 0.0 65535.0000 ECU_ADDRESS 0x3FA12A /end MEASUREMENT
/begin MEASUREMENT ed_rbm_index_223_inj.denominator_nv "Fahrzyklen" UWORD FORMULA_0010 0 0 0.0 65535.0000 ECU_ADDRESS 0x3FA12E /end MEASUREMENT
/begin MEASUREMENT ed_st_fehler_inj_1of7_ "ED-Gesamtstatus INJ-Fehler" ULONG FORMULA_0000 0 0 0.0 4294967295.0000 ECU_ADDRESS 0x3F884C /end MEASUREMENT
/begin MEASUREMENT ed_st_fehler_inj_2of7_ "ED-Gesamtstatus INJ-Fehler" ULONG FORMULA_0000 0 0 0.0 4294967295.0000 ECU_ADDRESS 0x3F8850 /end MEASUREMENT
/begin MEASUREMENT ed_st_fehler_inj_3of7_ "ED-Gesamtstatus INJ-Fehler" ULONG FORMULA_0000 0 0 0.0 4294967295.0000 ECU_ADDRESS 0x3F8854 /end MEASUREMENT
/begin MEASUREMENT ed_st_fehler_inj_4of7_ "ED-Gesamtstatus INJ-Fehler" ULONG FORMULA_0000 0 0 0.0 4294967295.0000 ECU_ADDRESS 0x3F8858 /end MEASUREMENT
/begin MEASUREMENT ed_st_fehler_inj_5of7_ "ED-Gesamtstatus INJ-Fehler" ULONG FORMULA_0000 0 0 0.0 4294967295.0000 ECU_ADDRESS 0x3F885C /end MEASUREMENT
/begin MEASUREMENT ed_st_fehler_inj_6of7_ "ED-Gesamtstatus INJ-Fehler" ULONG FORMULA_0000 0 0 0.0 4294967295.0000 ECU_ADDRESS 0x3F8860 /end MEASUREMENT
/begin MEASUREMENT ed_st_fehler_inj_7of7_ "ED-Gesamtstatus INJ-Fehler" ULONG FORMULA_0000 0 0 0.0 4294967295.0000 ECU_ADDRESS 0x3F8864 /end MEASUREMENT
/begin MEASUREMENT ed_st_filter_inj_1of7_ "ED-Gesamtstatus INJ-Filter" ULONG FORMULA_0000 0 0 0.0 4294967295.0000 ECU_ADDRESS 0x3F8868 /end MEASUREMENT
/begin MEASUREMENT ed_st_filter_inj_2of7_ "ED-Gesamtstatus INJ-Filter" ULONG FORMULA_0000 0 0 0.0 4294967295.0000 ECU_ADDRESS 0x3F886C /end MEASUREMENT
/begin MEASUREMENT ed_st_filter_inj_3of7_ "ED-Gesamtstatus INJ-Filter" ULONG FORMULA_0000 0 0 0.0 4294967295.0000 ECU_ADDRESS 0x3F8870 /end MEASUREMENT
/begin MEASUREMENT ed_st_filter_inj_4of7_ "ED-Gesamtstatus INJ-Filter" ULONG FORMULA_0000 0 0 0.0 4294967295.0000 ECU_ADDRESS 0x3F8874 /end MEASUREMENT
/begin MEASUREMENT ed_st_filter_inj_5of7_ "ED-Gesamtstatus INJ-Filter" ULONG FORMULA_0000 0 0 0.0 4294967295.0000 ECU_ADDRESS 0x3F8878 /end MEASUREMENT
/begin MEASUREMENT ed_st_filter_inj_6of7_ "ED-Gesamtstatus INJ-Filter" ULONG FORMULA_0000 0 0 0.0 4294967295.0000 ECU_ADDRESS 0x3F887C /end MEASUREMENT
/begin MEASUREMENT ed_st_filter_inj_7of7_ "ED-Gesamtstatus INJ-Filter" ULONG FORMULA_0000 0 0 0.0 4294967295.0000 ECU_ADDRESS 0x3F8880 /end MEASUREMENT
/begin MEASUREMENT ed_st_fehler_ign_1of4_ "ED-Gesamtstatus IGN-Fehler" ULONG FORMULA_0000 0 0 0.0 4294967295.0000 ECU_ADDRESS 0x3F8584 /end MEASUREMENT
/begin MEASUREMENT ed_st_fehler_ign_2of4_ "ED-Gesamtstatus IGN-Fehler" ULONG FORMULA_0000 0 0 0.0 4294967295.0000 ECU_ADDRESS 0x3F8588 /end MEASUREMENT
/begin MEASUREMENT ed_st_fehler_ign_3of4_ "ED-Gesamtstatus IGN-Fehler" ULONG FORMULA_0000 0 0 0.0 4294967295.0000 ECU_ADDRESS 0x3F858C /end MEASUREMENT
/begin MEASUREMENT ed_st_fehler_ign_4of4_ "ED-Gesamtstatus IGN-Fehler" ULONG FORMULA_0000 0 0 0.0 4294967295.0000 ECU_ADDRESS 0x3F8590 /end MEASUREMENT
/begin MEASUREMENT ed_st_filter_ign_1of4_ "ED-Gesamtstatus IGN-Filter" ULONG FORMULA_0000 0 0 0.0 4294967295.0000 ECU_ADDRESS 0x3F8594 /end MEASUREMENT
/begin MEASUREMENT ed_st_filter_ign_2of4_ "ED-Gesamtstatus IGN-Filter" ULONG FORMULA_0000 0 0 0.0 4294967295.0000 ECU_ADDRESS 0x3F8598 /end MEASUREMENT
/begin MEASUREMENT ed_st_filter_ign_3of4_ "ED-Gesamtstatus IGN-Filter" ULONG FORMULA_0000 0 0 0.0 4294967295.0000 ECU_ADDRESS 0x3F859C /end MEASUREMENT
/begin MEASUREMENT ed_st_filter_ign_4of4_ "ED-Gesamtstatus IGN-Filter" ULONG FORMULA_0000 0 0 0.0 4294967295.0000 ECU_ADDRESS 0x3F85A0 /end MEASUREMENT
/begin MEASUREMENT ed_rbm_time "Motor laeuft fuer Rate Based" UWORD FORMULA_0073 0 0 0.0 6553.5000 ECU_ADDRESS 0x3FBF5A /end MEASUREMENT
/begin MEASUREMENT ed_rbm_time_ll "Zeit im Leerlauf" UWORD FORMULA_0073 0 0 0.0 6553.5000 ECU_ADDRESS 0x3FBF5C /end MEASUREMENT
/begin MEASUREMENT ed_rbm_time_v "Zeit mit Mindestgeschwindigkeit" UWORD FORMULA_0073 0 0 0.0 6553.5000 ECU_ADDRESS 0x3FBF5E /end MEASUREMENT
/begin CHARACTERISTIC K_ED_APPL_DATA_INJ.P_CODE_SH_TO_UB "P-Code fuer die Art SH_TO_UB | EN: Fault code APPL_DATA_INJ - OBD P-code reported for short to battery voltage" VALUE 0x70F8A TKW_VV_VV_UW 100.0 FORMULA_0010 0.0 65535.0000 /end CHARACTERISTIC
/begin CHARACTERISTIC K_ED_EV1.P_CODE_SH_TO_UB "P-Code fuer die Art SH_TO_UB | EN: Fault code EV1 - OBD P-code reported for short to battery voltage" VALUE 0x711AC TKW_VV_VV_UW 100.0 FORMULA_0010 0.0 65535.0000 /end CHARACTERISTIC
/begin CHARACTERISTIC K_ED_EV2.P_CODE_SH_TO_UB "P-Code fuer die Art SH_TO_UB | EN: Fault code EV2 - OBD P-code reported for short to battery voltage" VALUE 0x711C6 TKW_VV_VV_UW 100.0 FORMULA_0010 0.0 65535.0000 /end CHARACTERISTIC
/begin CHARACTERISTIC K_ED_EV3.P_CODE_SH_TO_UB "P-Code fuer die Art SH_TO_UB | EN: Fault code EV3 - OBD P-code reported for short to battery voltage" VALUE 0x711E0 TKW_VV_VV_UW 100.0 FORMULA_0010 0.0 65535.0000 /end CHARACTERISTIC
/begin CHARACTERISTIC K_ED_EV4.P_CODE_SH_TO_UB "P-Code fuer die Art SH_TO_UB | EN: Fault code EV4 - OBD P-code reported for short to battery voltage" VALUE 0x711FA TKW_VV_VV_UW 100.0 FORMULA_0010 0.0 65535.0000 /end CHARACTERISTIC
/begin CHARACTERISTIC K_ED_EV5.P_CODE_SH_TO_UB "P-Code fuer die Art SH_TO_UB | EN: Fault code EV5 - OBD P-code reported for short to battery voltage" VALUE 0x71214 TKW_VV_VV_UW 100.0 FORMULA_0010 0.0 65535.0000 /end CHARACTERISTIC
/begin CHARACTERISTIC K_ED_EV6.P_CODE_SH_TO_UB "P-Code fuer die Art SH_TO_UB | EN: Fault code EV6 - OBD P-code reported for short to battery voltage" VALUE 0x7122E TKW_VV_VV_UW 100.0 FORMULA_0010 0.0 65535.0000 /end CHARACTERISTIC
/begin CHARACTERISTIC K_ED_EV7.P_CODE_SH_TO_UB "P-Code fuer die Art SH_TO_UB | EN: Fault code EV7 - OBD P-code reported for short to battery voltage" VALUE 0x71248 TKW_VV_VV_UW 100.0 FORMULA_0010 0.0 65535.0000 /end CHARACTERISTIC
/begin CHARACTERISTIC K_ED_EV8.P_CODE_SH_TO_UB "P-Code fuer die Art SH_TO_UB | EN: Fault code EV8 - OBD P-code reported for short to battery voltage" VALUE 0x71262 TKW_VV_VV_UW 100.0 FORMULA_0010 0.0 65535.0000 /end CHARACTERISTIC
/begin CHARACTERISTIC K_ED_EV9.P_CODE_SH_TO_UB "P-Code fuer die Art SH_TO_UB | EN: Fault code EV9 - OBD P-code reported for short to battery voltage" VALUE 0x7127C TKW_VV_VV_UW 100.0 FORMULA_0010 0.0 65535.0000 /end CHARACTERISTIC
/begin CHARACTERISTIC K_ED_EV10.P_CODE_SH_TO_UB "P-Code fuer die Art SH_TO_UB | EN: Fault code EV10 - OBD P-code reported for short to battery voltage" VALUE 0x71296 TKW_VV_VV_UW 100.0 FORMULA_0010 0.0 65535.0000 /end CHARACTERISTIC
/begin CHARACTERISTIC K_ED_DMTL_P.P_CODE_SH_TO_UB "P-Code fuer die Art SH_TO_UB | EN: Fault code DMTL_P - OBD P-code reported for short to battery voltage" VALUE 0x71332 TKW_VV_VV_UW 100.0 FORMULA_0010 0.0 65535.0000 /end CHARACTERISTIC
/begin CHARACTERISTIC K_ED_DMTL_V.P_CODE_SH_TO_UB "P-Code fuer die Art SH_TO_UB | EN: Fault code DMTL_V - OBD P-code reported for short to battery voltage" VALUE 0x7134C TKW_VV_VV_UW 100.0 FORMULA_0010 0.0 65535.0000 /end CHARACTERISTIC
/begin CHARACTERISTIC K_ED_DMTL_H.P_CODE_SH_TO_UB "P-Code fuer die Art SH_TO_UB | EN: Fault code DMTL_H - OBD P-code reported for short to battery voltage" VALUE 0x71366 TKW_VV_VV_UW 100.0 FORMULA_0010 0.0 65535.0000 /end CHARACTERISTIC
/begin CHARACTERISTIC K_ED_DMTL_GROBLECK.P_CODE_SH_TO_UB "P-Code fuer die Art SH_TO_UB | EN: Fault code DMTL_GROBLECK - OBD P-code reported for short to battery voltage" VALUE 0x71380 TKW_VV_VV_UW 100.0 FORMULA_0010 0.0 65535.0000 /end CHARACTERISTIC
/begin CHARACTERISTIC K_ED_DMTL_FEUCHT.P_CODE_SH_TO_UB "P-Code fuer die Art SH_TO_UB | EN: Fault code DMTL_FEUCHT - OBD P-code reported for short to battery voltage" VALUE 0x7139A TKW_VV_VV_UW 100.0 FORMULA_0010 0.0 65535.0000 /end CHARACTERISTIC
/begin CHARACTERISTIC K_ED_DMTL_DECKEL.P_CODE_SH_TO_UB "P-Code fuer die Art SH_TO_UB | EN: Fault code DMTL_DECKEL - OBD P-code reported for short to battery voltage" VALUE 0x713B4 TKW_VV_VV_UW 100.0 FORMULA_0010 0.0 65535.0000 /end CHARACTERISTIC
/begin CHARACTERISTIC K_ED_EKP_PWM.P_CODE_SH_TO_UB "P-Code fuer die Art SH_TO_UB | EN: Fault code EKP_PWM - OBD P-code reported for short to battery voltage" VALUE 0x7141C TKW_VV_VV_UW 100.0 FORMULA_0010 0.0 65535.0000 /end CHARACTERISTIC
/begin CHARACTERISTIC K_ED_FI_GEN.P_CODE_SH_TO_UB "P-Code fuer die Art SH_TO_UB | EN: Fault code FI_GEN - OBD P-code reported for short to battery voltage" VALUE 0x7156E TKW_VV_VV_UW 100.0 FORMULA_0010 0.0 65535.0000 /end CHARACTERISTIC
/begin CHARACTERISTIC K_ED_FI_BSD.P_CODE_SH_TO_UB "P-Code fuer die Art SH_TO_UB | EN: Fault code FI_BSD - OBD P-code reported for short to battery voltage" VALUE 0x71588 TKW_VV_VV_UW 100.0 FORMULA_0010 0.0 65535.0000 /end CHARACTERISTIC
/begin CHARACTERISTIC K_ED_FI_IBS1.P_CODE_SH_TO_UB "P-Code fuer die Art SH_TO_UB | EN: Fault code FI_IBS1 - OBD P-code reported for short to battery voltage" VALUE 0x715BC TKW_VV_VV_UW 100.0 FORMULA_0010 0.0 65535.0000 /end CHARACTERISTIC
/begin CHARACTERISTIC K_ED_FI_IBS2.P_CODE_SH_TO_UB "P-Code fuer die Art SH_TO_UB | EN: Fault code FI_IBS2 - OBD P-code reported for short to battery voltage" VALUE 0x715D6 TKW_VV_VV_UW 100.0 FORMULA_0010 0.0 65535.0000 /end CHARACTERISTIC
/begin CHARACTERISTIC K_ED_FI_IBS3.P_CODE_SH_TO_UB "P-Code fuer die Art SH_TO_UB | EN: Fault code FI_IBS3 - OBD P-code reported for short to battery voltage" VALUE 0x715F0 TKW_VV_VV_UW 100.0 FORMULA_0010 0.0 65535.0000 /end CHARACTERISTIC
/begin CHARACTERISTIC K_ED_FI_PMBATT.P_CODE_SH_TO_UB "P-Code fuer die Art SH_TO_UB | EN: Fault code FI_PMBATT - OBD P-code reported for short to battery voltage" VALUE 0x71624 TKW_VV_VV_UW 100.0 FORMULA_0010 0.0 65535.0000 /end CHARACTERISTIC
/begin CHARACTERISTIC K_ED_EWS_SCI.P_CODE_SH_TO_UB "P-Code fuer die Art SH_TO_UB | EN: Fault code EWS_SCI - OBD P-code reported for short to battery voltage" VALUE 0x716A6 TKW_VV_VV_UW 100.0 FORMULA_0010 0.0 65535.0000 /end CHARACTERISTIC
/begin CHARACTERISTIC K_ED_EWS_MAN.P_CODE_SH_TO_UB "P-Code fuer die Art SH_TO_UB | EN: Fault code EWS_MAN - OBD P-code reported for short to battery voltage" VALUE 0x716C0 TKW_VV_VV_UW 100.0 FORMULA_0010 0.0 65535.0000 /end CHARACTERISTIC
/begin CHARACTERISTIC K_ED_FI_BSD_0.P_CODE_SH_TO_UB "P-Code fuer die Art SH_TO_UB | EN: Fault code FI_BSD_0 - OBD P-code reported for short to battery voltage" VALUE 0x716DA TKW_VV_VV_UW 100.0 FORMULA_0010 0.0 65535.0000 /end CHARACTERISTIC
/begin CHARACTERISTIC K_ED_FI_BSD_6.P_CODE_SH_TO_UB "P-Code fuer die Art SH_TO_UB | EN: Fault code FI_BSD_6 - OBD P-code reported for short to battery voltage" VALUE 0x716F4 TKW_VV_VV_UW 100.0 FORMULA_0010 0.0 65535.0000 /end CHARACTERISTIC
/begin CHARACTERISTIC K_ED_FI_BSDGLOB.P_CODE_SH_TO_UB "P-Code fuer die Art SH_TO_UB | EN: Fault code FI_BSDGLOB - OBD P-code reported for short to battery voltage" VALUE 0x7170E TKW_VV_VV_UW 100.0 FORMULA_0010 0.0 65535.0000 /end CHARACTERISTIC
/begin CHARACTERISTIC K_ED_EBOX_ELU.P_CODE_SH_TO_UB "P-Code fuer die Art SH_TO_UB | EN: Fault code EBOX_ELU - OBD P-code reported for short to battery voltage" VALUE 0x7175C TKW_VV_VV_UW 100.0 FORMULA_0010 0.0 65535.0000 /end CHARACTERISTIC
/begin CHARACTERISTIC K_ED_DK1_ENLTG.P_CODE_SH_TO_UB "P-Code fuer die Art SH_TO_UB | EN: Fault code DK1_ENLTG - OBD P-code reported for short to battery voltage" VALUE 0x71790 TKW_VV_VV_UW 100.0 FORMULA_0010 0.0 65535.0000 /end CHARACTERISTIC
/begin CHARACTERISTIC K_ED_DK2_ENLTG.P_CODE_SH_TO_UB "P-Code fuer die Art SH_TO_UB | EN: Fault code DK2_ENLTG - OBD P-code reported for short to battery voltage" VALUE 0x717AA TKW_VV_VV_UW 100.0 FORMULA_0010 0.0 65535.0000 /end CHARACTERISTIC
/begin CHARACTERISTIC K_ED_E2_INJ.P_CODE_SH_TO_UB "P-Code fuer die Art SH_TO_UB | EN: Fault code E2_INJ - OBD P-code reported for short to battery voltage" VALUE 0x71846 TKW_VV_VV_UW 100.0 FORMULA_0010 0.0 65535.0000 /end CHARACTERISTIC
/begin CHARACTERISTIC K_ED_FETRAWE.P_CODE_SH_TO_UB "P-Code fuer die Art SH_TO_UB | EN: Fault code FETRAWE - OBD P-code reported for short to battery voltage" VALUE 0x71964 TKW_VV_VV_UW 100.0 FORMULA_0010 0.0 65535.0000 /end CHARACTERISTIC
/begin CHARACTERISTIC K_ED_ELUP.P_CODE_SH_TO_UB "P-Code fuer die Art SH_TO_UB | EN: Fault code ELUP - OBD P-code reported for short to battery voltage" VALUE 0x719CC TKW_VV_VV_UW 100.0 FORMULA_0010 0.0 65535.0000 /end CHARACTERISTIC
/begin CHARACTERISTIC K_ED_ELU.P_CODE_SH_TO_UB "P-Code fuer die Art SH_TO_UB | EN: Fault code ELU - OBD P-code reported for short to battery voltage" VALUE 0x719E6 TKW_VV_VV_UW 100.0 FORMULA_0010 0.0 65535.0000 /end CHARACTERISTIC
/begin CHARACTERISTIC K_ED_DMTL_FEINLECK.P_CODE_SH_TO_UB "P-Code fuer die Art SH_TO_UB | EN: Fault code DMTL_FEINLECK - OBD P-code reported for short to battery voltage" VALUE 0x71B04 TKW_VV_VV_UW 100.0 FORMULA_0010 0.0 65535.0000 /end CHARACTERISTIC
/begin CHARACTERISTIC K_ED_ELUP_OBD.P_CODE_SH_TO_UB "P-Code fuer die Art SH_TO_UB" VALUE 0x71D5A TKW_VV_VV_UW 100.0 FORMULA_0010 0.0 65535.0000 /end CHARACTERISTIC
/begin CHARACTERISTIC K_ED_APPL_DATA_INJ.P_CODE_SH_TO_GND "P-Code fuer die Art SH_TO_GND | EN: Fault code APPL_DATA_INJ - OBD P-code reported for short to ground" VALUE 0x70F8C TKW_VV_VV_UW 100.0 FORMULA_0010 0.0 65535.0000 /end CHARACTERISTIC
/begin CHARACTERISTIC K_ED_EV1.P_CODE_SH_TO_GND "P-Code fuer die Art SH_TO_GND | EN: Fault code EV1 - OBD P-code reported for short to ground" VALUE 0x711AE TKW_VV_VV_UW 100.0 FORMULA_0010 0.0 65535.0000 /end CHARACTERISTIC
/begin CHARACTERISTIC K_ED_EV2.P_CODE_SH_TO_GND "P-Code fuer die Art SH_TO_GND | EN: Fault code EV2 - OBD P-code reported for short to ground" VALUE 0x711C8 TKW_VV_VV_UW 100.0 FORMULA_0010 0.0 65535.0000 /end CHARACTERISTIC
/begin CHARACTERISTIC K_ED_EV3.P_CODE_SH_TO_GND "P-Code fuer die Art SH_TO_GND | EN: Fault code EV3 - OBD P-code reported for short to ground" VALUE 0x711E2 TKW_VV_VV_UW 100.0 FORMULA_0010 0.0 65535.0000 /end CHARACTERISTIC
/begin CHARACTERISTIC K_ED_EV4.P_CODE_SH_TO_GND "P-Code fuer die Art SH_TO_GND | EN: Fault code EV4 - OBD P-code reported for short to ground" VALUE 0x711FC TKW_VV_VV_UW 100.0 FORMULA_0010 0.0 65535.0000 /end CHARACTERISTIC
/begin CHARACTERISTIC K_ED_EV5.P_CODE_SH_TO_GND "P-Code fuer die Art SH_TO_GND | EN: Fault code EV5 - OBD P-code reported for short to ground" VALUE 0x71216 TKW_VV_VV_UW 100.0 FORMULA_0010 0.0 65535.0000 /end CHARACTERISTIC
/begin CHARACTERISTIC K_ED_EV6.P_CODE_SH_TO_GND "P-Code fuer die Art SH_TO_GND | EN: Fault code EV6 - OBD P-code reported for short to ground" VALUE 0x71230 TKW_VV_VV_UW 100.0 FORMULA_0010 0.0 65535.0000 /end CHARACTERISTIC
/begin CHARACTERISTIC K_ED_EV7.P_CODE_SH_TO_GND "P-Code fuer die Art SH_TO_GND | EN: Fault code EV7 - OBD P-code reported for short to ground" VALUE 0x7124A TKW_VV_VV_UW 100.0 FORMULA_0010 0.0 65535.0000 /end CHARACTERISTIC
/begin CHARACTERISTIC K_ED_EV8.P_CODE_SH_TO_GND "P-Code fuer die Art SH_TO_GND | EN: Fault code EV8 - OBD P-code reported for short to ground" VALUE 0x71264 TKW_VV_VV_UW 100.0 FORMULA_0010 0.0 65535.0000 /end CHARACTERISTIC
/begin CHARACTERISTIC K_ED_EV9.P_CODE_SH_TO_GND "P-Code fuer die Art SH_TO_GND | EN: Fault code EV9 - OBD P-code reported for short to ground" VALUE 0x7127E TKW_VV_VV_UW 100.0 FORMULA_0010 0.0 65535.0000 /end CHARACTERISTIC
/begin CHARACTERISTIC K_ED_EV10.P_CODE_SH_TO_GND "P-Code fuer die Art SH_TO_GND | EN: Fault code EV10 - OBD P-code reported for short to ground" VALUE 0x71298 TKW_VV_VV_UW 100.0 FORMULA_0010 0.0 65535.0000 /end CHARACTERISTIC
/begin CHARACTERISTIC K_ED_DMTL_P.P_CODE_SH_TO_GND "P-Code fuer die Art SH_TO_GND | EN: Fault code DMTL_P - OBD P-code reported for short to ground" VALUE 0x71334 TKW_VV_VV_UW 100.0 FORMULA_0010 0.0 65535.0000 /end CHARACTERISTIC
/begin CHARACTERISTIC K_ED_DMTL_V.P_CODE_SH_TO_GND "P-Code fuer die Art SH_TO_GND | EN: Fault code DMTL_V - OBD P-code reported for short to ground" VALUE 0x7134E TKW_VV_VV_UW 100.0 FORMULA_0010 0.0 65535.0000 /end CHARACTERISTIC
/begin CHARACTERISTIC K_ED_DMTL_H.P_CODE_SH_TO_GND "P-Code fuer die Art SH_TO_GND | EN: Fault code DMTL_H - OBD P-code reported for short to ground" VALUE 0x71368 TKW_VV_VV_UW 100.0 FORMULA_0010 0.0 65535.0000 /end CHARACTERISTIC
/begin CHARACTERISTIC K_ED_DMTL_GROBLECK.P_CODE_SH_TO_GND "P-Code fuer die Art SH_TO_GND | EN: Fault code DMTL_GROBLECK - OBD P-code reported for short to ground" VALUE 0x71382 TKW_VV_VV_UW 100.0 FORMULA_0010 0.0 65535.0000 /end CHARACTERISTIC
/begin CHARACTERISTIC K_ED_DMTL_FEUCHT.P_CODE_SH_TO_GND "P-Code fuer die Art SH_TO_GND | EN: Fault code DMTL_FEUCHT - OBD P-code reported for short to ground" VALUE 0x7139C TKW_VV_VV_UW 100.0 FORMULA_0010 0.0 65535.0000 /end CHARACTERISTIC
/begin CHARACTERISTIC K_ED_DMTL_DECKEL.P_CODE_SH_TO_GND "P-Code fuer die Art SH_TO_GND | EN: Fault code DMTL_DECKEL - OBD P-code reported for short to ground" VALUE 0x713B6 TKW_VV_VV_UW 100.0 FORMULA_0010 0.0 65535.0000 /end CHARACTERISTIC
/begin CHARACTERISTIC K_ED_EKP_PWM.P_CODE_SH_TO_GND "P-Code fuer die Art SH_TO_GND | EN: Fault code EKP_PWM - OBD P-code reported for short to ground" VALUE 0x7141E TKW_VV_VV_UW 100.0 FORMULA_0010 0.0 65535.0000 /end CHARACTERISTIC
/begin CHARACTERISTIC K_ED_FI_GEN.P_CODE_SH_TO_GND "P-Code fuer die Art SH_TO_GND | EN: Fault code FI_GEN - OBD P-code reported for short to ground" VALUE 0x71570 TKW_VV_VV_UW 100.0 FORMULA_0010 0.0 65535.0000 /end CHARACTERISTIC
/begin CHARACTERISTIC K_ED_FI_BSD.P_CODE_SH_TO_GND "P-Code fuer die Art SH_TO_GND | EN: Fault code FI_BSD - OBD P-code reported for short to ground" VALUE 0x7158A TKW_VV_VV_UW 100.0 FORMULA_0010 0.0 65535.0000 /end CHARACTERISTIC
/begin CHARACTERISTIC K_ED_FI_IBS1.P_CODE_SH_TO_GND "P-Code fuer die Art SH_TO_GND | EN: Fault code FI_IBS1 - OBD P-code reported for short to ground" VALUE 0x715BE TKW_VV_VV_UW 100.0 FORMULA_0010 0.0 65535.0000 /end CHARACTERISTIC
/begin CHARACTERISTIC K_ED_FI_IBS2.P_CODE_SH_TO_GND "P-Code fuer die Art SH_TO_GND | EN: Fault code FI_IBS2 - OBD P-code reported for short to ground" VALUE 0x715D8 TKW_VV_VV_UW 100.0 FORMULA_0010 0.0 65535.0000 /end CHARACTERISTIC
/begin CHARACTERISTIC K_ED_FI_IBS3.P_CODE_SH_TO_GND "P-Code fuer die Art SH_TO_GND | EN: Fault code FI_IBS3 - OBD P-code reported for short to ground" VALUE 0x715F2 TKW_VV_VV_UW 100.0 FORMULA_0010 0.0 65535.0000 /end CHARACTERISTIC
/begin CHARACTERISTIC K_ED_FI_PMBATT.P_CODE_SH_TO_GND "P-Code fuer die Art SH_TO_GND | EN: Fault code FI_PMBATT - OBD P-code reported for short to ground" VALUE 0x71626 TKW_VV_VV_UW 100.0 FORMULA_0010 0.0 65535.0000 /end CHARACTERISTIC
/begin CHARACTERISTIC K_ED_EWS_SCI.P_CODE_SH_TO_GND "P-Code fuer die Art SH_TO_GND | EN: Fault code EWS_SCI - OBD P-code reported for short to ground" VALUE 0x716A8 TKW_VV_VV_UW 100.0 FORMULA_0010 0.0 65535.0000 /end CHARACTERISTIC
/begin CHARACTERISTIC K_ED_EWS_MAN.P_CODE_SH_TO_GND "P-Code fuer die Art SH_TO_GND | EN: Fault code EWS_MAN - OBD P-code reported for short to ground" VALUE 0x716C2 TKW_VV_VV_UW 100.0 FORMULA_0010 0.0 65535.0000 /end CHARACTERISTIC
/begin CHARACTERISTIC K_ED_FI_BSD_0.P_CODE_SH_TO_GND "P-Code fuer die Art SH_TO_GND | EN: Fault code FI_BSD_0 - OBD P-code reported for short to ground" VALUE 0x716DC TKW_VV_VV_UW 100.0 FORMULA_0010 0.0 65535.0000 /end CHARACTERISTIC
/begin CHARACTERISTIC K_ED_FI_BSD_6.P_CODE_SH_TO_GND "P-Code fuer die Art SH_TO_GND | EN: Fault code FI_BSD_6 - OBD P-code reported for short to ground" VALUE 0x716F6 TKW_VV_VV_UW 100.0 FORMULA_0010 0.0 65535.0000 /end CHARACTERISTIC
/begin CHARACTERISTIC K_ED_FI_BSDGLOB.P_CODE_SH_TO_GND "P-Code fuer die Art SH_TO_GND | EN: Fault code FI_BSDGLOB - OBD P-code reported for short to ground" VALUE 0x71710 TKW_VV_VV_UW 100.0 FORMULA_0010 0.0 65535.0000 /end CHARACTERISTIC
/begin CHARACTERISTIC K_ED_EBOX_ELU.P_CODE_SH_TO_GND "P-Code fuer die Art SH_TO_GND | EN: Fault code EBOX_ELU - OBD P-code reported for short to ground" VALUE 0x7175E TKW_VV_VV_UW 100.0 FORMULA_0010 0.0 65535.0000 /end CHARACTERISTIC
/begin CHARACTERISTIC K_ED_DK1_ENLTG.P_CODE_SH_TO_GND "P-Code fuer die Art SH_TO_GND | EN: Fault code DK1_ENLTG - OBD P-code reported for short to ground" VALUE 0x71792 TKW_VV_VV_UW 100.0 FORMULA_0010 0.0 65535.0000 /end CHARACTERISTIC
/begin CHARACTERISTIC K_ED_DK2_ENLTG.P_CODE_SH_TO_GND "P-Code fuer die Art SH_TO_GND | EN: Fault code DK2_ENLTG - OBD P-code reported for short to ground" VALUE 0x717AC TKW_VV_VV_UW 100.0 FORMULA_0010 0.0 65535.0000 /end CHARACTERISTIC
/begin CHARACTERISTIC K_ED_E2_INJ.P_CODE_SH_TO_GND "P-Code fuer die Art SH_TO_GND | EN: Fault code E2_INJ - OBD P-code reported for short to ground" VALUE 0x71848 TKW_VV_VV_UW 100.0 FORMULA_0010 0.0 65535.0000 /end CHARACTERISTIC
/begin CHARACTERISTIC K_ED_FETRAWE.P_CODE_SH_TO_GND "P-Code fuer die Art SH_TO_GND | EN: Fault code FETRAWE - OBD P-code reported for short to ground" VALUE 0x71966 TKW_VV_VV_UW 100.0 FORMULA_0010 0.0 65535.0000 /end CHARACTERISTIC
/begin CHARACTERISTIC K_ED_ELUP.P_CODE_SH_TO_GND "P-Code fuer die Art SH_TO_GND | EN: Fault code ELUP - OBD P-code reported for short to ground" VALUE 0x719CE TKW_VV_VV_UW 100.0 FORMULA_0010 0.0 65535.0000 /end CHARACTERISTIC
/begin CHARACTERISTIC K_ED_ELU.P_CODE_SH_TO_GND "P-Code fuer die Art SH_TO_GND | EN: Fault code ELU - OBD P-code reported for short to ground" VALUE 0x719E8 TKW_VV_VV_UW 100.0 FORMULA_0010 0.0 65535.0000 /end CHARACTERISTIC
/begin CHARACTERISTIC K_ED_DMTL_FEINLECK.P_CODE_SH_TO_GND "P-Code fuer die Art SH_TO_GND | EN: Fault code DMTL_FEINLECK - OBD P-code reported for short to ground" VALUE 0x71B06 TKW_VV_VV_UW 100.0 FORMULA_0010 0.0 65535.0000 /end CHARACTERISTIC
/begin CHARACTERISTIC K_ED_ELUP_OBD.P_CODE_SH_TO_GND "P-Code fuer die Art SH_TO_GND" VALUE 0x71D5C TKW_VV_VV_UW 100.0 FORMULA_0010 0.0 65535.0000 /end CHARACTERISTIC
/begin CHARACTERISTIC K_ED_APPL_DATA_INJ.P_CODE_OPENLOAD "P-Code fuer die Art OPENLOAD | EN: Fault code APPL_DATA_INJ - OBD P-code reported for open circuit" VALUE 0x70F8E TKW_VV_VV_UW 100.0 FORMULA_0010 0.0 65535.0000 /end CHARACTERISTIC
/begin CHARACTERISTIC K_ED_EV1.P_CODE_OPENLOAD "P-Code fuer die Art OPENLOAD | EN: Fault code EV1 - OBD P-code reported for open circuit" VALUE 0x711B0 TKW_VV_VV_UW 100.0 FORMULA_0010 0.0 65535.0000 /end CHARACTERISTIC
/begin CHARACTERISTIC K_ED_EV2.P_CODE_OPENLOAD "P-Code fuer die Art OPENLOAD | EN: Fault code EV2 - OBD P-code reported for open circuit" VALUE 0x711CA TKW_VV_VV_UW 100.0 FORMULA_0010 0.0 65535.0000 /end CHARACTERISTIC
/begin CHARACTERISTIC K_ED_EV3.P_CODE_OPENLOAD "P-Code fuer die Art OPENLOAD | EN: Fault code EV3 - OBD P-code reported for open circuit" VALUE 0x711E4 TKW_VV_VV_UW 100.0 FORMULA_0010 0.0 65535.0000 /end CHARACTERISTIC
/begin CHARACTERISTIC K_ED_EV4.P_CODE_OPENLOAD "P-Code fuer die Art OPENLOAD | EN: Fault code EV4 - OBD P-code reported for open circuit" VALUE 0x711FE TKW_VV_VV_UW 100.0 FORMULA_0010 0.0 65535.0000 /end CHARACTERISTIC
/begin CHARACTERISTIC K_ED_EV5.P_CODE_OPENLOAD "P-Code fuer die Art OPENLOAD | EN: Fault code EV5 - OBD P-code reported for open circuit" VALUE 0x71218 TKW_VV_VV_UW 100.0 FORMULA_0010 0.0 65535.0000 /end CHARACTERISTIC
/begin CHARACTERISTIC K_ED_EV6.P_CODE_OPENLOAD "P-Code fuer die Art OPENLOAD | EN: Fault code EV6 - OBD P-code reported for open circuit" VALUE 0x71232 TKW_VV_VV_UW 100.0 FORMULA_0010 0.0 65535.0000 /end CHARACTERISTIC
/begin CHARACTERISTIC K_ED_EV7.P_CODE_OPENLOAD "P-Code fuer die Art OPENLOAD | EN: Fault code EV7 - OBD P-code reported for open circuit" VALUE 0x7124C TKW_VV_VV_UW 100.0 FORMULA_0010 0.0 65535.0000 /end CHARACTERISTIC
/begin CHARACTERISTIC K_ED_EV8.P_CODE_OPENLOAD "P-Code fuer die Art OPENLOAD | EN: Fault code EV8 - OBD P-code reported for open circuit" VALUE 0x71266 TKW_VV_VV_UW 100.0 FORMULA_0010 0.0 65535.0000 /end CHARACTERISTIC
/begin CHARACTERISTIC K_ED_EV9.P_CODE_OPENLOAD "P-Code fuer die Art OPENLOAD | EN: Fault code EV9 - OBD P-code reported for open circuit" VALUE 0x71280 TKW_VV_VV_UW 100.0 FORMULA_0010 0.0 65535.0000 /end CHARACTERISTIC
/begin CHARACTERISTIC K_ED_EV10.P_CODE_OPENLOAD "P-Code fuer die Art OPENLOAD | EN: Fault code EV10 - OBD P-code reported for open circuit" VALUE 0x7129A TKW_VV_VV_UW 100.0 FORMULA_0010 0.0 65535.0000 /end CHARACTERISTIC
/begin CHARACTERISTIC K_ED_DMTL_P.P_CODE_OPENLOAD "P-Code fuer die Art OPENLOAD | EN: Fault code DMTL_P - OBD P-code reported for open circuit" VALUE 0x71336 TKW_VV_VV_UW 100.0 FORMULA_0010 0.0 65535.0000 /end CHARACTERISTIC
/begin CHARACTERISTIC K_ED_DMTL_V.P_CODE_OPENLOAD "P-Code fuer die Art OPENLOAD | EN: Fault code DMTL_V - OBD P-code reported for open circuit" VALUE 0x71350 TKW_VV_VV_UW 100.0 FORMULA_0010 0.0 65535.0000 /end CHARACTERISTIC
/begin CHARACTERISTIC K_ED_DMTL_H.P_CODE_OPENLOAD "P-Code fuer die Art OPENLOAD | EN: Fault code DMTL_H - OBD P-code reported for open circuit" VALUE 0x7136A TKW_VV_VV_UW 100.0 FORMULA_0010 0.0 65535.0000 /end CHARACTERISTIC
/begin CHARACTERISTIC K_ED_DMTL_GROBLECK.P_CODE_OPENLOAD "P-Code fuer die Art OPENLOAD | EN: Fault code DMTL_GROBLECK - OBD P-code reported for open circuit" VALUE 0x71384 TKW_VV_VV_UW 100.0 FORMULA_0010 0.0 65535.0000 /end CHARACTERISTIC
/begin CHARACTERISTIC K_ED_DMTL_FEUCHT.P_CODE_OPENLOAD "P-Code fuer die Art OPENLOAD | EN: Fault code DMTL_FEUCHT - OBD P-code reported for open circuit" VALUE 0x7139E TKW_VV_VV_UW 100.0 FORMULA_0010 0.0 65535.0000 /end CHARACTERISTIC
/begin CHARACTERISTIC K_ED_DMTL_DECKEL.P_CODE_OPENLOAD "P-Code fuer die Art OPENLOAD | EN: Fault code DMTL_DECKEL - OBD P-code reported for open circuit" VALUE 0x713B8 TKW_VV_VV_UW 100.0 FORMULA_0010 0.0 65535.0000 /end CHARACTERISTIC
/begin CHARACTERISTIC K_ED_EKP_PWM.P_CODE_OPENLOAD "P-Code fuer die Art OPENLOAD | EN: Fault code EKP_PWM - OBD P-code reported for open circuit" VALUE 0x71420 TKW_VV_VV_UW 100.0 FORMULA_0010 0.0 65535.0000 /end CHARACTERISTIC
/begin CHARACTERISTIC K_ED_FI_GEN.P_CODE_OPENLOAD "P-Code fuer die Art OPENLOAD | EN: Fault code FI_GEN - OBD P-code reported for open circuit" VALUE 0x71572 TKW_VV_VV_UW 100.0 FORMULA_0010 0.0 65535.0000 /end CHARACTERISTIC
/begin CHARACTERISTIC K_ED_FI_BSD.P_CODE_OPENLOAD "P-Code fuer die Art OPENLOAD | EN: Fault code FI_BSD - OBD P-code reported for open circuit" VALUE 0x7158C TKW_VV_VV_UW 100.0 FORMULA_0010 0.0 65535.0000 /end CHARACTERISTIC
/begin CHARACTERISTIC K_ED_FI_IBS1.P_CODE_OPENLOAD "P-Code fuer die Art OPENLOAD | EN: Fault code FI_IBS1 - OBD P-code reported for open circuit" VALUE 0x715C0 TKW_VV_VV_UW 100.0 FORMULA_0010 0.0 65535.0000 /end CHARACTERISTIC
/begin CHARACTERISTIC K_ED_FI_IBS2.P_CODE_OPENLOAD "P-Code fuer die Art OPENLOAD | EN: Fault code FI_IBS2 - OBD P-code reported for open circuit" VALUE 0x715DA TKW_VV_VV_UW 100.0 FORMULA_0010 0.0 65535.0000 /end CHARACTERISTIC
/begin CHARACTERISTIC K_ED_FI_IBS3.P_CODE_OPENLOAD "P-Code fuer die Art OPENLOAD | EN: Fault code FI_IBS3 - OBD P-code reported for open circuit" VALUE 0x715F4 TKW_VV_VV_UW 100.0 FORMULA_0010 0.0 65535.0000 /end CHARACTERISTIC
/begin CHARACTERISTIC K_ED_FI_PMBATT.P_CODE_OPENLOAD "P-Code fuer die Art OPENLOAD | EN: Fault code FI_PMBATT - OBD P-code reported for open circuit" VALUE 0x71628 TKW_VV_VV_UW 100.0 FORMULA_0010 0.0 65535.0000 /end CHARACTERISTIC
/begin CHARACTERISTIC K_ED_EWS_SCI.P_CODE_OPENLOAD "P-Code fuer die Art OPENLOAD | EN: Fault code EWS_SCI - OBD P-code reported for open circuit" VALUE 0x716AA TKW_VV_VV_UW 100.0 FORMULA_0010 0.0 65535.0000 /end CHARACTERISTIC
/begin CHARACTERISTIC K_ED_EWS_MAN.P_CODE_OPENLOAD "P-Code fuer die Art OPENLOAD | EN: Fault code EWS_MAN - OBD P-code reported for open circuit" VALUE 0x716C4 TKW_VV_VV_UW 100.0 FORMULA_0010 0.0 65535.0000 /end CHARACTERISTIC
/begin CHARACTERISTIC K_ED_FI_BSD_0.P_CODE_OPENLOAD "P-Code fuer die Art OPENLOAD | EN: Fault code FI_BSD_0 - OBD P-code reported for open circuit" VALUE 0x716DE TKW_VV_VV_UW 100.0 FORMULA_0010 0.0 65535.0000 /end CHARACTERISTIC
/begin CHARACTERISTIC K_ED_FI_BSD_6.P_CODE_OPENLOAD "P-Code fuer die Art OPENLOAD | EN: Fault code FI_BSD_6 - OBD P-code reported for open circuit" VALUE 0x716F8 TKW_VV_VV_UW 100.0 FORMULA_0010 0.0 65535.0000 /end CHARACTERISTIC
/begin CHARACTERISTIC K_ED_FI_BSDGLOB.P_CODE_OPENLOAD "P-Code fuer die Art OPENLOAD | EN: Fault code FI_BSDGLOB - OBD P-code reported for open circuit" VALUE 0x71712 TKW_VV_VV_UW 100.0 FORMULA_0010 0.0 65535.0000 /end CHARACTERISTIC
/begin CHARACTERISTIC K_ED_EBOX_ELU.P_CODE_OPENLOAD "P-Code fuer die Art OPENLOAD | EN: Fault code EBOX_ELU - OBD P-code reported for open circuit" VALUE 0x71760 TKW_VV_VV_UW 100.0 FORMULA_0010 0.0 65535.0000 /end CHARACTERISTIC
/begin CHARACTERISTIC K_ED_DK1_ENLTG.P_CODE_OPENLOAD "P-Code fuer die Art OPENLOAD | EN: Fault code DK1_ENLTG - OBD P-code reported for open circuit" VALUE 0x71794 TKW_VV_VV_UW 100.0 FORMULA_0010 0.0 65535.0000 /end CHARACTERISTIC
/begin CHARACTERISTIC K_ED_DK2_ENLTG.P_CODE_OPENLOAD "P-Code fuer die Art OPENLOAD | EN: Fault code DK2_ENLTG - OBD P-code reported for open circuit" VALUE 0x717AE TKW_VV_VV_UW 100.0 FORMULA_0010 0.0 65535.0000 /end CHARACTERISTIC
/begin CHARACTERISTIC K_ED_E2_INJ.P_CODE_OPENLOAD "P-Code fuer die Art OPENLOAD | EN: Fault code E2_INJ - OBD P-code reported for open circuit" VALUE 0x7184A TKW_VV_VV_UW 100.0 FORMULA_0010 0.0 65535.0000 /end CHARACTERISTIC
/begin CHARACTERISTIC K_ED_FETRAWE.P_CODE_OPENLOAD "P-Code fuer die Art OPENLOAD | EN: Fault code FETRAWE - OBD P-code reported for open circuit" VALUE 0x71968 TKW_VV_VV_UW 100.0 FORMULA_0010 0.0 65535.0000 /end CHARACTERISTIC
/begin CHARACTERISTIC K_ED_ELUP.P_CODE_OPENLOAD "P-Code fuer die Art OPENLOAD | EN: Fault code ELUP - OBD P-code reported for open circuit" VALUE 0x719D0 TKW_VV_VV_UW 100.0 FORMULA_0010 0.0 65535.0000 /end CHARACTERISTIC
/begin CHARACTERISTIC K_ED_ELU.P_CODE_OPENLOAD "P-Code fuer die Art OPENLOAD | EN: Fault code ELU - OBD P-code reported for open circuit" VALUE 0x719EA TKW_VV_VV_UW 100.0 FORMULA_0010 0.0 65535.0000 /end CHARACTERISTIC
/begin CHARACTERISTIC K_ED_DMTL_FEINLECK.P_CODE_OPENLOAD "P-Code fuer die Art OPENLOAD | EN: Fault code DMTL_FEINLECK - OBD P-code reported for open circuit" VALUE 0x71B08 TKW_VV_VV_UW 100.0 FORMULA_0010 0.0 65535.0000 /end CHARACTERISTIC
/begin CHARACTERISTIC K_ED_ELUP_OBD.P_CODE_OPENLOAD "P-Code fuer die Art OPENLOAD" VALUE 0x71D5E TKW_VV_VV_UW 100.0 FORMULA_0010 0.0 65535.0000 /end CHARACTERISTIC
/begin CHARACTERISTIC K_ED_APPL_DATA_INJ.P_CODE_UNPLAUSIBEL "P-Code fuer die Art UNPLAUSIBEL | EN: Fault code APPL_DATA_INJ - OBD P-code reported for implausible signal" VALUE 0x70F90 TKW_VV_VV_UW 100.0 FORMULA_0010 0.0 65535.0000 /end CHARACTERISTIC
/begin CHARACTERISTIC K_ED_EV1.P_CODE_UNPLAUSIBEL "P-Code fuer die Art UNPLAUSIBEL | EN: Fault code EV1 - OBD P-code reported for implausible signal" VALUE 0x711B2 TKW_VV_VV_UW 100.0 FORMULA_0010 0.0 65535.0000 /end CHARACTERISTIC
/begin CHARACTERISTIC K_ED_EV2.P_CODE_UNPLAUSIBEL "P-Code fuer die Art UNPLAUSIBEL | EN: Fault code EV2 - OBD P-code reported for implausible signal" VALUE 0x711CC TKW_VV_VV_UW 100.0 FORMULA_0010 0.0 65535.0000 /end CHARACTERISTIC
/begin CHARACTERISTIC K_ED_EV3.P_CODE_UNPLAUSIBEL "P-Code fuer die Art UNPLAUSIBEL | EN: Fault code EV3 - OBD P-code reported for implausible signal" VALUE 0x711E6 TKW_VV_VV_UW 100.0 FORMULA_0010 0.0 65535.0000 /end CHARACTERISTIC
/begin CHARACTERISTIC K_ED_EV4.P_CODE_UNPLAUSIBEL "P-Code fuer die Art UNPLAUSIBEL | EN: Fault code EV4 - OBD P-code reported for implausible signal" VALUE 0x71200 TKW_VV_VV_UW 100.0 FORMULA_0010 0.0 65535.0000 /end CHARACTERISTIC
/begin CHARACTERISTIC K_ED_EV5.P_CODE_UNPLAUSIBEL "P-Code fuer die Art UNPLAUSIBEL | EN: Fault code EV5 - OBD P-code reported for implausible signal" VALUE 0x7121A TKW_VV_VV_UW 100.0 FORMULA_0010 0.0 65535.0000 /end CHARACTERISTIC
/begin CHARACTERISTIC K_ED_EV6.P_CODE_UNPLAUSIBEL "P-Code fuer die Art UNPLAUSIBEL | EN: Fault code EV6 - OBD P-code reported for implausible signal" VALUE 0x71234 TKW_VV_VV_UW 100.0 FORMULA_0010 0.0 65535.0000 /end CHARACTERISTIC
/begin CHARACTERISTIC K_ED_EV7.P_CODE_UNPLAUSIBEL "P-Code fuer die Art UNPLAUSIBEL | EN: Fault code EV7 - OBD P-code reported for implausible signal" VALUE 0x7124E TKW_VV_VV_UW 100.0 FORMULA_0010 0.0 65535.0000 /end CHARACTERISTIC
/begin CHARACTERISTIC K_ED_EV8.P_CODE_UNPLAUSIBEL "P-Code fuer die Art UNPLAUSIBEL | EN: Fault code EV8 - OBD P-code reported for implausible signal" VALUE 0x71268 TKW_VV_VV_UW 100.0 FORMULA_0010 0.0 65535.0000 /end CHARACTERISTIC
/begin CHARACTERISTIC K_ED_EV9.P_CODE_UNPLAUSIBEL "P-Code fuer die Art UNPLAUSIBEL | EN: Fault code EV9 - OBD P-code reported for implausible signal" VALUE 0x71282 TKW_VV_VV_UW 100.0 FORMULA_0010 0.0 65535.0000 /end CHARACTERISTIC
/begin CHARACTERISTIC K_ED_EV10.P_CODE_UNPLAUSIBEL "P-Code fuer die Art UNPLAUSIBEL | EN: Fault code EV10 - OBD P-code reported for implausible signal" VALUE 0x7129C TKW_VV_VV_UW 100.0 FORMULA_0010 0.0 65535.0000 /end CHARACTERISTIC
/begin CHARACTERISTIC K_ED_DMTL_P.P_CODE_UNPLAUSIBEL "P-Code fuer die Art UNPLAUSIBEL | EN: Fault code DMTL_P - OBD P-code reported for implausible signal" VALUE 0x71338 TKW_VV_VV_UW 100.0 FORMULA_0010 0.0 65535.0000 /end CHARACTERISTIC
/begin CHARACTERISTIC K_ED_DMTL_V.P_CODE_UNPLAUSIBEL "P-Code fuer die Art UNPLAUSIBEL | EN: Fault code DMTL_V - OBD P-code reported for implausible signal" VALUE 0x71352 TKW_VV_VV_UW 100.0 FORMULA_0010 0.0 65535.0000 /end CHARACTERISTIC
/begin CHARACTERISTIC K_ED_DMTL_H.P_CODE_UNPLAUSIBEL "P-Code fuer die Art UNPLAUSIBEL | EN: Fault code DMTL_H - OBD P-code reported for implausible signal" VALUE 0x7136C TKW_VV_VV_UW 100.0 FORMULA_0010 0.0 65535.0000 /end CHARACTERISTIC
/begin CHARACTERISTIC K_ED_DMTL_GROBLECK.P_CODE_UNPLAUSIBEL "P-Code fuer die Art UNPLAUSIBEL | EN: Fault code DMTL_GROBLECK - OBD P-code reported for implausible signal" VALUE 0x71386 TKW_VV_VV_UW 100.0 FORMULA_0010 0.0 65535.0000 /end CHARACTERISTIC
/begin CHARACTERISTIC K_ED_DMTL_FEUCHT.P_CODE_UNPLAUSIBEL "P-Code fuer die Art UNPLAUSIBEL | EN: Fault code DMTL_FEUCHT - OBD P-code reported for implausible signal" VALUE 0x713A0 TKW_VV_VV_UW 100.0 FORMULA_0010 0.0 65535.0000 /end CHARACTERISTIC
/begin CHARACTERISTIC K_ED_DMTL_DECKEL.P_CODE_UNPLAUSIBEL "P-Code fuer die Art UNPLAUSIBEL | EN: Fault code DMTL_DECKEL - OBD P-code reported for implausible signal" VALUE 0x713BA TKW_VV_VV_UW 100.0 FORMULA_0010 0.0 65535.0000 /end CHARACTERISTIC
/begin CHARACTERISTIC K_ED_EKP_PWM.P_CODE_UNPLAUSIBEL "P-Code fuer die Art UNPLAUSIBEL | EN: Fault code EKP_PWM - OBD P-code reported for implausible signal" VALUE 0x71422 TKW_VV_VV_UW 100.0 FORMULA_0010 0.0 65535.0000 /end CHARACTERISTIC
/begin CHARACTERISTIC K_ED_FI_GEN.P_CODE_UNPLAUSIBEL "P-Code fuer die Art UNPLAUSIBEL | EN: Fault code FI_GEN - OBD P-code reported for implausible signal" VALUE 0x71574 TKW_VV_VV_UW 100.0 FORMULA_0010 0.0 65535.0000 /end CHARACTERISTIC
/begin CHARACTERISTIC K_ED_FI_BSD.P_CODE_UNPLAUSIBEL "P-Code fuer die Art UNPLAUSIBEL | EN: Fault code FI_BSD - OBD P-code reported for implausible signal" VALUE 0x7158E TKW_VV_VV_UW 100.0 FORMULA_0010 0.0 65535.0000 /end CHARACTERISTIC
/begin CHARACTERISTIC K_ED_FI_IBS1.P_CODE_UNPLAUSIBEL "P-Code fuer die Art UNPLAUSIBEL | EN: Fault code FI_IBS1 - OBD P-code reported for implausible signal" VALUE 0x715C2 TKW_VV_VV_UW 100.0 FORMULA_0010 0.0 65535.0000 /end CHARACTERISTIC
/begin CHARACTERISTIC K_ED_FI_IBS2.P_CODE_UNPLAUSIBEL "P-Code fuer die Art UNPLAUSIBEL | EN: Fault code FI_IBS2 - OBD P-code reported for implausible signal" VALUE 0x715DC TKW_VV_VV_UW 100.0 FORMULA_0010 0.0 65535.0000 /end CHARACTERISTIC
/begin CHARACTERISTIC K_ED_FI_IBS3.P_CODE_UNPLAUSIBEL "P-Code fuer die Art UNPLAUSIBEL | EN: Fault code FI_IBS3 - OBD P-code reported for implausible signal" VALUE 0x715F6 TKW_VV_VV_UW 100.0 FORMULA_0010 0.0 65535.0000 /end CHARACTERISTIC
/begin CHARACTERISTIC K_ED_FI_PMBATT.P_CODE_UNPLAUSIBEL "P-Code fuer die Art UNPLAUSIBEL | EN: Fault code FI_PMBATT - OBD P-code reported for implausible signal" VALUE 0x7162A TKW_VV_VV_UW 100.0 FORMULA_0010 0.0 65535.0000 /end CHARACTERISTIC
/begin CHARACTERISTIC K_ED_EWS_SCI.P_CODE_UNPLAUSIBEL "P-Code fuer die Art UNPLAUSIBEL | EN: Fault code EWS_SCI - OBD P-code reported for implausible signal" VALUE 0x716AC TKW_VV_VV_UW 100.0 FORMULA_0010 0.0 65535.0000 /end CHARACTERISTIC
/begin CHARACTERISTIC K_ED_EWS_MAN.P_CODE_UNPLAUSIBEL "P-Code fuer die Art UNPLAUSIBEL | EN: Fault code EWS_MAN - OBD P-code reported for implausible signal" VALUE 0x716C6 TKW_VV_VV_UW 100.0 FORMULA_0010 0.0 65535.0000 /end CHARACTERISTIC
/begin CHARACTERISTIC K_ED_FI_BSD_0.P_CODE_UNPLAUSIBEL "P-Code fuer die Art UNPLAUSIBEL | EN: Fault code FI_BSD_0 - OBD P-code reported for implausible signal" VALUE 0x716E0 TKW_VV_VV_UW 100.0 FORMULA_0010 0.0 65535.0000 /end CHARACTERISTIC
/begin CHARACTERISTIC K_ED_FI_BSD_6.P_CODE_UNPLAUSIBEL "P-Code fuer die Art UNPLAUSIBEL | EN: Fault code FI_BSD_6 - OBD P-code reported for implausible signal" VALUE 0x716FA TKW_VV_VV_UW 100.0 FORMULA_0010 0.0 65535.0000 /end CHARACTERISTIC
/begin CHARACTERISTIC K_ED_FI_BSDGLOB.P_CODE_UNPLAUSIBEL "P-Code fuer die Art UNPLAUSIBEL | EN: Fault code FI_BSDGLOB - OBD P-code reported for implausible signal" VALUE 0x71714 TKW_VV_VV_UW 100.0 FORMULA_0010 0.0 65535.0000 /end CHARACTERISTIC
/begin CHARACTERISTIC K_ED_EBOX_ELU.P_CODE_UNPLAUSIBEL "P-Code fuer die Art UNPLAUSIBEL | EN: Fault code EBOX_ELU - OBD P-code reported for implausible signal" VALUE 0x71762 TKW_VV_VV_UW 100.0 FORMULA_0010 0.0 65535.0000 /end CHARACTERISTIC
/begin CHARACTERISTIC K_ED_DK1_ENLTG.P_CODE_UNPLAUSIBEL "P-Code fuer die Art UNPLAUSIBEL | EN: Fault code DK1_ENLTG - OBD P-code reported for implausible signal" VALUE 0x71796 TKW_VV_VV_UW 100.0 FORMULA_0010 0.0 65535.0000 /end CHARACTERISTIC
/begin CHARACTERISTIC K_ED_DK2_ENLTG.P_CODE_UNPLAUSIBEL "P-Code fuer die Art UNPLAUSIBEL | EN: Fault code DK2_ENLTG - OBD P-code reported for implausible signal" VALUE 0x717B0 TKW_VV_VV_UW 100.0 FORMULA_0010 0.0 65535.0000 /end CHARACTERISTIC
/begin CHARACTERISTIC K_ED_E2_INJ.P_CODE_UNPLAUSIBEL "P-Code fuer die Art UNPLAUSIBEL | EN: Fault code E2_INJ - OBD P-code reported for implausible signal" VALUE 0x7184C TKW_VV_VV_UW 100.0 FORMULA_0010 0.0 65535.0000 /end CHARACTERISTIC
/begin CHARACTERISTIC K_ED_FETRAWE.P_CODE_UNPLAUSIBEL "P-Code fuer die Art UNPLAUSIBEL | EN: Fault code FETRAWE - OBD P-code reported for implausible signal" VALUE 0x7196A TKW_VV_VV_UW 100.0 FORMULA_0010 0.0 65535.0000 /end CHARACTERISTIC
/begin CHARACTERISTIC K_ED_ELUP.P_CODE_UNPLAUSIBEL "P-Code fuer die Art UNPLAUSIBEL | EN: Fault code ELUP - OBD P-code reported for implausible signal" VALUE 0x719D2 TKW_VV_VV_UW 100.0 FORMULA_0010 0.0 65535.0000 /end CHARACTERISTIC
/begin CHARACTERISTIC K_ED_ELU.P_CODE_UNPLAUSIBEL "P-Code fuer die Art UNPLAUSIBEL | EN: Fault code ELU - OBD P-code reported for implausible signal" VALUE 0x719EC TKW_VV_VV_UW 100.0 FORMULA_0010 0.0 65535.0000 /end CHARACTERISTIC
/begin CHARACTERISTIC K_ED_DMTL_FEINLECK.P_CODE_UNPLAUSIBEL "P-Code fuer die Art UNPLAUSIBEL | EN: Fault code DMTL_FEINLECK - OBD P-code reported for implausible signal" VALUE 0x71B0A TKW_VV_VV_UW 100.0 FORMULA_0010 0.0 65535.0000 /end CHARACTERISTIC
/begin CHARACTERISTIC K_ED_ELUP_OBD.P_CODE_UNPLAUSIBEL "P-Code fuer die Art UNPLAUSIBEL" VALUE 0x71D60 TKW_VV_VV_UW 100.0 FORMULA_0010 0.0 65535.0000 /end CHARACTERISTIC
/begin CHARACTERISTIC K_ED_APPL_DATA_INJ.FEHLERSCHWELLE "Filterschwelle fuer Fehlereintrag | EN: Fault code APPL_DATA_INJ - debounce filter threshold for setting the fault" VALUE 0x70F92 TKW_VV_VV_UB 100.0 FORMULA_0003 0.0 255.0000 /end CHARACTERISTIC
/begin CHARACTERISTIC K_ED_EV1.FEHLERSCHWELLE "Filterschwelle fuer Fehlereintrag | EN: Fault code EV1 - debounce filter threshold for setting the fault" VALUE 0x711B4 TKW_VV_VV_UB 100.0 FORMULA_0003 0.0 255.0000 /end CHARACTERISTIC
/begin CHARACTERISTIC K_ED_EV2.FEHLERSCHWELLE "Filterschwelle fuer Fehlereintrag | EN: Fault code EV2 - debounce filter threshold for setting the fault" VALUE 0x711CE TKW_VV_VV_UB 100.0 FORMULA_0003 0.0 255.0000 /end CHARACTERISTIC
/begin CHARACTERISTIC K_ED_EV3.FEHLERSCHWELLE "Filterschwelle fuer Fehlereintrag | EN: Fault code EV3 - debounce filter threshold for setting the fault" VALUE 0x711E8 TKW_VV_VV_UB 100.0 FORMULA_0003 0.0 255.0000 /end CHARACTERISTIC
/begin CHARACTERISTIC K_ED_EV4.FEHLERSCHWELLE "Filterschwelle fuer Fehlereintrag | EN: Fault code EV4 - debounce filter threshold for setting the fault" VALUE 0x71202 TKW_VV_VV_UB 100.0 FORMULA_0003 0.0 255.0000 /end CHARACTERISTIC
/begin CHARACTERISTIC K_ED_EV5.FEHLERSCHWELLE "Filterschwelle fuer Fehlereintrag | EN: Fault code EV5 - debounce filter threshold for setting the fault" VALUE 0x7121C TKW_VV_VV_UB 100.0 FORMULA_0003 0.0 255.0000 /end CHARACTERISTIC
/begin CHARACTERISTIC K_ED_EV6.FEHLERSCHWELLE "Filterschwelle fuer Fehlereintrag | EN: Fault code EV6 - debounce filter threshold for setting the fault" VALUE 0x71236 TKW_VV_VV_UB 100.0 FORMULA_0003 0.0 255.0000 /end CHARACTERISTIC
/begin CHARACTERISTIC K_ED_EV7.FEHLERSCHWELLE "Filterschwelle fuer Fehlereintrag | EN: Fault code EV7 - debounce filter threshold for setting the fault" VALUE 0x71250 TKW_VV_VV_UB 100.0 FORMULA_0003 0.0 255.0000 /end CHARACTERISTIC
/begin CHARACTERISTIC K_ED_EV8.FEHLERSCHWELLE "Filterschwelle fuer Fehlereintrag | EN: Fault code EV8 - debounce filter threshold for setting the fault" VALUE 0x7126A TKW_VV_VV_UB 100.0 FORMULA_0003 0.0 255.0000 /end CHARACTERISTIC
/begin CHARACTERISTIC K_ED_EV9.FEHLERSCHWELLE "Filterschwelle fuer Fehlereintrag | EN: Fault code EV9 - debounce filter threshold for setting the fault" VALUE 0x71284 TKW_VV_VV_UB 100.0 FORMULA_0003 0.0 255.0000 /end CHARACTERISTIC
/begin CHARACTERISTIC K_ED_EV10.FEHLERSCHWELLE "Filterschwelle fuer Fehlereintrag | EN: Fault code EV10 - debounce filter threshold for setting the fault" VALUE 0x7129E TKW_VV_VV_UB 100.0 FORMULA_0003 0.0 255.0000 /end CHARACTERISTIC
/begin CHARACTERISTIC K_ED_DMTL_P.FEHLERSCHWELLE "Filterschwelle fuer Fehlereintrag | EN: Fault code DMTL_P - debounce filter threshold for setting the fault" VALUE 0x7133A TKW_VV_VV_UB 100.0 FORMULA_0003 0.0 255.0000 /end CHARACTERISTIC
/begin CHARACTERISTIC K_ED_DMTL_V.FEHLERSCHWELLE "Filterschwelle fuer Fehlereintrag | EN: Fault code DMTL_V - debounce filter threshold for setting the fault" VALUE 0x71354 TKW_VV_VV_UB 100.0 FORMULA_0003 0.0 255.0000 /end CHARACTERISTIC
/begin CHARACTERISTIC K_ED_DMTL_H.FEHLERSCHWELLE "Filterschwelle fuer Fehlereintrag | EN: Fault code DMTL_H - debounce filter threshold for setting the fault" VALUE 0x7136E TKW_VV_VV_UB 100.0 FORMULA_0003 0.0 255.0000 /end CHARACTERISTIC
/begin CHARACTERISTIC K_ED_DMTL_GROBLECK.FEHLERSCHWELLE "Filterschwelle fuer Fehlereintrag | EN: Fault code DMTL_GROBLECK - debounce filter threshold for setting the fault" VALUE 0x71388 TKW_VV_VV_UB 100.0 FORMULA_0003 0.0 255.0000 /end CHARACTERISTIC
/begin CHARACTERISTIC K_ED_DMTL_FEUCHT.FEHLERSCHWELLE "Filterschwelle fuer Fehlereintrag | EN: Fault code DMTL_FEUCHT - debounce filter threshold for setting the fault" VALUE 0x713A2 TKW_VV_VV_UB 100.0 FORMULA_0003 0.0 255.0000 /end CHARACTERISTIC
/begin CHARACTERISTIC K_ED_DMTL_DECKEL.FEHLERSCHWELLE "Filterschwelle fuer Fehlereintrag | EN: Fault code DMTL_DECKEL - debounce filter threshold for setting the fault" VALUE 0x713BC TKW_VV_VV_UB 100.0 FORMULA_0003 0.0 255.0000 /end CHARACTERISTIC
/begin CHARACTERISTIC K_ED_EKP_PWM.FEHLERSCHWELLE "Filterschwelle fuer Fehlereintrag | EN: Fault code EKP_PWM - debounce filter threshold for setting the fault" VALUE 0x71424 TKW_VV_VV_UB 100.0 FORMULA_0003 0.0 255.0000 /end CHARACTERISTIC
/begin CHARACTERISTIC K_ED_FI_GEN.FEHLERSCHWELLE "Filterschwelle fuer Fehlereintrag | EN: Fault code FI_GEN - debounce filter threshold for setting the fault" VALUE 0x71576 TKW_VV_VV_UB 100.0 FORMULA_0003 0.0 255.0000 /end CHARACTERISTIC
/begin CHARACTERISTIC K_ED_FI_BSD.FEHLERSCHWELLE "Filterschwelle fuer Fehlereintrag | EN: Fault code FI_BSD - debounce filter threshold for setting the fault" VALUE 0x71590 TKW_VV_VV_UB 100.0 FORMULA_0003 0.0 255.0000 /end CHARACTERISTIC
/begin CHARACTERISTIC K_ED_FI_IBS1.FEHLERSCHWELLE "Filterschwelle fuer Fehlereintrag | EN: Fault code FI_IBS1 - debounce filter threshold for setting the fault" VALUE 0x715C4 TKW_VV_VV_UB 100.0 FORMULA_0003 0.0 255.0000 /end CHARACTERISTIC
/begin CHARACTERISTIC K_ED_FI_IBS2.FEHLERSCHWELLE "Filterschwelle fuer Fehlereintrag | EN: Fault code FI_IBS2 - debounce filter threshold for setting the fault" VALUE 0x715DE TKW_VV_VV_UB 100.0 FORMULA_0003 0.0 255.0000 /end CHARACTERISTIC
/begin CHARACTERISTIC K_ED_FI_IBS3.FEHLERSCHWELLE "Filterschwelle fuer Fehlereintrag | EN: Fault code FI_IBS3 - debounce filter threshold for setting the fault" VALUE 0x715F8 TKW_VV_VV_UB 100.0 FORMULA_0003 0.0 255.0000 /end CHARACTERISTIC
/begin CHARACTERISTIC K_ED_FI_PMBATT.FEHLERSCHWELLE "Filterschwelle fuer Fehlereintrag | EN: Fault code FI_PMBATT - debounce filter threshold for setting the fault" VALUE 0x7162C TKW_VV_VV_UB 100.0 FORMULA_0003 0.0 255.0000 /end CHARACTERISTIC
/begin CHARACTERISTIC K_ED_EWS_SCI.FEHLERSCHWELLE "Filterschwelle fuer Fehlereintrag | EN: Fault code EWS_SCI - debounce filter threshold for setting the fault" VALUE 0x716AE TKW_VV_VV_UB 100.0 FORMULA_0003 0.0 255.0000 /end CHARACTERISTIC
/begin CHARACTERISTIC K_ED_EWS_MAN.FEHLERSCHWELLE "Filterschwelle fuer Fehlereintrag | EN: Fault code EWS_MAN - debounce filter threshold for setting the fault" VALUE 0x716C8 TKW_VV_VV_UB 100.0 FORMULA_0003 0.0 255.0000 /end CHARACTERISTIC
/begin CHARACTERISTIC K_ED_FI_BSD_0.FEHLERSCHWELLE "Filterschwelle fuer Fehlereintrag | EN: Fault code FI_BSD_0 - debounce filter threshold for setting the fault" VALUE 0x716E2 TKW_VV_VV_UB 100.0 FORMULA_0003 0.0 255.0000 /end CHARACTERISTIC
/begin CHARACTERISTIC K_ED_FI_BSD_6.FEHLERSCHWELLE "Filterschwelle fuer Fehlereintrag | EN: Fault code FI_BSD_6 - debounce filter threshold for setting the fault" VALUE 0x716FC TKW_VV_VV_UB 100.0 FORMULA_0003 0.0 255.0000 /end CHARACTERISTIC
/begin CHARACTERISTIC K_ED_FI_BSDGLOB.FEHLERSCHWELLE "Filterschwelle fuer Fehlereintrag | EN: Fault code FI_BSDGLOB - debounce filter threshold for setting the fault" VALUE 0x71716 TKW_VV_VV_UB 100.0 FORMULA_0003 0.0 255.0000 /end CHARACTERISTIC
/begin CHARACTERISTIC K_ED_EBOX_ELU.FEHLERSCHWELLE "Filterschwelle fuer Fehlereintrag | EN: Fault code EBOX_ELU - debounce filter threshold for setting the fault" VALUE 0x71764 TKW_VV_VV_UB 100.0 FORMULA_0003 0.0 255.0000 /end CHARACTERISTIC
/begin CHARACTERISTIC K_ED_DK1_ENLTG.FEHLERSCHWELLE "Filterschwelle fuer Fehlereintrag | EN: Fault code DK1_ENLTG - debounce filter threshold for setting the fault" VALUE 0x71798 TKW_VV_VV_UB 100.0 FORMULA_0003 0.0 255.0000 /end CHARACTERISTIC
/begin CHARACTERISTIC K_ED_DK2_ENLTG.FEHLERSCHWELLE "Filterschwelle fuer Fehlereintrag | EN: Fault code DK2_ENLTG - debounce filter threshold for setting the fault" VALUE 0x717B2 TKW_VV_VV_UB 100.0 FORMULA_0003 0.0 255.0000 /end CHARACTERISTIC
/begin CHARACTERISTIC K_ED_E2_INJ.FEHLERSCHWELLE "Filterschwelle fuer Fehlereintrag | EN: Fault code E2_INJ - debounce filter threshold for setting the fault" VALUE 0x7184E TKW_VV_VV_UB 100.0 FORMULA_0003 0.0 255.0000 /end CHARACTERISTIC
/begin CHARACTERISTIC K_ED_FETRAWE.FEHLERSCHWELLE "Filterschwelle fuer Fehlereintrag | EN: Fault code FETRAWE - debounce filter threshold for setting the fault" VALUE 0x7196C TKW_VV_VV_UB 100.0 FORMULA_0003 0.0 255.0000 /end CHARACTERISTIC
/begin CHARACTERISTIC K_ED_ELUP.FEHLERSCHWELLE "Filterschwelle fuer Fehlereintrag | EN: Fault code ELUP - debounce filter threshold for setting the fault" VALUE 0x719D4 TKW_VV_VV_UB 100.0 FORMULA_0003 0.0 255.0000 /end CHARACTERISTIC
/begin CHARACTERISTIC K_ED_ELU.FEHLERSCHWELLE "Filterschwelle fuer Fehlereintrag | EN: Fault code ELU - debounce filter threshold for setting the fault" VALUE 0x719EE TKW_VV_VV_UB 100.0 FORMULA_0003 0.0 255.0000 /end CHARACTERISTIC
/begin CHARACTERISTIC K_ED_DMTL_FEINLECK.FEHLERSCHWELLE "Filterschwelle fuer Fehlereintrag | EN: Fault code DMTL_FEINLECK - debounce filter threshold for setting the fault" VALUE 0x71B0C TKW_VV_VV_UB 100.0 FORMULA_0003 0.0 255.0000 /end CHARACTERISTIC
/begin CHARACTERISTIC K_ED_ELUP_OBD.FEHLERSCHWELLE "Filterschwelle fuer Fehlereintrag" VALUE 0x71D62 TKW_VV_VV_UB 100.0 FORMULA_0003 0.0 255.0000 /end CHARACTERISTIC
/begin CHARACTERISTIC K_ED_APPL_DATA_INJ.OK_SCHWELLE "Filterschwelle fuer Fehleraustrag | EN: Fault code APPL_DATA_INJ - debounce filter threshold for clearing (healing) the fault" VALUE 0x70F93 TKW_VV_VV_UB 100.0 FORMULA_0003 0.0 255.0000 /end CHARACTERISTIC
/begin CHARACTERISTIC K_ED_EV1.OK_SCHWELLE "Filterschwelle fuer Fehleraustrag | EN: Fault code EV1 - debounce filter threshold for clearing (healing) the fault" VALUE 0x711B5 TKW_VV_VV_UB 100.0 FORMULA_0003 0.0 255.0000 /end CHARACTERISTIC
/begin CHARACTERISTIC K_ED_EV2.OK_SCHWELLE "Filterschwelle fuer Fehleraustrag | EN: Fault code EV2 - debounce filter threshold for clearing (healing) the fault" VALUE 0x711CF TKW_VV_VV_UB 100.0 FORMULA_0003 0.0 255.0000 /end CHARACTERISTIC
/begin CHARACTERISTIC K_ED_EV3.OK_SCHWELLE "Filterschwelle fuer Fehleraustrag | EN: Fault code EV3 - debounce filter threshold for clearing (healing) the fault" VALUE 0x711E9 TKW_VV_VV_UB 100.0 FORMULA_0003 0.0 255.0000 /end CHARACTERISTIC
/begin CHARACTERISTIC K_ED_EV4.OK_SCHWELLE "Filterschwelle fuer Fehleraustrag | EN: Fault code EV4 - debounce filter threshold for clearing (healing) the fault" VALUE 0x71203 TKW_VV_VV_UB 100.0 FORMULA_0003 0.0 255.0000 /end CHARACTERISTIC
/begin CHARACTERISTIC K_ED_EV5.OK_SCHWELLE "Filterschwelle fuer Fehleraustrag | EN: Fault code EV5 - debounce filter threshold for clearing (healing) the fault" VALUE 0x7121D TKW_VV_VV_UB 100.0 FORMULA_0003 0.0 255.0000 /end CHARACTERISTIC
/begin CHARACTERISTIC K_ED_EV6.OK_SCHWELLE "Filterschwelle fuer Fehleraustrag | EN: Fault code EV6 - debounce filter threshold for clearing (healing) the fault" VALUE 0x71237 TKW_VV_VV_UB 100.0 FORMULA_0003 0.0 255.0000 /end CHARACTERISTIC
/begin CHARACTERISTIC K_ED_EV7.OK_SCHWELLE "Filterschwelle fuer Fehleraustrag | EN: Fault code EV7 - debounce filter threshold for clearing (healing) the fault" VALUE 0x71251 TKW_VV_VV_UB 100.0 FORMULA_0003 0.0 255.0000 /end CHARACTERISTIC
/begin CHARACTERISTIC K_ED_EV8.OK_SCHWELLE "Filterschwelle fuer Fehleraustrag | EN: Fault code EV8 - debounce filter threshold for clearing (healing) the fault" VALUE 0x7126B TKW_VV_VV_UB 100.0 FORMULA_0003 0.0 255.0000 /end CHARACTERISTIC
/begin CHARACTERISTIC K_ED_EV9.OK_SCHWELLE "Filterschwelle fuer Fehleraustrag | EN: Fault code EV9 - debounce filter threshold for clearing (healing) the fault" VALUE 0x71285 TKW_VV_VV_UB 100.0 FORMULA_0003 0.0 255.0000 /end CHARACTERISTIC
/begin CHARACTERISTIC K_ED_EV10.OK_SCHWELLE "Filterschwelle fuer Fehleraustrag | EN: Fault code EV10 - debounce filter threshold for clearing (healing) the fault" VALUE 0x7129F TKW_VV_VV_UB 100.0 FORMULA_0003 0.0 255.0000 /end CHARACTERISTIC
/begin CHARACTERISTIC K_ED_DMTL_P.OK_SCHWELLE "Filterschwelle fuer Fehleraustrag | EN: Fault code DMTL_P - debounce filter threshold for clearing (healing) the fault" VALUE 0x7133B TKW_VV_VV_UB 100.0 FORMULA_0003 0.0 255.0000 /end CHARACTERISTIC
/begin CHARACTERISTIC K_ED_DMTL_V.OK_SCHWELLE "Filterschwelle fuer Fehleraustrag | EN: Fault code DMTL_V - debounce filter threshold for clearing (healing) the fault" VALUE 0x71355 TKW_VV_VV_UB 100.0 FORMULA_0003 0.0 255.0000 /end CHARACTERISTIC
/begin CHARACTERISTIC K_ED_DMTL_H.OK_SCHWELLE "Filterschwelle fuer Fehleraustrag | EN: Fault code DMTL_H - debounce filter threshold for clearing (healing) the fault" VALUE 0x7136F TKW_VV_VV_UB 100.0 FORMULA_0003 0.0 255.0000 /end CHARACTERISTIC
/begin CHARACTERISTIC K_ED_DMTL_GROBLECK.OK_SCHWELLE "Filterschwelle fuer Fehleraustrag | EN: Fault code DMTL_GROBLECK - debounce filter threshold for clearing (healing) the fault" VALUE 0x71389 TKW_VV_VV_UB 100.0 FORMULA_0003 0.0 255.0000 /end CHARACTERISTIC
/begin CHARACTERISTIC K_ED_DMTL_FEUCHT.OK_SCHWELLE "Filterschwelle fuer Fehleraustrag | EN: Fault code DMTL_FEUCHT - debounce filter threshold for clearing (healing) the fault" VALUE 0x713A3 TKW_VV_VV_UB 100.0 FORMULA_0003 0.0 255.0000 /end CHARACTERISTIC
/begin CHARACTERISTIC K_ED_DMTL_DECKEL.OK_SCHWELLE "Filterschwelle fuer Fehleraustrag | EN: Fault code DMTL_DECKEL - debounce filter threshold for clearing (healing) the fault" VALUE 0x713BD TKW_VV_VV_UB 100.0 FORMULA_0003 0.0 255.0000 /end CHARACTERISTIC
/begin CHARACTERISTIC K_ED_EKP_PWM.OK_SCHWELLE "Filterschwelle fuer Fehleraustrag | EN: Fault code EKP_PWM - debounce filter threshold for clearing (healing) the fault" VALUE 0x71425 TKW_VV_VV_UB 100.0 FORMULA_0003 0.0 255.0000 /end CHARACTERISTIC
/begin CHARACTERISTIC K_ED_FI_GEN.OK_SCHWELLE "Filterschwelle fuer Fehleraustrag | EN: Fault code FI_GEN - debounce filter threshold for clearing (healing) the fault" VALUE 0x71577 TKW_VV_VV_UB 100.0 FORMULA_0003 0.0 255.0000 /end CHARACTERISTIC
/begin CHARACTERISTIC K_ED_FI_BSD.OK_SCHWELLE "Filterschwelle fuer Fehleraustrag | EN: Fault code FI_BSD - debounce filter threshold for clearing (healing) the fault" VALUE 0x71591 TKW_VV_VV_UB 100.0 FORMULA_0003 0.0 255.0000 /end CHARACTERISTIC
/begin CHARACTERISTIC K_ED_FI_IBS1.OK_SCHWELLE "Filterschwelle fuer Fehleraustrag | EN: Fault code FI_IBS1 - debounce filter threshold for clearing (healing) the fault" VALUE 0x715C5 TKW_VV_VV_UB 100.0 FORMULA_0003 0.0 255.0000 /end CHARACTERISTIC
/begin CHARACTERISTIC K_ED_FI_IBS2.OK_SCHWELLE "Filterschwelle fuer Fehleraustrag | EN: Fault code FI_IBS2 - debounce filter threshold for clearing (healing) the fault" VALUE 0x715DF TKW_VV_VV_UB 100.0 FORMULA_0003 0.0 255.0000 /end CHARACTERISTIC
/begin CHARACTERISTIC K_ED_FI_IBS3.OK_SCHWELLE "Filterschwelle fuer Fehleraustrag | EN: Fault code FI_IBS3 - debounce filter threshold for clearing (healing) the fault" VALUE 0x715F9 TKW_VV_VV_UB 100.0 FORMULA_0003 0.0 255.0000 /end CHARACTERISTIC
/begin CHARACTERISTIC K_ED_FI_PMBATT.OK_SCHWELLE "Filterschwelle fuer Fehleraustrag | EN: Fault code FI_PMBATT - debounce filter threshold for clearing (healing) the fault" VALUE 0x7162D TKW_VV_VV_UB 100.0 FORMULA_0003 0.0 255.0000 /end CHARACTERISTIC
/begin CHARACTERISTIC K_ED_EWS_SCI.OK_SCHWELLE "Filterschwelle fuer Fehleraustrag | EN: Fault code EWS_SCI - debounce filter threshold for clearing (healing) the fault" VALUE 0x716AF TKW_VV_VV_UB 100.0 FORMULA_0003 0.0 255.0000 /end CHARACTERISTIC
/begin CHARACTERISTIC K_ED_EWS_MAN.OK_SCHWELLE "Filterschwelle fuer Fehleraustrag | EN: Fault code EWS_MAN - debounce filter threshold for clearing (healing) the fault" VALUE 0x716C9 TKW_VV_VV_UB 100.0 FORMULA_0003 0.0 255.0000 /end CHARACTERISTIC
/begin CHARACTERISTIC K_ED_FI_BSD_0.OK_SCHWELLE "Filterschwelle fuer Fehleraustrag | EN: Fault code FI_BSD_0 - debounce filter threshold for clearing (healing) the fault" VALUE 0x716E3 TKW_VV_VV_UB 100.0 FORMULA_0003 0.0 255.0000 /end CHARACTERISTIC
/begin CHARACTERISTIC K_ED_FI_BSD_6.OK_SCHWELLE "Filterschwelle fuer Fehleraustrag | EN: Fault code FI_BSD_6 - debounce filter threshold for clearing (healing) the fault" VALUE 0x716FD TKW_VV_VV_UB 100.0 FORMULA_0003 0.0 255.0000 /end CHARACTERISTIC
/begin CHARACTERISTIC K_ED_FI_BSDGLOB.OK_SCHWELLE "Filterschwelle fuer Fehleraustrag | EN: Fault code FI_BSDGLOB - debounce filter threshold for clearing (healing) the fault" VALUE 0x71717 TKW_VV_VV_UB 100.0 FORMULA_0003 0.0 255.0000 /end CHARACTERISTIC
/begin CHARACTERISTIC K_ED_EBOX_ELU.OK_SCHWELLE "Filterschwelle fuer Fehleraustrag | EN: Fault code EBOX_ELU - debounce filter threshold for clearing (healing) the fault" VALUE 0x71765 TKW_VV_VV_UB 100.0 FORMULA_0003 0.0 255.0000 /end CHARACTERISTIC
/begin CHARACTERISTIC K_ED_DK1_ENLTG.OK_SCHWELLE "Filterschwelle fuer Fehleraustrag | EN: Fault code DK1_ENLTG - debounce filter threshold for clearing (healing) the fault" VALUE 0x71799 TKW_VV_VV_UB 100.0 FORMULA_0003 0.0 255.0000 /end CHARACTERISTIC
/begin CHARACTERISTIC K_ED_DK2_ENLTG.OK_SCHWELLE "Filterschwelle fuer Fehleraustrag | EN: Fault code DK2_ENLTG - debounce filter threshold for clearing (healing) the fault" VALUE 0x717B3 TKW_VV_VV_UB 100.0 FORMULA_0003 0.0 255.0000 /end CHARACTERISTIC
/begin CHARACTERISTIC K_ED_E2_INJ.OK_SCHWELLE "Filterschwelle fuer Fehleraustrag | EN: Fault code E2_INJ - debounce filter threshold for clearing (healing) the fault" VALUE 0x7184F TKW_VV_VV_UB 100.0 FORMULA_0003 0.0 255.0000 /end CHARACTERISTIC
/begin CHARACTERISTIC K_ED_FETRAWE.OK_SCHWELLE "Filterschwelle fuer Fehleraustrag | EN: Fault code FETRAWE - debounce filter threshold for clearing (healing) the fault" VALUE 0x7196D TKW_VV_VV_UB 100.0 FORMULA_0003 0.0 255.0000 /end CHARACTERISTIC
/begin CHARACTERISTIC K_ED_ELUP.OK_SCHWELLE "Filterschwelle fuer Fehleraustrag | EN: Fault code ELUP - debounce filter threshold for clearing (healing) the fault" VALUE 0x719D5 TKW_VV_VV_UB 100.0 FORMULA_0003 0.0 255.0000 /end CHARACTERISTIC
/begin CHARACTERISTIC K_ED_ELU.OK_SCHWELLE "Filterschwelle fuer Fehleraustrag | EN: Fault code ELU - debounce filter threshold for clearing (healing) the fault" VALUE 0x719EF TKW_VV_VV_UB 100.0 FORMULA_0003 0.0 255.0000 /end CHARACTERISTIC
/begin CHARACTERISTIC K_ED_DMTL_FEINLECK.OK_SCHWELLE "Filterschwelle fuer Fehleraustrag | EN: Fault code DMTL_FEINLECK - debounce filter threshold for clearing (healing) the fault" VALUE 0x71B0D TKW_VV_VV_UB 100.0 FORMULA_0003 0.0 255.0000 /end CHARACTERISTIC
/begin CHARACTERISTIC K_ED_ELUP_OBD.OK_SCHWELLE "Filterschwelle fuer Fehleraustrag" VALUE 0x71D63 TKW_VV_VV_UB 100.0 FORMULA_0003 0.0 255.0000 /end CHARACTERISTIC
/begin CHARACTERISTIC K_ED_APPL_DATA_INJ.INC_VOR_EINTRAG "Filtererhoehung vorm Fehlerspeichereintrag | EN: Fault code APPL_DATA_INJ - debounce filter increment before fault-memory entry" VALUE 0x70F94 TKW_VV_VV_UB 100.0 FORMULA_0003 0.0 255.0000 /end CHARACTERISTIC
/begin CHARACTERISTIC K_ED_EV1.INC_VOR_EINTRAG "Filtererhoehung vorm Fehlerspeichereintrag | EN: Fault code EV1 - debounce filter increment before fault-memory entry" VALUE 0x711B6 TKW_VV_VV_UB 100.0 FORMULA_0003 0.0 255.0000 /end CHARACTERISTIC
/begin CHARACTERISTIC K_ED_EV2.INC_VOR_EINTRAG "Filtererhoehung vorm Fehlerspeichereintrag | EN: Fault code EV2 - debounce filter increment before fault-memory entry" VALUE 0x711D0 TKW_VV_VV_UB 100.0 FORMULA_0003 0.0 255.0000 /end CHARACTERISTIC
/begin CHARACTERISTIC K_ED_EV3.INC_VOR_EINTRAG "Filtererhoehung vorm Fehlerspeichereintrag | EN: Fault code EV3 - debounce filter increment before fault-memory entry" VALUE 0x711EA TKW_VV_VV_UB 100.0 FORMULA_0003 0.0 255.0000 /end CHARACTERISTIC
/begin CHARACTERISTIC K_ED_EV4.INC_VOR_EINTRAG "Filtererhoehung vorm Fehlerspeichereintrag | EN: Fault code EV4 - debounce filter increment before fault-memory entry" VALUE 0x71204 TKW_VV_VV_UB 100.0 FORMULA_0003 0.0 255.0000 /end CHARACTERISTIC
/begin CHARACTERISTIC K_ED_EV5.INC_VOR_EINTRAG "Filtererhoehung vorm Fehlerspeichereintrag | EN: Fault code EV5 - debounce filter increment before fault-memory entry" VALUE 0x7121E TKW_VV_VV_UB 100.0 FORMULA_0003 0.0 255.0000 /end CHARACTERISTIC
/begin CHARACTERISTIC K_ED_EV6.INC_VOR_EINTRAG "Filtererhoehung vorm Fehlerspeichereintrag | EN: Fault code EV6 - debounce filter increment before fault-memory entry" VALUE 0x71238 TKW_VV_VV_UB 100.0 FORMULA_0003 0.0 255.0000 /end CHARACTERISTIC
/begin CHARACTERISTIC K_ED_EV7.INC_VOR_EINTRAG "Filtererhoehung vorm Fehlerspeichereintrag | EN: Fault code EV7 - debounce filter increment before fault-memory entry" VALUE 0x71252 TKW_VV_VV_UB 100.0 FORMULA_0003 0.0 255.0000 /end CHARACTERISTIC
/begin CHARACTERISTIC K_ED_EV8.INC_VOR_EINTRAG "Filtererhoehung vorm Fehlerspeichereintrag | EN: Fault code EV8 - debounce filter increment before fault-memory entry" VALUE 0x7126C TKW_VV_VV_UB 100.0 FORMULA_0003 0.0 255.0000 /end CHARACTERISTIC
/begin CHARACTERISTIC K_ED_EV9.INC_VOR_EINTRAG "Filtererhoehung vorm Fehlerspeichereintrag | EN: Fault code EV9 - debounce filter increment before fault-memory entry" VALUE 0x71286 TKW_VV_VV_UB 100.0 FORMULA_0003 0.0 255.0000 /end CHARACTERISTIC
/begin CHARACTERISTIC K_ED_EV10.INC_VOR_EINTRAG "Filtererhoehung vorm Fehlerspeichereintrag | EN: Fault code EV10 - debounce filter increment before fault-memory entry" VALUE 0x712A0 TKW_VV_VV_UB 100.0 FORMULA_0003 0.0 255.0000 /end CHARACTERISTIC
/begin CHARACTERISTIC K_ED_DMTL_P.INC_VOR_EINTRAG "Filtererhoehung vorm Fehlerspeichereintrag | EN: Fault code DMTL_P - debounce filter increment before fault-memory entry" VALUE 0x7133C TKW_VV_VV_UB 100.0 FORMULA_0003 0.0 255.0000 /end CHARACTERISTIC
/begin CHARACTERISTIC K_ED_DMTL_V.INC_VOR_EINTRAG "Filtererhoehung vorm Fehlerspeichereintrag | EN: Fault code DMTL_V - debounce filter increment before fault-memory entry" VALUE 0x71356 TKW_VV_VV_UB 100.0 FORMULA_0003 0.0 255.0000 /end CHARACTERISTIC
/begin CHARACTERISTIC K_ED_DMTL_H.INC_VOR_EINTRAG "Filtererhoehung vorm Fehlerspeichereintrag | EN: Fault code DMTL_H - debounce filter increment before fault-memory entry" VALUE 0x71370 TKW_VV_VV_UB 100.0 FORMULA_0003 0.0 255.0000 /end CHARACTERISTIC
/begin CHARACTERISTIC K_ED_DMTL_GROBLECK.INC_VOR_EINTRAG "Filtererhoehung vorm Fehlerspeichereintrag | EN: Fault code DMTL_GROBLECK - debounce filter increment before fault-memory entry" VALUE 0x7138A TKW_VV_VV_UB 100.0 FORMULA_0003 0.0 255.0000 /end CHARACTERISTIC
/begin CHARACTERISTIC K_ED_DMTL_FEUCHT.INC_VOR_EINTRAG "Filtererhoehung vorm Fehlerspeichereintrag | EN: Fault code DMTL_FEUCHT - debounce filter increment before fault-memory entry" VALUE 0x713A4 TKW_VV_VV_UB 100.0 FORMULA_0003 0.0 255.0000 /end CHARACTERISTIC
/begin CHARACTERISTIC K_ED_DMTL_DECKEL.INC_VOR_EINTRAG "Filtererhoehung vorm Fehlerspeichereintrag | EN: Fault code DMTL_DECKEL - debounce filter increment before fault-memory entry" VALUE 0x713BE TKW_VV_VV_UB 100.0 FORMULA_0003 0.0 255.0000 /end CHARACTERISTIC
/begin CHARACTERISTIC K_ED_EKP_PWM.INC_VOR_EINTRAG "Filtererhoehung vorm Fehlerspeichereintrag | EN: Fault code EKP_PWM - debounce filter increment before fault-memory entry" VALUE 0x71426 TKW_VV_VV_UB 100.0 FORMULA_0003 0.0 255.0000 /end CHARACTERISTIC
/begin CHARACTERISTIC K_ED_FI_GEN.INC_VOR_EINTRAG "Filtererhoehung vorm Fehlerspeichereintrag | EN: Fault code FI_GEN - debounce filter increment before fault-memory entry" VALUE 0x71578 TKW_VV_VV_UB 100.0 FORMULA_0003 0.0 255.0000 /end CHARACTERISTIC
/begin CHARACTERISTIC K_ED_FI_BSD.INC_VOR_EINTRAG "Filtererhoehung vorm Fehlerspeichereintrag | EN: Fault code FI_BSD - debounce filter increment before fault-memory entry" VALUE 0x71592 TKW_VV_VV_UB 100.0 FORMULA_0003 0.0 255.0000 /end CHARACTERISTIC
/begin CHARACTERISTIC K_ED_FI_IBS1.INC_VOR_EINTRAG "Filtererhoehung vorm Fehlerspeichereintrag | EN: Fault code FI_IBS1 - debounce filter increment before fault-memory entry" VALUE 0x715C6 TKW_VV_VV_UB 100.0 FORMULA_0003 0.0 255.0000 /end CHARACTERISTIC
/begin CHARACTERISTIC K_ED_FI_IBS2.INC_VOR_EINTRAG "Filtererhoehung vorm Fehlerspeichereintrag | EN: Fault code FI_IBS2 - debounce filter increment before fault-memory entry" VALUE 0x715E0 TKW_VV_VV_UB 100.0 FORMULA_0003 0.0 255.0000 /end CHARACTERISTIC
/begin CHARACTERISTIC K_ED_FI_IBS3.INC_VOR_EINTRAG "Filtererhoehung vorm Fehlerspeichereintrag | EN: Fault code FI_IBS3 - debounce filter increment before fault-memory entry" VALUE 0x715FA TKW_VV_VV_UB 100.0 FORMULA_0003 0.0 255.0000 /end CHARACTERISTIC
/begin CHARACTERISTIC K_ED_FI_PMBATT.INC_VOR_EINTRAG "Filtererhoehung vorm Fehlerspeichereintrag | EN: Fault code FI_PMBATT - debounce filter increment before fault-memory entry" VALUE 0x7162E TKW_VV_VV_UB 100.0 FORMULA_0003 0.0 255.0000 /end CHARACTERISTIC
/begin CHARACTERISTIC K_ED_EWS_SCI.INC_VOR_EINTRAG "Filtererhoehung vorm Fehlerspeichereintrag | EN: Fault code EWS_SCI - debounce filter increment before fault-memory entry" VALUE 0x716B0 TKW_VV_VV_UB 100.0 FORMULA_0003 0.0 255.0000 /end CHARACTERISTIC
/begin CHARACTERISTIC K_ED_EWS_MAN.INC_VOR_EINTRAG "Filtererhoehung vorm Fehlerspeichereintrag | EN: Fault code EWS_MAN - debounce filter increment before fault-memory entry" VALUE 0x716CA TKW_VV_VV_UB 100.0 FORMULA_0003 0.0 255.0000 /end CHARACTERISTIC
/begin CHARACTERISTIC K_ED_FI_BSD_0.INC_VOR_EINTRAG "Filtererhoehung vorm Fehlerspeichereintrag | EN: Fault code FI_BSD_0 - debounce filter increment before fault-memory entry" VALUE 0x716E4 TKW_VV_VV_UB 100.0 FORMULA_0003 0.0 255.0000 /end CHARACTERISTIC
/begin CHARACTERISTIC K_ED_FI_BSD_6.INC_VOR_EINTRAG "Filtererhoehung vorm Fehlerspeichereintrag | EN: Fault code FI_BSD_6 - debounce filter increment before fault-memory entry" VALUE 0x716FE TKW_VV_VV_UB 100.0 FORMULA_0003 0.0 255.0000 /end CHARACTERISTIC
/begin CHARACTERISTIC K_ED_FI_BSDGLOB.INC_VOR_EINTRAG "Filtererhoehung vorm Fehlerspeichereintrag | EN: Fault code FI_BSDGLOB - debounce filter increment before fault-memory entry" VALUE 0x71718 TKW_VV_VV_UB 100.0 FORMULA_0003 0.0 255.0000 /end CHARACTERISTIC
/begin CHARACTERISTIC K_ED_EBOX_ELU.INC_VOR_EINTRAG "Filtererhoehung vorm Fehlerspeichereintrag | EN: Fault code EBOX_ELU - debounce filter increment before fault-memory entry" VALUE 0x71766 TKW_VV_VV_UB 100.0 FORMULA_0003 0.0 255.0000 /end CHARACTERISTIC
/begin CHARACTERISTIC K_ED_DK1_ENLTG.INC_VOR_EINTRAG "Filtererhoehung vorm Fehlerspeichereintrag | EN: Fault code DK1_ENLTG - debounce filter increment before fault-memory entry" VALUE 0x7179A TKW_VV_VV_UB 100.0 FORMULA_0003 0.0 255.0000 /end CHARACTERISTIC
/begin CHARACTERISTIC K_ED_DK2_ENLTG.INC_VOR_EINTRAG "Filtererhoehung vorm Fehlerspeichereintrag | EN: Fault code DK2_ENLTG - debounce filter increment before fault-memory entry" VALUE 0x717B4 TKW_VV_VV_UB 100.0 FORMULA_0003 0.0 255.0000 /end CHARACTERISTIC
/begin CHARACTERISTIC K_ED_E2_INJ.INC_VOR_EINTRAG "Filtererhoehung vorm Fehlerspeichereintrag | EN: Fault code E2_INJ - debounce filter increment before fault-memory entry" VALUE 0x71850 TKW_VV_VV_UB 100.0 FORMULA_0003 0.0 255.0000 /end CHARACTERISTIC
/begin CHARACTERISTIC K_ED_FETRAWE.INC_VOR_EINTRAG "Filtererhoehung vorm Fehlerspeichereintrag | EN: Fault code FETRAWE - debounce filter increment before fault-memory entry" VALUE 0x7196E TKW_VV_VV_UB 100.0 FORMULA_0003 0.0 255.0000 /end CHARACTERISTIC
/begin CHARACTERISTIC K_ED_ELUP.INC_VOR_EINTRAG "Filtererhoehung vorm Fehlerspeichereintrag | EN: Fault code ELUP - debounce filter increment before fault-memory entry" VALUE 0x719D6 TKW_VV_VV_UB 100.0 FORMULA_0003 0.0 255.0000 /end CHARACTERISTIC
/begin CHARACTERISTIC K_ED_ELU.INC_VOR_EINTRAG "Filtererhoehung vorm Fehlerspeichereintrag | EN: Fault code ELU - debounce filter increment before fault-memory entry" VALUE 0x719F0 TKW_VV_VV_UB 100.0 FORMULA_0003 0.0 255.0000 /end CHARACTERISTIC
/begin CHARACTERISTIC K_ED_DMTL_FEINLECK.INC_VOR_EINTRAG "Filtererhoehung vorm Fehlerspeichereintrag | EN: Fault code DMTL_FEINLECK - debounce filter increment before fault-memory entry" VALUE 0x71B0E TKW_VV_VV_UB 100.0 FORMULA_0003 0.0 255.0000 /end CHARACTERISTIC
/begin CHARACTERISTIC K_ED_ELUP_OBD.INC_VOR_EINTRAG "Filtererhoehung vorm Fehlerspeichereintrag" VALUE 0x71D64 TKW_VV_VV_UB 100.0 FORMULA_0003 0.0 255.0000 /end CHARACTERISTIC
/begin CHARACTERISTIC K_ED_APPL_DATA_INJ.DEC_VOR_EINTRAG "Filterverringerung vorm Fehlerspeichereintrag | EN: Fault code APPL_DATA_INJ - debounce filter decrement before fault-memory entry" VALUE 0x70F95 TKW_VV_VV_UB 100.0 FORMULA_0003 0.0 255.0000 /end CHARACTERISTIC
/begin CHARACTERISTIC K_ED_EV1.DEC_VOR_EINTRAG "Filterverringerung vorm Fehlerspeichereintrag | EN: Fault code EV1 - debounce filter decrement before fault-memory entry" VALUE 0x711B7 TKW_VV_VV_UB 100.0 FORMULA_0003 0.0 255.0000 /end CHARACTERISTIC
/begin CHARACTERISTIC K_ED_EV2.DEC_VOR_EINTRAG "Filterverringerung vorm Fehlerspeichereintrag | EN: Fault code EV2 - debounce filter decrement before fault-memory entry" VALUE 0x711D1 TKW_VV_VV_UB 100.0 FORMULA_0003 0.0 255.0000 /end CHARACTERISTIC
/begin CHARACTERISTIC K_ED_EV3.DEC_VOR_EINTRAG "Filterverringerung vorm Fehlerspeichereintrag | EN: Fault code EV3 - debounce filter decrement before fault-memory entry" VALUE 0x711EB TKW_VV_VV_UB 100.0 FORMULA_0003 0.0 255.0000 /end CHARACTERISTIC
/begin CHARACTERISTIC K_ED_EV4.DEC_VOR_EINTRAG "Filterverringerung vorm Fehlerspeichereintrag | EN: Fault code EV4 - debounce filter decrement before fault-memory entry" VALUE 0x71205 TKW_VV_VV_UB 100.0 FORMULA_0003 0.0 255.0000 /end CHARACTERISTIC
/begin CHARACTERISTIC K_ED_EV5.DEC_VOR_EINTRAG "Filterverringerung vorm Fehlerspeichereintrag | EN: Fault code EV5 - debounce filter decrement before fault-memory entry" VALUE 0x7121F TKW_VV_VV_UB 100.0 FORMULA_0003 0.0 255.0000 /end CHARACTERISTIC
/begin CHARACTERISTIC K_ED_EV6.DEC_VOR_EINTRAG "Filterverringerung vorm Fehlerspeichereintrag | EN: Fault code EV6 - debounce filter decrement before fault-memory entry" VALUE 0x71239 TKW_VV_VV_UB 100.0 FORMULA_0003 0.0 255.0000 /end CHARACTERISTIC
/begin CHARACTERISTIC K_ED_EV7.DEC_VOR_EINTRAG "Filterverringerung vorm Fehlerspeichereintrag | EN: Fault code EV7 - debounce filter decrement before fault-memory entry" VALUE 0x71253 TKW_VV_VV_UB 100.0 FORMULA_0003 0.0 255.0000 /end CHARACTERISTIC
/begin CHARACTERISTIC K_ED_EV8.DEC_VOR_EINTRAG "Filterverringerung vorm Fehlerspeichereintrag | EN: Fault code EV8 - debounce filter decrement before fault-memory entry" VALUE 0x7126D TKW_VV_VV_UB 100.0 FORMULA_0003 0.0 255.0000 /end CHARACTERISTIC
/begin CHARACTERISTIC K_ED_EV9.DEC_VOR_EINTRAG "Filterverringerung vorm Fehlerspeichereintrag | EN: Fault code EV9 - debounce filter decrement before fault-memory entry" VALUE 0x71287 TKW_VV_VV_UB 100.0 FORMULA_0003 0.0 255.0000 /end CHARACTERISTIC
/begin CHARACTERISTIC K_ED_EV10.DEC_VOR_EINTRAG "Filterverringerung vorm Fehlerspeichereintrag | EN: Fault code EV10 - debounce filter decrement before fault-memory entry" VALUE 0x712A1 TKW_VV_VV_UB 100.0 FORMULA_0003 0.0 255.0000 /end CHARACTERISTIC
/begin CHARACTERISTIC K_ED_DMTL_P.DEC_VOR_EINTRAG "Filterverringerung vorm Fehlerspeichereintrag | EN: Fault code DMTL_P - debounce filter decrement before fault-memory entry" VALUE 0x7133D TKW_VV_VV_UB 100.0 FORMULA_0003 0.0 255.0000 /end CHARACTERISTIC
/begin CHARACTERISTIC K_ED_DMTL_V.DEC_VOR_EINTRAG "Filterverringerung vorm Fehlerspeichereintrag | EN: Fault code DMTL_V - debounce filter decrement before fault-memory entry" VALUE 0x71357 TKW_VV_VV_UB 100.0 FORMULA_0003 0.0 255.0000 /end CHARACTERISTIC
/begin CHARACTERISTIC K_ED_DMTL_H.DEC_VOR_EINTRAG "Filterverringerung vorm Fehlerspeichereintrag | EN: Fault code DMTL_H - debounce filter decrement before fault-memory entry" VALUE 0x71371 TKW_VV_VV_UB 100.0 FORMULA_0003 0.0 255.0000 /end CHARACTERISTIC
/begin CHARACTERISTIC K_ED_DMTL_GROBLECK.DEC_VOR_EINTRAG "Filterverringerung vorm Fehlerspeichereintrag | EN: Fault code DMTL_GROBLECK - debounce filter decrement before fault-memory entry" VALUE 0x7138B TKW_VV_VV_UB 100.0 FORMULA_0003 0.0 255.0000 /end CHARACTERISTIC
/begin CHARACTERISTIC K_ED_DMTL_FEUCHT.DEC_VOR_EINTRAG "Filterverringerung vorm Fehlerspeichereintrag | EN: Fault code DMTL_FEUCHT - debounce filter decrement before fault-memory entry" VALUE 0x713A5 TKW_VV_VV_UB 100.0 FORMULA_0003 0.0 255.0000 /end CHARACTERISTIC
/begin CHARACTERISTIC K_ED_DMTL_DECKEL.DEC_VOR_EINTRAG "Filterverringerung vorm Fehlerspeichereintrag | EN: Fault code DMTL_DECKEL - debounce filter decrement before fault-memory entry" VALUE 0x713BF TKW_VV_VV_UB 100.0 FORMULA_0003 0.0 255.0000 /end CHARACTERISTIC
/begin CHARACTERISTIC K_ED_EKP_PWM.DEC_VOR_EINTRAG "Filterverringerung vorm Fehlerspeichereintrag | EN: Fault code EKP_PWM - debounce filter decrement before fault-memory entry" VALUE 0x71427 TKW_VV_VV_UB 100.0 FORMULA_0003 0.0 255.0000 /end CHARACTERISTIC
/begin CHARACTERISTIC K_ED_FI_GEN.DEC_VOR_EINTRAG "Filterverringerung vorm Fehlerspeichereintrag | EN: Fault code FI_GEN - debounce filter decrement before fault-memory entry" VALUE 0x71579 TKW_VV_VV_UB 100.0 FORMULA_0003 0.0 255.0000 /end CHARACTERISTIC
/begin CHARACTERISTIC K_ED_FI_BSD.DEC_VOR_EINTRAG "Filterverringerung vorm Fehlerspeichereintrag | EN: Fault code FI_BSD - debounce filter decrement before fault-memory entry" VALUE 0x71593 TKW_VV_VV_UB 100.0 FORMULA_0003 0.0 255.0000 /end CHARACTERISTIC
/begin CHARACTERISTIC K_ED_FI_IBS1.DEC_VOR_EINTRAG "Filterverringerung vorm Fehlerspeichereintrag | EN: Fault code FI_IBS1 - debounce filter decrement before fault-memory entry" VALUE 0x715C7 TKW_VV_VV_UB 100.0 FORMULA_0003 0.0 255.0000 /end CHARACTERISTIC
/begin CHARACTERISTIC K_ED_FI_IBS2.DEC_VOR_EINTRAG "Filterverringerung vorm Fehlerspeichereintrag | EN: Fault code FI_IBS2 - debounce filter decrement before fault-memory entry" VALUE 0x715E1 TKW_VV_VV_UB 100.0 FORMULA_0003 0.0 255.0000 /end CHARACTERISTIC
/begin CHARACTERISTIC K_ED_FI_IBS3.DEC_VOR_EINTRAG "Filterverringerung vorm Fehlerspeichereintrag | EN: Fault code FI_IBS3 - debounce filter decrement before fault-memory entry" VALUE 0x715FB TKW_VV_VV_UB 100.0 FORMULA_0003 0.0 255.0000 /end CHARACTERISTIC
/begin CHARACTERISTIC K_ED_FI_PMBATT.DEC_VOR_EINTRAG "Filterverringerung vorm Fehlerspeichereintrag | EN: Fault code FI_PMBATT - debounce filter decrement before fault-memory entry" VALUE 0x7162F TKW_VV_VV_UB 100.0 FORMULA_0003 0.0 255.0000 /end CHARACTERISTIC
/begin CHARACTERISTIC K_ED_EWS_SCI.DEC_VOR_EINTRAG "Filterverringerung vorm Fehlerspeichereintrag | EN: Fault code EWS_SCI - debounce filter decrement before fault-memory entry" VALUE 0x716B1 TKW_VV_VV_UB 100.0 FORMULA_0003 0.0 255.0000 /end CHARACTERISTIC
/begin CHARACTERISTIC K_ED_EWS_MAN.DEC_VOR_EINTRAG "Filterverringerung vorm Fehlerspeichereintrag | EN: Fault code EWS_MAN - debounce filter decrement before fault-memory entry" VALUE 0x716CB TKW_VV_VV_UB 100.0 FORMULA_0003 0.0 255.0000 /end CHARACTERISTIC
/begin CHARACTERISTIC K_ED_FI_BSD_0.DEC_VOR_EINTRAG "Filterverringerung vorm Fehlerspeichereintrag | EN: Fault code FI_BSD_0 - debounce filter decrement before fault-memory entry" VALUE 0x716E5 TKW_VV_VV_UB 100.0 FORMULA_0003 0.0 255.0000 /end CHARACTERISTIC
/begin CHARACTERISTIC K_ED_FI_BSD_6.DEC_VOR_EINTRAG "Filterverringerung vorm Fehlerspeichereintrag | EN: Fault code FI_BSD_6 - debounce filter decrement before fault-memory entry" VALUE 0x716FF TKW_VV_VV_UB 100.0 FORMULA_0003 0.0 255.0000 /end CHARACTERISTIC
/begin CHARACTERISTIC K_ED_FI_BSDGLOB.DEC_VOR_EINTRAG "Filterverringerung vorm Fehlerspeichereintrag | EN: Fault code FI_BSDGLOB - debounce filter decrement before fault-memory entry" VALUE 0x71719 TKW_VV_VV_UB 100.0 FORMULA_0003 0.0 255.0000 /end CHARACTERISTIC
/begin CHARACTERISTIC K_ED_EBOX_ELU.DEC_VOR_EINTRAG "Filterverringerung vorm Fehlerspeichereintrag | EN: Fault code EBOX_ELU - debounce filter decrement before fault-memory entry" VALUE 0x71767 TKW_VV_VV_UB 100.0 FORMULA_0003 0.0 255.0000 /end CHARACTERISTIC
/begin CHARACTERISTIC K_ED_DK1_ENLTG.DEC_VOR_EINTRAG "Filterverringerung vorm Fehlerspeichereintrag | EN: Fault code DK1_ENLTG - debounce filter decrement before fault-memory entry" VALUE 0x7179B TKW_VV_VV_UB 100.0 FORMULA_0003 0.0 255.0000 /end CHARACTERISTIC
/begin CHARACTERISTIC K_ED_DK2_ENLTG.DEC_VOR_EINTRAG "Filterverringerung vorm Fehlerspeichereintrag | EN: Fault code DK2_ENLTG - debounce filter decrement before fault-memory entry" VALUE 0x717B5 TKW_VV_VV_UB 100.0 FORMULA_0003 0.0 255.0000 /end CHARACTERISTIC
/begin CHARACTERISTIC K_ED_E2_INJ.DEC_VOR_EINTRAG "Filterverringerung vorm Fehlerspeichereintrag | EN: Fault code E2_INJ - debounce filter decrement before fault-memory entry" VALUE 0x71851 TKW_VV_VV_UB 100.0 FORMULA_0003 0.0 255.0000 /end CHARACTERISTIC
/begin CHARACTERISTIC K_ED_FETRAWE.DEC_VOR_EINTRAG "Filterverringerung vorm Fehlerspeichereintrag | EN: Fault code FETRAWE - debounce filter decrement before fault-memory entry" VALUE 0x7196F TKW_VV_VV_UB 100.0 FORMULA_0003 0.0 255.0000 /end CHARACTERISTIC
/begin CHARACTERISTIC K_ED_ELUP.DEC_VOR_EINTRAG "Filterverringerung vorm Fehlerspeichereintrag | EN: Fault code ELUP - debounce filter decrement before fault-memory entry" VALUE 0x719D7 TKW_VV_VV_UB 100.0 FORMULA_0003 0.0 255.0000 /end CHARACTERISTIC
/begin CHARACTERISTIC K_ED_ELU.DEC_VOR_EINTRAG "Filterverringerung vorm Fehlerspeichereintrag | EN: Fault code ELU - debounce filter decrement before fault-memory entry" VALUE 0x719F1 TKW_VV_VV_UB 100.0 FORMULA_0003 0.0 255.0000 /end CHARACTERISTIC
/begin CHARACTERISTIC K_ED_DMTL_FEINLECK.DEC_VOR_EINTRAG "Filterverringerung vorm Fehlerspeichereintrag | EN: Fault code DMTL_FEINLECK - debounce filter decrement before fault-memory entry" VALUE 0x71B0F TKW_VV_VV_UB 100.0 FORMULA_0003 0.0 255.0000 /end CHARACTERISTIC
/begin CHARACTERISTIC K_ED_ELUP_OBD.DEC_VOR_EINTRAG "Filterverringerung vorm Fehlerspeichereintrag" VALUE 0x71D65 TKW_VV_VV_UB 100.0 FORMULA_0003 0.0 255.0000 /end CHARACTERISTIC
/begin CHARACTERISTIC K_ED_APPL_DATA_INJ.INC_NACH_EINTRAG "Filtererhoehung nach Fehlerspeichereintrag | EN: Fault code APPL_DATA_INJ - debounce filter increment after fault-memory entry" VALUE 0x70F96 TKW_VV_VV_UB 100.0 FORMULA_0003 0.0 255.0000 /end CHARACTERISTIC
/begin CHARACTERISTIC K_ED_EV1.INC_NACH_EINTRAG "Filtererhoehung nach Fehlerspeichereintrag | EN: Fault code EV1 - debounce filter increment after fault-memory entry" VALUE 0x711B8 TKW_VV_VV_UB 100.0 FORMULA_0003 0.0 255.0000 /end CHARACTERISTIC
/begin CHARACTERISTIC K_ED_EV2.INC_NACH_EINTRAG "Filtererhoehung nach Fehlerspeichereintrag | EN: Fault code EV2 - debounce filter increment after fault-memory entry" VALUE 0x711D2 TKW_VV_VV_UB 100.0 FORMULA_0003 0.0 255.0000 /end CHARACTERISTIC
/begin CHARACTERISTIC K_ED_EV3.INC_NACH_EINTRAG "Filtererhoehung nach Fehlerspeichereintrag | EN: Fault code EV3 - debounce filter increment after fault-memory entry" VALUE 0x711EC TKW_VV_VV_UB 100.0 FORMULA_0003 0.0 255.0000 /end CHARACTERISTIC
/begin CHARACTERISTIC K_ED_EV4.INC_NACH_EINTRAG "Filtererhoehung nach Fehlerspeichereintrag | EN: Fault code EV4 - debounce filter increment after fault-memory entry" VALUE 0x71206 TKW_VV_VV_UB 100.0 FORMULA_0003 0.0 255.0000 /end CHARACTERISTIC
/begin CHARACTERISTIC K_ED_EV5.INC_NACH_EINTRAG "Filtererhoehung nach Fehlerspeichereintrag | EN: Fault code EV5 - debounce filter increment after fault-memory entry" VALUE 0x71220 TKW_VV_VV_UB 100.0 FORMULA_0003 0.0 255.0000 /end CHARACTERISTIC
/begin CHARACTERISTIC K_ED_EV6.INC_NACH_EINTRAG "Filtererhoehung nach Fehlerspeichereintrag | EN: Fault code EV6 - debounce filter increment after fault-memory entry" VALUE 0x7123A TKW_VV_VV_UB 100.0 FORMULA_0003 0.0 255.0000 /end CHARACTERISTIC
/begin CHARACTERISTIC K_ED_EV7.INC_NACH_EINTRAG "Filtererhoehung nach Fehlerspeichereintrag | EN: Fault code EV7 - debounce filter increment after fault-memory entry" VALUE 0x71254 TKW_VV_VV_UB 100.0 FORMULA_0003 0.0 255.0000 /end CHARACTERISTIC
/begin CHARACTERISTIC K_ED_EV8.INC_NACH_EINTRAG "Filtererhoehung nach Fehlerspeichereintrag | EN: Fault code EV8 - debounce filter increment after fault-memory entry" VALUE 0x7126E TKW_VV_VV_UB 100.0 FORMULA_0003 0.0 255.0000 /end CHARACTERISTIC
/begin CHARACTERISTIC K_ED_EV9.INC_NACH_EINTRAG "Filtererhoehung nach Fehlerspeichereintrag | EN: Fault code EV9 - debounce filter increment after fault-memory entry" VALUE 0x71288 TKW_VV_VV_UB 100.0 FORMULA_0003 0.0 255.0000 /end CHARACTERISTIC
/begin CHARACTERISTIC K_ED_EV10.INC_NACH_EINTRAG "Filtererhoehung nach Fehlerspeichereintrag | EN: Fault code EV10 - debounce filter increment after fault-memory entry" VALUE 0x712A2 TKW_VV_VV_UB 100.0 FORMULA_0003 0.0 255.0000 /end CHARACTERISTIC
/begin CHARACTERISTIC K_ED_DMTL_P.INC_NACH_EINTRAG "Filtererhoehung nach Fehlerspeichereintrag | EN: Fault code DMTL_P - debounce filter increment after fault-memory entry" VALUE 0x7133E TKW_VV_VV_UB 100.0 FORMULA_0003 0.0 255.0000 /end CHARACTERISTIC
/begin CHARACTERISTIC K_ED_DMTL_V.INC_NACH_EINTRAG "Filtererhoehung nach Fehlerspeichereintrag | EN: Fault code DMTL_V - debounce filter increment after fault-memory entry" VALUE 0x71358 TKW_VV_VV_UB 100.0 FORMULA_0003 0.0 255.0000 /end CHARACTERISTIC
/begin CHARACTERISTIC K_ED_DMTL_H.INC_NACH_EINTRAG "Filtererhoehung nach Fehlerspeichereintrag | EN: Fault code DMTL_H - debounce filter increment after fault-memory entry" VALUE 0x71372 TKW_VV_VV_UB 100.0 FORMULA_0003 0.0 255.0000 /end CHARACTERISTIC
/begin CHARACTERISTIC K_ED_DMTL_GROBLECK.INC_NACH_EINTRAG "Filtererhoehung nach Fehlerspeichereintrag | EN: Fault code DMTL_GROBLECK - debounce filter increment after fault-memory entry" VALUE 0x7138C TKW_VV_VV_UB 100.0 FORMULA_0003 0.0 255.0000 /end CHARACTERISTIC
/begin CHARACTERISTIC K_ED_DMTL_FEUCHT.INC_NACH_EINTRAG "Filtererhoehung nach Fehlerspeichereintrag | EN: Fault code DMTL_FEUCHT - debounce filter increment after fault-memory entry" VALUE 0x713A6 TKW_VV_VV_UB 100.0 FORMULA_0003 0.0 255.0000 /end CHARACTERISTIC
/begin CHARACTERISTIC K_ED_DMTL_DECKEL.INC_NACH_EINTRAG "Filtererhoehung nach Fehlerspeichereintrag | EN: Fault code DMTL_DECKEL - debounce filter increment after fault-memory entry" VALUE 0x713C0 TKW_VV_VV_UB 100.0 FORMULA_0003 0.0 255.0000 /end CHARACTERISTIC
/begin CHARACTERISTIC K_ED_EKP_PWM.INC_NACH_EINTRAG "Filtererhoehung nach Fehlerspeichereintrag | EN: Fault code EKP_PWM - debounce filter increment after fault-memory entry" VALUE 0x71428 TKW_VV_VV_UB 100.0 FORMULA_0003 0.0 255.0000 /end CHARACTERISTIC
/begin CHARACTERISTIC K_ED_FI_GEN.INC_NACH_EINTRAG "Filtererhoehung nach Fehlerspeichereintrag | EN: Fault code FI_GEN - debounce filter increment after fault-memory entry" VALUE 0x7157A TKW_VV_VV_UB 100.0 FORMULA_0003 0.0 255.0000 /end CHARACTERISTIC
/begin CHARACTERISTIC K_ED_FI_BSD.INC_NACH_EINTRAG "Filtererhoehung nach Fehlerspeichereintrag | EN: Fault code FI_BSD - debounce filter increment after fault-memory entry" VALUE 0x71594 TKW_VV_VV_UB 100.0 FORMULA_0003 0.0 255.0000 /end CHARACTERISTIC
/begin CHARACTERISTIC K_ED_FI_IBS1.INC_NACH_EINTRAG "Filtererhoehung nach Fehlerspeichereintrag | EN: Fault code FI_IBS1 - debounce filter increment after fault-memory entry" VALUE 0x715C8 TKW_VV_VV_UB 100.0 FORMULA_0003 0.0 255.0000 /end CHARACTERISTIC
/begin CHARACTERISTIC K_ED_FI_IBS2.INC_NACH_EINTRAG "Filtererhoehung nach Fehlerspeichereintrag | EN: Fault code FI_IBS2 - debounce filter increment after fault-memory entry" VALUE 0x715E2 TKW_VV_VV_UB 100.0 FORMULA_0003 0.0 255.0000 /end CHARACTERISTIC
/begin CHARACTERISTIC K_ED_FI_IBS3.INC_NACH_EINTRAG "Filtererhoehung nach Fehlerspeichereintrag | EN: Fault code FI_IBS3 - debounce filter increment after fault-memory entry" VALUE 0x715FC TKW_VV_VV_UB 100.0 FORMULA_0003 0.0 255.0000 /end CHARACTERISTIC
/begin CHARACTERISTIC K_ED_FI_PMBATT.INC_NACH_EINTRAG "Filtererhoehung nach Fehlerspeichereintrag | EN: Fault code FI_PMBATT - debounce filter increment after fault-memory entry" VALUE 0x71630 TKW_VV_VV_UB 100.0 FORMULA_0003 0.0 255.0000 /end CHARACTERISTIC
/begin CHARACTERISTIC K_ED_EWS_SCI.INC_NACH_EINTRAG "Filtererhoehung nach Fehlerspeichereintrag | EN: Fault code EWS_SCI - debounce filter increment after fault-memory entry" VALUE 0x716B2 TKW_VV_VV_UB 100.0 FORMULA_0003 0.0 255.0000 /end CHARACTERISTIC
/begin CHARACTERISTIC K_ED_EWS_MAN.INC_NACH_EINTRAG "Filtererhoehung nach Fehlerspeichereintrag | EN: Fault code EWS_MAN - debounce filter increment after fault-memory entry" VALUE 0x716CC TKW_VV_VV_UB 100.0 FORMULA_0003 0.0 255.0000 /end CHARACTERISTIC
/begin CHARACTERISTIC K_ED_FI_BSD_0.INC_NACH_EINTRAG "Filtererhoehung nach Fehlerspeichereintrag | EN: Fault code FI_BSD_0 - debounce filter increment after fault-memory entry" VALUE 0x716E6 TKW_VV_VV_UB 100.0 FORMULA_0003 0.0 255.0000 /end CHARACTERISTIC
/begin CHARACTERISTIC K_ED_FI_BSD_6.INC_NACH_EINTRAG "Filtererhoehung nach Fehlerspeichereintrag | EN: Fault code FI_BSD_6 - debounce filter increment after fault-memory entry" VALUE 0x71700 TKW_VV_VV_UB 100.0 FORMULA_0003 0.0 255.0000 /end CHARACTERISTIC
/begin CHARACTERISTIC K_ED_FI_BSDGLOB.INC_NACH_EINTRAG "Filtererhoehung nach Fehlerspeichereintrag | EN: Fault code FI_BSDGLOB - debounce filter increment after fault-memory entry" VALUE 0x7171A TKW_VV_VV_UB 100.0 FORMULA_0003 0.0 255.0000 /end CHARACTERISTIC
/begin CHARACTERISTIC K_ED_EBOX_ELU.INC_NACH_EINTRAG "Filtererhoehung nach Fehlerspeichereintrag | EN: Fault code EBOX_ELU - debounce filter increment after fault-memory entry" VALUE 0x71768 TKW_VV_VV_UB 100.0 FORMULA_0003 0.0 255.0000 /end CHARACTERISTIC
/begin CHARACTERISTIC K_ED_DK1_ENLTG.INC_NACH_EINTRAG "Filtererhoehung nach Fehlerspeichereintrag | EN: Fault code DK1_ENLTG - debounce filter increment after fault-memory entry" VALUE 0x7179C TKW_VV_VV_UB 100.0 FORMULA_0003 0.0 255.0000 /end CHARACTERISTIC
/begin CHARACTERISTIC K_ED_DK2_ENLTG.INC_NACH_EINTRAG "Filtererhoehung nach Fehlerspeichereintrag | EN: Fault code DK2_ENLTG - debounce filter increment after fault-memory entry" VALUE 0x717B6 TKW_VV_VV_UB 100.0 FORMULA_0003 0.0 255.0000 /end CHARACTERISTIC
/begin CHARACTERISTIC K_ED_E2_INJ.INC_NACH_EINTRAG "Filtererhoehung nach Fehlerspeichereintrag | EN: Fault code E2_INJ - debounce filter increment after fault-memory entry" VALUE 0x71852 TKW_VV_VV_UB 100.0 FORMULA_0003 0.0 255.0000 /end CHARACTERISTIC
/begin CHARACTERISTIC K_ED_FETRAWE.INC_NACH_EINTRAG "Filtererhoehung nach Fehlerspeichereintrag | EN: Fault code FETRAWE - debounce filter increment after fault-memory entry" VALUE 0x71970 TKW_VV_VV_UB 100.0 FORMULA_0003 0.0 255.0000 /end CHARACTERISTIC
/begin CHARACTERISTIC K_ED_ELUP.INC_NACH_EINTRAG "Filtererhoehung nach Fehlerspeichereintrag | EN: Fault code ELUP - debounce filter increment after fault-memory entry" VALUE 0x719D8 TKW_VV_VV_UB 100.0 FORMULA_0003 0.0 255.0000 /end CHARACTERISTIC
/begin CHARACTERISTIC K_ED_ELU.INC_NACH_EINTRAG "Filtererhoehung nach Fehlerspeichereintrag | EN: Fault code ELU - debounce filter increment after fault-memory entry" VALUE 0x719F2 TKW_VV_VV_UB 100.0 FORMULA_0003 0.0 255.0000 /end CHARACTERISTIC
/begin CHARACTERISTIC K_ED_DMTL_FEINLECK.INC_NACH_EINTRAG "Filtererhoehung nach Fehlerspeichereintrag | EN: Fault code DMTL_FEINLECK - debounce filter increment after fault-memory entry" VALUE 0x71B10 TKW_VV_VV_UB 100.0 FORMULA_0003 0.0 255.0000 /end CHARACTERISTIC
/begin CHARACTERISTIC K_ED_ELUP_OBD.INC_NACH_EINTRAG "Filtererhoehung nach Fehlerspeichereintrag" VALUE 0x71D66 TKW_VV_VV_UB 100.0 FORMULA_0003 0.0 255.0000 /end CHARACTERISTIC
/begin CHARACTERISTIC K_ED_APPL_DATA_INJ.DEC_NACH_EINTRAG "Filterverringerung nach Fehlerspeichereintrag | EN: Fault code APPL_DATA_INJ - debounce filter decrement after fault-memory entry" VALUE 0x70F97 TKW_VV_VV_UB 100.0 FORMULA_0003 0.0 255.0000 /end CHARACTERISTIC
/begin CHARACTERISTIC K_ED_EV1.DEC_NACH_EINTRAG "Filterverringerung nach Fehlerspeichereintrag | EN: Fault code EV1 - debounce filter decrement after fault-memory entry" VALUE 0x711B9 TKW_VV_VV_UB 100.0 FORMULA_0003 0.0 255.0000 /end CHARACTERISTIC
/begin CHARACTERISTIC K_ED_EV2.DEC_NACH_EINTRAG "Filterverringerung nach Fehlerspeichereintrag | EN: Fault code EV2 - debounce filter decrement after fault-memory entry" VALUE 0x711D3 TKW_VV_VV_UB 100.0 FORMULA_0003 0.0 255.0000 /end CHARACTERISTIC
/begin CHARACTERISTIC K_ED_EV3.DEC_NACH_EINTRAG "Filterverringerung nach Fehlerspeichereintrag | EN: Fault code EV3 - debounce filter decrement after fault-memory entry" VALUE 0x711ED TKW_VV_VV_UB 100.0 FORMULA_0003 0.0 255.0000 /end CHARACTERISTIC
/begin CHARACTERISTIC K_ED_EV4.DEC_NACH_EINTRAG "Filterverringerung nach Fehlerspeichereintrag | EN: Fault code EV4 - debounce filter decrement after fault-memory entry" VALUE 0x71207 TKW_VV_VV_UB 100.0 FORMULA_0003 0.0 255.0000 /end CHARACTERISTIC
/begin CHARACTERISTIC K_ED_EV5.DEC_NACH_EINTRAG "Filterverringerung nach Fehlerspeichereintrag | EN: Fault code EV5 - debounce filter decrement after fault-memory entry" VALUE 0x71221 TKW_VV_VV_UB 100.0 FORMULA_0003 0.0 255.0000 /end CHARACTERISTIC
/begin CHARACTERISTIC K_ED_EV6.DEC_NACH_EINTRAG "Filterverringerung nach Fehlerspeichereintrag | EN: Fault code EV6 - debounce filter decrement after fault-memory entry" VALUE 0x7123B TKW_VV_VV_UB 100.0 FORMULA_0003 0.0 255.0000 /end CHARACTERISTIC
/begin CHARACTERISTIC K_ED_EV7.DEC_NACH_EINTRAG "Filterverringerung nach Fehlerspeichereintrag | EN: Fault code EV7 - debounce filter decrement after fault-memory entry" VALUE 0x71255 TKW_VV_VV_UB 100.0 FORMULA_0003 0.0 255.0000 /end CHARACTERISTIC
/begin CHARACTERISTIC K_ED_EV8.DEC_NACH_EINTRAG "Filterverringerung nach Fehlerspeichereintrag | EN: Fault code EV8 - debounce filter decrement after fault-memory entry" VALUE 0x7126F TKW_VV_VV_UB 100.0 FORMULA_0003 0.0 255.0000 /end CHARACTERISTIC
/begin CHARACTERISTIC K_ED_EV9.DEC_NACH_EINTRAG "Filterverringerung nach Fehlerspeichereintrag | EN: Fault code EV9 - debounce filter decrement after fault-memory entry" VALUE 0x71289 TKW_VV_VV_UB 100.0 FORMULA_0003 0.0 255.0000 /end CHARACTERISTIC
/begin CHARACTERISTIC K_ED_EV10.DEC_NACH_EINTRAG "Filterverringerung nach Fehlerspeichereintrag | EN: Fault code EV10 - debounce filter decrement after fault-memory entry" VALUE 0x712A3 TKW_VV_VV_UB 100.0 FORMULA_0003 0.0 255.0000 /end CHARACTERISTIC
/begin CHARACTERISTIC K_ED_DMTL_P.DEC_NACH_EINTRAG "Filterverringerung nach Fehlerspeichereintrag | EN: Fault code DMTL_P - debounce filter decrement after fault-memory entry" VALUE 0x7133F TKW_VV_VV_UB 100.0 FORMULA_0003 0.0 255.0000 /end CHARACTERISTIC
/begin CHARACTERISTIC K_ED_DMTL_V.DEC_NACH_EINTRAG "Filterverringerung nach Fehlerspeichereintrag | EN: Fault code DMTL_V - debounce filter decrement after fault-memory entry" VALUE 0x71359 TKW_VV_VV_UB 100.0 FORMULA_0003 0.0 255.0000 /end CHARACTERISTIC
/begin CHARACTERISTIC K_ED_DMTL_H.DEC_NACH_EINTRAG "Filterverringerung nach Fehlerspeichereintrag | EN: Fault code DMTL_H - debounce filter decrement after fault-memory entry" VALUE 0x71373 TKW_VV_VV_UB 100.0 FORMULA_0003 0.0 255.0000 /end CHARACTERISTIC
/begin CHARACTERISTIC K_ED_DMTL_GROBLECK.DEC_NACH_EINTRAG "Filterverringerung nach Fehlerspeichereintrag | EN: Fault code DMTL_GROBLECK - debounce filter decrement after fault-memory entry" VALUE 0x7138D TKW_VV_VV_UB 100.0 FORMULA_0003 0.0 255.0000 /end CHARACTERISTIC
/begin CHARACTERISTIC K_ED_DMTL_FEUCHT.DEC_NACH_EINTRAG "Filterverringerung nach Fehlerspeichereintrag | EN: Fault code DMTL_FEUCHT - debounce filter decrement after fault-memory entry" VALUE 0x713A7 TKW_VV_VV_UB 100.0 FORMULA_0003 0.0 255.0000 /end CHARACTERISTIC
/begin CHARACTERISTIC K_ED_DMTL_DECKEL.DEC_NACH_EINTRAG "Filterverringerung nach Fehlerspeichereintrag | EN: Fault code DMTL_DECKEL - debounce filter decrement after fault-memory entry" VALUE 0x713C1 TKW_VV_VV_UB 100.0 FORMULA_0003 0.0 255.0000 /end CHARACTERISTIC
/begin CHARACTERISTIC K_ED_EKP_PWM.DEC_NACH_EINTRAG "Filterverringerung nach Fehlerspeichereintrag | EN: Fault code EKP_PWM - debounce filter decrement after fault-memory entry" VALUE 0x71429 TKW_VV_VV_UB 100.0 FORMULA_0003 0.0 255.0000 /end CHARACTERISTIC
/begin CHARACTERISTIC K_ED_FI_GEN.DEC_NACH_EINTRAG "Filterverringerung nach Fehlerspeichereintrag | EN: Fault code FI_GEN - debounce filter decrement after fault-memory entry" VALUE 0x7157B TKW_VV_VV_UB 100.0 FORMULA_0003 0.0 255.0000 /end CHARACTERISTIC
/begin CHARACTERISTIC K_ED_FI_BSD.DEC_NACH_EINTRAG "Filterverringerung nach Fehlerspeichereintrag | EN: Fault code FI_BSD - debounce filter decrement after fault-memory entry" VALUE 0x71595 TKW_VV_VV_UB 100.0 FORMULA_0003 0.0 255.0000 /end CHARACTERISTIC
/begin CHARACTERISTIC K_ED_FI_IBS1.DEC_NACH_EINTRAG "Filterverringerung nach Fehlerspeichereintrag | EN: Fault code FI_IBS1 - debounce filter decrement after fault-memory entry" VALUE 0x715C9 TKW_VV_VV_UB 100.0 FORMULA_0003 0.0 255.0000 /end CHARACTERISTIC
/begin CHARACTERISTIC K_ED_FI_IBS2.DEC_NACH_EINTRAG "Filterverringerung nach Fehlerspeichereintrag | EN: Fault code FI_IBS2 - debounce filter decrement after fault-memory entry" VALUE 0x715E3 TKW_VV_VV_UB 100.0 FORMULA_0003 0.0 255.0000 /end CHARACTERISTIC
/begin CHARACTERISTIC K_ED_FI_IBS3.DEC_NACH_EINTRAG "Filterverringerung nach Fehlerspeichereintrag | EN: Fault code FI_IBS3 - debounce filter decrement after fault-memory entry" VALUE 0x715FD TKW_VV_VV_UB 100.0 FORMULA_0003 0.0 255.0000 /end CHARACTERISTIC
/begin CHARACTERISTIC K_ED_FI_PMBATT.DEC_NACH_EINTRAG "Filterverringerung nach Fehlerspeichereintrag | EN: Fault code FI_PMBATT - debounce filter decrement after fault-memory entry" VALUE 0x71631 TKW_VV_VV_UB 100.0 FORMULA_0003 0.0 255.0000 /end CHARACTERISTIC
/begin CHARACTERISTIC K_ED_EWS_SCI.DEC_NACH_EINTRAG "Filterverringerung nach Fehlerspeichereintrag | EN: Fault code EWS_SCI - debounce filter decrement after fault-memory entry" VALUE 0x716B3 TKW_VV_VV_UB 100.0 FORMULA_0003 0.0 255.0000 /end CHARACTERISTIC
/begin CHARACTERISTIC K_ED_EWS_MAN.DEC_NACH_EINTRAG "Filterverringerung nach Fehlerspeichereintrag | EN: Fault code EWS_MAN - debounce filter decrement after fault-memory entry" VALUE 0x716CD TKW_VV_VV_UB 100.0 FORMULA_0003 0.0 255.0000 /end CHARACTERISTIC
/begin CHARACTERISTIC K_ED_FI_BSD_0.DEC_NACH_EINTRAG "Filterverringerung nach Fehlerspeichereintrag | EN: Fault code FI_BSD_0 - debounce filter decrement after fault-memory entry" VALUE 0x716E7 TKW_VV_VV_UB 100.0 FORMULA_0003 0.0 255.0000 /end CHARACTERISTIC
/begin CHARACTERISTIC K_ED_FI_BSD_6.DEC_NACH_EINTRAG "Filterverringerung nach Fehlerspeichereintrag | EN: Fault code FI_BSD_6 - debounce filter decrement after fault-memory entry" VALUE 0x71701 TKW_VV_VV_UB 100.0 FORMULA_0003 0.0 255.0000 /end CHARACTERISTIC
/begin CHARACTERISTIC K_ED_FI_BSDGLOB.DEC_NACH_EINTRAG "Filterverringerung nach Fehlerspeichereintrag | EN: Fault code FI_BSDGLOB - debounce filter decrement after fault-memory entry" VALUE 0x7171B TKW_VV_VV_UB 100.0 FORMULA_0003 0.0 255.0000 /end CHARACTERISTIC
/begin CHARACTERISTIC K_ED_EBOX_ELU.DEC_NACH_EINTRAG "Filterverringerung nach Fehlerspeichereintrag | EN: Fault code EBOX_ELU - debounce filter decrement after fault-memory entry" VALUE 0x71769 TKW_VV_VV_UB 100.0 FORMULA_0003 0.0 255.0000 /end CHARACTERISTIC
/begin CHARACTERISTIC K_ED_DK1_ENLTG.DEC_NACH_EINTRAG "Filterverringerung nach Fehlerspeichereintrag | EN: Fault code DK1_ENLTG - debounce filter decrement after fault-memory entry" VALUE 0x7179D TKW_VV_VV_UB 100.0 FORMULA_0003 0.0 255.0000 /end CHARACTERISTIC
/begin CHARACTERISTIC K_ED_DK2_ENLTG.DEC_NACH_EINTRAG "Filterverringerung nach Fehlerspeichereintrag | EN: Fault code DK2_ENLTG - debounce filter decrement after fault-memory entry" VALUE 0x717B7 TKW_VV_VV_UB 100.0 FORMULA_0003 0.0 255.0000 /end CHARACTERISTIC
/begin CHARACTERISTIC K_ED_E2_INJ.DEC_NACH_EINTRAG "Filterverringerung nach Fehlerspeichereintrag | EN: Fault code E2_INJ - debounce filter decrement after fault-memory entry" VALUE 0x71853 TKW_VV_VV_UB 100.0 FORMULA_0003 0.0 255.0000 /end CHARACTERISTIC
/begin CHARACTERISTIC K_ED_FETRAWE.DEC_NACH_EINTRAG "Filterverringerung nach Fehlerspeichereintrag | EN: Fault code FETRAWE - debounce filter decrement after fault-memory entry" VALUE 0x71971 TKW_VV_VV_UB 100.0 FORMULA_0003 0.0 255.0000 /end CHARACTERISTIC
/begin CHARACTERISTIC K_ED_ELUP.DEC_NACH_EINTRAG "Filterverringerung nach Fehlerspeichereintrag | EN: Fault code ELUP - debounce filter decrement after fault-memory entry" VALUE 0x719D9 TKW_VV_VV_UB 100.0 FORMULA_0003 0.0 255.0000 /end CHARACTERISTIC
/begin CHARACTERISTIC K_ED_ELU.DEC_NACH_EINTRAG "Filterverringerung nach Fehlerspeichereintrag | EN: Fault code ELU - debounce filter decrement after fault-memory entry" VALUE 0x719F3 TKW_VV_VV_UB 100.0 FORMULA_0003 0.0 255.0000 /end CHARACTERISTIC
/begin CHARACTERISTIC K_ED_DMTL_FEINLECK.DEC_NACH_EINTRAG "Filterverringerung nach Fehlerspeichereintrag | EN: Fault code DMTL_FEINLECK - debounce filter decrement after fault-memory entry" VALUE 0x71B11 TKW_VV_VV_UB 100.0 FORMULA_0003 0.0 255.0000 /end CHARACTERISTIC
/begin CHARACTERISTIC K_ED_ELUP_OBD.DEC_NACH_EINTRAG "Filterverringerung nach Fehlerspeichereintrag" VALUE 0x71D67 TKW_VV_VV_UB 100.0 FORMULA_0003 0.0 255.0000 /end CHARACTERISTIC
/begin CHARACTERISTIC K_ED_APPL_DATA_INJ.KLASSENINDEX "Auswahl der Fehlerklasse | EN: Fault code APPL_DATA_INJ - fault class selection (lamp / warning behaviour)" VALUE 0x70F98 TKW_VV_VV_UB 100.0 FORMULA_0003 0.0 8.0000 /end CHARACTERISTIC
/begin CHARACTERISTIC K_ED_EV1.KLASSENINDEX "Auswahl der Fehlerklasse | EN: Fault code EV1 - fault class selection (lamp / warning behaviour)" VALUE 0x711BA TKW_VV_VV_UB 100.0 FORMULA_0003 0.0 8.0000 /end CHARACTERISTIC
/begin CHARACTERISTIC K_ED_EV2.KLASSENINDEX "Auswahl der Fehlerklasse | EN: Fault code EV2 - fault class selection (lamp / warning behaviour)" VALUE 0x711D4 TKW_VV_VV_UB 100.0 FORMULA_0003 0.0 8.0000 /end CHARACTERISTIC
/begin CHARACTERISTIC K_ED_EV3.KLASSENINDEX "Auswahl der Fehlerklasse | EN: Fault code EV3 - fault class selection (lamp / warning behaviour)" VALUE 0x711EE TKW_VV_VV_UB 100.0 FORMULA_0003 0.0 8.0000 /end CHARACTERISTIC
/begin CHARACTERISTIC K_ED_EV4.KLASSENINDEX "Auswahl der Fehlerklasse | EN: Fault code EV4 - fault class selection (lamp / warning behaviour)" VALUE 0x71208 TKW_VV_VV_UB 100.0 FORMULA_0003 0.0 8.0000 /end CHARACTERISTIC
/begin CHARACTERISTIC K_ED_EV5.KLASSENINDEX "Auswahl der Fehlerklasse | EN: Fault code EV5 - fault class selection (lamp / warning behaviour)" VALUE 0x71222 TKW_VV_VV_UB 100.0 FORMULA_0003 0.0 8.0000 /end CHARACTERISTIC
/begin CHARACTERISTIC K_ED_EV6.KLASSENINDEX "Auswahl der Fehlerklasse | EN: Fault code EV6 - fault class selection (lamp / warning behaviour)" VALUE 0x7123C TKW_VV_VV_UB 100.0 FORMULA_0003 0.0 8.0000 /end CHARACTERISTIC
/begin CHARACTERISTIC K_ED_EV7.KLASSENINDEX "Auswahl der Fehlerklasse | EN: Fault code EV7 - fault class selection (lamp / warning behaviour)" VALUE 0x71256 TKW_VV_VV_UB 100.0 FORMULA_0003 0.0 8.0000 /end CHARACTERISTIC
/begin CHARACTERISTIC K_ED_EV8.KLASSENINDEX "Auswahl der Fehlerklasse | EN: Fault code EV8 - fault class selection (lamp / warning behaviour)" VALUE 0x71270 TKW_VV_VV_UB 100.0 FORMULA_0003 0.0 8.0000 /end CHARACTERISTIC
/begin CHARACTERISTIC K_ED_EV9.KLASSENINDEX "Auswahl der Fehlerklasse | EN: Fault code EV9 - fault class selection (lamp / warning behaviour)" VALUE 0x7128A TKW_VV_VV_UB 100.0 FORMULA_0003 0.0 8.0000 /end CHARACTERISTIC
/begin CHARACTERISTIC K_ED_EV10.KLASSENINDEX "Auswahl der Fehlerklasse | EN: Fault code EV10 - fault class selection (lamp / warning behaviour)" VALUE 0x712A4 TKW_VV_VV_UB 100.0 FORMULA_0003 0.0 8.0000 /end CHARACTERISTIC
/begin CHARACTERISTIC K_ED_DMTL_P.KLASSENINDEX "Auswahl der Fehlerklasse | EN: Fault code DMTL_P - fault class selection (lamp / warning behaviour)" VALUE 0x71340 TKW_VV_VV_UB 100.0 FORMULA_0003 0.0 8.0000 /end CHARACTERISTIC
/begin CHARACTERISTIC K_ED_DMTL_V.KLASSENINDEX "Auswahl der Fehlerklasse | EN: Fault code DMTL_V - fault class selection (lamp / warning behaviour)" VALUE 0x7135A TKW_VV_VV_UB 100.0 FORMULA_0003 0.0 8.0000 /end CHARACTERISTIC
/begin CHARACTERISTIC K_ED_DMTL_H.KLASSENINDEX "Auswahl der Fehlerklasse | EN: Fault code DMTL_H - fault class selection (lamp / warning behaviour)" VALUE 0x71374 TKW_VV_VV_UB 100.0 FORMULA_0003 0.0 8.0000 /end CHARACTERISTIC
/begin CHARACTERISTIC K_ED_DMTL_GROBLECK.KLASSENINDEX "Auswahl der Fehlerklasse | EN: Fault code DMTL_GROBLECK - fault class selection (lamp / warning behaviour)" VALUE 0x7138E TKW_VV_VV_UB 100.0 FORMULA_0003 0.0 8.0000 /end CHARACTERISTIC
/begin CHARACTERISTIC K_ED_DMTL_FEUCHT.KLASSENINDEX "Auswahl der Fehlerklasse | EN: Fault code DMTL_FEUCHT - fault class selection (lamp / warning behaviour)" VALUE 0x713A8 TKW_VV_VV_UB 100.0 FORMULA_0003 0.0 8.0000 /end CHARACTERISTIC
/begin CHARACTERISTIC K_ED_DMTL_DECKEL.KLASSENINDEX "Auswahl der Fehlerklasse | EN: Fault code DMTL_DECKEL - fault class selection (lamp / warning behaviour)" VALUE 0x713C2 TKW_VV_VV_UB 100.0 FORMULA_0003 0.0 8.0000 /end CHARACTERISTIC
/begin CHARACTERISTIC K_ED_EKP_PWM.KLASSENINDEX "Auswahl der Fehlerklasse | EN: Fault code EKP_PWM - fault class selection (lamp / warning behaviour)" VALUE 0x7142A TKW_VV_VV_UB 100.0 FORMULA_0003 0.0 8.0000 /end CHARACTERISTIC
/begin CHARACTERISTIC K_ED_FI_GEN.KLASSENINDEX "Auswahl der Fehlerklasse | EN: Fault code FI_GEN - fault class selection (lamp / warning behaviour)" VALUE 0x7157C TKW_VV_VV_UB 100.0 FORMULA_0003 0.0 8.0000 /end CHARACTERISTIC
/begin CHARACTERISTIC K_ED_FI_BSD.KLASSENINDEX "Auswahl der Fehlerklasse | EN: Fault code FI_BSD - fault class selection (lamp / warning behaviour)" VALUE 0x71596 TKW_VV_VV_UB 100.0 FORMULA_0003 0.0 8.0000 /end CHARACTERISTIC
/begin CHARACTERISTIC K_ED_FI_IBS1.KLASSENINDEX "Auswahl der Fehlerklasse | EN: Fault code FI_IBS1 - fault class selection (lamp / warning behaviour)" VALUE 0x715CA TKW_VV_VV_UB 100.0 FORMULA_0003 0.0 8.0000 /end CHARACTERISTIC
/begin CHARACTERISTIC K_ED_FI_IBS2.KLASSENINDEX "Auswahl der Fehlerklasse | EN: Fault code FI_IBS2 - fault class selection (lamp / warning behaviour)" VALUE 0x715E4 TKW_VV_VV_UB 100.0 FORMULA_0003 0.0 8.0000 /end CHARACTERISTIC
/begin CHARACTERISTIC K_ED_FI_IBS3.KLASSENINDEX "Auswahl der Fehlerklasse | EN: Fault code FI_IBS3 - fault class selection (lamp / warning behaviour)" VALUE 0x715FE TKW_VV_VV_UB 100.0 FORMULA_0003 0.0 8.0000 /end CHARACTERISTIC
/begin CHARACTERISTIC K_ED_FI_PMBATT.KLASSENINDEX "Auswahl der Fehlerklasse | EN: Fault code FI_PMBATT - fault class selection (lamp / warning behaviour)" VALUE 0x71632 TKW_VV_VV_UB 100.0 FORMULA_0003 0.0 8.0000 /end CHARACTERISTIC
/begin CHARACTERISTIC K_ED_EWS_SCI.KLASSENINDEX "Auswahl der Fehlerklasse | EN: Fault code EWS_SCI - fault class selection (lamp / warning behaviour)" VALUE 0x716B4 TKW_VV_VV_UB 100.0 FORMULA_0003 0.0 8.0000 /end CHARACTERISTIC
/begin CHARACTERISTIC K_ED_EWS_MAN.KLASSENINDEX "Auswahl der Fehlerklasse | EN: Fault code EWS_MAN - fault class selection (lamp / warning behaviour)" VALUE 0x716CE TKW_VV_VV_UB 100.0 FORMULA_0003 0.0 8.0000 /end CHARACTERISTIC
/begin CHARACTERISTIC K_ED_FI_BSD_0.KLASSENINDEX "Auswahl der Fehlerklasse | EN: Fault code FI_BSD_0 - fault class selection (lamp / warning behaviour)" VALUE 0x716E8 TKW_VV_VV_UB 100.0 FORMULA_0003 0.0 8.0000 /end CHARACTERISTIC
/begin CHARACTERISTIC K_ED_FI_BSD_6.KLASSENINDEX "Auswahl der Fehlerklasse | EN: Fault code FI_BSD_6 - fault class selection (lamp / warning behaviour)" VALUE 0x71702 TKW_VV_VV_UB 100.0 FORMULA_0003 0.0 8.0000 /end CHARACTERISTIC
/begin CHARACTERISTIC K_ED_FI_BSDGLOB.KLASSENINDEX "Auswahl der Fehlerklasse | EN: Fault code FI_BSDGLOB - fault class selection (lamp / warning behaviour)" VALUE 0x7171C TKW_VV_VV_UB 100.0 FORMULA_0003 0.0 8.0000 /end CHARACTERISTIC
/begin CHARACTERISTIC K_ED_EBOX_ELU.KLASSENINDEX "Auswahl der Fehlerklasse | EN: Fault code EBOX_ELU - fault class selection (lamp / warning behaviour)" VALUE 0x7176A TKW_VV_VV_UB 100.0 FORMULA_0003 0.0 8.0000 /end CHARACTERISTIC
/begin CHARACTERISTIC K_ED_DK1_ENLTG.KLASSENINDEX "Auswahl der Fehlerklasse | EN: Fault code DK1_ENLTG - fault class selection (lamp / warning behaviour)" VALUE 0x7179E TKW_VV_VV_UB 100.0 FORMULA_0003 0.0 8.0000 /end CHARACTERISTIC
/begin CHARACTERISTIC K_ED_DK2_ENLTG.KLASSENINDEX "Auswahl der Fehlerklasse | EN: Fault code DK2_ENLTG - fault class selection (lamp / warning behaviour)" VALUE 0x717B8 TKW_VV_VV_UB 100.0 FORMULA_0003 0.0 8.0000 /end CHARACTERISTIC
/begin CHARACTERISTIC K_ED_E2_INJ.KLASSENINDEX "Auswahl der Fehlerklasse | EN: Fault code E2_INJ - fault class selection (lamp / warning behaviour)" VALUE 0x71854 TKW_VV_VV_UB 100.0 FORMULA_0003 0.0 8.0000 /end CHARACTERISTIC
/begin CHARACTERISTIC K_ED_FETRAWE.KLASSENINDEX "Auswahl der Fehlerklasse | EN: Fault code FETRAWE - fault class selection (lamp / warning behaviour)" VALUE 0x71972 TKW_VV_VV_UB 100.0 FORMULA_0003 0.0 8.0000 /end CHARACTERISTIC
/begin CHARACTERISTIC K_ED_ELUP.KLASSENINDEX "Auswahl der Fehlerklasse | EN: Fault code ELUP - fault class selection (lamp / warning behaviour)" VALUE 0x719DA TKW_VV_VV_UB 100.0 FORMULA_0003 0.0 8.0000 /end CHARACTERISTIC
/begin CHARACTERISTIC K_ED_ELU.KLASSENINDEX "Auswahl der Fehlerklasse | EN: Fault code ELU - fault class selection (lamp / warning behaviour)" VALUE 0x719F4 TKW_VV_VV_UB 100.0 FORMULA_0003 0.0 8.0000 /end CHARACTERISTIC
/begin CHARACTERISTIC K_ED_DMTL_FEINLECK.KLASSENINDEX "Auswahl der Fehlerklasse | EN: Fault code DMTL_FEINLECK - fault class selection (lamp / warning behaviour)" VALUE 0x71B12 TKW_VV_VV_UB 100.0 FORMULA_0003 0.0 8.0000 /end CHARACTERISTIC
/begin CHARACTERISTIC K_ED_ELUP_OBD.KLASSENINDEX "Auswahl der Fehlerklasse" VALUE 0x71D68 TKW_VV_VV_UB 100.0 FORMULA_0003 0.0 8.0000 /end CHARACTERISTIC
/begin CHARACTERISTIC K_ED_CSS_TIME "Zeit fuer CSS-Denominator | EN: Zeit fuer CSS-Denominator" VALUE 0x71F98 TKW_VV_VV_UW 100.0 FORMULA_0073 0.0 6553.5000 FORMAT "%4.1" /end CHARACTERISTIC
/begin MEASUREMENT ed_rbm_time_slp "Zeit mit Sekundaerlufteinblassung" UWORD FORMULA_0073 0 0 0.0 6553.5000 ECU_ADDRESS 0x3FBF54 /end MEASUREMENT
/begin FUNCTION Eigendiagnose ""
 /begin DEF_CHARACTERISTIC K_ED_APPL_DATA_INJ.DEC_NACH_EINTRAG K_ED_APPL_DATA_INJ.DEC_VOR_EINTRAG K_ED_APPL_DATA_INJ.FEHLERSCHWELLE K_ED_APPL_DATA_INJ.INC_NACH_EINTRAG K_ED_APPL_DATA_INJ.INC_VOR_EINTRAG K_ED_APPL_DATA_INJ.KLASSENINDEX K_ED_APPL_DATA_INJ.OK_SCHWELLE K_ED_APPL_DATA_INJ.P_CODE_OPENLOAD K_ED_APPL_DATA_INJ.P_CODE_SH_TO_GND K_ED_APPL_DATA_INJ.P_CODE_SH_TO_UB K_ED_APPL_DATA_INJ.P_CODE_UNPLAUSIBEL K_ED_CSS_TIME K_ED_DK1_ENLTG.DEC_NACH_EINTRAG K_ED_DK1_ENLTG.DEC_VOR_EINTRAG K_ED_DK1_ENLTG.FEHLERSCHWELLE K_ED_DK1_ENLTG.INC_NACH_EINTRAG K_ED_DK1_ENLTG.INC_VOR_EINTRAG K_ED_DK1_ENLTG.KLASSENINDEX K_ED_DK1_ENLTG.OK_SCHWELLE K_ED_DK1_ENLTG.P_CODE_OPENLOAD K_ED_DK1_ENLTG.P_CODE_SH_TO_GND K_ED_DK1_ENLTG.P_CODE_SH_TO_UB K_ED_DK1_ENLTG.P_CODE_UNPLAUSIBEL K_ED_DK2_ENLTG.DEC_NACH_EINTRAG K_ED_DK2_ENLTG.DEC_VOR_EINTRAG K_ED_DK2_ENLTG.FEHLERSCHWELLE K_ED_DK2_ENLTG.INC_NACH_EINTRAG K_ED_DK2_ENLTG.INC_VOR_EINTRAG K_ED_DK2_ENLTG.KLASSENINDEX K_ED_DK2_ENLTG.OK_SCHWELLE K_ED_DK2_ENLTG.P_CODE_OPENLOAD K_ED_DK2_ENLTG.P_CODE_SH_TO_GND K_ED_DK2_ENLTG.P_CODE_SH_TO_UB K_ED_DK2_ENLTG.P_CODE_UNPLAUSIBEL K_ED_DMTL_DECKEL.DEC_NACH_EINTRAG K_ED_DMTL_DECKEL.DEC_VOR_EINTRAG K_ED_DMTL_DECKEL.FEHLERSCHWELLE K_ED_DMTL_DECKEL.INC_NACH_EINTRAG K_ED_DMTL_DECKEL.INC_VOR_EINTRAG K_ED_DMTL_DECKEL.KLASSENINDEX K_ED_DMTL_DECKEL.OK_SCHWELLE K_ED_DMTL_DECKEL.P_CODE_OPENLOAD K_ED_DMTL_DECKEL.P_CODE_SH_TO_GND K_ED_DMTL_DECKEL.P_CODE_SH_TO_UB K_ED_DMTL_DECKEL.P_CODE_UNPLAUSIBEL K_ED_DMTL_FEINLECK.DEC_NACH_EINTRAG K_ED_DMTL_FEINLECK.DEC_VOR_EINTRAG K_ED_DMTL_FEINLECK.FEHLERSCHWELLE K_ED_DMTL_FEINLECK.INC_NACH_EINTRAG K_ED_DMTL_FEINLECK.INC_VOR_EINTRAG K_ED_DMTL_FEINLECK.KLASSENINDEX K_ED_DMTL_FEINLECK.OK_SCHWELLE K_ED_DMTL_FEINLECK.P_CODE_OPENLOAD K_ED_DMTL_FEINLECK.P_CODE_SH_TO_GND K_ED_DMTL_FEINLECK.P_CODE_SH_TO_UB K_ED_DMTL_FEINLECK.P_CODE_UNPLAUSIBEL K_ED_DMTL_FEUCHT.DEC_NACH_EINTRAG K_ED_DMTL_FEUCHT.DEC_VOR_EINTRAG K_ED_DMTL_FEUCHT.FEHLERSCHWELLE K_ED_DMTL_FEUCHT.INC_NACH_EINTRAG K_ED_DMTL_FEUCHT.INC_VOR_EINTRAG K_ED_DMTL_FEUCHT.KLASSENINDEX K_ED_DMTL_FEUCHT.OK_SCHWELLE K_ED_DMTL_FEUCHT.P_CODE_OPENLOAD K_ED_DMTL_FEUCHT.P_CODE_SH_TO_GND K_ED_DMTL_FEUCHT.P_CODE_SH_TO_UB K_ED_DMTL_FEUCHT.P_CODE_UNPLAUSIBEL K_ED_DMTL_GROBLECK.DEC_NACH_EINTRAG K_ED_DMTL_GROBLECK.DEC_VOR_EINTRAG K_ED_DMTL_GROBLECK.FEHLERSCHWELLE K_ED_DMTL_GROBLECK.INC_NACH_EINTRAG K_ED_DMTL_GROBLECK.INC_VOR_EINTRAG K_ED_DMTL_GROBLECK.KLASSENINDEX K_ED_DMTL_GROBLECK.OK_SCHWELLE K_ED_DMTL_GROBLECK.P_CODE_OPENLOAD K_ED_DMTL_GROBLECK.P_CODE_SH_TO_GND K_ED_DMTL_GROBLECK.P_CODE_SH_TO_UB K_ED_DMTL_GROBLECK.P_CODE_UNPLAUSIBEL K_ED_DMTL_H.DEC_NACH_EINTRAG K_ED_DMTL_H.DEC_VOR_EINTRAG K_ED_DMTL_H.FEHLERSCHWELLE K_ED_DMTL_H.INC_NACH_EINTRAG K_ED_DMTL_H.INC_VOR_EINTRAG K_ED_DMTL_H.KLASSENINDEX K_ED_DMTL_H.OK_SCHWELLE K_ED_DMTL_H.P_CODE_OPENLOAD K_ED_DMTL_H.P_CODE_SH_TO_GND K_ED_DMTL_H.P_CODE_SH_TO_UB K_ED_DMTL_H.P_CODE_UNPLAUSIBEL K_ED_DMTL_P.DEC_NACH_EINTRAG K_ED_DMTL_P.DEC_VOR_EINTRAG K_ED_DMTL_P.FEHLERSCHWELLE K_ED_DMTL_P.INC_NACH_EINTRAG K_ED_DMTL_P.INC_VOR_EINTRAG K_ED_DMTL_P.KLASSENINDEX K_ED_DMTL_P.OK_SCHWELLE K_ED_DMTL_P.P_CODE_OPENLOAD K_ED_DMTL_P.P_CODE_SH_TO_GND K_ED_DMTL_P.P_CODE_SH_TO_UB K_ED_DMTL_P.P_CODE_UNPLAUSIBEL K_ED_DMTL_V.DEC_NACH_EINTRAG K_ED_DMTL_V.DEC_VOR_EINTRAG K_ED_DMTL_V.FEHLERSCHWELLE K_ED_DMTL_V.INC_NACH_EINTRAG K_ED_DMTL_V.INC_VOR_EINTRAG K_ED_DMTL_V.KLASSENINDEX K_ED_DMTL_V.OK_SCHWELLE K_ED_DMTL_V.P_CODE_OPENLOAD K_ED_DMTL_V.P_CODE_SH_TO_GND K_ED_DMTL_V.P_CODE_SH_TO_UB K_ED_DMTL_V.P_CODE_UNPLAUSIBEL K_ED_E2_INJ.DEC_NACH_EINTRAG K_ED_E2_INJ.DEC_VOR_EINTRAG K_ED_E2_INJ.FEHLERSCHWELLE K_ED_E2_INJ.INC_NACH_EINTRAG K_ED_E2_INJ.INC_VOR_EINTRAG K_ED_E2_INJ.KLASSENINDEX K_ED_E2_INJ.OK_SCHWELLE K_ED_E2_INJ.P_CODE_OPENLOAD K_ED_E2_INJ.P_CODE_SH_TO_GND K_ED_E2_INJ.P_CODE_SH_TO_UB K_ED_E2_INJ.P_CODE_UNPLAUSIBEL K_ED_EBOX_ELU.DEC_NACH_EINTRAG K_ED_EBOX_ELU.DEC_VOR_EINTRAG K_ED_EBOX_ELU.FEHLERSCHWELLE K_ED_EBOX_ELU.INC_NACH_EINTRAG K_ED_EBOX_ELU.INC_VOR_EINTRAG K_ED_EBOX_ELU.KLASSENINDEX K_ED_EBOX_ELU.OK_SCHWELLE K_ED_EBOX_ELU.P_CODE_OPENLOAD K_ED_EBOX_ELU.P_CODE_SH_TO_GND K_ED_EBOX_ELU.P_CODE_SH_TO_UB K_ED_EBOX_ELU.P_CODE_UNPLAUSIBEL K_ED_EKP_PWM.DEC_NACH_EINTRAG K_ED_EKP_PWM.DEC_VOR_EINTRAG K_ED_EKP_PWM.FEHLERSCHWELLE K_ED_EKP_PWM.INC_NACH_EINTRAG K_ED_EKP_PWM.INC_VOR_EINTRAG K_ED_EKP_PWM.KLASSENINDEX K_ED_EKP_PWM.OK_SCHWELLE K_ED_EKP_PWM.P_CODE_OPENLOAD K_ED_EKP_PWM.P_CODE_SH_TO_GND K_ED_EKP_PWM.P_CODE_SH_TO_UB K_ED_EKP_PWM.P_CODE_UNPLAUSIBEL K_ED_ELU.DEC_NACH_EINTRAG K_ED_ELU.DEC_VOR_EINTRAG K_ED_ELU.FEHLERSCHWELLE K_ED_ELU.INC_NACH_EINTRAG K_ED_ELU.INC_VOR_EINTRAG K_ED_ELU.KLASSENINDEX K_ED_ELU.OK_SCHWELLE K_ED_ELU.P_CODE_OPENLOAD K_ED_ELU.P_CODE_SH_TO_GND K_ED_ELU.P_CODE_SH_TO_UB K_ED_ELU.P_CODE_UNPLAUSIBEL K_ED_ELUP.DEC_NACH_EINTRAG K_ED_ELUP.DEC_VOR_EINTRAG K_ED_ELUP.FEHLERSCHWELLE K_ED_ELUP.INC_NACH_EINTRAG K_ED_ELUP.INC_VOR_EINTRAG K_ED_ELUP.KLASSENINDEX K_ED_ELUP.OK_SCHWELLE K_ED_ELUP.P_CODE_OPENLOAD K_ED_ELUP.P_CODE_SH_TO_GND K_ED_ELUP.P_CODE_SH_TO_UB K_ED_ELUP.P_CODE_UNPLAUSIBEL K_ED_ELUP_OBD.DEC_NACH_EINTRAG K_ED_ELUP_OBD.DEC_VOR_EINTRAG K_ED_ELUP_OBD.FEHLERSCHWELLE K_ED_ELUP_OBD.INC_NACH_EINTRAG K_ED_ELUP_OBD.INC_VOR_EINTRAG K_ED_ELUP_OBD.KLASSENINDEX K_ED_ELUP_OBD.OK_SCHWELLE K_ED_ELUP_OBD.P_CODE_OPENLOAD K_ED_ELUP_OBD.P_CODE_SH_TO_GND K_ED_ELUP_OBD.P_CODE_SH_TO_UB K_ED_ELUP_OBD.P_CODE_UNPLAUSIBEL K_ED_EV1.DEC_NACH_EINTRAG K_ED_EV1.DEC_VOR_EINTRAG K_ED_EV1.FEHLERSCHWELLE K_ED_EV1.INC_NACH_EINTRAG K_ED_EV1.INC_VOR_EINTRAG K_ED_EV1.KLASSENINDEX K_ED_EV1.OK_SCHWELLE K_ED_EV1.P_CODE_OPENLOAD K_ED_EV1.P_CODE_SH_TO_GND K_ED_EV1.P_CODE_SH_TO_UB K_ED_EV1.P_CODE_UNPLAUSIBEL K_ED_EV10.DEC_NACH_EINTRAG K_ED_EV10.DEC_VOR_EINTRAG K_ED_EV10.FEHLERSCHWELLE K_ED_EV10.INC_NACH_EINTRAG K_ED_EV10.INC_VOR_EINTRAG K_ED_EV10.KLASSENINDEX K_ED_EV10.OK_SCHWELLE K_ED_EV10.P_CODE_OPENLOAD K_ED_EV10.P_CODE_SH_TO_GND K_ED_EV10.P_CODE_SH_TO_UB K_ED_EV10.P_CODE_UNPLAUSIBEL K_ED_EV2.DEC_NACH_EINTRAG K_ED_EV2.DEC_VOR_EINTRAG K_ED_EV2.FEHLERSCHWELLE K_ED_EV2.INC_NACH_EINTRAG K_ED_EV2.INC_VOR_EINTRAG K_ED_EV2.KLASSENINDEX K_ED_EV2.OK_SCHWELLE K_ED_EV2.P_CODE_OPENLOAD K_ED_EV2.P_CODE_SH_TO_GND K_ED_EV2.P_CODE_SH_TO_UB K_ED_EV2.P_CODE_UNPLAUSIBEL K_ED_EV3.DEC_NACH_EINTRAG K_ED_EV3.DEC_VOR_EINTRAG K_ED_EV3.FEHLERSCHWELLE K_ED_EV3.INC_NACH_EINTRAG K_ED_EV3.INC_VOR_EINTRAG K_ED_EV3.KLASSENINDEX K_ED_EV3.OK_SCHWELLE K_ED_EV3.P_CODE_OPENLOAD K_ED_EV3.P_CODE_SH_TO_GND K_ED_EV3.P_CODE_SH_TO_UB K_ED_EV3.P_CODE_UNPLAUSIBEL K_ED_EV4.DEC_NACH_EINTRAG K_ED_EV4.DEC_VOR_EINTRAG K_ED_EV4.FEHLERSCHWELLE K_ED_EV4.INC_NACH_EINTRAG K_ED_EV4.INC_VOR_EINTRAG K_ED_EV4.KLASSENINDEX K_ED_EV4.OK_SCHWELLE K_ED_EV4.P_CODE_OPENLOAD K_ED_EV4.P_CODE_SH_TO_GND K_ED_EV4.P_CODE_SH_TO_UB K_ED_EV4.P_CODE_UNPLAUSIBEL K_ED_EV5.DEC_NACH_EINTRAG K_ED_EV5.DEC_VOR_EINTRAG K_ED_EV5.FEHLERSCHWELLE K_ED_EV5.INC_NACH_EINTRAG K_ED_EV5.INC_VOR_EINTRAG K_ED_EV5.KLASSENINDEX K_ED_EV5.OK_SCHWELLE K_ED_EV5.P_CODE_OPENLOAD K_ED_EV5.P_CODE_SH_TO_GND K_ED_EV5.P_CODE_SH_TO_UB K_ED_EV5.P_CODE_UNPLAUSIBEL K_ED_EV6.DEC_NACH_EINTRAG K_ED_EV6.DEC_VOR_EINTRAG K_ED_EV6.FEHLERSCHWELLE K_ED_EV6.INC_NACH_EINTRAG K_ED_EV6.INC_VOR_EINTRAG K_ED_EV6.KLASSENINDEX K_ED_EV6.OK_SCHWELLE K_ED_EV6.P_CODE_OPENLOAD K_ED_EV6.P_CODE_SH_TO_GND K_ED_EV6.P_CODE_SH_TO_UB K_ED_EV6.P_CODE_UNPLAUSIBEL K_ED_EV7.DEC_NACH_EINTRAG K_ED_EV7.DEC_VOR_EINTRAG K_ED_EV7.FEHLERSCHWELLE K_ED_EV7.INC_NACH_EINTRAG K_ED_EV7.INC_VOR_EINTRAG K_ED_EV7.KLASSENINDEX K_ED_EV7.OK_SCHWELLE K_ED_EV7.P_CODE_OPENLOAD K_ED_EV7.P_CODE_SH_TO_GND K_ED_EV7.P_CODE_SH_TO_UB K_ED_EV7.P_CODE_UNPLAUSIBEL K_ED_EV8.DEC_NACH_EINTRAG K_ED_EV8.DEC_VOR_EINTRAG K_ED_EV8.FEHLERSCHWELLE K_ED_EV8.INC_NACH_EINTRAG K_ED_EV8.INC_VOR_EINTRAG K_ED_EV8.KLASSENINDEX K_ED_EV8.OK_SCHWELLE K_ED_EV8.P_CODE_OPENLOAD K_ED_EV8.P_CODE_SH_TO_GND K_ED_EV8.P_CODE_SH_TO_UB K_ED_EV8.P_CODE_UNPLAUSIBEL K_ED_EV9.DEC_NACH_EINTRAG K_ED_EV9.DEC_VOR_EINTRAG K_ED_EV9.FEHLERSCHWELLE K_ED_EV9.INC_NACH_EINTRAG K_ED_EV9.INC_VOR_EINTRAG K_ED_EV9.KLASSENINDEX K_ED_EV9.OK_SCHWELLE K_ED_EV9.P_CODE_OPENLOAD K_ED_EV9.P_CODE_SH_TO_GND K_ED_EV9.P_CODE_SH_TO_UB K_ED_EV9.P_CODE_UNPLAUSIBEL K_ED_EWS_MAN.DEC_NACH_EINTRAG K_ED_EWS_MAN.DEC_VOR_EINTRAG K_ED_EWS_MAN.FEHLERSCHWELLE K_ED_EWS_MAN.INC_NACH_EINTRAG K_ED_EWS_MAN.INC_VOR_EINTRAG K_ED_EWS_MAN.KLASSENINDEX K_ED_EWS_MAN.OK_SCHWELLE K_ED_EWS_MAN.P_CODE_OPENLOAD K_ED_EWS_MAN.P_CODE_SH_TO_GND K_ED_EWS_MAN.P_CODE_SH_TO_UB K_ED_EWS_MAN.P_CODE_UNPLAUSIBEL K_ED_EWS_SCI.DEC_NACH_EINTRAG K_ED_EWS_SCI.DEC_VOR_EINTRAG K_ED_EWS_SCI.FEHLERSCHWELLE K_ED_EWS_SCI.INC_NACH_EINTRAG K_ED_EWS_SCI.INC_VOR_EINTRAG K_ED_EWS_SCI.KLASSENINDEX K_ED_EWS_SCI.OK_SCHWELLE K_ED_EWS_SCI.P_CODE_OPENLOAD K_ED_EWS_SCI.P_CODE_SH_TO_GND K_ED_EWS_SCI.P_CODE_SH_TO_UB K_ED_EWS_SCI.P_CODE_UNPLAUSIBEL K_ED_FETRAWE.DEC_NACH_EINTRAG K_ED_FETRAWE.DEC_VOR_EINTRAG K_ED_FETRAWE.FEHLERSCHWELLE K_ED_FETRAWE.INC_NACH_EINTRAG K_ED_FETRAWE.INC_VOR_EINTRAG K_ED_FETRAWE.KLASSENINDEX K_ED_FETRAWE.OK_SCHWELLE K_ED_FETRAWE.P_CODE_OPENLOAD K_ED_FETRAWE.P_CODE_SH_TO_GND K_ED_FETRAWE.P_CODE_SH_TO_UB K_ED_FETRAWE.P_CODE_UNPLAUSIBEL K_ED_FI_BSD.DEC_NACH_EINTRAG K_ED_FI_BSD.DEC_VOR_EINTRAG K_ED_FI_BSD.FEHLERSCHWELLE K_ED_FI_BSD.INC_NACH_EINTRAG K_ED_FI_BSD.INC_VOR_EINTRAG K_ED_FI_BSD.KLASSENINDEX K_ED_FI_BSD.OK_SCHWELLE K_ED_FI_BSD.P_CODE_OPENLOAD K_ED_FI_BSD.P_CODE_SH_TO_GND K_ED_FI_BSD.P_CODE_SH_TO_UB K_ED_FI_BSD.P_CODE_UNPLAUSIBEL K_ED_FI_BSDGLOB.DEC_NACH_EINTRAG K_ED_FI_BSDGLOB.DEC_VOR_EINTRAG K_ED_FI_BSDGLOB.FEHLERSCHWELLE K_ED_FI_BSDGLOB.INC_NACH_EINTRAG K_ED_FI_BSDGLOB.INC_VOR_EINTRAG K_ED_FI_BSDGLOB.KLASSENINDEX K_ED_FI_BSDGLOB.OK_SCHWELLE K_ED_FI_BSDGLOB.P_CODE_OPENLOAD K_ED_FI_BSDGLOB.P_CODE_SH_TO_GND K_ED_FI_BSDGLOB.P_CODE_SH_TO_UB K_ED_FI_BSDGLOB.P_CODE_UNPLAUSIBEL K_ED_FI_BSD_0.DEC_NACH_EINTRAG K_ED_FI_BSD_0.DEC_VOR_EINTRAG K_ED_FI_BSD_0.FEHLERSCHWELLE K_ED_FI_BSD_0.INC_NACH_EINTRAG K_ED_FI_BSD_0.INC_VOR_EINTRAG K_ED_FI_BSD_0.KLASSENINDEX K_ED_FI_BSD_0.OK_SCHWELLE K_ED_FI_BSD_0.P_CODE_OPENLOAD K_ED_FI_BSD_0.P_CODE_SH_TO_GND K_ED_FI_BSD_0.P_CODE_SH_TO_UB K_ED_FI_BSD_0.P_CODE_UNPLAUSIBEL K_ED_FI_BSD_6.DEC_NACH_EINTRAG K_ED_FI_BSD_6.DEC_VOR_EINTRAG K_ED_FI_BSD_6.FEHLERSCHWELLE K_ED_FI_BSD_6.INC_NACH_EINTRAG K_ED_FI_BSD_6.INC_VOR_EINTRAG K_ED_FI_BSD_6.KLASSENINDEX K_ED_FI_BSD_6.OK_SCHWELLE K_ED_FI_BSD_6.P_CODE_OPENLOAD K_ED_FI_BSD_6.P_CODE_SH_TO_GND K_ED_FI_BSD_6.P_CODE_SH_TO_UB K_ED_FI_BSD_6.P_CODE_UNPLAUSIBEL K_ED_FI_GEN.DEC_NACH_EINTRAG K_ED_FI_GEN.DEC_VOR_EINTRAG K_ED_FI_GEN.FEHLERSCHWELLE K_ED_FI_GEN.INC_NACH_EINTRAG K_ED_FI_GEN.INC_VOR_EINTRAG K_ED_FI_GEN.KLASSENINDEX K_ED_FI_GEN.OK_SCHWELLE K_ED_FI_GEN.P_CODE_OPENLOAD K_ED_FI_GEN.P_CODE_SH_TO_GND K_ED_FI_GEN.P_CODE_SH_TO_UB K_ED_FI_GEN.P_CODE_UNPLAUSIBEL K_ED_FI_IBS1.DEC_NACH_EINTRAG K_ED_FI_IBS1.DEC_VOR_EINTRAG K_ED_FI_IBS1.FEHLERSCHWELLE K_ED_FI_IBS1.INC_NACH_EINTRAG K_ED_FI_IBS1.INC_VOR_EINTRAG K_ED_FI_IBS1.KLASSENINDEX K_ED_FI_IBS1.OK_SCHWELLE K_ED_FI_IBS1.P_CODE_OPENLOAD K_ED_FI_IBS1.P_CODE_SH_TO_GND K_ED_FI_IBS1.P_CODE_SH_TO_UB K_ED_FI_IBS1.P_CODE_UNPLAUSIBEL K_ED_FI_IBS2.DEC_NACH_EINTRAG K_ED_FI_IBS2.DEC_VOR_EINTRAG K_ED_FI_IBS2.FEHLERSCHWELLE K_ED_FI_IBS2.INC_NACH_EINTRAG K_ED_FI_IBS2.INC_VOR_EINTRAG K_ED_FI_IBS2.KLASSENINDEX K_ED_FI_IBS2.OK_SCHWELLE K_ED_FI_IBS2.P_CODE_OPENLOAD K_ED_FI_IBS2.P_CODE_SH_TO_GND K_ED_FI_IBS2.P_CODE_SH_TO_UB K_ED_FI_IBS2.P_CODE_UNPLAUSIBEL K_ED_FI_IBS3.DEC_NACH_EINTRAG K_ED_FI_IBS3.DEC_VOR_EINTRAG K_ED_FI_IBS3.FEHLERSCHWELLE K_ED_FI_IBS3.INC_NACH_EINTRAG K_ED_FI_IBS3.INC_VOR_EINTRAG K_ED_FI_IBS3.KLASSENINDEX K_ED_FI_IBS3.OK_SCHWELLE K_ED_FI_IBS3.P_CODE_OPENLOAD K_ED_FI_IBS3.P_CODE_SH_TO_GND K_ED_FI_IBS3.P_CODE_SH_TO_UB K_ED_FI_IBS3.P_CODE_UNPLAUSIBEL K_ED_FI_PMBATT.DEC_NACH_EINTRAG K_ED_FI_PMBATT.DEC_VOR_EINTRAG K_ED_FI_PMBATT.FEHLERSCHWELLE K_ED_FI_PMBATT.INC_NACH_EINTRAG K_ED_FI_PMBATT.INC_VOR_EINTRAG K_ED_FI_PMBATT.KLASSENINDEX K_ED_FI_PMBATT.OK_SCHWELLE K_ED_FI_PMBATT.P_CODE_OPENLOAD K_ED_FI_PMBATT.P_CODE_SH_TO_GND K_ED_FI_PMBATT.P_CODE_SH_TO_UB K_ED_FI_PMBATT.P_CODE_UNPLAUSIBEL /end DEF_CHARACTERISTIC
 /begin OUT_MEASUREMENT ed_rbm_ev6.numerator_nv ed_rbm_ev7.denominator_nv ed_rbm_ev7.numerator_nv ed_rbm_ev8.denominator_nv ed_rbm_ev8.numerator_nv ed_rbm_ev9.denominator_nv ed_rbm_ev9.numerator_nv ed_rbm_ews_man.denominator_nv ed_rbm_ews_man.numerator_nv ed_rbm_ews_sci.denominator_nv ed_rbm_ews_sci.numerator_nv ed_rbm_fetrawe.denominator_nv ed_rbm_fetrawe.numerator_nv ed_rbm_fi_bsd.denominator_nv ed_rbm_fi_bsd.numerator_nv ed_rbm_fi_bsd_0.denominator_nv ed_rbm_fi_bsd_0.numerator_nv ed_rbm_fi_bsd_6.denominator_nv ed_rbm_fi_bsd_6.numerator_nv ed_rbm_fi_bsdglob.denominator_nv ed_rbm_fi_bsdglob.numerator_nv ed_rbm_fi_gen.denominator_nv ed_rbm_fi_gen.numerator_nv ed_rbm_fi_ibs1.denominator_nv ed_rbm_fi_ibs1.numerator_nv ed_rbm_fi_ibs2.denominator_nv ed_rbm_fi_ibs2.numerator_nv ed_rbm_fi_ibs3.denominator_nv ed_rbm_fi_ibs3.numerator_nv ed_rbm_fi_pmbatt.denominator_nv ed_rbm_fi_pmbatt.numerator_nv ed_rbm_fi_pmbn.denominator_nv ed_rbm_fi_pmbn.numerator_nv ed_rbm_fi_pmruhverl.denominator_nv ed_rbm_fi_pmruhverl.numerator_nv ed_rbm_fi_qlt.denominator_nv ed_rbm_fi_qlt.numerator_nv ed_rbm_fi_toens.denominator_nv ed_rbm_fi_toens.numerator_nv ed_rbm_fplau1.denominator_nv ed_rbm_fplau1.numerator_nv ed_rbm_fplau2.denominator_nv ed_rbm_fplau2.numerator_nv ed_rbm_fst.denominator_nv ed_rbm_fst.numerator_nv ed_rbm_fst_geber.denominator_nv ed_rbm_fst_geber.numerator_nv ed_rbm_fst_geber_li.denominator_nv ed_rbm_fst_geber_li.numerator_nv ed_rbm_fst_geber_re.denominator_nv ed_rbm_fst_geber_re.numerator_nv ed_rbm_hfm1.denominator_nv ed_rbm_hfm1.numerator_nv ed_rbm_hfm2.denominator_nv ed_rbm_hfm2.numerator_nv ed_rbm_index_204_inj.denominator_nv ed_rbm_index_204_inj.numerator_nv ed_rbm_index_205_inj.denominator_nv ed_rbm_index_205_inj.numerator_nv ed_rbm_index_206_inj.denominator_nv ed_rbm_index_206_inj.numerator_nv ed_rbm_index_207_inj.denominator_nv ed_rbm_index_207_inj.numerator_nv ed_rbm_index_208_inj.denominator_nv ed_rbm_index_208_inj.numerator_nv ed_rbm_index_209_inj.denominator_nv ed_rbm_index_209_inj.numerator_nv ed_rbm_index_210_inj.denominator_nv ed_rbm_index_210_inj.numerator_nv ed_rbm_index_211_inj.denominator_nv ed_rbm_index_211_inj.numerator_nv ed_rbm_index_212_inj.denominator_nv ed_rbm_index_212_inj.numerator_nv ed_rbm_index_213_inj.denominator_nv ed_rbm_index_213_inj.numerator_nv ed_rbm_index_214_inj.denominator_nv ed_rbm_index_214_inj.numerator_nv ed_rbm_index_215_inj.denominator_nv ed_rbm_index_215_inj.numerator_nv ed_rbm_index_216_inj.denominator_nv ed_rbm_index_216_inj.numerator_nv ed_rbm_index_217_inj.denominator_nv ed_rbm_index_217_inj.numerator_nv ed_rbm_index_218_inj.denominator_nv ed_rbm_index_218_inj.numerator_nv ed_rbm_index_219_inj.denominator_nv ed_rbm_index_219_inj.numerator_nv ed_rbm_index_220_inj.denominator_nv ed_rbm_index_220_inj.numerator_nv ed_rbm_index_221_inj.denominator_nv ed_rbm_index_221_inj.numerator_nv ed_rbm_index_222_inj.denominator_nv ed_rbm_index_222_inj.numerator_nv ed_rbm_index_223_inj.denominator_nv ed_rbm_index_223_inj.numerator_nv ed_rbm_kat_obd1.denominator_nv ed_rbm_kat_obd1.numerator_nv ed_rbm_kat_obd2.denominator_nv ed_rbm_kat_obd2.numerator_nv ed_rbm_kats_b1.denominator_nv ed_rbm_kats_b1.numerator_nv ed_rbm_kats_b2.denominator_nv ed_rbm_kats_b2.numerator_nv ed_rbm_kge1.denominator_nv ed_rbm_kge1.numerator_nv ed_rbm_kge2.denominator_nv ed_rbm_kge2.numerator_nv ed_rbm_ksd1.denominator_nv ed_rbm_ksd1.numerator_nv ed_rbm_ksd2.denominator_nv ed_rbm_ksd2.numerator_nv ed_rbm_kw.denominator_nv ed_rbm_kw.numerator_nv ed_rbm_la1_adapt.denominator_nv ed_rbm_la1_adapt.numerator_nv ed_rbm_la1_trim_ad.denominator_nv ed_rbm_la1_trim_ad.numerator_nv ed_rbm_la2_adapt.denominator_nv ed_rbm_la2_adapt.numerator_nv ed_rbm_la2_trim_ad.denominator_nv ed_rbm_la2_trim_ad.numerator_nv ed_rbm_lam1_reg.denominator_nv ed_rbm_lam1_reg.numerator_nv ed_rbm_lam2_reg.denominator_nv ed_rbm_lam2_reg.numerator_nv ed_rbm_lank1.denominator_nv ed_rbm_lank1.numerator_nv ed_rbm_lank1_obd_s.denominator_nv ed_rbm_lank1_obd_s.numerator_nv ed_rbm_lank1_obd_slope.denominator_nv ed_rbm_lank1_obd_slope.numerator_nv ed_rbm_lank1_obd_we.denominator_nv ed_rbm_lank1_obd_we.numerator_nv ed_rbm_lank1_openload.denominator_nv ed_rbm_lank1_openload.numerator_nv ed_rbm_lank2.denominator_nv ed_rbm_lank2.numerator_nv ed_rbm_lank2_obd_s.denominator_nv ed_rbm_lank2_obd_s.numerator_nv ed_rbm_lank2_obd_slope.denominator_nv ed_rbm_lank2_obd_slope.numerator_nv ed_rbm_lank2_obd_we.denominator_nv ed_rbm_lank2_obd_we.numerator_nv ed_rbm_lank2_openload.denominator_nv ed_rbm_lank2_openload.numerator_nv ed_rbm_lavk1.denominator_nv ed_rbm_lavk1.numerator_nv ed_rbm_lavk1_diag.denominator_nv ed_rbm_lavk1_diag.numerator_nv ed_rbm_lavk1_ia_openload.denominator_nv ed_rbm_lavk1_ia_openload.numerator_nv ed_rbm_lavk1_ip_openload.denominator_nv ed_rbm_lavk1_ip_openload.numerator_nv ed_rbm_lavk1_obd_dyn.denominator_nv ed_rbm_lavk1_obd_dyn.numerator_nv ed_rbm_lavk1_obd_plau.denominator_nv ed_rbm_lavk1_obd_plau.numerator_nv ed_rbm_lavk1_obd_sa.denominator_nv ed_rbm_lavk1_obd_sa.numerator_nv ed_rbm_lavk1_obd_tl.denominator_nv ed_rbm_lavk1_obd_tl.numerator_nv ed_rbm_lavk1_trim.denominator_nv ed_rbm_lavk1_trim.numerator_nv ed_rbm_lavk1_un_openload.denominator_nv ed_rbm_lavk1_un_openload.numerator_nv ed_rbm_lavk2.denominator_nv ed_rbm_lavk2.numerator_nv ed_rbm_lavk2_atic42.denominator_nv ed_rbm_lavk2_atic42.numerator_nv ed_rbm_lavk2_diag.denominator_nv ed_rbm_lavk2_diag.numerator_nv ed_rbm_lavk2_ia_openload.denominator_nv ed_rbm_lavk2_ia_openload.numerator_nv ed_rbm_lavk2_ip_openload.denominator_nv ed_rbm_lavk2_ip_openload.numerator_nv ed_rbm_lavk2_obd_dyn.denominator_nv ed_rbm_lavk2_obd_dyn.numerator_nv ed_rbm_lavk2_obd_plau.denominator_nv ed_rbm_lavk2_obd_plau.numerator_nv ed_rbm_lavk2_obd_sa.denominator_nv ed_rbm_lavk2_obd_sa.numerator_nv ed_rbm_lavk2_obd_tl.denominator_nv ed_rbm_lavk2_obd_tl.numerator_nv ed_rbm_lavk2_trim.denominator_nv ed_rbm_lavk2_trim.numerator_nv ed_rbm_lavk2_un_openload.denominator_nv ed_rbm_lavk2_un_openload.numerator_nv ed_rbm_lavk_atic42.denominator_nv ed_rbm_lavk_atic42.numerator_nv ed_rbm_lshnk1.denominator_nv ed_rbm_lshnk1.numerator_nv ed_rbm_lshnk1_r.denominator_nv ed_rbm_lshnk1_r.numerator_nv ed_rbm_lshnk2.denominator_nv ed_rbm_lshnk2.numerator_nv ed_rbm_lshnk2_r.denominator_nv ed_rbm_lshnk2_r.numerator_nv ed_rbm_lshvk1.denominator_nv ed_rbm_lshvk1.numerator_nv ed_rbm_lshvk1_r.denominator_nv ed_rbm_lshvk1_r.numerator_nv ed_rbm_lshvk2.denominator_nv ed_rbm_lshvk2.numerator_nv ed_rbm_lshvk2_r.denominator_nv ed_rbm_lshvk2_r.numerator_nv ed_rbm_lsrvk1_obd_ref.denominator_nv ed_rbm_lsrvk1_obd_ref.numerator_nv ed_rbm_lsrvk1_obd_reg.denominator_nv ed_rbm_lsrvk1_obd_reg.numerator_nv ed_rbm_lsrvk1_obd_start.denominator_nv ed_rbm_lsrvk1_obd_start.numerator_nv ed_rbm_lsrvk2_obd_ref.denominator_nv ed_rbm_lsrvk2_obd_ref.numerator_nv ed_rbm_lsrvk2_obd_reg.denominator_nv ed_rbm_lsrvk2_obd_reg.numerator_nv ed_rbm_lsrvk2_obd_start.denominator_nv ed_rbm_lsrvk2_obd_start.numerator_nv ed_rbm_mvac_drucksensor.denominator_nv ed_rbm_mvac_drucksensor.numerator_nv ed_rbm_mvac_obd.denominator_nv ed_rbm_mvac_obd.numerator_nv ed_rbm_nw1_sync.denominator_nv ed_rbm_nw1_sync.numerator_nv ed_rbm_nw2_sync.denominator_nv ed_rbm_nw2_sync.numerator_nv ed_rbm_pctrl_inj.denominator_nv ed_rbm_pctrl_inj.numerator_nv ed_rbm_pks.denominator_nv ed_rbm_pks.numerator_nv ed_rbm_pks_adapt_anschl.denominator_nv ed_rbm_pks_adapt_anschl.numerator_nv ed_rbm_pks_ll.denominator_nv ed_rbm_pks_ll.numerator_nv ed_rbm_pks_modell.denominator_nv ed_rbm_pks_modell.numerator_nv ed_rbm_pks_paufbau.denominator_nv ed_rbm_pks_paufbau.numerator_nv ed_rbm_pks_q.denominator_nv ed_rbm_pks_q.numerator_nv ed_rbm_pks_tl.denominator_nv ed_rbm_pks_tl.numerator_nv ed_rbm_psau1.denominator_nv ed_rbm_psau1.numerator_nv ed_rbm_psau2.denominator_nv ed_rbm_psau2.numerator_nv ed_rbm_pt_anfradmom.denominator_nv ed_rbm_pt_anfradmom.numerator_nv ed_rbm_pt_atemp.denominator_nv ed_rbm_pt_atemp.numerator_nv ed_rbm_pt_ax.denominator_nv ed_rbm_pt_ax.numerator_nv ed_rbm_pt_bedat.denominator_nv ed_rbm_pt_bedat.numerator_nv ed_rbm_pt_bedfgr.denominator_nv ed_rbm_pt_bedfgr.numerator_nv ed_rbm_pt_busoff.denominator_nv ed_rbm_pt_busoff.numerator_nv ed_rbm_pt_crash.denominator_nv ed_rbm_pt_crash.numerator_nv ed_rbm_pt_grb.denominator_nv ed_rbm_pt_grb.numerator_nv ed_rbm_pt_grb2.denominator_nv ed_rbm_pt_grb2.numerator_nv ed_rbm_pt_kkos.denominator_nv ed_rbm_pt_kkos.numerator_nv ed_rbm_pt_klst.denominator_nv ed_rbm_pt_klst.numerator_nv ed_rbm_pt_km.denominator_nv ed_rbm_pt_km.numerator_nv ed_rbm_pt_kombi.denominator_nv ed_rbm_pt_kombi.numerator_nv ed_rbm_pt_lrw.denominator_nv ed_rbm_pt_lrw.numerator_nv ed_rbm_pt_obd_ed.denominator_nv ed_rbm_pt_obd_ed.numerator_nv ed_rbm_pt_statanh.denominator_nv ed_rbm_pt_statanh.numerator_nv ed_rbm_pt_statdkg.denominator_nv ed_rbm_pt_statdkg.numerator_nv ed_rbm_pt_statgrb.denominator_nv ed_rbm_pt_statgrb.numerator_nv ed_rbm_pt_statr.denominator_nv ed_rbm_pt_statr.numerator_nv ed_rbm_pt_stdsc.denominator_nv ed_rbm_pt_stdsc.numerator_nv ed_rbm_pt_toma.denominator_nv ed_rbm_pt_toma.numerator_nv ed_rbm_pt_torqdsc.denominator_nv ed_rbm_pt_torqdsc.numerator_nv ed_rbm_pt_vehmod.denominator_nv ed_rbm_pt_vehmod.numerator_nv ed_rbm_pt_vfzg.denominator_nv ed_rbm_pt_vfzg.numerator_nv ed_rbm_pt_vrad.denominator_nv ed_rbm_pt_vrad.numerator_nv ed_rbm_pumg.denominator_nv ed_rbm_pumg.numerator_nv ed_rbm_pumg_obd.denominator_nv ed_rbm_pumg_obd.numerator_nv ed_rbm_rlslp.denominator_nv ed_rbm_rlslp.numerator_nv ed_rbm_rlu87.denominator_nv ed_rbm_rlu87.numerator_nv ed_rbm_s_getr_hs.denominator_nv ed_rbm_s_getr_hs.numerator_nv ed_rbm_s_kupp_hs.denominator_nv ed_rbm_s_kupp_hs.numerator_nv ed_rbm_s_poel_diag.denominator_nv ed_rbm_s_poel_diag.numerator_nv ed_rbm_sg_inj.denominator_nv ed_rbm_sg_inj.numerator_nv ed_rbm_sk_manager_inj.denominator_nv ed_rbm_sk_manager_inj.numerator_nv ed_rbm_sk_tr_inj.denominator_nv ed_rbm_sk_tr_inj.numerator_nv ed_rbm_sl_durchs_b1.denominator_nv ed_rbm_sl_durchs_b1.numerator_nv ed_rbm_sl_durchs_b2.denominator_nv ed_rbm_sl_durchs_b2.numerator_nv ed_rbm_sl_durchs_hstrang.denominator_nv ed_rbm_sl_durchs_hstrang.numerator_nv ed_rbm_sl_ml_hfm.denominator_nv ed_rbm_sl_ml_hfm.numerator_nv ed_rbm_sl_ml_hfm_obd.denominator_nv ed_rbm_sl_ml_hfm_obd.numerator_nv ed_rbm_slp.denominator_nv ed_rbm_slp.numerator_nv ed_rbm_slv.denominator_nv ed_rbm_slv.numerator_nv ed_rbm_ssp.denominator_nv ed_rbm_ssp.numerator_nv ed_rbm_ssp_diag.denominator_nv ed_rbm_ssp_diag.numerator_nv ed_rbm_tank_leer.denominator_nv ed_rbm_tank_leer.numerator_nv ed_rbm_td.denominator_nv ed_rbm_td.numerator_nv ed_rbm_te_obd_1.denominator_nv ed_rbm_te_obd_1.numerator_nv ed_rbm_te_obd_2.denominator_nv ed_rbm_te_obd_2.numerator_nv ed_rbm_tev1.denominator_nv ed_rbm_tev1.numerator_nv ed_rbm_tev2.denominator_nv ed_rbm_tev2.numerator_nv ed_rbm_tgetr_hs.denominator_nv ed_rbm_tgetr_hs.numerator_nv ed_rbm_time ed_rbm_time_ll ed_rbm_time_slp ed_rbm_time_v ed_rbm_tz1.denominator_nv ed_rbm_tz1.numerator_nv ed_rbm_tz10.denominator_nv ed_rbm_tz10.numerator_nv ed_rbm_tz2.denominator_nv ed_rbm_tz2.numerator_nv ed_rbm_tz3.denominator_nv ed_rbm_tz3.numerator_nv ed_rbm_tz4.denominator_nv ed_rbm_tz4.numerator_nv ed_rbm_tz5.denominator_nv ed_rbm_tz5.numerator_nv ed_rbm_tz6.denominator_nv ed_rbm_tz6.numerator_nv ed_rbm_tz7.denominator_nv ed_rbm_tz7.numerator_nv ed_rbm_tz8.denominator_nv ed_rbm_tz8.numerator_nv ed_rbm_tz9.denominator_nv ed_rbm_tz9.numerator_nv ed_rbm_van_anschl_a1.denominator_nv ed_rbm_van_anschl_a1.numerator_nv ed_rbm_van_anschl_a2.denominator_nv ed_rbm_van_anschl_a2.numerator_nv ed_rbm_van_anschl_e1.denominator_nv ed_rbm_van_anschl_e1.numerator_nv ed_rbm_van_anschl_e2.denominator_nv ed_rbm_van_anschl_e2.numerator_nv ed_rbm_van_druck.denominator_nv ed_rbm_van_druck.numerator_nv ed_rbm_van_dsv.denominator_nv ed_rbm_van_dsv.numerator_nv ed_rbm_van_hall_a1.denominator_nv ed_rbm_van_hall_a1.numerator_nv ed_rbm_van_hall_a2.denominator_nv ed_rbm_van_hall_a2.numerator_nv ed_rbm_van_hall_e1.denominator_nv ed_rbm_van_hall_e1.numerator_nv ed_rbm_van_hall_e2.denominator_nv ed_rbm_van_hall_e2.numerator_nv ed_rbm_van_regl_a1.denominator_nv ed_rbm_van_regl_a1.numerator_nv ed_rbm_van_regl_a2.denominator_nv ed_rbm_van_regl_a2.numerator_nv ed_rbm_van_regl_e1.denominator_nv ed_rbm_van_regl_e1.numerator_nv ed_rbm_van_regl_e2.denominator_nv ed_rbm_van_regl_e2.numerator_nv ed_rbm_van_vent_a1.denominator_nv ed_rbm_van_vent_a1.numerator_nv ed_rbm_van_vent_a2.denominator_nv ed_rbm_van_vent_a2.numerator_nv ed_rbm_van_vent_e1.denominator_nv ed_rbm_van_vent_e1.numerator_nv ed_rbm_van_vent_e2.denominator_nv ed_rbm_van_vent_e2.numerator_nv ed_scdn_st_nv ed_st_fehler_ign_1of4_ ed_st_fehler_ign_2of4_ ed_st_fehler_ign_3of4_ ed_st_fehler_ign_4of4_ ed_st_fehler_inj_1of7_ ed_st_fehler_inj_2of7_ ed_st_fehler_inj_3of7_ ed_st_fehler_inj_4of7_ ed_st_fehler_inj_5of7_ ed_st_fehler_inj_6of7_ ed_st_fehler_inj_7of7_ ed_st_filter_ign_1of4_ ed_st_filter_ign_2of4_ ed_st_filter_ign_3of4_ ed_st_filter_ign_4of4_ ed_st_filter_inj_1of7_ ed_st_filter_inj_2of7_ ed_st_filter_inj_3of7_ ed_st_filter_inj_4of7_ ed_st_filter_inj_5of7_ ed_st_filter_inj_6of7_ ed_st_filter_inj_7of7_ ed_st_nv ed_st_nv_css_den ed_st_nv_css_num ed_st_nv_rbm_abbruch ed_st_nv_rbm_dcy ed_st_nv_rbm_evap ed_st_nv_rbm_slp ed_st_nv_wuc /end OUT_MEASUREMENT
/end FUNCTION
/begin RECORD_LAYOUT TKW_VV_VV_UB FNC_VALUES 1 UBYTE COLUMN_DIR DIRECT /end RECORD_LAYOUT
/begin RECORD_LAYOUT TKW_VV_VV_UW FNC_VALUES 1 UWORD COLUMN_DIR DIRECT /end RECORD_LAYOUT
/end MODULE
/end PROJECT
