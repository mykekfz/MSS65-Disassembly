/begin PROJECT MSS65-inj-V452 "MSS65 INJ - V452.01-B204.00, data set 0569Q60Z160E"
/begin HEADER "" VERSION "V452.01-B204.00" /end HEADER
/begin MODULE _MSS65-inj "MSS65 INJ - V452.01-B204.00, calibration xxxxxxxx"
/begin MOD_COMMON "" BYTE_ORDER MSB_FIRST /* Default byteorder (Motorola) */ /end MOD_COMMON
/begin COMPU_METHOD FORMULA_0003 "FORMULA_0003" RAT_FUNC "%3.0" "-" COEFFS 0 1 0 0 0 1 /end COMPU_METHOD
/begin COMPU_METHOD FORMULA_0008 "FORMULA_0008" RAT_FUNC "%6.1" "V" COEFFS 0 10 0 0 0 1 /end COMPU_METHOD
/begin COMPU_METHOD FORMULA_0010 "FORMULA_0010" RAT_FUNC "%5.0" "-" COEFFS 0 1 0 0 0 1 /end COMPU_METHOD
/* ------------------ Abschnitt erzeugt aus adapt_glob.dat ------------------ */
/begin COMPU_METHOD FORMULA_0023 "FORMULA_0023" RAT_FUNC "%6.1" "�C" COEFFS 0 10 2732 0 0 1 /end COMPU_METHOD
/begin COMPU_METHOD FORMULA_0073 "FORMULA_0073" RAT_FUNC "%6.1" "s" COEFFS 0 10 0 0 0 1 /end COMPU_METHOD
/begin COMPU_METHOD FORMULA_0075 "FORMULA_0075" RAT_FUNC "%8.3" "-" COEFFS 0 1024 0 0 0 1 /end COMPU_METHOD
/begin COMPU_METHOD FORMULA_0076 "FORMULA_0076" RAT_FUNC "%6.1" "Kelvin" COEFFS 0 10 0 0 0 1 /end COMPU_METHOD
/begin COMPU_METHOD FORMULA_0077 "FORMULA_0077" RAT_FUNC "%6.1" "mbar" COEFFS 0 16 0 0 0 1 /end COMPU_METHOD
/begin COMPU_METHOD FORMULA_0078 "FORMULA_0078" RAT_FUNC "%6.1" "km/h" COEFFS 0 16 0 0 0 1 /end COMPU_METHOD
/* ------------------ Abschnitt erzeugt aus ed_glob.dat ------------------ */
/begin CHARACTERISTIC K_ED_SCDN_ABDECKUNG_EINTRAG "Similar Abdeckung fuer Fehlerspeichereintrag  | EN: Similar Abdeckung fuer Fehlerspeichereintrag" VALUE 0x71F9A TKW_VV_VV_UW 100.0 FORMULA_0075 0.0 4.0000 FORMAT "%6.3" /end CHARACTERISTIC
/begin CHARACTERISTIC K_ED_SCDN_ABDECKUNG_AUSTRAG "Similar Abdeckung fuer Fehlerspeicheraustrag  | EN: Similar Abdeckung fuer Fehlerspeicheraustrag" VALUE 0x71F9C TKW_VV_VV_UW 100.0 FORMULA_0075 0.0 4.0000 FORMAT "%6.3" /end CHARACTERISTIC
/begin CHARACTERISTIC K_ED_WUC_TMOT_MIN "Min. Temperatur fuer Warmupcycle | EN: Minimum temperature for an OBD warm-up cycle" VALUE 0x71F9E TKW_VV_VV_SW 100.0 FORMULA_0023 -50.0000 170.0000 FORMAT "%4.1" /end CHARACTERISTIC
/begin CHARACTERISTIC K_ED_WUC_DELTA_TMOT "Min. Temperaturerhoehung fuer Warmupcycle | EN: Minimum temperature rise for an OBD warm-up cycle" VALUE 0x71FA0 TKW_VV_VV_SW 100.0 FORMULA_0076 -1000.0000 1000.0000 FORMAT "%4.1" /end CHARACTERISTIC
/begin CHARACTERISTIC K_ED_RBM_PUMG_MIN "Mindestluftdruck fuer Rate-Based | EN: Minimum air pressure for rate-based OBD monitoring" VALUE 0x71FA2 TKW_VV_VV_SW 100.0 FORMULA_0077 400.0000 1200.0000 FORMAT "%4.1" /end CHARACTERISTIC
/begin CHARACTERISTIC K_ED_RBM_TUMG_MIN "Mindesttemperatur | EN: Minimum ambient temperature (rate-based monitoring)" VALUE 0x71FA4 TKW_VV_VV_SW 100.0 FORMULA_0023 -50.0000 170.0000 FORMAT "%4.1" /end CHARACTERISTIC
/begin CHARACTERISTIC K_ED_RBM_TIME "Gesamtzeit fuer Fahrzyklus | EN: Total time for drive cycle (rate-based monitoring)" VALUE 0x71FA6 TKW_VV_VV_UW 100.0 FORMULA_0073 0.0 6553.5000 FORMAT "%4.1" /end CHARACTERISTIC
/begin CHARACTERISTIC K_ED_RBM_TIME_V "Geschwindigkeitszeit Fahrzyklus | EN: Time at speed in drive cycle (rate-based monitoring)" VALUE 0x71FA8 TKW_VV_VV_UW 100.0 FORMULA_0073 0.0 6553.5000 FORMAT "%4.1" /end CHARACTERISTIC
/begin CHARACTERISTIC K_ED_RBM_TIME_LL "Mindestleerlauf Fahrzyklus | EN: Minimum idle time in drive cycle (rate-based monitoring)" VALUE 0x71FAA TKW_VV_VV_UW 100.0 FORMULA_0073 0.0 6553.5000 FORMAT "%4.1" /end CHARACTERISTIC
/begin CHARACTERISTIC K_ED_RBM_V_MIN "Mindestgeschwindigkeit Fahrzyklus | EN: Minimum vehicle speed in drive cycle (rate-based monitoring)" VALUE 0x71FAC TKW_VV_VV_SW 100.0 FORMULA_0078 -80.0000 360.0000 FORMAT "%4.1" /end CHARACTERISTIC
/begin CHARACTERISTIC K_ED_RBM_EVAP_MIN "Mindesttemperatur EVAP | EN: Mindesttemperatur EVAP" VALUE 0x71FAE TKW_VV_VV_SW 100.0 FORMULA_0023 -50.0000 170.0000 FORMAT "%4.1" /end CHARACTERISTIC
/begin CHARACTERISTIC K_ED_RBM_EVAP_MAX "Maximaltemperatur EVAP | EN: Maximaltemperatur EVAP" VALUE 0x71FB0 TKW_VV_VV_SW 100.0 FORMULA_0023 -50.0000 170.0000 FORMAT "%4.1" /end CHARACTERISTIC
/begin CHARACTERISTIC K_ED_RBM_EVAP_TEMP_DELTA "Max. Differenz zwischen tmot und tumg fuer EVAP | EN: Max. Differenz zwischen tmot und tumg fuer EVAP" VALUE 0x71FB2 TKW_VV_VV_SW 100.0 FORMULA_0076 -1000.0000 1000.0000 FORMAT "%4.1" /end CHARACTERISTIC
/begin CHARACTERISTIC K_ED_UBMIN "untere UB-Schwelle fuer elektr. Diagnosen | EN: Lower battery-voltage threshold for electrical diagnoses" VALUE 0x71FB6 TKW_VV_VV_SW 100.0 FORMULA_0008 0.0 28.0000 FORMAT "%4.1" /end CHARACTERISTIC
/* ------------------ Abschnitt erzeugt aus ed.dat ------------------ */
/begin CHARACTERISTIC K_ED_SK_TR_INJ.P_CODE_SH_TO_UB "P-Code fuer die Art SH_TO_UB | EN: P-Code fuer die Art SH_TO_UB" VALUE 0x708D6 TKW_VV_VV_UW 100.0 FORMULA_0010 0.0 65535.0000 /end CHARACTERISTIC
/begin CHARACTERISTIC K_ED_PUMG.P_CODE_SH_TO_UB "P-Code fuer die Art SH_TO_UB | EN: Fault code PUMG - OBD P-code reported for short to battery voltage" VALUE 0x708F0 TKW_VV_VV_UW 100.0 FORMULA_0010 0.0 65535.0000 /end CHARACTERISTIC
/begin CHARACTERISTIC K_ED_VAN_HALL_E1.P_CODE_SH_TO_UB "P-Code fuer die Art SH_TO_UB | EN: Fault code VAN_HALL_E1 - OBD P-code reported for short to battery voltage" VALUE 0x70972 TKW_VV_VV_UW 100.0 FORMULA_0010 0.0 65535.0000 /end CHARACTERISTIC
/begin CHARACTERISTIC K_ED_VAN_HALL_A1.P_CODE_SH_TO_UB "P-Code fuer die Art SH_TO_UB | EN: Fault code VAN_HALL_A1 - OBD P-code reported for short to battery voltage" VALUE 0x7098C TKW_VV_VV_UW 100.0 FORMULA_0010 0.0 65535.0000 /end CHARACTERISTIC
/begin CHARACTERISTIC K_ED_VAN_HALL_E2.P_CODE_SH_TO_UB "P-Code fuer die Art SH_TO_UB | EN: Fault code VAN_HALL_E2 - OBD P-code reported for short to battery voltage" VALUE 0x709A6 TKW_VV_VV_UW 100.0 FORMULA_0010 0.0 65535.0000 /end CHARACTERISTIC
/begin CHARACTERISTIC K_ED_VAN_HALL_A2.P_CODE_SH_TO_UB "P-Code fuer die Art SH_TO_UB | EN: Fault code VAN_HALL_A2 - OBD P-code reported for short to battery voltage" VALUE 0x709C0 TKW_VV_VV_UW 100.0 FORMULA_0010 0.0 65535.0000 /end CHARACTERISTIC
/begin CHARACTERISTIC K_ED_VAN_REGL_E1.P_CODE_SH_TO_UB "P-Code fuer die Art SH_TO_UB | EN: Fault code VAN_REGL_E1 - OBD P-code reported for short to battery voltage" VALUE 0x709DA TKW_VV_VV_UW 100.0 FORMULA_0010 0.0 65535.0000 /end CHARACTERISTIC
/begin CHARACTERISTIC K_ED_VAN_REGL_A1.P_CODE_SH_TO_UB "P-Code fuer die Art SH_TO_UB | EN: Fault code VAN_REGL_A1 - OBD P-code reported for short to battery voltage" VALUE 0x709F4 TKW_VV_VV_UW 100.0 FORMULA_0010 0.0 65535.0000 /end CHARACTERISTIC
/begin CHARACTERISTIC K_ED_VAN_REGL_E2.P_CODE_SH_TO_UB "P-Code fuer die Art SH_TO_UB | EN: Fault code VAN_REGL_E2 - OBD P-code reported for short to battery voltage" VALUE 0x70A0E TKW_VV_VV_UW 100.0 FORMULA_0010 0.0 65535.0000 /end CHARACTERISTIC
/begin CHARACTERISTIC K_ED_VAN_REGL_A2.P_CODE_SH_TO_UB "P-Code fuer die Art SH_TO_UB | EN: Fault code VAN_REGL_A2 - OBD P-code reported for short to battery voltage" VALUE 0x70A28 TKW_VV_VV_UW 100.0 FORMULA_0010 0.0 65535.0000 /end CHARACTERISTIC
/begin CHARACTERISTIC K_ED_PT_VRAD.P_CODE_SH_TO_UB "P-Code fuer die Art SH_TO_UB | EN: Fault code PT_VRAD - OBD P-code reported for short to battery voltage" VALUE 0x70C30 TKW_VV_VV_UW 100.0 FORMULA_0010 0.0 65535.0000 /end CHARACTERISTIC
/begin CHARACTERISTIC K_ED_PT_VFZG.P_CODE_SH_TO_UB "P-Code fuer die Art SH_TO_UB | EN: Fault code PT_VFZG - OBD P-code reported for short to battery voltage" VALUE 0x70C4A TKW_VV_VV_UW 100.0 FORMULA_0010 0.0 65535.0000 /end CHARACTERISTIC
/begin CHARACTERISTIC K_ED_SL_ML_HFM.P_CODE_SH_TO_UB "P-Code fuer die Art SH_TO_UB | EN: Fault code SL_ML_HFM - OBD P-code reported for short to battery voltage" VALUE 0x70D00 TKW_VV_VV_UW 100.0 FORMULA_0010 0.0 65535.0000 /end CHARACTERISTIC
/begin CHARACTERISTIC K_ED_TZ1.P_CODE_SH_TO_UB "P-Code fuer die Art SH_TO_UB | EN: Fault code TZ1 - OBD P-code reported for short to battery voltage" VALUE 0x70FA4 TKW_VV_VV_UW 100.0 FORMULA_0010 0.0 65535.0000 /end CHARACTERISTIC
/begin CHARACTERISTIC K_ED_TZ2.P_CODE_SH_TO_UB "P-Code fuer die Art SH_TO_UB | EN: Fault code TZ2 - OBD P-code reported for short to battery voltage" VALUE 0x70FBE TKW_VV_VV_UW 100.0 FORMULA_0010 0.0 65535.0000 /end CHARACTERISTIC
/begin CHARACTERISTIC K_ED_TZ3.P_CODE_SH_TO_UB "P-Code fuer die Art SH_TO_UB | EN: Fault code TZ3 - OBD P-code reported for short to battery voltage" VALUE 0x70FD8 TKW_VV_VV_UW 100.0 FORMULA_0010 0.0 65535.0000 /end CHARACTERISTIC
/begin CHARACTERISTIC K_ED_TZ4.P_CODE_SH_TO_UB "P-Code fuer die Art SH_TO_UB | EN: Fault code TZ4 - OBD P-code reported for short to battery voltage" VALUE 0x70FF2 TKW_VV_VV_UW 100.0 FORMULA_0010 0.0 65535.0000 /end CHARACTERISTIC
/begin CHARACTERISTIC K_ED_TZ5.P_CODE_SH_TO_UB "P-Code fuer die Art SH_TO_UB | EN: Fault code TZ5 - OBD P-code reported for short to battery voltage" VALUE 0x7100C TKW_VV_VV_UW 100.0 FORMULA_0010 0.0 65535.0000 /end CHARACTERISTIC
/begin CHARACTERISTIC K_ED_TZ6.P_CODE_SH_TO_UB "P-Code fuer die Art SH_TO_UB | EN: Fault code TZ6 - OBD P-code reported for short to battery voltage" VALUE 0x71026 TKW_VV_VV_UW 100.0 FORMULA_0010 0.0 65535.0000 /end CHARACTERISTIC
/begin CHARACTERISTIC K_ED_TZ7.P_CODE_SH_TO_UB "P-Code fuer die Art SH_TO_UB | EN: Fault code TZ7 - OBD P-code reported for short to battery voltage" VALUE 0x71040 TKW_VV_VV_UW 100.0 FORMULA_0010 0.0 65535.0000 /end CHARACTERISTIC
/begin CHARACTERISTIC K_ED_TZ8.P_CODE_SH_TO_UB "P-Code fuer die Art SH_TO_UB | EN: Fault code TZ8 - OBD P-code reported for short to battery voltage" VALUE 0x7105A TKW_VV_VV_UW 100.0 FORMULA_0010 0.0 65535.0000 /end CHARACTERISTIC
/begin CHARACTERISTIC K_ED_TZ9.P_CODE_SH_TO_UB "P-Code fuer die Art SH_TO_UB | EN: Fault code TZ9 - OBD P-code reported for short to battery voltage" VALUE 0x71074 TKW_VV_VV_UW 100.0 FORMULA_0010 0.0 65535.0000 /end CHARACTERISTIC
/begin CHARACTERISTIC K_ED_TZ10.P_CODE_SH_TO_UB "P-Code fuer die Art SH_TO_UB | EN: Fault code TZ10 - OBD P-code reported for short to battery voltage" VALUE 0x7108E TKW_VV_VV_UW 100.0 FORMULA_0010 0.0 65535.0000 /end CHARACTERISTIC
/begin CHARACTERISTIC K_ED_VAN_ANSCHL_E1.P_CODE_SH_TO_UB "P-Code fuer die Art SH_TO_UB | EN: Fault code VAN_ANSCHL_E1 - OBD P-code reported for short to battery voltage" VALUE 0x710DC TKW_VV_VV_UW 100.0 FORMULA_0010 0.0 65535.0000 /end CHARACTERISTIC
/begin CHARACTERISTIC K_ED_VAN_ANSCHL_A1.P_CODE_SH_TO_UB "P-Code fuer die Art SH_TO_UB | EN: Fault code VAN_ANSCHL_A1 - OBD P-code reported for short to battery voltage" VALUE 0x710F6 TKW_VV_VV_UW 100.0 FORMULA_0010 0.0 65535.0000 /end CHARACTERISTIC
/begin CHARACTERISTIC K_ED_VAN_ANSCHL_E2.P_CODE_SH_TO_UB "P-Code fuer die Art SH_TO_UB | EN: Fault code VAN_ANSCHL_E2 - OBD P-code reported for short to battery voltage" VALUE 0x71110 TKW_VV_VV_UW 100.0 FORMULA_0010 0.0 65535.0000 /end CHARACTERISTIC
/begin CHARACTERISTIC K_ED_VAN_ANSCHL_A2.P_CODE_SH_TO_UB "P-Code fuer die Art SH_TO_UB | EN: Fault code VAN_ANSCHL_A2 - OBD P-code reported for short to battery voltage" VALUE 0x7112A TKW_VV_VV_UW 100.0 FORMULA_0010 0.0 65535.0000 /end CHARACTERISTIC
/begin CHARACTERISTIC K_ED_VAN_VENT_E1.P_CODE_SH_TO_UB "P-Code fuer die Art SH_TO_UB | EN: Fault code VAN_VENT_E1 - OBD P-code reported for short to battery voltage" VALUE 0x71144 TKW_VV_VV_UW 100.0 FORMULA_0010 0.0 65535.0000 /end CHARACTERISTIC
/begin CHARACTERISTIC K_ED_VAN_VENT_A1.P_CODE_SH_TO_UB "P-Code fuer die Art SH_TO_UB | EN: Fault code VAN_VENT_A1 - OBD P-code reported for short to battery voltage" VALUE 0x7115E TKW_VV_VV_UW 100.0 FORMULA_0010 0.0 65535.0000 /end CHARACTERISTIC
/begin CHARACTERISTIC K_ED_VAN_VENT_E2.P_CODE_SH_TO_UB "P-Code fuer die Art SH_TO_UB | EN: Fault code VAN_VENT_E2 - OBD P-code reported for short to battery voltage" VALUE 0x71178 TKW_VV_VV_UW 100.0 FORMULA_0010 0.0 65535.0000 /end CHARACTERISTIC
/begin CHARACTERISTIC K_ED_VAN_VENT_A2.P_CODE_SH_TO_UB "P-Code fuer die Art SH_TO_UB | EN: Fault code VAN_VENT_A2 - OBD P-code reported for short to battery voltage" VALUE 0x71192 TKW_VV_VV_UW 100.0 FORMULA_0010 0.0 65535.0000 /end CHARACTERISTIC
/begin CHARACTERISTIC K_ED_PT_VEHMOD.P_CODE_SH_TO_UB "P-Code fuer die Art SH_TO_UB | EN: Fault code PT_VEHMOD - OBD P-code reported for short to battery voltage" VALUE 0x712FE TKW_VV_VV_UW 100.0 FORMULA_0010 0.0 65535.0000 /end CHARACTERISTIC
/begin CHARACTERISTIC K_ED_RLU87.P_CODE_SH_TO_UB "P-Code fuer die Art SH_TO_UB | EN: Fault code RLU87 - OBD P-code reported for short to battery voltage" VALUE 0x71402 TKW_VV_VV_UW 100.0 FORMULA_0010 0.0 65535.0000 /end CHARACTERISTIC
/begin CHARACTERISTIC K_ED_SSP.P_CODE_SH_TO_UB "P-Code fuer die Art SH_TO_UB" VALUE 0x71436 TKW_VV_VV_UW 100.0 FORMULA_0010 0.0 65535.0000 /end CHARACTERISTIC
/begin CHARACTERISTIC K_ED_TD.P_CODE_SH_TO_UB "P-Code fuer die Art SH_TO_UB | EN: Fault code TD - OBD P-code reported for short to battery voltage" VALUE 0x71450 TKW_VV_VV_UW 100.0 FORMULA_0010 0.0 65535.0000 /end CHARACTERISTIC
/begin CHARACTERISTIC K_ED_RLSLP.P_CODE_SH_TO_UB "P-Code fuer die Art SH_TO_UB | EN: Fault code RLSLP - OBD P-code reported for short to battery voltage" VALUE 0x7146A TKW_VV_VV_UW 100.0 FORMULA_0010 0.0 65535.0000 /end CHARACTERISTIC
/begin CHARACTERISTIC K_ED_SLV.P_CODE_SH_TO_UB "P-Code fuer die Art SH_TO_UB | EN: Fault code SLV - OBD P-code reported for short to battery voltage" VALUE 0x71484 TKW_VV_VV_UW 100.0 FORMULA_0010 0.0 65535.0000 /end CHARACTERISTIC
/begin CHARACTERISTIC K_ED_VAN_DSV.P_CODE_SH_TO_UB "P-Code fuer die Art SH_TO_UB | EN: Fault code VAN_DSV - OBD P-code reported for short to battery voltage" VALUE 0x71554 TKW_VV_VV_UW 100.0 FORMULA_0010 0.0 65535.0000 /end CHARACTERISTIC
/begin CHARACTERISTIC K_ED_SK_MANAGER_INJ.P_CODE_SH_TO_UB "P-Code fuer die Art SH_TO_UB | EN: Fault code SK_MANAGER_INJ - OBD P-code reported for short to battery voltage" VALUE 0x71672 TKW_VV_VV_UW 100.0 FORMULA_0010 0.0 65535.0000 /end CHARACTERISTIC
/begin CHARACTERISTIC K_ED_SSP_DIAG.P_CODE_SH_TO_UB "P-Code fuer die Art SH_TO_UB" VALUE 0x7168C TKW_VV_VV_UW 100.0 FORMULA_0010 0.0 65535.0000 /end CHARACTERISTIC
/begin CHARACTERISTIC K_ED_SG_INJ.P_CODE_SH_TO_UB "P-Code fuer die Art SH_TO_UB | EN: Fault code SG_INJ - OBD P-code reported for short to battery voltage" VALUE 0x71776 TKW_VV_VV_UW 100.0 FORMULA_0010 0.0 65535.0000 /end CHARACTERISTIC
/begin CHARACTERISTIC K_ED_S_POEL_DIAG.P_CODE_SH_TO_UB "P-Code fuer die Art SH_TO_UB | EN: Fault code S_POEL_DIAG - OBD P-code reported for short to battery voltage" VALUE 0x717C4 TKW_VV_VV_UW 100.0 FORMULA_0010 0.0 65535.0000 /end CHARACTERISTIC
/begin CHARACTERISTIC K_ED_TE_OBD_1.P_CODE_SH_TO_UB "P-Code fuer die Art SH_TO_UB | EN: Fault code TE_OBD_1 - OBD P-code reported for short to battery voltage" VALUE 0x717DE TKW_VV_VV_UW 100.0 FORMULA_0010 0.0 65535.0000 /end CHARACTERISTIC
/begin CHARACTERISTIC K_ED_TE_OBD_2.P_CODE_SH_TO_UB "P-Code fuer die Art SH_TO_UB | EN: Fault code TE_OBD_2 - OBD P-code reported for short to battery voltage" VALUE 0x717F8 TKW_VV_VV_UW 100.0 FORMULA_0010 0.0 65535.0000 /end CHARACTERISTIC
/begin CHARACTERISTIC K_ED_TEV1.P_CODE_SH_TO_UB "P-Code fuer die Art SH_TO_UB | EN: Fault code TEV1 - OBD P-code reported for short to battery voltage" VALUE 0x71812 TKW_VV_VV_UW 100.0 FORMULA_0010 0.0 65535.0000 /end CHARACTERISTIC
/begin CHARACTERISTIC K_ED_TEV2.P_CODE_SH_TO_UB "P-Code fuer die Art SH_TO_UB | EN: Fault code TEV2 - OBD P-code reported for short to battery voltage" VALUE 0x7182C TKW_VV_VV_UW 100.0 FORMULA_0010 0.0 65535.0000 /end CHARACTERISTIC
/begin CHARACTERISTIC K_ED_SLP.P_CODE_SH_TO_UB "P-Code fuer die Art SH_TO_UB | EN: Fault code SLP - OBD P-code reported for short to battery voltage" VALUE 0x718FC TKW_VV_VV_UW 100.0 FORMULA_0010 0.0 65535.0000 /end CHARACTERISTIC
/begin CHARACTERISTIC K_ED_SL_DURCHS_B1.P_CODE_SH_TO_UB "P-Code fuer die Art SH_TO_UB | EN: Fault code SL_DURCHS_B1 - OBD P-code reported for short to battery voltage" VALUE 0x71916 TKW_VV_VV_UW 100.0 FORMULA_0010 0.0 65535.0000 /end CHARACTERISTIC
/begin CHARACTERISTIC K_ED_SL_DURCHS_B2.P_CODE_SH_TO_UB "P-Code fuer die Art SH_TO_UB | EN: Fault code SL_DURCHS_B2 - OBD P-code reported for short to battery voltage" VALUE 0x71930 TKW_VV_VV_UW 100.0 FORMULA_0010 0.0 65535.0000 /end CHARACTERISTIC
/begin CHARACTERISTIC K_ED_SL_DURCHS_HSTRANG.P_CODE_SH_TO_UB "P-Code fuer die Art SH_TO_UB | EN: Fault code SL_DURCHS_HSTRANG - OBD P-code reported for short to battery voltage" VALUE 0x7194A TKW_VV_VV_UW 100.0 FORMULA_0010 0.0 65535.0000 /end CHARACTERISTIC
/begin CHARACTERISTIC K_ED_S_GETR_HS.P_CODE_SH_TO_UB "P-Code fuer die Art SH_TO_UB | EN: Fault code S_GETR_HS - OBD P-code reported for short to battery voltage" VALUE 0x7197E TKW_VV_VV_UW 100.0 FORMULA_0010 0.0 65535.0000 /end CHARACTERISTIC
/begin CHARACTERISTIC K_ED_S_KUPP_HS.P_CODE_SH_TO_UB "P-Code fuer die Art SH_TO_UB | EN: Fault code S_KUPP_HS - OBD P-code reported for short to battery voltage" VALUE 0x71998 TKW_VV_VV_UW 100.0 FORMULA_0010 0.0 65535.0000 /end CHARACTERISTIC
/begin CHARACTERISTIC K_ED_VAN_DRUCK.P_CODE_SH_TO_UB "P-Code fuer die Art SH_TO_UB | EN: Fault code VAN_DRUCK - OBD P-code reported for short to battery voltage" VALUE 0x719B2 TKW_VV_VV_UW 100.0 FORMULA_0010 0.0 65535.0000 /end CHARACTERISTIC
/begin CHARACTERISTIC K_ED_TANK_LEER.P_CODE_SH_TO_UB "P-Code fuer die Art SH_TO_UB | EN: Fault code TANK_LEER - OBD P-code reported for short to battery voltage" VALUE 0x71AD0 TKW_VV_VV_UW 100.0 FORMULA_0010 0.0 65535.0000 /end CHARACTERISTIC
/begin CHARACTERISTIC K_ED_PUMG_OBD.P_CODE_SH_TO_UB "P-Code fuer die Art SH_TO_UB | EN: Fault code PUMG_OBD - OBD P-code reported for short to battery voltage" VALUE 0x71B1E TKW_VV_VV_UW 100.0 FORMULA_0010 0.0 65535.0000 /end CHARACTERISTIC
/begin CHARACTERISTIC K_ED_SL_ML_HFM_OBD.P_CODE_SH_TO_UB "P-Code fuer die Art SH_TO_UB | EN: Fault code SL_ML_HFM_OBD - OBD P-code reported for short to battery voltage" VALUE 0x71B38 TKW_VV_VV_UW 100.0 FORMULA_0010 0.0 65535.0000 /end CHARACTERISTIC
/begin CHARACTERISTIC K_ED_TGETR_HS.P_CODE_SH_TO_UB "P-Code fuer die Art SH_TO_UB | EN: Fault code TGETR_HS - OBD P-code reported for short to battery voltage" VALUE 0x71C70 TKW_VV_VV_UW 100.0 FORMULA_0010 0.0 65535.0000 /end CHARACTERISTIC
/begin CHARACTERISTIC K_ED_SK_TR_INJ.P_CODE_SH_TO_GND "P-Code fuer die Art SH_TO_GND | EN: P-Code fuer die Art SH_TO_GND" VALUE 0x708D8 TKW_VV_VV_UW 100.0 FORMULA_0010 0.0 65535.0000 /end CHARACTERISTIC
/begin CHARACTERISTIC K_ED_PUMG.P_CODE_SH_TO_GND "P-Code fuer die Art SH_TO_GND | EN: Fault code PUMG - OBD P-code reported for short to ground" VALUE 0x708F2 TKW_VV_VV_UW 100.0 FORMULA_0010 0.0 65535.0000 /end CHARACTERISTIC
/begin CHARACTERISTIC K_ED_VAN_HALL_E1.P_CODE_SH_TO_GND "P-Code fuer die Art SH_TO_GND | EN: Fault code VAN_HALL_E1 - OBD P-code reported for short to ground" VALUE 0x70974 TKW_VV_VV_UW 100.0 FORMULA_0010 0.0 65535.0000 /end CHARACTERISTIC
/begin CHARACTERISTIC K_ED_VAN_HALL_A1.P_CODE_SH_TO_GND "P-Code fuer die Art SH_TO_GND | EN: Fault code VAN_HALL_A1 - OBD P-code reported for short to ground" VALUE 0x7098E TKW_VV_VV_UW 100.0 FORMULA_0010 0.0 65535.0000 /end CHARACTERISTIC
/begin CHARACTERISTIC K_ED_VAN_HALL_E2.P_CODE_SH_TO_GND "P-Code fuer die Art SH_TO_GND | EN: Fault code VAN_HALL_E2 - OBD P-code reported for short to ground" VALUE 0x709A8 TKW_VV_VV_UW 100.0 FORMULA_0010 0.0 65535.0000 /end CHARACTERISTIC
/begin CHARACTERISTIC K_ED_VAN_HALL_A2.P_CODE_SH_TO_GND "P-Code fuer die Art SH_TO_GND | EN: Fault code VAN_HALL_A2 - OBD P-code reported for short to ground" VALUE 0x709C2 TKW_VV_VV_UW 100.0 FORMULA_0010 0.0 65535.0000 /end CHARACTERISTIC
/begin CHARACTERISTIC K_ED_VAN_REGL_E1.P_CODE_SH_TO_GND "P-Code fuer die Art SH_TO_GND | EN: Fault code VAN_REGL_E1 - OBD P-code reported for short to ground" VALUE 0x709DC TKW_VV_VV_UW 100.0 FORMULA_0010 0.0 65535.0000 /end CHARACTERISTIC
/begin CHARACTERISTIC K_ED_VAN_REGL_A1.P_CODE_SH_TO_GND "P-Code fuer die Art SH_TO_GND | EN: Fault code VAN_REGL_A1 - OBD P-code reported for short to ground" VALUE 0x709F6 TKW_VV_VV_UW 100.0 FORMULA_0010 0.0 65535.0000 /end CHARACTERISTIC
/begin CHARACTERISTIC K_ED_VAN_REGL_E2.P_CODE_SH_TO_GND "P-Code fuer die Art SH_TO_GND | EN: Fault code VAN_REGL_E2 - OBD P-code reported for short to ground" VALUE 0x70A10 TKW_VV_VV_UW 100.0 FORMULA_0010 0.0 65535.0000 /end CHARACTERISTIC
/begin CHARACTERISTIC K_ED_VAN_REGL_A2.P_CODE_SH_TO_GND "P-Code fuer die Art SH_TO_GND | EN: Fault code VAN_REGL_A2 - OBD P-code reported for short to ground" VALUE 0x70A2A TKW_VV_VV_UW 100.0 FORMULA_0010 0.0 65535.0000 /end CHARACTERISTIC
/begin CHARACTERISTIC K_ED_PT_VRAD.P_CODE_SH_TO_GND "P-Code fuer die Art SH_TO_GND | EN: Fault code PT_VRAD - OBD P-code reported for short to ground" VALUE 0x70C32 TKW_VV_VV_UW 100.0 FORMULA_0010 0.0 65535.0000 /end CHARACTERISTIC
/begin CHARACTERISTIC K_ED_PT_VFZG.P_CODE_SH_TO_GND "P-Code fuer die Art SH_TO_GND | EN: Fault code PT_VFZG - OBD P-code reported for short to ground" VALUE 0x70C4C TKW_VV_VV_UW 100.0 FORMULA_0010 0.0 65535.0000 /end CHARACTERISTIC
/begin CHARACTERISTIC K_ED_SL_ML_HFM.P_CODE_SH_TO_GND "P-Code fuer die Art SH_TO_GND | EN: Fault code SL_ML_HFM - OBD P-code reported for short to ground" VALUE 0x70D02 TKW_VV_VV_UW 100.0 FORMULA_0010 0.0 65535.0000 /end CHARACTERISTIC
/begin CHARACTERISTIC K_ED_TZ1.P_CODE_SH_TO_GND "P-Code fuer die Art SH_TO_GND | EN: Fault code TZ1 - OBD P-code reported for short to ground" VALUE 0x70FA6 TKW_VV_VV_UW 100.0 FORMULA_0010 0.0 65535.0000 /end CHARACTERISTIC
/begin CHARACTERISTIC K_ED_TZ2.P_CODE_SH_TO_GND "P-Code fuer die Art SH_TO_GND | EN: Fault code TZ2 - OBD P-code reported for short to ground" VALUE 0x70FC0 TKW_VV_VV_UW 100.0 FORMULA_0010 0.0 65535.0000 /end CHARACTERISTIC
/begin CHARACTERISTIC K_ED_TZ3.P_CODE_SH_TO_GND "P-Code fuer die Art SH_TO_GND | EN: Fault code TZ3 - OBD P-code reported for short to ground" VALUE 0x70FDA TKW_VV_VV_UW 100.0 FORMULA_0010 0.0 65535.0000 /end CHARACTERISTIC
/begin CHARACTERISTIC K_ED_TZ4.P_CODE_SH_TO_GND "P-Code fuer die Art SH_TO_GND | EN: Fault code TZ4 - OBD P-code reported for short to ground" VALUE 0x70FF4 TKW_VV_VV_UW 100.0 FORMULA_0010 0.0 65535.0000 /end CHARACTERISTIC
/begin CHARACTERISTIC K_ED_TZ5.P_CODE_SH_TO_GND "P-Code fuer die Art SH_TO_GND | EN: Fault code TZ5 - OBD P-code reported for short to ground" VALUE 0x7100E TKW_VV_VV_UW 100.0 FORMULA_0010 0.0 65535.0000 /end CHARACTERISTIC
/begin CHARACTERISTIC K_ED_TZ6.P_CODE_SH_TO_GND "P-Code fuer die Art SH_TO_GND | EN: Fault code TZ6 - OBD P-code reported for short to ground" VALUE 0x71028 TKW_VV_VV_UW 100.0 FORMULA_0010 0.0 65535.0000 /end CHARACTERISTIC
/begin CHARACTERISTIC K_ED_TZ7.P_CODE_SH_TO_GND "P-Code fuer die Art SH_TO_GND | EN: Fault code TZ7 - OBD P-code reported for short to ground" VALUE 0x71042 TKW_VV_VV_UW 100.0 FORMULA_0010 0.0 65535.0000 /end CHARACTERISTIC
/begin CHARACTERISTIC K_ED_TZ8.P_CODE_SH_TO_GND "P-Code fuer die Art SH_TO_GND | EN: Fault code TZ8 - OBD P-code reported for short to ground" VALUE 0x7105C TKW_VV_VV_UW 100.0 FORMULA_0010 0.0 65535.0000 /end CHARACTERISTIC
/begin CHARACTERISTIC K_ED_TZ9.P_CODE_SH_TO_GND "P-Code fuer die Art SH_TO_GND | EN: Fault code TZ9 - OBD P-code reported for short to ground" VALUE 0x71076 TKW_VV_VV_UW 100.0 FORMULA_0010 0.0 65535.0000 /end CHARACTERISTIC
/begin CHARACTERISTIC K_ED_TZ10.P_CODE_SH_TO_GND "P-Code fuer die Art SH_TO_GND | EN: Fault code TZ10 - OBD P-code reported for short to ground" VALUE 0x71090 TKW_VV_VV_UW 100.0 FORMULA_0010 0.0 65535.0000 /end CHARACTERISTIC
/begin CHARACTERISTIC K_ED_VAN_ANSCHL_E1.P_CODE_SH_TO_GND "P-Code fuer die Art SH_TO_GND | EN: Fault code VAN_ANSCHL_E1 - OBD P-code reported for short to ground" VALUE 0x710DE TKW_VV_VV_UW 100.0 FORMULA_0010 0.0 65535.0000 /end CHARACTERISTIC
/begin CHARACTERISTIC K_ED_VAN_ANSCHL_A1.P_CODE_SH_TO_GND "P-Code fuer die Art SH_TO_GND | EN: Fault code VAN_ANSCHL_A1 - OBD P-code reported for short to ground" VALUE 0x710F8 TKW_VV_VV_UW 100.0 FORMULA_0010 0.0 65535.0000 /end CHARACTERISTIC
/begin CHARACTERISTIC K_ED_VAN_ANSCHL_E2.P_CODE_SH_TO_GND "P-Code fuer die Art SH_TO_GND | EN: Fault code VAN_ANSCHL_E2 - OBD P-code reported for short to ground" VALUE 0x71112 TKW_VV_VV_UW 100.0 FORMULA_0010 0.0 65535.0000 /end CHARACTERISTIC
/begin CHARACTERISTIC K_ED_VAN_ANSCHL_A2.P_CODE_SH_TO_GND "P-Code fuer die Art SH_TO_GND | EN: Fault code VAN_ANSCHL_A2 - OBD P-code reported for short to ground" VALUE 0x7112C TKW_VV_VV_UW 100.0 FORMULA_0010 0.0 65535.0000 /end CHARACTERISTIC
/begin CHARACTERISTIC K_ED_VAN_VENT_E1.P_CODE_SH_TO_GND "P-Code fuer die Art SH_TO_GND | EN: Fault code VAN_VENT_E1 - OBD P-code reported for short to ground" VALUE 0x71146 TKW_VV_VV_UW 100.0 FORMULA_0010 0.0 65535.0000 /end CHARACTERISTIC
/begin CHARACTERISTIC K_ED_VAN_VENT_A1.P_CODE_SH_TO_GND "P-Code fuer die Art SH_TO_GND | EN: Fault code VAN_VENT_A1 - OBD P-code reported for short to ground" VALUE 0x71160 TKW_VV_VV_UW 100.0 FORMULA_0010 0.0 65535.0000 /end CHARACTERISTIC
/begin CHARACTERISTIC K_ED_VAN_VENT_E2.P_CODE_SH_TO_GND "P-Code fuer die Art SH_TO_GND | EN: Fault code VAN_VENT_E2 - OBD P-code reported for short to ground" VALUE 0x7117A TKW_VV_VV_UW 100.0 FORMULA_0010 0.0 65535.0000 /end CHARACTERISTIC
/begin CHARACTERISTIC K_ED_VAN_VENT_A2.P_CODE_SH_TO_GND "P-Code fuer die Art SH_TO_GND | EN: Fault code VAN_VENT_A2 - OBD P-code reported for short to ground" VALUE 0x71194 TKW_VV_VV_UW 100.0 FORMULA_0010 0.0 65535.0000 /end CHARACTERISTIC
/begin CHARACTERISTIC K_ED_RLU87.P_CODE_SH_TO_GND "P-Code fuer die Art SH_TO_GND | EN: Fault code RLU87 - OBD P-code reported for short to ground" VALUE 0x71404 TKW_VV_VV_UW 100.0 FORMULA_0010 0.0 65535.0000 /end CHARACTERISTIC
/begin CHARACTERISTIC K_ED_SSP.P_CODE_SH_TO_GND "P-Code fuer die Art SH_TO_GND" VALUE 0x71438 TKW_VV_VV_UW 100.0 FORMULA_0010 0.0 65535.0000 /end CHARACTERISTIC
/begin CHARACTERISTIC K_ED_TD.P_CODE_SH_TO_GND "P-Code fuer die Art SH_TO_GND | EN: Fault code TD - OBD P-code reported for short to ground" VALUE 0x71452 TKW_VV_VV_UW 100.0 FORMULA_0010 0.0 65535.0000 /end CHARACTERISTIC
/begin CHARACTERISTIC K_ED_RLSLP.P_CODE_SH_TO_GND "P-Code fuer die Art SH_TO_GND | EN: Fault code RLSLP - OBD P-code reported for short to ground" VALUE 0x7146C TKW_VV_VV_UW 100.0 FORMULA_0010 0.0 65535.0000 /end CHARACTERISTIC
/begin CHARACTERISTIC K_ED_SLV.P_CODE_SH_TO_GND "P-Code fuer die Art SH_TO_GND | EN: Fault code SLV - OBD P-code reported for short to ground" VALUE 0x71486 TKW_VV_VV_UW 100.0 FORMULA_0010 0.0 65535.0000 /end CHARACTERISTIC
/begin CHARACTERISTIC K_ED_VAN_DSV.P_CODE_SH_TO_GND "P-Code fuer die Art SH_TO_GND | EN: Fault code VAN_DSV - OBD P-code reported for short to ground" VALUE 0x71556 TKW_VV_VV_UW 100.0 FORMULA_0010 0.0 65535.0000 /end CHARACTERISTIC
/begin CHARACTERISTIC K_ED_SK_MANAGER_INJ.P_CODE_SH_TO_GND "P-Code fuer die Art SH_TO_GND | EN: Fault code SK_MANAGER_INJ - OBD P-code reported for short to ground" VALUE 0x71674 TKW_VV_VV_UW 100.0 FORMULA_0010 0.0 65535.0000 /end CHARACTERISTIC
/begin CHARACTERISTIC K_ED_SSP_DIAG.P_CODE_SH_TO_GND "P-Code fuer die Art SH_TO_GND" VALUE 0x7168E TKW_VV_VV_UW 100.0 FORMULA_0010 0.0 65535.0000 /end CHARACTERISTIC
/begin CHARACTERISTIC K_ED_SG_INJ.P_CODE_SH_TO_GND "P-Code fuer die Art SH_TO_GND | EN: Fault code SG_INJ - OBD P-code reported for short to ground" VALUE 0x71778 TKW_VV_VV_UW 100.0 FORMULA_0010 0.0 65535.0000 /end CHARACTERISTIC
/begin CHARACTERISTIC K_ED_S_POEL_DIAG.P_CODE_SH_TO_GND "P-Code fuer die Art SH_TO_GND | EN: Fault code S_POEL_DIAG - OBD P-code reported for short to ground" VALUE 0x717C6 TKW_VV_VV_UW 100.0 FORMULA_0010 0.0 65535.0000 /end CHARACTERISTIC
/begin CHARACTERISTIC K_ED_TE_OBD_1.P_CODE_SH_TO_GND "P-Code fuer die Art SH_TO_GND | EN: Fault code TE_OBD_1 - OBD P-code reported for short to ground" VALUE 0x717E0 TKW_VV_VV_UW 100.0 FORMULA_0010 0.0 65535.0000 /end CHARACTERISTIC
/begin CHARACTERISTIC K_ED_TE_OBD_2.P_CODE_SH_TO_GND "P-Code fuer die Art SH_TO_GND | EN: Fault code TE_OBD_2 - OBD P-code reported for short to ground" VALUE 0x717FA TKW_VV_VV_UW 100.0 FORMULA_0010 0.0 65535.0000 /end CHARACTERISTIC
/begin CHARACTERISTIC K_ED_TEV1.P_CODE_SH_TO_GND "P-Code fuer die Art SH_TO_GND | EN: Fault code TEV1 - OBD P-code reported for short to ground" VALUE 0x71814 TKW_VV_VV_UW 100.0 FORMULA_0010 0.0 65535.0000 /end CHARACTERISTIC
/begin CHARACTERISTIC K_ED_TEV2.P_CODE_SH_TO_GND "P-Code fuer die Art SH_TO_GND | EN: Fault code TEV2 - OBD P-code reported for short to ground" VALUE 0x7182E TKW_VV_VV_UW 100.0 FORMULA_0010 0.0 65535.0000 /end CHARACTERISTIC
/begin CHARACTERISTIC K_ED_SLP.P_CODE_SH_TO_GND "P-Code fuer die Art SH_TO_GND | EN: Fault code SLP - OBD P-code reported for short to ground" VALUE 0x718FE TKW_VV_VV_UW 100.0 FORMULA_0010 0.0 65535.0000 /end CHARACTERISTIC
/begin CHARACTERISTIC K_ED_SL_DURCHS_B1.P_CODE_SH_TO_GND "P-Code fuer die Art SH_TO_GND | EN: Fault code SL_DURCHS_B1 - OBD P-code reported for short to ground" VALUE 0x71918 TKW_VV_VV_UW 100.0 FORMULA_0010 0.0 65535.0000 /end CHARACTERISTIC
/begin CHARACTERISTIC K_ED_SL_DURCHS_B2.P_CODE_SH_TO_GND "P-Code fuer die Art SH_TO_GND | EN: Fault code SL_DURCHS_B2 - OBD P-code reported for short to ground" VALUE 0x71932 TKW_VV_VV_UW 100.0 FORMULA_0010 0.0 65535.0000 /end CHARACTERISTIC
/begin CHARACTERISTIC K_ED_SL_DURCHS_HSTRANG.P_CODE_SH_TO_GND "P-Code fuer die Art SH_TO_GND | EN: Fault code SL_DURCHS_HSTRANG - OBD P-code reported for short to ground" VALUE 0x7194C TKW_VV_VV_UW 100.0 FORMULA_0010 0.0 65535.0000 /end CHARACTERISTIC
/begin CHARACTERISTIC K_ED_S_GETR_HS.P_CODE_SH_TO_GND "P-Code fuer die Art SH_TO_GND | EN: Fault code S_GETR_HS - OBD P-code reported for short to ground" VALUE 0x71980 TKW_VV_VV_UW 100.0 FORMULA_0010 0.0 65535.0000 /end CHARACTERISTIC
/begin CHARACTERISTIC K_ED_S_KUPP_HS.P_CODE_SH_TO_GND "P-Code fuer die Art SH_TO_GND | EN: Fault code S_KUPP_HS - OBD P-code reported for short to ground" VALUE 0x7199A TKW_VV_VV_UW 100.0 FORMULA_0010 0.0 65535.0000 /end CHARACTERISTIC
/begin CHARACTERISTIC K_ED_VAN_DRUCK.P_CODE_SH_TO_GND "P-Code fuer die Art SH_TO_GND | EN: Fault code VAN_DRUCK - OBD P-code reported for short to ground" VALUE 0x719B4 TKW_VV_VV_UW 100.0 FORMULA_0010 0.0 65535.0000 /end CHARACTERISTIC
/begin CHARACTERISTIC K_ED_TANK_LEER.P_CODE_SH_TO_GND "P-Code fuer die Art SH_TO_GND | EN: Fault code TANK_LEER - OBD P-code reported for short to ground" VALUE 0x71AD2 TKW_VV_VV_UW 100.0 FORMULA_0010 0.0 65535.0000 /end CHARACTERISTIC
/begin CHARACTERISTIC K_ED_PUMG_OBD.P_CODE_SH_TO_GND "P-Code fuer die Art SH_TO_GND | EN: Fault code PUMG_OBD - OBD P-code reported for short to ground" VALUE 0x71B20 TKW_VV_VV_UW 100.0 FORMULA_0010 0.0 65535.0000 /end CHARACTERISTIC
/begin CHARACTERISTIC K_ED_SL_ML_HFM_OBD.P_CODE_SH_TO_GND "P-Code fuer die Art SH_TO_GND | EN: Fault code SL_ML_HFM_OBD - OBD P-code reported for short to ground" VALUE 0x71B3A TKW_VV_VV_UW 100.0 FORMULA_0010 0.0 65535.0000 /end CHARACTERISTIC
/begin CHARACTERISTIC K_ED_TGETR_HS.P_CODE_SH_TO_GND "P-Code fuer die Art SH_TO_GND | EN: Fault code TGETR_HS - OBD P-code reported for short to ground" VALUE 0x71C72 TKW_VV_VV_UW 100.0 FORMULA_0010 0.0 65535.0000 /end CHARACTERISTIC
/begin CHARACTERISTIC K_ED_SK_TR_INJ.P_CODE_OPENLOAD "P-Code fuer die Art OPENLOAD | EN: P-Code fuer die Art OPENLOAD" VALUE 0x708DA TKW_VV_VV_UW 100.0 FORMULA_0010 0.0 65535.0000 /end CHARACTERISTIC
/begin CHARACTERISTIC K_ED_PUMG.P_CODE_OPENLOAD "P-Code fuer die Art OPENLOAD | EN: Fault code PUMG - OBD P-code reported for open circuit" VALUE 0x708F4 TKW_VV_VV_UW 100.0 FORMULA_0010 0.0 65535.0000 /end CHARACTERISTIC
/begin CHARACTERISTIC K_ED_VAN_HALL_E1.P_CODE_OPENLOAD "P-Code fuer die Art OPENLOAD | EN: Fault code VAN_HALL_E1 - OBD P-code reported for open circuit" VALUE 0x70976 TKW_VV_VV_UW 100.0 FORMULA_0010 0.0 65535.0000 /end CHARACTERISTIC
/begin CHARACTERISTIC K_ED_VAN_HALL_A1.P_CODE_OPENLOAD "P-Code fuer die Art OPENLOAD | EN: Fault code VAN_HALL_A1 - OBD P-code reported for open circuit" VALUE 0x70990 TKW_VV_VV_UW 100.0 FORMULA_0010 0.0 65535.0000 /end CHARACTERISTIC
/begin CHARACTERISTIC K_ED_VAN_HALL_E2.P_CODE_OPENLOAD "P-Code fuer die Art OPENLOAD | EN: Fault code VAN_HALL_E2 - OBD P-code reported for open circuit" VALUE 0x709AA TKW_VV_VV_UW 100.0 FORMULA_0010 0.0 65535.0000 /end CHARACTERISTIC
/begin CHARACTERISTIC K_ED_VAN_HALL_A2.P_CODE_OPENLOAD "P-Code fuer die Art OPENLOAD | EN: Fault code VAN_HALL_A2 - OBD P-code reported for open circuit" VALUE 0x709C4 TKW_VV_VV_UW 100.0 FORMULA_0010 0.0 65535.0000 /end CHARACTERISTIC
/begin CHARACTERISTIC K_ED_VAN_REGL_E1.P_CODE_OPENLOAD "P-Code fuer die Art OPENLOAD | EN: Fault code VAN_REGL_E1 - OBD P-code reported for open circuit" VALUE 0x709DE TKW_VV_VV_UW 100.0 FORMULA_0010 0.0 65535.0000 /end CHARACTERISTIC
/begin CHARACTERISTIC K_ED_VAN_REGL_A1.P_CODE_OPENLOAD "P-Code fuer die Art OPENLOAD | EN: Fault code VAN_REGL_A1 - OBD P-code reported for open circuit" VALUE 0x709F8 TKW_VV_VV_UW 100.0 FORMULA_0010 0.0 65535.0000 /end CHARACTERISTIC
/begin CHARACTERISTIC K_ED_VAN_REGL_E2.P_CODE_OPENLOAD "P-Code fuer die Art OPENLOAD | EN: Fault code VAN_REGL_E2 - OBD P-code reported for open circuit" VALUE 0x70A12 TKW_VV_VV_UW 100.0 FORMULA_0010 0.0 65535.0000 /end CHARACTERISTIC
/begin CHARACTERISTIC K_ED_VAN_REGL_A2.P_CODE_OPENLOAD "P-Code fuer die Art OPENLOAD | EN: Fault code VAN_REGL_A2 - OBD P-code reported for open circuit" VALUE 0x70A2C TKW_VV_VV_UW 100.0 FORMULA_0010 0.0 65535.0000 /end CHARACTERISTIC
/begin CHARACTERISTIC K_ED_PT_VRAD.P_CODE_OPENLOAD "P-Code fuer die Art OPENLOAD | EN: Fault code PT_VRAD - OBD P-code reported for open circuit" VALUE 0x70C34 TKW_VV_VV_UW 100.0 FORMULA_0010 0.0 65535.0000 /end CHARACTERISTIC
/begin CHARACTERISTIC K_ED_PT_VFZG.P_CODE_OPENLOAD "P-Code fuer die Art OPENLOAD | EN: Fault code PT_VFZG - OBD P-code reported for open circuit" VALUE 0x70C4E TKW_VV_VV_UW 100.0 FORMULA_0010 0.0 65535.0000 /end CHARACTERISTIC
/begin CHARACTERISTIC K_ED_SL_ML_HFM.P_CODE_OPENLOAD "P-Code fuer die Art OPENLOAD | EN: Fault code SL_ML_HFM - OBD P-code reported for open circuit" VALUE 0x70D04 TKW_VV_VV_UW 100.0 FORMULA_0010 0.0 65535.0000 /end CHARACTERISTIC
/begin CHARACTERISTIC K_ED_TZ1.P_CODE_OPENLOAD "P-Code fuer die Art OPENLOAD | EN: Fault code TZ1 - OBD P-code reported for open circuit" VALUE 0x70FA8 TKW_VV_VV_UW 100.0 FORMULA_0010 0.0 65535.0000 /end CHARACTERISTIC
/begin CHARACTERISTIC K_ED_TZ2.P_CODE_OPENLOAD "P-Code fuer die Art OPENLOAD | EN: Fault code TZ2 - OBD P-code reported for open circuit" VALUE 0x70FC2 TKW_VV_VV_UW 100.0 FORMULA_0010 0.0 65535.0000 /end CHARACTERISTIC
/begin CHARACTERISTIC K_ED_TZ3.P_CODE_OPENLOAD "P-Code fuer die Art OPENLOAD | EN: Fault code TZ3 - OBD P-code reported for open circuit" VALUE 0x70FDC TKW_VV_VV_UW 100.0 FORMULA_0010 0.0 65535.0000 /end CHARACTERISTIC
/begin CHARACTERISTIC K_ED_TZ4.P_CODE_OPENLOAD "P-Code fuer die Art OPENLOAD | EN: Fault code TZ4 - OBD P-code reported for open circuit" VALUE 0x70FF6 TKW_VV_VV_UW 100.0 FORMULA_0010 0.0 65535.0000 /end CHARACTERISTIC
/begin CHARACTERISTIC K_ED_TZ5.P_CODE_OPENLOAD "P-Code fuer die Art OPENLOAD | EN: Fault code TZ5 - OBD P-code reported for open circuit" VALUE 0x71010 TKW_VV_VV_UW 100.0 FORMULA_0010 0.0 65535.0000 /end CHARACTERISTIC
/begin CHARACTERISTIC K_ED_TZ6.P_CODE_OPENLOAD "P-Code fuer die Art OPENLOAD | EN: Fault code TZ6 - OBD P-code reported for open circuit" VALUE 0x7102A TKW_VV_VV_UW 100.0 FORMULA_0010 0.0 65535.0000 /end CHARACTERISTIC
/begin CHARACTERISTIC K_ED_TZ7.P_CODE_OPENLOAD "P-Code fuer die Art OPENLOAD | EN: Fault code TZ7 - OBD P-code reported for open circuit" VALUE 0x71044 TKW_VV_VV_UW 100.0 FORMULA_0010 0.0 65535.0000 /end CHARACTERISTIC
/begin CHARACTERISTIC K_ED_TZ8.P_CODE_OPENLOAD "P-Code fuer die Art OPENLOAD | EN: Fault code TZ8 - OBD P-code reported for open circuit" VALUE 0x7105E TKW_VV_VV_UW 100.0 FORMULA_0010 0.0 65535.0000 /end CHARACTERISTIC
/begin CHARACTERISTIC K_ED_TZ9.P_CODE_OPENLOAD "P-Code fuer die Art OPENLOAD | EN: Fault code TZ9 - OBD P-code reported for open circuit" VALUE 0x71078 TKW_VV_VV_UW 100.0 FORMULA_0010 0.0 65535.0000 /end CHARACTERISTIC
/begin CHARACTERISTIC K_ED_TZ10.P_CODE_OPENLOAD "P-Code fuer die Art OPENLOAD | EN: Fault code TZ10 - OBD P-code reported for open circuit" VALUE 0x71092 TKW_VV_VV_UW 100.0 FORMULA_0010 0.0 65535.0000 /end CHARACTERISTIC
/begin CHARACTERISTIC K_ED_VAN_ANSCHL_E1.P_CODE_OPENLOAD "P-Code fuer die Art OPENLOAD | EN: Fault code VAN_ANSCHL_E1 - OBD P-code reported for open circuit" VALUE 0x710E0 TKW_VV_VV_UW 100.0 FORMULA_0010 0.0 65535.0000 /end CHARACTERISTIC
/begin CHARACTERISTIC K_ED_VAN_ANSCHL_A1.P_CODE_OPENLOAD "P-Code fuer die Art OPENLOAD | EN: Fault code VAN_ANSCHL_A1 - OBD P-code reported for open circuit" VALUE 0x710FA TKW_VV_VV_UW 100.0 FORMULA_0010 0.0 65535.0000 /end CHARACTERISTIC
/begin CHARACTERISTIC K_ED_VAN_ANSCHL_E2.P_CODE_OPENLOAD "P-Code fuer die Art OPENLOAD | EN: Fault code VAN_ANSCHL_E2 - OBD P-code reported for open circuit" VALUE 0x71114 TKW_VV_VV_UW 100.0 FORMULA_0010 0.0 65535.0000 /end CHARACTERISTIC
/begin CHARACTERISTIC K_ED_VAN_ANSCHL_A2.P_CODE_OPENLOAD "P-Code fuer die Art OPENLOAD | EN: Fault code VAN_ANSCHL_A2 - OBD P-code reported for open circuit" VALUE 0x7112E TKW_VV_VV_UW 100.0 FORMULA_0010 0.0 65535.0000 /end CHARACTERISTIC
/begin CHARACTERISTIC K_ED_VAN_VENT_E1.P_CODE_OPENLOAD "P-Code fuer die Art OPENLOAD | EN: Fault code VAN_VENT_E1 - OBD P-code reported for open circuit" VALUE 0x71148 TKW_VV_VV_UW 100.0 FORMULA_0010 0.0 65535.0000 /end CHARACTERISTIC
/begin CHARACTERISTIC K_ED_VAN_VENT_A1.P_CODE_OPENLOAD "P-Code fuer die Art OPENLOAD | EN: Fault code VAN_VENT_A1 - OBD P-code reported for open circuit" VALUE 0x71162 TKW_VV_VV_UW 100.0 FORMULA_0010 0.0 65535.0000 /end CHARACTERISTIC
/begin CHARACTERISTIC K_ED_VAN_VENT_E2.P_CODE_OPENLOAD "P-Code fuer die Art OPENLOAD | EN: Fault code VAN_VENT_E2 - OBD P-code reported for open circuit" VALUE 0x7117C TKW_VV_VV_UW 100.0 FORMULA_0010 0.0 65535.0000 /end CHARACTERISTIC
/begin CHARACTERISTIC K_ED_VAN_VENT_A2.P_CODE_OPENLOAD "P-Code fuer die Art OPENLOAD | EN: Fault code VAN_VENT_A2 - OBD P-code reported for open circuit" VALUE 0x71196 TKW_VV_VV_UW 100.0 FORMULA_0010 0.0 65535.0000 /end CHARACTERISTIC
/begin CHARACTERISTIC K_ED_RLU87.P_CODE_OPENLOAD "P-Code fuer die Art OPENLOAD | EN: Fault code RLU87 - OBD P-code reported for open circuit" VALUE 0x71406 TKW_VV_VV_UW 100.0 FORMULA_0010 0.0 65535.0000 /end CHARACTERISTIC
/begin CHARACTERISTIC K_ED_SSP.P_CODE_OPENLOAD "P-Code fuer die Art OPENLOAD" VALUE 0x7143A TKW_VV_VV_UW 100.0 FORMULA_0010 0.0 65535.0000 /end CHARACTERISTIC
/begin CHARACTERISTIC K_ED_TD.P_CODE_OPENLOAD "P-Code fuer die Art OPENLOAD | EN: Fault code TD - OBD P-code reported for open circuit" VALUE 0x71454 TKW_VV_VV_UW 100.0 FORMULA_0010 0.0 65535.0000 /end CHARACTERISTIC
/begin CHARACTERISTIC K_ED_RLSLP.P_CODE_OPENLOAD "P-Code fuer die Art OPENLOAD | EN: Fault code RLSLP - OBD P-code reported for open circuit" VALUE 0x7146E TKW_VV_VV_UW 100.0 FORMULA_0010 0.0 65535.0000 /end CHARACTERISTIC
/begin CHARACTERISTIC K_ED_SLV.P_CODE_OPENLOAD "P-Code fuer die Art OPENLOAD | EN: Fault code SLV - OBD P-code reported for open circuit" VALUE 0x71488 TKW_VV_VV_UW 100.0 FORMULA_0010 0.0 65535.0000 /end CHARACTERISTIC
/begin CHARACTERISTIC K_ED_VAN_DSV.P_CODE_OPENLOAD "P-Code fuer die Art OPENLOAD | EN: Fault code VAN_DSV - OBD P-code reported for open circuit" VALUE 0x71558 TKW_VV_VV_UW 100.0 FORMULA_0010 0.0 65535.0000 /end CHARACTERISTIC
/begin CHARACTERISTIC K_ED_SK_MANAGER_INJ.P_CODE_OPENLOAD "P-Code fuer die Art OPENLOAD | EN: Fault code SK_MANAGER_INJ - OBD P-code reported for open circuit" VALUE 0x71676 TKW_VV_VV_UW 100.0 FORMULA_0010 0.0 65535.0000 /end CHARACTERISTIC
/begin CHARACTERISTIC K_ED_SSP_DIAG.P_CODE_OPENLOAD "P-Code fuer die Art OPENLOAD" VALUE 0x71690 TKW_VV_VV_UW 100.0 FORMULA_0010 0.0 65535.0000 /end CHARACTERISTIC
/begin CHARACTERISTIC K_ED_SG_INJ.P_CODE_OPENLOAD "P-Code fuer die Art OPENLOAD | EN: Fault code SG_INJ - OBD P-code reported for open circuit" VALUE 0x7177A TKW_VV_VV_UW 100.0 FORMULA_0010 0.0 65535.0000 /end CHARACTERISTIC
/begin CHARACTERISTIC K_ED_S_POEL_DIAG.P_CODE_OPENLOAD "P-Code fuer die Art OPENLOAD | EN: Fault code S_POEL_DIAG - OBD P-code reported for open circuit" VALUE 0x717C8 TKW_VV_VV_UW 100.0 FORMULA_0010 0.0 65535.0000 /end CHARACTERISTIC
/begin CHARACTERISTIC K_ED_TE_OBD_1.P_CODE_OPENLOAD "P-Code fuer die Art OPENLOAD | EN: Fault code TE_OBD_1 - OBD P-code reported for open circuit" VALUE 0x717E2 TKW_VV_VV_UW 100.0 FORMULA_0010 0.0 65535.0000 /end CHARACTERISTIC
/begin CHARACTERISTIC K_ED_TE_OBD_2.P_CODE_OPENLOAD "P-Code fuer die Art OPENLOAD | EN: Fault code TE_OBD_2 - OBD P-code reported for open circuit" VALUE 0x717FC TKW_VV_VV_UW 100.0 FORMULA_0010 0.0 65535.0000 /end CHARACTERISTIC
/begin CHARACTERISTIC K_ED_TEV1.P_CODE_OPENLOAD "P-Code fuer die Art OPENLOAD | EN: Fault code TEV1 - OBD P-code reported for open circuit" VALUE 0x71816 TKW_VV_VV_UW 100.0 FORMULA_0010 0.0 65535.0000 /end CHARACTERISTIC
/begin CHARACTERISTIC K_ED_TEV2.P_CODE_OPENLOAD "P-Code fuer die Art OPENLOAD | EN: Fault code TEV2 - OBD P-code reported for open circuit" VALUE 0x71830 TKW_VV_VV_UW 100.0 FORMULA_0010 0.0 65535.0000 /end CHARACTERISTIC
/begin CHARACTERISTIC K_ED_SLP.P_CODE_OPENLOAD "P-Code fuer die Art OPENLOAD | EN: Fault code SLP - OBD P-code reported for open circuit" VALUE 0x71900 TKW_VV_VV_UW 100.0 FORMULA_0010 0.0 65535.0000 /end CHARACTERISTIC
/begin CHARACTERISTIC K_ED_SL_DURCHS_B1.P_CODE_OPENLOAD "P-Code fuer die Art OPENLOAD | EN: Fault code SL_DURCHS_B1 - OBD P-code reported for open circuit" VALUE 0x7191A TKW_VV_VV_UW 100.0 FORMULA_0010 0.0 65535.0000 /end CHARACTERISTIC
/begin CHARACTERISTIC K_ED_SL_DURCHS_B2.P_CODE_OPENLOAD "P-Code fuer die Art OPENLOAD | EN: Fault code SL_DURCHS_B2 - OBD P-code reported for open circuit" VALUE 0x71934 TKW_VV_VV_UW 100.0 FORMULA_0010 0.0 65535.0000 /end CHARACTERISTIC
/begin CHARACTERISTIC K_ED_SL_DURCHS_HSTRANG.P_CODE_OPENLOAD "P-Code fuer die Art OPENLOAD | EN: Fault code SL_DURCHS_HSTRANG - OBD P-code reported for open circuit" VALUE 0x7194E TKW_VV_VV_UW 100.0 FORMULA_0010 0.0 65535.0000 /end CHARACTERISTIC
/begin CHARACTERISTIC K_ED_S_GETR_HS.P_CODE_OPENLOAD "P-Code fuer die Art OPENLOAD | EN: Fault code S_GETR_HS - OBD P-code reported for open circuit" VALUE 0x71982 TKW_VV_VV_UW 100.0 FORMULA_0010 0.0 65535.0000 /end CHARACTERISTIC
/begin CHARACTERISTIC K_ED_S_KUPP_HS.P_CODE_OPENLOAD "P-Code fuer die Art OPENLOAD | EN: Fault code S_KUPP_HS - OBD P-code reported for open circuit" VALUE 0x7199C TKW_VV_VV_UW 100.0 FORMULA_0010 0.0 65535.0000 /end CHARACTERISTIC
/begin CHARACTERISTIC K_ED_VAN_DRUCK.P_CODE_OPENLOAD "P-Code fuer die Art OPENLOAD | EN: Fault code VAN_DRUCK - OBD P-code reported for open circuit" VALUE 0x719B6 TKW_VV_VV_UW 100.0 FORMULA_0010 0.0 65535.0000 /end CHARACTERISTIC
/begin CHARACTERISTIC K_ED_TANK_LEER.P_CODE_OPENLOAD "P-Code fuer die Art OPENLOAD | EN: Fault code TANK_LEER - OBD P-code reported for open circuit" VALUE 0x71AD4 TKW_VV_VV_UW 100.0 FORMULA_0010 0.0 65535.0000 /end CHARACTERISTIC
/begin CHARACTERISTIC K_ED_PUMG_OBD.P_CODE_OPENLOAD "P-Code fuer die Art OPENLOAD | EN: Fault code PUMG_OBD - OBD P-code reported for open circuit" VALUE 0x71B22 TKW_VV_VV_UW 100.0 FORMULA_0010 0.0 65535.0000 /end CHARACTERISTIC
/begin CHARACTERISTIC K_ED_SL_ML_HFM_OBD.P_CODE_OPENLOAD "P-Code fuer die Art OPENLOAD | EN: Fault code SL_ML_HFM_OBD - OBD P-code reported for open circuit" VALUE 0x71B3C TKW_VV_VV_UW 100.0 FORMULA_0010 0.0 65535.0000 /end CHARACTERISTIC
/begin CHARACTERISTIC K_ED_TGETR_HS.P_CODE_OPENLOAD "P-Code fuer die Art OPENLOAD | EN: Fault code TGETR_HS - OBD P-code reported for open circuit" VALUE 0x71C74 TKW_VV_VV_UW 100.0 FORMULA_0010 0.0 65535.0000 /end CHARACTERISTIC
/begin CHARACTERISTIC K_ED_SK_TR_INJ.P_CODE_UNPLAUSIBEL "P-Code fuer die Art UNPLAUSIBEL | EN: P-Code fuer die Art UNPLAUSIBEL" VALUE 0x708DC TKW_VV_VV_UW 100.0 FORMULA_0010 0.0 65535.0000 /end CHARACTERISTIC
/begin CHARACTERISTIC K_ED_PUMG.P_CODE_UNPLAUSIBEL "P-Code fuer die Art UNPLAUSIBEL | EN: Fault code PUMG - OBD P-code reported for implausible signal" VALUE 0x708F6 TKW_VV_VV_UW 100.0 FORMULA_0010 0.0 65535.0000 /end CHARACTERISTIC
/begin CHARACTERISTIC K_ED_VAN_HALL_E1.P_CODE_UNPLAUSIBEL "P-Code fuer die Art UNPLAUSIBEL | EN: Fault code VAN_HALL_E1 - OBD P-code reported for implausible signal" VALUE 0x70978 TKW_VV_VV_UW 100.0 FORMULA_0010 0.0 65535.0000 /end CHARACTERISTIC
/begin CHARACTERISTIC K_ED_VAN_HALL_A1.P_CODE_UNPLAUSIBEL "P-Code fuer die Art UNPLAUSIBEL | EN: Fault code VAN_HALL_A1 - OBD P-code reported for implausible signal" VALUE 0x70992 TKW_VV_VV_UW 100.0 FORMULA_0010 0.0 65535.0000 /end CHARACTERISTIC
/begin CHARACTERISTIC K_ED_VAN_HALL_E2.P_CODE_UNPLAUSIBEL "P-Code fuer die Art UNPLAUSIBEL | EN: Fault code VAN_HALL_E2 - OBD P-code reported for implausible signal" VALUE 0x709AC TKW_VV_VV_UW 100.0 FORMULA_0010 0.0 65535.0000 /end CHARACTERISTIC
/begin CHARACTERISTIC K_ED_VAN_HALL_A2.P_CODE_UNPLAUSIBEL "P-Code fuer die Art UNPLAUSIBEL | EN: Fault code VAN_HALL_A2 - OBD P-code reported for implausible signal" VALUE 0x709C6 TKW_VV_VV_UW 100.0 FORMULA_0010 0.0 65535.0000 /end CHARACTERISTIC
/begin CHARACTERISTIC K_ED_VAN_REGL_E1.P_CODE_UNPLAUSIBEL "P-Code fuer die Art UNPLAUSIBEL | EN: Fault code VAN_REGL_E1 - OBD P-code reported for implausible signal" VALUE 0x709E0 TKW_VV_VV_UW 100.0 FORMULA_0010 0.0 65535.0000 /end CHARACTERISTIC
/begin CHARACTERISTIC K_ED_VAN_REGL_A1.P_CODE_UNPLAUSIBEL "P-Code fuer die Art UNPLAUSIBEL | EN: Fault code VAN_REGL_A1 - OBD P-code reported for implausible signal" VALUE 0x709FA TKW_VV_VV_UW 100.0 FORMULA_0010 0.0 65535.0000 /end CHARACTERISTIC
/begin CHARACTERISTIC K_ED_VAN_REGL_E2.P_CODE_UNPLAUSIBEL "P-Code fuer die Art UNPLAUSIBEL | EN: Fault code VAN_REGL_E2 - OBD P-code reported for implausible signal" VALUE 0x70A14 TKW_VV_VV_UW 100.0 FORMULA_0010 0.0 65535.0000 /end CHARACTERISTIC
/begin CHARACTERISTIC K_ED_VAN_REGL_A2.P_CODE_UNPLAUSIBEL "P-Code fuer die Art UNPLAUSIBEL | EN: Fault code VAN_REGL_A2 - OBD P-code reported for implausible signal" VALUE 0x70A2E TKW_VV_VV_UW 100.0 FORMULA_0010 0.0 65535.0000 /end CHARACTERISTIC
/begin CHARACTERISTIC K_ED_PT_VRAD.P_CODE_UNPLAUSIBEL "P-Code fuer die Art UNPLAUSIBEL | EN: Fault code PT_VRAD - OBD P-code reported for implausible signal" VALUE 0x70C36 TKW_VV_VV_UW 100.0 FORMULA_0010 0.0 65535.0000 /end CHARACTERISTIC
/begin CHARACTERISTIC K_ED_PT_VFZG.P_CODE_UNPLAUSIBEL "P-Code fuer die Art UNPLAUSIBEL | EN: Fault code PT_VFZG - OBD P-code reported for implausible signal" VALUE 0x70C50 TKW_VV_VV_UW 100.0 FORMULA_0010 0.0 65535.0000 /end CHARACTERISTIC
/begin CHARACTERISTIC K_ED_SL_ML_HFM.P_CODE_UNPLAUSIBEL "P-Code fuer die Art UNPLAUSIBEL | EN: Fault code SL_ML_HFM - OBD P-code reported for implausible signal" VALUE 0x70D06 TKW_VV_VV_UW 100.0 FORMULA_0010 0.0 65535.0000 /end CHARACTERISTIC
/begin CHARACTERISTIC K_ED_TZ1.P_CODE_UNPLAUSIBEL "P-Code fuer die Art UNPLAUSIBEL | EN: Fault code TZ1 - OBD P-code reported for implausible signal" VALUE 0x70FAA TKW_VV_VV_UW 100.0 FORMULA_0010 0.0 65535.0000 /end CHARACTERISTIC
/begin CHARACTERISTIC K_ED_TZ2.P_CODE_UNPLAUSIBEL "P-Code fuer die Art UNPLAUSIBEL | EN: Fault code TZ2 - OBD P-code reported for implausible signal" VALUE 0x70FC4 TKW_VV_VV_UW 100.0 FORMULA_0010 0.0 65535.0000 /end CHARACTERISTIC
/begin CHARACTERISTIC K_ED_TZ3.P_CODE_UNPLAUSIBEL "P-Code fuer die Art UNPLAUSIBEL | EN: Fault code TZ3 - OBD P-code reported for implausible signal" VALUE 0x70FDE TKW_VV_VV_UW 100.0 FORMULA_0010 0.0 65535.0000 /end CHARACTERISTIC
/begin CHARACTERISTIC K_ED_TZ4.P_CODE_UNPLAUSIBEL "P-Code fuer die Art UNPLAUSIBEL | EN: Fault code TZ4 - OBD P-code reported for implausible signal" VALUE 0x70FF8 TKW_VV_VV_UW 100.0 FORMULA_0010 0.0 65535.0000 /end CHARACTERISTIC
/begin CHARACTERISTIC K_ED_TZ5.P_CODE_UNPLAUSIBEL "P-Code fuer die Art UNPLAUSIBEL | EN: Fault code TZ5 - OBD P-code reported for implausible signal" VALUE 0x71012 TKW_VV_VV_UW 100.0 FORMULA_0010 0.0 65535.0000 /end CHARACTERISTIC
/begin CHARACTERISTIC K_ED_TZ6.P_CODE_UNPLAUSIBEL "P-Code fuer die Art UNPLAUSIBEL | EN: Fault code TZ6 - OBD P-code reported for implausible signal" VALUE 0x7102C TKW_VV_VV_UW 100.0 FORMULA_0010 0.0 65535.0000 /end CHARACTERISTIC
/begin CHARACTERISTIC K_ED_TZ7.P_CODE_UNPLAUSIBEL "P-Code fuer die Art UNPLAUSIBEL | EN: Fault code TZ7 - OBD P-code reported for implausible signal" VALUE 0x71046 TKW_VV_VV_UW 100.0 FORMULA_0010 0.0 65535.0000 /end CHARACTERISTIC
/begin CHARACTERISTIC K_ED_TZ8.P_CODE_UNPLAUSIBEL "P-Code fuer die Art UNPLAUSIBEL | EN: Fault code TZ8 - OBD P-code reported for implausible signal" VALUE 0x71060 TKW_VV_VV_UW 100.0 FORMULA_0010 0.0 65535.0000 /end CHARACTERISTIC
/begin CHARACTERISTIC K_ED_TZ9.P_CODE_UNPLAUSIBEL "P-Code fuer die Art UNPLAUSIBEL | EN: Fault code TZ9 - OBD P-code reported for implausible signal" VALUE 0x7107A TKW_VV_VV_UW 100.0 FORMULA_0010 0.0 65535.0000 /end CHARACTERISTIC
/begin CHARACTERISTIC K_ED_TZ10.P_CODE_UNPLAUSIBEL "P-Code fuer die Art UNPLAUSIBEL | EN: Fault code TZ10 - OBD P-code reported for implausible signal" VALUE 0x71094 TKW_VV_VV_UW 100.0 FORMULA_0010 0.0 65535.0000 /end CHARACTERISTIC
/begin CHARACTERISTIC K_ED_VAN_ANSCHL_E1.P_CODE_UNPLAUSIBEL "P-Code fuer die Art UNPLAUSIBEL | EN: Fault code VAN_ANSCHL_E1 - OBD P-code reported for implausible signal" VALUE 0x710E2 TKW_VV_VV_UW 100.0 FORMULA_0010 0.0 65535.0000 /end CHARACTERISTIC
/begin CHARACTERISTIC K_ED_VAN_ANSCHL_A1.P_CODE_UNPLAUSIBEL "P-Code fuer die Art UNPLAUSIBEL | EN: Fault code VAN_ANSCHL_A1 - OBD P-code reported for implausible signal" VALUE 0x710FC TKW_VV_VV_UW 100.0 FORMULA_0010 0.0 65535.0000 /end CHARACTERISTIC
/begin CHARACTERISTIC K_ED_VAN_ANSCHL_E2.P_CODE_UNPLAUSIBEL "P-Code fuer die Art UNPLAUSIBEL | EN: Fault code VAN_ANSCHL_E2 - OBD P-code reported for implausible signal" VALUE 0x71116 TKW_VV_VV_UW 100.0 FORMULA_0010 0.0 65535.0000 /end CHARACTERISTIC
/begin CHARACTERISTIC K_ED_VAN_ANSCHL_A2.P_CODE_UNPLAUSIBEL "P-Code fuer die Art UNPLAUSIBEL | EN: Fault code VAN_ANSCHL_A2 - OBD P-code reported for implausible signal" VALUE 0x71130 TKW_VV_VV_UW 100.0 FORMULA_0010 0.0 65535.0000 /end CHARACTERISTIC
/begin CHARACTERISTIC K_ED_VAN_VENT_E1.P_CODE_UNPLAUSIBEL "P-Code fuer die Art UNPLAUSIBEL | EN: Fault code VAN_VENT_E1 - OBD P-code reported for implausible signal" VALUE 0x7114A TKW_VV_VV_UW 100.0 FORMULA_0010 0.0 65535.0000 /end CHARACTERISTIC
/begin CHARACTERISTIC K_ED_VAN_VENT_A1.P_CODE_UNPLAUSIBEL "P-Code fuer die Art UNPLAUSIBEL | EN: Fault code VAN_VENT_A1 - OBD P-code reported for implausible signal" VALUE 0x71164 TKW_VV_VV_UW 100.0 FORMULA_0010 0.0 65535.0000 /end CHARACTERISTIC
/begin CHARACTERISTIC K_ED_VAN_VENT_E2.P_CODE_UNPLAUSIBEL "P-Code fuer die Art UNPLAUSIBEL | EN: Fault code VAN_VENT_E2 - OBD P-code reported for implausible signal" VALUE 0x7117E TKW_VV_VV_UW 100.0 FORMULA_0010 0.0 65535.0000 /end CHARACTERISTIC
/begin CHARACTERISTIC K_ED_VAN_VENT_A2.P_CODE_UNPLAUSIBEL "P-Code fuer die Art UNPLAUSIBEL | EN: Fault code VAN_VENT_A2 - OBD P-code reported for implausible signal" VALUE 0x71198 TKW_VV_VV_UW 100.0 FORMULA_0010 0.0 65535.0000 /end CHARACTERISTIC
/begin CHARACTERISTIC K_ED_PT_VEHMOD.P_CODE_UNPLAUSIBEL "P-Code fuer die Art UNPLAUSIBEL | EN: Fault code PT_VEHMOD - OBD P-code reported for implausible signal" VALUE 0x71304 TKW_VV_VV_UW 100.0 FORMULA_0010 0.0 65535.0000 /end CHARACTERISTIC
/begin CHARACTERISTIC K_ED_RLU87.P_CODE_UNPLAUSIBEL "P-Code fuer die Art UNPLAUSIBEL | EN: Fault code RLU87 - OBD P-code reported for implausible signal" VALUE 0x71408 TKW_VV_VV_UW 100.0 FORMULA_0010 0.0 65535.0000 /end CHARACTERISTIC
/begin CHARACTERISTIC K_ED_SSP.P_CODE_UNPLAUSIBEL "P-Code fuer die Art UNPLAUSIBEL" VALUE 0x7143C TKW_VV_VV_UW 100.0 FORMULA_0010 0.0 65535.0000 /end CHARACTERISTIC
/begin CHARACTERISTIC K_ED_TD.P_CODE_UNPLAUSIBEL "P-Code fuer die Art UNPLAUSIBEL | EN: Fault code TD - OBD P-code reported for implausible signal" VALUE 0x71456 TKW_VV_VV_UW 100.0 FORMULA_0010 0.0 65535.0000 /end CHARACTERISTIC
/begin CHARACTERISTIC K_ED_RLSLP.P_CODE_UNPLAUSIBEL "P-Code fuer die Art UNPLAUSIBEL | EN: Fault code RLSLP - OBD P-code reported for implausible signal" VALUE 0x71470 TKW_VV_VV_UW 100.0 FORMULA_0010 0.0 65535.0000 /end CHARACTERISTIC
/begin CHARACTERISTIC K_ED_SLV.P_CODE_UNPLAUSIBEL "P-Code fuer die Art UNPLAUSIBEL | EN: Fault code SLV - OBD P-code reported for implausible signal" VALUE 0x7148A TKW_VV_VV_UW 100.0 FORMULA_0010 0.0 65535.0000 /end CHARACTERISTIC
/begin CHARACTERISTIC K_ED_VAN_DSV.P_CODE_UNPLAUSIBEL "P-Code fuer die Art UNPLAUSIBEL | EN: Fault code VAN_DSV - OBD P-code reported for implausible signal" VALUE 0x7155A TKW_VV_VV_UW 100.0 FORMULA_0010 0.0 65535.0000 /end CHARACTERISTIC
/begin CHARACTERISTIC K_ED_SK_MANAGER_INJ.P_CODE_UNPLAUSIBEL "P-Code fuer die Art UNPLAUSIBEL | EN: Fault code SK_MANAGER_INJ - OBD P-code reported for implausible signal" VALUE 0x71678 TKW_VV_VV_UW 100.0 FORMULA_0010 0.0 65535.0000 /end CHARACTERISTIC
/begin CHARACTERISTIC K_ED_SSP_DIAG.P_CODE_UNPLAUSIBEL "P-Code fuer die Art UNPLAUSIBEL" VALUE 0x71692 TKW_VV_VV_UW 100.0 FORMULA_0010 0.0 65535.0000 /end CHARACTERISTIC
/begin CHARACTERISTIC K_ED_SG_INJ.P_CODE_UNPLAUSIBEL "P-Code fuer die Art UNPLAUSIBEL | EN: Fault code SG_INJ - OBD P-code reported for implausible signal" VALUE 0x7177C TKW_VV_VV_UW 100.0 FORMULA_0010 0.0 65535.0000 /end CHARACTERISTIC
/begin CHARACTERISTIC K_ED_S_POEL_DIAG.P_CODE_UNPLAUSIBEL "P-Code fuer die Art UNPLAUSIBEL | EN: Fault code S_POEL_DIAG - OBD P-code reported for implausible signal" VALUE 0x717CA TKW_VV_VV_UW 100.0 FORMULA_0010 0.0 65535.0000 /end CHARACTERISTIC
/begin CHARACTERISTIC K_ED_TE_OBD_1.P_CODE_UNPLAUSIBEL "P-Code fuer die Art UNPLAUSIBEL | EN: Fault code TE_OBD_1 - OBD P-code reported for implausible signal" VALUE 0x717E4 TKW_VV_VV_UW 100.0 FORMULA_0010 0.0 65535.0000 /end CHARACTERISTIC
/begin CHARACTERISTIC K_ED_TE_OBD_2.P_CODE_UNPLAUSIBEL "P-Code fuer die Art UNPLAUSIBEL | EN: Fault code TE_OBD_2 - OBD P-code reported for implausible signal" VALUE 0x717FE TKW_VV_VV_UW 100.0 FORMULA_0010 0.0 65535.0000 /end CHARACTERISTIC
/begin CHARACTERISTIC K_ED_TEV1.P_CODE_UNPLAUSIBEL "P-Code fuer die Art UNPLAUSIBEL | EN: Fault code TEV1 - OBD P-code reported for implausible signal" VALUE 0x71818 TKW_VV_VV_UW 100.0 FORMULA_0010 0.0 65535.0000 /end CHARACTERISTIC
/begin CHARACTERISTIC K_ED_TEV2.P_CODE_UNPLAUSIBEL "P-Code fuer die Art UNPLAUSIBEL | EN: Fault code TEV2 - OBD P-code reported for implausible signal" VALUE 0x71832 TKW_VV_VV_UW 100.0 FORMULA_0010 0.0 65535.0000 /end CHARACTERISTIC
/begin CHARACTERISTIC K_ED_SLP.P_CODE_UNPLAUSIBEL "P-Code fuer die Art UNPLAUSIBEL | EN: Fault code SLP - OBD P-code reported for implausible signal" VALUE 0x71902 TKW_VV_VV_UW 100.0 FORMULA_0010 0.0 65535.0000 /end CHARACTERISTIC
/begin CHARACTERISTIC K_ED_SL_DURCHS_B1.P_CODE_UNPLAUSIBEL "P-Code fuer die Art UNPLAUSIBEL | EN: Fault code SL_DURCHS_B1 - OBD P-code reported for implausible signal" VALUE 0x7191C TKW_VV_VV_UW 100.0 FORMULA_0010 0.0 65535.0000 /end CHARACTERISTIC
/begin CHARACTERISTIC K_ED_SL_DURCHS_B2.P_CODE_UNPLAUSIBEL "P-Code fuer die Art UNPLAUSIBEL | EN: Fault code SL_DURCHS_B2 - OBD P-code reported for implausible signal" VALUE 0x71936 TKW_VV_VV_UW 100.0 FORMULA_0010 0.0 65535.0000 /end CHARACTERISTIC
/begin CHARACTERISTIC K_ED_SL_DURCHS_HSTRANG.P_CODE_UNPLAUSIBEL "P-Code fuer die Art UNPLAUSIBEL | EN: Fault code SL_DURCHS_HSTRANG - OBD P-code reported for implausible signal" VALUE 0x71950 TKW_VV_VV_UW 100.0 FORMULA_0010 0.0 65535.0000 /end CHARACTERISTIC
/begin CHARACTERISTIC K_ED_S_GETR_HS.P_CODE_UNPLAUSIBEL "P-Code fuer die Art UNPLAUSIBEL | EN: Fault code S_GETR_HS - OBD P-code reported for implausible signal" VALUE 0x71984 TKW_VV_VV_UW 100.0 FORMULA_0010 0.0 65535.0000 /end CHARACTERISTIC
/begin CHARACTERISTIC K_ED_S_KUPP_HS.P_CODE_UNPLAUSIBEL "P-Code fuer die Art UNPLAUSIBEL | EN: Fault code S_KUPP_HS - OBD P-code reported for implausible signal" VALUE 0x7199E TKW_VV_VV_UW 100.0 FORMULA_0010 0.0 65535.0000 /end CHARACTERISTIC
/begin CHARACTERISTIC K_ED_VAN_DRUCK.P_CODE_UNPLAUSIBEL "P-Code fuer die Art UNPLAUSIBEL | EN: Fault code VAN_DRUCK - OBD P-code reported for implausible signal" VALUE 0x719B8 TKW_VV_VV_UW 100.0 FORMULA_0010 0.0 65535.0000 /end CHARACTERISTIC
/begin CHARACTERISTIC K_ED_TANK_LEER.P_CODE_UNPLAUSIBEL "P-Code fuer die Art UNPLAUSIBEL | EN: Fault code TANK_LEER - OBD P-code reported for implausible signal" VALUE 0x71AD6 TKW_VV_VV_UW 100.0 FORMULA_0010 0.0 65535.0000 /end CHARACTERISTIC
/begin CHARACTERISTIC K_ED_PUMG_OBD.P_CODE_UNPLAUSIBEL "P-Code fuer die Art UNPLAUSIBEL | EN: Fault code PUMG_OBD - OBD P-code reported for implausible signal" VALUE 0x71B24 TKW_VV_VV_UW 100.0 FORMULA_0010 0.0 65535.0000 /end CHARACTERISTIC
/begin CHARACTERISTIC K_ED_SL_ML_HFM_OBD.P_CODE_UNPLAUSIBEL "P-Code fuer die Art UNPLAUSIBEL | EN: Fault code SL_ML_HFM_OBD - OBD P-code reported for implausible signal" VALUE 0x71B3E TKW_VV_VV_UW 100.0 FORMULA_0010 0.0 65535.0000 /end CHARACTERISTIC
/begin CHARACTERISTIC K_ED_TGETR_HS.P_CODE_UNPLAUSIBEL "P-Code fuer die Art UNPLAUSIBEL | EN: Fault code TGETR_HS - OBD P-code reported for implausible signal" VALUE 0x71C76 TKW_VV_VV_UW 100.0 FORMULA_0010 0.0 65535.0000 /end CHARACTERISTIC
/begin CHARACTERISTIC K_ED_SK_TR_INJ.FEHLERSCHWELLE "Filterschwelle fuer Fehlereintrag | EN: Filterschwelle fuer Fehlereintrag" VALUE 0x708DE TKW_VV_VV_UB 100.0 FORMULA_0003 0.0 255.0000 /end CHARACTERISTIC
/begin CHARACTERISTIC K_ED_PUMG.FEHLERSCHWELLE "Filterschwelle fuer Fehlereintrag | EN: Fault code PUMG - debounce filter threshold for setting the fault" VALUE 0x708F8 TKW_VV_VV_UB 100.0 FORMULA_0003 0.0 255.0000 /end CHARACTERISTIC
/begin CHARACTERISTIC K_ED_VAN_HALL_E1.FEHLERSCHWELLE "Filterschwelle fuer Fehlereintrag | EN: Fault code VAN_HALL_E1 - debounce filter threshold for setting the fault" VALUE 0x7097A TKW_VV_VV_UB 100.0 FORMULA_0003 0.0 255.0000 /end CHARACTERISTIC
/begin CHARACTERISTIC K_ED_VAN_HALL_A1.FEHLERSCHWELLE "Filterschwelle fuer Fehlereintrag | EN: Fault code VAN_HALL_A1 - debounce filter threshold for setting the fault" VALUE 0x70994 TKW_VV_VV_UB 100.0 FORMULA_0003 0.0 255.0000 /end CHARACTERISTIC
/begin CHARACTERISTIC K_ED_VAN_HALL_E2.FEHLERSCHWELLE "Filterschwelle fuer Fehlereintrag | EN: Fault code VAN_HALL_E2 - debounce filter threshold for setting the fault" VALUE 0x709AE TKW_VV_VV_UB 100.0 FORMULA_0003 0.0 255.0000 /end CHARACTERISTIC
/begin CHARACTERISTIC K_ED_VAN_HALL_A2.FEHLERSCHWELLE "Filterschwelle fuer Fehlereintrag | EN: Fault code VAN_HALL_A2 - debounce filter threshold for setting the fault" VALUE 0x709C8 TKW_VV_VV_UB 100.0 FORMULA_0003 0.0 255.0000 /end CHARACTERISTIC
/begin CHARACTERISTIC K_ED_VAN_REGL_E1.FEHLERSCHWELLE "Filterschwelle fuer Fehlereintrag | EN: Fault code VAN_REGL_E1 - debounce filter threshold for setting the fault" VALUE 0x709E2 TKW_VV_VV_UB 100.0 FORMULA_0003 0.0 255.0000 /end CHARACTERISTIC
/begin CHARACTERISTIC K_ED_VAN_REGL_A1.FEHLERSCHWELLE "Filterschwelle fuer Fehlereintrag | EN: Fault code VAN_REGL_A1 - debounce filter threshold for setting the fault" VALUE 0x709FC TKW_VV_VV_UB 100.0 FORMULA_0003 0.0 255.0000 /end CHARACTERISTIC
/begin CHARACTERISTIC K_ED_VAN_REGL_E2.FEHLERSCHWELLE "Filterschwelle fuer Fehlereintrag | EN: Fault code VAN_REGL_E2 - debounce filter threshold for setting the fault" VALUE 0x70A16 TKW_VV_VV_UB 100.0 FORMULA_0003 0.0 255.0000 /end CHARACTERISTIC
/begin CHARACTERISTIC K_ED_VAN_REGL_A2.FEHLERSCHWELLE "Filterschwelle fuer Fehlereintrag | EN: Fault code VAN_REGL_A2 - debounce filter threshold for setting the fault" VALUE 0x70A30 TKW_VV_VV_UB 100.0 FORMULA_0003 0.0 255.0000 /end CHARACTERISTIC
/begin CHARACTERISTIC K_ED_PT_VRAD.FEHLERSCHWELLE "Filterschwelle fuer Fehlereintrag | EN: Fault code PT_VRAD - debounce filter threshold for setting the fault" VALUE 0x70C38 TKW_VV_VV_UB 100.0 FORMULA_0003 0.0 255.0000 /end CHARACTERISTIC
/begin CHARACTERISTIC K_ED_PT_VFZG.FEHLERSCHWELLE "Filterschwelle fuer Fehlereintrag | EN: Fault code PT_VFZG - debounce filter threshold for setting the fault" VALUE 0x70C52 TKW_VV_VV_UB 100.0 FORMULA_0003 0.0 255.0000 /end CHARACTERISTIC
/begin CHARACTERISTIC K_ED_SL_ML_HFM.FEHLERSCHWELLE "Filterschwelle fuer Fehlereintrag | EN: Fault code SL_ML_HFM - debounce filter threshold for setting the fault" VALUE 0x70D08 TKW_VV_VV_UB 100.0 FORMULA_0003 0.0 255.0000 /end CHARACTERISTIC
/begin CHARACTERISTIC K_ED_TZ1.FEHLERSCHWELLE "Filterschwelle fuer Fehlereintrag | EN: Fault code TZ1 - debounce filter threshold for setting the fault" VALUE 0x70FAC TKW_VV_VV_UB 100.0 FORMULA_0003 0.0 255.0000 /end CHARACTERISTIC
/begin CHARACTERISTIC K_ED_TZ2.FEHLERSCHWELLE "Filterschwelle fuer Fehlereintrag | EN: Fault code TZ2 - debounce filter threshold for setting the fault" VALUE 0x70FC6 TKW_VV_VV_UB 100.0 FORMULA_0003 0.0 255.0000 /end CHARACTERISTIC
/begin CHARACTERISTIC K_ED_TZ3.FEHLERSCHWELLE "Filterschwelle fuer Fehlereintrag | EN: Fault code TZ3 - debounce filter threshold for setting the fault" VALUE 0x70FE0 TKW_VV_VV_UB 100.0 FORMULA_0003 0.0 255.0000 /end CHARACTERISTIC
/begin CHARACTERISTIC K_ED_TZ4.FEHLERSCHWELLE "Filterschwelle fuer Fehlereintrag | EN: Fault code TZ4 - debounce filter threshold for setting the fault" VALUE 0x70FFA TKW_VV_VV_UB 100.0 FORMULA_0003 0.0 255.0000 /end CHARACTERISTIC
/begin CHARACTERISTIC K_ED_TZ5.FEHLERSCHWELLE "Filterschwelle fuer Fehlereintrag | EN: Fault code TZ5 - debounce filter threshold for setting the fault" VALUE 0x71014 TKW_VV_VV_UB 100.0 FORMULA_0003 0.0 255.0000 /end CHARACTERISTIC
/begin CHARACTERISTIC K_ED_TZ6.FEHLERSCHWELLE "Filterschwelle fuer Fehlereintrag | EN: Fault code TZ6 - debounce filter threshold for setting the fault" VALUE 0x7102E TKW_VV_VV_UB 100.0 FORMULA_0003 0.0 255.0000 /end CHARACTERISTIC
/begin CHARACTERISTIC K_ED_TZ7.FEHLERSCHWELLE "Filterschwelle fuer Fehlereintrag | EN: Fault code TZ7 - debounce filter threshold for setting the fault" VALUE 0x71048 TKW_VV_VV_UB 100.0 FORMULA_0003 0.0 255.0000 /end CHARACTERISTIC
/begin CHARACTERISTIC K_ED_TZ8.FEHLERSCHWELLE "Filterschwelle fuer Fehlereintrag | EN: Fault code TZ8 - debounce filter threshold for setting the fault" VALUE 0x71062 TKW_VV_VV_UB 100.0 FORMULA_0003 0.0 255.0000 /end CHARACTERISTIC
/begin CHARACTERISTIC K_ED_TZ9.FEHLERSCHWELLE "Filterschwelle fuer Fehlereintrag | EN: Fault code TZ9 - debounce filter threshold for setting the fault" VALUE 0x7107C TKW_VV_VV_UB 100.0 FORMULA_0003 0.0 255.0000 /end CHARACTERISTIC
/begin CHARACTERISTIC K_ED_TZ10.FEHLERSCHWELLE "Filterschwelle fuer Fehlereintrag | EN: Fault code TZ10 - debounce filter threshold for setting the fault" VALUE 0x71096 TKW_VV_VV_UB 100.0 FORMULA_0003 0.0 255.0000 /end CHARACTERISTIC
/begin CHARACTERISTIC K_ED_VAN_ANSCHL_E1.FEHLERSCHWELLE "Filterschwelle fuer Fehlereintrag | EN: Fault code VAN_ANSCHL_E1 - debounce filter threshold for setting the fault" VALUE 0x710E4 TKW_VV_VV_UB 100.0 FORMULA_0003 0.0 255.0000 /end CHARACTERISTIC
/begin CHARACTERISTIC K_ED_VAN_ANSCHL_A1.FEHLERSCHWELLE "Filterschwelle fuer Fehlereintrag | EN: Fault code VAN_ANSCHL_A1 - debounce filter threshold for setting the fault" VALUE 0x710FE TKW_VV_VV_UB 100.0 FORMULA_0003 0.0 255.0000 /end CHARACTERISTIC
/begin CHARACTERISTIC K_ED_VAN_ANSCHL_E2.FEHLERSCHWELLE "Filterschwelle fuer Fehlereintrag | EN: Fault code VAN_ANSCHL_E2 - debounce filter threshold for setting the fault" VALUE 0x71118 TKW_VV_VV_UB 100.0 FORMULA_0003 0.0 255.0000 /end CHARACTERISTIC
/begin CHARACTERISTIC K_ED_VAN_ANSCHL_A2.FEHLERSCHWELLE "Filterschwelle fuer Fehlereintrag | EN: Fault code VAN_ANSCHL_A2 - debounce filter threshold for setting the fault" VALUE 0x71132 TKW_VV_VV_UB 100.0 FORMULA_0003 0.0 255.0000 /end CHARACTERISTIC
/begin CHARACTERISTIC K_ED_VAN_VENT_E1.FEHLERSCHWELLE "Filterschwelle fuer Fehlereintrag | EN: Fault code VAN_VENT_E1 - debounce filter threshold for setting the fault" VALUE 0x7114C TKW_VV_VV_UB 100.0 FORMULA_0003 0.0 255.0000 /end CHARACTERISTIC
/begin CHARACTERISTIC K_ED_VAN_VENT_A1.FEHLERSCHWELLE "Filterschwelle fuer Fehlereintrag | EN: Fault code VAN_VENT_A1 - debounce filter threshold for setting the fault" VALUE 0x71166 TKW_VV_VV_UB 100.0 FORMULA_0003 0.0 255.0000 /end CHARACTERISTIC
/begin CHARACTERISTIC K_ED_VAN_VENT_E2.FEHLERSCHWELLE "Filterschwelle fuer Fehlereintrag | EN: Fault code VAN_VENT_E2 - debounce filter threshold for setting the fault" VALUE 0x71180 TKW_VV_VV_UB 100.0 FORMULA_0003 0.0 255.0000 /end CHARACTERISTIC
/begin CHARACTERISTIC K_ED_VAN_VENT_A2.FEHLERSCHWELLE "Filterschwelle fuer Fehlereintrag | EN: Fault code VAN_VENT_A2 - debounce filter threshold for setting the fault" VALUE 0x7119A TKW_VV_VV_UB 100.0 FORMULA_0003 0.0 255.0000 /end CHARACTERISTIC
/begin CHARACTERISTIC K_ED_RLU87.FEHLERSCHWELLE "Filterschwelle fuer Fehlereintrag | EN: Fault code RLU87 - debounce filter threshold for setting the fault" VALUE 0x7140A TKW_VV_VV_UB 100.0 FORMULA_0003 0.0 255.0000 /end CHARACTERISTIC
/begin CHARACTERISTIC K_ED_SSP.FEHLERSCHWELLE "Filterschwelle fuer Fehlereintrag" VALUE 0x7143E TKW_VV_VV_UB 100.0 FORMULA_0003 0.0 255.0000 /end CHARACTERISTIC
/begin CHARACTERISTIC K_ED_TD.FEHLERSCHWELLE "Filterschwelle fuer Fehlereintrag | EN: Fault code TD - debounce filter threshold for setting the fault" VALUE 0x71458 TKW_VV_VV_UB 100.0 FORMULA_0003 0.0 255.0000 /end CHARACTERISTIC
/begin CHARACTERISTIC K_ED_RLSLP.FEHLERSCHWELLE "Filterschwelle fuer Fehlereintrag | EN: Fault code RLSLP - debounce filter threshold for setting the fault" VALUE 0x71472 TKW_VV_VV_UB 100.0 FORMULA_0003 0.0 255.0000 /end CHARACTERISTIC
/begin CHARACTERISTIC K_ED_SLV.FEHLERSCHWELLE "Filterschwelle fuer Fehlereintrag | EN: Fault code SLV - debounce filter threshold for setting the fault" VALUE 0x7148C TKW_VV_VV_UB 100.0 FORMULA_0003 0.0 255.0000 /end CHARACTERISTIC
/begin CHARACTERISTIC K_ED_VAN_DSV.FEHLERSCHWELLE "Filterschwelle fuer Fehlereintrag | EN: Fault code VAN_DSV - debounce filter threshold for setting the fault" VALUE 0x7155C TKW_VV_VV_UB 100.0 FORMULA_0003 0.0 255.0000 /end CHARACTERISTIC
/begin CHARACTERISTIC K_ED_SK_MANAGER_INJ.FEHLERSCHWELLE "Filterschwelle fuer Fehlereintrag | EN: Fault code SK_MANAGER_INJ - debounce filter threshold for setting the fault" VALUE 0x7167A TKW_VV_VV_UB 100.0 FORMULA_0003 0.0 255.0000 /end CHARACTERISTIC
/begin CHARACTERISTIC K_ED_SSP_DIAG.FEHLERSCHWELLE "Filterschwelle fuer Fehlereintrag" VALUE 0x71694 TKW_VV_VV_UB 100.0 FORMULA_0003 0.0 255.0000 /end CHARACTERISTIC
/begin CHARACTERISTIC K_ED_SG_INJ.FEHLERSCHWELLE "Filterschwelle fuer Fehlereintrag | EN: Fault code SG_INJ - debounce filter threshold for setting the fault" VALUE 0x7177E TKW_VV_VV_UB 100.0 FORMULA_0003 0.0 255.0000 /end CHARACTERISTIC
/begin CHARACTERISTIC K_ED_S_POEL_DIAG.FEHLERSCHWELLE "Filterschwelle fuer Fehlereintrag | EN: Fault code S_POEL_DIAG - debounce filter threshold for setting the fault" VALUE 0x717CC TKW_VV_VV_UB 100.0 FORMULA_0003 0.0 255.0000 /end CHARACTERISTIC
/begin CHARACTERISTIC K_ED_TE_OBD_1.FEHLERSCHWELLE "Filterschwelle fuer Fehlereintrag | EN: Fault code TE_OBD_1 - debounce filter threshold for setting the fault" VALUE 0x717E6 TKW_VV_VV_UB 100.0 FORMULA_0003 0.0 255.0000 /end CHARACTERISTIC
/begin CHARACTERISTIC K_ED_TE_OBD_2.FEHLERSCHWELLE "Filterschwelle fuer Fehlereintrag | EN: Fault code TE_OBD_2 - debounce filter threshold for setting the fault" VALUE 0x71800 TKW_VV_VV_UB 100.0 FORMULA_0003 0.0 255.0000 /end CHARACTERISTIC
/begin CHARACTERISTIC K_ED_TEV1.FEHLERSCHWELLE "Filterschwelle fuer Fehlereintrag | EN: Fault code TEV1 - debounce filter threshold for setting the fault" VALUE 0x7181A TKW_VV_VV_UB 100.0 FORMULA_0003 0.0 255.0000 /end CHARACTERISTIC
/begin CHARACTERISTIC K_ED_TEV2.FEHLERSCHWELLE "Filterschwelle fuer Fehlereintrag | EN: Fault code TEV2 - debounce filter threshold for setting the fault" VALUE 0x71834 TKW_VV_VV_UB 100.0 FORMULA_0003 0.0 255.0000 /end CHARACTERISTIC
/begin CHARACTERISTIC K_ED_SLP.FEHLERSCHWELLE "Filterschwelle fuer Fehlereintrag | EN: Fault code SLP - debounce filter threshold for setting the fault" VALUE 0x71904 TKW_VV_VV_UB 100.0 FORMULA_0003 0.0 255.0000 /end CHARACTERISTIC
/begin CHARACTERISTIC K_ED_SL_DURCHS_B1.FEHLERSCHWELLE "Filterschwelle fuer Fehlereintrag | EN: Fault code SL_DURCHS_B1 - debounce filter threshold for setting the fault" VALUE 0x7191E TKW_VV_VV_UB 100.0 FORMULA_0003 0.0 255.0000 /end CHARACTERISTIC
/begin CHARACTERISTIC K_ED_SL_DURCHS_B2.FEHLERSCHWELLE "Filterschwelle fuer Fehlereintrag | EN: Fault code SL_DURCHS_B2 - debounce filter threshold for setting the fault" VALUE 0x71938 TKW_VV_VV_UB 100.0 FORMULA_0003 0.0 255.0000 /end CHARACTERISTIC
/begin CHARACTERISTIC K_ED_SL_DURCHS_HSTRANG.FEHLERSCHWELLE "Filterschwelle fuer Fehlereintrag | EN: Fault code SL_DURCHS_HSTRANG - debounce filter threshold for setting the fault" VALUE 0x71952 TKW_VV_VV_UB 100.0 FORMULA_0003 0.0 255.0000 /end CHARACTERISTIC
/begin CHARACTERISTIC K_ED_S_GETR_HS.FEHLERSCHWELLE "Filterschwelle fuer Fehlereintrag | EN: Fault code S_GETR_HS - debounce filter threshold for setting the fault" VALUE 0x71986 TKW_VV_VV_UB 100.0 FORMULA_0003 0.0 255.0000 /end CHARACTERISTIC
/begin CHARACTERISTIC K_ED_S_KUPP_HS.FEHLERSCHWELLE "Filterschwelle fuer Fehlereintrag | EN: Fault code S_KUPP_HS - debounce filter threshold for setting the fault" VALUE 0x719A0 TKW_VV_VV_UB 100.0 FORMULA_0003 0.0 255.0000 /end CHARACTERISTIC
/begin CHARACTERISTIC K_ED_VAN_DRUCK.FEHLERSCHWELLE "Filterschwelle fuer Fehlereintrag | EN: Fault code VAN_DRUCK - debounce filter threshold for setting the fault" VALUE 0x719BA TKW_VV_VV_UB 100.0 FORMULA_0003 0.0 255.0000 /end CHARACTERISTIC
/begin CHARACTERISTIC K_ED_TANK_LEER.FEHLERSCHWELLE "Filterschwelle fuer Fehlereintrag | EN: Fault code TANK_LEER - debounce filter threshold for setting the fault" VALUE 0x71AD8 TKW_VV_VV_UB 100.0 FORMULA_0003 0.0 255.0000 /end CHARACTERISTIC
/begin CHARACTERISTIC K_ED_PUMG_OBD.FEHLERSCHWELLE "Filterschwelle fuer Fehlereintrag | EN: Fault code PUMG_OBD - debounce filter threshold for setting the fault" VALUE 0x71B26 TKW_VV_VV_UB 100.0 FORMULA_0003 0.0 255.0000 /end CHARACTERISTIC
/begin CHARACTERISTIC K_ED_SL_ML_HFM_OBD.FEHLERSCHWELLE "Filterschwelle fuer Fehlereintrag | EN: Fault code SL_ML_HFM_OBD - debounce filter threshold for setting the fault" VALUE 0x71B40 TKW_VV_VV_UB 100.0 FORMULA_0003 0.0 255.0000 /end CHARACTERISTIC
/begin CHARACTERISTIC K_ED_TGETR_HS.FEHLERSCHWELLE "Filterschwelle fuer Fehlereintrag | EN: Fault code TGETR_HS - debounce filter threshold for setting the fault" VALUE 0x71C78 TKW_VV_VV_UB 100.0 FORMULA_0003 0.0 255.0000 /end CHARACTERISTIC
/begin CHARACTERISTIC K_ED_SK_TR_INJ.OK_SCHWELLE "Filterschwelle fuer Fehleraustrag | EN: Filterschwelle fuer Fehleraustrag" VALUE 0x708DF TKW_VV_VV_UB 100.0 FORMULA_0003 0.0 255.0000 /end CHARACTERISTIC
/begin CHARACTERISTIC K_ED_PUMG.OK_SCHWELLE "Filterschwelle fuer Fehleraustrag | EN: Fault code PUMG - debounce filter threshold for clearing (healing) the fault" VALUE 0x708F9 TKW_VV_VV_UB 100.0 FORMULA_0003 0.0 255.0000 /end CHARACTERISTIC
/begin CHARACTERISTIC K_ED_VAN_HALL_E1.OK_SCHWELLE "Filterschwelle fuer Fehleraustrag | EN: Fault code VAN_HALL_E1 - debounce filter threshold for clearing (healing) the fault" VALUE 0x7097B TKW_VV_VV_UB 100.0 FORMULA_0003 0.0 255.0000 /end CHARACTERISTIC
/begin CHARACTERISTIC K_ED_VAN_HALL_A1.OK_SCHWELLE "Filterschwelle fuer Fehleraustrag | EN: Fault code VAN_HALL_A1 - debounce filter threshold for clearing (healing) the fault" VALUE 0x70995 TKW_VV_VV_UB 100.0 FORMULA_0003 0.0 255.0000 /end CHARACTERISTIC
/begin CHARACTERISTIC K_ED_VAN_HALL_E2.OK_SCHWELLE "Filterschwelle fuer Fehleraustrag | EN: Fault code VAN_HALL_E2 - debounce filter threshold for clearing (healing) the fault" VALUE 0x709AF TKW_VV_VV_UB 100.0 FORMULA_0003 0.0 255.0000 /end CHARACTERISTIC
/begin CHARACTERISTIC K_ED_VAN_HALL_A2.OK_SCHWELLE "Filterschwelle fuer Fehleraustrag | EN: Fault code VAN_HALL_A2 - debounce filter threshold for clearing (healing) the fault" VALUE 0x709C9 TKW_VV_VV_UB 100.0 FORMULA_0003 0.0 255.0000 /end CHARACTERISTIC
/begin CHARACTERISTIC K_ED_VAN_REGL_E1.OK_SCHWELLE "Filterschwelle fuer Fehleraustrag | EN: Fault code VAN_REGL_E1 - debounce filter threshold for clearing (healing) the fault" VALUE 0x709E3 TKW_VV_VV_UB 100.0 FORMULA_0003 0.0 255.0000 /end CHARACTERISTIC
/begin CHARACTERISTIC K_ED_VAN_REGL_A1.OK_SCHWELLE "Filterschwelle fuer Fehleraustrag | EN: Fault code VAN_REGL_A1 - debounce filter threshold for clearing (healing) the fault" VALUE 0x709FD TKW_VV_VV_UB 100.0 FORMULA_0003 0.0 255.0000 /end CHARACTERISTIC
/begin CHARACTERISTIC K_ED_VAN_REGL_E2.OK_SCHWELLE "Filterschwelle fuer Fehleraustrag | EN: Fault code VAN_REGL_E2 - debounce filter threshold for clearing (healing) the fault" VALUE 0x70A17 TKW_VV_VV_UB 100.0 FORMULA_0003 0.0 255.0000 /end CHARACTERISTIC
/begin CHARACTERISTIC K_ED_VAN_REGL_A2.OK_SCHWELLE "Filterschwelle fuer Fehleraustrag | EN: Fault code VAN_REGL_A2 - debounce filter threshold for clearing (healing) the fault" VALUE 0x70A31 TKW_VV_VV_UB 100.0 FORMULA_0003 0.0 255.0000 /end CHARACTERISTIC
/begin CHARACTERISTIC K_ED_PT_VRAD.OK_SCHWELLE "Filterschwelle fuer Fehleraustrag | EN: Fault code PT_VRAD - debounce filter threshold for clearing (healing) the fault" VALUE 0x70C39 TKW_VV_VV_UB 100.0 FORMULA_0003 0.0 255.0000 /end CHARACTERISTIC
/begin CHARACTERISTIC K_ED_PT_VFZG.OK_SCHWELLE "Filterschwelle fuer Fehleraustrag | EN: Fault code PT_VFZG - debounce filter threshold for clearing (healing) the fault" VALUE 0x70C53 TKW_VV_VV_UB 100.0 FORMULA_0003 0.0 255.0000 /end CHARACTERISTIC
/begin CHARACTERISTIC K_ED_SL_ML_HFM.OK_SCHWELLE "Filterschwelle fuer Fehleraustrag | EN: Fault code SL_ML_HFM - debounce filter threshold for clearing (healing) the fault" VALUE 0x70D09 TKW_VV_VV_UB 100.0 FORMULA_0003 0.0 255.0000 /end CHARACTERISTIC
/begin CHARACTERISTIC K_ED_TZ1.OK_SCHWELLE "Filterschwelle fuer Fehleraustrag | EN: Fault code TZ1 - debounce filter threshold for clearing (healing) the fault" VALUE 0x70FAD TKW_VV_VV_UB 100.0 FORMULA_0003 0.0 255.0000 /end CHARACTERISTIC
/begin CHARACTERISTIC K_ED_TZ2.OK_SCHWELLE "Filterschwelle fuer Fehleraustrag | EN: Fault code TZ2 - debounce filter threshold for clearing (healing) the fault" VALUE 0x70FC7 TKW_VV_VV_UB 100.0 FORMULA_0003 0.0 255.0000 /end CHARACTERISTIC
/begin CHARACTERISTIC K_ED_TZ3.OK_SCHWELLE "Filterschwelle fuer Fehleraustrag | EN: Fault code TZ3 - debounce filter threshold for clearing (healing) the fault" VALUE 0x70FE1 TKW_VV_VV_UB 100.0 FORMULA_0003 0.0 255.0000 /end CHARACTERISTIC
/begin CHARACTERISTIC K_ED_TZ4.OK_SCHWELLE "Filterschwelle fuer Fehleraustrag | EN: Fault code TZ4 - debounce filter threshold for clearing (healing) the fault" VALUE 0x70FFB TKW_VV_VV_UB 100.0 FORMULA_0003 0.0 255.0000 /end CHARACTERISTIC
/begin CHARACTERISTIC K_ED_TZ5.OK_SCHWELLE "Filterschwelle fuer Fehleraustrag | EN: Fault code TZ5 - debounce filter threshold for clearing (healing) the fault" VALUE 0x71015 TKW_VV_VV_UB 100.0 FORMULA_0003 0.0 255.0000 /end CHARACTERISTIC
/begin CHARACTERISTIC K_ED_TZ6.OK_SCHWELLE "Filterschwelle fuer Fehleraustrag | EN: Fault code TZ6 - debounce filter threshold for clearing (healing) the fault" VALUE 0x7102F TKW_VV_VV_UB 100.0 FORMULA_0003 0.0 255.0000 /end CHARACTERISTIC
/begin CHARACTERISTIC K_ED_TZ7.OK_SCHWELLE "Filterschwelle fuer Fehleraustrag | EN: Fault code TZ7 - debounce filter threshold for clearing (healing) the fault" VALUE 0x71049 TKW_VV_VV_UB 100.0 FORMULA_0003 0.0 255.0000 /end CHARACTERISTIC
/begin CHARACTERISTIC K_ED_TZ8.OK_SCHWELLE "Filterschwelle fuer Fehleraustrag | EN: Fault code TZ8 - debounce filter threshold for clearing (healing) the fault" VALUE 0x71063 TKW_VV_VV_UB 100.0 FORMULA_0003 0.0 255.0000 /end CHARACTERISTIC
/begin CHARACTERISTIC K_ED_TZ9.OK_SCHWELLE "Filterschwelle fuer Fehleraustrag | EN: Fault code TZ9 - debounce filter threshold for clearing (healing) the fault" VALUE 0x7107D TKW_VV_VV_UB 100.0 FORMULA_0003 0.0 255.0000 /end CHARACTERISTIC
/begin CHARACTERISTIC K_ED_TZ10.OK_SCHWELLE "Filterschwelle fuer Fehleraustrag | EN: Fault code TZ10 - debounce filter threshold for clearing (healing) the fault" VALUE 0x71097 TKW_VV_VV_UB 100.0 FORMULA_0003 0.0 255.0000 /end CHARACTERISTIC
/begin CHARACTERISTIC K_ED_VAN_ANSCHL_E1.OK_SCHWELLE "Filterschwelle fuer Fehleraustrag | EN: Fault code VAN_ANSCHL_E1 - debounce filter threshold for clearing (healing) the fault" VALUE 0x710E5 TKW_VV_VV_UB 100.0 FORMULA_0003 0.0 255.0000 /end CHARACTERISTIC
/begin CHARACTERISTIC K_ED_VAN_ANSCHL_A1.OK_SCHWELLE "Filterschwelle fuer Fehleraustrag | EN: Fault code VAN_ANSCHL_A1 - debounce filter threshold for clearing (healing) the fault" VALUE 0x710FF TKW_VV_VV_UB 100.0 FORMULA_0003 0.0 255.0000 /end CHARACTERISTIC
/begin CHARACTERISTIC K_ED_VAN_ANSCHL_E2.OK_SCHWELLE "Filterschwelle fuer Fehleraustrag | EN: Fault code VAN_ANSCHL_E2 - debounce filter threshold for clearing (healing) the fault" VALUE 0x71119 TKW_VV_VV_UB 100.0 FORMULA_0003 0.0 255.0000 /end CHARACTERISTIC
/begin CHARACTERISTIC K_ED_VAN_ANSCHL_A2.OK_SCHWELLE "Filterschwelle fuer Fehleraustrag | EN: Fault code VAN_ANSCHL_A2 - debounce filter threshold for clearing (healing) the fault" VALUE 0x71133 TKW_VV_VV_UB 100.0 FORMULA_0003 0.0 255.0000 /end CHARACTERISTIC
/begin CHARACTERISTIC K_ED_VAN_VENT_E1.OK_SCHWELLE "Filterschwelle fuer Fehleraustrag | EN: Fault code VAN_VENT_E1 - debounce filter threshold for clearing (healing) the fault" VALUE 0x7114D TKW_VV_VV_UB 100.0 FORMULA_0003 0.0 255.0000 /end CHARACTERISTIC
/begin CHARACTERISTIC K_ED_VAN_VENT_A1.OK_SCHWELLE "Filterschwelle fuer Fehleraustrag | EN: Fault code VAN_VENT_A1 - debounce filter threshold for clearing (healing) the fault" VALUE 0x71167 TKW_VV_VV_UB 100.0 FORMULA_0003 0.0 255.0000 /end CHARACTERISTIC
/begin CHARACTERISTIC K_ED_VAN_VENT_E2.OK_SCHWELLE "Filterschwelle fuer Fehleraustrag | EN: Fault code VAN_VENT_E2 - debounce filter threshold for clearing (healing) the fault" VALUE 0x71181 TKW_VV_VV_UB 100.0 FORMULA_0003 0.0 255.0000 /end CHARACTERISTIC
/begin CHARACTERISTIC K_ED_VAN_VENT_A2.OK_SCHWELLE "Filterschwelle fuer Fehleraustrag | EN: Fault code VAN_VENT_A2 - debounce filter threshold for clearing (healing) the fault" VALUE 0x7119B TKW_VV_VV_UB 100.0 FORMULA_0003 0.0 255.0000 /end CHARACTERISTIC
/begin CHARACTERISTIC K_ED_RLU87.OK_SCHWELLE "Filterschwelle fuer Fehleraustrag | EN: Fault code RLU87 - debounce filter threshold for clearing (healing) the fault" VALUE 0x7140B TKW_VV_VV_UB 100.0 FORMULA_0003 0.0 255.0000 /end CHARACTERISTIC
/begin CHARACTERISTIC K_ED_SSP.OK_SCHWELLE "Filterschwelle fuer Fehleraustrag" VALUE 0x7143F TKW_VV_VV_UB 100.0 FORMULA_0003 0.0 255.0000 /end CHARACTERISTIC
/begin CHARACTERISTIC K_ED_TD.OK_SCHWELLE "Filterschwelle fuer Fehleraustrag | EN: Fault code TD - debounce filter threshold for clearing (healing) the fault" VALUE 0x71459 TKW_VV_VV_UB 100.0 FORMULA_0003 0.0 255.0000 /end CHARACTERISTIC
/begin CHARACTERISTIC K_ED_RLSLP.OK_SCHWELLE "Filterschwelle fuer Fehleraustrag | EN: Fault code RLSLP - debounce filter threshold for clearing (healing) the fault" VALUE 0x71473 TKW_VV_VV_UB 100.0 FORMULA_0003 0.0 255.0000 /end CHARACTERISTIC
/begin CHARACTERISTIC K_ED_SLV.OK_SCHWELLE "Filterschwelle fuer Fehleraustrag | EN: Fault code SLV - debounce filter threshold for clearing (healing) the fault" VALUE 0x7148D TKW_VV_VV_UB 100.0 FORMULA_0003 0.0 255.0000 /end CHARACTERISTIC
/begin CHARACTERISTIC K_ED_VAN_DSV.OK_SCHWELLE "Filterschwelle fuer Fehleraustrag | EN: Fault code VAN_DSV - debounce filter threshold for clearing (healing) the fault" VALUE 0x7155D TKW_VV_VV_UB 100.0 FORMULA_0003 0.0 255.0000 /end CHARACTERISTIC
/begin CHARACTERISTIC K_ED_SK_MANAGER_INJ.OK_SCHWELLE "Filterschwelle fuer Fehleraustrag | EN: Fault code SK_MANAGER_INJ - debounce filter threshold for clearing (healing) the fault" VALUE 0x7167B TKW_VV_VV_UB 100.0 FORMULA_0003 0.0 255.0000 /end CHARACTERISTIC
/begin CHARACTERISTIC K_ED_SSP_DIAG.OK_SCHWELLE "Filterschwelle fuer Fehleraustrag" VALUE 0x71695 TKW_VV_VV_UB 100.0 FORMULA_0003 0.0 255.0000 /end CHARACTERISTIC
/begin CHARACTERISTIC K_ED_SG_INJ.OK_SCHWELLE "Filterschwelle fuer Fehleraustrag | EN: Fault code SG_INJ - debounce filter threshold for clearing (healing) the fault" VALUE 0x7177F TKW_VV_VV_UB 100.0 FORMULA_0003 0.0 255.0000 /end CHARACTERISTIC
/begin CHARACTERISTIC K_ED_S_POEL_DIAG.OK_SCHWELLE "Filterschwelle fuer Fehleraustrag | EN: Fault code S_POEL_DIAG - debounce filter threshold for clearing (healing) the fault" VALUE 0x717CD TKW_VV_VV_UB 100.0 FORMULA_0003 0.0 255.0000 /end CHARACTERISTIC
/begin CHARACTERISTIC K_ED_TE_OBD_1.OK_SCHWELLE "Filterschwelle fuer Fehleraustrag | EN: Fault code TE_OBD_1 - debounce filter threshold for clearing (healing) the fault" VALUE 0x717E7 TKW_VV_VV_UB 100.0 FORMULA_0003 0.0 255.0000 /end CHARACTERISTIC
/begin CHARACTERISTIC K_ED_TE_OBD_2.OK_SCHWELLE "Filterschwelle fuer Fehleraustrag | EN: Fault code TE_OBD_2 - debounce filter threshold for clearing (healing) the fault" VALUE 0x71801 TKW_VV_VV_UB 100.0 FORMULA_0003 0.0 255.0000 /end CHARACTERISTIC
/begin CHARACTERISTIC K_ED_TEV1.OK_SCHWELLE "Filterschwelle fuer Fehleraustrag | EN: Fault code TEV1 - debounce filter threshold for clearing (healing) the fault" VALUE 0x7181B TKW_VV_VV_UB 100.0 FORMULA_0003 0.0 255.0000 /end CHARACTERISTIC
/begin CHARACTERISTIC K_ED_TEV2.OK_SCHWELLE "Filterschwelle fuer Fehleraustrag | EN: Fault code TEV2 - debounce filter threshold for clearing (healing) the fault" VALUE 0x71835 TKW_VV_VV_UB 100.0 FORMULA_0003 0.0 255.0000 /end CHARACTERISTIC
/begin CHARACTERISTIC K_ED_SLP.OK_SCHWELLE "Filterschwelle fuer Fehleraustrag | EN: Fault code SLP - debounce filter threshold for clearing (healing) the fault" VALUE 0x71905 TKW_VV_VV_UB 100.0 FORMULA_0003 0.0 255.0000 /end CHARACTERISTIC
/begin CHARACTERISTIC K_ED_SL_DURCHS_B1.OK_SCHWELLE "Filterschwelle fuer Fehleraustrag | EN: Fault code SL_DURCHS_B1 - debounce filter threshold for clearing (healing) the fault" VALUE 0x7191F TKW_VV_VV_UB 100.0 FORMULA_0003 0.0 255.0000 /end CHARACTERISTIC
/begin CHARACTERISTIC K_ED_SL_DURCHS_B2.OK_SCHWELLE "Filterschwelle fuer Fehleraustrag | EN: Fault code SL_DURCHS_B2 - debounce filter threshold for clearing (healing) the fault" VALUE 0x71939 TKW_VV_VV_UB 100.0 FORMULA_0003 0.0 255.0000 /end CHARACTERISTIC
/begin CHARACTERISTIC K_ED_SL_DURCHS_HSTRANG.OK_SCHWELLE "Filterschwelle fuer Fehleraustrag | EN: Fault code SL_DURCHS_HSTRANG - debounce filter threshold for clearing (healing) the fault" VALUE 0x71953 TKW_VV_VV_UB 100.0 FORMULA_0003 0.0 255.0000 /end CHARACTERISTIC
/begin CHARACTERISTIC K_ED_S_GETR_HS.OK_SCHWELLE "Filterschwelle fuer Fehleraustrag | EN: Fault code S_GETR_HS - debounce filter threshold for clearing (healing) the fault" VALUE 0x71987 TKW_VV_VV_UB 100.0 FORMULA_0003 0.0 255.0000 /end CHARACTERISTIC
/begin CHARACTERISTIC K_ED_S_KUPP_HS.OK_SCHWELLE "Filterschwelle fuer Fehleraustrag | EN: Fault code S_KUPP_HS - debounce filter threshold for clearing (healing) the fault" VALUE 0x719A1 TKW_VV_VV_UB 100.0 FORMULA_0003 0.0 255.0000 /end CHARACTERISTIC
/begin CHARACTERISTIC K_ED_VAN_DRUCK.OK_SCHWELLE "Filterschwelle fuer Fehleraustrag | EN: Fault code VAN_DRUCK - debounce filter threshold for clearing (healing) the fault" VALUE 0x719BB TKW_VV_VV_UB 100.0 FORMULA_0003 0.0 255.0000 /end CHARACTERISTIC
/begin CHARACTERISTIC K_ED_TANK_LEER.OK_SCHWELLE "Filterschwelle fuer Fehleraustrag | EN: Fault code TANK_LEER - debounce filter threshold for clearing (healing) the fault" VALUE 0x71AD9 TKW_VV_VV_UB 100.0 FORMULA_0003 0.0 255.0000 /end CHARACTERISTIC
/begin CHARACTERISTIC K_ED_PUMG_OBD.OK_SCHWELLE "Filterschwelle fuer Fehleraustrag | EN: Fault code PUMG_OBD - debounce filter threshold for clearing (healing) the fault" VALUE 0x71B27 TKW_VV_VV_UB 100.0 FORMULA_0003 0.0 255.0000 /end CHARACTERISTIC
/begin CHARACTERISTIC K_ED_SL_ML_HFM_OBD.OK_SCHWELLE "Filterschwelle fuer Fehleraustrag | EN: Fault code SL_ML_HFM_OBD - debounce filter threshold for clearing (healing) the fault" VALUE 0x71B41 TKW_VV_VV_UB 100.0 FORMULA_0003 0.0 255.0000 /end CHARACTERISTIC
/begin CHARACTERISTIC K_ED_TGETR_HS.OK_SCHWELLE "Filterschwelle fuer Fehleraustrag | EN: Fault code TGETR_HS - debounce filter threshold for clearing (healing) the fault" VALUE 0x71C79 TKW_VV_VV_UB 100.0 FORMULA_0003 0.0 255.0000 /end CHARACTERISTIC
/begin CHARACTERISTIC K_ED_SK_TR_INJ.INC_VOR_EINTRAG "Filtererhoehung vorm Fehlerspeichereintrag | EN: Filtererhoehung vorm Fehlerspeichereintrag" VALUE 0x708E0 TKW_VV_VV_UB 100.0 FORMULA_0003 0.0 255.0000 /end CHARACTERISTIC
/begin CHARACTERISTIC K_ED_PUMG.INC_VOR_EINTRAG "Filtererhoehung vorm Fehlerspeichereintrag | EN: Fault code PUMG - debounce filter increment before fault-memory entry" VALUE 0x708FA TKW_VV_VV_UB 100.0 FORMULA_0003 0.0 255.0000 /end CHARACTERISTIC
/begin CHARACTERISTIC K_ED_VAN_HALL_E1.INC_VOR_EINTRAG "Filtererhoehung vorm Fehlerspeichereintrag | EN: Fault code VAN_HALL_E1 - debounce filter increment before fault-memory entry" VALUE 0x7097C TKW_VV_VV_UB 100.0 FORMULA_0003 0.0 255.0000 /end CHARACTERISTIC
/begin CHARACTERISTIC K_ED_VAN_HALL_A1.INC_VOR_EINTRAG "Filtererhoehung vorm Fehlerspeichereintrag | EN: Fault code VAN_HALL_A1 - debounce filter increment before fault-memory entry" VALUE 0x70996 TKW_VV_VV_UB 100.0 FORMULA_0003 0.0 255.0000 /end CHARACTERISTIC
/begin CHARACTERISTIC K_ED_VAN_HALL_E2.INC_VOR_EINTRAG "Filtererhoehung vorm Fehlerspeichereintrag | EN: Fault code VAN_HALL_E2 - debounce filter increment before fault-memory entry" VALUE 0x709B0 TKW_VV_VV_UB 100.0 FORMULA_0003 0.0 255.0000 /end CHARACTERISTIC
/begin CHARACTERISTIC K_ED_VAN_HALL_A2.INC_VOR_EINTRAG "Filtererhoehung vorm Fehlerspeichereintrag | EN: Fault code VAN_HALL_A2 - debounce filter increment before fault-memory entry" VALUE 0x709CA TKW_VV_VV_UB 100.0 FORMULA_0003 0.0 255.0000 /end CHARACTERISTIC
/begin CHARACTERISTIC K_ED_VAN_REGL_E1.INC_VOR_EINTRAG "Filtererhoehung vorm Fehlerspeichereintrag | EN: Fault code VAN_REGL_E1 - debounce filter increment before fault-memory entry" VALUE 0x709E4 TKW_VV_VV_UB 100.0 FORMULA_0003 0.0 255.0000 /end CHARACTERISTIC
/begin CHARACTERISTIC K_ED_VAN_REGL_A1.INC_VOR_EINTRAG "Filtererhoehung vorm Fehlerspeichereintrag | EN: Fault code VAN_REGL_A1 - debounce filter increment before fault-memory entry" VALUE 0x709FE TKW_VV_VV_UB 100.0 FORMULA_0003 0.0 255.0000 /end CHARACTERISTIC
/begin CHARACTERISTIC K_ED_VAN_REGL_E2.INC_VOR_EINTRAG "Filtererhoehung vorm Fehlerspeichereintrag | EN: Fault code VAN_REGL_E2 - debounce filter increment before fault-memory entry" VALUE 0x70A18 TKW_VV_VV_UB 100.0 FORMULA_0003 0.0 255.0000 /end CHARACTERISTIC
/begin CHARACTERISTIC K_ED_VAN_REGL_A2.INC_VOR_EINTRAG "Filtererhoehung vorm Fehlerspeichereintrag | EN: Fault code VAN_REGL_A2 - debounce filter increment before fault-memory entry" VALUE 0x70A32 TKW_VV_VV_UB 100.0 FORMULA_0003 0.0 255.0000 /end CHARACTERISTIC
/begin CHARACTERISTIC K_ED_PT_VRAD.INC_VOR_EINTRAG "Filtererhoehung vorm Fehlerspeichereintrag | EN: Fault code PT_VRAD - debounce filter increment before fault-memory entry" VALUE 0x70C3A TKW_VV_VV_UB 100.0 FORMULA_0003 0.0 255.0000 /end CHARACTERISTIC
/begin CHARACTERISTIC K_ED_PT_VFZG.INC_VOR_EINTRAG "Filtererhoehung vorm Fehlerspeichereintrag | EN: Fault code PT_VFZG - debounce filter increment before fault-memory entry" VALUE 0x70C54 TKW_VV_VV_UB 100.0 FORMULA_0003 0.0 255.0000 /end CHARACTERISTIC
/begin CHARACTERISTIC K_ED_SL_ML_HFM.INC_VOR_EINTRAG "Filtererhoehung vorm Fehlerspeichereintrag | EN: Fault code SL_ML_HFM - debounce filter increment before fault-memory entry" VALUE 0x70D0A TKW_VV_VV_UB 100.0 FORMULA_0003 0.0 255.0000 /end CHARACTERISTIC
/begin CHARACTERISTIC K_ED_TZ1.INC_VOR_EINTRAG "Filtererhoehung vorm Fehlerspeichereintrag | EN: Fault code TZ1 - debounce filter increment before fault-memory entry" VALUE 0x70FAE TKW_VV_VV_UB 100.0 FORMULA_0003 0.0 255.0000 /end CHARACTERISTIC
/begin CHARACTERISTIC K_ED_TZ2.INC_VOR_EINTRAG "Filtererhoehung vorm Fehlerspeichereintrag | EN: Fault code TZ2 - debounce filter increment before fault-memory entry" VALUE 0x70FC8 TKW_VV_VV_UB 100.0 FORMULA_0003 0.0 255.0000 /end CHARACTERISTIC
/begin CHARACTERISTIC K_ED_TZ3.INC_VOR_EINTRAG "Filtererhoehung vorm Fehlerspeichereintrag | EN: Fault code TZ3 - debounce filter increment before fault-memory entry" VALUE 0x70FE2 TKW_VV_VV_UB 100.0 FORMULA_0003 0.0 255.0000 /end CHARACTERISTIC
/begin CHARACTERISTIC K_ED_TZ4.INC_VOR_EINTRAG "Filtererhoehung vorm Fehlerspeichereintrag | EN: Fault code TZ4 - debounce filter increment before fault-memory entry" VALUE 0x70FFC TKW_VV_VV_UB 100.0 FORMULA_0003 0.0 255.0000 /end CHARACTERISTIC
/begin CHARACTERISTIC K_ED_TZ5.INC_VOR_EINTRAG "Filtererhoehung vorm Fehlerspeichereintrag | EN: Fault code TZ5 - debounce filter increment before fault-memory entry" VALUE 0x71016 TKW_VV_VV_UB 100.0 FORMULA_0003 0.0 255.0000 /end CHARACTERISTIC
/begin CHARACTERISTIC K_ED_TZ6.INC_VOR_EINTRAG "Filtererhoehung vorm Fehlerspeichereintrag | EN: Fault code TZ6 - debounce filter increment before fault-memory entry" VALUE 0x71030 TKW_VV_VV_UB 100.0 FORMULA_0003 0.0 255.0000 /end CHARACTERISTIC
/begin CHARACTERISTIC K_ED_TZ7.INC_VOR_EINTRAG "Filtererhoehung vorm Fehlerspeichereintrag | EN: Fault code TZ7 - debounce filter increment before fault-memory entry" VALUE 0x7104A TKW_VV_VV_UB 100.0 FORMULA_0003 0.0 255.0000 /end CHARACTERISTIC
/begin CHARACTERISTIC K_ED_TZ8.INC_VOR_EINTRAG "Filtererhoehung vorm Fehlerspeichereintrag | EN: Fault code TZ8 - debounce filter increment before fault-memory entry" VALUE 0x71064 TKW_VV_VV_UB 100.0 FORMULA_0003 0.0 255.0000 /end CHARACTERISTIC
/begin CHARACTERISTIC K_ED_TZ9.INC_VOR_EINTRAG "Filtererhoehung vorm Fehlerspeichereintrag | EN: Fault code TZ9 - debounce filter increment before fault-memory entry" VALUE 0x7107E TKW_VV_VV_UB 100.0 FORMULA_0003 0.0 255.0000 /end CHARACTERISTIC
/begin CHARACTERISTIC K_ED_TZ10.INC_VOR_EINTRAG "Filtererhoehung vorm Fehlerspeichereintrag | EN: Fault code TZ10 - debounce filter increment before fault-memory entry" VALUE 0x71098 TKW_VV_VV_UB 100.0 FORMULA_0003 0.0 255.0000 /end CHARACTERISTIC
/begin CHARACTERISTIC K_ED_VAN_ANSCHL_E1.INC_VOR_EINTRAG "Filtererhoehung vorm Fehlerspeichereintrag | EN: Fault code VAN_ANSCHL_E1 - debounce filter increment before fault-memory entry" VALUE 0x710E6 TKW_VV_VV_UB 100.0 FORMULA_0003 0.0 255.0000 /end CHARACTERISTIC
/begin CHARACTERISTIC K_ED_VAN_ANSCHL_A1.INC_VOR_EINTRAG "Filtererhoehung vorm Fehlerspeichereintrag | EN: Fault code VAN_ANSCHL_A1 - debounce filter increment before fault-memory entry" VALUE 0x71100 TKW_VV_VV_UB 100.0 FORMULA_0003 0.0 255.0000 /end CHARACTERISTIC
/begin CHARACTERISTIC K_ED_VAN_ANSCHL_E2.INC_VOR_EINTRAG "Filtererhoehung vorm Fehlerspeichereintrag | EN: Fault code VAN_ANSCHL_E2 - debounce filter increment before fault-memory entry" VALUE 0x7111A TKW_VV_VV_UB 100.0 FORMULA_0003 0.0 255.0000 /end CHARACTERISTIC
/begin CHARACTERISTIC K_ED_VAN_ANSCHL_A2.INC_VOR_EINTRAG "Filtererhoehung vorm Fehlerspeichereintrag | EN: Fault code VAN_ANSCHL_A2 - debounce filter increment before fault-memory entry" VALUE 0x71134 TKW_VV_VV_UB 100.0 FORMULA_0003 0.0 255.0000 /end CHARACTERISTIC
/begin CHARACTERISTIC K_ED_VAN_VENT_E1.INC_VOR_EINTRAG "Filtererhoehung vorm Fehlerspeichereintrag | EN: Fault code VAN_VENT_E1 - debounce filter increment before fault-memory entry" VALUE 0x7114E TKW_VV_VV_UB 100.0 FORMULA_0003 0.0 255.0000 /end CHARACTERISTIC
/begin CHARACTERISTIC K_ED_VAN_VENT_A1.INC_VOR_EINTRAG "Filtererhoehung vorm Fehlerspeichereintrag | EN: Fault code VAN_VENT_A1 - debounce filter increment before fault-memory entry" VALUE 0x71168 TKW_VV_VV_UB 100.0 FORMULA_0003 0.0 255.0000 /end CHARACTERISTIC
/begin CHARACTERISTIC K_ED_VAN_VENT_E2.INC_VOR_EINTRAG "Filtererhoehung vorm Fehlerspeichereintrag | EN: Fault code VAN_VENT_E2 - debounce filter increment before fault-memory entry" VALUE 0x71182 TKW_VV_VV_UB 100.0 FORMULA_0003 0.0 255.0000 /end CHARACTERISTIC
/begin CHARACTERISTIC K_ED_VAN_VENT_A2.INC_VOR_EINTRAG "Filtererhoehung vorm Fehlerspeichereintrag | EN: Fault code VAN_VENT_A2 - debounce filter increment before fault-memory entry" VALUE 0x7119C TKW_VV_VV_UB 100.0 FORMULA_0003 0.0 255.0000 /end CHARACTERISTIC
/begin CHARACTERISTIC K_ED_RLU87.INC_VOR_EINTRAG "Filtererhoehung vorm Fehlerspeichereintrag | EN: Fault code RLU87 - debounce filter increment before fault-memory entry" VALUE 0x7140C TKW_VV_VV_UB 100.0 FORMULA_0003 0.0 255.0000 /end CHARACTERISTIC
/begin CHARACTERISTIC K_ED_SSP.INC_VOR_EINTRAG "Filtererhoehung vorm Fehlerspeichereintrag" VALUE 0x71440 TKW_VV_VV_UB 100.0 FORMULA_0003 0.0 255.0000 /end CHARACTERISTIC
/begin CHARACTERISTIC K_ED_TD.INC_VOR_EINTRAG "Filtererhoehung vorm Fehlerspeichereintrag | EN: Fault code TD - debounce filter increment before fault-memory entry" VALUE 0x7145A TKW_VV_VV_UB 100.0 FORMULA_0003 0.0 255.0000 /end CHARACTERISTIC
/begin CHARACTERISTIC K_ED_RLSLP.INC_VOR_EINTRAG "Filtererhoehung vorm Fehlerspeichereintrag | EN: Fault code RLSLP - debounce filter increment before fault-memory entry" VALUE 0x71474 TKW_VV_VV_UB 100.0 FORMULA_0003 0.0 255.0000 /end CHARACTERISTIC
/begin CHARACTERISTIC K_ED_SLV.INC_VOR_EINTRAG "Filtererhoehung vorm Fehlerspeichereintrag | EN: Fault code SLV - debounce filter increment before fault-memory entry" VALUE 0x7148E TKW_VV_VV_UB 100.0 FORMULA_0003 0.0 255.0000 /end CHARACTERISTIC
/begin CHARACTERISTIC K_ED_VAN_DSV.INC_VOR_EINTRAG "Filtererhoehung vorm Fehlerspeichereintrag | EN: Fault code VAN_DSV - debounce filter increment before fault-memory entry" VALUE 0x7155E TKW_VV_VV_UB 100.0 FORMULA_0003 0.0 255.0000 /end CHARACTERISTIC
/begin CHARACTERISTIC K_ED_SK_MANAGER_INJ.INC_VOR_EINTRAG "Filtererhoehung vorm Fehlerspeichereintrag | EN: Fault code SK_MANAGER_INJ - debounce filter increment before fault-memory entry" VALUE 0x7167C TKW_VV_VV_UB 100.0 FORMULA_0003 0.0 255.0000 /end CHARACTERISTIC
/begin CHARACTERISTIC K_ED_SSP_DIAG.INC_VOR_EINTRAG "Filtererhoehung vorm Fehlerspeichereintrag" VALUE 0x71696 TKW_VV_VV_UB 100.0 FORMULA_0003 0.0 255.0000 /end CHARACTERISTIC
/begin CHARACTERISTIC K_ED_SG_INJ.INC_VOR_EINTRAG "Filtererhoehung vorm Fehlerspeichereintrag | EN: Fault code SG_INJ - debounce filter increment before fault-memory entry" VALUE 0x71780 TKW_VV_VV_UB 100.0 FORMULA_0003 0.0 255.0000 /end CHARACTERISTIC
/begin CHARACTERISTIC K_ED_S_POEL_DIAG.INC_VOR_EINTRAG "Filtererhoehung vorm Fehlerspeichereintrag | EN: Fault code S_POEL_DIAG - debounce filter increment before fault-memory entry" VALUE 0x717CE TKW_VV_VV_UB 100.0 FORMULA_0003 0.0 255.0000 /end CHARACTERISTIC
/begin CHARACTERISTIC K_ED_TE_OBD_1.INC_VOR_EINTRAG "Filtererhoehung vorm Fehlerspeichereintrag | EN: Fault code TE_OBD_1 - debounce filter increment before fault-memory entry" VALUE 0x717E8 TKW_VV_VV_UB 100.0 FORMULA_0003 0.0 255.0000 /end CHARACTERISTIC
/begin CHARACTERISTIC K_ED_TE_OBD_2.INC_VOR_EINTRAG "Filtererhoehung vorm Fehlerspeichereintrag | EN: Fault code TE_OBD_2 - debounce filter increment before fault-memory entry" VALUE 0x71802 TKW_VV_VV_UB 100.0 FORMULA_0003 0.0 255.0000 /end CHARACTERISTIC
/begin CHARACTERISTIC K_ED_TEV1.INC_VOR_EINTRAG "Filtererhoehung vorm Fehlerspeichereintrag | EN: Fault code TEV1 - debounce filter increment before fault-memory entry" VALUE 0x7181C TKW_VV_VV_UB 100.0 FORMULA_0003 0.0 255.0000 /end CHARACTERISTIC
/begin CHARACTERISTIC K_ED_TEV2.INC_VOR_EINTRAG "Filtererhoehung vorm Fehlerspeichereintrag | EN: Fault code TEV2 - debounce filter increment before fault-memory entry" VALUE 0x71836 TKW_VV_VV_UB 100.0 FORMULA_0003 0.0 255.0000 /end CHARACTERISTIC
/begin CHARACTERISTIC K_ED_SLP.INC_VOR_EINTRAG "Filtererhoehung vorm Fehlerspeichereintrag | EN: Fault code SLP - debounce filter increment before fault-memory entry" VALUE 0x71906 TKW_VV_VV_UB 100.0 FORMULA_0003 0.0 255.0000 /end CHARACTERISTIC
/begin CHARACTERISTIC K_ED_SL_DURCHS_B1.INC_VOR_EINTRAG "Filtererhoehung vorm Fehlerspeichereintrag | EN: Fault code SL_DURCHS_B1 - debounce filter increment before fault-memory entry" VALUE 0x71920 TKW_VV_VV_UB 100.0 FORMULA_0003 0.0 255.0000 /end CHARACTERISTIC
/begin CHARACTERISTIC K_ED_SL_DURCHS_B2.INC_VOR_EINTRAG "Filtererhoehung vorm Fehlerspeichereintrag | EN: Fault code SL_DURCHS_B2 - debounce filter increment before fault-memory entry" VALUE 0x7193A TKW_VV_VV_UB 100.0 FORMULA_0003 0.0 255.0000 /end CHARACTERISTIC
/begin CHARACTERISTIC K_ED_SL_DURCHS_HSTRANG.INC_VOR_EINTRAG "Filtererhoehung vorm Fehlerspeichereintrag | EN: Fault code SL_DURCHS_HSTRANG - debounce filter increment before fault-memory entry" VALUE 0x71954 TKW_VV_VV_UB 100.0 FORMULA_0003 0.0 255.0000 /end CHARACTERISTIC
/begin CHARACTERISTIC K_ED_S_GETR_HS.INC_VOR_EINTRAG "Filtererhoehung vorm Fehlerspeichereintrag | EN: Fault code S_GETR_HS - debounce filter increment before fault-memory entry" VALUE 0x71988 TKW_VV_VV_UB 100.0 FORMULA_0003 0.0 255.0000 /end CHARACTERISTIC
/begin CHARACTERISTIC K_ED_S_KUPP_HS.INC_VOR_EINTRAG "Filtererhoehung vorm Fehlerspeichereintrag | EN: Fault code S_KUPP_HS - debounce filter increment before fault-memory entry" VALUE 0x719A2 TKW_VV_VV_UB 100.0 FORMULA_0003 0.0 255.0000 /end CHARACTERISTIC
/begin CHARACTERISTIC K_ED_VAN_DRUCK.INC_VOR_EINTRAG "Filtererhoehung vorm Fehlerspeichereintrag | EN: Fault code VAN_DRUCK - debounce filter increment before fault-memory entry" VALUE 0x719BC TKW_VV_VV_UB 100.0 FORMULA_0003 0.0 255.0000 /end CHARACTERISTIC
/begin CHARACTERISTIC K_ED_TANK_LEER.INC_VOR_EINTRAG "Filtererhoehung vorm Fehlerspeichereintrag | EN: Fault code TANK_LEER - debounce filter increment before fault-memory entry" VALUE 0x71ADA TKW_VV_VV_UB 100.0 FORMULA_0003 0.0 255.0000 /end CHARACTERISTIC
/begin CHARACTERISTIC K_ED_PUMG_OBD.INC_VOR_EINTRAG "Filtererhoehung vorm Fehlerspeichereintrag | EN: Fault code PUMG_OBD - debounce filter increment before fault-memory entry" VALUE 0x71B28 TKW_VV_VV_UB 100.0 FORMULA_0003 0.0 255.0000 /end CHARACTERISTIC
/begin CHARACTERISTIC K_ED_SL_ML_HFM_OBD.INC_VOR_EINTRAG "Filtererhoehung vorm Fehlerspeichereintrag | EN: Fault code SL_ML_HFM_OBD - debounce filter increment before fault-memory entry" VALUE 0x71B42 TKW_VV_VV_UB 100.0 FORMULA_0003 0.0 255.0000 /end CHARACTERISTIC
/begin CHARACTERISTIC K_ED_TGETR_HS.INC_VOR_EINTRAG "Filtererhoehung vorm Fehlerspeichereintrag | EN: Fault code TGETR_HS - debounce filter increment before fault-memory entry" VALUE 0x71C7A TKW_VV_VV_UB 100.0 FORMULA_0003 0.0 255.0000 /end CHARACTERISTIC
/begin CHARACTERISTIC K_ED_SK_TR_INJ.DEC_VOR_EINTRAG "Filterverringerung vorm Fehlerspeichereintrag | EN: Filterverringerung vorm Fehlerspeichereintrag" VALUE 0x708E1 TKW_VV_VV_UB 100.0 FORMULA_0003 0.0 255.0000 /end CHARACTERISTIC
/begin CHARACTERISTIC K_ED_PUMG.DEC_VOR_EINTRAG "Filterverringerung vorm Fehlerspeichereintrag | EN: Fault code PUMG - debounce filter decrement before fault-memory entry" VALUE 0x708FB TKW_VV_VV_UB 100.0 FORMULA_0003 0.0 255.0000 /end CHARACTERISTIC
/begin CHARACTERISTIC K_ED_VAN_HALL_E1.DEC_VOR_EINTRAG "Filterverringerung vorm Fehlerspeichereintrag | EN: Fault code VAN_HALL_E1 - debounce filter decrement before fault-memory entry" VALUE 0x7097D TKW_VV_VV_UB 100.0 FORMULA_0003 0.0 255.0000 /end CHARACTERISTIC
/begin CHARACTERISTIC K_ED_VAN_HALL_A1.DEC_VOR_EINTRAG "Filterverringerung vorm Fehlerspeichereintrag | EN: Fault code VAN_HALL_A1 - debounce filter decrement before fault-memory entry" VALUE 0x70997 TKW_VV_VV_UB 100.0 FORMULA_0003 0.0 255.0000 /end CHARACTERISTIC
/begin CHARACTERISTIC K_ED_VAN_HALL_E2.DEC_VOR_EINTRAG "Filterverringerung vorm Fehlerspeichereintrag | EN: Fault code VAN_HALL_E2 - debounce filter decrement before fault-memory entry" VALUE 0x709B1 TKW_VV_VV_UB 100.0 FORMULA_0003 0.0 255.0000 /end CHARACTERISTIC
/begin CHARACTERISTIC K_ED_VAN_HALL_A2.DEC_VOR_EINTRAG "Filterverringerung vorm Fehlerspeichereintrag | EN: Fault code VAN_HALL_A2 - debounce filter decrement before fault-memory entry" VALUE 0x709CB TKW_VV_VV_UB 100.0 FORMULA_0003 0.0 255.0000 /end CHARACTERISTIC
/begin CHARACTERISTIC K_ED_VAN_REGL_E1.DEC_VOR_EINTRAG "Filterverringerung vorm Fehlerspeichereintrag | EN: Fault code VAN_REGL_E1 - debounce filter decrement before fault-memory entry" VALUE 0x709E5 TKW_VV_VV_UB 100.0 FORMULA_0003 0.0 255.0000 /end CHARACTERISTIC
/begin CHARACTERISTIC K_ED_VAN_REGL_A1.DEC_VOR_EINTRAG "Filterverringerung vorm Fehlerspeichereintrag | EN: Fault code VAN_REGL_A1 - debounce filter decrement before fault-memory entry" VALUE 0x709FF TKW_VV_VV_UB 100.0 FORMULA_0003 0.0 255.0000 /end CHARACTERISTIC
/begin CHARACTERISTIC K_ED_VAN_REGL_E2.DEC_VOR_EINTRAG "Filterverringerung vorm Fehlerspeichereintrag | EN: Fault code VAN_REGL_E2 - debounce filter decrement before fault-memory entry" VALUE 0x70A19 TKW_VV_VV_UB 100.0 FORMULA_0003 0.0 255.0000 /end CHARACTERISTIC
/begin CHARACTERISTIC K_ED_VAN_REGL_A2.DEC_VOR_EINTRAG "Filterverringerung vorm Fehlerspeichereintrag | EN: Fault code VAN_REGL_A2 - debounce filter decrement before fault-memory entry" VALUE 0x70A33 TKW_VV_VV_UB 100.0 FORMULA_0003 0.0 255.0000 /end CHARACTERISTIC
/begin CHARACTERISTIC K_ED_PT_VRAD.DEC_VOR_EINTRAG "Filterverringerung vorm Fehlerspeichereintrag | EN: Fault code PT_VRAD - debounce filter decrement before fault-memory entry" VALUE 0x70C3B TKW_VV_VV_UB 100.0 FORMULA_0003 0.0 255.0000 /end CHARACTERISTIC
/begin CHARACTERISTIC K_ED_PT_VFZG.DEC_VOR_EINTRAG "Filterverringerung vorm Fehlerspeichereintrag | EN: Fault code PT_VFZG - debounce filter decrement before fault-memory entry" VALUE 0x70C55 TKW_VV_VV_UB 100.0 FORMULA_0003 0.0 255.0000 /end CHARACTERISTIC
/begin CHARACTERISTIC K_ED_SL_ML_HFM.DEC_VOR_EINTRAG "Filterverringerung vorm Fehlerspeichereintrag | EN: Fault code SL_ML_HFM - debounce filter decrement before fault-memory entry" VALUE 0x70D0B TKW_VV_VV_UB 100.0 FORMULA_0003 0.0 255.0000 /end CHARACTERISTIC
/begin CHARACTERISTIC K_ED_TZ1.DEC_VOR_EINTRAG "Filterverringerung vorm Fehlerspeichereintrag | EN: Fault code TZ1 - debounce filter decrement before fault-memory entry" VALUE 0x70FAF TKW_VV_VV_UB 100.0 FORMULA_0003 0.0 255.0000 /end CHARACTERISTIC
/begin CHARACTERISTIC K_ED_TZ2.DEC_VOR_EINTRAG "Filterverringerung vorm Fehlerspeichereintrag | EN: Fault code TZ2 - debounce filter decrement before fault-memory entry" VALUE 0x70FC9 TKW_VV_VV_UB 100.0 FORMULA_0003 0.0 255.0000 /end CHARACTERISTIC
/begin CHARACTERISTIC K_ED_TZ3.DEC_VOR_EINTRAG "Filterverringerung vorm Fehlerspeichereintrag | EN: Fault code TZ3 - debounce filter decrement before fault-memory entry" VALUE 0x70FE3 TKW_VV_VV_UB 100.0 FORMULA_0003 0.0 255.0000 /end CHARACTERISTIC
/begin CHARACTERISTIC K_ED_TZ4.DEC_VOR_EINTRAG "Filterverringerung vorm Fehlerspeichereintrag | EN: Fault code TZ4 - debounce filter decrement before fault-memory entry" VALUE 0x70FFD TKW_VV_VV_UB 100.0 FORMULA_0003 0.0 255.0000 /end CHARACTERISTIC
/begin CHARACTERISTIC K_ED_TZ5.DEC_VOR_EINTRAG "Filterverringerung vorm Fehlerspeichereintrag | EN: Fault code TZ5 - debounce filter decrement before fault-memory entry" VALUE 0x71017 TKW_VV_VV_UB 100.0 FORMULA_0003 0.0 255.0000 /end CHARACTERISTIC
/begin CHARACTERISTIC K_ED_TZ6.DEC_VOR_EINTRAG "Filterverringerung vorm Fehlerspeichereintrag | EN: Fault code TZ6 - debounce filter decrement before fault-memory entry" VALUE 0x71031 TKW_VV_VV_UB 100.0 FORMULA_0003 0.0 255.0000 /end CHARACTERISTIC
/begin CHARACTERISTIC K_ED_TZ7.DEC_VOR_EINTRAG "Filterverringerung vorm Fehlerspeichereintrag | EN: Fault code TZ7 - debounce filter decrement before fault-memory entry" VALUE 0x7104B TKW_VV_VV_UB 100.0 FORMULA_0003 0.0 255.0000 /end CHARACTERISTIC
/begin CHARACTERISTIC K_ED_TZ8.DEC_VOR_EINTRAG "Filterverringerung vorm Fehlerspeichereintrag | EN: Fault code TZ8 - debounce filter decrement before fault-memory entry" VALUE 0x71065 TKW_VV_VV_UB 100.0 FORMULA_0003 0.0 255.0000 /end CHARACTERISTIC
/begin CHARACTERISTIC K_ED_TZ9.DEC_VOR_EINTRAG "Filterverringerung vorm Fehlerspeichereintrag | EN: Fault code TZ9 - debounce filter decrement before fault-memory entry" VALUE 0x7107F TKW_VV_VV_UB 100.0 FORMULA_0003 0.0 255.0000 /end CHARACTERISTIC
/begin CHARACTERISTIC K_ED_TZ10.DEC_VOR_EINTRAG "Filterverringerung vorm Fehlerspeichereintrag | EN: Fault code TZ10 - debounce filter decrement before fault-memory entry" VALUE 0x71099 TKW_VV_VV_UB 100.0 FORMULA_0003 0.0 255.0000 /end CHARACTERISTIC
/begin CHARACTERISTIC K_ED_VAN_ANSCHL_E1.DEC_VOR_EINTRAG "Filterverringerung vorm Fehlerspeichereintrag | EN: Fault code VAN_ANSCHL_E1 - debounce filter decrement before fault-memory entry" VALUE 0x710E7 TKW_VV_VV_UB 100.0 FORMULA_0003 0.0 255.0000 /end CHARACTERISTIC
/begin CHARACTERISTIC K_ED_VAN_ANSCHL_A1.DEC_VOR_EINTRAG "Filterverringerung vorm Fehlerspeichereintrag | EN: Fault code VAN_ANSCHL_A1 - debounce filter decrement before fault-memory entry" VALUE 0x71101 TKW_VV_VV_UB 100.0 FORMULA_0003 0.0 255.0000 /end CHARACTERISTIC
/begin CHARACTERISTIC K_ED_VAN_ANSCHL_E2.DEC_VOR_EINTRAG "Filterverringerung vorm Fehlerspeichereintrag | EN: Fault code VAN_ANSCHL_E2 - debounce filter decrement before fault-memory entry" VALUE 0x7111B TKW_VV_VV_UB 100.0 FORMULA_0003 0.0 255.0000 /end CHARACTERISTIC
/begin CHARACTERISTIC K_ED_VAN_ANSCHL_A2.DEC_VOR_EINTRAG "Filterverringerung vorm Fehlerspeichereintrag | EN: Fault code VAN_ANSCHL_A2 - debounce filter decrement before fault-memory entry" VALUE 0x71135 TKW_VV_VV_UB 100.0 FORMULA_0003 0.0 255.0000 /end CHARACTERISTIC
/begin CHARACTERISTIC K_ED_VAN_VENT_E1.DEC_VOR_EINTRAG "Filterverringerung vorm Fehlerspeichereintrag | EN: Fault code VAN_VENT_E1 - debounce filter decrement before fault-memory entry" VALUE 0x7114F TKW_VV_VV_UB 100.0 FORMULA_0003 0.0 255.0000 /end CHARACTERISTIC
/begin CHARACTERISTIC K_ED_VAN_VENT_A1.DEC_VOR_EINTRAG "Filterverringerung vorm Fehlerspeichereintrag | EN: Fault code VAN_VENT_A1 - debounce filter decrement before fault-memory entry" VALUE 0x71169 TKW_VV_VV_UB 100.0 FORMULA_0003 0.0 255.0000 /end CHARACTERISTIC
/begin CHARACTERISTIC K_ED_VAN_VENT_E2.DEC_VOR_EINTRAG "Filterverringerung vorm Fehlerspeichereintrag | EN: Fault code VAN_VENT_E2 - debounce filter decrement before fault-memory entry" VALUE 0x71183 TKW_VV_VV_UB 100.0 FORMULA_0003 0.0 255.0000 /end CHARACTERISTIC
/begin CHARACTERISTIC K_ED_VAN_VENT_A2.DEC_VOR_EINTRAG "Filterverringerung vorm Fehlerspeichereintrag | EN: Fault code VAN_VENT_A2 - debounce filter decrement before fault-memory entry" VALUE 0x7119D TKW_VV_VV_UB 100.0 FORMULA_0003 0.0 255.0000 /end CHARACTERISTIC
/begin CHARACTERISTIC K_ED_RLU87.DEC_VOR_EINTRAG "Filterverringerung vorm Fehlerspeichereintrag | EN: Fault code RLU87 - debounce filter decrement before fault-memory entry" VALUE 0x7140D TKW_VV_VV_UB 100.0 FORMULA_0003 0.0 255.0000 /end CHARACTERISTIC
/begin CHARACTERISTIC K_ED_SSP.DEC_VOR_EINTRAG "Filterverringerung vorm Fehlerspeichereintrag" VALUE 0x71441 TKW_VV_VV_UB 100.0 FORMULA_0003 0.0 255.0000 /end CHARACTERISTIC
/begin CHARACTERISTIC K_ED_TD.DEC_VOR_EINTRAG "Filterverringerung vorm Fehlerspeichereintrag | EN: Fault code TD - debounce filter decrement before fault-memory entry" VALUE 0x7145B TKW_VV_VV_UB 100.0 FORMULA_0003 0.0 255.0000 /end CHARACTERISTIC
/begin CHARACTERISTIC K_ED_RLSLP.DEC_VOR_EINTRAG "Filterverringerung vorm Fehlerspeichereintrag | EN: Fault code RLSLP - debounce filter decrement before fault-memory entry" VALUE 0x71475 TKW_VV_VV_UB 100.0 FORMULA_0003 0.0 255.0000 /end CHARACTERISTIC
/begin CHARACTERISTIC K_ED_SLV.DEC_VOR_EINTRAG "Filterverringerung vorm Fehlerspeichereintrag | EN: Fault code SLV - debounce filter decrement before fault-memory entry" VALUE 0x7148F TKW_VV_VV_UB 100.0 FORMULA_0003 0.0 255.0000 /end CHARACTERISTIC
/begin CHARACTERISTIC K_ED_VAN_DSV.DEC_VOR_EINTRAG "Filterverringerung vorm Fehlerspeichereintrag | EN: Fault code VAN_DSV - debounce filter decrement before fault-memory entry" VALUE 0x7155F TKW_VV_VV_UB 100.0 FORMULA_0003 0.0 255.0000 /end CHARACTERISTIC
/begin CHARACTERISTIC K_ED_SK_MANAGER_INJ.DEC_VOR_EINTRAG "Filterverringerung vorm Fehlerspeichereintrag | EN: Fault code SK_MANAGER_INJ - debounce filter decrement before fault-memory entry" VALUE 0x7167D TKW_VV_VV_UB 100.0 FORMULA_0003 0.0 255.0000 /end CHARACTERISTIC
/begin CHARACTERISTIC K_ED_SSP_DIAG.DEC_VOR_EINTRAG "Filterverringerung vorm Fehlerspeichereintrag" VALUE 0x71697 TKW_VV_VV_UB 100.0 FORMULA_0003 0.0 255.0000 /end CHARACTERISTIC
/begin CHARACTERISTIC K_ED_SG_INJ.DEC_VOR_EINTRAG "Filterverringerung vorm Fehlerspeichereintrag | EN: Fault code SG_INJ - debounce filter decrement before fault-memory entry" VALUE 0x71781 TKW_VV_VV_UB 100.0 FORMULA_0003 0.0 255.0000 /end CHARACTERISTIC
/begin CHARACTERISTIC K_ED_S_POEL_DIAG.DEC_VOR_EINTRAG "Filterverringerung vorm Fehlerspeichereintrag | EN: Fault code S_POEL_DIAG - debounce filter decrement before fault-memory entry" VALUE 0x717CF TKW_VV_VV_UB 100.0 FORMULA_0003 0.0 255.0000 /end CHARACTERISTIC
/begin CHARACTERISTIC K_ED_TE_OBD_1.DEC_VOR_EINTRAG "Filterverringerung vorm Fehlerspeichereintrag | EN: Fault code TE_OBD_1 - debounce filter decrement before fault-memory entry" VALUE 0x717E9 TKW_VV_VV_UB 100.0 FORMULA_0003 0.0 255.0000 /end CHARACTERISTIC
/begin CHARACTERISTIC K_ED_TE_OBD_2.DEC_VOR_EINTRAG "Filterverringerung vorm Fehlerspeichereintrag | EN: Fault code TE_OBD_2 - debounce filter decrement before fault-memory entry" VALUE 0x71803 TKW_VV_VV_UB 100.0 FORMULA_0003 0.0 255.0000 /end CHARACTERISTIC
/begin CHARACTERISTIC K_ED_TEV1.DEC_VOR_EINTRAG "Filterverringerung vorm Fehlerspeichereintrag | EN: Fault code TEV1 - debounce filter decrement before fault-memory entry" VALUE 0x7181D TKW_VV_VV_UB 100.0 FORMULA_0003 0.0 255.0000 /end CHARACTERISTIC
/begin CHARACTERISTIC K_ED_TEV2.DEC_VOR_EINTRAG "Filterverringerung vorm Fehlerspeichereintrag | EN: Fault code TEV2 - debounce filter decrement before fault-memory entry" VALUE 0x71837 TKW_VV_VV_UB 100.0 FORMULA_0003 0.0 255.0000 /end CHARACTERISTIC
/begin CHARACTERISTIC K_ED_SLP.DEC_VOR_EINTRAG "Filterverringerung vorm Fehlerspeichereintrag | EN: Fault code SLP - debounce filter decrement before fault-memory entry" VALUE 0x71907 TKW_VV_VV_UB 100.0 FORMULA_0003 0.0 255.0000 /end CHARACTERISTIC
/begin CHARACTERISTIC K_ED_SL_DURCHS_B1.DEC_VOR_EINTRAG "Filterverringerung vorm Fehlerspeichereintrag | EN: Fault code SL_DURCHS_B1 - debounce filter decrement before fault-memory entry" VALUE 0x71921 TKW_VV_VV_UB 100.0 FORMULA_0003 0.0 255.0000 /end CHARACTERISTIC
/begin CHARACTERISTIC K_ED_SL_DURCHS_B2.DEC_VOR_EINTRAG "Filterverringerung vorm Fehlerspeichereintrag | EN: Fault code SL_DURCHS_B2 - debounce filter decrement before fault-memory entry" VALUE 0x7193B TKW_VV_VV_UB 100.0 FORMULA_0003 0.0 255.0000 /end CHARACTERISTIC
/begin CHARACTERISTIC K_ED_SL_DURCHS_HSTRANG.DEC_VOR_EINTRAG "Filterverringerung vorm Fehlerspeichereintrag | EN: Fault code SL_DURCHS_HSTRANG - debounce filter decrement before fault-memory entry" VALUE 0x71955 TKW_VV_VV_UB 100.0 FORMULA_0003 0.0 255.0000 /end CHARACTERISTIC
/begin CHARACTERISTIC K_ED_S_GETR_HS.DEC_VOR_EINTRAG "Filterverringerung vorm Fehlerspeichereintrag | EN: Fault code S_GETR_HS - debounce filter decrement before fault-memory entry" VALUE 0x71989 TKW_VV_VV_UB 100.0 FORMULA_0003 0.0 255.0000 /end CHARACTERISTIC
/begin CHARACTERISTIC K_ED_S_KUPP_HS.DEC_VOR_EINTRAG "Filterverringerung vorm Fehlerspeichereintrag | EN: Fault code S_KUPP_HS - debounce filter decrement before fault-memory entry" VALUE 0x719A3 TKW_VV_VV_UB 100.0 FORMULA_0003 0.0 255.0000 /end CHARACTERISTIC
/begin CHARACTERISTIC K_ED_VAN_DRUCK.DEC_VOR_EINTRAG "Filterverringerung vorm Fehlerspeichereintrag | EN: Fault code VAN_DRUCK - debounce filter decrement before fault-memory entry" VALUE 0x719BD TKW_VV_VV_UB 100.0 FORMULA_0003 0.0 255.0000 /end CHARACTERISTIC
/begin CHARACTERISTIC K_ED_TANK_LEER.DEC_VOR_EINTRAG "Filterverringerung vorm Fehlerspeichereintrag | EN: Fault code TANK_LEER - debounce filter decrement before fault-memory entry" VALUE 0x71ADB TKW_VV_VV_UB 100.0 FORMULA_0003 0.0 255.0000 /end CHARACTERISTIC
/begin CHARACTERISTIC K_ED_PUMG_OBD.DEC_VOR_EINTRAG "Filterverringerung vorm Fehlerspeichereintrag | EN: Fault code PUMG_OBD - debounce filter decrement before fault-memory entry" VALUE 0x71B29 TKW_VV_VV_UB 100.0 FORMULA_0003 0.0 255.0000 /end CHARACTERISTIC
/begin CHARACTERISTIC K_ED_SL_ML_HFM_OBD.DEC_VOR_EINTRAG "Filterverringerung vorm Fehlerspeichereintrag | EN: Fault code SL_ML_HFM_OBD - debounce filter decrement before fault-memory entry" VALUE 0x71B43 TKW_VV_VV_UB 100.0 FORMULA_0003 0.0 255.0000 /end CHARACTERISTIC
/begin CHARACTERISTIC K_ED_TGETR_HS.DEC_VOR_EINTRAG "Filterverringerung vorm Fehlerspeichereintrag | EN: Fault code TGETR_HS - debounce filter decrement before fault-memory entry" VALUE 0x71C7B TKW_VV_VV_UB 100.0 FORMULA_0003 0.0 255.0000 /end CHARACTERISTIC
/begin CHARACTERISTIC K_ED_SK_TR_INJ.INC_NACH_EINTRAG "Filtererhoehung nach Fehlerspeichereintrag | EN: Filtererhoehung nach Fehlerspeichereintrag" VALUE 0x708E2 TKW_VV_VV_UB 100.0 FORMULA_0003 0.0 255.0000 /end CHARACTERISTIC
/begin CHARACTERISTIC K_ED_PUMG.INC_NACH_EINTRAG "Filtererhoehung nach Fehlerspeichereintrag | EN: Fault code PUMG - debounce filter increment after fault-memory entry" VALUE 0x708FC TKW_VV_VV_UB 100.0 FORMULA_0003 0.0 255.0000 /end CHARACTERISTIC
/begin CHARACTERISTIC K_ED_VAN_HALL_E1.INC_NACH_EINTRAG "Filtererhoehung nach Fehlerspeichereintrag | EN: Fault code VAN_HALL_E1 - debounce filter increment after fault-memory entry" VALUE 0x7097E TKW_VV_VV_UB 100.0 FORMULA_0003 0.0 255.0000 /end CHARACTERISTIC
/begin CHARACTERISTIC K_ED_VAN_HALL_A1.INC_NACH_EINTRAG "Filtererhoehung nach Fehlerspeichereintrag | EN: Fault code VAN_HALL_A1 - debounce filter increment after fault-memory entry" VALUE 0x70998 TKW_VV_VV_UB 100.0 FORMULA_0003 0.0 255.0000 /end CHARACTERISTIC
/begin CHARACTERISTIC K_ED_VAN_HALL_E2.INC_NACH_EINTRAG "Filtererhoehung nach Fehlerspeichereintrag | EN: Fault code VAN_HALL_E2 - debounce filter increment after fault-memory entry" VALUE 0x709B2 TKW_VV_VV_UB 100.0 FORMULA_0003 0.0 255.0000 /end CHARACTERISTIC
/begin CHARACTERISTIC K_ED_VAN_HALL_A2.INC_NACH_EINTRAG "Filtererhoehung nach Fehlerspeichereintrag | EN: Fault code VAN_HALL_A2 - debounce filter increment after fault-memory entry" VALUE 0x709CC TKW_VV_VV_UB 100.0 FORMULA_0003 0.0 255.0000 /end CHARACTERISTIC
/begin CHARACTERISTIC K_ED_VAN_REGL_E1.INC_NACH_EINTRAG "Filtererhoehung nach Fehlerspeichereintrag | EN: Fault code VAN_REGL_E1 - debounce filter increment after fault-memory entry" VALUE 0x709E6 TKW_VV_VV_UB 100.0 FORMULA_0003 0.0 255.0000 /end CHARACTERISTIC
/begin CHARACTERISTIC K_ED_VAN_REGL_A1.INC_NACH_EINTRAG "Filtererhoehung nach Fehlerspeichereintrag | EN: Fault code VAN_REGL_A1 - debounce filter increment after fault-memory entry" VALUE 0x70A00 TKW_VV_VV_UB 100.0 FORMULA_0003 0.0 255.0000 /end CHARACTERISTIC
/begin CHARACTERISTIC K_ED_VAN_REGL_E2.INC_NACH_EINTRAG "Filtererhoehung nach Fehlerspeichereintrag | EN: Fault code VAN_REGL_E2 - debounce filter increment after fault-memory entry" VALUE 0x70A1A TKW_VV_VV_UB 100.0 FORMULA_0003 0.0 255.0000 /end CHARACTERISTIC
/begin CHARACTERISTIC K_ED_VAN_REGL_A2.INC_NACH_EINTRAG "Filtererhoehung nach Fehlerspeichereintrag | EN: Fault code VAN_REGL_A2 - debounce filter increment after fault-memory entry" VALUE 0x70A34 TKW_VV_VV_UB 100.0 FORMULA_0003 0.0 255.0000 /end CHARACTERISTIC
/begin CHARACTERISTIC K_ED_PT_VRAD.INC_NACH_EINTRAG "Filtererhoehung nach Fehlerspeichereintrag | EN: Fault code PT_VRAD - debounce filter increment after fault-memory entry" VALUE 0x70C3C TKW_VV_VV_UB 100.0 FORMULA_0003 0.0 255.0000 /end CHARACTERISTIC
/begin CHARACTERISTIC K_ED_PT_VFZG.INC_NACH_EINTRAG "Filtererhoehung nach Fehlerspeichereintrag | EN: Fault code PT_VFZG - debounce filter increment after fault-memory entry" VALUE 0x70C56 TKW_VV_VV_UB 100.0 FORMULA_0003 0.0 255.0000 /end CHARACTERISTIC
/begin CHARACTERISTIC K_ED_SL_ML_HFM.INC_NACH_EINTRAG "Filtererhoehung nach Fehlerspeichereintrag | EN: Fault code SL_ML_HFM - debounce filter increment after fault-memory entry" VALUE 0x70D0C TKW_VV_VV_UB 100.0 FORMULA_0003 0.0 255.0000 /end CHARACTERISTIC
/begin CHARACTERISTIC K_ED_TZ1.INC_NACH_EINTRAG "Filtererhoehung nach Fehlerspeichereintrag | EN: Fault code TZ1 - debounce filter increment after fault-memory entry" VALUE 0x70FB0 TKW_VV_VV_UB 100.0 FORMULA_0003 0.0 255.0000 /end CHARACTERISTIC
/begin CHARACTERISTIC K_ED_TZ2.INC_NACH_EINTRAG "Filtererhoehung nach Fehlerspeichereintrag | EN: Fault code TZ2 - debounce filter increment after fault-memory entry" VALUE 0x70FCA TKW_VV_VV_UB 100.0 FORMULA_0003 0.0 255.0000 /end CHARACTERISTIC
/begin CHARACTERISTIC K_ED_TZ3.INC_NACH_EINTRAG "Filtererhoehung nach Fehlerspeichereintrag | EN: Fault code TZ3 - debounce filter increment after fault-memory entry" VALUE 0x70FE4 TKW_VV_VV_UB 100.0 FORMULA_0003 0.0 255.0000 /end CHARACTERISTIC
/begin CHARACTERISTIC K_ED_TZ4.INC_NACH_EINTRAG "Filtererhoehung nach Fehlerspeichereintrag | EN: Fault code TZ4 - debounce filter increment after fault-memory entry" VALUE 0x70FFE TKW_VV_VV_UB 100.0 FORMULA_0003 0.0 255.0000 /end CHARACTERISTIC
/begin CHARACTERISTIC K_ED_TZ5.INC_NACH_EINTRAG "Filtererhoehung nach Fehlerspeichereintrag | EN: Fault code TZ5 - debounce filter increment after fault-memory entry" VALUE 0x71018 TKW_VV_VV_UB 100.0 FORMULA_0003 0.0 255.0000 /end CHARACTERISTIC
/begin CHARACTERISTIC K_ED_TZ6.INC_NACH_EINTRAG "Filtererhoehung nach Fehlerspeichereintrag | EN: Fault code TZ6 - debounce filter increment after fault-memory entry" VALUE 0x71032 TKW_VV_VV_UB 100.0 FORMULA_0003 0.0 255.0000 /end CHARACTERISTIC
/begin CHARACTERISTIC K_ED_TZ7.INC_NACH_EINTRAG "Filtererhoehung nach Fehlerspeichereintrag | EN: Fault code TZ7 - debounce filter increment after fault-memory entry" VALUE 0x7104C TKW_VV_VV_UB 100.0 FORMULA_0003 0.0 255.0000 /end CHARACTERISTIC
/begin CHARACTERISTIC K_ED_TZ8.INC_NACH_EINTRAG "Filtererhoehung nach Fehlerspeichereintrag | EN: Fault code TZ8 - debounce filter increment after fault-memory entry" VALUE 0x71066 TKW_VV_VV_UB 100.0 FORMULA_0003 0.0 255.0000 /end CHARACTERISTIC
/begin CHARACTERISTIC K_ED_TZ9.INC_NACH_EINTRAG "Filtererhoehung nach Fehlerspeichereintrag | EN: Fault code TZ9 - debounce filter increment after fault-memory entry" VALUE 0x71080 TKW_VV_VV_UB 100.0 FORMULA_0003 0.0 255.0000 /end CHARACTERISTIC
/begin CHARACTERISTIC K_ED_TZ10.INC_NACH_EINTRAG "Filtererhoehung nach Fehlerspeichereintrag | EN: Fault code TZ10 - debounce filter increment after fault-memory entry" VALUE 0x7109A TKW_VV_VV_UB 100.0 FORMULA_0003 0.0 255.0000 /end CHARACTERISTIC
/begin CHARACTERISTIC K_ED_VAN_ANSCHL_E1.INC_NACH_EINTRAG "Filtererhoehung nach Fehlerspeichereintrag | EN: Fault code VAN_ANSCHL_E1 - debounce filter increment after fault-memory entry" VALUE 0x710E8 TKW_VV_VV_UB 100.0 FORMULA_0003 0.0 255.0000 /end CHARACTERISTIC
/begin CHARACTERISTIC K_ED_VAN_ANSCHL_A1.INC_NACH_EINTRAG "Filtererhoehung nach Fehlerspeichereintrag | EN: Fault code VAN_ANSCHL_A1 - debounce filter increment after fault-memory entry" VALUE 0x71102 TKW_VV_VV_UB 100.0 FORMULA_0003 0.0 255.0000 /end CHARACTERISTIC
/begin CHARACTERISTIC K_ED_VAN_ANSCHL_E2.INC_NACH_EINTRAG "Filtererhoehung nach Fehlerspeichereintrag | EN: Fault code VAN_ANSCHL_E2 - debounce filter increment after fault-memory entry" VALUE 0x7111C TKW_VV_VV_UB 100.0 FORMULA_0003 0.0 255.0000 /end CHARACTERISTIC
/begin CHARACTERISTIC K_ED_VAN_ANSCHL_A2.INC_NACH_EINTRAG "Filtererhoehung nach Fehlerspeichereintrag | EN: Fault code VAN_ANSCHL_A2 - debounce filter increment after fault-memory entry" VALUE 0x71136 TKW_VV_VV_UB 100.0 FORMULA_0003 0.0 255.0000 /end CHARACTERISTIC
/begin CHARACTERISTIC K_ED_VAN_VENT_E1.INC_NACH_EINTRAG "Filtererhoehung nach Fehlerspeichereintrag | EN: Fault code VAN_VENT_E1 - debounce filter increment after fault-memory entry" VALUE 0x71150 TKW_VV_VV_UB 100.0 FORMULA_0003 0.0 255.0000 /end CHARACTERISTIC
/begin CHARACTERISTIC K_ED_VAN_VENT_A1.INC_NACH_EINTRAG "Filtererhoehung nach Fehlerspeichereintrag | EN: Fault code VAN_VENT_A1 - debounce filter increment after fault-memory entry" VALUE 0x7116A TKW_VV_VV_UB 100.0 FORMULA_0003 0.0 255.0000 /end CHARACTERISTIC
/begin CHARACTERISTIC K_ED_VAN_VENT_E2.INC_NACH_EINTRAG "Filtererhoehung nach Fehlerspeichereintrag | EN: Fault code VAN_VENT_E2 - debounce filter increment after fault-memory entry" VALUE 0x71184 TKW_VV_VV_UB 100.0 FORMULA_0003 0.0 255.0000 /end CHARACTERISTIC
/begin CHARACTERISTIC K_ED_VAN_VENT_A2.INC_NACH_EINTRAG "Filtererhoehung nach Fehlerspeichereintrag | EN: Fault code VAN_VENT_A2 - debounce filter increment after fault-memory entry" VALUE 0x7119E TKW_VV_VV_UB 100.0 FORMULA_0003 0.0 255.0000 /end CHARACTERISTIC
/begin CHARACTERISTIC K_ED_RLU87.INC_NACH_EINTRAG "Filtererhoehung nach Fehlerspeichereintrag | EN: Fault code RLU87 - debounce filter increment after fault-memory entry" VALUE 0x7140E TKW_VV_VV_UB 100.0 FORMULA_0003 0.0 255.0000 /end CHARACTERISTIC
/begin CHARACTERISTIC K_ED_SSP.INC_NACH_EINTRAG "Filtererhoehung nach Fehlerspeichereintrag" VALUE 0x71442 TKW_VV_VV_UB 100.0 FORMULA_0003 0.0 255.0000 /end CHARACTERISTIC
/begin CHARACTERISTIC K_ED_TD.INC_NACH_EINTRAG "Filtererhoehung nach Fehlerspeichereintrag | EN: Fault code TD - debounce filter increment after fault-memory entry" VALUE 0x7145C TKW_VV_VV_UB 100.0 FORMULA_0003 0.0 255.0000 /end CHARACTERISTIC
/begin CHARACTERISTIC K_ED_RLSLP.INC_NACH_EINTRAG "Filtererhoehung nach Fehlerspeichereintrag | EN: Fault code RLSLP - debounce filter increment after fault-memory entry" VALUE 0x71476 TKW_VV_VV_UB 100.0 FORMULA_0003 0.0 255.0000 /end CHARACTERISTIC
/begin CHARACTERISTIC K_ED_SLV.INC_NACH_EINTRAG "Filtererhoehung nach Fehlerspeichereintrag | EN: Fault code SLV - debounce filter increment after fault-memory entry" VALUE 0x71490 TKW_VV_VV_UB 100.0 FORMULA_0003 0.0 255.0000 /end CHARACTERISTIC
/begin CHARACTERISTIC K_ED_VAN_DSV.INC_NACH_EINTRAG "Filtererhoehung nach Fehlerspeichereintrag | EN: Fault code VAN_DSV - debounce filter increment after fault-memory entry" VALUE 0x71560 TKW_VV_VV_UB 100.0 FORMULA_0003 0.0 255.0000 /end CHARACTERISTIC
/begin CHARACTERISTIC K_ED_SK_MANAGER_INJ.INC_NACH_EINTRAG "Filtererhoehung nach Fehlerspeichereintrag | EN: Fault code SK_MANAGER_INJ - debounce filter increment after fault-memory entry" VALUE 0x7167E TKW_VV_VV_UB 100.0 FORMULA_0003 0.0 255.0000 /end CHARACTERISTIC
/begin CHARACTERISTIC K_ED_SSP_DIAG.INC_NACH_EINTRAG "Filtererhoehung nach Fehlerspeichereintrag" VALUE 0x71698 TKW_VV_VV_UB 100.0 FORMULA_0003 0.0 255.0000 /end CHARACTERISTIC
/begin CHARACTERISTIC K_ED_SG_INJ.INC_NACH_EINTRAG "Filtererhoehung nach Fehlerspeichereintrag | EN: Fault code SG_INJ - debounce filter increment after fault-memory entry" VALUE 0x71782 TKW_VV_VV_UB 100.0 FORMULA_0003 0.0 255.0000 /end CHARACTERISTIC
/begin CHARACTERISTIC K_ED_S_POEL_DIAG.INC_NACH_EINTRAG "Filtererhoehung nach Fehlerspeichereintrag | EN: Fault code S_POEL_DIAG - debounce filter increment after fault-memory entry" VALUE 0x717D0 TKW_VV_VV_UB 100.0 FORMULA_0003 0.0 255.0000 /end CHARACTERISTIC
/begin CHARACTERISTIC K_ED_TE_OBD_1.INC_NACH_EINTRAG "Filtererhoehung nach Fehlerspeichereintrag | EN: Fault code TE_OBD_1 - debounce filter increment after fault-memory entry" VALUE 0x717EA TKW_VV_VV_UB 100.0 FORMULA_0003 0.0 255.0000 /end CHARACTERISTIC
/begin CHARACTERISTIC K_ED_TE_OBD_2.INC_NACH_EINTRAG "Filtererhoehung nach Fehlerspeichereintrag | EN: Fault code TE_OBD_2 - debounce filter increment after fault-memory entry" VALUE 0x71804 TKW_VV_VV_UB 100.0 FORMULA_0003 0.0 255.0000 /end CHARACTERISTIC
/begin CHARACTERISTIC K_ED_TEV1.INC_NACH_EINTRAG "Filtererhoehung nach Fehlerspeichereintrag | EN: Fault code TEV1 - debounce filter increment after fault-memory entry" VALUE 0x7181E TKW_VV_VV_UB 100.0 FORMULA_0003 0.0 255.0000 /end CHARACTERISTIC
/begin CHARACTERISTIC K_ED_TEV2.INC_NACH_EINTRAG "Filtererhoehung nach Fehlerspeichereintrag | EN: Fault code TEV2 - debounce filter increment after fault-memory entry" VALUE 0x71838 TKW_VV_VV_UB 100.0 FORMULA_0003 0.0 255.0000 /end CHARACTERISTIC
/begin CHARACTERISTIC K_ED_SLP.INC_NACH_EINTRAG "Filtererhoehung nach Fehlerspeichereintrag | EN: Fault code SLP - debounce filter increment after fault-memory entry" VALUE 0x71908 TKW_VV_VV_UB 100.0 FORMULA_0003 0.0 255.0000 /end CHARACTERISTIC
/begin CHARACTERISTIC K_ED_SL_DURCHS_B1.INC_NACH_EINTRAG "Filtererhoehung nach Fehlerspeichereintrag | EN: Fault code SL_DURCHS_B1 - debounce filter increment after fault-memory entry" VALUE 0x71922 TKW_VV_VV_UB 100.0 FORMULA_0003 0.0 255.0000 /end CHARACTERISTIC
/begin CHARACTERISTIC K_ED_SL_DURCHS_B2.INC_NACH_EINTRAG "Filtererhoehung nach Fehlerspeichereintrag | EN: Fault code SL_DURCHS_B2 - debounce filter increment after fault-memory entry" VALUE 0x7193C TKW_VV_VV_UB 100.0 FORMULA_0003 0.0 255.0000 /end CHARACTERISTIC
/begin CHARACTERISTIC K_ED_SL_DURCHS_HSTRANG.INC_NACH_EINTRAG "Filtererhoehung nach Fehlerspeichereintrag | EN: Fault code SL_DURCHS_HSTRANG - debounce filter increment after fault-memory entry" VALUE 0x71956 TKW_VV_VV_UB 100.0 FORMULA_0003 0.0 255.0000 /end CHARACTERISTIC
/begin CHARACTERISTIC K_ED_S_GETR_HS.INC_NACH_EINTRAG "Filtererhoehung nach Fehlerspeichereintrag | EN: Fault code S_GETR_HS - debounce filter increment after fault-memory entry" VALUE 0x7198A TKW_VV_VV_UB 100.0 FORMULA_0003 0.0 255.0000 /end CHARACTERISTIC
/begin CHARACTERISTIC K_ED_S_KUPP_HS.INC_NACH_EINTRAG "Filtererhoehung nach Fehlerspeichereintrag | EN: Fault code S_KUPP_HS - debounce filter increment after fault-memory entry" VALUE 0x719A4 TKW_VV_VV_UB 100.0 FORMULA_0003 0.0 255.0000 /end CHARACTERISTIC
/begin CHARACTERISTIC K_ED_VAN_DRUCK.INC_NACH_EINTRAG "Filtererhoehung nach Fehlerspeichereintrag | EN: Fault code VAN_DRUCK - debounce filter increment after fault-memory entry" VALUE 0x719BE TKW_VV_VV_UB 100.0 FORMULA_0003 0.0 255.0000 /end CHARACTERISTIC
/begin CHARACTERISTIC K_ED_TANK_LEER.INC_NACH_EINTRAG "Filtererhoehung nach Fehlerspeichereintrag | EN: Fault code TANK_LEER - debounce filter increment after fault-memory entry" VALUE 0x71ADC TKW_VV_VV_UB 100.0 FORMULA_0003 0.0 255.0000 /end CHARACTERISTIC
/begin CHARACTERISTIC K_ED_PUMG_OBD.INC_NACH_EINTRAG "Filtererhoehung nach Fehlerspeichereintrag | EN: Fault code PUMG_OBD - debounce filter increment after fault-memory entry" VALUE 0x71B2A TKW_VV_VV_UB 100.0 FORMULA_0003 0.0 255.0000 /end CHARACTERISTIC
/begin CHARACTERISTIC K_ED_SL_ML_HFM_OBD.INC_NACH_EINTRAG "Filtererhoehung nach Fehlerspeichereintrag | EN: Fault code SL_ML_HFM_OBD - debounce filter increment after fault-memory entry" VALUE 0x71B44 TKW_VV_VV_UB 100.0 FORMULA_0003 0.0 255.0000 /end CHARACTERISTIC
/begin CHARACTERISTIC K_ED_TGETR_HS.INC_NACH_EINTRAG "Filtererhoehung nach Fehlerspeichereintrag | EN: Fault code TGETR_HS - debounce filter increment after fault-memory entry" VALUE 0x71C7C TKW_VV_VV_UB 100.0 FORMULA_0003 0.0 255.0000 /end CHARACTERISTIC
/begin CHARACTERISTIC K_ED_SK_TR_INJ.DEC_NACH_EINTRAG "Filterverringerung nach Fehlerspeichereintrag | EN: Filterverringerung nach Fehlerspeichereintrag" VALUE 0x708E3 TKW_VV_VV_UB 100.0 FORMULA_0003 0.0 255.0000 /end CHARACTERISTIC
/begin CHARACTERISTIC K_ED_PUMG.DEC_NACH_EINTRAG "Filterverringerung nach Fehlerspeichereintrag | EN: Fault code PUMG - debounce filter decrement after fault-memory entry" VALUE 0x708FD TKW_VV_VV_UB 100.0 FORMULA_0003 0.0 255.0000 /end CHARACTERISTIC
/begin CHARACTERISTIC K_ED_VAN_HALL_E1.DEC_NACH_EINTRAG "Filterverringerung nach Fehlerspeichereintrag | EN: Fault code VAN_HALL_E1 - debounce filter decrement after fault-memory entry" VALUE 0x7097F TKW_VV_VV_UB 100.0 FORMULA_0003 0.0 255.0000 /end CHARACTERISTIC
/begin CHARACTERISTIC K_ED_VAN_HALL_A1.DEC_NACH_EINTRAG "Filterverringerung nach Fehlerspeichereintrag | EN: Fault code VAN_HALL_A1 - debounce filter decrement after fault-memory entry" VALUE 0x70999 TKW_VV_VV_UB 100.0 FORMULA_0003 0.0 255.0000 /end CHARACTERISTIC
/begin CHARACTERISTIC K_ED_VAN_HALL_E2.DEC_NACH_EINTRAG "Filterverringerung nach Fehlerspeichereintrag | EN: Fault code VAN_HALL_E2 - debounce filter decrement after fault-memory entry" VALUE 0x709B3 TKW_VV_VV_UB 100.0 FORMULA_0003 0.0 255.0000 /end CHARACTERISTIC
/begin CHARACTERISTIC K_ED_VAN_HALL_A2.DEC_NACH_EINTRAG "Filterverringerung nach Fehlerspeichereintrag | EN: Fault code VAN_HALL_A2 - debounce filter decrement after fault-memory entry" VALUE 0x709CD TKW_VV_VV_UB 100.0 FORMULA_0003 0.0 255.0000 /end CHARACTERISTIC
/begin CHARACTERISTIC K_ED_VAN_REGL_E1.DEC_NACH_EINTRAG "Filterverringerung nach Fehlerspeichereintrag | EN: Fault code VAN_REGL_E1 - debounce filter decrement after fault-memory entry" VALUE 0x709E7 TKW_VV_VV_UB 100.0 FORMULA_0003 0.0 255.0000 /end CHARACTERISTIC
/begin CHARACTERISTIC K_ED_VAN_REGL_A1.DEC_NACH_EINTRAG "Filterverringerung nach Fehlerspeichereintrag | EN: Fault code VAN_REGL_A1 - debounce filter decrement after fault-memory entry" VALUE 0x70A01 TKW_VV_VV_UB 100.0 FORMULA_0003 0.0 255.0000 /end CHARACTERISTIC
/begin CHARACTERISTIC K_ED_VAN_REGL_E2.DEC_NACH_EINTRAG "Filterverringerung nach Fehlerspeichereintrag | EN: Fault code VAN_REGL_E2 - debounce filter decrement after fault-memory entry" VALUE 0x70A1B TKW_VV_VV_UB 100.0 FORMULA_0003 0.0 255.0000 /end CHARACTERISTIC
/begin CHARACTERISTIC K_ED_VAN_REGL_A2.DEC_NACH_EINTRAG "Filterverringerung nach Fehlerspeichereintrag | EN: Fault code VAN_REGL_A2 - debounce filter decrement after fault-memory entry" VALUE 0x70A35 TKW_VV_VV_UB 100.0 FORMULA_0003 0.0 255.0000 /end CHARACTERISTIC
/begin CHARACTERISTIC K_ED_PT_VRAD.DEC_NACH_EINTRAG "Filterverringerung nach Fehlerspeichereintrag | EN: Fault code PT_VRAD - debounce filter decrement after fault-memory entry" VALUE 0x70C3D TKW_VV_VV_UB 100.0 FORMULA_0003 0.0 255.0000 /end CHARACTERISTIC
/begin CHARACTERISTIC K_ED_PT_VFZG.DEC_NACH_EINTRAG "Filterverringerung nach Fehlerspeichereintrag | EN: Fault code PT_VFZG - debounce filter decrement after fault-memory entry" VALUE 0x70C57 TKW_VV_VV_UB 100.0 FORMULA_0003 0.0 255.0000 /end CHARACTERISTIC
/begin CHARACTERISTIC K_ED_SL_ML_HFM.DEC_NACH_EINTRAG "Filterverringerung nach Fehlerspeichereintrag | EN: Fault code SL_ML_HFM - debounce filter decrement after fault-memory entry" VALUE 0x70D0D TKW_VV_VV_UB 100.0 FORMULA_0003 0.0 255.0000 /end CHARACTERISTIC
/begin CHARACTERISTIC K_ED_TZ1.DEC_NACH_EINTRAG "Filterverringerung nach Fehlerspeichereintrag | EN: Fault code TZ1 - debounce filter decrement after fault-memory entry" VALUE 0x70FB1 TKW_VV_VV_UB 100.0 FORMULA_0003 0.0 255.0000 /end CHARACTERISTIC
/begin CHARACTERISTIC K_ED_TZ2.DEC_NACH_EINTRAG "Filterverringerung nach Fehlerspeichereintrag | EN: Fault code TZ2 - debounce filter decrement after fault-memory entry" VALUE 0x70FCB TKW_VV_VV_UB 100.0 FORMULA_0003 0.0 255.0000 /end CHARACTERISTIC
/begin CHARACTERISTIC K_ED_TZ3.DEC_NACH_EINTRAG "Filterverringerung nach Fehlerspeichereintrag | EN: Fault code TZ3 - debounce filter decrement after fault-memory entry" VALUE 0x70FE5 TKW_VV_VV_UB 100.0 FORMULA_0003 0.0 255.0000 /end CHARACTERISTIC
/begin CHARACTERISTIC K_ED_TZ4.DEC_NACH_EINTRAG "Filterverringerung nach Fehlerspeichereintrag | EN: Fault code TZ4 - debounce filter decrement after fault-memory entry" VALUE 0x70FFF TKW_VV_VV_UB 100.0 FORMULA_0003 0.0 255.0000 /end CHARACTERISTIC
/begin CHARACTERISTIC K_ED_TZ5.DEC_NACH_EINTRAG "Filterverringerung nach Fehlerspeichereintrag | EN: Fault code TZ5 - debounce filter decrement after fault-memory entry" VALUE 0x71019 TKW_VV_VV_UB 100.0 FORMULA_0003 0.0 255.0000 /end CHARACTERISTIC
/begin CHARACTERISTIC K_ED_TZ6.DEC_NACH_EINTRAG "Filterverringerung nach Fehlerspeichereintrag | EN: Fault code TZ6 - debounce filter decrement after fault-memory entry" VALUE 0x71033 TKW_VV_VV_UB 100.0 FORMULA_0003 0.0 255.0000 /end CHARACTERISTIC
/begin CHARACTERISTIC K_ED_TZ7.DEC_NACH_EINTRAG "Filterverringerung nach Fehlerspeichereintrag | EN: Fault code TZ7 - debounce filter decrement after fault-memory entry" VALUE 0x7104D TKW_VV_VV_UB 100.0 FORMULA_0003 0.0 255.0000 /end CHARACTERISTIC
/begin CHARACTERISTIC K_ED_TZ8.DEC_NACH_EINTRAG "Filterverringerung nach Fehlerspeichereintrag | EN: Fault code TZ8 - debounce filter decrement after fault-memory entry" VALUE 0x71067 TKW_VV_VV_UB 100.0 FORMULA_0003 0.0 255.0000 /end CHARACTERISTIC
/begin CHARACTERISTIC K_ED_TZ9.DEC_NACH_EINTRAG "Filterverringerung nach Fehlerspeichereintrag | EN: Fault code TZ9 - debounce filter decrement after fault-memory entry" VALUE 0x71081 TKW_VV_VV_UB 100.0 FORMULA_0003 0.0 255.0000 /end CHARACTERISTIC
/begin CHARACTERISTIC K_ED_TZ10.DEC_NACH_EINTRAG "Filterverringerung nach Fehlerspeichereintrag | EN: Fault code TZ10 - debounce filter decrement after fault-memory entry" VALUE 0x7109B TKW_VV_VV_UB 100.0 FORMULA_0003 0.0 255.0000 /end CHARACTERISTIC
/begin CHARACTERISTIC K_ED_VAN_ANSCHL_E1.DEC_NACH_EINTRAG "Filterverringerung nach Fehlerspeichereintrag | EN: Fault code VAN_ANSCHL_E1 - debounce filter decrement after fault-memory entry" VALUE 0x710E9 TKW_VV_VV_UB 100.0 FORMULA_0003 0.0 255.0000 /end CHARACTERISTIC
/begin CHARACTERISTIC K_ED_VAN_ANSCHL_A1.DEC_NACH_EINTRAG "Filterverringerung nach Fehlerspeichereintrag | EN: Fault code VAN_ANSCHL_A1 - debounce filter decrement after fault-memory entry" VALUE 0x71103 TKW_VV_VV_UB 100.0 FORMULA_0003 0.0 255.0000 /end CHARACTERISTIC
/begin CHARACTERISTIC K_ED_VAN_ANSCHL_E2.DEC_NACH_EINTRAG "Filterverringerung nach Fehlerspeichereintrag | EN: Fault code VAN_ANSCHL_E2 - debounce filter decrement after fault-memory entry" VALUE 0x7111D TKW_VV_VV_UB 100.0 FORMULA_0003 0.0 255.0000 /end CHARACTERISTIC
/begin CHARACTERISTIC K_ED_VAN_ANSCHL_A2.DEC_NACH_EINTRAG "Filterverringerung nach Fehlerspeichereintrag | EN: Fault code VAN_ANSCHL_A2 - debounce filter decrement after fault-memory entry" VALUE 0x71137 TKW_VV_VV_UB 100.0 FORMULA_0003 0.0 255.0000 /end CHARACTERISTIC
/begin CHARACTERISTIC K_ED_VAN_VENT_E1.DEC_NACH_EINTRAG "Filterverringerung nach Fehlerspeichereintrag | EN: Fault code VAN_VENT_E1 - debounce filter decrement after fault-memory entry" VALUE 0x71151 TKW_VV_VV_UB 100.0 FORMULA_0003 0.0 255.0000 /end CHARACTERISTIC
/begin CHARACTERISTIC K_ED_VAN_VENT_A1.DEC_NACH_EINTRAG "Filterverringerung nach Fehlerspeichereintrag | EN: Fault code VAN_VENT_A1 - debounce filter decrement after fault-memory entry" VALUE 0x7116B TKW_VV_VV_UB 100.0 FORMULA_0003 0.0 255.0000 /end CHARACTERISTIC
/begin CHARACTERISTIC K_ED_VAN_VENT_E2.DEC_NACH_EINTRAG "Filterverringerung nach Fehlerspeichereintrag | EN: Fault code VAN_VENT_E2 - debounce filter decrement after fault-memory entry" VALUE 0x71185 TKW_VV_VV_UB 100.0 FORMULA_0003 0.0 255.0000 /end CHARACTERISTIC
/begin CHARACTERISTIC K_ED_VAN_VENT_A2.DEC_NACH_EINTRAG "Filterverringerung nach Fehlerspeichereintrag | EN: Fault code VAN_VENT_A2 - debounce filter decrement after fault-memory entry" VALUE 0x7119F TKW_VV_VV_UB 100.0 FORMULA_0003 0.0 255.0000 /end CHARACTERISTIC
/begin CHARACTERISTIC K_ED_RLU87.DEC_NACH_EINTRAG "Filterverringerung nach Fehlerspeichereintrag | EN: Fault code RLU87 - debounce filter decrement after fault-memory entry" VALUE 0x7140F TKW_VV_VV_UB 100.0 FORMULA_0003 0.0 255.0000 /end CHARACTERISTIC
/begin CHARACTERISTIC K_ED_SSP.DEC_NACH_EINTRAG "Filterverringerung nach Fehlerspeichereintrag" VALUE 0x71443 TKW_VV_VV_UB 100.0 FORMULA_0003 0.0 255.0000 /end CHARACTERISTIC
/begin CHARACTERISTIC K_ED_TD.DEC_NACH_EINTRAG "Filterverringerung nach Fehlerspeichereintrag | EN: Fault code TD - debounce filter decrement after fault-memory entry" VALUE 0x7145D TKW_VV_VV_UB 100.0 FORMULA_0003 0.0 255.0000 /end CHARACTERISTIC
/begin CHARACTERISTIC K_ED_RLSLP.DEC_NACH_EINTRAG "Filterverringerung nach Fehlerspeichereintrag | EN: Fault code RLSLP - debounce filter decrement after fault-memory entry" VALUE 0x71477 TKW_VV_VV_UB 100.0 FORMULA_0003 0.0 255.0000 /end CHARACTERISTIC
/begin CHARACTERISTIC K_ED_SLV.DEC_NACH_EINTRAG "Filterverringerung nach Fehlerspeichereintrag | EN: Fault code SLV - debounce filter decrement after fault-memory entry" VALUE 0x71491 TKW_VV_VV_UB 100.0 FORMULA_0003 0.0 255.0000 /end CHARACTERISTIC
/begin CHARACTERISTIC K_ED_VAN_DSV.DEC_NACH_EINTRAG "Filterverringerung nach Fehlerspeichereintrag | EN: Fault code VAN_DSV - debounce filter decrement after fault-memory entry" VALUE 0x71561 TKW_VV_VV_UB 100.0 FORMULA_0003 0.0 255.0000 /end CHARACTERISTIC
/begin CHARACTERISTIC K_ED_SK_MANAGER_INJ.DEC_NACH_EINTRAG "Filterverringerung nach Fehlerspeichereintrag | EN: Fault code SK_MANAGER_INJ - debounce filter decrement after fault-memory entry" VALUE 0x7167F TKW_VV_VV_UB 100.0 FORMULA_0003 0.0 255.0000 /end CHARACTERISTIC
/begin CHARACTERISTIC K_ED_SSP_DIAG.DEC_NACH_EINTRAG "Filterverringerung nach Fehlerspeichereintrag" VALUE 0x71699 TKW_VV_VV_UB 100.0 FORMULA_0003 0.0 255.0000 /end CHARACTERISTIC
/begin CHARACTERISTIC K_ED_SG_INJ.DEC_NACH_EINTRAG "Filterverringerung nach Fehlerspeichereintrag | EN: Fault code SG_INJ - debounce filter decrement after fault-memory entry" VALUE 0x71783 TKW_VV_VV_UB 100.0 FORMULA_0003 0.0 255.0000 /end CHARACTERISTIC
/begin CHARACTERISTIC K_ED_S_POEL_DIAG.DEC_NACH_EINTRAG "Filterverringerung nach Fehlerspeichereintrag | EN: Fault code S_POEL_DIAG - debounce filter decrement after fault-memory entry" VALUE 0x717D1 TKW_VV_VV_UB 100.0 FORMULA_0003 0.0 255.0000 /end CHARACTERISTIC
/begin CHARACTERISTIC K_ED_TE_OBD_1.DEC_NACH_EINTRAG "Filterverringerung nach Fehlerspeichereintrag | EN: Fault code TE_OBD_1 - debounce filter decrement after fault-memory entry" VALUE 0x717EB TKW_VV_VV_UB 100.0 FORMULA_0003 0.0 255.0000 /end CHARACTERISTIC
/begin CHARACTERISTIC K_ED_TE_OBD_2.DEC_NACH_EINTRAG "Filterverringerung nach Fehlerspeichereintrag | EN: Fault code TE_OBD_2 - debounce filter decrement after fault-memory entry" VALUE 0x71805 TKW_VV_VV_UB 100.0 FORMULA_0003 0.0 255.0000 /end CHARACTERISTIC
/begin CHARACTERISTIC K_ED_TEV1.DEC_NACH_EINTRAG "Filterverringerung nach Fehlerspeichereintrag | EN: Fault code TEV1 - debounce filter decrement after fault-memory entry" VALUE 0x7181F TKW_VV_VV_UB 100.0 FORMULA_0003 0.0 255.0000 /end CHARACTERISTIC
/begin CHARACTERISTIC K_ED_TEV2.DEC_NACH_EINTRAG "Filterverringerung nach Fehlerspeichereintrag | EN: Fault code TEV2 - debounce filter decrement after fault-memory entry" VALUE 0x71839 TKW_VV_VV_UB 100.0 FORMULA_0003 0.0 255.0000 /end CHARACTERISTIC
/begin CHARACTERISTIC K_ED_SLP.DEC_NACH_EINTRAG "Filterverringerung nach Fehlerspeichereintrag | EN: Fault code SLP - debounce filter decrement after fault-memory entry" VALUE 0x71909 TKW_VV_VV_UB 100.0 FORMULA_0003 0.0 255.0000 /end CHARACTERISTIC
/begin CHARACTERISTIC K_ED_SL_DURCHS_B1.DEC_NACH_EINTRAG "Filterverringerung nach Fehlerspeichereintrag | EN: Fault code SL_DURCHS_B1 - debounce filter decrement after fault-memory entry" VALUE 0x71923 TKW_VV_VV_UB 100.0 FORMULA_0003 0.0 255.0000 /end CHARACTERISTIC
/begin CHARACTERISTIC K_ED_SL_DURCHS_B2.DEC_NACH_EINTRAG "Filterverringerung nach Fehlerspeichereintrag | EN: Fault code SL_DURCHS_B2 - debounce filter decrement after fault-memory entry" VALUE 0x7193D TKW_VV_VV_UB 100.0 FORMULA_0003 0.0 255.0000 /end CHARACTERISTIC
/begin CHARACTERISTIC K_ED_SL_DURCHS_HSTRANG.DEC_NACH_EINTRAG "Filterverringerung nach Fehlerspeichereintrag | EN: Fault code SL_DURCHS_HSTRANG - debounce filter decrement after fault-memory entry" VALUE 0x71957 TKW_VV_VV_UB 100.0 FORMULA_0003 0.0 255.0000 /end CHARACTERISTIC
/begin CHARACTERISTIC K_ED_S_GETR_HS.DEC_NACH_EINTRAG "Filterverringerung nach Fehlerspeichereintrag | EN: Fault code S_GETR_HS - debounce filter decrement after fault-memory entry" VALUE 0x7198B TKW_VV_VV_UB 100.0 FORMULA_0003 0.0 255.0000 /end CHARACTERISTIC
/begin CHARACTERISTIC K_ED_S_KUPP_HS.DEC_NACH_EINTRAG "Filterverringerung nach Fehlerspeichereintrag | EN: Fault code S_KUPP_HS - debounce filter decrement after fault-memory entry" VALUE 0x719A5 TKW_VV_VV_UB 100.0 FORMULA_0003 0.0 255.0000 /end CHARACTERISTIC
/begin CHARACTERISTIC K_ED_VAN_DRUCK.DEC_NACH_EINTRAG "Filterverringerung nach Fehlerspeichereintrag | EN: Fault code VAN_DRUCK - debounce filter decrement after fault-memory entry" VALUE 0x719BF TKW_VV_VV_UB 100.0 FORMULA_0003 0.0 255.0000 /end CHARACTERISTIC
/begin CHARACTERISTIC K_ED_TANK_LEER.DEC_NACH_EINTRAG "Filterverringerung nach Fehlerspeichereintrag | EN: Fault code TANK_LEER - debounce filter decrement after fault-memory entry" VALUE 0x71ADD TKW_VV_VV_UB 100.0 FORMULA_0003 0.0 255.0000 /end CHARACTERISTIC
/begin CHARACTERISTIC K_ED_PUMG_OBD.DEC_NACH_EINTRAG "Filterverringerung nach Fehlerspeichereintrag | EN: Fault code PUMG_OBD - debounce filter decrement after fault-memory entry" VALUE 0x71B2B TKW_VV_VV_UB 100.0 FORMULA_0003 0.0 255.0000 /end CHARACTERISTIC
/begin CHARACTERISTIC K_ED_SL_ML_HFM_OBD.DEC_NACH_EINTRAG "Filterverringerung nach Fehlerspeichereintrag | EN: Fault code SL_ML_HFM_OBD - debounce filter decrement after fault-memory entry" VALUE 0x71B45 TKW_VV_VV_UB 100.0 FORMULA_0003 0.0 255.0000 /end CHARACTERISTIC
/begin CHARACTERISTIC K_ED_TGETR_HS.DEC_NACH_EINTRAG "Filterverringerung nach Fehlerspeichereintrag | EN: Fault code TGETR_HS - debounce filter decrement after fault-memory entry" VALUE 0x71C7D TKW_VV_VV_UB 100.0 FORMULA_0003 0.0 255.0000 /end CHARACTERISTIC
/begin CHARACTERISTIC K_ED_SK_TR_INJ.KLASSENINDEX "Auswahl der Fehlerklasse | EN: Fault code SK_TR_INJ - fault class selection (lamp / warning behaviour)" VALUE 0x708E4 TKW_VV_VV_UB 100.0 FORMULA_0003 0.0 8.0000 /end CHARACTERISTIC
/begin CHARACTERISTIC K_ED_PUMG.KLASSENINDEX "Auswahl der Fehlerklasse | EN: Fault code PUMG - fault class selection (lamp / warning behaviour)" VALUE 0x708FE TKW_VV_VV_UB 100.0 FORMULA_0003 0.0 8.0000 /end CHARACTERISTIC
/begin CHARACTERISTIC K_ED_VAN_HALL_E1.KLASSENINDEX "Auswahl der Fehlerklasse | EN: Fault code VAN_HALL_E1 - fault class selection (lamp / warning behaviour)" VALUE 0x70980 TKW_VV_VV_UB 100.0 FORMULA_0003 0.0 8.0000 /end CHARACTERISTIC
/begin CHARACTERISTIC K_ED_VAN_HALL_A1.KLASSENINDEX "Auswahl der Fehlerklasse | EN: Fault code VAN_HALL_A1 - fault class selection (lamp / warning behaviour)" VALUE 0x7099A TKW_VV_VV_UB 100.0 FORMULA_0003 0.0 8.0000 /end CHARACTERISTIC
/begin CHARACTERISTIC K_ED_VAN_HALL_E2.KLASSENINDEX "Auswahl der Fehlerklasse | EN: Fault code VAN_HALL_E2 - fault class selection (lamp / warning behaviour)" VALUE 0x709B4 TKW_VV_VV_UB 100.0 FORMULA_0003 0.0 8.0000 /end CHARACTERISTIC
/begin CHARACTERISTIC K_ED_VAN_HALL_A2.KLASSENINDEX "Auswahl der Fehlerklasse | EN: Fault code VAN_HALL_A2 - fault class selection (lamp / warning behaviour)" VALUE 0x709CE TKW_VV_VV_UB 100.0 FORMULA_0003 0.0 8.0000 /end CHARACTERISTIC
/begin CHARACTERISTIC K_ED_VAN_REGL_E1.KLASSENINDEX "Auswahl der Fehlerklasse | EN: Fault code VAN_REGL_E1 - fault class selection (lamp / warning behaviour)" VALUE 0x709E8 TKW_VV_VV_UB 100.0 FORMULA_0003 0.0 8.0000 /end CHARACTERISTIC
/begin CHARACTERISTIC K_ED_VAN_REGL_A1.KLASSENINDEX "Auswahl der Fehlerklasse | EN: Fault code VAN_REGL_A1 - fault class selection (lamp / warning behaviour)" VALUE 0x70A02 TKW_VV_VV_UB 100.0 FORMULA_0003 0.0 8.0000 /end CHARACTERISTIC
/begin CHARACTERISTIC K_ED_VAN_REGL_E2.KLASSENINDEX "Auswahl der Fehlerklasse | EN: Fault code VAN_REGL_E2 - fault class selection (lamp / warning behaviour)" VALUE 0x70A1C TKW_VV_VV_UB 100.0 FORMULA_0003 0.0 8.0000 /end CHARACTERISTIC
/begin CHARACTERISTIC K_ED_VAN_REGL_A2.KLASSENINDEX "Auswahl der Fehlerklasse | EN: Fault code VAN_REGL_A2 - fault class selection (lamp / warning behaviour)" VALUE 0x70A36 TKW_VV_VV_UB 100.0 FORMULA_0003 0.0 8.0000 /end CHARACTERISTIC
/begin CHARACTERISTIC K_ED_PT_VRAD.KLASSENINDEX "Auswahl der Fehlerklasse | EN: Fault code PT_VRAD - fault class selection (lamp / warning behaviour)" VALUE 0x70C3E TKW_VV_VV_UB 100.0 FORMULA_0003 0.0 8.0000 /end CHARACTERISTIC
/begin CHARACTERISTIC K_ED_PT_VFZG.KLASSENINDEX "Auswahl der Fehlerklasse | EN: Fault code PT_VFZG - fault class selection (lamp / warning behaviour)" VALUE 0x70C58 TKW_VV_VV_UB 100.0 FORMULA_0003 0.0 8.0000 /end CHARACTERISTIC
/begin CHARACTERISTIC K_ED_SL_ML_HFM.KLASSENINDEX "Auswahl der Fehlerklasse | EN: Fault code SL_ML_HFM - fault class selection (lamp / warning behaviour)" VALUE 0x70D0E TKW_VV_VV_UB 100.0 FORMULA_0003 0.0 8.0000 /end CHARACTERISTIC
/begin CHARACTERISTIC K_ED_TZ1.KLASSENINDEX "Auswahl der Fehlerklasse | EN: Fault code TZ1 - fault class selection (lamp / warning behaviour)" VALUE 0x70FB2 TKW_VV_VV_UB 100.0 FORMULA_0003 0.0 8.0000 /end CHARACTERISTIC
/begin CHARACTERISTIC K_ED_TZ2.KLASSENINDEX "Auswahl der Fehlerklasse | EN: Fault code TZ2 - fault class selection (lamp / warning behaviour)" VALUE 0x70FCC TKW_VV_VV_UB 100.0 FORMULA_0003 0.0 8.0000 /end CHARACTERISTIC
/begin CHARACTERISTIC K_ED_TZ3.KLASSENINDEX "Auswahl der Fehlerklasse | EN: Fault code TZ3 - fault class selection (lamp / warning behaviour)" VALUE 0x70FE6 TKW_VV_VV_UB 100.0 FORMULA_0003 0.0 8.0000 /end CHARACTERISTIC
/begin CHARACTERISTIC K_ED_TZ4.KLASSENINDEX "Auswahl der Fehlerklasse | EN: Fault code TZ4 - fault class selection (lamp / warning behaviour)" VALUE 0x71000 TKW_VV_VV_UB 100.0 FORMULA_0003 0.0 8.0000 /end CHARACTERISTIC
/begin CHARACTERISTIC K_ED_TZ5.KLASSENINDEX "Auswahl der Fehlerklasse | EN: Fault code TZ5 - fault class selection (lamp / warning behaviour)" VALUE 0x7101A TKW_VV_VV_UB 100.0 FORMULA_0003 0.0 8.0000 /end CHARACTERISTIC
/begin CHARACTERISTIC K_ED_TZ6.KLASSENINDEX "Auswahl der Fehlerklasse | EN: Fault code TZ6 - fault class selection (lamp / warning behaviour)" VALUE 0x71034 TKW_VV_VV_UB 100.0 FORMULA_0003 0.0 8.0000 /end CHARACTERISTIC
/begin CHARACTERISTIC K_ED_TZ7.KLASSENINDEX "Auswahl der Fehlerklasse | EN: Fault code TZ7 - fault class selection (lamp / warning behaviour)" VALUE 0x7104E TKW_VV_VV_UB 100.0 FORMULA_0003 0.0 8.0000 /end CHARACTERISTIC
/begin CHARACTERISTIC K_ED_TZ8.KLASSENINDEX "Auswahl der Fehlerklasse | EN: Fault code TZ8 - fault class selection (lamp / warning behaviour)" VALUE 0x71068 TKW_VV_VV_UB 100.0 FORMULA_0003 0.0 8.0000 /end CHARACTERISTIC
/begin CHARACTERISTIC K_ED_TZ9.KLASSENINDEX "Auswahl der Fehlerklasse | EN: Fault code TZ9 - fault class selection (lamp / warning behaviour)" VALUE 0x71082 TKW_VV_VV_UB 100.0 FORMULA_0003 0.0 8.0000 /end CHARACTERISTIC
/begin CHARACTERISTIC K_ED_TZ10.KLASSENINDEX "Auswahl der Fehlerklasse | EN: Fault code TZ10 - fault class selection (lamp / warning behaviour)" VALUE 0x7109C TKW_VV_VV_UB 100.0 FORMULA_0003 0.0 8.0000 /end CHARACTERISTIC
/begin CHARACTERISTIC K_ED_VAN_ANSCHL_E1.KLASSENINDEX "Auswahl der Fehlerklasse | EN: Fault code VAN_ANSCHL_E1 - fault class selection (lamp / warning behaviour)" VALUE 0x710EA TKW_VV_VV_UB 100.0 FORMULA_0003 0.0 8.0000 /end CHARACTERISTIC
/begin CHARACTERISTIC K_ED_VAN_ANSCHL_A1.KLASSENINDEX "Auswahl der Fehlerklasse | EN: Fault code VAN_ANSCHL_A1 - fault class selection (lamp / warning behaviour)" VALUE 0x71104 TKW_VV_VV_UB 100.0 FORMULA_0003 0.0 8.0000 /end CHARACTERISTIC
/begin CHARACTERISTIC K_ED_VAN_ANSCHL_E2.KLASSENINDEX "Auswahl der Fehlerklasse | EN: Fault code VAN_ANSCHL_E2 - fault class selection (lamp / warning behaviour)" VALUE 0x7111E TKW_VV_VV_UB 100.0 FORMULA_0003 0.0 8.0000 /end CHARACTERISTIC
/begin CHARACTERISTIC K_ED_VAN_ANSCHL_A2.KLASSENINDEX "Auswahl der Fehlerklasse | EN: Fault code VAN_ANSCHL_A2 - fault class selection (lamp / warning behaviour)" VALUE 0x71138 TKW_VV_VV_UB 100.0 FORMULA_0003 0.0 8.0000 /end CHARACTERISTIC
/begin CHARACTERISTIC K_ED_VAN_VENT_E1.KLASSENINDEX "Auswahl der Fehlerklasse | EN: Fault code VAN_VENT_E1 - fault class selection (lamp / warning behaviour)" VALUE 0x71152 TKW_VV_VV_UB 100.0 FORMULA_0003 0.0 8.0000 /end CHARACTERISTIC
/begin CHARACTERISTIC K_ED_VAN_VENT_A1.KLASSENINDEX "Auswahl der Fehlerklasse | EN: Fault code VAN_VENT_A1 - fault class selection (lamp / warning behaviour)" VALUE 0x7116C TKW_VV_VV_UB 100.0 FORMULA_0003 0.0 8.0000 /end CHARACTERISTIC
/begin CHARACTERISTIC K_ED_VAN_VENT_E2.KLASSENINDEX "Auswahl der Fehlerklasse | EN: Fault code VAN_VENT_E2 - fault class selection (lamp / warning behaviour)" VALUE 0x71186 TKW_VV_VV_UB 100.0 FORMULA_0003 0.0 8.0000 /end CHARACTERISTIC
/begin CHARACTERISTIC K_ED_VAN_VENT_A2.KLASSENINDEX "Auswahl der Fehlerklasse | EN: Fault code VAN_VENT_A2 - fault class selection (lamp / warning behaviour)" VALUE 0x711A0 TKW_VV_VV_UB 100.0 FORMULA_0003 0.0 8.0000 /end CHARACTERISTIC
/begin CHARACTERISTIC K_ED_RLU87.KLASSENINDEX "Auswahl der Fehlerklasse | EN: Fault code RLU87 - fault class selection (lamp / warning behaviour)" VALUE 0x71410 TKW_VV_VV_UB 100.0 FORMULA_0003 0.0 8.0000 /end CHARACTERISTIC
/begin CHARACTERISTIC K_ED_SSP.KLASSENINDEX "Auswahl der Fehlerklasse" VALUE 0x71444 TKW_VV_VV_UB 100.0 FORMULA_0003 0.0 8.0000 /end CHARACTERISTIC
/begin CHARACTERISTIC K_ED_TD.KLASSENINDEX "Auswahl der Fehlerklasse | EN: Fault code TD - fault class selection (lamp / warning behaviour)" VALUE 0x7145E TKW_VV_VV_UB 100.0 FORMULA_0003 0.0 8.0000 /end CHARACTERISTIC
/begin CHARACTERISTIC K_ED_RLSLP.KLASSENINDEX "Auswahl der Fehlerklasse | EN: Fault code RLSLP - fault class selection (lamp / warning behaviour)" VALUE 0x71478 TKW_VV_VV_UB 100.0 FORMULA_0003 0.0 8.0000 /end CHARACTERISTIC
/begin CHARACTERISTIC K_ED_SLV.KLASSENINDEX "Auswahl der Fehlerklasse | EN: Fault code SLV - fault class selection (lamp / warning behaviour)" VALUE 0x71492 TKW_VV_VV_UB 100.0 FORMULA_0003 0.0 8.0000 /end CHARACTERISTIC
/begin CHARACTERISTIC K_ED_VAN_DSV.KLASSENINDEX "Auswahl der Fehlerklasse | EN: Fault code VAN_DSV - fault class selection (lamp / warning behaviour)" VALUE 0x71562 TKW_VV_VV_UB 100.0 FORMULA_0003 0.0 8.0000 /end CHARACTERISTIC
/begin CHARACTERISTIC K_ED_SK_MANAGER_INJ.KLASSENINDEX "Auswahl der Fehlerklasse | EN: Fault code SK_MANAGER_INJ - fault class selection (lamp / warning behaviour)" VALUE 0x71680 TKW_VV_VV_UB 100.0 FORMULA_0003 0.0 8.0000 /end CHARACTERISTIC
/begin CHARACTERISTIC K_ED_SSP_DIAG.KLASSENINDEX "Auswahl der Fehlerklasse" VALUE 0x7169A TKW_VV_VV_UB 100.0 FORMULA_0003 0.0 8.0000 /end CHARACTERISTIC
/begin CHARACTERISTIC K_ED_SG_INJ.KLASSENINDEX "Auswahl der Fehlerklasse | EN: Fault code SG_INJ - fault class selection (lamp / warning behaviour)" VALUE 0x71784 TKW_VV_VV_UB 100.0 FORMULA_0003 0.0 8.0000 /end CHARACTERISTIC
/begin CHARACTERISTIC K_ED_S_POEL_DIAG.KLASSENINDEX "Auswahl der Fehlerklasse | EN: Fault code S_POEL_DIAG - fault class selection (lamp / warning behaviour)" VALUE 0x717D2 TKW_VV_VV_UB 100.0 FORMULA_0003 0.0 8.0000 /end CHARACTERISTIC
/begin CHARACTERISTIC K_ED_TE_OBD_1.KLASSENINDEX "Auswahl der Fehlerklasse | EN: Fault code TE_OBD_1 - fault class selection (lamp / warning behaviour)" VALUE 0x717EC TKW_VV_VV_UB 100.0 FORMULA_0003 0.0 8.0000 /end CHARACTERISTIC
/begin CHARACTERISTIC K_ED_TE_OBD_2.KLASSENINDEX "Auswahl der Fehlerklasse | EN: Fault code TE_OBD_2 - fault class selection (lamp / warning behaviour)" VALUE 0x71806 TKW_VV_VV_UB 100.0 FORMULA_0003 0.0 8.0000 /end CHARACTERISTIC
/begin CHARACTERISTIC K_ED_TEV1.KLASSENINDEX "Auswahl der Fehlerklasse | EN: Fault code TEV1 - fault class selection (lamp / warning behaviour)" VALUE 0x71820 TKW_VV_VV_UB 100.0 FORMULA_0003 0.0 8.0000 /end CHARACTERISTIC
/begin CHARACTERISTIC K_ED_TEV2.KLASSENINDEX "Auswahl der Fehlerklasse | EN: Fault code TEV2 - fault class selection (lamp / warning behaviour)" VALUE 0x7183A TKW_VV_VV_UB 100.0 FORMULA_0003 0.0 8.0000 /end CHARACTERISTIC
/begin CHARACTERISTIC K_ED_SLP.KLASSENINDEX "Auswahl der Fehlerklasse | EN: Fault code SLP - fault class selection (lamp / warning behaviour)" VALUE 0x7190A TKW_VV_VV_UB 100.0 FORMULA_0003 0.0 8.0000 /end CHARACTERISTIC
/begin CHARACTERISTIC K_ED_SL_DURCHS_B1.KLASSENINDEX "Auswahl der Fehlerklasse | EN: Fault code SL_DURCHS_B1 - fault class selection (lamp / warning behaviour)" VALUE 0x71924 TKW_VV_VV_UB 100.0 FORMULA_0003 0.0 8.0000 /end CHARACTERISTIC
/begin CHARACTERISTIC K_ED_SL_DURCHS_B2.KLASSENINDEX "Auswahl der Fehlerklasse | EN: Fault code SL_DURCHS_B2 - fault class selection (lamp / warning behaviour)" VALUE 0x7193E TKW_VV_VV_UB 100.0 FORMULA_0003 0.0 8.0000 /end CHARACTERISTIC
/begin CHARACTERISTIC K_ED_SL_DURCHS_HSTRANG.KLASSENINDEX "Auswahl der Fehlerklasse | EN: Fault code SL_DURCHS_HSTRANG - fault class selection (lamp / warning behaviour)" VALUE 0x71958 TKW_VV_VV_UB 100.0 FORMULA_0003 0.0 8.0000 /end CHARACTERISTIC
/begin CHARACTERISTIC K_ED_S_GETR_HS.KLASSENINDEX "Auswahl der Fehlerklasse | EN: Fault code S_GETR_HS - fault class selection (lamp / warning behaviour)" VALUE 0x7198C TKW_VV_VV_UB 100.0 FORMULA_0003 0.0 8.0000 /end CHARACTERISTIC
/begin CHARACTERISTIC K_ED_S_KUPP_HS.KLASSENINDEX "Auswahl der Fehlerklasse | EN: Fault code S_KUPP_HS - fault class selection (lamp / warning behaviour)" VALUE 0x719A6 TKW_VV_VV_UB 100.0 FORMULA_0003 0.0 8.0000 /end CHARACTERISTIC
/begin CHARACTERISTIC K_ED_VAN_DRUCK.KLASSENINDEX "Auswahl der Fehlerklasse | EN: Fault code VAN_DRUCK - fault class selection (lamp / warning behaviour)" VALUE 0x719C0 TKW_VV_VV_UB 100.0 FORMULA_0003 0.0 8.0000 /end CHARACTERISTIC
/begin CHARACTERISTIC K_ED_TANK_LEER.KLASSENINDEX "Auswahl der Fehlerklasse | EN: Fault code TANK_LEER - fault class selection (lamp / warning behaviour)" VALUE 0x71ADE TKW_VV_VV_UB 100.0 FORMULA_0003 0.0 8.0000 /end CHARACTERISTIC
/begin CHARACTERISTIC K_ED_PUMG_OBD.KLASSENINDEX "Auswahl der Fehlerklasse | EN: Fault code PUMG_OBD - fault class selection (lamp / warning behaviour)" VALUE 0x71B2C TKW_VV_VV_UB 100.0 FORMULA_0003 0.0 8.0000 /end CHARACTERISTIC
/begin CHARACTERISTIC K_ED_SL_ML_HFM_OBD.KLASSENINDEX "Auswahl der Fehlerklasse | EN: Fault code SL_ML_HFM_OBD - fault class selection (lamp / warning behaviour)" VALUE 0x71B46 TKW_VV_VV_UB 100.0 FORMULA_0003 0.0 8.0000 /end CHARACTERISTIC
/begin CHARACTERISTIC K_ED_TGETR_HS.KLASSENINDEX "Auswahl der Fehlerklasse | EN: Fault code TGETR_HS - fault class selection (lamp / warning behaviour)" VALUE 0x71C7E TKW_VV_VV_UB 100.0 FORMULA_0003 0.0 8.0000 /end CHARACTERISTIC
/begin CHARACTERISTIC K_ED_RBM_TIME_SLP "SLP-Mindestzeit fuer Fahrzyklus | EN: SLP-Mindestzeit fuer Fahrzyklus" VALUE 0x71F96 TKW_VV_VV_UW 100.0 FORMULA_0073 0.0 6553.5000 FORMAT "%4.1" /end CHARACTERISTIC
/begin FUNCTION Eigendiagnose ""
 /begin DEF_CHARACTERISTIC K_ED_PT_VEHMOD.P_CODE_SH_TO_UB K_ED_PT_VEHMOD.P_CODE_UNPLAUSIBEL K_ED_PT_VFZG.DEC_NACH_EINTRAG K_ED_PT_VFZG.DEC_VOR_EINTRAG K_ED_PT_VFZG.FEHLERSCHWELLE K_ED_PT_VFZG.INC_NACH_EINTRAG K_ED_PT_VFZG.INC_VOR_EINTRAG K_ED_PT_VFZG.KLASSENINDEX K_ED_PT_VFZG.OK_SCHWELLE K_ED_PT_VFZG.P_CODE_OPENLOAD K_ED_PT_VFZG.P_CODE_SH_TO_GND K_ED_PT_VFZG.P_CODE_SH_TO_UB K_ED_PT_VFZG.P_CODE_UNPLAUSIBEL K_ED_PT_VRAD.DEC_NACH_EINTRAG K_ED_PT_VRAD.DEC_VOR_EINTRAG K_ED_PT_VRAD.FEHLERSCHWELLE K_ED_PT_VRAD.INC_NACH_EINTRAG K_ED_PT_VRAD.INC_VOR_EINTRAG K_ED_PT_VRAD.KLASSENINDEX K_ED_PT_VRAD.OK_SCHWELLE K_ED_PT_VRAD.P_CODE_OPENLOAD K_ED_PT_VRAD.P_CODE_SH_TO_GND K_ED_PT_VRAD.P_CODE_SH_TO_UB K_ED_PT_VRAD.P_CODE_UNPLAUSIBEL K_ED_PUMG.DEC_NACH_EINTRAG K_ED_PUMG.DEC_VOR_EINTRAG K_ED_PUMG.FEHLERSCHWELLE K_ED_PUMG.INC_NACH_EINTRAG K_ED_PUMG.INC_VOR_EINTRAG K_ED_PUMG.KLASSENINDEX K_ED_PUMG.OK_SCHWELLE K_ED_PUMG.P_CODE_OPENLOAD K_ED_PUMG.P_CODE_SH_TO_GND K_ED_PUMG.P_CODE_SH_TO_UB K_ED_PUMG.P_CODE_UNPLAUSIBEL K_ED_PUMG_OBD.DEC_NACH_EINTRAG K_ED_PUMG_OBD.DEC_VOR_EINTRAG K_ED_PUMG_OBD.FEHLERSCHWELLE K_ED_PUMG_OBD.INC_NACH_EINTRAG K_ED_PUMG_OBD.INC_VOR_EINTRAG K_ED_PUMG_OBD.KLASSENINDEX K_ED_PUMG_OBD.OK_SCHWELLE K_ED_PUMG_OBD.P_CODE_OPENLOAD K_ED_PUMG_OBD.P_CODE_SH_TO_GND K_ED_PUMG_OBD.P_CODE_SH_TO_UB K_ED_PUMG_OBD.P_CODE_UNPLAUSIBEL K_ED_RBM_EVAP_MAX K_ED_RBM_EVAP_MIN K_ED_RBM_EVAP_TEMP_DELTA K_ED_RBM_PUMG_MIN K_ED_RBM_TIME K_ED_RBM_TIME_LL K_ED_RBM_TIME_SLP K_ED_RBM_TIME_V K_ED_RBM_TUMG_MIN K_ED_RBM_V_MIN K_ED_RLSLP.DEC_NACH_EINTRAG K_ED_RLSLP.DEC_VOR_EINTRAG K_ED_RLSLP.FEHLERSCHWELLE K_ED_RLSLP.INC_NACH_EINTRAG K_ED_RLSLP.INC_VOR_EINTRAG K_ED_RLSLP.KLASSENINDEX K_ED_RLSLP.OK_SCHWELLE K_ED_RLSLP.P_CODE_OPENLOAD K_ED_RLSLP.P_CODE_SH_TO_GND K_ED_RLSLP.P_CODE_SH_TO_UB K_ED_RLSLP.P_CODE_UNPLAUSIBEL K_ED_RLU87.DEC_NACH_EINTRAG K_ED_RLU87.DEC_VOR_EINTRAG K_ED_RLU87.FEHLERSCHWELLE K_ED_RLU87.INC_NACH_EINTRAG K_ED_RLU87.INC_VOR_EINTRAG K_ED_RLU87.KLASSENINDEX K_ED_RLU87.OK_SCHWELLE K_ED_RLU87.P_CODE_OPENLOAD K_ED_RLU87.P_CODE_SH_TO_GND K_ED_RLU87.P_CODE_SH_TO_UB K_ED_RLU87.P_CODE_UNPLAUSIBEL K_ED_SCDN_ABDECKUNG_AUSTRAG K_ED_SCDN_ABDECKUNG_EINTRAG K_ED_SG_INJ.DEC_NACH_EINTRAG K_ED_SG_INJ.DEC_VOR_EINTRAG K_ED_SG_INJ.FEHLERSCHWELLE K_ED_SG_INJ.INC_NACH_EINTRAG K_ED_SG_INJ.INC_VOR_EINTRAG K_ED_SG_INJ.KLASSENINDEX K_ED_SG_INJ.OK_SCHWELLE K_ED_SG_INJ.P_CODE_OPENLOAD K_ED_SG_INJ.P_CODE_SH_TO_GND K_ED_SG_INJ.P_CODE_SH_TO_UB K_ED_SG_INJ.P_CODE_UNPLAUSIBEL K_ED_SK_MANAGER_INJ.DEC_NACH_EINTRAG K_ED_SK_MANAGER_INJ.DEC_VOR_EINTRAG K_ED_SK_MANAGER_INJ.FEHLERSCHWELLE K_ED_SK_MANAGER_INJ.INC_NACH_EINTRAG K_ED_SK_MANAGER_INJ.INC_VOR_EINTRAG K_ED_SK_MANAGER_INJ.KLASSENINDEX K_ED_SK_MANAGER_INJ.OK_SCHWELLE K_ED_SK_MANAGER_INJ.P_CODE_OPENLOAD K_ED_SK_MANAGER_INJ.P_CODE_SH_TO_GND K_ED_SK_MANAGER_INJ.P_CODE_SH_TO_UB K_ED_SK_MANAGER_INJ.P_CODE_UNPLAUSIBEL K_ED_SK_TR_INJ.DEC_NACH_EINTRAG K_ED_SK_TR_INJ.DEC_VOR_EINTRAG K_ED_SK_TR_INJ.FEHLERSCHWELLE K_ED_SK_TR_INJ.INC_NACH_EINTRAG K_ED_SK_TR_INJ.INC_VOR_EINTRAG K_ED_SK_TR_INJ.KLASSENINDEX K_ED_SK_TR_INJ.OK_SCHWELLE K_ED_SK_TR_INJ.P_CODE_OPENLOAD K_ED_SK_TR_INJ.P_CODE_SH_TO_GND K_ED_SK_TR_INJ.P_CODE_SH_TO_UB K_ED_SK_TR_INJ.P_CODE_UNPLAUSIBEL K_ED_SLP.DEC_NACH_EINTRAG K_ED_SLP.DEC_VOR_EINTRAG K_ED_SLP.FEHLERSCHWELLE K_ED_SLP.INC_NACH_EINTRAG K_ED_SLP.INC_VOR_EINTRAG K_ED_SLP.KLASSENINDEX K_ED_SLP.OK_SCHWELLE K_ED_SLP.P_CODE_OPENLOAD K_ED_SLP.P_CODE_SH_TO_GND K_ED_SLP.P_CODE_SH_TO_UB K_ED_SLP.P_CODE_UNPLAUSIBEL K_ED_SLV.DEC_NACH_EINTRAG K_ED_SLV.DEC_VOR_EINTRAG K_ED_SLV.FEHLERSCHWELLE K_ED_SLV.INC_NACH_EINTRAG K_ED_SLV.INC_VOR_EINTRAG K_ED_SLV.KLASSENINDEX K_ED_SLV.OK_SCHWELLE K_ED_SLV.P_CODE_OPENLOAD K_ED_SLV.P_CODE_SH_TO_GND K_ED_SLV.P_CODE_SH_TO_UB K_ED_SLV.P_CODE_UNPLAUSIBEL K_ED_SL_DURCHS_B1.DEC_NACH_EINTRAG K_ED_SL_DURCHS_B1.DEC_VOR_EINTRAG K_ED_SL_DURCHS_B1.FEHLERSCHWELLE K_ED_SL_DURCHS_B1.INC_NACH_EINTRAG K_ED_SL_DURCHS_B1.INC_VOR_EINTRAG K_ED_SL_DURCHS_B1.KLASSENINDEX K_ED_SL_DURCHS_B1.OK_SCHWELLE K_ED_SL_DURCHS_B1.P_CODE_OPENLOAD K_ED_SL_DURCHS_B1.P_CODE_SH_TO_GND K_ED_SL_DURCHS_B1.P_CODE_SH_TO_UB K_ED_SL_DURCHS_B1.P_CODE_UNPLAUSIBEL K_ED_SL_DURCHS_B2.DEC_NACH_EINTRAG K_ED_SL_DURCHS_B2.DEC_VOR_EINTRAG K_ED_SL_DURCHS_B2.FEHLERSCHWELLE K_ED_SL_DURCHS_B2.INC_NACH_EINTRAG K_ED_SL_DURCHS_B2.INC_VOR_EINTRAG K_ED_SL_DURCHS_B2.KLASSENINDEX K_ED_SL_DURCHS_B2.OK_SCHWELLE K_ED_SL_DURCHS_B2.P_CODE_OPENLOAD K_ED_SL_DURCHS_B2.P_CODE_SH_TO_GND K_ED_SL_DURCHS_B2.P_CODE_SH_TO_UB K_ED_SL_DURCHS_B2.P_CODE_UNPLAUSIBEL K_ED_SL_DURCHS_HSTRANG.DEC_NACH_EINTRAG K_ED_SL_DURCHS_HSTRANG.DEC_VOR_EINTRAG K_ED_SL_DURCHS_HSTRANG.FEHLERSCHWELLE K_ED_SL_DURCHS_HSTRANG.INC_NACH_EINTRAG K_ED_SL_DURCHS_HSTRANG.INC_VOR_EINTRAG K_ED_SL_DURCHS_HSTRANG.KLASSENINDEX K_ED_SL_DURCHS_HSTRANG.OK_SCHWELLE K_ED_SL_DURCHS_HSTRANG.P_CODE_OPENLOAD K_ED_SL_DURCHS_HSTRANG.P_CODE_SH_TO_GND K_ED_SL_DURCHS_HSTRANG.P_CODE_SH_TO_UB K_ED_SL_DURCHS_HSTRANG.P_CODE_UNPLAUSIBEL K_ED_SL_ML_HFM.DEC_NACH_EINTRAG K_ED_SL_ML_HFM.DEC_VOR_EINTRAG K_ED_SL_ML_HFM.FEHLERSCHWELLE K_ED_SL_ML_HFM.INC_NACH_EINTRAG K_ED_SL_ML_HFM.INC_VOR_EINTRAG K_ED_SL_ML_HFM.KLASSENINDEX K_ED_SL_ML_HFM.OK_SCHWELLE K_ED_SL_ML_HFM.P_CODE_OPENLOAD K_ED_SL_ML_HFM.P_CODE_SH_TO_GND K_ED_SL_ML_HFM.P_CODE_SH_TO_UB K_ED_SL_ML_HFM.P_CODE_UNPLAUSIBEL K_ED_SL_ML_HFM_OBD.DEC_NACH_EINTRAG K_ED_SL_ML_HFM_OBD.DEC_VOR_EINTRAG K_ED_SL_ML_HFM_OBD.FEHLERSCHWELLE K_ED_SL_ML_HFM_OBD.INC_NACH_EINTRAG K_ED_SL_ML_HFM_OBD.INC_VOR_EINTRAG K_ED_SL_ML_HFM_OBD.KLASSENINDEX K_ED_SL_ML_HFM_OBD.OK_SCHWELLE K_ED_SL_ML_HFM_OBD.P_CODE_OPENLOAD K_ED_SL_ML_HFM_OBD.P_CODE_SH_TO_GND K_ED_SL_ML_HFM_OBD.P_CODE_SH_TO_UB K_ED_SL_ML_HFM_OBD.P_CODE_UNPLAUSIBEL K_ED_SSP.DEC_NACH_EINTRAG K_ED_SSP.DEC_VOR_EINTRAG K_ED_SSP.FEHLERSCHWELLE K_ED_SSP.INC_NACH_EINTRAG K_ED_SSP.INC_VOR_EINTRAG K_ED_SSP.KLASSENINDEX K_ED_SSP.OK_SCHWELLE K_ED_SSP.P_CODE_OPENLOAD K_ED_SSP.P_CODE_SH_TO_GND K_ED_SSP.P_CODE_SH_TO_UB K_ED_SSP.P_CODE_UNPLAUSIBEL K_ED_SSP_DIAG.DEC_NACH_EINTRAG K_ED_SSP_DIAG.DEC_VOR_EINTRAG K_ED_SSP_DIAG.FEHLERSCHWELLE K_ED_SSP_DIAG.INC_NACH_EINTRAG K_ED_SSP_DIAG.INC_VOR_EINTRAG K_ED_SSP_DIAG.KLASSENINDEX K_ED_SSP_DIAG.OK_SCHWELLE K_ED_SSP_DIAG.P_CODE_OPENLOAD K_ED_SSP_DIAG.P_CODE_SH_TO_GND K_ED_SSP_DIAG.P_CODE_SH_TO_UB K_ED_SSP_DIAG.P_CODE_UNPLAUSIBEL K_ED_S_GETR_HS.DEC_NACH_EINTRAG K_ED_S_GETR_HS.DEC_VOR_EINTRAG K_ED_S_GETR_HS.FEHLERSCHWELLE K_ED_S_GETR_HS.INC_NACH_EINTRAG K_ED_S_GETR_HS.INC_VOR_EINTRAG K_ED_S_GETR_HS.KLASSENINDEX K_ED_S_GETR_HS.OK_SCHWELLE K_ED_S_GETR_HS.P_CODE_OPENLOAD K_ED_S_GETR_HS.P_CODE_SH_TO_GND K_ED_S_GETR_HS.P_CODE_SH_TO_UB K_ED_S_GETR_HS.P_CODE_UNPLAUSIBEL K_ED_S_KUPP_HS.DEC_NACH_EINTRAG K_ED_S_KUPP_HS.DEC_VOR_EINTRAG K_ED_S_KUPP_HS.FEHLERSCHWELLE K_ED_S_KUPP_HS.INC_NACH_EINTRAG K_ED_S_KUPP_HS.INC_VOR_EINTRAG K_ED_S_KUPP_HS.KLASSENINDEX K_ED_S_KUPP_HS.OK_SCHWELLE K_ED_S_KUPP_HS.P_CODE_OPENLOAD K_ED_S_KUPP_HS.P_CODE_SH_TO_GND K_ED_S_KUPP_HS.P_CODE_SH_TO_UB K_ED_S_KUPP_HS.P_CODE_UNPLAUSIBEL K_ED_S_POEL_DIAG.DEC_NACH_EINTRAG K_ED_S_POEL_DIAG.DEC_VOR_EINTRAG K_ED_S_POEL_DIAG.FEHLERSCHWELLE K_ED_S_POEL_DIAG.INC_NACH_EINTRAG K_ED_S_POEL_DIAG.INC_VOR_EINTRAG K_ED_S_POEL_DIAG.KLASSENINDEX K_ED_S_POEL_DIAG.OK_SCHWELLE K_ED_S_POEL_DIAG.P_CODE_OPENLOAD K_ED_S_POEL_DIAG.P_CODE_SH_TO_GND K_ED_S_POEL_DIAG.P_CODE_SH_TO_UB K_ED_S_POEL_DIAG.P_CODE_UNPLAUSIBEL K_ED_TANK_LEER.DEC_NACH_EINTRAG K_ED_TANK_LEER.DEC_VOR_EINTRAG K_ED_TANK_LEER.FEHLERSCHWELLE K_ED_TANK_LEER.INC_NACH_EINTRAG K_ED_TANK_LEER.INC_VOR_EINTRAG K_ED_TANK_LEER.KLASSENINDEX K_ED_TANK_LEER.OK_SCHWELLE K_ED_TANK_LEER.P_CODE_OPENLOAD K_ED_TANK_LEER.P_CODE_SH_TO_GND K_ED_TANK_LEER.P_CODE_SH_TO_UB K_ED_TANK_LEER.P_CODE_UNPLAUSIBEL K_ED_TD.DEC_NACH_EINTRAG K_ED_TD.DEC_VOR_EINTRAG K_ED_TD.FEHLERSCHWELLE K_ED_TD.INC_NACH_EINTRAG K_ED_TD.INC_VOR_EINTRAG K_ED_TD.KLASSENINDEX K_ED_TD.OK_SCHWELLE K_ED_TD.P_CODE_OPENLOAD K_ED_TD.P_CODE_SH_TO_GND K_ED_TD.P_CODE_SH_TO_UB K_ED_TD.P_CODE_UNPLAUSIBEL K_ED_TEV1.DEC_NACH_EINTRAG K_ED_TEV1.DEC_VOR_EINTRAG K_ED_TEV1.FEHLERSCHWELLE K_ED_TEV1.INC_NACH_EINTRAG K_ED_TEV1.INC_VOR_EINTRAG K_ED_TEV1.KLASSENINDEX K_ED_TEV1.OK_SCHWELLE K_ED_TEV1.P_CODE_OPENLOAD K_ED_TEV1.P_CODE_SH_TO_GND K_ED_TEV1.P_CODE_SH_TO_UB K_ED_TEV1.P_CODE_UNPLAUSIBEL K_ED_TEV2.DEC_NACH_EINTRAG K_ED_TEV2.DEC_VOR_EINTRAG K_ED_TEV2.FEHLERSCHWELLE K_ED_TEV2.INC_NACH_EINTRAG K_ED_TEV2.INC_VOR_EINTRAG K_ED_TEV2.KLASSENINDEX K_ED_TEV2.OK_SCHWELLE K_ED_TEV2.P_CODE_OPENLOAD K_ED_TEV2.P_CODE_SH_TO_GND K_ED_TEV2.P_CODE_SH_TO_UB K_ED_TEV2.P_CODE_UNPLAUSIBEL K_ED_TE_OBD_1.DEC_NACH_EINTRAG K_ED_TE_OBD_1.DEC_VOR_EINTRAG K_ED_TE_OBD_1.FEHLERSCHWELLE K_ED_TE_OBD_1.INC_NACH_EINTRAG K_ED_TE_OBD_1.INC_VOR_EINTRAG K_ED_TE_OBD_1.KLASSENINDEX K_ED_TE_OBD_1.OK_SCHWELLE K_ED_TE_OBD_1.P_CODE_OPENLOAD K_ED_TE_OBD_1.P_CODE_SH_TO_GND K_ED_TE_OBD_1.P_CODE_SH_TO_UB K_ED_TE_OBD_1.P_CODE_UNPLAUSIBEL K_ED_TE_OBD_2.DEC_NACH_EINTRAG K_ED_TE_OBD_2.DEC_VOR_EINTRAG K_ED_TE_OBD_2.FEHLERSCHWELLE K_ED_TE_OBD_2.INC_NACH_EINTRAG K_ED_TE_OBD_2.INC_VOR_EINTRAG K_ED_TE_OBD_2.KLASSENINDEX K_ED_TE_OBD_2.OK_SCHWELLE K_ED_TE_OBD_2.P_CODE_OPENLOAD K_ED_TE_OBD_2.P_CODE_SH_TO_GND K_ED_TE_OBD_2.P_CODE_SH_TO_UB K_ED_TE_OBD_2.P_CODE_UNPLAUSIBEL K_ED_TGETR_HS.DEC_NACH_EINTRAG K_ED_TGETR_HS.DEC_VOR_EINTRAG K_ED_TGETR_HS.FEHLERSCHWELLE K_ED_TGETR_HS.INC_NACH_EINTRAG K_ED_TGETR_HS.INC_VOR_EINTRAG K_ED_TGETR_HS.KLASSENINDEX K_ED_TGETR_HS.OK_SCHWELLE K_ED_TGETR_HS.P_CODE_OPENLOAD K_ED_TGETR_HS.P_CODE_SH_TO_GND K_ED_TGETR_HS.P_CODE_SH_TO_UB K_ED_TGETR_HS.P_CODE_UNPLAUSIBEL K_ED_TZ1.DEC_NACH_EINTRAG K_ED_TZ1.DEC_VOR_EINTRAG K_ED_TZ1.FEHLERSCHWELLE K_ED_TZ1.INC_NACH_EINTRAG K_ED_TZ1.INC_VOR_EINTRAG K_ED_TZ1.KLASSENINDEX K_ED_TZ1.OK_SCHWELLE K_ED_TZ1.P_CODE_OPENLOAD K_ED_TZ1.P_CODE_SH_TO_GND K_ED_TZ1.P_CODE_SH_TO_UB K_ED_TZ1.P_CODE_UNPLAUSIBEL K_ED_TZ10.DEC_NACH_EINTRAG K_ED_TZ10.DEC_VOR_EINTRAG K_ED_TZ10.FEHLERSCHWELLE K_ED_TZ10.INC_NACH_EINTRAG K_ED_TZ10.INC_VOR_EINTRAG K_ED_TZ10.KLASSENINDEX K_ED_TZ10.OK_SCHWELLE K_ED_TZ10.P_CODE_OPENLOAD K_ED_TZ10.P_CODE_SH_TO_GND K_ED_TZ10.P_CODE_SH_TO_UB K_ED_TZ10.P_CODE_UNPLAUSIBEL K_ED_TZ2.DEC_NACH_EINTRAG K_ED_TZ2.DEC_VOR_EINTRAG K_ED_TZ2.FEHLERSCHWELLE K_ED_TZ2.INC_NACH_EINTRAG K_ED_TZ2.INC_VOR_EINTRAG K_ED_TZ2.KLASSENINDEX K_ED_TZ2.OK_SCHWELLE K_ED_TZ2.P_CODE_OPENLOAD K_ED_TZ2.P_CODE_SH_TO_GND K_ED_TZ2.P_CODE_SH_TO_UB K_ED_TZ2.P_CODE_UNPLAUSIBEL K_ED_TZ3.DEC_NACH_EINTRAG K_ED_TZ3.DEC_VOR_EINTRAG K_ED_TZ3.FEHLERSCHWELLE K_ED_TZ3.INC_NACH_EINTRAG K_ED_TZ3.INC_VOR_EINTRAG K_ED_TZ3.KLASSENINDEX K_ED_TZ3.OK_SCHWELLE K_ED_TZ3.P_CODE_OPENLOAD K_ED_TZ3.P_CODE_SH_TO_GND K_ED_TZ3.P_CODE_SH_TO_UB K_ED_TZ3.P_CODE_UNPLAUSIBEL K_ED_TZ4.DEC_NACH_EINTRAG K_ED_TZ4.DEC_VOR_EINTRAG K_ED_TZ4.FEHLERSCHWELLE K_ED_TZ4.INC_NACH_EINTRAG K_ED_TZ4.INC_VOR_EINTRAG K_ED_TZ4.KLASSENINDEX K_ED_TZ4.OK_SCHWELLE K_ED_TZ4.P_CODE_OPENLOAD K_ED_TZ4.P_CODE_SH_TO_GND K_ED_TZ4.P_CODE_SH_TO_UB K_ED_TZ4.P_CODE_UNPLAUSIBEL K_ED_TZ5.DEC_NACH_EINTRAG K_ED_TZ5.DEC_VOR_EINTRAG K_ED_TZ5.FEHLERSCHWELLE K_ED_TZ5.INC_NACH_EINTRAG K_ED_TZ5.INC_VOR_EINTRAG K_ED_TZ5.KLASSENINDEX K_ED_TZ5.OK_SCHWELLE K_ED_TZ5.P_CODE_OPENLOAD K_ED_TZ5.P_CODE_SH_TO_GND K_ED_TZ5.P_CODE_SH_TO_UB K_ED_TZ5.P_CODE_UNPLAUSIBEL K_ED_TZ6.DEC_NACH_EINTRAG K_ED_TZ6.DEC_VOR_EINTRAG K_ED_TZ6.FEHLERSCHWELLE K_ED_TZ6.INC_NACH_EINTRAG K_ED_TZ6.INC_VOR_EINTRAG K_ED_TZ6.KLASSENINDEX K_ED_TZ6.OK_SCHWELLE K_ED_TZ6.P_CODE_OPENLOAD K_ED_TZ6.P_CODE_SH_TO_GND K_ED_TZ6.P_CODE_SH_TO_UB K_ED_TZ6.P_CODE_UNPLAUSIBEL K_ED_TZ7.DEC_NACH_EINTRAG K_ED_TZ7.DEC_VOR_EINTRAG K_ED_TZ7.FEHLERSCHWELLE K_ED_TZ7.INC_NACH_EINTRAG K_ED_TZ7.INC_VOR_EINTRAG K_ED_TZ7.KLASSENINDEX K_ED_TZ7.OK_SCHWELLE K_ED_TZ7.P_CODE_OPENLOAD K_ED_TZ7.P_CODE_SH_TO_GND K_ED_TZ7.P_CODE_SH_TO_UB K_ED_TZ7.P_CODE_UNPLAUSIBEL K_ED_TZ8.DEC_NACH_EINTRAG K_ED_TZ8.DEC_VOR_EINTRAG K_ED_TZ8.FEHLERSCHWELLE K_ED_TZ8.INC_NACH_EINTRAG K_ED_TZ8.INC_VOR_EINTRAG K_ED_TZ8.KLASSENINDEX K_ED_TZ8.OK_SCHWELLE K_ED_TZ8.P_CODE_OPENLOAD K_ED_TZ8.P_CODE_SH_TO_GND K_ED_TZ8.P_CODE_SH_TO_UB K_ED_TZ8.P_CODE_UNPLAUSIBEL K_ED_TZ9.DEC_NACH_EINTRAG K_ED_TZ9.DEC_VOR_EINTRAG K_ED_TZ9.FEHLERSCHWELLE K_ED_TZ9.INC_NACH_EINTRAG K_ED_TZ9.INC_VOR_EINTRAG K_ED_TZ9.KLASSENINDEX K_ED_TZ9.OK_SCHWELLE K_ED_TZ9.P_CODE_OPENLOAD K_ED_TZ9.P_CODE_SH_TO_GND K_ED_TZ9.P_CODE_SH_TO_UB K_ED_TZ9.P_CODE_UNPLAUSIBEL K_ED_UBMIN K_ED_VAN_ANSCHL_A1.DEC_NACH_EINTRAG K_ED_VAN_ANSCHL_A1.DEC_VOR_EINTRAG K_ED_VAN_ANSCHL_A1.FEHLERSCHWELLE K_ED_VAN_ANSCHL_A1.INC_NACH_EINTRAG K_ED_VAN_ANSCHL_A1.INC_VOR_EINTRAG K_ED_VAN_ANSCHL_A1.KLASSENINDEX K_ED_VAN_ANSCHL_A1.OK_SCHWELLE K_ED_VAN_ANSCHL_A1.P_CODE_OPENLOAD K_ED_VAN_ANSCHL_A1.P_CODE_SH_TO_GND K_ED_VAN_ANSCHL_A1.P_CODE_SH_TO_UB K_ED_VAN_ANSCHL_A1.P_CODE_UNPLAUSIBEL K_ED_VAN_ANSCHL_A2.DEC_NACH_EINTRAG K_ED_VAN_ANSCHL_A2.DEC_VOR_EINTRAG K_ED_VAN_ANSCHL_A2.FEHLERSCHWELLE K_ED_VAN_ANSCHL_A2.INC_NACH_EINTRAG K_ED_VAN_ANSCHL_A2.INC_VOR_EINTRAG K_ED_VAN_ANSCHL_A2.KLASSENINDEX K_ED_VAN_ANSCHL_A2.OK_SCHWELLE K_ED_VAN_ANSCHL_A2.P_CODE_OPENLOAD K_ED_VAN_ANSCHL_A2.P_CODE_SH_TO_GND K_ED_VAN_ANSCHL_A2.P_CODE_SH_TO_UB K_ED_VAN_ANSCHL_A2.P_CODE_UNPLAUSIBEL K_ED_VAN_ANSCHL_E1.DEC_NACH_EINTRAG K_ED_VAN_ANSCHL_E1.DEC_VOR_EINTRAG K_ED_VAN_ANSCHL_E1.FEHLERSCHWELLE K_ED_VAN_ANSCHL_E1.INC_NACH_EINTRAG K_ED_VAN_ANSCHL_E1.INC_VOR_EINTRAG K_ED_VAN_ANSCHL_E1.KLASSENINDEX K_ED_VAN_ANSCHL_E1.OK_SCHWELLE K_ED_VAN_ANSCHL_E1.P_CODE_OPENLOAD K_ED_VAN_ANSCHL_E1.P_CODE_SH_TO_GND K_ED_VAN_ANSCHL_E1.P_CODE_SH_TO_UB K_ED_VAN_ANSCHL_E1.P_CODE_UNPLAUSIBEL K_ED_VAN_ANSCHL_E2.DEC_NACH_EINTRAG K_ED_VAN_ANSCHL_E2.DEC_VOR_EINTRAG K_ED_VAN_ANSCHL_E2.FEHLERSCHWELLE K_ED_VAN_ANSCHL_E2.INC_NACH_EINTRAG K_ED_VAN_ANSCHL_E2.INC_VOR_EINTRAG K_ED_VAN_ANSCHL_E2.KLASSENINDEX K_ED_VAN_ANSCHL_E2.OK_SCHWELLE K_ED_VAN_ANSCHL_E2.P_CODE_OPENLOAD K_ED_VAN_ANSCHL_E2.P_CODE_SH_TO_GND K_ED_VAN_ANSCHL_E2.P_CODE_SH_TO_UB K_ED_VAN_ANSCHL_E2.P_CODE_UNPLAUSIBEL K_ED_VAN_DRUCK.DEC_NACH_EINTRAG K_ED_VAN_DRUCK.DEC_VOR_EINTRAG K_ED_VAN_DRUCK.FEHLERSCHWELLE K_ED_VAN_DRUCK.INC_NACH_EINTRAG K_ED_VAN_DRUCK.INC_VOR_EINTRAG K_ED_VAN_DRUCK.KLASSENINDEX K_ED_VAN_DRUCK.OK_SCHWELLE K_ED_VAN_DRUCK.P_CODE_OPENLOAD K_ED_VAN_DRUCK.P_CODE_SH_TO_GND K_ED_VAN_DRUCK.P_CODE_SH_TO_UB K_ED_VAN_DRUCK.P_CODE_UNPLAUSIBEL K_ED_VAN_DSV.DEC_NACH_EINTRAG K_ED_VAN_DSV.DEC_VOR_EINTRAG K_ED_VAN_DSV.FEHLERSCHWELLE K_ED_VAN_DSV.INC_NACH_EINTRAG K_ED_VAN_DSV.INC_VOR_EINTRAG K_ED_VAN_DSV.KLASSENINDEX K_ED_VAN_DSV.OK_SCHWELLE K_ED_VAN_DSV.P_CODE_OPENLOAD K_ED_VAN_DSV.P_CODE_SH_TO_GND K_ED_VAN_DSV.P_CODE_SH_TO_UB K_ED_VAN_DSV.P_CODE_UNPLAUSIBEL K_ED_VAN_HALL_A1.DEC_NACH_EINTRAG K_ED_VAN_HALL_A1.DEC_VOR_EINTRAG K_ED_VAN_HALL_A1.FEHLERSCHWELLE K_ED_VAN_HALL_A1.INC_NACH_EINTRAG K_ED_VAN_HALL_A1.INC_VOR_EINTRAG K_ED_VAN_HALL_A1.KLASSENINDEX K_ED_VAN_HALL_A1.OK_SCHWELLE K_ED_VAN_HALL_A1.P_CODE_OPENLOAD K_ED_VAN_HALL_A1.P_CODE_SH_TO_GND K_ED_VAN_HALL_A1.P_CODE_SH_TO_UB K_ED_VAN_HALL_A1.P_CODE_UNPLAUSIBEL K_ED_VAN_HALL_A2.DEC_NACH_EINTRAG K_ED_VAN_HALL_A2.DEC_VOR_EINTRAG K_ED_VAN_HALL_A2.FEHLERSCHWELLE K_ED_VAN_HALL_A2.INC_NACH_EINTRAG K_ED_VAN_HALL_A2.INC_VOR_EINTRAG K_ED_VAN_HALL_A2.KLASSENINDEX K_ED_VAN_HALL_A2.OK_SCHWELLE K_ED_VAN_HALL_A2.P_CODE_OPENLOAD K_ED_VAN_HALL_A2.P_CODE_SH_TO_GND K_ED_VAN_HALL_A2.P_CODE_SH_TO_UB K_ED_VAN_HALL_A2.P_CODE_UNPLAUSIBEL K_ED_VAN_HALL_E1.DEC_NACH_EINTRAG K_ED_VAN_HALL_E1.DEC_VOR_EINTRAG K_ED_VAN_HALL_E1.FEHLERSCHWELLE K_ED_VAN_HALL_E1.INC_NACH_EINTRAG K_ED_VAN_HALL_E1.INC_VOR_EINTRAG K_ED_VAN_HALL_E1.KLASSENINDEX K_ED_VAN_HALL_E1.OK_SCHWELLE K_ED_VAN_HALL_E1.P_CODE_OPENLOAD K_ED_VAN_HALL_E1.P_CODE_SH_TO_GND K_ED_VAN_HALL_E1.P_CODE_SH_TO_UB K_ED_VAN_HALL_E1.P_CODE_UNPLAUSIBEL K_ED_VAN_HALL_E2.DEC_NACH_EINTRAG K_ED_VAN_HALL_E2.DEC_VOR_EINTRAG K_ED_VAN_HALL_E2.FEHLERSCHWELLE K_ED_VAN_HALL_E2.INC_NACH_EINTRAG K_ED_VAN_HALL_E2.INC_VOR_EINTRAG K_ED_VAN_HALL_E2.KLASSENINDEX K_ED_VAN_HALL_E2.OK_SCHWELLE K_ED_VAN_HALL_E2.P_CODE_OPENLOAD K_ED_VAN_HALL_E2.P_CODE_SH_TO_GND K_ED_VAN_HALL_E2.P_CODE_SH_TO_UB K_ED_VAN_HALL_E2.P_CODE_UNPLAUSIBEL K_ED_VAN_REGL_A1.DEC_NACH_EINTRAG K_ED_VAN_REGL_A1.DEC_VOR_EINTRAG K_ED_VAN_REGL_A1.FEHLERSCHWELLE K_ED_VAN_REGL_A1.INC_NACH_EINTRAG K_ED_VAN_REGL_A1.INC_VOR_EINTRAG K_ED_VAN_REGL_A1.KLASSENINDEX K_ED_VAN_REGL_A1.OK_SCHWELLE K_ED_VAN_REGL_A1.P_CODE_OPENLOAD K_ED_VAN_REGL_A1.P_CODE_SH_TO_GND K_ED_VAN_REGL_A1.P_CODE_SH_TO_UB K_ED_VAN_REGL_A1.P_CODE_UNPLAUSIBEL K_ED_VAN_REGL_A2.DEC_NACH_EINTRAG K_ED_VAN_REGL_A2.DEC_VOR_EINTRAG K_ED_VAN_REGL_A2.FEHLERSCHWELLE K_ED_VAN_REGL_A2.INC_NACH_EINTRAG K_ED_VAN_REGL_A2.INC_VOR_EINTRAG K_ED_VAN_REGL_A2.KLASSENINDEX K_ED_VAN_REGL_A2.OK_SCHWELLE K_ED_VAN_REGL_A2.P_CODE_OPENLOAD K_ED_VAN_REGL_A2.P_CODE_SH_TO_GND K_ED_VAN_REGL_A2.P_CODE_SH_TO_UB K_ED_VAN_REGL_A2.P_CODE_UNPLAUSIBEL K_ED_VAN_REGL_E1.DEC_NACH_EINTRAG K_ED_VAN_REGL_E1.DEC_VOR_EINTRAG K_ED_VAN_REGL_E1.FEHLERSCHWELLE K_ED_VAN_REGL_E1.INC_NACH_EINTRAG K_ED_VAN_REGL_E1.INC_VOR_EINTRAG K_ED_VAN_REGL_E1.KLASSENINDEX K_ED_VAN_REGL_E1.OK_SCHWELLE K_ED_VAN_REGL_E1.P_CODE_OPENLOAD K_ED_VAN_REGL_E1.P_CODE_SH_TO_GND K_ED_VAN_REGL_E1.P_CODE_SH_TO_UB K_ED_VAN_REGL_E1.P_CODE_UNPLAUSIBEL K_ED_VAN_REGL_E2.DEC_NACH_EINTRAG K_ED_VAN_REGL_E2.DEC_VOR_EINTRAG K_ED_VAN_REGL_E2.FEHLERSCHWELLE K_ED_VAN_REGL_E2.INC_NACH_EINTRAG K_ED_VAN_REGL_E2.INC_VOR_EINTRAG K_ED_VAN_REGL_E2.KLASSENINDEX K_ED_VAN_REGL_E2.OK_SCHWELLE K_ED_VAN_REGL_E2.P_CODE_OPENLOAD K_ED_VAN_REGL_E2.P_CODE_SH_TO_GND K_ED_VAN_REGL_E2.P_CODE_SH_TO_UB K_ED_VAN_REGL_E2.P_CODE_UNPLAUSIBEL K_ED_VAN_VENT_A1.DEC_NACH_EINTRAG K_ED_VAN_VENT_A1.DEC_VOR_EINTRAG K_ED_VAN_VENT_A1.FEHLERSCHWELLE K_ED_VAN_VENT_A1.INC_NACH_EINTRAG K_ED_VAN_VENT_A1.INC_VOR_EINTRAG K_ED_VAN_VENT_A1.KLASSENINDEX K_ED_VAN_VENT_A1.OK_SCHWELLE K_ED_VAN_VENT_A1.P_CODE_OPENLOAD K_ED_VAN_VENT_A1.P_CODE_SH_TO_GND K_ED_VAN_VENT_A1.P_CODE_SH_TO_UB K_ED_VAN_VENT_A1.P_CODE_UNPLAUSIBEL K_ED_VAN_VENT_A2.DEC_NACH_EINTRAG K_ED_VAN_VENT_A2.DEC_VOR_EINTRAG K_ED_VAN_VENT_A2.FEHLERSCHWELLE K_ED_VAN_VENT_A2.INC_NACH_EINTRAG K_ED_VAN_VENT_A2.INC_VOR_EINTRAG K_ED_VAN_VENT_A2.KLASSENINDEX K_ED_VAN_VENT_A2.OK_SCHWELLE K_ED_VAN_VENT_A2.P_CODE_OPENLOAD K_ED_VAN_VENT_A2.P_CODE_SH_TO_GND K_ED_VAN_VENT_A2.P_CODE_SH_TO_UB K_ED_VAN_VENT_A2.P_CODE_UNPLAUSIBEL K_ED_VAN_VENT_E1.DEC_NACH_EINTRAG K_ED_VAN_VENT_E1.DEC_VOR_EINTRAG K_ED_VAN_VENT_E1.FEHLERSCHWELLE K_ED_VAN_VENT_E1.INC_NACH_EINTRAG K_ED_VAN_VENT_E1.INC_VOR_EINTRAG K_ED_VAN_VENT_E1.KLASSENINDEX K_ED_VAN_VENT_E1.OK_SCHWELLE K_ED_VAN_VENT_E1.P_CODE_OPENLOAD K_ED_VAN_VENT_E1.P_CODE_SH_TO_GND K_ED_VAN_VENT_E1.P_CODE_SH_TO_UB K_ED_VAN_VENT_E1.P_CODE_UNPLAUSIBEL K_ED_VAN_VENT_E2.DEC_NACH_EINTRAG K_ED_VAN_VENT_E2.DEC_VOR_EINTRAG K_ED_VAN_VENT_E2.FEHLERSCHWELLE K_ED_VAN_VENT_E2.INC_NACH_EINTRAG K_ED_VAN_VENT_E2.INC_VOR_EINTRAG K_ED_VAN_VENT_E2.KLASSENINDEX K_ED_VAN_VENT_E2.OK_SCHWELLE K_ED_VAN_VENT_E2.P_CODE_OPENLOAD K_ED_VAN_VENT_E2.P_CODE_SH_TO_GND K_ED_VAN_VENT_E2.P_CODE_SH_TO_UB K_ED_VAN_VENT_E2.P_CODE_UNPLAUSIBEL K_ED_WUC_DELTA_TMOT K_ED_WUC_TMOT_MIN /end DEF_CHARACTERISTIC
/end FUNCTION
/begin RECORD_LAYOUT TKW_VV_VV_UB FNC_VALUES 1 UBYTE COLUMN_DIR DIRECT /end RECORD_LAYOUT
/begin RECORD_LAYOUT TKW_VV_VV_UW FNC_VALUES 1 UWORD COLUMN_DIR DIRECT /end RECORD_LAYOUT
/begin RECORD_LAYOUT TKW_VV_VV_SW FNC_VALUES 1 SWORD COLUMN_DIR DIRECT /end RECORD_LAYOUT
/end MODULE
/end PROJECT
