/begin PROJECT MSS65-inj-V452 "MSS65 INJ - V452.01-B204.00, data set 0569Q60Z160E"
/begin HEADER "" VERSION "V452.01-B204.00" /end HEADER
/begin MODULE _MSS65-inj "MSS65 INJ - V452.01-B204.00, calibration xxxxxxxx"
/begin MOD_COMMON "" BYTE_ORDER MSB_FIRST /* Default byteorder (Motorola) */ /end MOD_COMMON
/begin COMPU_METHOD FORMULA_0003 "FORMULA_0003" RAT_FUNC "%3.0" "-" COEFFS 0 1 0 0 0 1 /end COMPU_METHOD
/begin COMPU_METHOD FORMULA_0010 "FORMULA_0010" RAT_FUNC "%5.0" "-" COEFFS 0 1 0 0 0 1 /end COMPU_METHOD
/begin COMPU_METHOD FORMULA_0024 "FORMULA_0024" RAT_FUNC "%9.4" "-" COEFFS 0 32768 0 0 0 1 /end COMPU_METHOD
/begin COMPU_METHOD FORMULA_0049 "FORMULA_0049" TAB_VERB "%7.2" "-" COMPU_TAB_REF FORMULA_0049_VTAB /end COMPU_METHOD
/begin COMPU_VTAB FORMULA_0049_VTAB "FORMULA_0049_VTAB" TAB_VERB 44 0 "O.K." 1 "SH_TO_UB" 2 "SH_TO_GND" 4 "OPENLOAD" 8 "UNPLAUSI" 256 "O.K./ZYKLUS" 512 "FILTER" 513 "FIL/SH_TO_UB" 514 "FIL/SH_TO_GND" 516 "FIL/OPENLOAD" 520 "FIL/UNPLAUSI" 576 "VORHANDEN" 577 "VORH/SH_TO_UB" 578 "VORH/SH_TO_GND" 580 "VORH/OPENLOAD" 584 "VORH/UNPLAUSI" 768 "FILTER/ZYKLUS" 769 "FIL/ZYK/SH_TO_UB" 770 "FIL/ZYK/SH_TO_GND" 772 "FIL/ZYK/OPENLOAD" 776 "FIL/ZYK/UNPLAUSI" 832 "VORHANDEN/ZYKLUS" 833 "VORH/ZYK/SH_TO_UB" 834 "VORH/ZYK/SH_TO_GND" 836 "VORH/ZYK/OPENLOAD" 840 "VORH/ZYK/UNPLAUSI" 2048 "O.K./SCDN" 2304 "O.K./S/ZYKLUS" 2561 "FIL/S/SH_TO_UB" 2562 "FIL/S/SH_TO_GND" 2564 "FIL/S/OPENLOAD" 2568 "FIL/S/UNPLAUSI" 2625 "VORH/S/SH_TO_UB" 2626 "VORH/S/SH_TO_GND" 2628 "VORH/S/OPENLOAD" 2632 "VORH/S/UNPLAUSI" 2817 "FIL/ZYK/S/SH_TO_UB" 2818 "FIL/ZYK/S/SH_TO_GND" 2820 "FIL/ZYK/S/OPENLOAD" 2824 "FIL/ZYK/S/UNPLAUSI" 2881 "VORH/ZYK/S/SH_TO_UB" 2882 "VORH/ZYK/S/SH_TO_GND" 2884 "VORH/ZYK/S/OPENLOAD" 2888 "VORH/ZYK/S/UNPLAUSI" /end COMPU_VTAB
/begin COMPU_METHOD FORMULA_0050 "FORMULA_0050" TAB_VERB "%5.0" "-" COMPU_TAB_REF FORMULA_0050_VTAB /end COMPU_METHOD
/begin COMPU_VTAB FORMULA_0050_VTAB "FORMULA_0050_VTAB" TAB_VERB 352 10000 "SK_INJ_TESTFEHLER" 10001 "PUMG_FEHLER" 10002 "HFM1_FEHLER" 10003 "HFM2_FEHLER" 10004 "PSAU1_FEHLER" 10005 "PSAU2_FEHLER" 10006 "VAN_HALL_E1_FEHLER" 10007 "VAN_HALL_A1_FEHLER" 10008 "VAN_HALL_E2_FEHLER" 10009 "VAN_HALL_A2_FEHLER" 10010 "VAN_REGL_E1_FEHLER" 10011 "VAN_REGL_A1_FEHLER" 10012 "VAN_REGL_E2_FEHLER" 10013 "VAN_REGL_A2_FEHLER" 10014 "NW1_SYNC_FEHLER" 10015 "NW2_SYNC_FEHLER" 10016 "PCTRL_IGN_FEHLER" 10017 "PT_TORQDKG_FEHLER" 10018 "PKS_FEHLER" 10019 "PT_STATUSR_FEHLER" 10020 "LAVK1_FEHLER" 10021 "LAVK2_FEHLER" 10022 "LAVK1_OBD_PLAU_FEHLER" 10023 "LAVK2_OBD_PLAU_FEHLER" 10024 "LAVK1_OBD_SA_FEHLER" 10025 "LAVK2_OBD_SA_FEHLER" 10026 "LANK1_FEHLER" 10027 "LANK2_FEHLER" 10028 "LSHNK1_FEHLER" 10029 "LSHNK2_FEHLER" 52615 "PT_BUSOFF" 52632 "PT_TORQDSC_FEHLER" 52645 "PT_STDSC_FEHLER" 52667 "PT_VRAD_FEHLER" 52636 "PT_VFZG_FEHLER" 52628 "PT_ATEMP_FEHLER" 52640 "PT_KLST_FEHLER" 52649 "PT_KKOS_FEHLER" 52641 "PT_LRW_FEHLER" 10039 "FPLAU1_FEHLER" 10040 "FPLAU2_FEHLER" 10041 "SL_ML_HFM_FEHLER" 10042 "LANK1_OBD_S_FEHLER" 10043 "LANK2_OBD_S_FEHLER" 10044 "LAVK1_OBD_TL_FEHLER" 10045 "LAVK2_OBD_TL_FEHLER" 10046 "LSHVK1_FEHLER" 10047 "LSHVK2_FEHLER" 10048 "LSRVK1_OBD_REG_FEHLER" 10049 "LSRVK2_OBD_REG_FEHLER" 10050 "LSHVK1_R_FEHLER" 10051 "LSHVK2_R_FEHLER" 10052 "LSRVK1_OBD_START_FEHLER" 10053 "LSRVK2_OBD_START_FEHLER" 10054 "LSRVK1_OBD_REF_FEHLER" 10055 "LSRVK2_OBD_REF_FEHLER" 10056 "LAVK1_DIAG_FEHLER" 10057 "LAVK2_DIAG_FEHLER" 10058 "LAVK1_IA_OPENLOAD_FEHLER" 10059 "LAVK2_IA_OPENLOAD_FEHLER" 10060 "PT_GRB_FEHLER" 10061 "PT_GRB2_FEHLER" 10062 "LAVK1_UN_OPENLOAD_FEHLER" 10063 "LAVK2_UN_OPENLOAD_FEHLER" 10064 "LAVK1_IP_OPENLOAD_FEHLER" 10065 "LAVK2_IP_OPENLOAD_FEHLER" 10066 "APPL_DATA_INJ" 10067 "TZ1_FEHLER" 10068 "TZ2_FEHLER" 10069 "TZ3_FEHLER" 10070 "TZ4_FEHLER" 10071 "TZ5_FEHLER" 10072 "TZ6_FEHLER" 10073 "TZ7_FEHLER" 10074 "TZ8_FEHLER" 10075 "TZ9_FEHLER" 10076 "TZ10_FEHLER" 10077 "LAM1_REG_FEHLER" 10078 "LAM2_REG_FEHLER" 10079 "VAN_ANSCHL_E1_FEHLER" 10080 "VAN_ANSCHL_A1_FEHLER" 10081 "VAN_ANSCHL_E2_FEHLER" 10082 "VAN_ANSCHL_A2_FEHLER" 10083 "VAN_VENT_E1_FEHLER" 10084 "VAN_VENT_A1_FEHLER" 10085 "VAN_VENT_E2_FEHLER" 10086 "VAN_VENT_A2_FEHLER" 10087 "EV1_FEHLER" 10088 "EV2_FEHLER" 10089 "EV3_FEHLER" 10090 "EV4_FEHLER" 10091 "EV5_FEHLER" 10092 "EV6_FEHLER" 10093 "EV7_FEHLER" 10094 "EV8_FEHLER" 10095 "EV9_FEHLER" 10096 "EV10_FEHLER" 10097 "LAVK1_OBD_DYN_FEHLER" 10098 "LAVK2_OBD_DYN_FEHLER" 52650 "PT_CRASH_FEHLER" 52635 "PT_VEHMOD_FEHLER" 52629 "PT_BEDFGR_FEHLER" 10102 "DMTL_P_FEHLER" 10103 "DMTL_V_FEHLER" 10104 "DMTL_H_FEHLER" 10105 "DMTL_GROBLECK_FEHLER" 10106 "DMTL_FEUCHT_FEHLER" 10107 "DMTL_DECKEL_MELDUNG" 10108 "LA1_TRIM_FEHLER" 10109 "LA2_TRIM_FEHLER" 10110 "RLU87_FEHLER" 10111 "EKP_PWM_FEHLER" 10112 "SSP_FEHLER" 10113 "TD_FEHLER" 10114 "RLSLP_FEHLER" 10115 "SLV_FEHLER" 52639 "PT_KMST_FEHLER" 52648 "PT_STATKOM_FEHLER" 10118 "PKS_LL_FEHLER" 10119 "PKS_TL_FEHLER" 10120 "PKS_Q_FEHLER" 10121 "KAT_OBD1_FEHLER" 10122 "KAT_OBD2_FEHLER" 10123 "VAN_DSV_FEHLER" 10124 "FI_GEN" 10125 "FI_BSD" 10126 "FI_QLT" 10127 "FI_IBS1" 10128 "FI_IBS2" 10129 "FI_IBS3" 10130 "FI_PMBN" 10131 "FI_PMBATT" 10132 "MVAC_DRUCKSENSOR" 52668 "PT_BEDAT_FEHLER" 10134 "SK_MANAGER_INJ" 10135 "SSP_DIAG_FEHLER" 10136 "EWS_SCI_FEHLER" 10137 "EWS_MAN_FEHLER" 10138 "FI_BSD_0" 10139 "FI_BSD_6" 10140 "FI_BSDGLOB" 10141 "FI_PMRUHVERL" 10142 "FI_TOENS" 10143 "EBOX_ELU_FEHLER" 10144 "SG_INJ_FEHLER" 10145 "EGAS_ENLTG1_DIAG" 10146 "EGAS_ENLTG2_DIAG" 10147 "S_POEL_FEHLER" 10148 "TEV1_OBD_FEHLER" 10149 "TEV2_OBD_FEHLER" 10150 "TEV1_FEHLER" 10151 "TEV2_FEHLER" 10152 "EBENE2_INJ_FEHLER" 10153 "KW_FEHLER" 10154 "LA1_ADAPT_FEHLER" 10155 "LA2_ADAPT_FEHLER" 10156 "KGE1_FEHLER" 10157 "KGE2_FEHLER" 10158 "FST_FEHLER" 10159 "SLP_FEHLER" 10160 "SL_DURCHS_B1" 10161 "SL_DURCHS_B2" 10162 "SL_DURCHS_HSTRANG" 10163 "FETRAWE_FEHLER" 10164 "S_GETR_HS_FEHLER" 10165 "S_KUPP_HS_FEHLER" 10166 "VAN_DRUCK_FEHLER" 10167 "ELUP_FEHLER" 10168 "ELU_FEHLER" 52655 "PT_STATANH_FEHLER" 10170 "KSD1_FEHLER" 10171 "KSD2_FEHLER" 10172 "KATS1_FEHLER" 10173 "KATS2_FEHLER" 10174 "PT_STATGRB_FEHLER" 10175 "PT_ANFRADMOM_FEHLER" 10176 "FST_GEBER_FEHLER" 10177 "TANK_LEER_INFO" 10178 "PT_TOMA_FEHLER" 10179 "DMTL_FEINLECK_FEHLER" 10180 "PUMG_OBD_FEHLER" 10181 "SL_ML_HFM_OBD_FEHLER" 10182 "LA1_TRIM_AD_FEHLER" 10183 "LA2_TRIM_AD_FEHLER" 10184 "LANK1_OPENLOAD_FEHLER" 10185 "LANK2_OPENLOAD_FEHLER" 10186 "LANK1_OBD_WE_FEHLER" 10187 "LANK2_OBD_WE_FEHLER" 10188 "LSHNK1_R_FEHLER" 10189 "LSHNK2_R_FEHLER" 10190 "PKS_MODELL_FEHLER" 10191 "PKS_PAUFBAU_FEHLER" 10192 "PKSR_ADAPT_ANSCHL_FEHLER" 10193 "TGETR_FEHLER" 10194 "LAVK_ATIC42_FEHLER" 10195 "PT_ALAENGS_FEHLER" 10196 "PT_OBD_ED_FEHLER" 10197 "FST_GEBER_LI_FEHLER" 10198 "FST_GEBER_RE_FEHLER" 10199 "LANK1_OBD_SLOPE_FEHLER" 10200 "LANK2_OBD_SLOPE_FEHLER" 10201 "MVAC_OBD_FEHLER" 10202 "ELUP_OBD_FEHLER" 10203 "LAVK2_ATIC42_FEHLER" 10204 "INDEX_204_INJ" 10205 "INDEX_205_INJ" 10206 "INDEX_206_INJ" 10207 "INDEX_207_INJ" 10208 "INDEX_208_INJ" 10209 "INDEX_209_INJ" 10210 "INDEX_210_INJ" 10211 "INDEX_211_INJ" 10212 "INDEX_212_INJ" 10213 "INDEX_213_INJ" 10214 "INDEX_214_INJ" 10215 "INDEX_215_INJ" 10216 "INDEX_216_INJ" 10217 "INDEX_217_INJ" 10218 "INDEX_218_INJ" 10219 "INDEX_219_INJ" 10220 "INDEX_220_INJ" 10221 "INDEX_221_INJ" 10222 "INDEX_222_INJ" 10223 "INDEX_223_INJ" 11000 "SK_IGN_TESTFEHLER" 11001 "TMOT_FEHLER" 11002 "TMOT_OBD_FEHLER" 11003 "TAN1_FEHLER" 11004 "TAN2_FEHLER" 11005 "TIME_REL_OBD_FEHLER" 11006 "UB_FEHLER" 11007 "TKA_FEHLER" 11008 "TDME_FEHLER" 11009 "UEXT_111_219_514_FEHLER" 11010 "UEXT_124_512_FEHLER" 11011 "APPL_DATA_IGN" 11012 "TKA_OBD_FEHLER" 11013 "PWG1_FEHLER" 11014 "PWG2_FEHLER" 11015 "PWG_VGL_FEHLER" 11016 "PCTRL_INJ_FEHLER" 52669 "EC_LLS1_FEHLER" 52670 "EC_LLS2_FEHLER" 52671 "EC_DK1_FEHLER" 52672 "EC_DK2_FEHLER" 11021 "LLS1_SK_FEHLER" 11022 "LLS2_SK_FEHLER" 11023 "SMG_SCHALTABLAUF" 11024 "SMG_SK_FEHLER" 11025 "SMG_SK_N_UEBERWACHUNG" 11026 "TUMG_OBD_FEHLER" 11027 "V_FEHLER" 11028 "DK_INIT_FEHLER" 11029 "DK1_REG_FEHLER" 11030 "DK2_REG_FEHLER" 11031 "DK1_ADAPT_FEHLER" 11032 "DK2_ADAPT_FEHLER" 11033 "IONVERST_B1" 11034 "IONSPG_B1" 11035 "IONVERST_B2" 11036 "IONSPG_B2" 11037 "TABG1_FEHLER" 11038 "TABG2_FEHLER" 11039 "DK1_WDK_FEHLER" 11040 "DK2_WDK_FEHLER" 11041 "DK1_PDR_FEHLER" 11042 "DK2_PDR_FEHLER" 11043 "LLS1_REG_FEHLER" 11044 "LLS2_REG_FEHLER" 11045 "DK1_SK_FEHLER" 11046 "DK2_SK_FEHLER" 11047 "DK1_FT_FEHLER" 11048 "DK2_FT_FEHLER" 11049 "MD_SK_ERR" 11050 "LLS_INIT_FEHLER" 11051 "DSC_EINGR_FEHLER" 11052 "DK1_CMD_FEHLER" 11053 "DK2_CMD_FEHLER" 11054 "LLS1_CMD_FEHLER" 11055 "LLS2_CMD_FEHLER" 52673 "SC_SMG1_FEHLER" 52674 "SC_SMG2_FEHLER" 52675 "SC_SMG3_FEHLER" 52619 "SC_BUSOFF_FEHLER" 52627 "EC_BUSOFF_FEHLER" 11061 "AUSS_KAT_Z1_FEHLER" 11062 "AUSS_KAT_Z2_FEHLER" 11063 "AUSS_KAT_Z3_FEHLER" 11064 "AUSS_KAT_Z4_FEHLER" 11065 "AUSS_KAT_Z5_FEHLER" 11066 "AUSS_KAT_Z6_FEHLER" 11067 "AUSS_KAT_Z7_FEHLER" 11068 "AUSS_KAT_Z8_FEHLER" 11069 "AUSS_KAT_Z9_FEHLER" 11070 "AUSS_KAT_Z10_FEHLER" 11071 "ION_SIG_BANK_1" 11072 "ION_SIG_BANK_2" 11073 "AUSS_KAT_MULT_FEHLER" 11074 "AUSS_ABG_Z1_FEHLER" 11075 "AUSS_ABG_Z2_FEHLER" 11076 "AUSS_ABG_Z3_FEHLER" 11077 "AUSS_ABG_Z4_FEHLER" 11078 "AUSS_ABG_Z5_FEHLER" 11079 "AUSS_ABG_Z6_FEHLER" 11080 "AUSS_ABG_Z7_FEHLER" 11081 "AUSS_ABG_Z8_FEHLER" 11082 "AUSS_ABG_Z9_FEHLER" 11083 "AUSS_ABG_Z10_FEHLER" 11084 "ION_SAT_BANK_1" 11085 "ION_SAT_BANK_2" 11086 "AUSS_ABG_MULT_FEHLER" 11087 "TAN_OBD_B1_FEHLER" 11088 "DKG_EINGR_FEHLER" 11089 "SC_PKS_FEHLER" 11090 "ZOELP1_FEHLER" 11091 "ZOELP2_FEHLER" 11092 "SG_IGN_FEHLER" 11093 "EBENE2_IGN_FEHLER" 11094 "BLS_PLAU_FEHLER" 11095 "SK_MANAGER_IGN" 11096 "LLR_DIAGNOSE" 11097 "THERMOSTAT_FEHLER" 11098 "TAN_OBD_B2_FEHLER" 11099 "DK1_ZUSTAND" 11100 "DK2_ZUSTAND" 11101 "FGR_ABWURF" 11102 "PWG_BLS_FEHLER" 11103 "START_RL_FEHLER" 11104 "AFZ_FEHLER" 11105 "N_GETR_EIN_HS_FEHLER" 11106 "TUMG_FEHLER" 11107 "LLR_DIAGNOSE_CSS" 11108 "TMOT_HIGH_FEHLER" 11109 "AFZ_NA_FEHLER" 11110 "INDEX_110_IGN" 11111 "INDEX_111_IGN" 11112 "INDEX_112_IGN" 11113 "INDEX_113_IGN" 11114 "INDEX_114_IGN" 11115 "INDEX_115_IGN" 11116 "INDEX_116_IGN" 11117 "INDEX_117_IGN" 11118 "INDEX_118_IGN" 11119 "INDEX_119_IGN" 11120 "INDEX_120_IGN" 11121 "INDEX_121_IGN" 11122 "INDEX_122_IGN" 11123 "INDEX_123_IGN" 11124 "INDEX_124_IGN" 11125 "INDEX_125_IGN" 11126 "INDEX_126_IGN" 11127 "INDEX_127_IGN" /end COMPU_VTAB
/begin COMPU_METHOD FORMULA_0051 "FORMULA_0051" RAT_FUNC "%5.0" "km" COEFFS 0 1 0 0 0 8 /end COMPU_METHOD
/begin COMPU_METHOD FORMULA_0052 "FORMULA_0052" RAT_FUNC "%5.0" "-" COEFFS 0 4 0 0 0 1 /end COMPU_METHOD
/begin COMPU_METHOD FORMULA_0053 "FORMULA_0053" RAT_FUNC "%7.2" "g/s" COEFFS 0 100 0 0 0 1 /end COMPU_METHOD
/begin COMPU_METHOD FORMULA_0054 "FORMULA_0054" TAB_VERB "%3.0" "-" COMPU_TAB_REF FORMULA_0054_VTAB /end COMPU_METHOD
/begin COMPU_VTAB FORMULA_0054_VTAB "FORMULA_0054_VTAB" TAB_VERB 4 1 "Regler noch aus" 2 "Regler aktiv" 4 "Schubabschalten" 8 "Sonde defekt" /end COMPU_VTAB
/begin COMPU_METHOD FORMULA_0055 "FORMULA_0055" RAT_FUNC "%7.4" "-" COEFFS 0 128 0 0 0 1 /end COMPU_METHOD
/begin COMPU_METHOD FORMULA_0056 "FORMULA_0056" RAT_FUNC "%7.4" "%" COEFFS 0 255 0 0 0 100 /end COMPU_METHOD
/begin COMPU_METHOD FORMULA_0057 "FORMULA_0057" RAT_FUNC "%3.0" "�C" COEFFS 0 1 40 0 0 1 /end COMPU_METHOD
/begin COMPU_METHOD FORMULA_0058 "FORMULA_0058" RAT_FUNC "%3.0" "kPa" COEFFS 0 1 0 0 0 3 /end COMPU_METHOD
/begin COMPU_METHOD FORMULA_0059 "FORMULA_0059" RAT_FUNC "%3.0" "km/h" COEFFS 0 1 0 0 0 1 /end COMPU_METHOD
/begin COMPU_METHOD FORMULA_0060 "FORMULA_0060" RAT_FUNC "%4.1" "�KW" COEFFS 0 2 128 0 0 1 /end COMPU_METHOD
/begin COMPU_METHOD FORMULA_0061 "FORMULA_0061" TAB_VERB "%3.0" "-" COMPU_TAB_REF FORMULA_0061_VTAB /end COMPU_METHOD
/begin COMPU_VTAB FORMULA_0061_VTAB "FORMULA_0061_VTAB" TAB_VERB 2 1 "Einblasung" 4 "Keine Einblasung" /end COMPU_VTAB
/begin COMPU_METHOD FORMULA_0062 "FORMULA_0062" RAT_FUNC "%5.0" "s" COEFFS 0 1 0 0 0 1 /end COMPU_METHOD
/begin COMPU_METHOD FORMULA_0063 "FORMULA_0063" RAT_FUNC "%8.3" "V" COEFFS 0 1000 0 0 0 1 /end COMPU_METHOD
/begin COMPU_METHOD FORMULA_0064 "FORMULA_0064" RAT_FUNC "%9.4" "%" COEFFS 0 255 0 0 0 1 /end COMPU_METHOD
/begin COMPU_METHOD FORMULA_0065 "FORMULA_0065" RAT_FUNC "%5.2" "%" COEFFS 0 255 0 0 0 100 /end COMPU_METHOD
/begin COMPU_METHOD FORMULA_0066 "FORMULA_0066" RAT_FUNC "%3.0" "kPa" COEFFS 0 1 0 0 0 1 /end COMPU_METHOD
/begin MEASUREMENT ed_fil_sk_tr_inj.filter_nv "Filterwert vor und nach Eintrag" UBYTE FORMULA_0003 0 0 0.0 255.0000 ECU_ADDRESS 0x3F9870 /end MEASUREMENT
/begin MEASUREMENT ed_fil_pumg.filter_nv "Filterwert vor und nach Eintrag" UBYTE FORMULA_0003 0 0 0.0 255.0000 ECU_ADDRESS 0x3F9876 /end MEASUREMENT
/begin MEASUREMENT ed_fil_psau1.filter_nv "Filterwert vor und nach Eintrag" UBYTE FORMULA_0003 0 0 0.0 255.0000 ECU_ADDRESS 0x3F9888 /end MEASUREMENT
/begin MEASUREMENT ed_fil_psau2.filter_nv "Filterwert vor und nach Eintrag" UBYTE FORMULA_0003 0 0 0.0 255.0000 ECU_ADDRESS 0x3F988E /end MEASUREMENT
/begin MEASUREMENT ed_fil_van_hall_e1.filter_nv "Filterwert vor und nach Eintrag" UBYTE FORMULA_0003 0 0 0.0 255.0000 ECU_ADDRESS 0x3F9894 /end MEASUREMENT
/begin MEASUREMENT ed_fil_van_hall_a1.filter_nv "Filterwert vor und nach Eintrag" UBYTE FORMULA_0003 0 0 0.0 255.0000 ECU_ADDRESS 0x3F989A /end MEASUREMENT
/begin MEASUREMENT ed_fil_van_hall_e2.filter_nv "Filterwert vor und nach Eintrag" UBYTE FORMULA_0003 0 0 0.0 255.0000 ECU_ADDRESS 0x3F98A0 /end MEASUREMENT
/begin MEASUREMENT ed_fil_van_hall_a2.filter_nv "Filterwert vor und nach Eintrag" UBYTE FORMULA_0003 0 0 0.0 255.0000 ECU_ADDRESS 0x3F98A6 /end MEASUREMENT
/begin MEASUREMENT ed_fil_van_regl_e1.filter_nv "Filterwert vor und nach Eintrag" UBYTE FORMULA_0003 0 0 0.0 255.0000 ECU_ADDRESS 0x3F98AC /end MEASUREMENT
/begin MEASUREMENT ed_fil_van_regl_a1.filter_nv "Filterwert vor und nach Eintrag" UBYTE FORMULA_0003 0 0 0.0 255.0000 ECU_ADDRESS 0x3F98B2 /end MEASUREMENT
/begin MEASUREMENT ed_fil_van_regl_e2.filter_nv "Filterwert vor und nach Eintrag" UBYTE FORMULA_0003 0 0 0.0 255.0000 ECU_ADDRESS 0x3F98B8 /end MEASUREMENT
/begin MEASUREMENT ed_fil_van_regl_a2.filter_nv "Filterwert vor und nach Eintrag" UBYTE FORMULA_0003 0 0 0.0 255.0000 ECU_ADDRESS 0x3F98BE /end MEASUREMENT
/begin MEASUREMENT ed_fil_nw1_sync.filter_nv "Filterwert vor und nach Eintrag" UBYTE FORMULA_0003 0 0 0.0 255.0000 ECU_ADDRESS 0x3F98C4 /end MEASUREMENT
/begin MEASUREMENT ed_fil_nw2_sync.filter_nv "Filterwert vor und nach Eintrag" UBYTE FORMULA_0003 0 0 0.0 255.0000 ECU_ADDRESS 0x3F98CA /end MEASUREMENT
/begin MEASUREMENT ed_fil_pctrl_inj.filter_nv "Filterwert vor und nach Eintrag" UBYTE FORMULA_0003 0 0 0.0 255.0000 ECU_ADDRESS 0x3F98D0 /end MEASUREMENT
/begin MEASUREMENT ed_fil_pt_statdkg.filter_nv "Filterwert vor und nach Eintrag" UBYTE FORMULA_0003 0 0 0.0 255.0000 ECU_ADDRESS 0x3F98D6 /end MEASUREMENT
/begin MEASUREMENT ed_fil_pks.filter_nv "Filterwert vor und nach Eintrag" UBYTE FORMULA_0003 0 0 0.0 255.0000 ECU_ADDRESS 0x3F98DC /end MEASUREMENT
/begin MEASUREMENT ed_fil_pt_statr.filter_nv "Filterwert vor und nach Eintrag" UBYTE FORMULA_0003 0 0 0.0 255.0000 ECU_ADDRESS 0x3F98E2 /end MEASUREMENT
/begin MEASUREMENT ed_fil_lavk1.filter_nv "Filterwert vor und nach Eintrag" UBYTE FORMULA_0003 0 0 0.0 255.0000 ECU_ADDRESS 0x3F98E8 /end MEASUREMENT
/begin MEASUREMENT ed_fil_lavk2.filter_nv "Filterwert vor und nach Eintrag" UBYTE FORMULA_0003 0 0 0.0 255.0000 ECU_ADDRESS 0x3F98EE /end MEASUREMENT
/begin MEASUREMENT ed_fil_lavk1_obd_plau.filter_nv "Filterwert vor und nach Eintrag" UBYTE FORMULA_0003 0 0 0.0 255.0000 ECU_ADDRESS 0x3F98F4 /end MEASUREMENT
/begin MEASUREMENT ed_fil_lavk2_obd_plau.filter_nv "Filterwert vor und nach Eintrag" UBYTE FORMULA_0003 0 0 0.0 255.0000 ECU_ADDRESS 0x3F98FA /end MEASUREMENT
/begin MEASUREMENT ed_fil_lavk1_obd_sa.filter_nv "Filterwert vor und nach Eintrag" UBYTE FORMULA_0003 0 0 0.0 255.0000 ECU_ADDRESS 0x3F9900 /end MEASUREMENT
/begin MEASUREMENT ed_fil_lavk2_obd_sa.filter_nv "Filterwert vor und nach Eintrag" UBYTE FORMULA_0003 0 0 0.0 255.0000 ECU_ADDRESS 0x3F9906 /end MEASUREMENT
/begin MEASUREMENT ed_fil_lank2.filter_nv "Filterwert vor und nach Eintrag" UBYTE FORMULA_0003 0 0 0.0 255.0000 ECU_ADDRESS 0x3F9912 /end MEASUREMENT
/begin MEASUREMENT ed_fil_lshnk1.filter_nv "Filterwert vor und nach Eintrag" UBYTE FORMULA_0003 0 0 0.0 255.0000 ECU_ADDRESS 0x3F9918 /end MEASUREMENT
/begin MEASUREMENT ed_fil_lshnk2.filter_nv "Filterwert vor und nach Eintrag" UBYTE FORMULA_0003 0 0 0.0 255.0000 ECU_ADDRESS 0x3F991E /end MEASUREMENT
/begin MEASUREMENT ed_fil_pt_busoff.filter_nv "Filterwert vor und nach Eintrag" UBYTE FORMULA_0003 0 0 0.0 255.0000 ECU_ADDRESS 0x3F9924 /end MEASUREMENT
/begin MEASUREMENT ed_fil_pt_torqdsc.filter_nv "Filterwert vor und nach Eintrag" UBYTE FORMULA_0003 0 0 0.0 255.0000 ECU_ADDRESS 0x3F992A /end MEASUREMENT
/begin MEASUREMENT ed_fil_pt_stdsc.filter_nv "Filterwert vor und nach Eintrag" UBYTE FORMULA_0003 0 0 0.0 255.0000 ECU_ADDRESS 0x3F9930 /end MEASUREMENT
/begin MEASUREMENT ed_fil_pt_vrad.filter_nv "Filterwert vor und nach Eintrag" UBYTE FORMULA_0003 0 0 0.0 255.0000 ECU_ADDRESS 0x3F9936 /end MEASUREMENT
/begin MEASUREMENT ed_fil_pt_vfzg.filter_nv "Filterwert vor und nach Eintrag" UBYTE FORMULA_0003 0 0 0.0 255.0000 ECU_ADDRESS 0x3F993C /end MEASUREMENT
/begin MEASUREMENT ed_fil_pt_atemp.filter_nv "Filterwert vor und nach Eintrag" UBYTE FORMULA_0003 0 0 0.0 255.0000 ECU_ADDRESS 0x3F9942 /end MEASUREMENT
/begin MEASUREMENT ed_fil_pt_klst.filter_nv "Filterwert vor und nach Eintrag" UBYTE FORMULA_0003 0 0 0.0 255.0000 ECU_ADDRESS 0x3F9948 /end MEASUREMENT
/begin MEASUREMENT ed_fil_pt_kkos.filter_nv "Filterwert vor und nach Eintrag" UBYTE FORMULA_0003 0 0 0.0 255.0000 ECU_ADDRESS 0x3F994E /end MEASUREMENT
/begin MEASUREMENT ed_fil_pt_lrw.filter_nv "Filterwert vor und nach Eintrag" UBYTE FORMULA_0003 0 0 0.0 255.0000 ECU_ADDRESS 0x3F9954 /end MEASUREMENT
/begin MEASUREMENT ed_fil_sl_ml_hfm.filter_nv "Filterwert vor und nach Eintrag" UBYTE FORMULA_0003 0 0 0.0 255.0000 ECU_ADDRESS 0x3F9966 /end MEASUREMENT
/begin MEASUREMENT ed_fil_lank2_obd_s.filter_nv "Filterwert vor und nach Eintrag" UBYTE FORMULA_0003 0 0 0.0 255.0000 ECU_ADDRESS 0x3F9972 /end MEASUREMENT
/begin MEASUREMENT ed_fil_lavk1_obd_tl.filter_nv "Filterwert vor und nach Eintrag" UBYTE FORMULA_0003 0 0 0.0 255.0000 ECU_ADDRESS 0x3F9978 /end MEASUREMENT
/begin MEASUREMENT ed_fil_lavk2_obd_tl.filter_nv "Filterwert vor und nach Eintrag" UBYTE FORMULA_0003 0 0 0.0 255.0000 ECU_ADDRESS 0x3F997E /end MEASUREMENT
/begin MEASUREMENT ed_fil_lshvk1.filter_nv "Filterwert vor und nach Eintrag" UBYTE FORMULA_0003 0 0 0.0 255.0000 ECU_ADDRESS 0x3F9984 /end MEASUREMENT
/begin MEASUREMENT ed_fil_lshvk2.filter_nv "Filterwert vor und nach Eintrag" UBYTE FORMULA_0003 0 0 0.0 255.0000 ECU_ADDRESS 0x3F998A /end MEASUREMENT
/begin MEASUREMENT ed_fil_lsrvk1_obd_reg.filter_nv "Filterwert vor und nach Eintrag" UBYTE FORMULA_0003 0 0 0.0 255.0000 ECU_ADDRESS 0x3F9990 /end MEASUREMENT
/begin MEASUREMENT ed_fil_lsrvk2_obd_reg.filter_nv "Filterwert vor und nach Eintrag" UBYTE FORMULA_0003 0 0 0.0 255.0000 ECU_ADDRESS 0x3F9996 /end MEASUREMENT
/begin MEASUREMENT ed_fil_lshvk1_r.filter_nv "Filterwert vor und nach Eintrag" UBYTE FORMULA_0003 0 0 0.0 255.0000 ECU_ADDRESS 0x3F999C /end MEASUREMENT
/begin MEASUREMENT ed_fil_lshvk2_r.filter_nv "Filterwert vor und nach Eintrag" UBYTE FORMULA_0003 0 0 0.0 255.0000 ECU_ADDRESS 0x3F99A2 /end MEASUREMENT
/begin MEASUREMENT ed_fil_lsrvk1_obd_start.filter_nv "Filterwert vor und nach Eintrag" UBYTE FORMULA_0003 0 0 0.0 255.0000 ECU_ADDRESS 0x3F99A8 /end MEASUREMENT
/begin MEASUREMENT ed_fil_lsrvk2_obd_start.filter_nv "Filterwert vor und nach Eintrag" UBYTE FORMULA_0003 0 0 0.0 255.0000 ECU_ADDRESS 0x3F99AE /end MEASUREMENT
/begin MEASUREMENT ed_fil_lsrvk1_obd_ref.filter_nv "Filterwert vor und nach Eintrag" UBYTE FORMULA_0003 0 0 0.0 255.0000 ECU_ADDRESS 0x3F99B4 /end MEASUREMENT
/begin MEASUREMENT ed_fil_lsrvk2_obd_ref.filter_nv "Filterwert vor und nach Eintrag" UBYTE FORMULA_0003 0 0 0.0 255.0000 ECU_ADDRESS 0x3F99BA /end MEASUREMENT
/begin MEASUREMENT ed_fil_lavk1_diag.filter_nv "Filterwert vor und nach Eintrag" UBYTE FORMULA_0003 0 0 0.0 255.0000 ECU_ADDRESS 0x3F99C0 /end MEASUREMENT
/begin MEASUREMENT ed_fil_lavk2_diag.filter_nv "Filterwert vor und nach Eintrag" UBYTE FORMULA_0003 0 0 0.0 255.0000 ECU_ADDRESS 0x3F99C6 /end MEASUREMENT
/begin MEASUREMENT ed_fil_lavk1_ia_openload.filter_nv "Filterwert vor und nach Eintrag" UBYTE FORMULA_0003 0 0 0.0 255.0000 ECU_ADDRESS 0x3F99CC /end MEASUREMENT
/begin MEASUREMENT ed_fil_lavk2_ia_openload.filter_nv "Filterwert vor und nach Eintrag" UBYTE FORMULA_0003 0 0 0.0 255.0000 ECU_ADDRESS 0x3F99D2 /end MEASUREMENT
/begin MEASUREMENT ed_fil_pt_grb.filter_nv "Filterwert vor und nach Eintrag" UBYTE FORMULA_0003 0 0 0.0 255.0000 ECU_ADDRESS 0x3F99D8 /end MEASUREMENT
/begin MEASUREMENT ed_fil_pt_grb2.filter_nv "Filterwert vor und nach Eintrag" UBYTE FORMULA_0003 0 0 0.0 255.0000 ECU_ADDRESS 0x3F99DE /end MEASUREMENT
/begin MEASUREMENT ed_fil_lavk1_un_openload.filter_nv "Filterwert vor und nach Eintrag" UBYTE FORMULA_0003 0 0 0.0 255.0000 ECU_ADDRESS 0x3F99E4 /end MEASUREMENT
/begin MEASUREMENT ed_fil_lavk2_un_openload.filter_nv "Filterwert vor und nach Eintrag" UBYTE FORMULA_0003 0 0 0.0 255.0000 ECU_ADDRESS 0x3F99EA /end MEASUREMENT
/begin MEASUREMENT ed_fil_lavk1_ip_openload.filter_nv "Filterwert vor und nach Eintrag" UBYTE FORMULA_0003 0 0 0.0 255.0000 ECU_ADDRESS 0x3F99F0 /end MEASUREMENT
/begin MEASUREMENT ed_fil_lavk2_ip_openload.filter_nv "Filterwert vor und nach Eintrag" UBYTE FORMULA_0003 0 0 0.0 255.0000 ECU_ADDRESS 0x3F99F6 /end MEASUREMENT
/begin MEASUREMENT ed_fil_tz1.filter_nv "Filterwert vor und nach Eintrag" UBYTE FORMULA_0003 0 0 0.0 255.0000 ECU_ADDRESS 0x3F9A02 /end MEASUREMENT
/begin MEASUREMENT ed_fil_tz2.filter_nv "Filterwert vor und nach Eintrag" UBYTE FORMULA_0003 0 0 0.0 255.0000 ECU_ADDRESS 0x3F9A08 /end MEASUREMENT
/begin MEASUREMENT ed_fil_tz3.filter_nv "Filterwert vor und nach Eintrag" UBYTE FORMULA_0003 0 0 0.0 255.0000 ECU_ADDRESS 0x3F9A0E /end MEASUREMENT
/begin MEASUREMENT ed_fil_tz4.filter_nv "Filterwert vor und nach Eintrag" UBYTE FORMULA_0003 0 0 0.0 255.0000 ECU_ADDRESS 0x3F9A14 /end MEASUREMENT
/begin MEASUREMENT ed_fil_tz5.filter_nv "Filterwert vor und nach Eintrag" UBYTE FORMULA_0003 0 0 0.0 255.0000 ECU_ADDRESS 0x3F9A1A /end MEASUREMENT
/begin MEASUREMENT ed_fil_tz6.filter_nv "Filterwert vor und nach Eintrag" UBYTE FORMULA_0003 0 0 0.0 255.0000 ECU_ADDRESS 0x3F9A20 /end MEASUREMENT
/begin MEASUREMENT ed_fil_tz7.filter_nv "Filterwert vor und nach Eintrag" UBYTE FORMULA_0003 0 0 0.0 255.0000 ECU_ADDRESS 0x3F9A26 /end MEASUREMENT
/begin MEASUREMENT ed_fil_tz8.filter_nv "Filterwert vor und nach Eintrag" UBYTE FORMULA_0003 0 0 0.0 255.0000 ECU_ADDRESS 0x3F9A2C /end MEASUREMENT
/begin MEASUREMENT ed_fil_tz9.filter_nv "Filterwert vor und nach Eintrag" UBYTE FORMULA_0003 0 0 0.0 255.0000 ECU_ADDRESS 0x3F9A32 /end MEASUREMENT
/begin MEASUREMENT ed_fil_tz10.filter_nv "Filterwert vor und nach Eintrag" UBYTE FORMULA_0003 0 0 0.0 255.0000 ECU_ADDRESS 0x3F9A38 /end MEASUREMENT
/begin MEASUREMENT ed_fil_van_anschl_e1.filter_nv "Filterwert vor und nach Eintrag" UBYTE FORMULA_0003 0 0 0.0 255.0000 ECU_ADDRESS 0x3F9A4A /end MEASUREMENT
/begin MEASUREMENT ed_fil_van_anschl_a1.filter_nv "Filterwert vor und nach Eintrag" UBYTE FORMULA_0003 0 0 0.0 255.0000 ECU_ADDRESS 0x3F9A50 /end MEASUREMENT
/begin MEASUREMENT ed_fil_van_anschl_e2.filter_nv "Filterwert vor und nach Eintrag" UBYTE FORMULA_0003 0 0 0.0 255.0000 ECU_ADDRESS 0x3F9A56 /end MEASUREMENT
/begin MEASUREMENT ed_fil_van_anschl_a2.filter_nv "Filterwert vor und nach Eintrag" UBYTE FORMULA_0003 0 0 0.0 255.0000 ECU_ADDRESS 0x3F9A5C /end MEASUREMENT
/begin MEASUREMENT ed_fil_van_vent_e1.filter_nv "Filterwert vor und nach Eintrag" UBYTE FORMULA_0003 0 0 0.0 255.0000 ECU_ADDRESS 0x3F9A62 /end MEASUREMENT
/begin MEASUREMENT ed_fil_van_vent_a1.filter_nv "Filterwert vor und nach Eintrag" UBYTE FORMULA_0003 0 0 0.0 255.0000 ECU_ADDRESS 0x3F9A68 /end MEASUREMENT
/begin MEASUREMENT ed_fil_van_vent_e2.filter_nv "Filterwert vor und nach Eintrag" UBYTE FORMULA_0003 0 0 0.0 255.0000 ECU_ADDRESS 0x3F9A6E /end MEASUREMENT
/begin MEASUREMENT ed_fil_van_vent_a2.filter_nv "Filterwert vor und nach Eintrag" UBYTE FORMULA_0003 0 0 0.0 255.0000 ECU_ADDRESS 0x3F9A74 /end MEASUREMENT
/begin MEASUREMENT ed_fil_lavk1_obd_dyn.filter_nv "Filterwert vor und nach Eintrag" UBYTE FORMULA_0003 0 0 0.0 255.0000 ECU_ADDRESS 0x3F9AB6 /end MEASUREMENT
/begin MEASUREMENT ed_fil_lavk2_obd_dyn.filter_nv "Filterwert vor und nach Eintrag" UBYTE FORMULA_0003 0 0 0.0 255.0000 ECU_ADDRESS 0x3F9ABC /end MEASUREMENT
/begin MEASUREMENT ed_fil_pt_crash.filter_nv "Filterwert vor und nach Eintrag" UBYTE FORMULA_0003 0 0 0.0 255.0000 ECU_ADDRESS 0x3F9AC2 /end MEASUREMENT
/begin MEASUREMENT ed_fil_pt_vehmod.filter_nv "Filterwert vor und nach Eintrag" UBYTE FORMULA_0003 0 0 0.0 255.0000 ECU_ADDRESS 0x3F9AC8 /end MEASUREMENT
/begin MEASUREMENT ed_fil_pt_bedfgr.filter_nv "Filterwert vor und nach Eintrag" UBYTE FORMULA_0003 0 0 0.0 255.0000 ECU_ADDRESS 0x3F9ACE /end MEASUREMENT
/begin MEASUREMENT ed_fil_lavk1_trim.filter_nv "Filterwert vor und nach Eintrag" UBYTE FORMULA_0003 0 0 0.0 255.0000 ECU_ADDRESS 0x3F9AF8 /end MEASUREMENT
/begin MEASUREMENT ed_fil_lavk2_trim.filter_nv "Filterwert vor und nach Eintrag" UBYTE FORMULA_0003 0 0 0.0 255.0000 ECU_ADDRESS 0x3F9AFE /end MEASUREMENT
/begin MEASUREMENT ed_fil_rlu87.filter_nv "Filterwert vor und nach Eintrag" UBYTE FORMULA_0003 0 0 0.0 255.0000 ECU_ADDRESS 0x3F9B04 /end MEASUREMENT
/begin MEASUREMENT ed_fil_ssp.filter_nv "Filterwert vor und nach Eintrag" UBYTE FORMULA_0003 0 0 0.0 255.0000 ECU_ADDRESS 0x3F9B10 /end MEASUREMENT
/begin MEASUREMENT ed_fil_td.filter_nv "Filterwert vor und nach Eintrag" UBYTE FORMULA_0003 0 0 0.0 255.0000 ECU_ADDRESS 0x3F9B16 /end MEASUREMENT
/begin MEASUREMENT ed_fil_rlslp.filter_nv "Filterwert vor und nach Eintrag" UBYTE FORMULA_0003 0 0 0.0 255.0000 ECU_ADDRESS 0x3F9B1C /end MEASUREMENT
/begin MEASUREMENT ed_fil_slv.filter_nv "Filterwert vor und nach Eintrag" UBYTE FORMULA_0003 0 0 0.0 255.0000 ECU_ADDRESS 0x3F9B22 /end MEASUREMENT
/begin MEASUREMENT ed_fil_pt_km.filter_nv "Filterwert vor und nach Eintrag" UBYTE FORMULA_0003 0 0 0.0 255.0000 ECU_ADDRESS 0x3F9B28 /end MEASUREMENT
/begin MEASUREMENT ed_fil_pt_kombi.filter_nv "Filterwert vor und nach Eintrag" UBYTE FORMULA_0003 0 0 0.0 255.0000 ECU_ADDRESS 0x3F9B2E /end MEASUREMENT
/begin MEASUREMENT ed_fil_pks_ll.filter_nv "Filterwert vor und nach Eintrag" UBYTE FORMULA_0003 0 0 0.0 255.0000 ECU_ADDRESS 0x3F9B34 /end MEASUREMENT
/begin MEASUREMENT ed_fil_pks_tl.filter_nv "Filterwert vor und nach Eintrag" UBYTE FORMULA_0003 0 0 0.0 255.0000 ECU_ADDRESS 0x3F9B3A /end MEASUREMENT
/begin MEASUREMENT ed_fil_pks_q.filter_nv "Filterwert vor und nach Eintrag" UBYTE FORMULA_0003 0 0 0.0 255.0000 ECU_ADDRESS 0x3F9B40 /end MEASUREMENT
/begin MEASUREMENT ed_fil_van_dsv.filter_nv "Filterwert vor und nach Eintrag" UBYTE FORMULA_0003 0 0 0.0 255.0000 ECU_ADDRESS 0x3F9B52 /end MEASUREMENT
/begin MEASUREMENT ed_fil_mvac_drucksensor.filter_nv "Filterwert vor und nach Eintrag" UBYTE FORMULA_0003 0 0 0.0 255.0000 ECU_ADDRESS 0x3F9B88 /end MEASUREMENT
/begin MEASUREMENT ed_fil_pt_bedat.filter_nv "Filterwert vor und nach Eintrag" UBYTE FORMULA_0003 0 0 0.0 255.0000 ECU_ADDRESS 0x3F9B8E /end MEASUREMENT
/begin MEASUREMENT ed_fil_sk_manager_inj.filter_nv "Filterwert vor und nach Eintrag" UBYTE FORMULA_0003 0 0 0.0 255.0000 ECU_ADDRESS 0x3F9B94 /end MEASUREMENT
/begin MEASUREMENT ed_fil_ssp_diag.filter_nv "Filterwert vor und nach Eintrag" UBYTE FORMULA_0003 0 0 0.0 255.0000 ECU_ADDRESS 0x3F9B9A /end MEASUREMENT
/begin MEASUREMENT ed_fil_sg_inj.filter_nv "Filterwert vor und nach Eintrag" UBYTE FORMULA_0003 0 0 0.0 255.0000 ECU_ADDRESS 0x3F9BD0 /end MEASUREMENT
/begin MEASUREMENT ed_fil_s_poel_diag.filter_nv "Filterwert vor und nach Eintrag" UBYTE FORMULA_0003 0 0 0.0 255.0000 ECU_ADDRESS 0x3F9BE2 /end MEASUREMENT
/begin MEASUREMENT ed_fil_te_obd_1.filter_nv "Filterwert vor und nach Eintrag" UBYTE FORMULA_0003 0 0 0.0 255.0000 ECU_ADDRESS 0x3F9BE8 /end MEASUREMENT
/begin MEASUREMENT ed_fil_te_obd_2.filter_nv "Filterwert vor und nach Eintrag" UBYTE FORMULA_0003 0 0 0.0 255.0000 ECU_ADDRESS 0x3F9BEE /end MEASUREMENT
/begin MEASUREMENT ed_fil_tev1.filter_nv "Filterwert vor und nach Eintrag" UBYTE FORMULA_0003 0 0 0.0 255.0000 ECU_ADDRESS 0x3F9BF4 /end MEASUREMENT
/begin MEASUREMENT ed_fil_tev2.filter_nv "Filterwert vor und nach Eintrag" UBYTE FORMULA_0003 0 0 0.0 255.0000 ECU_ADDRESS 0x3F9BFA /end MEASUREMENT
/begin MEASUREMENT ed_fil_slp.filter_nv "Filterwert vor und nach Eintrag" UBYTE FORMULA_0003 0 0 0.0 255.0000 ECU_ADDRESS 0x3F9C2A /end MEASUREMENT
/begin MEASUREMENT ed_fil_sl_durchs_b1.filter_nv "Filterwert vor und nach Eintrag" UBYTE FORMULA_0003 0 0 0.0 255.0000 ECU_ADDRESS 0x3F9C30 /end MEASUREMENT
/begin MEASUREMENT ed_fil_sl_durchs_b2.filter_nv "Filterwert vor und nach Eintrag" UBYTE FORMULA_0003 0 0 0.0 255.0000 ECU_ADDRESS 0x3F9C36 /end MEASUREMENT
/begin MEASUREMENT ed_fil_sl_durchs_hstrang.filter_nv "Filterwert vor und nach Eintrag" UBYTE FORMULA_0003 0 0 0.0 255.0000 ECU_ADDRESS 0x3F9C3C /end MEASUREMENT
/begin MEASUREMENT ed_fil_s_getr_hs.filter_nv "Filterwert vor und nach Eintrag" UBYTE FORMULA_0003 0 0 0.0 255.0000 ECU_ADDRESS 0x3F9C48 /end MEASUREMENT
/begin MEASUREMENT ed_fil_s_kupp_hs.filter_nv "Filterwert vor und nach Eintrag" UBYTE FORMULA_0003 0 0 0.0 255.0000 ECU_ADDRESS 0x3F9C4E /end MEASUREMENT
/begin MEASUREMENT ed_fil_van_druck.filter_nv "Filterwert vor und nach Eintrag" UBYTE FORMULA_0003 0 0 0.0 255.0000 ECU_ADDRESS 0x3F9C54 /end MEASUREMENT
/begin MEASUREMENT ed_fil_pt_statanh.filter_nv "Filterwert vor und nach Eintrag" UBYTE FORMULA_0003 0 0 0.0 255.0000 ECU_ADDRESS 0x3F9C66 /end MEASUREMENT
/begin MEASUREMENT ed_fil_pt_statgrb.filter_nv "Filterwert vor und nach Eintrag" UBYTE FORMULA_0003 0 0 0.0 255.0000 ECU_ADDRESS 0x3F9C84 /end MEASUREMENT
/begin MEASUREMENT ed_fil_pt_anfradmom.filter_nv "Filterwert vor und nach Eintrag" UBYTE FORMULA_0003 0 0 0.0 255.0000 ECU_ADDRESS 0x3F9C8A /end MEASUREMENT
/begin MEASUREMENT ed_fil_tank_leer.filter_nv "Filterwert vor und nach Eintrag" UBYTE FORMULA_0003 0 0 0.0 255.0000 ECU_ADDRESS 0x3F9C96 /end MEASUREMENT
/begin MEASUREMENT ed_fil_pt_toma.filter_nv "Filterwert vor und nach Eintrag" UBYTE FORMULA_0003 0 0 0.0 255.0000 ECU_ADDRESS 0x3F9C9C /end MEASUREMENT
/begin MEASUREMENT ed_fil_pumg_obd.filter_nv "Filterwert vor und nach Eintrag" UBYTE FORMULA_0003 0 0 0.0 255.0000 ECU_ADDRESS 0x3F9CA8 /end MEASUREMENT
/begin MEASUREMENT ed_fil_sl_ml_hfm_obd.filter_nv "Filterwert vor und nach Eintrag" UBYTE FORMULA_0003 0 0 0.0 255.0000 ECU_ADDRESS 0x3F9CAE /end MEASUREMENT
/begin MEASUREMENT ed_fil_lank1_openload.filter_nv "Filterwert vor und nach Eintrag" UBYTE FORMULA_0003 0 0 0.0 255.0000 ECU_ADDRESS 0x3F9CC0 /end MEASUREMENT
/begin MEASUREMENT ed_fil_lank2_openload.filter_nv "Filterwert vor und nach Eintrag" UBYTE FORMULA_0003 0 0 0.0 255.0000 ECU_ADDRESS 0x3F9CC6 /end MEASUREMENT
/begin MEASUREMENT ed_fil_lank1_obd_we.filter_nv "Filterwert vor und nach Eintrag" UBYTE FORMULA_0003 0 0 0.0 255.0000 ECU_ADDRESS 0x3F9CCC /end MEASUREMENT
/begin MEASUREMENT ed_fil_lank2_obd_we.filter_nv "Filterwert vor und nach Eintrag" UBYTE FORMULA_0003 0 0 0.0 255.0000 ECU_ADDRESS 0x3F9CD2 /end MEASUREMENT
/begin MEASUREMENT ed_fil_lshnk1_r.filter_nv "Filterwert vor und nach Eintrag" UBYTE FORMULA_0003 0 0 0.0 255.0000 ECU_ADDRESS 0x3F9CD8 /end MEASUREMENT
/begin MEASUREMENT ed_fil_lshnk2_r.filter_nv "Filterwert vor und nach Eintrag" UBYTE FORMULA_0003 0 0 0.0 255.0000 ECU_ADDRESS 0x3F9CDE /end MEASUREMENT
/begin MEASUREMENT ed_fil_pks_modell.filter_nv "Filterwert vor und nach Eintrag" UBYTE FORMULA_0003 0 0 0.0 255.0000 ECU_ADDRESS 0x3F9CE4 /end MEASUREMENT
/begin MEASUREMENT ed_fil_pks_paufbau.filter_nv "Filterwert vor und nach Eintrag" UBYTE FORMULA_0003 0 0 0.0 255.0000 ECU_ADDRESS 0x3F9CEA /end MEASUREMENT
/begin MEASUREMENT ed_fil_pks_adapt_anschl.filter_nv "Filterwert vor und nach Eintrag" UBYTE FORMULA_0003 0 0 0.0 255.0000 ECU_ADDRESS 0x3F9CF0 /end MEASUREMENT
/begin MEASUREMENT ed_fil_tgetr_hs.filter_nv "Filterwert vor und nach Eintrag" UBYTE FORMULA_0003 0 0 0.0 255.0000 ECU_ADDRESS 0x3F9CF6 /end MEASUREMENT
/begin MEASUREMENT ed_fil_lavk_atic42.filter_nv "Filterwert vor und nach Eintrag" UBYTE FORMULA_0003 0 0 0.0 255.0000 ECU_ADDRESS 0x3F9CFC /end MEASUREMENT
/begin MEASUREMENT ed_fil_pt_ax.filter_nv "Filterwert vor und nach Eintrag" UBYTE FORMULA_0003 0 0 0.0 255.0000 ECU_ADDRESS 0x3F9D02 /end MEASUREMENT
/begin MEASUREMENT ed_fil_pt_obd_ed.filter_nv "Filterwert vor und nach Eintrag" UBYTE FORMULA_0003 0 0 0.0 255.0000 ECU_ADDRESS 0x3F9D08 /end MEASUREMENT
/begin MEASUREMENT ed_fil_lank2_obd_slope.filter_nv "Filterwert vor und nach Eintrag" UBYTE FORMULA_0003 0 0 0.0 255.0000 ECU_ADDRESS 0x3F9D20 /end MEASUREMENT
/begin MEASUREMENT ed_fil_mvac_obd.filter_nv "Filterwert vor und nach Eintrag" UBYTE FORMULA_0003 0 0 0.0 255.0000 ECU_ADDRESS 0x3F9D26 /end MEASUREMENT
/begin MEASUREMENT ed_fil_lavk2_atic42.filter_nv "Filterwert vor und nach Eintrag" UBYTE FORMULA_0003 0 0 0.0 255.0000 ECU_ADDRESS 0x3F9D32 /end MEASUREMENT
/begin MEASUREMENT ed_fil_sk_tr_inj.zyklus_filter_nv "Vorwaertsfilter zur Fehlerzustandsbestaetigung" UBYTE FORMULA_0003 0 0 0.0 255.0000 ECU_ADDRESS 0x3F9871 /end MEASUREMENT
/begin MEASUREMENT ed_fil_pumg.zyklus_filter_nv "Vorwaertsfilter zur Fehlerzustandsbestaetigung" UBYTE FORMULA_0003 0 0 0.0 255.0000 ECU_ADDRESS 0x3F9877 /end MEASUREMENT
/begin MEASUREMENT ed_fil_psau1.zyklus_filter_nv "Vorwaertsfilter zur Fehlerzustandsbestaetigung" UBYTE FORMULA_0003 0 0 0.0 255.0000 ECU_ADDRESS 0x3F9889 /end MEASUREMENT
/begin MEASUREMENT ed_fil_psau2.zyklus_filter_nv "Vorwaertsfilter zur Fehlerzustandsbestaetigung" UBYTE FORMULA_0003 0 0 0.0 255.0000 ECU_ADDRESS 0x3F988F /end MEASUREMENT
/begin MEASUREMENT ed_fil_van_hall_e1.zyklus_filter_nv "Vorwaertsfilter zur Fehlerzustandsbestaetigung" UBYTE FORMULA_0003 0 0 0.0 255.0000 ECU_ADDRESS 0x3F9895 /end MEASUREMENT
/begin MEASUREMENT ed_fil_van_hall_a1.zyklus_filter_nv "Vorwaertsfilter zur Fehlerzustandsbestaetigung" UBYTE FORMULA_0003 0 0 0.0 255.0000 ECU_ADDRESS 0x3F989B /end MEASUREMENT
/begin MEASUREMENT ed_fil_van_hall_e2.zyklus_filter_nv "Vorwaertsfilter zur Fehlerzustandsbestaetigung" UBYTE FORMULA_0003 0 0 0.0 255.0000 ECU_ADDRESS 0x3F98A1 /end MEASUREMENT
/begin MEASUREMENT ed_fil_van_hall_a2.zyklus_filter_nv "Vorwaertsfilter zur Fehlerzustandsbestaetigung" UBYTE FORMULA_0003 0 0 0.0 255.0000 ECU_ADDRESS 0x3F98A7 /end MEASUREMENT
/begin MEASUREMENT ed_fil_van_regl_e1.zyklus_filter_nv "Vorwaertsfilter zur Fehlerzustandsbestaetigung" UBYTE FORMULA_0003 0 0 0.0 255.0000 ECU_ADDRESS 0x3F98AD /end MEASUREMENT
/begin MEASUREMENT ed_fil_van_regl_a1.zyklus_filter_nv "Vorwaertsfilter zur Fehlerzustandsbestaetigung" UBYTE FORMULA_0003 0 0 0.0 255.0000 ECU_ADDRESS 0x3F98B3 /end MEASUREMENT
/begin MEASUREMENT ed_fil_van_regl_e2.zyklus_filter_nv "Vorwaertsfilter zur Fehlerzustandsbestaetigung" UBYTE FORMULA_0003 0 0 0.0 255.0000 ECU_ADDRESS 0x3F98B9 /end MEASUREMENT
/begin MEASUREMENT ed_fil_van_regl_a2.zyklus_filter_nv "Vorwaertsfilter zur Fehlerzustandsbestaetigung" UBYTE FORMULA_0003 0 0 0.0 255.0000 ECU_ADDRESS 0x3F98BF /end MEASUREMENT
/begin MEASUREMENT ed_fil_nw1_sync.zyklus_filter_nv "Vorwaertsfilter zur Fehlerzustandsbestaetigung" UBYTE FORMULA_0003 0 0 0.0 255.0000 ECU_ADDRESS 0x3F98C5 /end MEASUREMENT
/begin MEASUREMENT ed_fil_nw2_sync.zyklus_filter_nv "Vorwaertsfilter zur Fehlerzustandsbestaetigung" UBYTE FORMULA_0003 0 0 0.0 255.0000 ECU_ADDRESS 0x3F98CB /end MEASUREMENT
/begin MEASUREMENT ed_fil_pctrl_inj.zyklus_filter_nv "Vorwaertsfilter zur Fehlerzustandsbestaetigung" UBYTE FORMULA_0003 0 0 0.0 255.0000 ECU_ADDRESS 0x3F98D1 /end MEASUREMENT
/begin MEASUREMENT ed_fil_pt_statdkg.zyklus_filter_nv "Vorwaertsfilter zur Fehlerzustandsbestaetigung" UBYTE FORMULA_0003 0 0 0.0 255.0000 ECU_ADDRESS 0x3F98D7 /end MEASUREMENT
/begin MEASUREMENT ed_fil_pks.zyklus_filter_nv "Vorwaertsfilter zur Fehlerzustandsbestaetigung" UBYTE FORMULA_0003 0 0 0.0 255.0000 ECU_ADDRESS 0x3F98DD /end MEASUREMENT
/begin MEASUREMENT ed_fil_pt_statr.zyklus_filter_nv "Vorwaertsfilter zur Fehlerzustandsbestaetigung" UBYTE FORMULA_0003 0 0 0.0 255.0000 ECU_ADDRESS 0x3F98E3 /end MEASUREMENT
/begin MEASUREMENT ed_fil_lavk1.zyklus_filter_nv "Vorwaertsfilter zur Fehlerzustandsbestaetigung" UBYTE FORMULA_0003 0 0 0.0 255.0000 ECU_ADDRESS 0x3F98E9 /end MEASUREMENT
/begin MEASUREMENT ed_fil_lavk2.zyklus_filter_nv "Vorwaertsfilter zur Fehlerzustandsbestaetigung" UBYTE FORMULA_0003 0 0 0.0 255.0000 ECU_ADDRESS 0x3F98EF /end MEASUREMENT
/begin MEASUREMENT ed_fil_lavk1_obd_plau.zyklus_filter_nv "Vorwaertsfilter zur Fehlerzustandsbestaetigung" UBYTE FORMULA_0003 0 0 0.0 255.0000 ECU_ADDRESS 0x3F98F5 /end MEASUREMENT
/begin MEASUREMENT ed_fil_lavk2_obd_plau.zyklus_filter_nv "Vorwaertsfilter zur Fehlerzustandsbestaetigung" UBYTE FORMULA_0003 0 0 0.0 255.0000 ECU_ADDRESS 0x3F98FB /end MEASUREMENT
/begin MEASUREMENT ed_fil_lavk1_obd_sa.zyklus_filter_nv "Vorwaertsfilter zur Fehlerzustandsbestaetigung" UBYTE FORMULA_0003 0 0 0.0 255.0000 ECU_ADDRESS 0x3F9901 /end MEASUREMENT
/begin MEASUREMENT ed_fil_lavk2_obd_sa.zyklus_filter_nv "Vorwaertsfilter zur Fehlerzustandsbestaetigung" UBYTE FORMULA_0003 0 0 0.0 255.0000 ECU_ADDRESS 0x3F9907 /end MEASUREMENT
/begin MEASUREMENT ed_fil_lank2.zyklus_filter_nv "Vorwaertsfilter zur Fehlerzustandsbestaetigung" UBYTE FORMULA_0003 0 0 0.0 255.0000 ECU_ADDRESS 0x3F9913 /end MEASUREMENT
/begin MEASUREMENT ed_fil_lshnk1.zyklus_filter_nv "Vorwaertsfilter zur Fehlerzustandsbestaetigung" UBYTE FORMULA_0003 0 0 0.0 255.0000 ECU_ADDRESS 0x3F9919 /end MEASUREMENT
/begin MEASUREMENT ed_fil_lshnk2.zyklus_filter_nv "Vorwaertsfilter zur Fehlerzustandsbestaetigung" UBYTE FORMULA_0003 0 0 0.0 255.0000 ECU_ADDRESS 0x3F991F /end MEASUREMENT
/begin MEASUREMENT ed_fil_pt_busoff.zyklus_filter_nv "Vorwaertsfilter zur Fehlerzustandsbestaetigung" UBYTE FORMULA_0003 0 0 0.0 255.0000 ECU_ADDRESS 0x3F9925 /end MEASUREMENT
/begin MEASUREMENT ed_fil_pt_torqdsc.zyklus_filter_nv "Vorwaertsfilter zur Fehlerzustandsbestaetigung" UBYTE FORMULA_0003 0 0 0.0 255.0000 ECU_ADDRESS 0x3F992B /end MEASUREMENT
/begin MEASUREMENT ed_fil_pt_stdsc.zyklus_filter_nv "Vorwaertsfilter zur Fehlerzustandsbestaetigung" UBYTE FORMULA_0003 0 0 0.0 255.0000 ECU_ADDRESS 0x3F9931 /end MEASUREMENT
/begin MEASUREMENT ed_fil_pt_vrad.zyklus_filter_nv "Vorwaertsfilter zur Fehlerzustandsbestaetigung" UBYTE FORMULA_0003 0 0 0.0 255.0000 ECU_ADDRESS 0x3F9937 /end MEASUREMENT
/begin MEASUREMENT ed_fil_pt_vfzg.zyklus_filter_nv "Vorwaertsfilter zur Fehlerzustandsbestaetigung" UBYTE FORMULA_0003 0 0 0.0 255.0000 ECU_ADDRESS 0x3F993D /end MEASUREMENT
/begin MEASUREMENT ed_fil_pt_atemp.zyklus_filter_nv "Vorwaertsfilter zur Fehlerzustandsbestaetigung" UBYTE FORMULA_0003 0 0 0.0 255.0000 ECU_ADDRESS 0x3F9943 /end MEASUREMENT
/begin MEASUREMENT ed_fil_pt_klst.zyklus_filter_nv "Vorwaertsfilter zur Fehlerzustandsbestaetigung" UBYTE FORMULA_0003 0 0 0.0 255.0000 ECU_ADDRESS 0x3F9949 /end MEASUREMENT
/begin MEASUREMENT ed_fil_pt_kkos.zyklus_filter_nv "Vorwaertsfilter zur Fehlerzustandsbestaetigung" UBYTE FORMULA_0003 0 0 0.0 255.0000 ECU_ADDRESS 0x3F994F /end MEASUREMENT
/begin MEASUREMENT ed_fil_pt_lrw.zyklus_filter_nv "Vorwaertsfilter zur Fehlerzustandsbestaetigung" UBYTE FORMULA_0003 0 0 0.0 255.0000 ECU_ADDRESS 0x3F9955 /end MEASUREMENT
/begin MEASUREMENT ed_fil_sl_ml_hfm.zyklus_filter_nv "Vorwaertsfilter zur Fehlerzustandsbestaetigung" UBYTE FORMULA_0003 0 0 0.0 255.0000 ECU_ADDRESS 0x3F9967 /end MEASUREMENT
/begin MEASUREMENT ed_fil_lank2_obd_s.zyklus_filter_nv "Vorwaertsfilter zur Fehlerzustandsbestaetigung" UBYTE FORMULA_0003 0 0 0.0 255.0000 ECU_ADDRESS 0x3F9973 /end MEASUREMENT
/begin MEASUREMENT ed_fil_lavk1_obd_tl.zyklus_filter_nv "Vorwaertsfilter zur Fehlerzustandsbestaetigung" UBYTE FORMULA_0003 0 0 0.0 255.0000 ECU_ADDRESS 0x3F9979 /end MEASUREMENT
/begin MEASUREMENT ed_fil_lavk2_obd_tl.zyklus_filter_nv "Vorwaertsfilter zur Fehlerzustandsbestaetigung" UBYTE FORMULA_0003 0 0 0.0 255.0000 ECU_ADDRESS 0x3F997F /end MEASUREMENT
/begin MEASUREMENT ed_fil_lshvk1.zyklus_filter_nv "Vorwaertsfilter zur Fehlerzustandsbestaetigung" UBYTE FORMULA_0003 0 0 0.0 255.0000 ECU_ADDRESS 0x3F9985 /end MEASUREMENT
/begin MEASUREMENT ed_fil_lshvk2.zyklus_filter_nv "Vorwaertsfilter zur Fehlerzustandsbestaetigung" UBYTE FORMULA_0003 0 0 0.0 255.0000 ECU_ADDRESS 0x3F998B /end MEASUREMENT
/begin MEASUREMENT ed_fil_lsrvk1_obd_reg.zyklus_filter_nv "Vorwaertsfilter zur Fehlerzustandsbestaetigung" UBYTE FORMULA_0003 0 0 0.0 255.0000 ECU_ADDRESS 0x3F9991 /end MEASUREMENT
/begin MEASUREMENT ed_fil_lsrvk2_obd_reg.zyklus_filter_nv "Vorwaertsfilter zur Fehlerzustandsbestaetigung" UBYTE FORMULA_0003 0 0 0.0 255.0000 ECU_ADDRESS 0x3F9997 /end MEASUREMENT
/begin MEASUREMENT ed_fil_lshvk1_r.zyklus_filter_nv "Vorwaertsfilter zur Fehlerzustandsbestaetigung" UBYTE FORMULA_0003 0 0 0.0 255.0000 ECU_ADDRESS 0x3F999D /end MEASUREMENT
/begin MEASUREMENT ed_fil_lshvk2_r.zyklus_filter_nv "Vorwaertsfilter zur Fehlerzustandsbestaetigung" UBYTE FORMULA_0003 0 0 0.0 255.0000 ECU_ADDRESS 0x3F99A3 /end MEASUREMENT
/begin MEASUREMENT ed_fil_lsrvk1_obd_start.zyklus_filter_nv "Vorwaertsfilter zur Fehlerzustandsbestaetigung" UBYTE FORMULA_0003 0 0 0.0 255.0000 ECU_ADDRESS 0x3F99A9 /end MEASUREMENT
/begin MEASUREMENT ed_fil_lsrvk2_obd_start.zyklus_filter_nv "Vorwaertsfilter zur Fehlerzustandsbestaetigung" UBYTE FORMULA_0003 0 0 0.0 255.0000 ECU_ADDRESS 0x3F99AF /end MEASUREMENT
/begin MEASUREMENT ed_fil_lsrvk1_obd_ref.zyklus_filter_nv "Vorwaertsfilter zur Fehlerzustandsbestaetigung" UBYTE FORMULA_0003 0 0 0.0 255.0000 ECU_ADDRESS 0x3F99B5 /end MEASUREMENT
/begin MEASUREMENT ed_fil_lsrvk2_obd_ref.zyklus_filter_nv "Vorwaertsfilter zur Fehlerzustandsbestaetigung" UBYTE FORMULA_0003 0 0 0.0 255.0000 ECU_ADDRESS 0x3F99BB /end MEASUREMENT
/begin MEASUREMENT ed_fil_lavk1_diag.zyklus_filter_nv "Vorwaertsfilter zur Fehlerzustandsbestaetigung" UBYTE FORMULA_0003 0 0 0.0 255.0000 ECU_ADDRESS 0x3F99C1 /end MEASUREMENT
/begin MEASUREMENT ed_fil_lavk2_diag.zyklus_filter_nv "Vorwaertsfilter zur Fehlerzustandsbestaetigung" UBYTE FORMULA_0003 0 0 0.0 255.0000 ECU_ADDRESS 0x3F99C7 /end MEASUREMENT
/begin MEASUREMENT ed_fil_lavk1_ia_openload.zyklus_filter_nv "Vorwaertsfilter zur Fehlerzustandsbestaetigung" UBYTE FORMULA_0003 0 0 0.0 255.0000 ECU_ADDRESS 0x3F99CD /end MEASUREMENT
/begin MEASUREMENT ed_fil_lavk2_ia_openload.zyklus_filter_nv "Vorwaertsfilter zur Fehlerzustandsbestaetigung" UBYTE FORMULA_0003 0 0 0.0 255.0000 ECU_ADDRESS 0x3F99D3 /end MEASUREMENT
/begin MEASUREMENT ed_fil_pt_grb.zyklus_filter_nv "Vorwaertsfilter zur Fehlerzustandsbestaetigung" UBYTE FORMULA_0003 0 0 0.0 255.0000 ECU_ADDRESS 0x3F99D9 /end MEASUREMENT
/begin MEASUREMENT ed_fil_pt_grb2.zyklus_filter_nv "Vorwaertsfilter zur Fehlerzustandsbestaetigung" UBYTE FORMULA_0003 0 0 0.0 255.0000 ECU_ADDRESS 0x3F99DF /end MEASUREMENT
/begin MEASUREMENT ed_fil_lavk1_un_openload.zyklus_filter_nv "Vorwaertsfilter zur Fehlerzustandsbestaetigung" UBYTE FORMULA_0003 0 0 0.0 255.0000 ECU_ADDRESS 0x3F99E5 /end MEASUREMENT
/begin MEASUREMENT ed_fil_lavk2_un_openload.zyklus_filter_nv "Vorwaertsfilter zur Fehlerzustandsbestaetigung" UBYTE FORMULA_0003 0 0 0.0 255.0000 ECU_ADDRESS 0x3F99EB /end MEASUREMENT
/begin MEASUREMENT ed_fil_lavk1_ip_openload.zyklus_filter_nv "Vorwaertsfilter zur Fehlerzustandsbestaetigung" UBYTE FORMULA_0003 0 0 0.0 255.0000 ECU_ADDRESS 0x3F99F1 /end MEASUREMENT
/begin MEASUREMENT ed_fil_lavk2_ip_openload.zyklus_filter_nv "Vorwaertsfilter zur Fehlerzustandsbestaetigung" UBYTE FORMULA_0003 0 0 0.0 255.0000 ECU_ADDRESS 0x3F99F7 /end MEASUREMENT
/begin MEASUREMENT ed_fil_tz1.zyklus_filter_nv "Vorwaertsfilter zur Fehlerzustandsbestaetigung" UBYTE FORMULA_0003 0 0 0.0 255.0000 ECU_ADDRESS 0x3F9A03 /end MEASUREMENT
/begin MEASUREMENT ed_fil_tz2.zyklus_filter_nv "Vorwaertsfilter zur Fehlerzustandsbestaetigung" UBYTE FORMULA_0003 0 0 0.0 255.0000 ECU_ADDRESS 0x3F9A09 /end MEASUREMENT
/begin MEASUREMENT ed_fil_tz3.zyklus_filter_nv "Vorwaertsfilter zur Fehlerzustandsbestaetigung" UBYTE FORMULA_0003 0 0 0.0 255.0000 ECU_ADDRESS 0x3F9A0F /end MEASUREMENT
/begin MEASUREMENT ed_fil_tz4.zyklus_filter_nv "Vorwaertsfilter zur Fehlerzustandsbestaetigung" UBYTE FORMULA_0003 0 0 0.0 255.0000 ECU_ADDRESS 0x3F9A15 /end MEASUREMENT
/begin MEASUREMENT ed_fil_tz5.zyklus_filter_nv "Vorwaertsfilter zur Fehlerzustandsbestaetigung" UBYTE FORMULA_0003 0 0 0.0 255.0000 ECU_ADDRESS 0x3F9A1B /end MEASUREMENT
/begin MEASUREMENT ed_fil_tz6.zyklus_filter_nv "Vorwaertsfilter zur Fehlerzustandsbestaetigung" UBYTE FORMULA_0003 0 0 0.0 255.0000 ECU_ADDRESS 0x3F9A21 /end MEASUREMENT
/begin MEASUREMENT ed_fil_tz7.zyklus_filter_nv "Vorwaertsfilter zur Fehlerzustandsbestaetigung" UBYTE FORMULA_0003 0 0 0.0 255.0000 ECU_ADDRESS 0x3F9A27 /end MEASUREMENT
/begin MEASUREMENT ed_fil_tz8.zyklus_filter_nv "Vorwaertsfilter zur Fehlerzustandsbestaetigung" UBYTE FORMULA_0003 0 0 0.0 255.0000 ECU_ADDRESS 0x3F9A2D /end MEASUREMENT
/begin MEASUREMENT ed_fil_tz9.zyklus_filter_nv "Vorwaertsfilter zur Fehlerzustandsbestaetigung" UBYTE FORMULA_0003 0 0 0.0 255.0000 ECU_ADDRESS 0x3F9A33 /end MEASUREMENT
/begin MEASUREMENT ed_fil_tz10.zyklus_filter_nv "Vorwaertsfilter zur Fehlerzustandsbestaetigung" UBYTE FORMULA_0003 0 0 0.0 255.0000 ECU_ADDRESS 0x3F9A39 /end MEASUREMENT
/begin MEASUREMENT ed_fil_van_anschl_e1.zyklus_filter_nv "Vorwaertsfilter zur Fehlerzustandsbestaetigung" UBYTE FORMULA_0003 0 0 0.0 255.0000 ECU_ADDRESS 0x3F9A4B /end MEASUREMENT
/begin MEASUREMENT ed_fil_van_anschl_a1.zyklus_filter_nv "Vorwaertsfilter zur Fehlerzustandsbestaetigung" UBYTE FORMULA_0003 0 0 0.0 255.0000 ECU_ADDRESS 0x3F9A51 /end MEASUREMENT
/begin MEASUREMENT ed_fil_van_anschl_e2.zyklus_filter_nv "Vorwaertsfilter zur Fehlerzustandsbestaetigung" UBYTE FORMULA_0003 0 0 0.0 255.0000 ECU_ADDRESS 0x3F9A57 /end MEASUREMENT
/begin MEASUREMENT ed_fil_van_anschl_a2.zyklus_filter_nv "Vorwaertsfilter zur Fehlerzustandsbestaetigung" UBYTE FORMULA_0003 0 0 0.0 255.0000 ECU_ADDRESS 0x3F9A5D /end MEASUREMENT
/begin MEASUREMENT ed_fil_van_vent_e1.zyklus_filter_nv "Vorwaertsfilter zur Fehlerzustandsbestaetigung" UBYTE FORMULA_0003 0 0 0.0 255.0000 ECU_ADDRESS 0x3F9A63 /end MEASUREMENT
/begin MEASUREMENT ed_fil_van_vent_a1.zyklus_filter_nv "Vorwaertsfilter zur Fehlerzustandsbestaetigung" UBYTE FORMULA_0003 0 0 0.0 255.0000 ECU_ADDRESS 0x3F9A69 /end MEASUREMENT
/begin MEASUREMENT ed_fil_van_vent_e2.zyklus_filter_nv "Vorwaertsfilter zur Fehlerzustandsbestaetigung" UBYTE FORMULA_0003 0 0 0.0 255.0000 ECU_ADDRESS 0x3F9A6F /end MEASUREMENT
/begin MEASUREMENT ed_fil_van_vent_a2.zyklus_filter_nv "Vorwaertsfilter zur Fehlerzustandsbestaetigung" UBYTE FORMULA_0003 0 0 0.0 255.0000 ECU_ADDRESS 0x3F9A75 /end MEASUREMENT
/begin MEASUREMENT ed_fil_lavk1_obd_dyn.zyklus_filter_nv "Vorwaertsfilter zur Fehlerzustandsbestaetigung" UBYTE FORMULA_0003 0 0 0.0 255.0000 ECU_ADDRESS 0x3F9AB7 /end MEASUREMENT
/begin MEASUREMENT ed_fil_lavk2_obd_dyn.zyklus_filter_nv "Vorwaertsfilter zur Fehlerzustandsbestaetigung" UBYTE FORMULA_0003 0 0 0.0 255.0000 ECU_ADDRESS 0x3F9ABD /end MEASUREMENT
/begin MEASUREMENT ed_fil_pt_crash.zyklus_filter_nv "Vorwaertsfilter zur Fehlerzustandsbestaetigung" UBYTE FORMULA_0003 0 0 0.0 255.0000 ECU_ADDRESS 0x3F9AC3 /end MEASUREMENT
/begin MEASUREMENT ed_fil_pt_vehmod.zyklus_filter_nv "Vorwaertsfilter zur Fehlerzustandsbestaetigung" UBYTE FORMULA_0003 0 0 0.0 255.0000 ECU_ADDRESS 0x3F9AC9 /end MEASUREMENT
/begin MEASUREMENT ed_fil_pt_bedfgr.zyklus_filter_nv "Vorwaertsfilter zur Fehlerzustandsbestaetigung" UBYTE FORMULA_0003 0 0 0.0 255.0000 ECU_ADDRESS 0x3F9ACF /end MEASUREMENT
/begin MEASUREMENT ed_fil_lavk1_trim.zyklus_filter_nv "Vorwaertsfilter zur Fehlerzustandsbestaetigung" UBYTE FORMULA_0003 0 0 0.0 255.0000 ECU_ADDRESS 0x3F9AF9 /end MEASUREMENT
/begin MEASUREMENT ed_fil_lavk2_trim.zyklus_filter_nv "Vorwaertsfilter zur Fehlerzustandsbestaetigung" UBYTE FORMULA_0003 0 0 0.0 255.0000 ECU_ADDRESS 0x3F9AFF /end MEASUREMENT
/begin MEASUREMENT ed_fil_rlu87.zyklus_filter_nv "Vorwaertsfilter zur Fehlerzustandsbestaetigung" UBYTE FORMULA_0003 0 0 0.0 255.0000 ECU_ADDRESS 0x3F9B05 /end MEASUREMENT
/begin MEASUREMENT ed_fil_ssp.zyklus_filter_nv "Vorwaertsfilter zur Fehlerzustandsbestaetigung" UBYTE FORMULA_0003 0 0 0.0 255.0000 ECU_ADDRESS 0x3F9B11 /end MEASUREMENT
/begin MEASUREMENT ed_fil_td.zyklus_filter_nv "Vorwaertsfilter zur Fehlerzustandsbestaetigung" UBYTE FORMULA_0003 0 0 0.0 255.0000 ECU_ADDRESS 0x3F9B17 /end MEASUREMENT
/begin MEASUREMENT ed_fil_rlslp.zyklus_filter_nv "Vorwaertsfilter zur Fehlerzustandsbestaetigung" UBYTE FORMULA_0003 0 0 0.0 255.0000 ECU_ADDRESS 0x3F9B1D /end MEASUREMENT
/begin MEASUREMENT ed_fil_slv.zyklus_filter_nv "Vorwaertsfilter zur Fehlerzustandsbestaetigung" UBYTE FORMULA_0003 0 0 0.0 255.0000 ECU_ADDRESS 0x3F9B23 /end MEASUREMENT
/begin MEASUREMENT ed_fil_pt_km.zyklus_filter_nv "Vorwaertsfilter zur Fehlerzustandsbestaetigung" UBYTE FORMULA_0003 0 0 0.0 255.0000 ECU_ADDRESS 0x3F9B29 /end MEASUREMENT
/begin MEASUREMENT ed_fil_pt_kombi.zyklus_filter_nv "Vorwaertsfilter zur Fehlerzustandsbestaetigung" UBYTE FORMULA_0003 0 0 0.0 255.0000 ECU_ADDRESS 0x3F9B2F /end MEASUREMENT
/begin MEASUREMENT ed_fil_pks_ll.zyklus_filter_nv "Vorwaertsfilter zur Fehlerzustandsbestaetigung" UBYTE FORMULA_0003 0 0 0.0 255.0000 ECU_ADDRESS 0x3F9B35 /end MEASUREMENT
/begin MEASUREMENT ed_fil_pks_tl.zyklus_filter_nv "Vorwaertsfilter zur Fehlerzustandsbestaetigung" UBYTE FORMULA_0003 0 0 0.0 255.0000 ECU_ADDRESS 0x3F9B3B /end MEASUREMENT
/begin MEASUREMENT ed_fil_pks_q.zyklus_filter_nv "Vorwaertsfilter zur Fehlerzustandsbestaetigung" UBYTE FORMULA_0003 0 0 0.0 255.0000 ECU_ADDRESS 0x3F9B41 /end MEASUREMENT
/begin MEASUREMENT ed_fil_van_dsv.zyklus_filter_nv "Vorwaertsfilter zur Fehlerzustandsbestaetigung" UBYTE FORMULA_0003 0 0 0.0 255.0000 ECU_ADDRESS 0x3F9B53 /end MEASUREMENT
/begin MEASUREMENT ed_fil_mvac_drucksensor.zyklus_filter_nv "Vorwaertsfilter zur Fehlerzustandsbestaetigung" UBYTE FORMULA_0003 0 0 0.0 255.0000 ECU_ADDRESS 0x3F9B89 /end MEASUREMENT
/begin MEASUREMENT ed_fil_pt_bedat.zyklus_filter_nv "Vorwaertsfilter zur Fehlerzustandsbestaetigung" UBYTE FORMULA_0003 0 0 0.0 255.0000 ECU_ADDRESS 0x3F9B8F /end MEASUREMENT
/begin MEASUREMENT ed_fil_sk_manager_inj.zyklus_filter_nv "Vorwaertsfilter zur Fehlerzustandsbestaetigung" UBYTE FORMULA_0003 0 0 0.0 255.0000 ECU_ADDRESS 0x3F9B95 /end MEASUREMENT
/begin MEASUREMENT ed_fil_ssp_diag.zyklus_filter_nv "Vorwaertsfilter zur Fehlerzustandsbestaetigung" UBYTE FORMULA_0003 0 0 0.0 255.0000 ECU_ADDRESS 0x3F9B9B /end MEASUREMENT
/begin MEASUREMENT ed_fil_sg_inj.zyklus_filter_nv "Vorwaertsfilter zur Fehlerzustandsbestaetigung" UBYTE FORMULA_0003 0 0 0.0 255.0000 ECU_ADDRESS 0x3F9BD1 /end MEASUREMENT
/begin MEASUREMENT ed_fil_s_poel_diag.zyklus_filter_nv "Vorwaertsfilter zur Fehlerzustandsbestaetigung" UBYTE FORMULA_0003 0 0 0.0 255.0000 ECU_ADDRESS 0x3F9BE3 /end MEASUREMENT
/begin MEASUREMENT ed_fil_te_obd_1.zyklus_filter_nv "Vorwaertsfilter zur Fehlerzustandsbestaetigung" UBYTE FORMULA_0003 0 0 0.0 255.0000 ECU_ADDRESS 0x3F9BE9 /end MEASUREMENT
/begin MEASUREMENT ed_fil_te_obd_2.zyklus_filter_nv "Vorwaertsfilter zur Fehlerzustandsbestaetigung" UBYTE FORMULA_0003 0 0 0.0 255.0000 ECU_ADDRESS 0x3F9BEF /end MEASUREMENT
/begin MEASUREMENT ed_fil_tev1.zyklus_filter_nv "Vorwaertsfilter zur Fehlerzustandsbestaetigung" UBYTE FORMULA_0003 0 0 0.0 255.0000 ECU_ADDRESS 0x3F9BF5 /end MEASUREMENT
/begin MEASUREMENT ed_fil_tev2.zyklus_filter_nv "Vorwaertsfilter zur Fehlerzustandsbestaetigung" UBYTE FORMULA_0003 0 0 0.0 255.0000 ECU_ADDRESS 0x3F9BFB /end MEASUREMENT
/begin MEASUREMENT ed_fil_slp.zyklus_filter_nv "Vorwaertsfilter zur Fehlerzustandsbestaetigung" UBYTE FORMULA_0003 0 0 0.0 255.0000 ECU_ADDRESS 0x3F9C2B /end MEASUREMENT
/begin MEASUREMENT ed_fil_sl_durchs_b1.zyklus_filter_nv "Vorwaertsfilter zur Fehlerzustandsbestaetigung" UBYTE FORMULA_0003 0 0 0.0 255.0000 ECU_ADDRESS 0x3F9C31 /end MEASUREMENT
/begin MEASUREMENT ed_fil_sl_durchs_b2.zyklus_filter_nv "Vorwaertsfilter zur Fehlerzustandsbestaetigung" UBYTE FORMULA_0003 0 0 0.0 255.0000 ECU_ADDRESS 0x3F9C37 /end MEASUREMENT
/begin MEASUREMENT ed_fil_sl_durchs_hstrang.zyklus_filter_nv "Vorwaertsfilter zur Fehlerzustandsbestaetigung" UBYTE FORMULA_0003 0 0 0.0 255.0000 ECU_ADDRESS 0x3F9C3D /end MEASUREMENT
/begin MEASUREMENT ed_fil_s_getr_hs.zyklus_filter_nv "Vorwaertsfilter zur Fehlerzustandsbestaetigung" UBYTE FORMULA_0003 0 0 0.0 255.0000 ECU_ADDRESS 0x3F9C49 /end MEASUREMENT
/begin MEASUREMENT ed_fil_s_kupp_hs.zyklus_filter_nv "Vorwaertsfilter zur Fehlerzustandsbestaetigung" UBYTE FORMULA_0003 0 0 0.0 255.0000 ECU_ADDRESS 0x3F9C4F /end MEASUREMENT
/begin MEASUREMENT ed_fil_van_druck.zyklus_filter_nv "Vorwaertsfilter zur Fehlerzustandsbestaetigung" UBYTE FORMULA_0003 0 0 0.0 255.0000 ECU_ADDRESS 0x3F9C55 /end MEASUREMENT
/begin MEASUREMENT ed_fil_pt_statanh.zyklus_filter_nv "Vorwaertsfilter zur Fehlerzustandsbestaetigung" UBYTE FORMULA_0003 0 0 0.0 255.0000 ECU_ADDRESS 0x3F9C67 /end MEASUREMENT
/begin MEASUREMENT ed_fil_pt_statgrb.zyklus_filter_nv "Vorwaertsfilter zur Fehlerzustandsbestaetigung" UBYTE FORMULA_0003 0 0 0.0 255.0000 ECU_ADDRESS 0x3F9C85 /end MEASUREMENT
/begin MEASUREMENT ed_fil_pt_anfradmom.zyklus_filter_nv "Vorwaertsfilter zur Fehlerzustandsbestaetigung" UBYTE FORMULA_0003 0 0 0.0 255.0000 ECU_ADDRESS 0x3F9C8B /end MEASUREMENT
/begin MEASUREMENT ed_fil_tank_leer.zyklus_filter_nv "Vorwaertsfilter zur Fehlerzustandsbestaetigung" UBYTE FORMULA_0003 0 0 0.0 255.0000 ECU_ADDRESS 0x3F9C97 /end MEASUREMENT
/begin MEASUREMENT ed_fil_pt_toma.zyklus_filter_nv "Vorwaertsfilter zur Fehlerzustandsbestaetigung" UBYTE FORMULA_0003 0 0 0.0 255.0000 ECU_ADDRESS 0x3F9C9D /end MEASUREMENT
/begin MEASUREMENT ed_fil_pumg_obd.zyklus_filter_nv "Vorwaertsfilter zur Fehlerzustandsbestaetigung" UBYTE FORMULA_0003 0 0 0.0 255.0000 ECU_ADDRESS 0x3F9CA9 /end MEASUREMENT
/begin MEASUREMENT ed_fil_sl_ml_hfm_obd.zyklus_filter_nv "Vorwaertsfilter zur Fehlerzustandsbestaetigung" UBYTE FORMULA_0003 0 0 0.0 255.0000 ECU_ADDRESS 0x3F9CAF /end MEASUREMENT
/begin MEASUREMENT ed_fil_lank1_openload.zyklus_filter_nv "Vorwaertsfilter zur Fehlerzustandsbestaetigung" UBYTE FORMULA_0003 0 0 0.0 255.0000 ECU_ADDRESS 0x3F9CC1 /end MEASUREMENT
/begin MEASUREMENT ed_fil_lank2_openload.zyklus_filter_nv "Vorwaertsfilter zur Fehlerzustandsbestaetigung" UBYTE FORMULA_0003 0 0 0.0 255.0000 ECU_ADDRESS 0x3F9CC7 /end MEASUREMENT
/begin MEASUREMENT ed_fil_lank1_obd_we.zyklus_filter_nv "Vorwaertsfilter zur Fehlerzustandsbestaetigung" UBYTE FORMULA_0003 0 0 0.0 255.0000 ECU_ADDRESS 0x3F9CCD /end MEASUREMENT
/begin MEASUREMENT ed_fil_lank2_obd_we.zyklus_filter_nv "Vorwaertsfilter zur Fehlerzustandsbestaetigung" UBYTE FORMULA_0003 0 0 0.0 255.0000 ECU_ADDRESS 0x3F9CD3 /end MEASUREMENT
/begin MEASUREMENT ed_fil_lshnk1_r.zyklus_filter_nv "Vorwaertsfilter zur Fehlerzustandsbestaetigung" UBYTE FORMULA_0003 0 0 0.0 255.0000 ECU_ADDRESS 0x3F9CD9 /end MEASUREMENT
/begin MEASUREMENT ed_fil_lshnk2_r.zyklus_filter_nv "Vorwaertsfilter zur Fehlerzustandsbestaetigung" UBYTE FORMULA_0003 0 0 0.0 255.0000 ECU_ADDRESS 0x3F9CDF /end MEASUREMENT
/begin MEASUREMENT ed_fil_pks_modell.zyklus_filter_nv "Vorwaertsfilter zur Fehlerzustandsbestaetigung" UBYTE FORMULA_0003 0 0 0.0 255.0000 ECU_ADDRESS 0x3F9CE5 /end MEASUREMENT
/begin MEASUREMENT ed_fil_pks_paufbau.zyklus_filter_nv "Vorwaertsfilter zur Fehlerzustandsbestaetigung" UBYTE FORMULA_0003 0 0 0.0 255.0000 ECU_ADDRESS 0x3F9CEB /end MEASUREMENT
/begin MEASUREMENT ed_fil_pks_adapt_anschl.zyklus_filter_nv "Vorwaertsfilter zur Fehlerzustandsbestaetigung" UBYTE FORMULA_0003 0 0 0.0 255.0000 ECU_ADDRESS 0x3F9CF1 /end MEASUREMENT
/begin MEASUREMENT ed_fil_tgetr_hs.zyklus_filter_nv "Vorwaertsfilter zur Fehlerzustandsbestaetigung" UBYTE FORMULA_0003 0 0 0.0 255.0000 ECU_ADDRESS 0x3F9CF7 /end MEASUREMENT
/begin MEASUREMENT ed_fil_lavk_atic42.zyklus_filter_nv "Vorwaertsfilter zur Fehlerzustandsbestaetigung" UBYTE FORMULA_0003 0 0 0.0 255.0000 ECU_ADDRESS 0x3F9CFD /end MEASUREMENT
/begin MEASUREMENT ed_fil_pt_ax.zyklus_filter_nv "Vorwaertsfilter zur Fehlerzustandsbestaetigung" UBYTE FORMULA_0003 0 0 0.0 255.0000 ECU_ADDRESS 0x3F9D03 /end MEASUREMENT
/begin MEASUREMENT ed_fil_pt_obd_ed.zyklus_filter_nv "Vorwaertsfilter zur Fehlerzustandsbestaetigung" UBYTE FORMULA_0003 0 0 0.0 255.0000 ECU_ADDRESS 0x3F9D09 /end MEASUREMENT
/begin MEASUREMENT ed_fil_lank2_obd_slope.zyklus_filter_nv "Vorwaertsfilter zur Fehlerzustandsbestaetigung" UBYTE FORMULA_0003 0 0 0.0 255.0000 ECU_ADDRESS 0x3F9D21 /end MEASUREMENT
/begin MEASUREMENT ed_fil_mvac_obd.zyklus_filter_nv "Vorwaertsfilter zur Fehlerzustandsbestaetigung" UBYTE FORMULA_0003 0 0 0.0 255.0000 ECU_ADDRESS 0x3F9D27 /end MEASUREMENT
/begin MEASUREMENT ed_fil_lavk2_atic42.zyklus_filter_nv "Vorwaertsfilter zur Fehlerzustandsbestaetigung" UBYTE FORMULA_0003 0 0 0.0 255.0000 ECU_ADDRESS 0x3F9D33 /end MEASUREMENT
/begin MEASUREMENT ed_fil_sk_tr_inj.art_aktuell_nv "Fehlerart und Statusbits" UWORD FORMULA_0049 0 0 0.0 65535.0 ECU_ADDRESS 0x3F9872 BIT_MASK 0xB4F /end MEASUREMENT
/begin MEASUREMENT ed_fil_pumg.art_aktuell_nv "Fehlerart und Statusbits" UWORD FORMULA_0049 0 0 0.0 65535.0 ECU_ADDRESS 0x3F9878 BIT_MASK 0xB4F /end MEASUREMENT
/begin MEASUREMENT ed_fil_psau1.art_aktuell_nv "Fehlerart und Statusbits" UWORD FORMULA_0049 0 0 0.0 65535.0 ECU_ADDRESS 0x3F988A BIT_MASK 0xB4F /end MEASUREMENT
/begin MEASUREMENT ed_fil_psau2.art_aktuell_nv "Fehlerart und Statusbits" UWORD FORMULA_0049 0 0 0.0 65535.0 ECU_ADDRESS 0x3F9890 BIT_MASK 0xB4F /end MEASUREMENT
/begin MEASUREMENT ed_fil_van_hall_e1.art_aktuell_nv "Fehlerart und Statusbits" UWORD FORMULA_0049 0 0 0.0 65535.0 ECU_ADDRESS 0x3F9896 BIT_MASK 0xB4F /end MEASUREMENT
/begin MEASUREMENT ed_fil_van_hall_a1.art_aktuell_nv "Fehlerart und Statusbits" UWORD FORMULA_0049 0 0 0.0 65535.0 ECU_ADDRESS 0x3F989C BIT_MASK 0xB4F /end MEASUREMENT
/begin MEASUREMENT ed_fil_van_hall_e2.art_aktuell_nv "Fehlerart und Statusbits" UWORD FORMULA_0049 0 0 0.0 65535.0 ECU_ADDRESS 0x3F98A2 BIT_MASK 0xB4F /end MEASUREMENT
/begin MEASUREMENT ed_fil_van_hall_a2.art_aktuell_nv "Fehlerart und Statusbits" UWORD FORMULA_0049 0 0 0.0 65535.0 ECU_ADDRESS 0x3F98A8 BIT_MASK 0xB4F /end MEASUREMENT
/begin MEASUREMENT ed_fil_van_regl_e1.art_aktuell_nv "Fehlerart und Statusbits" UWORD FORMULA_0049 0 0 0.0 65535.0 ECU_ADDRESS 0x3F98AE BIT_MASK 0xB4F /end MEASUREMENT
/begin MEASUREMENT ed_fil_van_regl_a1.art_aktuell_nv "Fehlerart und Statusbits" UWORD FORMULA_0049 0 0 0.0 65535.0 ECU_ADDRESS 0x3F98B4 BIT_MASK 0xB4F /end MEASUREMENT
/begin MEASUREMENT ed_fil_van_regl_e2.art_aktuell_nv "Fehlerart und Statusbits" UWORD FORMULA_0049 0 0 0.0 65535.0 ECU_ADDRESS 0x3F98BA BIT_MASK 0xB4F /end MEASUREMENT
/begin MEASUREMENT ed_fil_van_regl_a2.art_aktuell_nv "Fehlerart und Statusbits" UWORD FORMULA_0049 0 0 0.0 65535.0 ECU_ADDRESS 0x3F98C0 BIT_MASK 0xB4F /end MEASUREMENT
/begin MEASUREMENT ed_fil_nw1_sync.art_aktuell_nv "Fehlerart und Statusbits" UWORD FORMULA_0049 0 0 0.0 65535.0 ECU_ADDRESS 0x3F98C6 BIT_MASK 0xB4F /end MEASUREMENT
/begin MEASUREMENT ed_fil_nw2_sync.art_aktuell_nv "Fehlerart und Statusbits" UWORD FORMULA_0049 0 0 0.0 65535.0 ECU_ADDRESS 0x3F98CC BIT_MASK 0xB4F /end MEASUREMENT
/begin MEASUREMENT ed_fil_pctrl_inj.art_aktuell_nv "Fehlerart und Statusbits" UWORD FORMULA_0049 0 0 0.0 65535.0 ECU_ADDRESS 0x3F98D2 BIT_MASK 0xB4F /end MEASUREMENT
/begin MEASUREMENT ed_fil_pt_statdkg.art_aktuell_nv "Fehlerart und Statusbits" UWORD FORMULA_0049 0 0 0.0 65535.0 ECU_ADDRESS 0x3F98D8 BIT_MASK 0xB4F /end MEASUREMENT
/begin MEASUREMENT ed_fil_pks.art_aktuell_nv "Fehlerart und Statusbits" UWORD FORMULA_0049 0 0 0.0 65535.0 ECU_ADDRESS 0x3F98DE BIT_MASK 0xB4F /end MEASUREMENT
/begin MEASUREMENT ed_fil_pt_statr.art_aktuell_nv "Fehlerart und Statusbits" UWORD FORMULA_0049 0 0 0.0 65535.0 ECU_ADDRESS 0x3F98E4 BIT_MASK 0xB4F /end MEASUREMENT
/begin MEASUREMENT ed_fil_lavk1.art_aktuell_nv "Fehlerart und Statusbits" UWORD FORMULA_0049 0 0 0.0 65535.0 ECU_ADDRESS 0x3F98EA BIT_MASK 0xB4F /end MEASUREMENT
/begin MEASUREMENT ed_fil_lavk2.art_aktuell_nv "Fehlerart und Statusbits" UWORD FORMULA_0049 0 0 0.0 65535.0 ECU_ADDRESS 0x3F98F0 BIT_MASK 0xB4F /end MEASUREMENT
/begin MEASUREMENT ed_fil_lavk1_obd_plau.art_aktuell_nv "Fehlerart und Statusbits" UWORD FORMULA_0049 0 0 0.0 65535.0 ECU_ADDRESS 0x3F98F6 BIT_MASK 0xB4F /end MEASUREMENT
/begin MEASUREMENT ed_fil_lavk2_obd_plau.art_aktuell_nv "Fehlerart und Statusbits" UWORD FORMULA_0049 0 0 0.0 65535.0 ECU_ADDRESS 0x3F98FC BIT_MASK 0xB4F /end MEASUREMENT
/begin MEASUREMENT ed_fil_lavk1_obd_sa.art_aktuell_nv "Fehlerart und Statusbits" UWORD FORMULA_0049 0 0 0.0 65535.0 ECU_ADDRESS 0x3F9902 BIT_MASK 0xB4F /end MEASUREMENT
/begin MEASUREMENT ed_fil_lavk2_obd_sa.art_aktuell_nv "Fehlerart und Statusbits" UWORD FORMULA_0049 0 0 0.0 65535.0 ECU_ADDRESS 0x3F9908 BIT_MASK 0xB4F /end MEASUREMENT
/begin MEASUREMENT ed_fil_lank2.art_aktuell_nv "Fehlerart und Statusbits" UWORD FORMULA_0049 0 0 0.0 65535.0 ECU_ADDRESS 0x3F9914 BIT_MASK 0xB4F /end MEASUREMENT
/begin MEASUREMENT ed_fil_lshnk1.art_aktuell_nv "Fehlerart und Statusbits" UWORD FORMULA_0049 0 0 0.0 65535.0 ECU_ADDRESS 0x3F991A BIT_MASK 0xB4F /end MEASUREMENT
/begin MEASUREMENT ed_fil_lshnk2.art_aktuell_nv "Fehlerart und Statusbits" UWORD FORMULA_0049 0 0 0.0 65535.0 ECU_ADDRESS 0x3F9920 BIT_MASK 0xB4F /end MEASUREMENT
/begin MEASUREMENT ed_fil_pt_busoff.art_aktuell_nv "Fehlerart und Statusbits" UWORD FORMULA_0049 0 0 0.0 65535.0 ECU_ADDRESS 0x3F9926 BIT_MASK 0xB4F /end MEASUREMENT
/begin MEASUREMENT ed_fil_pt_torqdsc.art_aktuell_nv "Fehlerart und Statusbits" UWORD FORMULA_0049 0 0 0.0 65535.0 ECU_ADDRESS 0x3F992C BIT_MASK 0xB4F /end MEASUREMENT
/begin MEASUREMENT ed_fil_pt_stdsc.art_aktuell_nv "Fehlerart und Statusbits" UWORD FORMULA_0049 0 0 0.0 65535.0 ECU_ADDRESS 0x3F9932 BIT_MASK 0xB4F /end MEASUREMENT
/begin MEASUREMENT ed_fil_pt_vrad.art_aktuell_nv "Fehlerart und Statusbits" UWORD FORMULA_0049 0 0 0.0 65535.0 ECU_ADDRESS 0x3F9938 BIT_MASK 0xB4F /end MEASUREMENT
/begin MEASUREMENT ed_fil_pt_vfzg.art_aktuell_nv "Fehlerart und Statusbits" UWORD FORMULA_0049 0 0 0.0 65535.0 ECU_ADDRESS 0x3F993E BIT_MASK 0xB4F /end MEASUREMENT
/begin MEASUREMENT ed_fil_pt_atemp.art_aktuell_nv "Fehlerart und Statusbits" UWORD FORMULA_0049 0 0 0.0 65535.0 ECU_ADDRESS 0x3F9944 BIT_MASK 0xB4F /end MEASUREMENT
/begin MEASUREMENT ed_fil_pt_klst.art_aktuell_nv "Fehlerart und Statusbits" UWORD FORMULA_0049 0 0 0.0 65535.0 ECU_ADDRESS 0x3F994A BIT_MASK 0xB4F /end MEASUREMENT
/begin MEASUREMENT ed_fil_pt_kkos.art_aktuell_nv "Fehlerart und Statusbits" UWORD FORMULA_0049 0 0 0.0 65535.0 ECU_ADDRESS 0x3F9950 BIT_MASK 0xB4F /end MEASUREMENT
/begin MEASUREMENT ed_fil_pt_lrw.art_aktuell_nv "Fehlerart und Statusbits" UWORD FORMULA_0049 0 0 0.0 65535.0 ECU_ADDRESS 0x3F9956 BIT_MASK 0xB4F /end MEASUREMENT
/begin MEASUREMENT ed_fil_sl_ml_hfm.art_aktuell_nv "Fehlerart und Statusbits" UWORD FORMULA_0049 0 0 0.0 65535.0 ECU_ADDRESS 0x3F9968 BIT_MASK 0xB4F /end MEASUREMENT
/begin MEASUREMENT ed_fil_lank2_obd_s.art_aktuell_nv "Fehlerart und Statusbits" UWORD FORMULA_0049 0 0 0.0 65535.0 ECU_ADDRESS 0x3F9974 BIT_MASK 0xB4F /end MEASUREMENT
/begin MEASUREMENT ed_fil_lavk1_obd_tl.art_aktuell_nv "Fehlerart und Statusbits" UWORD FORMULA_0049 0 0 0.0 65535.0 ECU_ADDRESS 0x3F997A BIT_MASK 0xB4F /end MEASUREMENT
/begin MEASUREMENT ed_fil_lavk2_obd_tl.art_aktuell_nv "Fehlerart und Statusbits" UWORD FORMULA_0049 0 0 0.0 65535.0 ECU_ADDRESS 0x3F9980 BIT_MASK 0xB4F /end MEASUREMENT
/begin MEASUREMENT ed_fil_lshvk1.art_aktuell_nv "Fehlerart und Statusbits" UWORD FORMULA_0049 0 0 0.0 65535.0 ECU_ADDRESS 0x3F9986 BIT_MASK 0xB4F /end MEASUREMENT
/begin MEASUREMENT ed_fil_lshvk2.art_aktuell_nv "Fehlerart und Statusbits" UWORD FORMULA_0049 0 0 0.0 65535.0 ECU_ADDRESS 0x3F998C BIT_MASK 0xB4F /end MEASUREMENT
/begin MEASUREMENT ed_fil_lsrvk1_obd_reg.art_aktuell_nv "Fehlerart und Statusbits" UWORD FORMULA_0049 0 0 0.0 65535.0 ECU_ADDRESS 0x3F9992 BIT_MASK 0xB4F /end MEASUREMENT
/begin MEASUREMENT ed_fil_lsrvk2_obd_reg.art_aktuell_nv "Fehlerart und Statusbits" UWORD FORMULA_0049 0 0 0.0 65535.0 ECU_ADDRESS 0x3F9998 BIT_MASK 0xB4F /end MEASUREMENT
/begin MEASUREMENT ed_fil_lshvk1_r.art_aktuell_nv "Fehlerart und Statusbits" UWORD FORMULA_0049 0 0 0.0 65535.0 ECU_ADDRESS 0x3F999E BIT_MASK 0xB4F /end MEASUREMENT
/begin MEASUREMENT ed_fil_lshvk2_r.art_aktuell_nv "Fehlerart und Statusbits" UWORD FORMULA_0049 0 0 0.0 65535.0 ECU_ADDRESS 0x3F99A4 BIT_MASK 0xB4F /end MEASUREMENT
/begin MEASUREMENT ed_fil_lsrvk1_obd_start.art_aktuell_nv "Fehlerart und Statusbits" UWORD FORMULA_0049 0 0 0.0 65535.0 ECU_ADDRESS 0x3F99AA BIT_MASK 0xB4F /end MEASUREMENT
/begin MEASUREMENT ed_fil_lsrvk2_obd_start.art_aktuell_nv "Fehlerart und Statusbits" UWORD FORMULA_0049 0 0 0.0 65535.0 ECU_ADDRESS 0x3F99B0 BIT_MASK 0xB4F /end MEASUREMENT
/begin MEASUREMENT ed_fil_lsrvk1_obd_ref.art_aktuell_nv "Fehlerart und Statusbits" UWORD FORMULA_0049 0 0 0.0 65535.0 ECU_ADDRESS 0x3F99B6 BIT_MASK 0xB4F /end MEASUREMENT
/begin MEASUREMENT ed_fil_lsrvk2_obd_ref.art_aktuell_nv "Fehlerart und Statusbits" UWORD FORMULA_0049 0 0 0.0 65535.0 ECU_ADDRESS 0x3F99BC BIT_MASK 0xB4F /end MEASUREMENT
/begin MEASUREMENT ed_fil_lavk1_diag.art_aktuell_nv "Fehlerart und Statusbits" UWORD FORMULA_0049 0 0 0.0 65535.0 ECU_ADDRESS 0x3F99C2 BIT_MASK 0xB4F /end MEASUREMENT
/begin MEASUREMENT ed_fil_lavk2_diag.art_aktuell_nv "Fehlerart und Statusbits" UWORD FORMULA_0049 0 0 0.0 65535.0 ECU_ADDRESS 0x3F99C8 BIT_MASK 0xB4F /end MEASUREMENT
/begin MEASUREMENT ed_fil_lavk1_ia_openload.art_aktuell_nv "Fehlerart und Statusbits" UWORD FORMULA_0049 0 0 0.0 65535.0 ECU_ADDRESS 0x3F99CE BIT_MASK 0xB4F /end MEASUREMENT
/begin MEASUREMENT ed_fil_lavk2_ia_openload.art_aktuell_nv "Fehlerart und Statusbits" UWORD FORMULA_0049 0 0 0.0 65535.0 ECU_ADDRESS 0x3F99D4 BIT_MASK 0xB4F /end MEASUREMENT
/begin MEASUREMENT ed_fil_pt_grb.art_aktuell_nv "Fehlerart und Statusbits" UWORD FORMULA_0049 0 0 0.0 65535.0 ECU_ADDRESS 0x3F99DA BIT_MASK 0xB4F /end MEASUREMENT
/begin MEASUREMENT ed_fil_pt_grb2.art_aktuell_nv "Fehlerart und Statusbits" UWORD FORMULA_0049 0 0 0.0 65535.0 ECU_ADDRESS 0x3F99E0 BIT_MASK 0xB4F /end MEASUREMENT
/begin MEASUREMENT ed_fil_lavk1_un_openload.art_aktuell_nv "Fehlerart und Statusbits" UWORD FORMULA_0049 0 0 0.0 65535.0 ECU_ADDRESS 0x3F99E6 BIT_MASK 0xB4F /end MEASUREMENT
/begin MEASUREMENT ed_fil_lavk2_un_openload.art_aktuell_nv "Fehlerart und Statusbits" UWORD FORMULA_0049 0 0 0.0 65535.0 ECU_ADDRESS 0x3F99EC BIT_MASK 0xB4F /end MEASUREMENT
/begin MEASUREMENT ed_fil_lavk1_ip_openload.art_aktuell_nv "Fehlerart und Statusbits" UWORD FORMULA_0049 0 0 0.0 65535.0 ECU_ADDRESS 0x3F99F2 BIT_MASK 0xB4F /end MEASUREMENT
/begin MEASUREMENT ed_fil_lavk2_ip_openload.art_aktuell_nv "Fehlerart und Statusbits" UWORD FORMULA_0049 0 0 0.0 65535.0 ECU_ADDRESS 0x3F99F8 BIT_MASK 0xB4F /end MEASUREMENT
/begin MEASUREMENT ed_fil_tz1.art_aktuell_nv "Fehlerart und Statusbits" UWORD FORMULA_0049 0 0 0.0 65535.0 ECU_ADDRESS 0x3F9A04 BIT_MASK 0xB4F /end MEASUREMENT
/begin MEASUREMENT ed_fil_tz2.art_aktuell_nv "Fehlerart und Statusbits" UWORD FORMULA_0049 0 0 0.0 65535.0 ECU_ADDRESS 0x3F9A0A BIT_MASK 0xB4F /end MEASUREMENT
/begin MEASUREMENT ed_fil_tz3.art_aktuell_nv "Fehlerart und Statusbits" UWORD FORMULA_0049 0 0 0.0 65535.0 ECU_ADDRESS 0x3F9A10 BIT_MASK 0xB4F /end MEASUREMENT
/begin MEASUREMENT ed_fil_tz4.art_aktuell_nv "Fehlerart und Statusbits" UWORD FORMULA_0049 0 0 0.0 65535.0 ECU_ADDRESS 0x3F9A16 BIT_MASK 0xB4F /end MEASUREMENT
/begin MEASUREMENT ed_fil_tz5.art_aktuell_nv "Fehlerart und Statusbits" UWORD FORMULA_0049 0 0 0.0 65535.0 ECU_ADDRESS 0x3F9A1C BIT_MASK 0xB4F /end MEASUREMENT
/begin MEASUREMENT ed_fil_tz6.art_aktuell_nv "Fehlerart und Statusbits" UWORD FORMULA_0049 0 0 0.0 65535.0 ECU_ADDRESS 0x3F9A22 BIT_MASK 0xB4F /end MEASUREMENT
/begin MEASUREMENT ed_fil_tz7.art_aktuell_nv "Fehlerart und Statusbits" UWORD FORMULA_0049 0 0 0.0 65535.0 ECU_ADDRESS 0x3F9A28 BIT_MASK 0xB4F /end MEASUREMENT
/begin MEASUREMENT ed_fil_tz8.art_aktuell_nv "Fehlerart und Statusbits" UWORD FORMULA_0049 0 0 0.0 65535.0 ECU_ADDRESS 0x3F9A2E BIT_MASK 0xB4F /end MEASUREMENT
/begin MEASUREMENT ed_fil_tz9.art_aktuell_nv "Fehlerart und Statusbits" UWORD FORMULA_0049 0 0 0.0 65535.0 ECU_ADDRESS 0x3F9A34 BIT_MASK 0xB4F /end MEASUREMENT
/begin MEASUREMENT ed_fil_tz10.art_aktuell_nv "Fehlerart und Statusbits" UWORD FORMULA_0049 0 0 0.0 65535.0 ECU_ADDRESS 0x3F9A3A BIT_MASK 0xB4F /end MEASUREMENT
/begin MEASUREMENT ed_fil_van_anschl_e1.art_aktuell_nv "Fehlerart und Statusbits" UWORD FORMULA_0049 0 0 0.0 65535.0 ECU_ADDRESS 0x3F9A4C BIT_MASK 0xB4F /end MEASUREMENT
/begin MEASUREMENT ed_fil_van_anschl_a1.art_aktuell_nv "Fehlerart und Statusbits" UWORD FORMULA_0049 0 0 0.0 65535.0 ECU_ADDRESS 0x3F9A52 BIT_MASK 0xB4F /end MEASUREMENT
/begin MEASUREMENT ed_fil_van_anschl_e2.art_aktuell_nv "Fehlerart und Statusbits" UWORD FORMULA_0049 0 0 0.0 65535.0 ECU_ADDRESS 0x3F9A58 BIT_MASK 0xB4F /end MEASUREMENT
/begin MEASUREMENT ed_fil_van_anschl_a2.art_aktuell_nv "Fehlerart und Statusbits" UWORD FORMULA_0049 0 0 0.0 65535.0 ECU_ADDRESS 0x3F9A5E BIT_MASK 0xB4F /end MEASUREMENT
/begin MEASUREMENT ed_fil_van_vent_e1.art_aktuell_nv "Fehlerart und Statusbits" UWORD FORMULA_0049 0 0 0.0 65535.0 ECU_ADDRESS 0x3F9A64 BIT_MASK 0xB4F /end MEASUREMENT
/begin MEASUREMENT ed_fil_van_vent_a1.art_aktuell_nv "Fehlerart und Statusbits" UWORD FORMULA_0049 0 0 0.0 65535.0 ECU_ADDRESS 0x3F9A6A BIT_MASK 0xB4F /end MEASUREMENT
/begin MEASUREMENT ed_fil_van_vent_e2.art_aktuell_nv "Fehlerart und Statusbits" UWORD FORMULA_0049 0 0 0.0 65535.0 ECU_ADDRESS 0x3F9A70 BIT_MASK 0xB4F /end MEASUREMENT
/begin MEASUREMENT ed_fil_van_vent_a2.art_aktuell_nv "Fehlerart und Statusbits" UWORD FORMULA_0049 0 0 0.0 65535.0 ECU_ADDRESS 0x3F9A76 BIT_MASK 0xB4F /end MEASUREMENT
/begin MEASUREMENT ed_fil_lavk1_obd_dyn.art_aktuell_nv "Fehlerart und Statusbits" UWORD FORMULA_0049 0 0 0.0 65535.0 ECU_ADDRESS 0x3F9AB8 BIT_MASK 0xB4F /end MEASUREMENT
/begin MEASUREMENT ed_fil_lavk2_obd_dyn.art_aktuell_nv "Fehlerart und Statusbits" UWORD FORMULA_0049 0 0 0.0 65535.0 ECU_ADDRESS 0x3F9ABE BIT_MASK 0xB4F /end MEASUREMENT
/begin MEASUREMENT ed_fil_pt_crash.art_aktuell_nv "Fehlerart und Statusbits" UWORD FORMULA_0049 0 0 0.0 65535.0 ECU_ADDRESS 0x3F9AC4 BIT_MASK 0xB4F /end MEASUREMENT
/begin MEASUREMENT ed_fil_pt_vehmod.art_aktuell_nv "Fehlerart und Statusbits" UWORD FORMULA_0049 0 0 0.0 65535.0 ECU_ADDRESS 0x3F9ACA BIT_MASK 0xB4F /end MEASUREMENT
/begin MEASUREMENT ed_fil_pt_bedfgr.art_aktuell_nv "Fehlerart und Statusbits" UWORD FORMULA_0049 0 0 0.0 65535.0 ECU_ADDRESS 0x3F9AD0 BIT_MASK 0xB4F /end MEASUREMENT
/begin MEASUREMENT ed_fil_lavk1_trim.art_aktuell_nv "Fehlerart und Statusbits" UWORD FORMULA_0049 0 0 0.0 65535.0 ECU_ADDRESS 0x3F9AFA BIT_MASK 0xB4F /end MEASUREMENT
/begin MEASUREMENT ed_fil_lavk2_trim.art_aktuell_nv "Fehlerart und Statusbits" UWORD FORMULA_0049 0 0 0.0 65535.0 ECU_ADDRESS 0x3F9B00 BIT_MASK 0xB4F /end MEASUREMENT
/begin MEASUREMENT ed_fil_rlu87.art_aktuell_nv "Fehlerart und Statusbits" UWORD FORMULA_0049 0 0 0.0 65535.0 ECU_ADDRESS 0x3F9B06 BIT_MASK 0xB4F /end MEASUREMENT
/begin MEASUREMENT ed_fil_ssp.art_aktuell_nv "Fehlerart und Statusbits" UWORD FORMULA_0049 0 0 0.0 65535.0 ECU_ADDRESS 0x3F9B12 BIT_MASK 0xB4F /end MEASUREMENT
/begin MEASUREMENT ed_fil_td.art_aktuell_nv "Fehlerart und Statusbits" UWORD FORMULA_0049 0 0 0.0 65535.0 ECU_ADDRESS 0x3F9B18 BIT_MASK 0xB4F /end MEASUREMENT
/begin MEASUREMENT ed_fil_rlslp.art_aktuell_nv "Fehlerart und Statusbits" UWORD FORMULA_0049 0 0 0.0 65535.0 ECU_ADDRESS 0x3F9B1E BIT_MASK 0xB4F /end MEASUREMENT
/begin MEASUREMENT ed_fil_slv.art_aktuell_nv "Fehlerart und Statusbits" UWORD FORMULA_0049 0 0 0.0 65535.0 ECU_ADDRESS 0x3F9B24 BIT_MASK 0xB4F /end MEASUREMENT
/begin MEASUREMENT ed_fil_pt_km.art_aktuell_nv "Fehlerart und Statusbits" UWORD FORMULA_0049 0 0 0.0 65535.0 ECU_ADDRESS 0x3F9B2A BIT_MASK 0xB4F /end MEASUREMENT
/begin MEASUREMENT ed_fil_pt_kombi.art_aktuell_nv "Fehlerart und Statusbits" UWORD FORMULA_0049 0 0 0.0 65535.0 ECU_ADDRESS 0x3F9B30 BIT_MASK 0xB4F /end MEASUREMENT
/begin MEASUREMENT ed_fil_pks_ll.art_aktuell_nv "Fehlerart und Statusbits" UWORD FORMULA_0049 0 0 0.0 65535.0 ECU_ADDRESS 0x3F9B36 BIT_MASK 0xB4F /end MEASUREMENT
/begin MEASUREMENT ed_fil_pks_tl.art_aktuell_nv "Fehlerart und Statusbits" UWORD FORMULA_0049 0 0 0.0 65535.0 ECU_ADDRESS 0x3F9B3C BIT_MASK 0xB4F /end MEASUREMENT
/begin MEASUREMENT ed_fil_pks_q.art_aktuell_nv "Fehlerart und Statusbits" UWORD FORMULA_0049 0 0 0.0 65535.0 ECU_ADDRESS 0x3F9B42 BIT_MASK 0xB4F /end MEASUREMENT
/begin MEASUREMENT ed_fil_van_dsv.art_aktuell_nv "Fehlerart und Statusbits" UWORD FORMULA_0049 0 0 0.0 65535.0 ECU_ADDRESS 0x3F9B54 BIT_MASK 0xB4F /end MEASUREMENT
/begin MEASUREMENT ed_fil_mvac_drucksensor.art_aktuell_nv "Fehlerart und Statusbits" UWORD FORMULA_0049 0 0 0.0 65535.0 ECU_ADDRESS 0x3F9B8A BIT_MASK 0xB4F /end MEASUREMENT
/begin MEASUREMENT ed_fil_pt_bedat.art_aktuell_nv "Fehlerart und Statusbits" UWORD FORMULA_0049 0 0 0.0 65535.0 ECU_ADDRESS 0x3F9B90 BIT_MASK 0xB4F /end MEASUREMENT
/begin MEASUREMENT ed_fil_sk_manager_inj.art_aktuell_nv "Fehlerart und Statusbits" UWORD FORMULA_0049 0 0 0.0 65535.0 ECU_ADDRESS 0x3F9B96 BIT_MASK 0xB4F /end MEASUREMENT
/begin MEASUREMENT ed_fil_ssp_diag.art_aktuell_nv "Fehlerart und Statusbits" UWORD FORMULA_0049 0 0 0.0 65535.0 ECU_ADDRESS 0x3F9B9C BIT_MASK 0xB4F /end MEASUREMENT
/begin MEASUREMENT ed_fil_sg_inj.art_aktuell_nv "Fehlerart und Statusbits" UWORD FORMULA_0049 0 0 0.0 65535.0 ECU_ADDRESS 0x3F9BD2 BIT_MASK 0xB4F /end MEASUREMENT
/begin MEASUREMENT ed_fil_s_poel_diag.art_aktuell_nv "Fehlerart und Statusbits" UWORD FORMULA_0049 0 0 0.0 65535.0 ECU_ADDRESS 0x3F9BE4 BIT_MASK 0xB4F /end MEASUREMENT
/begin MEASUREMENT ed_fil_te_obd_1.art_aktuell_nv "Fehlerart und Statusbits" UWORD FORMULA_0049 0 0 0.0 65535.0 ECU_ADDRESS 0x3F9BEA BIT_MASK 0xB4F /end MEASUREMENT
/begin MEASUREMENT ed_fil_te_obd_2.art_aktuell_nv "Fehlerart und Statusbits" UWORD FORMULA_0049 0 0 0.0 65535.0 ECU_ADDRESS 0x3F9BF0 BIT_MASK 0xB4F /end MEASUREMENT
/begin MEASUREMENT ed_fil_tev1.art_aktuell_nv "Fehlerart und Statusbits" UWORD FORMULA_0049 0 0 0.0 65535.0 ECU_ADDRESS 0x3F9BF6 BIT_MASK 0xB4F /end MEASUREMENT
/begin MEASUREMENT ed_fil_tev2.art_aktuell_nv "Fehlerart und Statusbits" UWORD FORMULA_0049 0 0 0.0 65535.0 ECU_ADDRESS 0x3F9BFC BIT_MASK 0xB4F /end MEASUREMENT
/begin MEASUREMENT ed_fil_slp.art_aktuell_nv "Fehlerart und Statusbits" UWORD FORMULA_0049 0 0 0.0 65535.0 ECU_ADDRESS 0x3F9C2C BIT_MASK 0xB4F /end MEASUREMENT
/begin MEASUREMENT ed_fil_sl_durchs_b1.art_aktuell_nv "Fehlerart und Statusbits" UWORD FORMULA_0049 0 0 0.0 65535.0 ECU_ADDRESS 0x3F9C32 BIT_MASK 0xB4F /end MEASUREMENT
/begin MEASUREMENT ed_fil_sl_durchs_b2.art_aktuell_nv "Fehlerart und Statusbits" UWORD FORMULA_0049 0 0 0.0 65535.0 ECU_ADDRESS 0x3F9C38 BIT_MASK 0xB4F /end MEASUREMENT
/begin MEASUREMENT ed_fil_sl_durchs_hstrang.art_aktuell_nv "Fehlerart und Statusbits" UWORD FORMULA_0049 0 0 0.0 65535.0 ECU_ADDRESS 0x3F9C3E BIT_MASK 0xB4F /end MEASUREMENT
/begin MEASUREMENT ed_fil_s_getr_hs.art_aktuell_nv "Fehlerart und Statusbits" UWORD FORMULA_0049 0 0 0.0 65535.0 ECU_ADDRESS 0x3F9C4A BIT_MASK 0xB4F /end MEASUREMENT
/begin MEASUREMENT ed_fil_s_kupp_hs.art_aktuell_nv "Fehlerart und Statusbits" UWORD FORMULA_0049 0 0 0.0 65535.0 ECU_ADDRESS 0x3F9C50 BIT_MASK 0xB4F /end MEASUREMENT
/begin MEASUREMENT ed_fil_van_druck.art_aktuell_nv "Fehlerart und Statusbits" UWORD FORMULA_0049 0 0 0.0 65535.0 ECU_ADDRESS 0x3F9C56 BIT_MASK 0xB4F /end MEASUREMENT
/begin MEASUREMENT ed_fil_pt_statanh.art_aktuell_nv "Fehlerart und Statusbits" UWORD FORMULA_0049 0 0 0.0 65535.0 ECU_ADDRESS 0x3F9C68 BIT_MASK 0xB4F /end MEASUREMENT
/begin MEASUREMENT ed_fil_pt_statgrb.art_aktuell_nv "Fehlerart und Statusbits" UWORD FORMULA_0049 0 0 0.0 65535.0 ECU_ADDRESS 0x3F9C86 BIT_MASK 0xB4F /end MEASUREMENT
/begin MEASUREMENT ed_fil_pt_anfradmom.art_aktuell_nv "Fehlerart und Statusbits" UWORD FORMULA_0049 0 0 0.0 65535.0 ECU_ADDRESS 0x3F9C8C BIT_MASK 0xB4F /end MEASUREMENT
/begin MEASUREMENT ed_fil_tank_leer.art_aktuell_nv "Fehlerart und Statusbits" UWORD FORMULA_0049 0 0 0.0 65535.0 ECU_ADDRESS 0x3F9C98 BIT_MASK 0xB4F /end MEASUREMENT
/begin MEASUREMENT ed_fil_pt_toma.art_aktuell_nv "Fehlerart und Statusbits" UWORD FORMULA_0049 0 0 0.0 65535.0 ECU_ADDRESS 0x3F9C9E BIT_MASK 0xB4F /end MEASUREMENT
/begin MEASUREMENT ed_fil_pumg_obd.art_aktuell_nv "Fehlerart und Statusbits" UWORD FORMULA_0049 0 0 0.0 65535.0 ECU_ADDRESS 0x3F9CAA BIT_MASK 0xB4F /end MEASUREMENT
/begin MEASUREMENT ed_fil_sl_ml_hfm_obd.art_aktuell_nv "Fehlerart und Statusbits" UWORD FORMULA_0049 0 0 0.0 65535.0 ECU_ADDRESS 0x3F9CB0 BIT_MASK 0xB4F /end MEASUREMENT
/begin MEASUREMENT ed_fil_lank1_openload.art_aktuell_nv "Fehlerart und Statusbits" UWORD FORMULA_0049 0 0 0.0 65535.0 ECU_ADDRESS 0x3F9CC2 BIT_MASK 0xB4F /end MEASUREMENT
/begin MEASUREMENT ed_fil_lank2_openload.art_aktuell_nv "Fehlerart und Statusbits" UWORD FORMULA_0049 0 0 0.0 65535.0 ECU_ADDRESS 0x3F9CC8 BIT_MASK 0xB4F /end MEASUREMENT
/begin MEASUREMENT ed_fil_lank2_obd_we.art_aktuell_nv "Fehlerart und Statusbits" UWORD FORMULA_0049 0 0 0.0 65535.0 ECU_ADDRESS 0x3F9CD4 BIT_MASK 0xB4F /end MEASUREMENT
/begin MEASUREMENT ed_fil_lshnk1_r.art_aktuell_nv "Fehlerart und Statusbits" UWORD FORMULA_0049 0 0 0.0 65535.0 ECU_ADDRESS 0x3F9CDA BIT_MASK 0xB4F /end MEASUREMENT
/begin MEASUREMENT ed_fil_lshnk2_r.art_aktuell_nv "Fehlerart und Statusbits" UWORD FORMULA_0049 0 0 0.0 65535.0 ECU_ADDRESS 0x3F9CE0 BIT_MASK 0xB4F /end MEASUREMENT
/begin MEASUREMENT ed_fil_pks_modell.art_aktuell_nv "Fehlerart und Statusbits" UWORD FORMULA_0049 0 0 0.0 65535.0 ECU_ADDRESS 0x3F9CE6 BIT_MASK 0xB4F /end MEASUREMENT
/begin MEASUREMENT ed_fil_pks_paufbau.art_aktuell_nv "Fehlerart und Statusbits" UWORD FORMULA_0049 0 0 0.0 65535.0 ECU_ADDRESS 0x3F9CEC BIT_MASK 0xB4F /end MEASUREMENT
/begin MEASUREMENT ed_fil_pks_adapt_anschl.art_aktuell_nv "Fehlerart und Statusbits" UWORD FORMULA_0049 0 0 0.0 65535.0 ECU_ADDRESS 0x3F9CF2 BIT_MASK 0xB4F /end MEASUREMENT
/begin MEASUREMENT ed_fil_tgetr_hs.art_aktuell_nv "Fehlerart und Statusbits" UWORD FORMULA_0049 0 0 0.0 65535.0 ECU_ADDRESS 0x3F9CF8 BIT_MASK 0xB4F /end MEASUREMENT
/begin MEASUREMENT ed_fil_lavk_atic42.art_aktuell_nv "Fehlerart und Statusbits" UWORD FORMULA_0049 0 0 0.0 65535.0 ECU_ADDRESS 0x3F9CFE BIT_MASK 0xB4F /end MEASUREMENT
/begin MEASUREMENT ed_fil_pt_ax.art_aktuell_nv "Fehlerart und Statusbits" UWORD FORMULA_0049 0 0 0.0 65535.0 ECU_ADDRESS 0x3F9D04 BIT_MASK 0xB4F /end MEASUREMENT
/begin MEASUREMENT ed_fil_pt_obd_ed.art_aktuell_nv "Fehlerart und Statusbits" UWORD FORMULA_0049 0 0 0.0 65535.0 ECU_ADDRESS 0x3F9D0A BIT_MASK 0xB4F /end MEASUREMENT
/begin MEASUREMENT ed_fil_lank2_obd_slope.art_aktuell_nv "Fehlerart und Statusbits" UWORD FORMULA_0049 0 0 0.0 65535.0 ECU_ADDRESS 0x3F9D22 BIT_MASK 0xB4F /end MEASUREMENT
/begin MEASUREMENT ed_fil_mvac_obd.art_aktuell_nv "Fehlerart und Statusbits" UWORD FORMULA_0049 0 0 0.0 65535.0 ECU_ADDRESS 0x3F9D28 BIT_MASK 0xB4F /end MEASUREMENT
/begin MEASUREMENT ed_fil_lavk2_atic42.art_aktuell_nv "Fehlerart und Statusbits" UWORD FORMULA_0049 0 0 0.0 65535.0 ECU_ADDRESS 0x3F9D34 BIT_MASK 0xB4F /end MEASUREMENT
/begin MEASUREMENT ed_fil_sk_tr_inj.filter_max_nv "Maximaler Fehlerfilterwert" UBYTE FORMULA_0003 0 0 0.0 255.0000 ECU_ADDRESS 0x3F9874 /end MEASUREMENT
/begin MEASUREMENT ed_fil_pumg.filter_max_nv "Maximaler Fehlerfilterwert" UBYTE FORMULA_0003 0 0 0.0 255.0000 ECU_ADDRESS 0x3F987A /end MEASUREMENT
/begin MEASUREMENT ed_fil_psau1.filter_max_nv "Maximaler Fehlerfilterwert" UBYTE FORMULA_0003 0 0 0.0 255.0000 ECU_ADDRESS 0x3F988C /end MEASUREMENT
/begin MEASUREMENT ed_fil_psau2.filter_max_nv "Maximaler Fehlerfilterwert" UBYTE FORMULA_0003 0 0 0.0 255.0000 ECU_ADDRESS 0x3F9892 /end MEASUREMENT
/begin MEASUREMENT ed_fil_van_hall_e1.filter_max_nv "Maximaler Fehlerfilterwert" UBYTE FORMULA_0003 0 0 0.0 255.0000 ECU_ADDRESS 0x3F9898 /end MEASUREMENT
/begin MEASUREMENT ed_fil_van_hall_a1.filter_max_nv "Maximaler Fehlerfilterwert" UBYTE FORMULA_0003 0 0 0.0 255.0000 ECU_ADDRESS 0x3F989E /end MEASUREMENT
/begin MEASUREMENT ed_fil_van_hall_e2.filter_max_nv "Maximaler Fehlerfilterwert" UBYTE FORMULA_0003 0 0 0.0 255.0000 ECU_ADDRESS 0x3F98A4 /end MEASUREMENT
/begin MEASUREMENT ed_fil_van_hall_a2.filter_max_nv "Maximaler Fehlerfilterwert" UBYTE FORMULA_0003 0 0 0.0 255.0000 ECU_ADDRESS 0x3F98AA /end MEASUREMENT
/begin MEASUREMENT ed_fil_van_regl_e1.filter_max_nv "Maximaler Fehlerfilterwert" UBYTE FORMULA_0003 0 0 0.0 255.0000 ECU_ADDRESS 0x3F98B0 /end MEASUREMENT
/begin MEASUREMENT ed_fil_van_regl_a1.filter_max_nv "Maximaler Fehlerfilterwert" UBYTE FORMULA_0003 0 0 0.0 255.0000 ECU_ADDRESS 0x3F98B6 /end MEASUREMENT
/begin MEASUREMENT ed_fil_van_regl_e2.filter_max_nv "Maximaler Fehlerfilterwert" UBYTE FORMULA_0003 0 0 0.0 255.0000 ECU_ADDRESS 0x3F98BC /end MEASUREMENT
/begin MEASUREMENT ed_fil_van_regl_a2.filter_max_nv "Maximaler Fehlerfilterwert" UBYTE FORMULA_0003 0 0 0.0 255.0000 ECU_ADDRESS 0x3F98C2 /end MEASUREMENT
/begin MEASUREMENT ed_fil_nw1_sync.filter_max_nv "Maximaler Fehlerfilterwert" UBYTE FORMULA_0003 0 0 0.0 255.0000 ECU_ADDRESS 0x3F98C8 /end MEASUREMENT
/begin MEASUREMENT ed_fil_nw2_sync.filter_max_nv "Maximaler Fehlerfilterwert" UBYTE FORMULA_0003 0 0 0.0 255.0000 ECU_ADDRESS 0x3F98CE /end MEASUREMENT
/begin MEASUREMENT ed_fil_pctrl_inj.filter_max_nv "Maximaler Fehlerfilterwert" UBYTE FORMULA_0003 0 0 0.0 255.0000 ECU_ADDRESS 0x3F98D4 /end MEASUREMENT
/begin MEASUREMENT ed_fil_pt_statdkg.filter_max_nv "Maximaler Fehlerfilterwert" UBYTE FORMULA_0003 0 0 0.0 255.0000 ECU_ADDRESS 0x3F98DA /end MEASUREMENT
/begin MEASUREMENT ed_fil_pks.filter_max_nv "Maximaler Fehlerfilterwert" UBYTE FORMULA_0003 0 0 0.0 255.0000 ECU_ADDRESS 0x3F98E0 /end MEASUREMENT
/begin MEASUREMENT ed_fil_pt_statr.filter_max_nv "Maximaler Fehlerfilterwert" UBYTE FORMULA_0003 0 0 0.0 255.0000 ECU_ADDRESS 0x3F98E6 /end MEASUREMENT
/begin MEASUREMENT ed_fil_lavk1.filter_max_nv "Maximaler Fehlerfilterwert" UBYTE FORMULA_0003 0 0 0.0 255.0000 ECU_ADDRESS 0x3F98EC /end MEASUREMENT
/begin MEASUREMENT ed_fil_lavk2.filter_max_nv "Maximaler Fehlerfilterwert" UBYTE FORMULA_0003 0 0 0.0 255.0000 ECU_ADDRESS 0x3F98F2 /end MEASUREMENT
/begin MEASUREMENT ed_fil_lavk1_obd_plau.filter_max_nv "Maximaler Fehlerfilterwert" UBYTE FORMULA_0003 0 0 0.0 255.0000 ECU_ADDRESS 0x3F98F8 /end MEASUREMENT
/begin MEASUREMENT ed_fil_lavk2_obd_plau.filter_max_nv "Maximaler Fehlerfilterwert" UBYTE FORMULA_0003 0 0 0.0 255.0000 ECU_ADDRESS 0x3F98FE /end MEASUREMENT
/begin MEASUREMENT ed_fil_lavk1_obd_sa.filter_max_nv "Maximaler Fehlerfilterwert" UBYTE FORMULA_0003 0 0 0.0 255.0000 ECU_ADDRESS 0x3F9904 /end MEASUREMENT
/begin MEASUREMENT ed_fil_lavk2_obd_sa.filter_max_nv "Maximaler Fehlerfilterwert" UBYTE FORMULA_0003 0 0 0.0 255.0000 ECU_ADDRESS 0x3F990A /end MEASUREMENT
/begin MEASUREMENT ed_fil_lank2.filter_max_nv "Maximaler Fehlerfilterwert" UBYTE FORMULA_0003 0 0 0.0 255.0000 ECU_ADDRESS 0x3F9916 /end MEASUREMENT
/begin MEASUREMENT ed_fil_lshnk1.filter_max_nv "Maximaler Fehlerfilterwert" UBYTE FORMULA_0003 0 0 0.0 255.0000 ECU_ADDRESS 0x3F991C /end MEASUREMENT
/begin MEASUREMENT ed_fil_lshnk2.filter_max_nv "Maximaler Fehlerfilterwert" UBYTE FORMULA_0003 0 0 0.0 255.0000 ECU_ADDRESS 0x3F9922 /end MEASUREMENT
/begin MEASUREMENT ed_fil_pt_busoff.filter_max_nv "Maximaler Fehlerfilterwert" UBYTE FORMULA_0003 0 0 0.0 255.0000 ECU_ADDRESS 0x3F9928 /end MEASUREMENT
/begin MEASUREMENT ed_fil_pt_torqdsc.filter_max_nv "Maximaler Fehlerfilterwert" UBYTE FORMULA_0003 0 0 0.0 255.0000 ECU_ADDRESS 0x3F992E /end MEASUREMENT
/begin MEASUREMENT ed_fil_pt_stdsc.filter_max_nv "Maximaler Fehlerfilterwert" UBYTE FORMULA_0003 0 0 0.0 255.0000 ECU_ADDRESS 0x3F9934 /end MEASUREMENT
/begin MEASUREMENT ed_fil_pt_vrad.filter_max_nv "Maximaler Fehlerfilterwert" UBYTE FORMULA_0003 0 0 0.0 255.0000 ECU_ADDRESS 0x3F993A /end MEASUREMENT
/begin MEASUREMENT ed_fil_pt_vfzg.filter_max_nv "Maximaler Fehlerfilterwert" UBYTE FORMULA_0003 0 0 0.0 255.0000 ECU_ADDRESS 0x3F9940 /end MEASUREMENT
/begin MEASUREMENT ed_fil_pt_atemp.filter_max_nv "Maximaler Fehlerfilterwert" UBYTE FORMULA_0003 0 0 0.0 255.0000 ECU_ADDRESS 0x3F9946 /end MEASUREMENT
/begin MEASUREMENT ed_fil_pt_klst.filter_max_nv "Maximaler Fehlerfilterwert" UBYTE FORMULA_0003 0 0 0.0 255.0000 ECU_ADDRESS 0x3F994C /end MEASUREMENT
/begin MEASUREMENT ed_fil_pt_kkos.filter_max_nv "Maximaler Fehlerfilterwert" UBYTE FORMULA_0003 0 0 0.0 255.0000 ECU_ADDRESS 0x3F9952 /end MEASUREMENT
/begin MEASUREMENT ed_fil_pt_lrw.filter_max_nv "Maximaler Fehlerfilterwert" UBYTE FORMULA_0003 0 0 0.0 255.0000 ECU_ADDRESS 0x3F9958 /end MEASUREMENT
/begin MEASUREMENT ed_fil_sl_ml_hfm.filter_max_nv "Maximaler Fehlerfilterwert" UBYTE FORMULA_0003 0 0 0.0 255.0000 ECU_ADDRESS 0x3F996A /end MEASUREMENT
/begin MEASUREMENT ed_fil_lank2_obd_s.filter_max_nv "Maximaler Fehlerfilterwert" UBYTE FORMULA_0003 0 0 0.0 255.0000 ECU_ADDRESS 0x3F9976 /end MEASUREMENT
/begin MEASUREMENT ed_fil_lavk1_obd_tl.filter_max_nv "Maximaler Fehlerfilterwert" UBYTE FORMULA_0003 0 0 0.0 255.0000 ECU_ADDRESS 0x3F997C /end MEASUREMENT
/begin MEASUREMENT ed_fil_lavk2_obd_tl.filter_max_nv "Maximaler Fehlerfilterwert" UBYTE FORMULA_0003 0 0 0.0 255.0000 ECU_ADDRESS 0x3F9982 /end MEASUREMENT
/begin MEASUREMENT ed_fil_lshvk1.filter_max_nv "Maximaler Fehlerfilterwert" UBYTE FORMULA_0003 0 0 0.0 255.0000 ECU_ADDRESS 0x3F9988 /end MEASUREMENT
/begin MEASUREMENT ed_fil_lshvk2.filter_max_nv "Maximaler Fehlerfilterwert" UBYTE FORMULA_0003 0 0 0.0 255.0000 ECU_ADDRESS 0x3F998E /end MEASUREMENT
/begin MEASUREMENT ed_fil_lsrvk1_obd_reg.filter_max_nv "Maximaler Fehlerfilterwert" UBYTE FORMULA_0003 0 0 0.0 255.0000 ECU_ADDRESS 0x3F9994 /end MEASUREMENT
/begin MEASUREMENT ed_fil_lsrvk2_obd_reg.filter_max_nv "Maximaler Fehlerfilterwert" UBYTE FORMULA_0003 0 0 0.0 255.0000 ECU_ADDRESS 0x3F999A /end MEASUREMENT
/begin MEASUREMENT ed_fil_lshvk1_r.filter_max_nv "Maximaler Fehlerfilterwert" UBYTE FORMULA_0003 0 0 0.0 255.0000 ECU_ADDRESS 0x3F99A0 /end MEASUREMENT
/begin MEASUREMENT ed_fil_lshvk2_r.filter_max_nv "Maximaler Fehlerfilterwert" UBYTE FORMULA_0003 0 0 0.0 255.0000 ECU_ADDRESS 0x3F99A6 /end MEASUREMENT
/begin MEASUREMENT ed_fil_lsrvk1_obd_start.filter_max_nv "Maximaler Fehlerfilterwert" UBYTE FORMULA_0003 0 0 0.0 255.0000 ECU_ADDRESS 0x3F99AC /end MEASUREMENT
/begin MEASUREMENT ed_fil_lsrvk2_obd_start.filter_max_nv "Maximaler Fehlerfilterwert" UBYTE FORMULA_0003 0 0 0.0 255.0000 ECU_ADDRESS 0x3F99B2 /end MEASUREMENT
/begin MEASUREMENT ed_fil_lsrvk1_obd_ref.filter_max_nv "Maximaler Fehlerfilterwert" UBYTE FORMULA_0003 0 0 0.0 255.0000 ECU_ADDRESS 0x3F99B8 /end MEASUREMENT
/begin MEASUREMENT ed_fil_lsrvk2_obd_ref.filter_max_nv "Maximaler Fehlerfilterwert" UBYTE FORMULA_0003 0 0 0.0 255.0000 ECU_ADDRESS 0x3F99BE /end MEASUREMENT
/begin MEASUREMENT ed_fil_lavk1_diag.filter_max_nv "Maximaler Fehlerfilterwert" UBYTE FORMULA_0003 0 0 0.0 255.0000 ECU_ADDRESS 0x3F99C4 /end MEASUREMENT
/begin MEASUREMENT ed_fil_lavk2_diag.filter_max_nv "Maximaler Fehlerfilterwert" UBYTE FORMULA_0003 0 0 0.0 255.0000 ECU_ADDRESS 0x3F99CA /end MEASUREMENT
/begin MEASUREMENT ed_fil_lavk1_ia_openload.filter_max_nv "Maximaler Fehlerfilterwert" UBYTE FORMULA_0003 0 0 0.0 255.0000 ECU_ADDRESS 0x3F99D0 /end MEASUREMENT
/begin MEASUREMENT ed_fil_lavk2_ia_openload.filter_max_nv "Maximaler Fehlerfilterwert" UBYTE FORMULA_0003 0 0 0.0 255.0000 ECU_ADDRESS 0x3F99D6 /end MEASUREMENT
/begin MEASUREMENT ed_fil_pt_grb.filter_max_nv "Maximaler Fehlerfilterwert" UBYTE FORMULA_0003 0 0 0.0 255.0000 ECU_ADDRESS 0x3F99DC /end MEASUREMENT
/begin MEASUREMENT ed_fil_pt_grb2.filter_max_nv "Maximaler Fehlerfilterwert" UBYTE FORMULA_0003 0 0 0.0 255.0000 ECU_ADDRESS 0x3F99E2 /end MEASUREMENT
/begin MEASUREMENT ed_fil_lavk1_un_openload.filter_max_nv "Maximaler Fehlerfilterwert" UBYTE FORMULA_0003 0 0 0.0 255.0000 ECU_ADDRESS 0x3F99E8 /end MEASUREMENT
/begin MEASUREMENT ed_fil_lavk2_un_openload.filter_max_nv "Maximaler Fehlerfilterwert" UBYTE FORMULA_0003 0 0 0.0 255.0000 ECU_ADDRESS 0x3F99EE /end MEASUREMENT
/begin MEASUREMENT ed_fil_lavk1_ip_openload.filter_max_nv "Maximaler Fehlerfilterwert" UBYTE FORMULA_0003 0 0 0.0 255.0000 ECU_ADDRESS 0x3F99F4 /end MEASUREMENT
/begin MEASUREMENT ed_fil_lavk2_ip_openload.filter_max_nv "Maximaler Fehlerfilterwert" UBYTE FORMULA_0003 0 0 0.0 255.0000 ECU_ADDRESS 0x3F99FA /end MEASUREMENT
/begin MEASUREMENT ed_fil_tz1.filter_max_nv "Maximaler Fehlerfilterwert" UBYTE FORMULA_0003 0 0 0.0 255.0000 ECU_ADDRESS 0x3F9A06 /end MEASUREMENT
/begin MEASUREMENT ed_fil_tz2.filter_max_nv "Maximaler Fehlerfilterwert" UBYTE FORMULA_0003 0 0 0.0 255.0000 ECU_ADDRESS 0x3F9A0C /end MEASUREMENT
/begin MEASUREMENT ed_fil_tz3.filter_max_nv "Maximaler Fehlerfilterwert" UBYTE FORMULA_0003 0 0 0.0 255.0000 ECU_ADDRESS 0x3F9A12 /end MEASUREMENT
/begin MEASUREMENT ed_fil_tz4.filter_max_nv "Maximaler Fehlerfilterwert" UBYTE FORMULA_0003 0 0 0.0 255.0000 ECU_ADDRESS 0x3F9A18 /end MEASUREMENT
/begin MEASUREMENT ed_fil_tz5.filter_max_nv "Maximaler Fehlerfilterwert" UBYTE FORMULA_0003 0 0 0.0 255.0000 ECU_ADDRESS 0x3F9A1E /end MEASUREMENT
/begin MEASUREMENT ed_fil_tz6.filter_max_nv "Maximaler Fehlerfilterwert" UBYTE FORMULA_0003 0 0 0.0 255.0000 ECU_ADDRESS 0x3F9A24 /end MEASUREMENT
/begin MEASUREMENT ed_fil_tz7.filter_max_nv "Maximaler Fehlerfilterwert" UBYTE FORMULA_0003 0 0 0.0 255.0000 ECU_ADDRESS 0x3F9A2A /end MEASUREMENT
/begin MEASUREMENT ed_fil_tz8.filter_max_nv "Maximaler Fehlerfilterwert" UBYTE FORMULA_0003 0 0 0.0 255.0000 ECU_ADDRESS 0x3F9A30 /end MEASUREMENT
/begin MEASUREMENT ed_fil_tz9.filter_max_nv "Maximaler Fehlerfilterwert" UBYTE FORMULA_0003 0 0 0.0 255.0000 ECU_ADDRESS 0x3F9A36 /end MEASUREMENT
/begin MEASUREMENT ed_fil_tz10.filter_max_nv "Maximaler Fehlerfilterwert" UBYTE FORMULA_0003 0 0 0.0 255.0000 ECU_ADDRESS 0x3F9A3C /end MEASUREMENT
/begin MEASUREMENT ed_fil_van_anschl_e1.filter_max_nv "Maximaler Fehlerfilterwert" UBYTE FORMULA_0003 0 0 0.0 255.0000 ECU_ADDRESS 0x3F9A4E /end MEASUREMENT
/begin MEASUREMENT ed_fil_van_anschl_a1.filter_max_nv "Maximaler Fehlerfilterwert" UBYTE FORMULA_0003 0 0 0.0 255.0000 ECU_ADDRESS 0x3F9A54 /end MEASUREMENT
/begin MEASUREMENT ed_fil_van_anschl_e2.filter_max_nv "Maximaler Fehlerfilterwert" UBYTE FORMULA_0003 0 0 0.0 255.0000 ECU_ADDRESS 0x3F9A5A /end MEASUREMENT
/begin MEASUREMENT ed_fil_van_anschl_a2.filter_max_nv "Maximaler Fehlerfilterwert" UBYTE FORMULA_0003 0 0 0.0 255.0000 ECU_ADDRESS 0x3F9A60 /end MEASUREMENT
/begin MEASUREMENT ed_fil_van_vent_e1.filter_max_nv "Maximaler Fehlerfilterwert" UBYTE FORMULA_0003 0 0 0.0 255.0000 ECU_ADDRESS 0x3F9A66 /end MEASUREMENT
/begin MEASUREMENT ed_fil_van_vent_a1.filter_max_nv "Maximaler Fehlerfilterwert" UBYTE FORMULA_0003 0 0 0.0 255.0000 ECU_ADDRESS 0x3F9A6C /end MEASUREMENT
/begin MEASUREMENT ed_fil_van_vent_e2.filter_max_nv "Maximaler Fehlerfilterwert" UBYTE FORMULA_0003 0 0 0.0 255.0000 ECU_ADDRESS 0x3F9A72 /end MEASUREMENT
/begin MEASUREMENT ed_fil_van_vent_a2.filter_max_nv "Maximaler Fehlerfilterwert" UBYTE FORMULA_0003 0 0 0.0 255.0000 ECU_ADDRESS 0x3F9A78 /end MEASUREMENT
/begin MEASUREMENT ed_fil_lavk1_obd_dyn.filter_max_nv "Maximaler Fehlerfilterwert" UBYTE FORMULA_0003 0 0 0.0 255.0000 ECU_ADDRESS 0x3F9ABA /end MEASUREMENT
/begin MEASUREMENT ed_fil_lavk2_obd_dyn.filter_max_nv "Maximaler Fehlerfilterwert" UBYTE FORMULA_0003 0 0 0.0 255.0000 ECU_ADDRESS 0x3F9AC0 /end MEASUREMENT
/begin MEASUREMENT ed_fil_pt_crash.filter_max_nv "Maximaler Fehlerfilterwert" UBYTE FORMULA_0003 0 0 0.0 255.0000 ECU_ADDRESS 0x3F9AC6 /end MEASUREMENT
/begin MEASUREMENT ed_fil_pt_vehmod.filter_max_nv "Maximaler Fehlerfilterwert" UBYTE FORMULA_0003 0 0 0.0 255.0000 ECU_ADDRESS 0x3F9ACC /end MEASUREMENT
/begin MEASUREMENT ed_fil_pt_bedfgr.filter_max_nv "Maximaler Fehlerfilterwert" UBYTE FORMULA_0003 0 0 0.0 255.0000 ECU_ADDRESS 0x3F9AD2 /end MEASUREMENT
/begin MEASUREMENT ed_fil_lavk1_trim.filter_max_nv "Maximaler Fehlerfilterwert" UBYTE FORMULA_0003 0 0 0.0 255.0000 ECU_ADDRESS 0x3F9AFC /end MEASUREMENT
/begin MEASUREMENT ed_fil_lavk2_trim.filter_max_nv "Maximaler Fehlerfilterwert" UBYTE FORMULA_0003 0 0 0.0 255.0000 ECU_ADDRESS 0x3F9B02 /end MEASUREMENT
/begin MEASUREMENT ed_fil_rlu87.filter_max_nv "Maximaler Fehlerfilterwert" UBYTE FORMULA_0003 0 0 0.0 255.0000 ECU_ADDRESS 0x3F9B08 /end MEASUREMENT
/begin MEASUREMENT ed_fil_ssp.filter_max_nv "Maximaler Fehlerfilterwert" UBYTE FORMULA_0003 0 0 0.0 255.0000 ECU_ADDRESS 0x3F9B14 /end MEASUREMENT
/begin MEASUREMENT ed_fil_td.filter_max_nv "Maximaler Fehlerfilterwert" UBYTE FORMULA_0003 0 0 0.0 255.0000 ECU_ADDRESS 0x3F9B1A /end MEASUREMENT
/begin MEASUREMENT ed_fil_rlslp.filter_max_nv "Maximaler Fehlerfilterwert" UBYTE FORMULA_0003 0 0 0.0 255.0000 ECU_ADDRESS 0x3F9B20 /end MEASUREMENT
/begin MEASUREMENT ed_fil_slv.filter_max_nv "Maximaler Fehlerfilterwert" UBYTE FORMULA_0003 0 0 0.0 255.0000 ECU_ADDRESS 0x3F9B26 /end MEASUREMENT
/begin MEASUREMENT ed_fil_pt_km.filter_max_nv "Maximaler Fehlerfilterwert" UBYTE FORMULA_0003 0 0 0.0 255.0000 ECU_ADDRESS 0x3F9B2C /end MEASUREMENT
/begin MEASUREMENT ed_fil_pt_kombi.filter_max_nv "Maximaler Fehlerfilterwert" UBYTE FORMULA_0003 0 0 0.0 255.0000 ECU_ADDRESS 0x3F9B32 /end MEASUREMENT
/begin MEASUREMENT ed_fil_pks_ll.filter_max_nv "Maximaler Fehlerfilterwert" UBYTE FORMULA_0003 0 0 0.0 255.0000 ECU_ADDRESS 0x3F9B38 /end MEASUREMENT
/begin MEASUREMENT ed_fil_pks_tl.filter_max_nv "Maximaler Fehlerfilterwert" UBYTE FORMULA_0003 0 0 0.0 255.0000 ECU_ADDRESS 0x3F9B3E /end MEASUREMENT
/begin MEASUREMENT ed_fil_pks_q.filter_max_nv "Maximaler Fehlerfilterwert" UBYTE FORMULA_0003 0 0 0.0 255.0000 ECU_ADDRESS 0x3F9B44 /end MEASUREMENT
/begin MEASUREMENT ed_fil_van_dsv.filter_max_nv "Maximaler Fehlerfilterwert" UBYTE FORMULA_0003 0 0 0.0 255.0000 ECU_ADDRESS 0x3F9B56 /end MEASUREMENT
/begin MEASUREMENT ed_fil_mvac_drucksensor.filter_max_nv "Maximaler Fehlerfilterwert" UBYTE FORMULA_0003 0 0 0.0 255.0000 ECU_ADDRESS 0x3F9B8C /end MEASUREMENT
/begin MEASUREMENT ed_fil_pt_bedat.filter_max_nv "Maximaler Fehlerfilterwert" UBYTE FORMULA_0003 0 0 0.0 255.0000 ECU_ADDRESS 0x3F9B92 /end MEASUREMENT
/begin MEASUREMENT ed_fil_sk_manager_inj.filter_max_nv "Maximaler Fehlerfilterwert" UBYTE FORMULA_0003 0 0 0.0 255.0000 ECU_ADDRESS 0x3F9B98 /end MEASUREMENT
/begin MEASUREMENT ed_fil_ssp_diag.filter_max_nv "Maximaler Fehlerfilterwert" UBYTE FORMULA_0003 0 0 0.0 255.0000 ECU_ADDRESS 0x3F9B9E /end MEASUREMENT
/begin MEASUREMENT ed_fil_sg_inj.filter_max_nv "Maximaler Fehlerfilterwert" UBYTE FORMULA_0003 0 0 0.0 255.0000 ECU_ADDRESS 0x3F9BD4 /end MEASUREMENT
/begin MEASUREMENT ed_fil_s_poel_diag.filter_max_nv "Maximaler Fehlerfilterwert" UBYTE FORMULA_0003 0 0 0.0 255.0000 ECU_ADDRESS 0x3F9BE6 /end MEASUREMENT
/begin MEASUREMENT ed_fil_te_obd_1.filter_max_nv "Maximaler Fehlerfilterwert" UBYTE FORMULA_0003 0 0 0.0 255.0000 ECU_ADDRESS 0x3F9BEC /end MEASUREMENT
/begin MEASUREMENT ed_fil_te_obd_2.filter_max_nv "Maximaler Fehlerfilterwert" UBYTE FORMULA_0003 0 0 0.0 255.0000 ECU_ADDRESS 0x3F9BF2 /end MEASUREMENT
/begin MEASUREMENT ed_fil_tev1.filter_max_nv "Maximaler Fehlerfilterwert" UBYTE FORMULA_0003 0 0 0.0 255.0000 ECU_ADDRESS 0x3F9BF8 /end MEASUREMENT
/begin MEASUREMENT ed_fil_tev2.filter_max_nv "Maximaler Fehlerfilterwert" UBYTE FORMULA_0003 0 0 0.0 255.0000 ECU_ADDRESS 0x3F9BFE /end MEASUREMENT
/begin MEASUREMENT ed_fil_slp.filter_max_nv "Maximaler Fehlerfilterwert" UBYTE FORMULA_0003 0 0 0.0 255.0000 ECU_ADDRESS 0x3F9C2E /end MEASUREMENT
/begin MEASUREMENT ed_fil_sl_durchs_b1.filter_max_nv "Maximaler Fehlerfilterwert" UBYTE FORMULA_0003 0 0 0.0 255.0000 ECU_ADDRESS 0x3F9C34 /end MEASUREMENT
/begin MEASUREMENT ed_fil_sl_durchs_b2.filter_max_nv "Maximaler Fehlerfilterwert" UBYTE FORMULA_0003 0 0 0.0 255.0000 ECU_ADDRESS 0x3F9C3A /end MEASUREMENT
/begin MEASUREMENT ed_fil_sl_durchs_hstrang.filter_max_nv "Maximaler Fehlerfilterwert" UBYTE FORMULA_0003 0 0 0.0 255.0000 ECU_ADDRESS 0x3F9C40 /end MEASUREMENT
/begin MEASUREMENT ed_fil_s_getr_hs.filter_max_nv "Maximaler Fehlerfilterwert" UBYTE FORMULA_0003 0 0 0.0 255.0000 ECU_ADDRESS 0x3F9C4C /end MEASUREMENT
/begin MEASUREMENT ed_fil_s_kupp_hs.filter_max_nv "Maximaler Fehlerfilterwert" UBYTE FORMULA_0003 0 0 0.0 255.0000 ECU_ADDRESS 0x3F9C52 /end MEASUREMENT
/begin MEASUREMENT ed_fil_van_druck.filter_max_nv "Maximaler Fehlerfilterwert" UBYTE FORMULA_0003 0 0 0.0 255.0000 ECU_ADDRESS 0x3F9C58 /end MEASUREMENT
/begin MEASUREMENT ed_fil_pt_statanh.filter_max_nv "Maximaler Fehlerfilterwert" UBYTE FORMULA_0003 0 0 0.0 255.0000 ECU_ADDRESS 0x3F9C6A /end MEASUREMENT
/begin MEASUREMENT ed_fil_pt_statgrb.filter_max_nv "Maximaler Fehlerfilterwert" UBYTE FORMULA_0003 0 0 0.0 255.0000 ECU_ADDRESS 0x3F9C88 /end MEASUREMENT
/begin MEASUREMENT ed_fil_pt_anfradmom.filter_max_nv "Maximaler Fehlerfilterwert" UBYTE FORMULA_0003 0 0 0.0 255.0000 ECU_ADDRESS 0x3F9C8E /end MEASUREMENT
/begin MEASUREMENT ed_fil_tank_leer.filter_max_nv "Maximaler Fehlerfilterwert" UBYTE FORMULA_0003 0 0 0.0 255.0000 ECU_ADDRESS 0x3F9C9A /end MEASUREMENT
/begin MEASUREMENT ed_fil_pt_toma.filter_max_nv "Maximaler Fehlerfilterwert" UBYTE FORMULA_0003 0 0 0.0 255.0000 ECU_ADDRESS 0x3F9CA0 /end MEASUREMENT
/begin MEASUREMENT ed_fil_pumg_obd.filter_max_nv "Maximaler Fehlerfilterwert" UBYTE FORMULA_0003 0 0 0.0 255.0000 ECU_ADDRESS 0x3F9CAC /end MEASUREMENT
/begin MEASUREMENT ed_fil_sl_ml_hfm_obd.filter_max_nv "Maximaler Fehlerfilterwert" UBYTE FORMULA_0003 0 0 0.0 255.0000 ECU_ADDRESS 0x3F9CB2 /end MEASUREMENT
/begin MEASUREMENT ed_fil_lank1_openload.filter_max_nv "Maximaler Fehlerfilterwert" UBYTE FORMULA_0003 0 0 0.0 255.0000 ECU_ADDRESS 0x3F9CC4 /end MEASUREMENT
/begin MEASUREMENT ed_fil_lank2_openload.filter_max_nv "Maximaler Fehlerfilterwert" UBYTE FORMULA_0003 0 0 0.0 255.0000 ECU_ADDRESS 0x3F9CCA /end MEASUREMENT
/begin MEASUREMENT ed_fil_lank1_obd_we.filter_max_nv "Maximaler Fehlerfilterwert" UBYTE FORMULA_0003 0 0 0.0 255.0000 ECU_ADDRESS 0x3F9CD0 /end MEASUREMENT
/begin MEASUREMENT ed_fil_lank2_obd_we.filter_max_nv "Maximaler Fehlerfilterwert" UBYTE FORMULA_0003 0 0 0.0 255.0000 ECU_ADDRESS 0x3F9CD6 /end MEASUREMENT
/begin MEASUREMENT ed_fil_lshnk1_r.filter_max_nv "Maximaler Fehlerfilterwert" UBYTE FORMULA_0003 0 0 0.0 255.0000 ECU_ADDRESS 0x3F9CDC /end MEASUREMENT
/begin MEASUREMENT ed_fil_lshnk2_r.filter_max_nv "Maximaler Fehlerfilterwert" UBYTE FORMULA_0003 0 0 0.0 255.0000 ECU_ADDRESS 0x3F9CE2 /end MEASUREMENT
/begin MEASUREMENT ed_fil_pks_modell.filter_max_nv "Maximaler Fehlerfilterwert" UBYTE FORMULA_0003 0 0 0.0 255.0000 ECU_ADDRESS 0x3F9CE8 /end MEASUREMENT
/begin MEASUREMENT ed_fil_pks_paufbau.filter_max_nv "Maximaler Fehlerfilterwert" UBYTE FORMULA_0003 0 0 0.0 255.0000 ECU_ADDRESS 0x3F9CEE /end MEASUREMENT
/begin MEASUREMENT ed_fil_pks_adapt_anschl.filter_max_nv "Maximaler Fehlerfilterwert" UBYTE FORMULA_0003 0 0 0.0 255.0000 ECU_ADDRESS 0x3F9CF4 /end MEASUREMENT
/begin MEASUREMENT ed_fil_tgetr_hs.filter_max_nv "Maximaler Fehlerfilterwert" UBYTE FORMULA_0003 0 0 0.0 255.0000 ECU_ADDRESS 0x3F9CFA /end MEASUREMENT
/begin MEASUREMENT ed_fil_lavk_atic42.filter_max_nv "Maximaler Fehlerfilterwert" UBYTE FORMULA_0003 0 0 0.0 255.0000 ECU_ADDRESS 0x3F9D00 /end MEASUREMENT
/begin MEASUREMENT ed_fil_pt_ax.filter_max_nv "Maximaler Fehlerfilterwert" UBYTE FORMULA_0003 0 0 0.0 255.0000 ECU_ADDRESS 0x3F9D06 /end MEASUREMENT
/begin MEASUREMENT ed_fil_pt_obd_ed.filter_max_nv "Maximaler Fehlerfilterwert" UBYTE FORMULA_0003 0 0 0.0 255.0000 ECU_ADDRESS 0x3F9D0C /end MEASUREMENT
/begin MEASUREMENT ed_fil_lank2_obd_slope.filter_max_nv "Maximaler Fehlerfilterwert" UBYTE FORMULA_0003 0 0 0.0 255.0000 ECU_ADDRESS 0x3F9D24 /end MEASUREMENT
/begin MEASUREMENT ed_fil_mvac_obd.filter_max_nv "Maximaler Fehlerfilterwert" UBYTE FORMULA_0003 0 0 0.0 255.0000 ECU_ADDRESS 0x3F9D2A /end MEASUREMENT
/begin MEASUREMENT ed_fil_lavk2_atic42.filter_max_nv "Maximaler Fehlerfilterwert" UBYTE FORMULA_0003 0 0 0.0 255.0000 ECU_ADDRESS 0x3F9D36 /end MEASUREMENT
/begin MEASUREMENT ed_fil_sk_tr_inj.fehler_aufrufe_nv "Gesamtzahl der Fehleraufrufe" UBYTE FORMULA_0003 0 0 0.0 255.0000 ECU_ADDRESS 0x3F9875 /end MEASUREMENT
/begin MEASUREMENT ed_fil_pumg.fehler_aufrufe_nv "Gesamtzahl der Fehleraufrufe" UBYTE FORMULA_0003 0 0 0.0 255.0000 ECU_ADDRESS 0x3F987B /end MEASUREMENT
/begin MEASUREMENT ed_fil_psau1.fehler_aufrufe_nv "Gesamtzahl der Fehleraufrufe" UBYTE FORMULA_0003 0 0 0.0 255.0000 ECU_ADDRESS 0x3F988D /end MEASUREMENT
/begin MEASUREMENT ed_fil_psau2.fehler_aufrufe_nv "Gesamtzahl der Fehleraufrufe" UBYTE FORMULA_0003 0 0 0.0 255.0000 ECU_ADDRESS 0x3F9893 /end MEASUREMENT
/begin MEASUREMENT ed_fil_van_hall_e1.fehler_aufrufe_nv "Gesamtzahl der Fehleraufrufe" UBYTE FORMULA_0003 0 0 0.0 255.0000 ECU_ADDRESS 0x3F9899 /end MEASUREMENT
/begin MEASUREMENT ed_fil_van_hall_a1.fehler_aufrufe_nv "Gesamtzahl der Fehleraufrufe" UBYTE FORMULA_0003 0 0 0.0 255.0000 ECU_ADDRESS 0x3F989F /end MEASUREMENT
/begin MEASUREMENT ed_fil_van_hall_e2.fehler_aufrufe_nv "Gesamtzahl der Fehleraufrufe" UBYTE FORMULA_0003 0 0 0.0 255.0000 ECU_ADDRESS 0x3F98A5 /end MEASUREMENT
/begin MEASUREMENT ed_fil_van_hall_a2.fehler_aufrufe_nv "Gesamtzahl der Fehleraufrufe" UBYTE FORMULA_0003 0 0 0.0 255.0000 ECU_ADDRESS 0x3F98AB /end MEASUREMENT
/begin MEASUREMENT ed_fil_van_regl_e1.fehler_aufrufe_nv "Gesamtzahl der Fehleraufrufe" UBYTE FORMULA_0003 0 0 0.0 255.0000 ECU_ADDRESS 0x3F98B1 /end MEASUREMENT
/begin MEASUREMENT ed_fil_van_regl_a1.fehler_aufrufe_nv "Gesamtzahl der Fehleraufrufe" UBYTE FORMULA_0003 0 0 0.0 255.0000 ECU_ADDRESS 0x3F98B7 /end MEASUREMENT
/begin MEASUREMENT ed_fil_van_regl_e2.fehler_aufrufe_nv "Gesamtzahl der Fehleraufrufe" UBYTE FORMULA_0003 0 0 0.0 255.0000 ECU_ADDRESS 0x3F98BD /end MEASUREMENT
/begin MEASUREMENT ed_fil_van_regl_a2.fehler_aufrufe_nv "Gesamtzahl der Fehleraufrufe" UBYTE FORMULA_0003 0 0 0.0 255.0000 ECU_ADDRESS 0x3F98C3 /end MEASUREMENT
/begin MEASUREMENT ed_fil_nw1_sync.fehler_aufrufe_nv "Gesamtzahl der Fehleraufrufe" UBYTE FORMULA_0003 0 0 0.0 255.0000 ECU_ADDRESS 0x3F98C9 /end MEASUREMENT
/begin MEASUREMENT ed_fil_nw2_sync.fehler_aufrufe_nv "Gesamtzahl der Fehleraufrufe" UBYTE FORMULA_0003 0 0 0.0 255.0000 ECU_ADDRESS 0x3F98CF /end MEASUREMENT
/begin MEASUREMENT ed_fil_pctrl_inj.fehler_aufrufe_nv "Gesamtzahl der Fehleraufrufe" UBYTE FORMULA_0003 0 0 0.0 255.0000 ECU_ADDRESS 0x3F98D5 /end MEASUREMENT
/begin MEASUREMENT ed_fil_pt_statdkg.fehler_aufrufe_nv "Gesamtzahl der Fehleraufrufe" UBYTE FORMULA_0003 0 0 0.0 255.0000 ECU_ADDRESS 0x3F98DB /end MEASUREMENT
/begin MEASUREMENT ed_fil_pks.fehler_aufrufe_nv "Gesamtzahl der Fehleraufrufe" UBYTE FORMULA_0003 0 0 0.0 255.0000 ECU_ADDRESS 0x3F98E1 /end MEASUREMENT
/begin MEASUREMENT ed_fil_pt_statr.fehler_aufrufe_nv "Gesamtzahl der Fehleraufrufe" UBYTE FORMULA_0003 0 0 0.0 255.0000 ECU_ADDRESS 0x3F98E7 /end MEASUREMENT
/begin MEASUREMENT ed_fil_lavk1.fehler_aufrufe_nv "Gesamtzahl der Fehleraufrufe" UBYTE FORMULA_0003 0 0 0.0 255.0000 ECU_ADDRESS 0x3F98ED /end MEASUREMENT
/begin MEASUREMENT ed_fil_lavk2.fehler_aufrufe_nv "Gesamtzahl der Fehleraufrufe" UBYTE FORMULA_0003 0 0 0.0 255.0000 ECU_ADDRESS 0x3F98F3 /end MEASUREMENT
/begin MEASUREMENT ed_fil_lavk1_obd_plau.fehler_aufrufe_nv "Gesamtzahl der Fehleraufrufe" UBYTE FORMULA_0003 0 0 0.0 255.0000 ECU_ADDRESS 0x3F98F9 /end MEASUREMENT
/begin MEASUREMENT ed_fil_lavk2_obd_plau.fehler_aufrufe_nv "Gesamtzahl der Fehleraufrufe" UBYTE FORMULA_0003 0 0 0.0 255.0000 ECU_ADDRESS 0x3F98FF /end MEASUREMENT
/begin MEASUREMENT ed_fil_lavk1_obd_sa.fehler_aufrufe_nv "Gesamtzahl der Fehleraufrufe" UBYTE FORMULA_0003 0 0 0.0 255.0000 ECU_ADDRESS 0x3F9905 /end MEASUREMENT
/begin MEASUREMENT ed_fil_lavk2_obd_sa.fehler_aufrufe_nv "Gesamtzahl der Fehleraufrufe" UBYTE FORMULA_0003 0 0 0.0 255.0000 ECU_ADDRESS 0x3F990B /end MEASUREMENT
/begin MEASUREMENT ed_fil_lank2.fehler_aufrufe_nv "Gesamtzahl der Fehleraufrufe" UBYTE FORMULA_0003 0 0 0.0 255.0000 ECU_ADDRESS 0x3F9917 /end MEASUREMENT
/begin MEASUREMENT ed_fil_lshnk1.fehler_aufrufe_nv "Gesamtzahl der Fehleraufrufe" UBYTE FORMULA_0003 0 0 0.0 255.0000 ECU_ADDRESS 0x3F991D /end MEASUREMENT
/begin MEASUREMENT ed_fil_lshnk2.fehler_aufrufe_nv "Gesamtzahl der Fehleraufrufe" UBYTE FORMULA_0003 0 0 0.0 255.0000 ECU_ADDRESS 0x3F9923 /end MEASUREMENT
/begin MEASUREMENT ed_fil_pt_busoff.fehler_aufrufe_nv "Gesamtzahl der Fehleraufrufe" UBYTE FORMULA_0003 0 0 0.0 255.0000 ECU_ADDRESS 0x3F9929 /end MEASUREMENT
/begin MEASUREMENT ed_fil_pt_torqdsc.fehler_aufrufe_nv "Gesamtzahl der Fehleraufrufe" UBYTE FORMULA_0003 0 0 0.0 255.0000 ECU_ADDRESS 0x3F992F /end MEASUREMENT
/begin MEASUREMENT ed_fil_pt_stdsc.fehler_aufrufe_nv "Gesamtzahl der Fehleraufrufe" UBYTE FORMULA_0003 0 0 0.0 255.0000 ECU_ADDRESS 0x3F9935 /end MEASUREMENT
/begin MEASUREMENT ed_fil_pt_vrad.fehler_aufrufe_nv "Gesamtzahl der Fehleraufrufe" UBYTE FORMULA_0003 0 0 0.0 255.0000 ECU_ADDRESS 0x3F993B /end MEASUREMENT
/begin MEASUREMENT ed_fil_pt_vfzg.fehler_aufrufe_nv "Gesamtzahl der Fehleraufrufe" UBYTE FORMULA_0003 0 0 0.0 255.0000 ECU_ADDRESS 0x3F9941 /end MEASUREMENT
/begin MEASUREMENT ed_fil_pt_atemp.fehler_aufrufe_nv "Gesamtzahl der Fehleraufrufe" UBYTE FORMULA_0003 0 0 0.0 255.0000 ECU_ADDRESS 0x3F9947 /end MEASUREMENT
/begin MEASUREMENT ed_fil_pt_klst.fehler_aufrufe_nv "Gesamtzahl der Fehleraufrufe" UBYTE FORMULA_0003 0 0 0.0 255.0000 ECU_ADDRESS 0x3F994D /end MEASUREMENT
/begin MEASUREMENT ed_fil_pt_kkos.fehler_aufrufe_nv "Gesamtzahl der Fehleraufrufe" UBYTE FORMULA_0003 0 0 0.0 255.0000 ECU_ADDRESS 0x3F9953 /end MEASUREMENT
/begin MEASUREMENT ed_fil_pt_lrw.fehler_aufrufe_nv "Gesamtzahl der Fehleraufrufe" UBYTE FORMULA_0003 0 0 0.0 255.0000 ECU_ADDRESS 0x3F9959 /end MEASUREMENT
/begin MEASUREMENT ed_fil_sl_ml_hfm.fehler_aufrufe_nv "Gesamtzahl der Fehleraufrufe" UBYTE FORMULA_0003 0 0 0.0 255.0000 ECU_ADDRESS 0x3F996B /end MEASUREMENT
/begin MEASUREMENT ed_fil_lank2_obd_s.fehler_aufrufe_nv "Gesamtzahl der Fehleraufrufe" UBYTE FORMULA_0003 0 0 0.0 255.0000 ECU_ADDRESS 0x3F9977 /end MEASUREMENT
/begin MEASUREMENT ed_fil_lavk1_obd_tl.fehler_aufrufe_nv "Gesamtzahl der Fehleraufrufe" UBYTE FORMULA_0003 0 0 0.0 255.0000 ECU_ADDRESS 0x3F997D /end MEASUREMENT
/begin MEASUREMENT ed_fil_lavk2_obd_tl.fehler_aufrufe_nv "Gesamtzahl der Fehleraufrufe" UBYTE FORMULA_0003 0 0 0.0 255.0000 ECU_ADDRESS 0x3F9983 /end MEASUREMENT
/begin MEASUREMENT ed_fil_lshvk1.fehler_aufrufe_nv "Gesamtzahl der Fehleraufrufe" UBYTE FORMULA_0003 0 0 0.0 255.0000 ECU_ADDRESS 0x3F9989 /end MEASUREMENT
/begin MEASUREMENT ed_fil_lshvk2.fehler_aufrufe_nv "Gesamtzahl der Fehleraufrufe" UBYTE FORMULA_0003 0 0 0.0 255.0000 ECU_ADDRESS 0x3F998F /end MEASUREMENT
/begin MEASUREMENT ed_fil_lsrvk1_obd_reg.fehler_aufrufe_nv "Gesamtzahl der Fehleraufrufe" UBYTE FORMULA_0003 0 0 0.0 255.0000 ECU_ADDRESS 0x3F9995 /end MEASUREMENT
/begin MEASUREMENT ed_fil_lsrvk2_obd_reg.fehler_aufrufe_nv "Gesamtzahl der Fehleraufrufe" UBYTE FORMULA_0003 0 0 0.0 255.0000 ECU_ADDRESS 0x3F999B /end MEASUREMENT
/begin MEASUREMENT ed_fil_lshvk1_r.fehler_aufrufe_nv "Gesamtzahl der Fehleraufrufe" UBYTE FORMULA_0003 0 0 0.0 255.0000 ECU_ADDRESS 0x3F99A1 /end MEASUREMENT
/begin MEASUREMENT ed_fil_lshvk2_r.fehler_aufrufe_nv "Gesamtzahl der Fehleraufrufe" UBYTE FORMULA_0003 0 0 0.0 255.0000 ECU_ADDRESS 0x3F99A7 /end MEASUREMENT
/begin MEASUREMENT ed_fil_lsrvk1_obd_start.fehler_aufrufe_nv "Gesamtzahl der Fehleraufrufe" UBYTE FORMULA_0003 0 0 0.0 255.0000 ECU_ADDRESS 0x3F99AD /end MEASUREMENT
/begin MEASUREMENT ed_fil_lsrvk2_obd_start.fehler_aufrufe_nv "Gesamtzahl der Fehleraufrufe" UBYTE FORMULA_0003 0 0 0.0 255.0000 ECU_ADDRESS 0x3F99B3 /end MEASUREMENT
/begin MEASUREMENT ed_fil_lsrvk1_obd_ref.fehler_aufrufe_nv "Gesamtzahl der Fehleraufrufe" UBYTE FORMULA_0003 0 0 0.0 255.0000 ECU_ADDRESS 0x3F99B9 /end MEASUREMENT
/begin MEASUREMENT ed_fil_lsrvk2_obd_ref.fehler_aufrufe_nv "Gesamtzahl der Fehleraufrufe" UBYTE FORMULA_0003 0 0 0.0 255.0000 ECU_ADDRESS 0x3F99BF /end MEASUREMENT
/begin MEASUREMENT ed_fil_lavk1_diag.fehler_aufrufe_nv "Gesamtzahl der Fehleraufrufe" UBYTE FORMULA_0003 0 0 0.0 255.0000 ECU_ADDRESS 0x3F99C5 /end MEASUREMENT
/begin MEASUREMENT ed_fil_lavk2_diag.fehler_aufrufe_nv "Gesamtzahl der Fehleraufrufe" UBYTE FORMULA_0003 0 0 0.0 255.0000 ECU_ADDRESS 0x3F99CB /end MEASUREMENT
/begin MEASUREMENT ed_fil_lavk1_ia_openload.fehler_aufrufe_nv "Gesamtzahl der Fehleraufrufe" UBYTE FORMULA_0003 0 0 0.0 255.0000 ECU_ADDRESS 0x3F99D1 /end MEASUREMENT
/begin MEASUREMENT ed_fil_lavk2_ia_openload.fehler_aufrufe_nv "Gesamtzahl der Fehleraufrufe" UBYTE FORMULA_0003 0 0 0.0 255.0000 ECU_ADDRESS 0x3F99D7 /end MEASUREMENT
/begin MEASUREMENT ed_fil_pt_grb.fehler_aufrufe_nv "Gesamtzahl der Fehleraufrufe" UBYTE FORMULA_0003 0 0 0.0 255.0000 ECU_ADDRESS 0x3F99DD /end MEASUREMENT
/begin MEASUREMENT ed_fil_pt_grb2.fehler_aufrufe_nv "Gesamtzahl der Fehleraufrufe" UBYTE FORMULA_0003 0 0 0.0 255.0000 ECU_ADDRESS 0x3F99E3 /end MEASUREMENT
/begin MEASUREMENT ed_fil_lavk1_un_openload.fehler_aufrufe_nv "Gesamtzahl der Fehleraufrufe" UBYTE FORMULA_0003 0 0 0.0 255.0000 ECU_ADDRESS 0x3F99E9 /end MEASUREMENT
/begin MEASUREMENT ed_fil_lavk2_un_openload.fehler_aufrufe_nv "Gesamtzahl der Fehleraufrufe" UBYTE FORMULA_0003 0 0 0.0 255.0000 ECU_ADDRESS 0x3F99EF /end MEASUREMENT
/begin MEASUREMENT ed_fil_lavk1_ip_openload.fehler_aufrufe_nv "Gesamtzahl der Fehleraufrufe" UBYTE FORMULA_0003 0 0 0.0 255.0000 ECU_ADDRESS 0x3F99F5 /end MEASUREMENT
/begin MEASUREMENT ed_fil_lavk2_ip_openload.fehler_aufrufe_nv "Gesamtzahl der Fehleraufrufe" UBYTE FORMULA_0003 0 0 0.0 255.0000 ECU_ADDRESS 0x3F99FB /end MEASUREMENT
/begin MEASUREMENT ed_fil_tz1.fehler_aufrufe_nv "Gesamtzahl der Fehleraufrufe" UBYTE FORMULA_0003 0 0 0.0 255.0000 ECU_ADDRESS 0x3F9A07 /end MEASUREMENT
/begin MEASUREMENT ed_fil_tz2.fehler_aufrufe_nv "Gesamtzahl der Fehleraufrufe" UBYTE FORMULA_0003 0 0 0.0 255.0000 ECU_ADDRESS 0x3F9A0D /end MEASUREMENT
/begin MEASUREMENT ed_fil_tz3.fehler_aufrufe_nv "Gesamtzahl der Fehleraufrufe" UBYTE FORMULA_0003 0 0 0.0 255.0000 ECU_ADDRESS 0x3F9A13 /end MEASUREMENT
/begin MEASUREMENT ed_fil_tz4.fehler_aufrufe_nv "Gesamtzahl der Fehleraufrufe" UBYTE FORMULA_0003 0 0 0.0 255.0000 ECU_ADDRESS 0x3F9A19 /end MEASUREMENT
/begin MEASUREMENT ed_fil_tz5.fehler_aufrufe_nv "Gesamtzahl der Fehleraufrufe" UBYTE FORMULA_0003 0 0 0.0 255.0000 ECU_ADDRESS 0x3F9A1F /end MEASUREMENT
/begin MEASUREMENT ed_fil_tz6.fehler_aufrufe_nv "Gesamtzahl der Fehleraufrufe" UBYTE FORMULA_0003 0 0 0.0 255.0000 ECU_ADDRESS 0x3F9A25 /end MEASUREMENT
/begin MEASUREMENT ed_fil_tz7.fehler_aufrufe_nv "Gesamtzahl der Fehleraufrufe" UBYTE FORMULA_0003 0 0 0.0 255.0000 ECU_ADDRESS 0x3F9A2B /end MEASUREMENT
/begin MEASUREMENT ed_fil_tz8.fehler_aufrufe_nv "Gesamtzahl der Fehleraufrufe" UBYTE FORMULA_0003 0 0 0.0 255.0000 ECU_ADDRESS 0x3F9A31 /end MEASUREMENT
/begin MEASUREMENT ed_fil_tz9.fehler_aufrufe_nv "Gesamtzahl der Fehleraufrufe" UBYTE FORMULA_0003 0 0 0.0 255.0000 ECU_ADDRESS 0x3F9A37 /end MEASUREMENT
/begin MEASUREMENT ed_fil_tz10.fehler_aufrufe_nv "Gesamtzahl der Fehleraufrufe" UBYTE FORMULA_0003 0 0 0.0 255.0000 ECU_ADDRESS 0x3F9A3D /end MEASUREMENT
/begin MEASUREMENT ed_fil_van_anschl_e1.fehler_aufrufe_nv "Gesamtzahl der Fehleraufrufe" UBYTE FORMULA_0003 0 0 0.0 255.0000 ECU_ADDRESS 0x3F9A4F /end MEASUREMENT
/begin MEASUREMENT ed_fil_van_anschl_a1.fehler_aufrufe_nv "Gesamtzahl der Fehleraufrufe" UBYTE FORMULA_0003 0 0 0.0 255.0000 ECU_ADDRESS 0x3F9A55 /end MEASUREMENT
/begin MEASUREMENT ed_fil_van_anschl_e2.fehler_aufrufe_nv "Gesamtzahl der Fehleraufrufe" UBYTE FORMULA_0003 0 0 0.0 255.0000 ECU_ADDRESS 0x3F9A5B /end MEASUREMENT
/begin MEASUREMENT ed_fil_van_anschl_a2.fehler_aufrufe_nv "Gesamtzahl der Fehleraufrufe" UBYTE FORMULA_0003 0 0 0.0 255.0000 ECU_ADDRESS 0x3F9A61 /end MEASUREMENT
/begin MEASUREMENT ed_fil_van_vent_e1.fehler_aufrufe_nv "Gesamtzahl der Fehleraufrufe" UBYTE FORMULA_0003 0 0 0.0 255.0000 ECU_ADDRESS 0x3F9A67 /end MEASUREMENT
/begin MEASUREMENT ed_fil_van_vent_a1.fehler_aufrufe_nv "Gesamtzahl der Fehleraufrufe" UBYTE FORMULA_0003 0 0 0.0 255.0000 ECU_ADDRESS 0x3F9A6D /end MEASUREMENT
/begin MEASUREMENT ed_fil_van_vent_e2.fehler_aufrufe_nv "Gesamtzahl der Fehleraufrufe" UBYTE FORMULA_0003 0 0 0.0 255.0000 ECU_ADDRESS 0x3F9A73 /end MEASUREMENT
/begin MEASUREMENT ed_fil_van_vent_a2.fehler_aufrufe_nv "Gesamtzahl der Fehleraufrufe" UBYTE FORMULA_0003 0 0 0.0 255.0000 ECU_ADDRESS 0x3F9A79 /end MEASUREMENT
/begin MEASUREMENT ed_fil_lavk1_obd_dyn.fehler_aufrufe_nv "Gesamtzahl der Fehleraufrufe" UBYTE FORMULA_0003 0 0 0.0 255.0000 ECU_ADDRESS 0x3F9ABB /end MEASUREMENT
/begin MEASUREMENT ed_fil_lavk2_obd_dyn.fehler_aufrufe_nv "Gesamtzahl der Fehleraufrufe" UBYTE FORMULA_0003 0 0 0.0 255.0000 ECU_ADDRESS 0x3F9AC1 /end MEASUREMENT
/begin MEASUREMENT ed_fil_pt_crash.fehler_aufrufe_nv "Gesamtzahl der Fehleraufrufe" UBYTE FORMULA_0003 0 0 0.0 255.0000 ECU_ADDRESS 0x3F9AC7 /end MEASUREMENT
/begin MEASUREMENT ed_fil_pt_vehmod.fehler_aufrufe_nv "Gesamtzahl der Fehleraufrufe" UBYTE FORMULA_0003 0 0 0.0 255.0000 ECU_ADDRESS 0x3F9ACD /end MEASUREMENT
/begin MEASUREMENT ed_fil_pt_bedfgr.fehler_aufrufe_nv "Gesamtzahl der Fehleraufrufe" UBYTE FORMULA_0003 0 0 0.0 255.0000 ECU_ADDRESS 0x3F9AD3 /end MEASUREMENT
/begin MEASUREMENT ed_fil_lavk1_trim.fehler_aufrufe_nv "Gesamtzahl der Fehleraufrufe" UBYTE FORMULA_0003 0 0 0.0 255.0000 ECU_ADDRESS 0x3F9AFD /end MEASUREMENT
/begin MEASUREMENT ed_fil_lavk2_trim.fehler_aufrufe_nv "Gesamtzahl der Fehleraufrufe" UBYTE FORMULA_0003 0 0 0.0 255.0000 ECU_ADDRESS 0x3F9B03 /end MEASUREMENT
/begin MEASUREMENT ed_fil_rlu87.fehler_aufrufe_nv "Gesamtzahl der Fehleraufrufe" UBYTE FORMULA_0003 0 0 0.0 255.0000 ECU_ADDRESS 0x3F9B09 /end MEASUREMENT
/begin MEASUREMENT ed_fil_ssp.fehler_aufrufe_nv "Gesamtzahl der Fehleraufrufe" UBYTE FORMULA_0003 0 0 0.0 255.0000 ECU_ADDRESS 0x3F9B15 /end MEASUREMENT
/begin MEASUREMENT ed_fil_td.fehler_aufrufe_nv "Gesamtzahl der Fehleraufrufe" UBYTE FORMULA_0003 0 0 0.0 255.0000 ECU_ADDRESS 0x3F9B1B /end MEASUREMENT
/begin MEASUREMENT ed_fil_rlslp.fehler_aufrufe_nv "Gesamtzahl der Fehleraufrufe" UBYTE FORMULA_0003 0 0 0.0 255.0000 ECU_ADDRESS 0x3F9B21 /end MEASUREMENT
/begin MEASUREMENT ed_fil_slv.fehler_aufrufe_nv "Gesamtzahl der Fehleraufrufe" UBYTE FORMULA_0003 0 0 0.0 255.0000 ECU_ADDRESS 0x3F9B27 /end MEASUREMENT
/begin MEASUREMENT ed_fil_pt_km.fehler_aufrufe_nv "Gesamtzahl der Fehleraufrufe" UBYTE FORMULA_0003 0 0 0.0 255.0000 ECU_ADDRESS 0x3F9B2D /end MEASUREMENT
/begin MEASUREMENT ed_fil_pt_kombi.fehler_aufrufe_nv "Gesamtzahl der Fehleraufrufe" UBYTE FORMULA_0003 0 0 0.0 255.0000 ECU_ADDRESS 0x3F9B33 /end MEASUREMENT
/begin MEASUREMENT ed_fil_pks_ll.fehler_aufrufe_nv "Gesamtzahl der Fehleraufrufe" UBYTE FORMULA_0003 0 0 0.0 255.0000 ECU_ADDRESS 0x3F9B39 /end MEASUREMENT
/begin MEASUREMENT ed_fil_pks_tl.fehler_aufrufe_nv "Gesamtzahl der Fehleraufrufe" UBYTE FORMULA_0003 0 0 0.0 255.0000 ECU_ADDRESS 0x3F9B3F /end MEASUREMENT
/begin MEASUREMENT ed_fil_pks_q.fehler_aufrufe_nv "Gesamtzahl der Fehleraufrufe" UBYTE FORMULA_0003 0 0 0.0 255.0000 ECU_ADDRESS 0x3F9B45 /end MEASUREMENT
/begin MEASUREMENT ed_fil_van_dsv.fehler_aufrufe_nv "Gesamtzahl der Fehleraufrufe" UBYTE FORMULA_0003 0 0 0.0 255.0000 ECU_ADDRESS 0x3F9B57 /end MEASUREMENT
/begin MEASUREMENT ed_fil_mvac_drucksensor.fehler_aufrufe_nv "Gesamtzahl der Fehleraufrufe" UBYTE FORMULA_0003 0 0 0.0 255.0000 ECU_ADDRESS 0x3F9B8D /end MEASUREMENT
/begin MEASUREMENT ed_fil_pt_bedat.fehler_aufrufe_nv "Gesamtzahl der Fehleraufrufe" UBYTE FORMULA_0003 0 0 0.0 255.0000 ECU_ADDRESS 0x3F9B93 /end MEASUREMENT
/begin MEASUREMENT ed_fil_sk_manager_inj.fehler_aufrufe_nv "Gesamtzahl der Fehleraufrufe" UBYTE FORMULA_0003 0 0 0.0 255.0000 ECU_ADDRESS 0x3F9B99 /end MEASUREMENT
/begin MEASUREMENT ed_fil_ssp_diag.fehler_aufrufe_nv "Gesamtzahl der Fehleraufrufe" UBYTE FORMULA_0003 0 0 0.0 255.0000 ECU_ADDRESS 0x3F9B9F /end MEASUREMENT
/begin MEASUREMENT ed_fil_sg_inj.fehler_aufrufe_nv "Gesamtzahl der Fehleraufrufe" UBYTE FORMULA_0003 0 0 0.0 255.0000 ECU_ADDRESS 0x3F9BD5 /end MEASUREMENT
/begin MEASUREMENT ed_fil_s_poel_diag.fehler_aufrufe_nv "Gesamtzahl der Fehleraufrufe" UBYTE FORMULA_0003 0 0 0.0 255.0000 ECU_ADDRESS 0x3F9BE7 /end MEASUREMENT
/begin MEASUREMENT ed_fil_te_obd_1.fehler_aufrufe_nv "Gesamtzahl der Fehleraufrufe" UBYTE FORMULA_0003 0 0 0.0 255.0000 ECU_ADDRESS 0x3F9BED /end MEASUREMENT
/begin MEASUREMENT ed_fil_te_obd_2.fehler_aufrufe_nv "Gesamtzahl der Fehleraufrufe" UBYTE FORMULA_0003 0 0 0.0 255.0000 ECU_ADDRESS 0x3F9BF3 /end MEASUREMENT
/begin MEASUREMENT ed_fil_tev1.fehler_aufrufe_nv "Gesamtzahl der Fehleraufrufe" UBYTE FORMULA_0003 0 0 0.0 255.0000 ECU_ADDRESS 0x3F9BF9 /end MEASUREMENT
/begin MEASUREMENT ed_fil_tev2.fehler_aufrufe_nv "Gesamtzahl der Fehleraufrufe" UBYTE FORMULA_0003 0 0 0.0 255.0000 ECU_ADDRESS 0x3F9BFF /end MEASUREMENT
/begin MEASUREMENT ed_fil_slp.fehler_aufrufe_nv "Gesamtzahl der Fehleraufrufe" UBYTE FORMULA_0003 0 0 0.0 255.0000 ECU_ADDRESS 0x3F9C2F /end MEASUREMENT
/begin MEASUREMENT ed_fil_sl_durchs_b1.fehler_aufrufe_nv "Gesamtzahl der Fehleraufrufe" UBYTE FORMULA_0003 0 0 0.0 255.0000 ECU_ADDRESS 0x3F9C35 /end MEASUREMENT
/begin MEASUREMENT ed_fil_sl_durchs_b2.fehler_aufrufe_nv "Gesamtzahl der Fehleraufrufe" UBYTE FORMULA_0003 0 0 0.0 255.0000 ECU_ADDRESS 0x3F9C3B /end MEASUREMENT
/begin MEASUREMENT ed_fil_sl_durchs_hstrang.fehler_aufrufe_nv "Gesamtzahl der Fehleraufrufe" UBYTE FORMULA_0003 0 0 0.0 255.0000 ECU_ADDRESS 0x3F9C41 /end MEASUREMENT
/begin MEASUREMENT ed_fil_s_getr_hs.fehler_aufrufe_nv "Gesamtzahl der Fehleraufrufe" UBYTE FORMULA_0003 0 0 0.0 255.0000 ECU_ADDRESS 0x3F9C4D /end MEASUREMENT
/begin MEASUREMENT ed_fil_s_kupp_hs.fehler_aufrufe_nv "Gesamtzahl der Fehleraufrufe" UBYTE FORMULA_0003 0 0 0.0 255.0000 ECU_ADDRESS 0x3F9C53 /end MEASUREMENT
/begin MEASUREMENT ed_fil_van_druck.fehler_aufrufe_nv "Gesamtzahl der Fehleraufrufe" UBYTE FORMULA_0003 0 0 0.0 255.0000 ECU_ADDRESS 0x3F9C59 /end MEASUREMENT
/begin MEASUREMENT ed_fil_pt_statanh.fehler_aufrufe_nv "Gesamtzahl der Fehleraufrufe" UBYTE FORMULA_0003 0 0 0.0 255.0000 ECU_ADDRESS 0x3F9C6B /end MEASUREMENT
/begin MEASUREMENT ed_fil_pt_statgrb.fehler_aufrufe_nv "Gesamtzahl der Fehleraufrufe" UBYTE FORMULA_0003 0 0 0.0 255.0000 ECU_ADDRESS 0x3F9C89 /end MEASUREMENT
/begin MEASUREMENT ed_fil_pt_anfradmom.fehler_aufrufe_nv "Gesamtzahl der Fehleraufrufe" UBYTE FORMULA_0003 0 0 0.0 255.0000 ECU_ADDRESS 0x3F9C8F /end MEASUREMENT
/begin MEASUREMENT ed_fil_tank_leer.fehler_aufrufe_nv "Gesamtzahl der Fehleraufrufe" UBYTE FORMULA_0003 0 0 0.0 255.0000 ECU_ADDRESS 0x3F9C9B /end MEASUREMENT
/begin MEASUREMENT ed_fil_pt_toma.fehler_aufrufe_nv "Gesamtzahl der Fehleraufrufe" UBYTE FORMULA_0003 0 0 0.0 255.0000 ECU_ADDRESS 0x3F9CA1 /end MEASUREMENT
/begin MEASUREMENT ed_fil_pumg_obd.fehler_aufrufe_nv "Gesamtzahl der Fehleraufrufe" UBYTE FORMULA_0003 0 0 0.0 255.0000 ECU_ADDRESS 0x3F9CAD /end MEASUREMENT
/begin MEASUREMENT ed_fil_sl_ml_hfm_obd.fehler_aufrufe_nv "Gesamtzahl der Fehleraufrufe" UBYTE FORMULA_0003 0 0 0.0 255.0000 ECU_ADDRESS 0x3F9CB3 /end MEASUREMENT
/begin MEASUREMENT ed_fil_lank1_openload.fehler_aufrufe_nv "Gesamtzahl der Fehleraufrufe" UBYTE FORMULA_0003 0 0 0.0 255.0000 ECU_ADDRESS 0x3F9CC5 /end MEASUREMENT
/begin MEASUREMENT ed_fil_lank2_openload.fehler_aufrufe_nv "Gesamtzahl der Fehleraufrufe" UBYTE FORMULA_0003 0 0 0.0 255.0000 ECU_ADDRESS 0x3F9CCB /end MEASUREMENT
/begin MEASUREMENT ed_fil_lank1_obd_we.fehler_aufrufe_nv "Gesamtzahl der Fehleraufrufe" UBYTE FORMULA_0003 0 0 0.0 255.0000 ECU_ADDRESS 0x3F9CD1 /end MEASUREMENT
/begin MEASUREMENT ed_fil_lank2_obd_we.fehler_aufrufe_nv "Gesamtzahl der Fehleraufrufe" UBYTE FORMULA_0003 0 0 0.0 255.0000 ECU_ADDRESS 0x3F9CD7 /end MEASUREMENT
/begin MEASUREMENT ed_fil_lshnk1_r.fehler_aufrufe_nv "Gesamtzahl der Fehleraufrufe" UBYTE FORMULA_0003 0 0 0.0 255.0000 ECU_ADDRESS 0x3F9CDD /end MEASUREMENT
/begin MEASUREMENT ed_fil_lshnk2_r.fehler_aufrufe_nv "Gesamtzahl der Fehleraufrufe" UBYTE FORMULA_0003 0 0 0.0 255.0000 ECU_ADDRESS 0x3F9CE3 /end MEASUREMENT
/begin MEASUREMENT ed_fil_pks_modell.fehler_aufrufe_nv "Gesamtzahl der Fehleraufrufe" UBYTE FORMULA_0003 0 0 0.0 255.0000 ECU_ADDRESS 0x3F9CE9 /end MEASUREMENT
/begin MEASUREMENT ed_fil_pks_paufbau.fehler_aufrufe_nv "Gesamtzahl der Fehleraufrufe" UBYTE FORMULA_0003 0 0 0.0 255.0000 ECU_ADDRESS 0x3F9CEF /end MEASUREMENT
/begin MEASUREMENT ed_fil_pks_adapt_anschl.fehler_aufrufe_nv "Gesamtzahl der Fehleraufrufe" UBYTE FORMULA_0003 0 0 0.0 255.0000 ECU_ADDRESS 0x3F9CF5 /end MEASUREMENT
/begin MEASUREMENT ed_fil_tgetr_hs.fehler_aufrufe_nv "Gesamtzahl der Fehleraufrufe" UBYTE FORMULA_0003 0 0 0.0 255.0000 ECU_ADDRESS 0x3F9CFB /end MEASUREMENT
/begin MEASUREMENT ed_fil_lavk_atic42.fehler_aufrufe_nv "Gesamtzahl der Fehleraufrufe" UBYTE FORMULA_0003 0 0 0.0 255.0000 ECU_ADDRESS 0x3F9D01 /end MEASUREMENT
/begin MEASUREMENT ed_fil_pt_ax.fehler_aufrufe_nv "Gesamtzahl der Fehleraufrufe" UBYTE FORMULA_0003 0 0 0.0 255.0000 ECU_ADDRESS 0x3F9D07 /end MEASUREMENT
/begin MEASUREMENT ed_fil_pt_obd_ed.fehler_aufrufe_nv "Gesamtzahl der Fehleraufrufe" UBYTE FORMULA_0003 0 0 0.0 255.0000 ECU_ADDRESS 0x3F9D0D /end MEASUREMENT
/begin MEASUREMENT ed_fil_lank2_obd_slope.fehler_aufrufe_nv "Gesamtzahl der Fehleraufrufe" UBYTE FORMULA_0003 0 0 0.0 255.0000 ECU_ADDRESS 0x3F9D25 /end MEASUREMENT
/begin MEASUREMENT ed_fil_mvac_obd.fehler_aufrufe_nv "Gesamtzahl der Fehleraufrufe" UBYTE FORMULA_0003 0 0 0.0 255.0000 ECU_ADDRESS 0x3F9D2B /end MEASUREMENT
/begin MEASUREMENT ed_fil_lavk2_atic42.fehler_aufrufe_nv "Gesamtzahl der Fehleraufrufe" UBYTE FORMULA_0003 0 0 0.0 255.0000 ECU_ADDRESS 0x3F9D37 /end MEASUREMENT
/begin MEASUREMENT ed_fsp_10of20_.fehlercode_nv "Externer Fehlerort" UWORD FORMULA_0050 0 0 0.0 65535.0 ECU_ADDRESS 0x3FA412 /end MEASUREMENT
/begin MEASUREMENT ed_fsp_11of20_.fehlercode_nv "Externer Fehlerort" UWORD FORMULA_0050 0 0 0.0 65535.0 ECU_ADDRESS 0x3FA464 /end MEASUREMENT
/begin MEASUREMENT ed_fsp_12of20_.fehlercode_nv "Externer Fehlerort" UWORD FORMULA_0050 0 0 0.0 65535.0 ECU_ADDRESS 0x3FA4B6 /end MEASUREMENT
/begin MEASUREMENT ed_fsp_13of20_.fehlercode_nv "Externer Fehlerort" UWORD FORMULA_0050 0 0 0.0 65535.0 ECU_ADDRESS 0x3FA508 /end MEASUREMENT
/begin MEASUREMENT ed_fsp_14of20_.fehlercode_nv "Externer Fehlerort" UWORD FORMULA_0050 0 0 0.0 65535.0 ECU_ADDRESS 0x3FA55A /end MEASUREMENT
/begin MEASUREMENT ed_fsp_10of20_.fehlerart_nv "Fehlerart und Statusbits" UWORD FORMULA_0010 0 0 0.0 65535.0000 ECU_ADDRESS 0x3FA414 /end MEASUREMENT
/begin MEASUREMENT ed_fsp_11of20_.fehlerart_nv "Fehlerart und Statusbits" UWORD FORMULA_0010 0 0 0.0 65535.0000 ECU_ADDRESS 0x3FA466 /end MEASUREMENT
/begin MEASUREMENT ed_fsp_12of20_.fehlerart_nv "Fehlerart und Statusbits" UWORD FORMULA_0010 0 0 0.0 65535.0000 ECU_ADDRESS 0x3FA4B8 /end MEASUREMENT
/begin MEASUREMENT ed_fsp_13of20_.fehlerart_nv "Fehlerart und Statusbits" UWORD FORMULA_0010 0 0 0.0 65535.0000 ECU_ADDRESS 0x3FA50A /end MEASUREMENT
/begin MEASUREMENT ed_fsp_14of20_.fehlerart_nv "Fehlerart und Statusbits" UWORD FORMULA_0010 0 0 0.0 65535.0000 ECU_ADDRESS 0x3FA55C /end MEASUREMENT
/begin MEASUREMENT ed_fsp_10of20_.haeufigkeitszaehler_nv "Uebergangszaehler von i.O. -> n.i.O" UBYTE FORMULA_0003 0 0 0.0 255.0000 ECU_ADDRESS 0x3FA416 /end MEASUREMENT
/begin MEASUREMENT ed_fsp_11of20_.haeufigkeitszaehler_nv "Uebergangszaehler von i.O. -> n.i.O" UBYTE FORMULA_0003 0 0 0.0 255.0000 ECU_ADDRESS 0x3FA468 /end MEASUREMENT
/begin MEASUREMENT ed_fsp_12of20_.haeufigkeitszaehler_nv "Uebergangszaehler von i.O. -> n.i.O" UBYTE FORMULA_0003 0 0 0.0 255.0000 ECU_ADDRESS 0x3FA4BA /end MEASUREMENT
/begin MEASUREMENT ed_fsp_13of20_.haeufigkeitszaehler_nv "Uebergangszaehler von i.O. -> n.i.O" UBYTE FORMULA_0003 0 0 0.0 255.0000 ECU_ADDRESS 0x3FA50C /end MEASUREMENT
/begin MEASUREMENT ed_fsp_10of20_.logistikzaehler_nv "Warm-Up-Cycling-Zaehler" UBYTE FORMULA_0003 0 0 0.0 255.0000 ECU_ADDRESS 0x3FA417 /end MEASUREMENT
/begin MEASUREMENT ed_fsp_11of20_.logistikzaehler_nv "Warm-Up-Cycling-Zaehler" UBYTE FORMULA_0003 0 0 0.0 255.0000 ECU_ADDRESS 0x3FA469 /end MEASUREMENT
/begin MEASUREMENT ed_fsp_12of20_.logistikzaehler_nv "Warm-Up-Cycling-Zaehler" UBYTE FORMULA_0003 0 0 0.0 255.0000 ECU_ADDRESS 0x3FA4BB /end MEASUREMENT
/begin MEASUREMENT ed_fsp_13of20_.logistikzaehler_nv "Warm-Up-Cycling-Zaehler" UBYTE FORMULA_0003 0 0 0.0 255.0000 ECU_ADDRESS 0x3FA50D /end MEASUREMENT
/begin MEASUREMENT ed_fsp_10of20_.uw_satz_1of3_.uw_km_stand_nv "Kilometerstand beim Fehlereintrag" UWORD FORMULA_0051 0 0 0.0 524280.0000 ECU_ADDRESS 0x3FA418 /end MEASUREMENT
/begin MEASUREMENT ed_fsp_10of20_.uw_satz_2of3_.uw_km_stand_nv "Kilometerstand beim Fehlereintrag" UWORD FORMULA_0051 0 0 0.0 524280.0000 ECU_ADDRESS 0x3FA422 /end MEASUREMENT
/begin MEASUREMENT ed_fsp_10of20_.uw_satz_3of3_.uw_km_stand_nv "Kilometerstand beim Fehlereintrag" UWORD FORMULA_0051 0 0 0.0 524280.0000 ECU_ADDRESS 0x3FA42C /end MEASUREMENT
/begin MEASUREMENT ed_fsp_11of20_.uw_satz_1of3_.uw_km_stand_nv "Kilometerstand beim Fehlereintrag" UWORD FORMULA_0051 0 0 0.0 524280.0000 ECU_ADDRESS 0x3FA46A /end MEASUREMENT
/begin MEASUREMENT ed_fsp_11of20_.uw_satz_2of3_.uw_km_stand_nv "Kilometerstand beim Fehlereintrag" UWORD FORMULA_0051 0 0 0.0 524280.0000 ECU_ADDRESS 0x3FA474 /end MEASUREMENT
/begin MEASUREMENT ed_fsp_11of20_.uw_satz_3of3_.uw_km_stand_nv "Kilometerstand beim Fehlereintrag" UWORD FORMULA_0051 0 0 0.0 524280.0000 ECU_ADDRESS 0x3FA47E /end MEASUREMENT
/begin MEASUREMENT ed_fsp_12of20_.uw_satz_1of3_.uw_km_stand_nv "Kilometerstand beim Fehlereintrag" UWORD FORMULA_0051 0 0 0.0 524280.0000 ECU_ADDRESS 0x3FA4BC /end MEASUREMENT
/begin MEASUREMENT ed_fsp_12of20_.uw_satz_2of3_.uw_km_stand_nv "Kilometerstand beim Fehlereintrag" UWORD FORMULA_0051 0 0 0.0 524280.0000 ECU_ADDRESS 0x3FA4C6 /end MEASUREMENT
/begin MEASUREMENT ed_fsp_12of20_.uw_satz_3of3_.uw_km_stand_nv "Kilometerstand beim Fehlereintrag" UWORD FORMULA_0051 0 0 0.0 524280.0000 ECU_ADDRESS 0x3FA4D0 /end MEASUREMENT
/begin MEASUREMENT ed_fsp_13of20_.uw_satz_1of3_.uw_km_stand_nv "Kilometerstand beim Fehlereintrag" UWORD FORMULA_0051 0 0 0.0 524280.0000 ECU_ADDRESS 0x3FA50E /end MEASUREMENT
/begin MEASUREMENT ed_fsp_13of20_.uw_satz_2of3_.uw_km_stand_nv "Kilometerstand beim Fehlereintrag" UWORD FORMULA_0051 0 0 0.0 524280.0000 ECU_ADDRESS 0x3FA518 /end MEASUREMENT
/begin MEASUREMENT ed_fsp_13of20_.uw_satz_3of3_.uw_km_stand_nv "Kilometerstand beim Fehlereintrag" UWORD FORMULA_0051 0 0 0.0 524280.0000 ECU_ADDRESS 0x3FA522 /end MEASUREMENT
/begin MEASUREMENT ed_fsp_10of20_.uw_satz_1of3_.uw_wert_nv_1of4_ "Umweltbedingung beim Fehlereintrag" UWORD FORMULA_0010 0 0 0.0 65535.0000 ECU_ADDRESS 0x3FA41A /end MEASUREMENT
/begin MEASUREMENT ed_fsp_10of20_.uw_satz_1of3_.uw_wert_nv_2of4_ "Umweltbedingung beim Fehlereintrag" UWORD FORMULA_0010 0 0 0.0 65535.0000 ECU_ADDRESS 0x3FA41C /end MEASUREMENT
/begin MEASUREMENT ed_fsp_10of20_.uw_satz_1of3_.uw_wert_nv_3of4_ "Umweltbedingung beim Fehlereintrag" UWORD FORMULA_0010 0 0 0.0 65535.0000 ECU_ADDRESS 0x3FA41E /end MEASUREMENT
/begin MEASUREMENT ed_fsp_10of20_.uw_satz_1of3_.uw_wert_nv_4of4_ "Umweltbedingung beim Fehlereintrag" UWORD FORMULA_0010 0 0 0.0 65535.0000 ECU_ADDRESS 0x3FA420 /end MEASUREMENT
/begin MEASUREMENT ed_fsp_10of20_.uw_satz_2of3_.uw_wert_nv_1of4_ "Umweltbedingung beim Fehlereintrag" UWORD FORMULA_0010 0 0 0.0 65535.0000 ECU_ADDRESS 0x3FA424 /end MEASUREMENT
/begin MEASUREMENT ed_fsp_10of20_.uw_satz_2of3_.uw_wert_nv_2of4_ "Umweltbedingung beim Fehlereintrag" UWORD FORMULA_0010 0 0 0.0 65535.0000 ECU_ADDRESS 0x3FA426 /end MEASUREMENT
/begin MEASUREMENT ed_fsp_10of20_.uw_satz_2of3_.uw_wert_nv_3of4_ "Umweltbedingung beim Fehlereintrag" UWORD FORMULA_0010 0 0 0.0 65535.0000 ECU_ADDRESS 0x3FA428 /end MEASUREMENT
/begin MEASUREMENT ed_fsp_10of20_.uw_satz_2of3_.uw_wert_nv_4of4_ "Umweltbedingung beim Fehlereintrag" UWORD FORMULA_0010 0 0 0.0 65535.0000 ECU_ADDRESS 0x3FA42A /end MEASUREMENT
/begin MEASUREMENT ed_fsp_10of20_.uw_satz_3of3_.uw_wert_nv_1of4_ "Umweltbedingung beim Fehlereintrag" UWORD FORMULA_0010 0 0 0.0 65535.0000 ECU_ADDRESS 0x3FA42E /end MEASUREMENT
/begin MEASUREMENT ed_fsp_10of20_.uw_satz_3of3_.uw_wert_nv_2of4_ "Umweltbedingung beim Fehlereintrag" UWORD FORMULA_0010 0 0 0.0 65535.0000 ECU_ADDRESS 0x3FA430 /end MEASUREMENT
/begin MEASUREMENT ed_fsp_10of20_.uw_satz_3of3_.uw_wert_nv_3of4_ "Umweltbedingung beim Fehlereintrag" UWORD FORMULA_0010 0 0 0.0 65535.0000 ECU_ADDRESS 0x3FA432 /end MEASUREMENT
/begin MEASUREMENT ed_fsp_10of20_.uw_satz_3of3_.uw_wert_nv_4of4_ "Umweltbedingung beim Fehlereintrag" UWORD FORMULA_0010 0 0 0.0 65535.0000 ECU_ADDRESS 0x3FA434 /end MEASUREMENT
/begin MEASUREMENT ed_fsp_11of20_.uw_satz_1of3_.uw_wert_nv_1of4_ "Umweltbedingung beim Fehlereintrag" UWORD FORMULA_0010 0 0 0.0 65535.0000 ECU_ADDRESS 0x3FA46C /end MEASUREMENT
/begin MEASUREMENT ed_fsp_11of20_.uw_satz_1of3_.uw_wert_nv_2of4_ "Umweltbedingung beim Fehlereintrag" UWORD FORMULA_0010 0 0 0.0 65535.0000 ECU_ADDRESS 0x3FA46E /end MEASUREMENT
/begin MEASUREMENT ed_fsp_11of20_.uw_satz_1of3_.uw_wert_nv_3of4_ "Umweltbedingung beim Fehlereintrag" UWORD FORMULA_0010 0 0 0.0 65535.0000 ECU_ADDRESS 0x3FA470 /end MEASUREMENT
/begin MEASUREMENT ed_fsp_11of20_.uw_satz_1of3_.uw_wert_nv_4of4_ "Umweltbedingung beim Fehlereintrag" UWORD FORMULA_0010 0 0 0.0 65535.0000 ECU_ADDRESS 0x3FA472 /end MEASUREMENT
/begin MEASUREMENT ed_fsp_11of20_.uw_satz_2of3_.uw_wert_nv_1of4_ "Umweltbedingung beim Fehlereintrag" UWORD FORMULA_0010 0 0 0.0 65535.0000 ECU_ADDRESS 0x3FA476 /end MEASUREMENT
/begin MEASUREMENT ed_fsp_11of20_.uw_satz_2of3_.uw_wert_nv_2of4_ "Umweltbedingung beim Fehlereintrag" UWORD FORMULA_0010 0 0 0.0 65535.0000 ECU_ADDRESS 0x3FA478 /end MEASUREMENT
/begin MEASUREMENT ed_fsp_11of20_.uw_satz_2of3_.uw_wert_nv_3of4_ "Umweltbedingung beim Fehlereintrag" UWORD FORMULA_0010 0 0 0.0 65535.0000 ECU_ADDRESS 0x3FA47A /end MEASUREMENT
/begin MEASUREMENT ed_fsp_11of20_.uw_satz_2of3_.uw_wert_nv_4of4_ "Umweltbedingung beim Fehlereintrag" UWORD FORMULA_0010 0 0 0.0 65535.0000 ECU_ADDRESS 0x3FA47C /end MEASUREMENT
/begin MEASUREMENT ed_fsp_11of20_.uw_satz_3of3_.uw_wert_nv_1of4_ "Umweltbedingung beim Fehlereintrag" UWORD FORMULA_0010 0 0 0.0 65535.0000 ECU_ADDRESS 0x3FA480 /end MEASUREMENT
/begin MEASUREMENT ed_fsp_11of20_.uw_satz_3of3_.uw_wert_nv_2of4_ "Umweltbedingung beim Fehlereintrag" UWORD FORMULA_0010 0 0 0.0 65535.0000 ECU_ADDRESS 0x3FA482 /end MEASUREMENT
/begin MEASUREMENT ed_fsp_11of20_.uw_satz_3of3_.uw_wert_nv_3of4_ "Umweltbedingung beim Fehlereintrag" UWORD FORMULA_0010 0 0 0.0 65535.0000 ECU_ADDRESS 0x3FA484 /end MEASUREMENT
/begin MEASUREMENT ed_fsp_11of20_.uw_satz_3of3_.uw_wert_nv_4of4_ "Umweltbedingung beim Fehlereintrag" UWORD FORMULA_0010 0 0 0.0 65535.0000 ECU_ADDRESS 0x3FA486 /end MEASUREMENT
/begin MEASUREMENT ed_fsp_12of20_.uw_satz_1of3_.uw_wert_nv_1of4_ "Umweltbedingung beim Fehlereintrag" UWORD FORMULA_0010 0 0 0.0 65535.0000 ECU_ADDRESS 0x3FA4BE /end MEASUREMENT
/begin MEASUREMENT ed_fsp_12of20_.uw_satz_1of3_.uw_wert_nv_2of4_ "Umweltbedingung beim Fehlereintrag" UWORD FORMULA_0010 0 0 0.0 65535.0000 ECU_ADDRESS 0x3FA4C0 /end MEASUREMENT
/begin MEASUREMENT ed_fsp_12of20_.uw_satz_1of3_.uw_wert_nv_3of4_ "Umweltbedingung beim Fehlereintrag" UWORD FORMULA_0010 0 0 0.0 65535.0000 ECU_ADDRESS 0x3FA4C2 /end MEASUREMENT
/begin MEASUREMENT ed_fsp_12of20_.uw_satz_1of3_.uw_wert_nv_4of4_ "Umweltbedingung beim Fehlereintrag" UWORD FORMULA_0010 0 0 0.0 65535.0000 ECU_ADDRESS 0x3FA4C4 /end MEASUREMENT
/begin MEASUREMENT ed_fsp_12of20_.uw_satz_2of3_.uw_wert_nv_1of4_ "Umweltbedingung beim Fehlereintrag" UWORD FORMULA_0010 0 0 0.0 65535.0000 ECU_ADDRESS 0x3FA4C8 /end MEASUREMENT
/begin MEASUREMENT ed_fsp_12of20_.uw_satz_2of3_.uw_wert_nv_2of4_ "Umweltbedingung beim Fehlereintrag" UWORD FORMULA_0010 0 0 0.0 65535.0000 ECU_ADDRESS 0x3FA4CA /end MEASUREMENT
/begin MEASUREMENT ed_fsp_12of20_.uw_satz_2of3_.uw_wert_nv_3of4_ "Umweltbedingung beim Fehlereintrag" UWORD FORMULA_0010 0 0 0.0 65535.0000 ECU_ADDRESS 0x3FA4CC /end MEASUREMENT
/begin MEASUREMENT ed_fsp_12of20_.uw_satz_2of3_.uw_wert_nv_4of4_ "Umweltbedingung beim Fehlereintrag" UWORD FORMULA_0010 0 0 0.0 65535.0000 ECU_ADDRESS 0x3FA4CE /end MEASUREMENT
/begin MEASUREMENT ed_fsp_12of20_.uw_satz_3of3_.uw_wert_nv_1of4_ "Umweltbedingung beim Fehlereintrag" UWORD FORMULA_0010 0 0 0.0 65535.0000 ECU_ADDRESS 0x3FA4D2 /end MEASUREMENT
/begin MEASUREMENT ed_fsp_12of20_.uw_satz_3of3_.uw_wert_nv_2of4_ "Umweltbedingung beim Fehlereintrag" UWORD FORMULA_0010 0 0 0.0 65535.0000 ECU_ADDRESS 0x3FA4D4 /end MEASUREMENT
/begin MEASUREMENT ed_fsp_12of20_.uw_satz_3of3_.uw_wert_nv_3of4_ "Umweltbedingung beim Fehlereintrag" UWORD FORMULA_0010 0 0 0.0 65535.0000 ECU_ADDRESS 0x3FA4D6 /end MEASUREMENT
/begin MEASUREMENT ed_fsp_12of20_.uw_satz_3of3_.uw_wert_nv_4of4_ "Umweltbedingung beim Fehlereintrag" UWORD FORMULA_0010 0 0 0.0 65535.0000 ECU_ADDRESS 0x3FA4D8 /end MEASUREMENT
/begin MEASUREMENT ed_fsp_13of20_.uw_satz_1of3_.uw_wert_nv_1of4_ "Umweltbedingung beim Fehlereintrag" UWORD FORMULA_0010 0 0 0.0 65535.0000 ECU_ADDRESS 0x3FA510 /end MEASUREMENT
/begin MEASUREMENT ed_fsp_13of20_.uw_satz_1of3_.uw_wert_nv_2of4_ "Umweltbedingung beim Fehlereintrag" UWORD FORMULA_0010 0 0 0.0 65535.0000 ECU_ADDRESS 0x3FA512 /end MEASUREMENT
/begin MEASUREMENT ed_fsp_13of20_.uw_satz_1of3_.uw_wert_nv_3of4_ "Umweltbedingung beim Fehlereintrag" UWORD FORMULA_0010 0 0 0.0 65535.0000 ECU_ADDRESS 0x3FA514 /end MEASUREMENT
/begin MEASUREMENT ed_fsp_13of20_.uw_satz_1of3_.uw_wert_nv_4of4_ "Umweltbedingung beim Fehlereintrag" UWORD FORMULA_0010 0 0 0.0 65535.0000 ECU_ADDRESS 0x3FA516 /end MEASUREMENT
/begin MEASUREMENT ed_fsp_13of20_.uw_satz_2of3_.uw_wert_nv_1of4_ "Umweltbedingung beim Fehlereintrag" UWORD FORMULA_0010 0 0 0.0 65535.0000 ECU_ADDRESS 0x3FA51A /end MEASUREMENT
/begin MEASUREMENT ed_fsp_13of20_.uw_satz_2of3_.uw_wert_nv_2of4_ "Umweltbedingung beim Fehlereintrag" UWORD FORMULA_0010 0 0 0.0 65535.0000 ECU_ADDRESS 0x3FA51C /end MEASUREMENT
/begin MEASUREMENT ed_fsp_13of20_.uw_satz_2of3_.uw_wert_nv_3of4_ "Umweltbedingung beim Fehlereintrag" UWORD FORMULA_0010 0 0 0.0 65535.0000 ECU_ADDRESS 0x3FA51E /end MEASUREMENT
/begin MEASUREMENT ed_fsp_13of20_.uw_satz_2of3_.uw_wert_nv_4of4_ "Umweltbedingung beim Fehlereintrag" UWORD FORMULA_0010 0 0 0.0 65535.0000 ECU_ADDRESS 0x3FA520 /end MEASUREMENT
/begin MEASUREMENT ed_fsp_13of20_.uw_satz_3of3_.uw_wert_nv_1of4_ "Umweltbedingung beim Fehlereintrag" UWORD FORMULA_0010 0 0 0.0 65535.0000 ECU_ADDRESS 0x3FA524 /end MEASUREMENT
/begin MEASUREMENT ed_fsp_13of20_.uw_satz_3of3_.uw_wert_nv_2of4_ "Umweltbedingung beim Fehlereintrag" UWORD FORMULA_0010 0 0 0.0 65535.0000 ECU_ADDRESS 0x3FA526 /end MEASUREMENT
/begin MEASUREMENT ed_fsp_13of20_.uw_satz_3of3_.uw_wert_nv_3of4_ "Umweltbedingung beim Fehlereintrag" UWORD FORMULA_0010 0 0 0.0 65535.0000 ECU_ADDRESS 0x3FA528 /end MEASUREMENT
/begin MEASUREMENT ed_fsp_13of20_.uw_satz_3of3_.uw_wert_nv_4of4_ "Umweltbedingung beim Fehlereintrag" UWORD FORMULA_0010 0 0 0.0 65535.0000 ECU_ADDRESS 0x3FA52A /end MEASUREMENT
/begin MEASUREMENT ed_fsp_10of20_.inj_fehlerzaehler_nv "INJ-Fehlerzaehler" UWORD FORMULA_0010 0 0 0.0 65535.0000 ECU_ADDRESS 0x3FA436 /end MEASUREMENT
/begin MEASUREMENT ed_fsp_11of20_.inj_fehlerzaehler_nv "INJ-Fehlerzaehler" UWORD FORMULA_0010 0 0 0.0 65535.0000 ECU_ADDRESS 0x3FA488 /end MEASUREMENT
/begin MEASUREMENT ed_fsp_12of20_.inj_fehlerzaehler_nv "INJ-Fehlerzaehler" UWORD FORMULA_0010 0 0 0.0 65535.0000 ECU_ADDRESS 0x3FA4DA /end MEASUREMENT
/begin MEASUREMENT ed_fsp_13of20_.inj_fehlerzaehler_nv "INJ-Fehlerzaehler" UWORD FORMULA_0010 0 0 0.0 65535.0000 ECU_ADDRESS 0x3FA52C /end MEASUREMENT
/begin MEASUREMENT ed_fsp_10of20_.ed_fil_index_nv "Verweis auf Fehlerfilter" UWORD FORMULA_0010 0 0 0.0 65535.0000 ECU_ADDRESS 0x3FA438 /end MEASUREMENT
/begin MEASUREMENT ed_fsp_11of20_.ed_fil_index_nv "Verweis auf Fehlerfilter" UWORD FORMULA_0010 0 0 0.0 65535.0000 ECU_ADDRESS 0x3FA48A /end MEASUREMENT
/begin MEASUREMENT ed_fsp_12of20_.ed_fil_index_nv "Verweis auf Fehlerfilter" UWORD FORMULA_0010 0 0 0.0 65535.0000 ECU_ADDRESS 0x3FA4DC /end MEASUREMENT
/begin MEASUREMENT ed_fsp_13of20_.ed_fil_index_nv "Verweis auf Fehlerfilter" UWORD FORMULA_0010 0 0 0.0 65535.0000 ECU_ADDRESS 0x3FA52E /end MEASUREMENT
/begin MEASUREMENT ed_fsp_14of20_.ed_fil_index_nv "Verweis auf Fehlerfilter" UWORD FORMULA_0010 0 0 0.0 65535.0000 ECU_ADDRESS 0x3FA580 /end MEASUREMENT
/begin MEASUREMENT ed_fsp_10of20_.mil_filter_nv "Filterwert der Milansteuerung" SBYTE FORMULA_0003 0 0 -128.0000 127.0000 ECU_ADDRESS 0x3FA43A /end MEASUREMENT
/begin MEASUREMENT ed_fsp_11of20_.mil_filter_nv "Filterwert der Milansteuerung" SBYTE FORMULA_0003 0 0 -128.0000 127.0000 ECU_ADDRESS 0x3FA48C /end MEASUREMENT
/begin MEASUREMENT ed_fsp_12of20_.mil_filter_nv "Filterwert der Milansteuerung" SBYTE FORMULA_0003 0 0 -128.0000 127.0000 ECU_ADDRESS 0x3FA4DE /end MEASUREMENT
/begin MEASUREMENT ed_fsp_13of20_.mil_filter_nv "Filterwert der Milansteuerung" SBYTE FORMULA_0003 0 0 -128.0000 127.0000 ECU_ADDRESS 0x3FA530 /end MEASUREMENT
/begin MEASUREMENT ed_fsp_10of20_.mil_filter_scdn_nv "Similar Conditions Eintragsfilterwert der Milansteuerung" UBYTE FORMULA_0003 0 0 0.0 255.0000 ECU_ADDRESS 0x3FA43B /end MEASUREMENT
/begin MEASUREMENT ed_fsp_11of20_.mil_filter_scdn_nv "Similar Conditions Eintragsfilterwert der Milansteuerung" UBYTE FORMULA_0003 0 0 0.0 255.0000 ECU_ADDRESS 0x3FA48D /end MEASUREMENT
/begin MEASUREMENT ed_fsp_12of20_.mil_filter_scdn_nv "Similar Conditions Eintragsfilterwert der Milansteuerung" UBYTE FORMULA_0003 0 0 0.0 255.0000 ECU_ADDRESS 0x3FA4DF /end MEASUREMENT
/begin MEASUREMENT ed_fsp_13of20_.mil_filter_scdn_nv "Similar Conditions Eintragsfilterwert der Milansteuerung" UBYTE FORMULA_0003 0 0 0.0 255.0000 ECU_ADDRESS 0x3FA531 /end MEASUREMENT
/begin MEASUREMENT ed_fsp_10of20_.scdn_zaehler_nv "Im similar Fenster" UWORD FORMULA_0010 0 0 0.0 65535.0000 ECU_ADDRESS 0x3FA43C /end MEASUREMENT
/begin MEASUREMENT ed_fsp_11of20_.scdn_zaehler_nv "Im similar Fenster" UWORD FORMULA_0010 0 0 0.0 65535.0000 ECU_ADDRESS 0x3FA48E /end MEASUREMENT
/begin MEASUREMENT ed_fsp_12of20_.scdn_zaehler_nv "Im similar Fenster" UWORD FORMULA_0010 0 0 0.0 65535.0000 ECU_ADDRESS 0x3FA4E0 /end MEASUREMENT
/begin MEASUREMENT ed_fsp_13of20_.scdn_zaehler_nv "Im similar Fenster" UWORD FORMULA_0010 0 0 0.0 65535.0000 ECU_ADDRESS 0x3FA532 /end MEASUREMENT
/begin MEASUREMENT ed_fsp_10of20_.scdn_nenner_nv "Gesamte Anzahl" UWORD FORMULA_0010 0 0 0.0 65535.0000 ECU_ADDRESS 0x3FA43E /end MEASUREMENT
/begin MEASUREMENT ed_fsp_11of20_.scdn_nenner_nv "Gesamte Anzahl" UWORD FORMULA_0010 0 0 0.0 65535.0000 ECU_ADDRESS 0x3FA490 /end MEASUREMENT
/begin MEASUREMENT ed_fsp_12of20_.scdn_nenner_nv "Gesamte Anzahl" UWORD FORMULA_0010 0 0 0.0 65535.0000 ECU_ADDRESS 0x3FA4E2 /end MEASUREMENT
/begin MEASUREMENT ed_fsp_13of20_.scdn_nenner_nv "Gesamte Anzahl" UWORD FORMULA_0010 0 0 0.0 65535.0000 ECU_ADDRESS 0x3FA534 /end MEASUREMENT
/begin MEASUREMENT ed_fsp_10of20_.ff_p_code_nv "P-Code des Freeze Frame" UWORD FORMULA_0010 0 0 0.0 65535.0000 ECU_ADDRESS 0x3FA440 /end MEASUREMENT
/begin MEASUREMENT ed_fsp_11of20_.ff_p_code_nv "P-Code des Freeze Frame" UWORD FORMULA_0010 0 0 0.0 65535.0000 ECU_ADDRESS 0x3FA492 /end MEASUREMENT
/begin MEASUREMENT ed_fsp_12of20_.ff_p_code_nv "P-Code des Freeze Frame" UWORD FORMULA_0010 0 0 0.0 65535.0000 ECU_ADDRESS 0x3FA4E4 /end MEASUREMENT
/begin MEASUREMENT ed_fsp_13of20_.ff_p_code_nv "P-Code des Freeze Frame" UWORD FORMULA_0010 0 0 0.0 65535.0000 ECU_ADDRESS 0x3FA536 /end MEASUREMENT
/begin MEASUREMENT ed_fsp_14of20_.ff_p_code_nv "P-Code des Freeze Frame" UWORD FORMULA_0010 0 0 0.0 65535.0000 ECU_ADDRESS 0x3FA588 /end MEASUREMENT
/begin MEASUREMENT ed_fsp_10of20_.ff_n_nv "Drehzahl des Freeze Frame" UWORD FORMULA_0052 0 0 0.0 16383.7500 ECU_ADDRESS 0x3FA442 /end MEASUREMENT
/begin MEASUREMENT ed_fsp_11of20_.ff_n_nv "Drehzahl des Freeze Frame" UWORD FORMULA_0052 0 0 0.0 16383.7500 ECU_ADDRESS 0x3FA494 /end MEASUREMENT
/begin MEASUREMENT ed_fsp_12of20_.ff_n_nv "Drehzahl des Freeze Frame" UWORD FORMULA_0052 0 0 0.0 16383.7500 ECU_ADDRESS 0x3FA4E6 /end MEASUREMENT
/begin MEASUREMENT ed_fsp_13of20_.ff_n_nv "Drehzahl des Freeze Frame" UWORD FORMULA_0052 0 0 0.0 16383.7500 ECU_ADDRESS 0x3FA538 /end MEASUREMENT
/begin MEASUREMENT ed_fsp_14of20_.ff_n_nv "Drehzahl des Freeze Frame" UWORD FORMULA_0052 0 0 0.0 16383.7500 ECU_ADDRESS 0x3FA58A /end MEASUREMENT
/begin MEASUREMENT ed_fsp_10of20_.ff_ml_b1_nv "Luftmasse des Freeze Frame" UWORD FORMULA_0053 0 0 0.0 655.3500 ECU_ADDRESS 0x3FA444 /end MEASUREMENT
/begin MEASUREMENT ed_fsp_11of20_.ff_ml_b1_nv "Luftmasse des Freeze Frame" UWORD FORMULA_0053 0 0 0.0 655.3500 ECU_ADDRESS 0x3FA496 /end MEASUREMENT
/begin MEASUREMENT ed_fsp_12of20_.ff_ml_b1_nv "Luftmasse des Freeze Frame" UWORD FORMULA_0053 0 0 0.0 655.3500 ECU_ADDRESS 0x3FA4E8 /end MEASUREMENT
/begin MEASUREMENT ed_fsp_13of20_.ff_ml_b1_nv "Luftmasse des Freeze Frame" UWORD FORMULA_0053 0 0 0.0 655.3500 ECU_ADDRESS 0x3FA53A /end MEASUREMENT
/begin MEASUREMENT ed_fsp_14of20_.ff_ml_b1_nv "Luftmasse des Freeze Frame" UWORD FORMULA_0053 0 0 0.0 655.3500 ECU_ADDRESS 0x3FA58C /end MEASUREMENT
/begin MEASUREMENT ed_fsp_10of20_.ff_lam_reg_b1_nv "Einspritzsystem des Freeze Frame" UBYTE FORMULA_0054 0 0 0.0 255.0 ECU_ADDRESS 0x3FA446 /end MEASUREMENT
/begin MEASUREMENT ed_fsp_11of20_.ff_lam_reg_b1_nv "Einspritzsystem des Freeze Frame" UBYTE FORMULA_0054 0 0 0.0 255.0 ECU_ADDRESS 0x3FA498 /end MEASUREMENT
/begin MEASUREMENT ed_fsp_12of20_.ff_lam_reg_b1_nv "Einspritzsystem des Freeze Frame" UBYTE FORMULA_0054 0 0 0.0 255.0 ECU_ADDRESS 0x3FA4EA /end MEASUREMENT
/begin MEASUREMENT ed_fsp_13of20_.ff_lam_reg_b1_nv "Einspritzsystem des Freeze Frame" UBYTE FORMULA_0054 0 0 0.0 255.0 ECU_ADDRESS 0x3FA53C /end MEASUREMENT
/begin MEASUREMENT ed_fsp_14of20_.ff_lam_reg_b1_nv "Einspritzsystem des Freeze Frame" UBYTE FORMULA_0054 0 0 0.0 255.0 ECU_ADDRESS 0x3FA58E /end MEASUREMENT
/begin MEASUREMENT ed_fsp_10of20_.ff_lam_reg_b2_nv "Einspritzsystem des Freeze Frame" UBYTE FORMULA_0054 0 0 0.0 255.0 ECU_ADDRESS 0x3FA447 /end MEASUREMENT
/begin MEASUREMENT ed_fsp_11of20_.ff_lam_reg_b2_nv "Einspritzsystem des Freeze Frame" UBYTE FORMULA_0054 0 0 0.0 255.0 ECU_ADDRESS 0x3FA499 /end MEASUREMENT
/begin MEASUREMENT ed_fsp_12of20_.ff_lam_reg_b2_nv "Einspritzsystem des Freeze Frame" UBYTE FORMULA_0054 0 0 0.0 255.0 ECU_ADDRESS 0x3FA4EB /end MEASUREMENT
/begin MEASUREMENT ed_fsp_13of20_.ff_lam_reg_b2_nv "Einspritzsystem des Freeze Frame" UBYTE FORMULA_0054 0 0 0.0 255.0 ECU_ADDRESS 0x3FA53D /end MEASUREMENT
/begin MEASUREMENT ed_fsp_14of20_.ff_lam_reg_b2_nv "Einspritzsystem des Freeze Frame" UBYTE FORMULA_0054 0 0 0.0 255.0 ECU_ADDRESS 0x3FA58F /end MEASUREMENT
/begin MEASUREMENT ed_fsp_10of20_.ff_lam_reg_f_b1_nv "Lambdaregelfaktor des Freeze Frame" UBYTE FORMULA_0055 0 0 0.0 1.9921 ECU_ADDRESS 0x3FA448 /end MEASUREMENT
/begin MEASUREMENT ed_fsp_11of20_.ff_lam_reg_f_b1_nv "Lambdaregelfaktor des Freeze Frame" UBYTE FORMULA_0055 0 0 0.0 1.9921 ECU_ADDRESS 0x3FA49A /end MEASUREMENT
/begin MEASUREMENT ed_fsp_12of20_.ff_lam_reg_f_b1_nv "Lambdaregelfaktor des Freeze Frame" UBYTE FORMULA_0055 0 0 0.0 1.9921 ECU_ADDRESS 0x3FA4EC /end MEASUREMENT
/begin MEASUREMENT ed_fsp_13of20_.ff_lam_reg_f_b1_nv "Lambdaregelfaktor des Freeze Frame" UBYTE FORMULA_0055 0 0 0.0 1.9921 ECU_ADDRESS 0x3FA53E /end MEASUREMENT
/begin MEASUREMENT ed_fsp_14of20_.ff_lam_reg_f_b1_nv "Lambdaregelfaktor des Freeze Frame" UBYTE FORMULA_0055 0 0 0.0 1.9921 ECU_ADDRESS 0x3FA590 /end MEASUREMENT
/begin MEASUREMENT ed_fsp_10of20_.ff_lam_reg_f_b2_nv "Lambdaregelfaktor des Freeze Frame" UBYTE FORMULA_0055 0 0 0.0 1.9921 ECU_ADDRESS 0x3FA449 /end MEASUREMENT
/begin MEASUREMENT ed_fsp_11of20_.ff_lam_reg_f_b2_nv "Lambdaregelfaktor des Freeze Frame" UBYTE FORMULA_0055 0 0 0.0 1.9921 ECU_ADDRESS 0x3FA49B /end MEASUREMENT
/begin MEASUREMENT ed_fsp_12of20_.ff_lam_reg_f_b2_nv "Lambdaregelfaktor des Freeze Frame" UBYTE FORMULA_0055 0 0 0.0 1.9921 ECU_ADDRESS 0x3FA4ED /end MEASUREMENT
/begin MEASUREMENT ed_fsp_13of20_.ff_lam_reg_f_b2_nv "Lambdaregelfaktor des Freeze Frame" UBYTE FORMULA_0055 0 0 0.0 1.9921 ECU_ADDRESS 0x3FA53F /end MEASUREMENT
/begin MEASUREMENT ed_fsp_14of20_.ff_lam_reg_f_b2_nv "Lambdaregelfaktor des Freeze Frame" UBYTE FORMULA_0055 0 0 0.0 1.9921 ECU_ADDRESS 0x3FA591 /end MEASUREMENT
/begin MEASUREMENT ed_fsp_10of20_.ff_laa_f_ber_b1_nv "Lambdaadaptionsfaktor ohne TE des Freeze Frame" UBYTE FORMULA_0055 0 0 0.0 1.9921 ECU_ADDRESS 0x3FA44A /end MEASUREMENT
/begin MEASUREMENT ed_fsp_11of20_.ff_laa_f_ber_b1_nv "Lambdaadaptionsfaktor ohne TE des Freeze Frame" UBYTE FORMULA_0055 0 0 0.0 1.9921 ECU_ADDRESS 0x3FA49C /end MEASUREMENT
/begin MEASUREMENT ed_fsp_12of20_.ff_laa_f_ber_b1_nv "Lambdaadaptionsfaktor ohne TE des Freeze Frame" UBYTE FORMULA_0055 0 0 0.0 1.9921 ECU_ADDRESS 0x3FA4EE /end MEASUREMENT
/begin MEASUREMENT ed_fsp_13of20_.ff_laa_f_ber_b1_nv "Lambdaadaptionsfaktor ohne TE des Freeze Frame" UBYTE FORMULA_0055 0 0 0.0 1.9921 ECU_ADDRESS 0x3FA540 /end MEASUREMENT
/begin MEASUREMENT ed_fsp_14of20_.ff_laa_f_ber_b1_nv "Lambdaadaptionsfaktor ohne TE des Freeze Frame" UBYTE FORMULA_0055 0 0 0.0 1.9921 ECU_ADDRESS 0x3FA592 /end MEASUREMENT
/begin MEASUREMENT ed_fsp_10of20_.ff_laa_f_ber_b2_nv "Lambdaadaptionsfaktor ohne TE des Freeze Frame" UBYTE FORMULA_0055 0 0 0.0 1.9921 ECU_ADDRESS 0x3FA44B /end MEASUREMENT
/begin MEASUREMENT ed_fsp_11of20_.ff_laa_f_ber_b2_nv "Lambdaadaptionsfaktor ohne TE des Freeze Frame" UBYTE FORMULA_0055 0 0 0.0 1.9921 ECU_ADDRESS 0x3FA49D /end MEASUREMENT
/begin MEASUREMENT ed_fsp_12of20_.ff_laa_f_ber_b2_nv "Lambdaadaptionsfaktor ohne TE des Freeze Frame" UBYTE FORMULA_0055 0 0 0.0 1.9921 ECU_ADDRESS 0x3FA4EF /end MEASUREMENT
/begin MEASUREMENT ed_fsp_13of20_.ff_laa_f_ber_b2_nv "Lambdaadaptionsfaktor ohne TE des Freeze Frame" UBYTE FORMULA_0055 0 0 0.0 1.9921 ECU_ADDRESS 0x3FA541 /end MEASUREMENT
/begin MEASUREMENT ed_fsp_14of20_.ff_laa_f_ber_b2_nv "Lambdaadaptionsfaktor ohne TE des Freeze Frame" UBYTE FORMULA_0055 0 0 0.0 1.9921 ECU_ADDRESS 0x3FA593 /end MEASUREMENT
/begin MEASUREMENT ed_fsp_10of20_.ff_rf_b1_berech_nv "Berechnete_Last des Freeze Frame" UBYTE FORMULA_0056 0 0 0.0 100.0000 ECU_ADDRESS 0x3FA44C /end MEASUREMENT
/begin MEASUREMENT ed_fsp_11of20_.ff_rf_b1_berech_nv "Berechnete_Last des Freeze Frame" UBYTE FORMULA_0056 0 0 0.0 100.0000 ECU_ADDRESS 0x3FA49E /end MEASUREMENT
/begin MEASUREMENT ed_fsp_12of20_.ff_rf_b1_berech_nv "Berechnete_Last des Freeze Frame" UBYTE FORMULA_0056 0 0 0.0 100.0000 ECU_ADDRESS 0x3FA4F0 /end MEASUREMENT
/begin MEASUREMENT ed_fsp_13of20_.ff_rf_b1_berech_nv "Berechnete_Last des Freeze Frame" UBYTE FORMULA_0056 0 0 0.0 100.0000 ECU_ADDRESS 0x3FA542 /end MEASUREMENT
/begin MEASUREMENT ed_fsp_10of20_.ff_tmot_nv "Kuehlwassertemperatur des Freeze Frame" UBYTE FORMULA_0057 0 0 -40.0000 215.0000 ECU_ADDRESS 0x3FA44D /end MEASUREMENT
/begin MEASUREMENT ed_fsp_11of20_.ff_tmot_nv "Kuehlwassertemperatur des Freeze Frame" UBYTE FORMULA_0057 0 0 -40.0000 215.0000 ECU_ADDRESS 0x3FA49F /end MEASUREMENT
/begin MEASUREMENT ed_fsp_12of20_.ff_tmot_nv "Kuehlwassertemperatur des Freeze Frame" UBYTE FORMULA_0057 0 0 -40.0000 215.0000 ECU_ADDRESS 0x3FA4F1 /end MEASUREMENT
/begin MEASUREMENT ed_fsp_13of20_.ff_tmot_nv "Kuehlwassertemperatur des Freeze Frame" UBYTE FORMULA_0057 0 0 -40.0000 215.0000 ECU_ADDRESS 0x3FA543 /end MEASUREMENT
/begin MEASUREMENT ed_fsp_10of20_.ff_pks_ist_nv "Kraftstoffdruck des Freeze Frame" UBYTE FORMULA_0058 0 0 0.0 765.0000 ECU_ADDRESS 0x3FA44E /end MEASUREMENT
/begin MEASUREMENT ed_fsp_11of20_.ff_pks_ist_nv "Kraftstoffdruck des Freeze Frame" UBYTE FORMULA_0058 0 0 0.0 765.0000 ECU_ADDRESS 0x3FA4A0 /end MEASUREMENT
/begin MEASUREMENT ed_fsp_12of20_.ff_pks_ist_nv "Kraftstoffdruck des Freeze Frame" UBYTE FORMULA_0058 0 0 0.0 765.0000 ECU_ADDRESS 0x3FA4F2 /end MEASUREMENT
/begin MEASUREMENT ed_fsp_13of20_.ff_pks_ist_nv "Kraftstoffdruck des Freeze Frame" UBYTE FORMULA_0058 0 0 0.0 765.0000 ECU_ADDRESS 0x3FA544 /end MEASUREMENT
/begin MEASUREMENT ed_fsp_14of20_.ff_pks_ist_nv "Kraftstoffdruck des Freeze Frame" UBYTE FORMULA_0058 0 0 0.0 765.0000 ECU_ADDRESS 0x3FA596 /end MEASUREMENT
/begin MEASUREMENT ed_fsp_10of20_.ff_v_vorne_nv "Geschwindigkeit des Freeze Frame" UBYTE FORMULA_0059 0 0 0.0 255.0000 ECU_ADDRESS 0x3FA44F /end MEASUREMENT
/begin MEASUREMENT ed_fsp_11of20_.ff_v_vorne_nv "Geschwindigkeit des Freeze Frame" UBYTE FORMULA_0059 0 0 0.0 255.0000 ECU_ADDRESS 0x3FA4A1 /end MEASUREMENT
/begin MEASUREMENT ed_fsp_12of20_.ff_v_vorne_nv "Geschwindigkeit des Freeze Frame" UBYTE FORMULA_0059 0 0 0.0 255.0000 ECU_ADDRESS 0x3FA4F3 /end MEASUREMENT
/begin MEASUREMENT ed_fsp_13of20_.ff_v_vorne_nv "Geschwindigkeit des Freeze Frame" UBYTE FORMULA_0059 0 0 0.0 255.0000 ECU_ADDRESS 0x3FA545 /end MEASUREMENT
/begin MEASUREMENT ed_fsp_10of20_.ff_tz1_nv "Zuendwinkel 1 des Freeze Frame" UBYTE FORMULA_0060 0 0 -64.0000 63.5000 ECU_ADDRESS 0x3FA450 /end MEASUREMENT
/begin MEASUREMENT ed_fsp_11of20_.ff_tz1_nv "Zuendwinkel 1 des Freeze Frame" UBYTE FORMULA_0060 0 0 -64.0000 63.5000 ECU_ADDRESS 0x3FA4A2 /end MEASUREMENT
/begin MEASUREMENT ed_fsp_12of20_.ff_tz1_nv "Zuendwinkel 1 des Freeze Frame" UBYTE FORMULA_0060 0 0 -64.0000 63.5000 ECU_ADDRESS 0x3FA4F4 /end MEASUREMENT
/begin MEASUREMENT ed_fsp_13of20_.ff_tz1_nv "Zuendwinkel 1 des Freeze Frame" UBYTE FORMULA_0060 0 0 -64.0000 63.5000 ECU_ADDRESS 0x3FA546 /end MEASUREMENT
/begin MEASUREMENT ed_fsp_10of20_.ff_tan_b1_nv "Ansauglufttemperatur des Freeze Frame" UBYTE FORMULA_0057 0 0 -40.0000 215.0000 ECU_ADDRESS 0x3FA451 /end MEASUREMENT
/begin MEASUREMENT ed_fsp_11of20_.ff_tan_b1_nv "Ansauglufttemperatur des Freeze Frame" UBYTE FORMULA_0057 0 0 -40.0000 215.0000 ECU_ADDRESS 0x3FA4A3 /end MEASUREMENT
/begin MEASUREMENT ed_fsp_12of20_.ff_tan_b1_nv "Ansauglufttemperatur des Freeze Frame" UBYTE FORMULA_0057 0 0 -40.0000 215.0000 ECU_ADDRESS 0x3FA4F5 /end MEASUREMENT
/begin MEASUREMENT ed_fsp_13of20_.ff_tan_b1_nv "Ansauglufttemperatur des Freeze Frame" UBYTE FORMULA_0057 0 0 -40.0000 215.0000 ECU_ADDRESS 0x3FA547 /end MEASUREMENT
/begin MEASUREMENT ed_fsp_10of20_.ff_egas_abs_dk_b1_nv "Absolute Drosselklappenposition des Freeze Frame" UBYTE FORMULA_0056 0 0 0.0 100.0000 ECU_ADDRESS 0x3FA452 /end MEASUREMENT
/begin MEASUREMENT ed_fsp_11of20_.ff_egas_abs_dk_b1_nv "Absolute Drosselklappenposition des Freeze Frame" UBYTE FORMULA_0056 0 0 0.0 100.0000 ECU_ADDRESS 0x3FA4A4 /end MEASUREMENT
/begin MEASUREMENT ed_fsp_12of20_.ff_egas_abs_dk_b1_nv "Absolute Drosselklappenposition des Freeze Frame" UBYTE FORMULA_0056 0 0 0.0 100.0000 ECU_ADDRESS 0x3FA4F6 /end MEASUREMENT
/begin MEASUREMENT ed_fsp_13of20_.ff_egas_abs_dk_b1_nv "Absolute Drosselklappenposition des Freeze Frame" UBYTE FORMULA_0056 0 0 0.0 100.0000 ECU_ADDRESS 0x3FA548 /end MEASUREMENT
/begin MEASUREMENT ed_fsp_14of20_.ff_egas_abs_dk_b1_nv "Absolute Drosselklappenposition des Freeze Frame" UBYTE FORMULA_0056 0 0 0.0 100.0000 ECU_ADDRESS 0x3FA59A /end MEASUREMENT
/begin MEASUREMENT ed_fsp_10of20_.ff_sl_st_nv "Sekundaerluftstatus des Freeze Frame" UBYTE FORMULA_0061 0 0 0.0 255.0 ECU_ADDRESS 0x3FA453 /end MEASUREMENT
/begin MEASUREMENT ed_fsp_11of20_.ff_sl_st_nv "Sekundaerluftstatus des Freeze Frame" UBYTE FORMULA_0061 0 0 0.0 255.0 ECU_ADDRESS 0x3FA4A5 /end MEASUREMENT
/begin MEASUREMENT ed_fsp_12of20_.ff_sl_st_nv "Sekundaerluftstatus des Freeze Frame" UBYTE FORMULA_0061 0 0 0.0 255.0 ECU_ADDRESS 0x3FA4F7 /end MEASUREMENT
/begin MEASUREMENT ed_fsp_13of20_.ff_sl_st_nv "Sekundaerluftstatus des Freeze Frame" UBYTE FORMULA_0061 0 0 0.0 255.0 ECU_ADDRESS 0x3FA549 /end MEASUREMENT
/begin MEASUREMENT ed_fsp_10of20_.ff_time_ml_nv "Zeit seit Motorstart des Freeze Frame" UWORD FORMULA_0062 0 0 0.0 65535.0000 ECU_ADDRESS 0x3FA454 /end MEASUREMENT
/begin MEASUREMENT ed_fsp_11of20_.ff_time_ml_nv "Zeit seit Motorstart des Freeze Frame" UWORD FORMULA_0062 0 0 0.0 65535.0000 ECU_ADDRESS 0x3FA4A6 /end MEASUREMENT
/begin MEASUREMENT ed_fsp_12of20_.ff_time_ml_nv "Zeit seit Motorstart des Freeze Frame" UWORD FORMULA_0062 0 0 0.0 65535.0000 ECU_ADDRESS 0x3FA4F8 /end MEASUREMENT
/begin MEASUREMENT ed_fsp_13of20_.ff_time_ml_nv "Zeit seit Motorstart des Freeze Frame" UWORD FORMULA_0062 0 0 0.0 65535.0000 ECU_ADDRESS 0x3FA54A /end MEASUREMENT
/begin MEASUREMENT ed_fsp_10of20_.ff_ub_nv "Systemspannung fuer Steuergeraet des Freeze Frame" UWORD FORMULA_0063 0 0 0.0 65.5350 ECU_ADDRESS 0x3FA456 /end MEASUREMENT
/begin MEASUREMENT ed_fsp_11of20_.ff_ub_nv "Systemspannung fuer Steuergeraet des Freeze Frame" UWORD FORMULA_0063 0 0 0.0 65.5350 ECU_ADDRESS 0x3FA4A8 /end MEASUREMENT
/begin MEASUREMENT ed_fsp_12of20_.ff_ub_nv "Systemspannung fuer Steuergeraet des Freeze Frame" UWORD FORMULA_0063 0 0 0.0 65.5350 ECU_ADDRESS 0x3FA4FA /end MEASUREMENT
/begin MEASUREMENT ed_fsp_13of20_.ff_ub_nv "Systemspannung fuer Steuergeraet des Freeze Frame" UWORD FORMULA_0063 0 0 0.0 65.5350 ECU_ADDRESS 0x3FA54C /end MEASUREMENT
/begin MEASUREMENT ed_fsp_10of20_.ff_rf_b1_nv "Absolute Lastwert des Freeze Frame" UWORD FORMULA_0064 0 0 0.0 257.0000 ECU_ADDRESS 0x3FA458 /end MEASUREMENT
/begin MEASUREMENT ed_fsp_11of20_.ff_rf_b1_nv "Absolute Lastwert des Freeze Frame" UWORD FORMULA_0064 0 0 0.0 257.0000 ECU_ADDRESS 0x3FA4AA /end MEASUREMENT
/begin MEASUREMENT ed_fsp_12of20_.ff_rf_b1_nv "Absolute Lastwert des Freeze Frame" UWORD FORMULA_0064 0 0 0.0 257.0000 ECU_ADDRESS 0x3FA4FC /end MEASUREMENT
/begin MEASUREMENT ed_fsp_13of20_.ff_rf_b1_nv "Absolute Lastwert des Freeze Frame" UWORD FORMULA_0064 0 0 0.0 257.0000 ECU_ADDRESS 0x3FA54E /end MEASUREMENT
/begin MEASUREMENT ed_fsp_10of20_.ff_lam_soll_b1_nv "Lambdaregelfaktor des Freeze Frame" UWORD FORMULA_0024 0 0 0.0 1.9999 ECU_ADDRESS 0x3FA45A /end MEASUREMENT
/begin MEASUREMENT ed_fsp_11of20_.ff_lam_soll_b1_nv "Lambdaregelfaktor des Freeze Frame" UWORD FORMULA_0024 0 0 0.0 1.9999 ECU_ADDRESS 0x3FA4AC /end MEASUREMENT
/begin MEASUREMENT ed_fsp_12of20_.ff_lam_soll_b1_nv "Lambdaregelfaktor des Freeze Frame" UWORD FORMULA_0024 0 0 0.0 1.9999 ECU_ADDRESS 0x3FA4FE /end MEASUREMENT
/begin MEASUREMENT ed_fsp_13of20_.ff_lam_soll_b1_nv "Lambdaregelfaktor des Freeze Frame" UWORD FORMULA_0024 0 0 0.0 1.9999 ECU_ADDRESS 0x3FA550 /end MEASUREMENT
/begin MEASUREMENT ed_fsp_14of20_.ff_lam_soll_b1_nv "Lambdaregelfaktor des Freeze Frame" UWORD FORMULA_0024 0 0 0.0 1.9999 ECU_ADDRESS 0x3FA5A2 /end MEASUREMENT
/begin MEASUREMENT ed_fsp_10of20_.ff_tev_b1_nv "Tankentlueftungsventil des Freeze Frame" UBYTE FORMULA_0065 0 0 0.0 100.0000 ECU_ADDRESS 0x3FA45C /end MEASUREMENT
/begin MEASUREMENT ed_fsp_11of20_.ff_tev_b1_nv "Tankentlueftungsventil des Freeze Frame" UBYTE FORMULA_0065 0 0 0.0 100.0000 ECU_ADDRESS 0x3FA4AE /end MEASUREMENT
/begin MEASUREMENT ed_fsp_12of20_.ff_tev_b1_nv "Tankentlueftungsventil des Freeze Frame" UBYTE FORMULA_0065 0 0 0.0 100.0000 ECU_ADDRESS 0x3FA500 /end MEASUREMENT
/begin MEASUREMENT ed_fsp_13of20_.ff_tev_b1_nv "Tankentlueftungsventil des Freeze Frame" UBYTE FORMULA_0065 0 0 0.0 100.0000 ECU_ADDRESS 0x3FA552 /end MEASUREMENT
/begin MEASUREMENT ed_fsp_10of20_.ff_fst_nv "Tankfuellstand des Freeze Frame" UBYTE FORMULA_0065 0 0 0.0 100.0000 ECU_ADDRESS 0x3FA45D /end MEASUREMENT
/begin MEASUREMENT ed_fsp_11of20_.ff_fst_nv "Tankfuellstand des Freeze Frame" UBYTE FORMULA_0065 0 0 0.0 100.0000 ECU_ADDRESS 0x3FA4AF /end MEASUREMENT
/begin MEASUREMENT ed_fsp_12of20_.ff_fst_nv "Tankfuellstand des Freeze Frame" UBYTE FORMULA_0065 0 0 0.0 100.0000 ECU_ADDRESS 0x3FA501 /end MEASUREMENT
/begin MEASUREMENT ed_fsp_13of20_.ff_fst_nv "Tankfuellstand des Freeze Frame" UBYTE FORMULA_0065 0 0 0.0 100.0000 ECU_ADDRESS 0x3FA553 /end MEASUREMENT
/begin MEASUREMENT ed_fsp_14of20_.ff_fst_nv "Tankfuellstand des Freeze Frame" UBYTE FORMULA_0065 0 0 0.0 100.0000 ECU_ADDRESS 0x3FA5A5 /end MEASUREMENT
/begin MEASUREMENT ed_fsp_10of20_.ff_pumg_nv "Barometrischer Druck des Freeze Frame" UBYTE FORMULA_0066 0 0 0.0 255.0000 ECU_ADDRESS 0x3FA45E /end MEASUREMENT
/begin MEASUREMENT ed_fsp_11of20_.ff_pumg_nv "Barometrischer Druck des Freeze Frame" UBYTE FORMULA_0066 0 0 0.0 255.0000 ECU_ADDRESS 0x3FA4B0 /end MEASUREMENT
/begin MEASUREMENT ed_fsp_12of20_.ff_pumg_nv "Barometrischer Druck des Freeze Frame" UBYTE FORMULA_0066 0 0 0.0 255.0000 ECU_ADDRESS 0x3FA502 /end MEASUREMENT
/begin MEASUREMENT ed_fsp_13of20_.ff_pumg_nv "Barometrischer Druck des Freeze Frame" UBYTE FORMULA_0066 0 0 0.0 255.0000 ECU_ADDRESS 0x3FA554 /end MEASUREMENT
/begin MEASUREMENT ed_fsp_14of20_.ff_pumg_nv "Barometrischer Druck des Freeze Frame" UBYTE FORMULA_0066 0 0 0.0 255.0000 ECU_ADDRESS 0x3FA5A6 /end MEASUREMENT
/begin MEASUREMENT ed_fsp_10of20_.ff_egas_ist_dk_b1_nv "Relative Drosselklappen des Freeze Frame" UBYTE FORMULA_0065 0 0 0.0 100.0000 ECU_ADDRESS 0x3FA45F /end MEASUREMENT
/begin MEASUREMENT ed_fsp_11of20_.ff_egas_ist_dk_b1_nv "Relative Drosselklappen des Freeze Frame" UBYTE FORMULA_0065 0 0 0.0 100.0000 ECU_ADDRESS 0x3FA4B1 /end MEASUREMENT
/begin MEASUREMENT ed_fsp_12of20_.ff_egas_ist_dk_b1_nv "Relative Drosselklappen des Freeze Frame" UBYTE FORMULA_0065 0 0 0.0 100.0000 ECU_ADDRESS 0x3FA503 /end MEASUREMENT
/begin MEASUREMENT ed_fsp_13of20_.ff_egas_ist_dk_b1_nv "Relative Drosselklappen des Freeze Frame" UBYTE FORMULA_0065 0 0 0.0 100.0000 ECU_ADDRESS 0x3FA555 /end MEASUREMENT
/begin MEASUREMENT ed_fsp_14of20_.ff_egas_ist_dk_b1_nv "Relative Drosselklappen des Freeze Frame" UBYTE FORMULA_0065 0 0 0.0 100.0000 ECU_ADDRESS 0x3FA5A7 /end MEASUREMENT
/begin MEASUREMENT ed_fsp_10of20_.ff_tumg_nv "Umgebungslufttemperatur des Freeze Frame" UBYTE FORMULA_0057 0 0 -40.0000 215.0000 ECU_ADDRESS 0x3FA460 /end MEASUREMENT
/begin MEASUREMENT ed_fsp_11of20_.ff_tumg_nv "Umgebungslufttemperatur des Freeze Frame" UBYTE FORMULA_0057 0 0 -40.0000 215.0000 ECU_ADDRESS 0x3FA4B2 /end MEASUREMENT
/begin MEASUREMENT ed_fsp_12of20_.ff_tumg_nv "Umgebungslufttemperatur des Freeze Frame" UBYTE FORMULA_0057 0 0 -40.0000 215.0000 ECU_ADDRESS 0x3FA504 /end MEASUREMENT
/begin MEASUREMENT ed_fsp_13of20_.ff_tumg_nv "Umgebungslufttemperatur des Freeze Frame" UBYTE FORMULA_0057 0 0 -40.0000 215.0000 ECU_ADDRESS 0x3FA556 /end MEASUREMENT
/begin MEASUREMENT ed_fsp_10of20_.ff_pwg1_abs_roh_nv "Gaspedalposition D des Freeze Frame" UBYTE FORMULA_0065 0 0 0.0 100.0000 ECU_ADDRESS 0x3FA461 /end MEASUREMENT
/begin MEASUREMENT ed_fsp_11of20_.ff_pwg1_abs_roh_nv "Gaspedalposition D des Freeze Frame" UBYTE FORMULA_0065 0 0 0.0 100.0000 ECU_ADDRESS 0x3FA4B3 /end MEASUREMENT
/begin MEASUREMENT ed_fsp_12of20_.ff_pwg1_abs_roh_nv "Gaspedalposition D des Freeze Frame" UBYTE FORMULA_0065 0 0 0.0 100.0000 ECU_ADDRESS 0x3FA505 /end MEASUREMENT
/begin MEASUREMENT ed_fsp_13of20_.ff_pwg1_abs_roh_nv "Gaspedalposition D des Freeze Frame" UBYTE FORMULA_0065 0 0 0.0 100.0000 ECU_ADDRESS 0x3FA557 /end MEASUREMENT
/begin MEASUREMENT ed_fsp_10of20_.ff_pwg2_abs_roh_nv "Gaspedalposition E des Freeze Frame" UBYTE FORMULA_0065 0 0 0.0 100.0000 ECU_ADDRESS 0x3FA462 /end MEASUREMENT
/begin MEASUREMENT ed_fsp_11of20_.ff_pwg2_abs_roh_nv "Gaspedalposition E des Freeze Frame" UBYTE FORMULA_0065 0 0 0.0 100.0000 ECU_ADDRESS 0x3FA4B4 /end MEASUREMENT
/begin MEASUREMENT ed_fsp_12of20_.ff_pwg2_abs_roh_nv "Gaspedalposition E des Freeze Frame" UBYTE FORMULA_0065 0 0 0.0 100.0000 ECU_ADDRESS 0x3FA506 /end MEASUREMENT
/begin MEASUREMENT ed_fsp_13of20_.ff_pwg2_abs_roh_nv "Gaspedalposition E des Freeze Frame" UBYTE FORMULA_0065 0 0 0.0 100.0000 ECU_ADDRESS 0x3FA558 /end MEASUREMENT
/begin MEASUREMENT ed_fsp_10of20_.ff_egas_soll_dk_b1_nv "Sollwert relative Drosselklappenposition des Freeze Frame" UBYTE FORMULA_0065 0 0 0.0 100.0000 ECU_ADDRESS 0x3FA463 /end MEASUREMENT
/begin MEASUREMENT ed_fsp_11of20_.ff_egas_soll_dk_b1_nv "Sollwert relative Drosselklappenposition des Freeze Frame" UBYTE FORMULA_0065 0 0 0.0 100.0000 ECU_ADDRESS 0x3FA4B5 /end MEASUREMENT
/begin MEASUREMENT ed_fsp_12of20_.ff_egas_soll_dk_b1_nv "Sollwert relative Drosselklappenposition des Freeze Frame" UBYTE FORMULA_0065 0 0 0.0 100.0000 ECU_ADDRESS 0x3FA507 /end MEASUREMENT
/begin MEASUREMENT ed_fsp_13of20_.ff_egas_soll_dk_b1_nv "Sollwert relative Drosselklappenposition des Freeze Frame" UBYTE FORMULA_0065 0 0 0.0 100.0000 ECU_ADDRESS 0x3FA559 /end MEASUREMENT
/begin MEASUREMENT ed_fsp_14of20_.ff_egas_soll_dk_b1_nv "Sollwert relative Drosselklappenposition des Freeze Frame" UBYTE FORMULA_0065 0 0 0.0 100.0000 ECU_ADDRESS 0x3FA5AB /end MEASUREMENT
/begin FUNCTION Eigendiagnose ""
 /begin OUT_MEASUREMENT ed_fil_lank1_obd_we.fehler_aufrufe_nv ed_fil_lank1_obd_we.filter_max_nv ed_fil_lank1_obd_we.filter_nv ed_fil_lank1_obd_we.zyklus_filter_nv ed_fil_lank1_openload.art_aktuell_nv ed_fil_lank1_openload.fehler_aufrufe_nv ed_fil_lank1_openload.filter_max_nv ed_fil_lank1_openload.filter_nv ed_fil_lank1_openload.zyklus_filter_nv ed_fil_lank2.art_aktuell_nv ed_fil_lank2.fehler_aufrufe_nv ed_fil_lank2.filter_max_nv ed_fil_lank2.filter_nv ed_fil_lank2.zyklus_filter_nv ed_fil_lank2_obd_s.art_aktuell_nv ed_fil_lank2_obd_s.fehler_aufrufe_nv ed_fil_lank2_obd_s.filter_max_nv ed_fil_lank2_obd_s.filter_nv ed_fil_lank2_obd_s.zyklus_filter_nv ed_fil_lank2_obd_slope.art_aktuell_nv ed_fil_lank2_obd_slope.fehler_aufrufe_nv ed_fil_lank2_obd_slope.filter_max_nv ed_fil_lank2_obd_slope.filter_nv ed_fil_lank2_obd_slope.zyklus_filter_nv ed_fil_lank2_obd_we.art_aktuell_nv ed_fil_lank2_obd_we.fehler_aufrufe_nv ed_fil_lank2_obd_we.filter_max_nv ed_fil_lank2_obd_we.filter_nv ed_fil_lank2_obd_we.zyklus_filter_nv ed_fil_lank2_openload.art_aktuell_nv ed_fil_lank2_openload.fehler_aufrufe_nv ed_fil_lank2_openload.filter_max_nv ed_fil_lank2_openload.filter_nv ed_fil_lank2_openload.zyklus_filter_nv ed_fil_lavk1.art_aktuell_nv ed_fil_lavk1.fehler_aufrufe_nv ed_fil_lavk1.filter_max_nv ed_fil_lavk1.filter_nv ed_fil_lavk1.zyklus_filter_nv ed_fil_lavk1_diag.art_aktuell_nv ed_fil_lavk1_diag.fehler_aufrufe_nv ed_fil_lavk1_diag.filter_max_nv ed_fil_lavk1_diag.filter_nv ed_fil_lavk1_diag.zyklus_filter_nv ed_fil_lavk1_ia_openload.art_aktuell_nv ed_fil_lavk1_ia_openload.fehler_aufrufe_nv ed_fil_lavk1_ia_openload.filter_max_nv ed_fil_lavk1_ia_openload.filter_nv ed_fil_lavk1_ia_openload.zyklus_filter_nv ed_fil_lavk1_ip_openload.art_aktuell_nv ed_fil_lavk1_ip_openload.fehler_aufrufe_nv ed_fil_lavk1_ip_openload.filter_max_nv ed_fil_lavk1_ip_openload.filter_nv ed_fil_lavk1_ip_openload.zyklus_filter_nv ed_fil_lavk1_obd_dyn.art_aktuell_nv ed_fil_lavk1_obd_dyn.fehler_aufrufe_nv ed_fil_lavk1_obd_dyn.filter_max_nv ed_fil_lavk1_obd_dyn.filter_nv ed_fil_lavk1_obd_dyn.zyklus_filter_nv ed_fil_lavk1_obd_plau.art_aktuell_nv ed_fil_lavk1_obd_plau.fehler_aufrufe_nv ed_fil_lavk1_obd_plau.filter_max_nv ed_fil_lavk1_obd_plau.filter_nv ed_fil_lavk1_obd_plau.zyklus_filter_nv ed_fil_lavk1_obd_sa.art_aktuell_nv ed_fil_lavk1_obd_sa.fehler_aufrufe_nv ed_fil_lavk1_obd_sa.filter_max_nv ed_fil_lavk1_obd_sa.filter_nv ed_fil_lavk1_obd_sa.zyklus_filter_nv ed_fil_lavk1_obd_tl.art_aktuell_nv ed_fil_lavk1_obd_tl.fehler_aufrufe_nv ed_fil_lavk1_obd_tl.filter_max_nv ed_fil_lavk1_obd_tl.filter_nv ed_fil_lavk1_obd_tl.zyklus_filter_nv ed_fil_lavk1_trim.art_aktuell_nv ed_fil_lavk1_trim.fehler_aufrufe_nv ed_fil_lavk1_trim.filter_max_nv ed_fil_lavk1_trim.filter_nv ed_fil_lavk1_trim.zyklus_filter_nv ed_fil_lavk1_un_openload.art_aktuell_nv ed_fil_lavk1_un_openload.fehler_aufrufe_nv ed_fil_lavk1_un_openload.filter_max_nv ed_fil_lavk1_un_openload.filter_nv ed_fil_lavk1_un_openload.zyklus_filter_nv ed_fil_lavk2.art_aktuell_nv ed_fil_lavk2.fehler_aufrufe_nv ed_fil_lavk2.filter_max_nv ed_fil_lavk2.filter_nv ed_fil_lavk2.zyklus_filter_nv ed_fil_lavk2_atic42.art_aktuell_nv ed_fil_lavk2_atic42.fehler_aufrufe_nv ed_fil_lavk2_atic42.filter_max_nv ed_fil_lavk2_atic42.filter_nv ed_fil_lavk2_atic42.zyklus_filter_nv ed_fil_lavk2_diag.art_aktuell_nv ed_fil_lavk2_diag.fehler_aufrufe_nv ed_fil_lavk2_diag.filter_max_nv ed_fil_lavk2_diag.filter_nv ed_fil_lavk2_diag.zyklus_filter_nv ed_fil_lavk2_ia_openload.art_aktuell_nv ed_fil_lavk2_ia_openload.fehler_aufrufe_nv ed_fil_lavk2_ia_openload.filter_max_nv ed_fil_lavk2_ia_openload.filter_nv ed_fil_lavk2_ia_openload.zyklus_filter_nv ed_fil_lavk2_ip_openload.art_aktuell_nv ed_fil_lavk2_ip_openload.fehler_aufrufe_nv ed_fil_lavk2_ip_openload.filter_max_nv ed_fil_lavk2_ip_openload.filter_nv ed_fil_lavk2_ip_openload.zyklus_filter_nv ed_fil_lavk2_obd_dyn.art_aktuell_nv ed_fil_lavk2_obd_dyn.fehler_aufrufe_nv ed_fil_lavk2_obd_dyn.filter_max_nv ed_fil_lavk2_obd_dyn.filter_nv ed_fil_lavk2_obd_dyn.zyklus_filter_nv ed_fil_lavk2_obd_plau.art_aktuell_nv ed_fil_lavk2_obd_plau.fehler_aufrufe_nv ed_fil_lavk2_obd_plau.filter_max_nv ed_fil_lavk2_obd_plau.filter_nv ed_fil_lavk2_obd_plau.zyklus_filter_nv ed_fil_lavk2_obd_sa.art_aktuell_nv ed_fil_lavk2_obd_sa.fehler_aufrufe_nv ed_fil_lavk2_obd_sa.filter_max_nv ed_fil_lavk2_obd_sa.filter_nv ed_fil_lavk2_obd_sa.zyklus_filter_nv ed_fil_lavk2_obd_tl.art_aktuell_nv ed_fil_lavk2_obd_tl.fehler_aufrufe_nv ed_fil_lavk2_obd_tl.filter_max_nv ed_fil_lavk2_obd_tl.filter_nv ed_fil_lavk2_obd_tl.zyklus_filter_nv ed_fil_lavk2_trim.art_aktuell_nv ed_fil_lavk2_trim.fehler_aufrufe_nv ed_fil_lavk2_trim.filter_max_nv ed_fil_lavk2_trim.filter_nv ed_fil_lavk2_trim.zyklus_filter_nv ed_fil_lavk2_un_openload.art_aktuell_nv ed_fil_lavk2_un_openload.fehler_aufrufe_nv ed_fil_lavk2_un_openload.filter_max_nv ed_fil_lavk2_un_openload.filter_nv ed_fil_lavk2_un_openload.zyklus_filter_nv ed_fil_lavk_atic42.art_aktuell_nv ed_fil_lavk_atic42.fehler_aufrufe_nv ed_fil_lavk_atic42.filter_max_nv ed_fil_lavk_atic42.filter_nv ed_fil_lavk_atic42.zyklus_filter_nv ed_fil_lshnk1.art_aktuell_nv ed_fil_lshnk1.fehler_aufrufe_nv ed_fil_lshnk1.filter_max_nv ed_fil_lshnk1.filter_nv ed_fil_lshnk1.zyklus_filter_nv ed_fil_lshnk1_r.art_aktuell_nv ed_fil_lshnk1_r.fehler_aufrufe_nv ed_fil_lshnk1_r.filter_max_nv ed_fil_lshnk1_r.filter_nv ed_fil_lshnk1_r.zyklus_filter_nv ed_fil_lshnk2.art_aktuell_nv ed_fil_lshnk2.fehler_aufrufe_nv ed_fil_lshnk2.filter_max_nv ed_fil_lshnk2.filter_nv ed_fil_lshnk2.zyklus_filter_nv ed_fil_lshnk2_r.art_aktuell_nv ed_fil_lshnk2_r.fehler_aufrufe_nv ed_fil_lshnk2_r.filter_max_nv ed_fil_lshnk2_r.filter_nv ed_fil_lshnk2_r.zyklus_filter_nv ed_fil_lshvk1.art_aktuell_nv ed_fil_lshvk1.fehler_aufrufe_nv ed_fil_lshvk1.filter_max_nv ed_fil_lshvk1.filter_nv ed_fil_lshvk1.zyklus_filter_nv ed_fil_lshvk1_r.art_aktuell_nv ed_fil_lshvk1_r.fehler_aufrufe_nv ed_fil_lshvk1_r.filter_max_nv ed_fil_lshvk1_r.filter_nv ed_fil_lshvk1_r.zyklus_filter_nv ed_fil_lshvk2.art_aktuell_nv ed_fil_lshvk2.fehler_aufrufe_nv ed_fil_lshvk2.filter_max_nv ed_fil_lshvk2.filter_nv ed_fil_lshvk2.zyklus_filter_nv ed_fil_lshvk2_r.art_aktuell_nv ed_fil_lshvk2_r.fehler_aufrufe_nv ed_fil_lshvk2_r.filter_max_nv ed_fil_lshvk2_r.filter_nv ed_fil_lshvk2_r.zyklus_filter_nv ed_fil_lsrvk1_obd_ref.art_aktuell_nv ed_fil_lsrvk1_obd_ref.fehler_aufrufe_nv ed_fil_lsrvk1_obd_ref.filter_max_nv ed_fil_lsrvk1_obd_ref.filter_nv ed_fil_lsrvk1_obd_ref.zyklus_filter_nv ed_fil_lsrvk1_obd_reg.art_aktuell_nv ed_fil_lsrvk1_obd_reg.fehler_aufrufe_nv ed_fil_lsrvk1_obd_reg.filter_max_nv ed_fil_lsrvk1_obd_reg.filter_nv ed_fil_lsrvk1_obd_reg.zyklus_filter_nv ed_fil_lsrvk1_obd_start.art_aktuell_nv ed_fil_lsrvk1_obd_start.fehler_aufrufe_nv ed_fil_lsrvk1_obd_start.filter_max_nv ed_fil_lsrvk1_obd_start.filter_nv ed_fil_lsrvk1_obd_start.zyklus_filter_nv ed_fil_lsrvk2_obd_ref.art_aktuell_nv ed_fil_lsrvk2_obd_ref.fehler_aufrufe_nv ed_fil_lsrvk2_obd_ref.filter_max_nv ed_fil_lsrvk2_obd_ref.filter_nv ed_fil_lsrvk2_obd_ref.zyklus_filter_nv ed_fil_lsrvk2_obd_reg.art_aktuell_nv ed_fil_lsrvk2_obd_reg.fehler_aufrufe_nv ed_fil_lsrvk2_obd_reg.filter_max_nv ed_fil_lsrvk2_obd_reg.filter_nv ed_fil_lsrvk2_obd_reg.zyklus_filter_nv ed_fil_lsrvk2_obd_start.art_aktuell_nv ed_fil_lsrvk2_obd_start.fehler_aufrufe_nv ed_fil_lsrvk2_obd_start.filter_max_nv ed_fil_lsrvk2_obd_start.filter_nv ed_fil_lsrvk2_obd_start.zyklus_filter_nv ed_fil_mvac_drucksensor.art_aktuell_nv ed_fil_mvac_drucksensor.fehler_aufrufe_nv ed_fil_mvac_drucksensor.filter_max_nv ed_fil_mvac_drucksensor.filter_nv ed_fil_mvac_drucksensor.zyklus_filter_nv ed_fil_mvac_obd.art_aktuell_nv ed_fil_mvac_obd.fehler_aufrufe_nv ed_fil_mvac_obd.filter_max_nv ed_fil_mvac_obd.filter_nv ed_fil_mvac_obd.zyklus_filter_nv ed_fil_nw1_sync.art_aktuell_nv ed_fil_nw1_sync.fehler_aufrufe_nv ed_fil_nw1_sync.filter_max_nv ed_fil_nw1_sync.filter_nv ed_fil_nw1_sync.zyklus_filter_nv ed_fil_nw2_sync.art_aktuell_nv ed_fil_nw2_sync.fehler_aufrufe_nv ed_fil_nw2_sync.filter_max_nv ed_fil_nw2_sync.filter_nv ed_fil_nw2_sync.zyklus_filter_nv ed_fil_pctrl_inj.art_aktuell_nv ed_fil_pctrl_inj.fehler_aufrufe_nv ed_fil_pctrl_inj.filter_max_nv ed_fil_pctrl_inj.filter_nv ed_fil_pctrl_inj.zyklus_filter_nv ed_fil_pks.art_aktuell_nv ed_fil_pks.fehler_aufrufe_nv ed_fil_pks.filter_max_nv ed_fil_pks.filter_nv ed_fil_pks.zyklus_filter_nv ed_fil_pks_adapt_anschl.art_aktuell_nv ed_fil_pks_adapt_anschl.fehler_aufrufe_nv ed_fil_pks_adapt_anschl.filter_max_nv ed_fil_pks_adapt_anschl.filter_nv ed_fil_pks_adapt_anschl.zyklus_filter_nv ed_fil_pks_ll.art_aktuell_nv ed_fil_pks_ll.fehler_aufrufe_nv ed_fil_pks_ll.filter_max_nv ed_fil_pks_ll.filter_nv ed_fil_pks_ll.zyklus_filter_nv ed_fil_pks_modell.art_aktuell_nv ed_fil_pks_modell.fehler_aufrufe_nv ed_fil_pks_modell.filter_max_nv ed_fil_pks_modell.filter_nv ed_fil_pks_modell.zyklus_filter_nv ed_fil_pks_paufbau.art_aktuell_nv ed_fil_pks_paufbau.fehler_aufrufe_nv ed_fil_pks_paufbau.filter_max_nv ed_fil_pks_paufbau.filter_nv ed_fil_pks_paufbau.zyklus_filter_nv ed_fil_pks_q.art_aktuell_nv ed_fil_pks_q.fehler_aufrufe_nv ed_fil_pks_q.filter_max_nv ed_fil_pks_q.filter_nv ed_fil_pks_q.zyklus_filter_nv ed_fil_pks_tl.art_aktuell_nv ed_fil_pks_tl.fehler_aufrufe_nv ed_fil_pks_tl.filter_max_nv ed_fil_pks_tl.filter_nv ed_fil_pks_tl.zyklus_filter_nv ed_fil_psau1.art_aktuell_nv ed_fil_psau1.fehler_aufrufe_nv ed_fil_psau1.filter_max_nv ed_fil_psau1.filter_nv ed_fil_psau1.zyklus_filter_nv ed_fil_psau2.art_aktuell_nv ed_fil_psau2.fehler_aufrufe_nv ed_fil_psau2.filter_max_nv ed_fil_psau2.filter_nv ed_fil_psau2.zyklus_filter_nv ed_fil_pt_anfradmom.art_aktuell_nv ed_fil_pt_anfradmom.fehler_aufrufe_nv ed_fil_pt_anfradmom.filter_max_nv ed_fil_pt_anfradmom.filter_nv ed_fil_pt_anfradmom.zyklus_filter_nv ed_fil_pt_atemp.art_aktuell_nv ed_fil_pt_atemp.fehler_aufrufe_nv ed_fil_pt_atemp.filter_max_nv ed_fil_pt_atemp.filter_nv ed_fil_pt_atemp.zyklus_filter_nv ed_fil_pt_ax.art_aktuell_nv ed_fil_pt_ax.fehler_aufrufe_nv ed_fil_pt_ax.filter_max_nv ed_fil_pt_ax.filter_nv ed_fil_pt_ax.zyklus_filter_nv ed_fil_pt_bedat.art_aktuell_nv ed_fil_pt_bedat.fehler_aufrufe_nv ed_fil_pt_bedat.filter_max_nv ed_fil_pt_bedat.filter_nv ed_fil_pt_bedat.zyklus_filter_nv ed_fil_pt_bedfgr.art_aktuell_nv ed_fil_pt_bedfgr.fehler_aufrufe_nv ed_fil_pt_bedfgr.filter_max_nv ed_fil_pt_bedfgr.filter_nv ed_fil_pt_bedfgr.zyklus_filter_nv ed_fil_pt_busoff.art_aktuell_nv ed_fil_pt_busoff.fehler_aufrufe_nv ed_fil_pt_busoff.filter_max_nv ed_fil_pt_busoff.filter_nv ed_fil_pt_busoff.zyklus_filter_nv ed_fil_pt_crash.art_aktuell_nv ed_fil_pt_crash.fehler_aufrufe_nv ed_fil_pt_crash.filter_max_nv ed_fil_pt_crash.filter_nv ed_fil_pt_crash.zyklus_filter_nv ed_fil_pt_grb.art_aktuell_nv ed_fil_pt_grb.fehler_aufrufe_nv ed_fil_pt_grb.filter_max_nv ed_fil_pt_grb.filter_nv ed_fil_pt_grb.zyklus_filter_nv ed_fil_pt_grb2.art_aktuell_nv ed_fil_pt_grb2.fehler_aufrufe_nv ed_fil_pt_grb2.filter_max_nv ed_fil_pt_grb2.filter_nv ed_fil_pt_grb2.zyklus_filter_nv ed_fil_pt_kkos.art_aktuell_nv ed_fil_pt_kkos.fehler_aufrufe_nv ed_fil_pt_kkos.filter_max_nv ed_fil_pt_kkos.filter_nv ed_fil_pt_kkos.zyklus_filter_nv ed_fil_pt_klst.art_aktuell_nv ed_fil_pt_klst.fehler_aufrufe_nv ed_fil_pt_klst.filter_max_nv ed_fil_pt_klst.filter_nv ed_fil_pt_klst.zyklus_filter_nv ed_fil_pt_km.art_aktuell_nv ed_fil_pt_km.fehler_aufrufe_nv ed_fil_pt_km.filter_max_nv ed_fil_pt_km.filter_nv ed_fil_pt_km.zyklus_filter_nv ed_fil_pt_kombi.art_aktuell_nv ed_fil_pt_kombi.fehler_aufrufe_nv ed_fil_pt_kombi.filter_max_nv ed_fil_pt_kombi.filter_nv ed_fil_pt_kombi.zyklus_filter_nv ed_fil_pt_lrw.art_aktuell_nv ed_fil_pt_lrw.fehler_aufrufe_nv ed_fil_pt_lrw.filter_max_nv ed_fil_pt_lrw.filter_nv ed_fil_pt_lrw.zyklus_filter_nv ed_fil_pt_obd_ed.art_aktuell_nv ed_fil_pt_obd_ed.fehler_aufrufe_nv ed_fil_pt_obd_ed.filter_max_nv ed_fil_pt_obd_ed.filter_nv ed_fil_pt_obd_ed.zyklus_filter_nv ed_fil_pt_statanh.art_aktuell_nv ed_fil_pt_statanh.fehler_aufrufe_nv ed_fil_pt_statanh.filter_max_nv ed_fil_pt_statanh.filter_nv ed_fil_pt_statanh.zyklus_filter_nv ed_fil_pt_statdkg.art_aktuell_nv ed_fil_pt_statdkg.fehler_aufrufe_nv ed_fil_pt_statdkg.filter_max_nv ed_fil_pt_statdkg.filter_nv ed_fil_pt_statdkg.zyklus_filter_nv ed_fil_pt_statgrb.art_aktuell_nv ed_fil_pt_statgrb.fehler_aufrufe_nv ed_fil_pt_statgrb.filter_max_nv ed_fil_pt_statgrb.filter_nv ed_fil_pt_statgrb.zyklus_filter_nv ed_fil_pt_statr.art_aktuell_nv ed_fil_pt_statr.fehler_aufrufe_nv ed_fil_pt_statr.filter_max_nv ed_fil_pt_statr.filter_nv ed_fil_pt_statr.zyklus_filter_nv ed_fil_pt_stdsc.art_aktuell_nv ed_fil_pt_stdsc.fehler_aufrufe_nv ed_fil_pt_stdsc.filter_max_nv ed_fil_pt_stdsc.filter_nv ed_fil_pt_stdsc.zyklus_filter_nv ed_fil_pt_toma.art_aktuell_nv ed_fil_pt_toma.fehler_aufrufe_nv ed_fil_pt_toma.filter_max_nv ed_fil_pt_toma.filter_nv ed_fil_pt_toma.zyklus_filter_nv ed_fil_pt_torqdsc.art_aktuell_nv ed_fil_pt_torqdsc.fehler_aufrufe_nv ed_fil_pt_torqdsc.filter_max_nv ed_fil_pt_torqdsc.filter_nv ed_fil_pt_torqdsc.zyklus_filter_nv ed_fil_pt_vehmod.art_aktuell_nv ed_fil_pt_vehmod.fehler_aufrufe_nv ed_fil_pt_vehmod.filter_max_nv ed_fil_pt_vehmod.filter_nv ed_fil_pt_vehmod.zyklus_filter_nv ed_fil_pt_vfzg.art_aktuell_nv ed_fil_pt_vfzg.fehler_aufrufe_nv ed_fil_pt_vfzg.filter_max_nv ed_fil_pt_vfzg.filter_nv ed_fil_pt_vfzg.zyklus_filter_nv ed_fil_pt_vrad.art_aktuell_nv ed_fil_pt_vrad.fehler_aufrufe_nv ed_fil_pt_vrad.filter_max_nv ed_fil_pt_vrad.filter_nv ed_fil_pt_vrad.zyklus_filter_nv ed_fil_pumg.art_aktuell_nv ed_fil_pumg.fehler_aufrufe_nv ed_fil_pumg.filter_max_nv ed_fil_pumg.filter_nv ed_fil_pumg.zyklus_filter_nv ed_fil_pumg_obd.art_aktuell_nv ed_fil_pumg_obd.fehler_aufrufe_nv ed_fil_pumg_obd.filter_max_nv ed_fil_pumg_obd.filter_nv ed_fil_pumg_obd.zyklus_filter_nv ed_fil_rlslp.art_aktuell_nv ed_fil_rlslp.fehler_aufrufe_nv ed_fil_rlslp.filter_max_nv ed_fil_rlslp.filter_nv ed_fil_rlslp.zyklus_filter_nv ed_fil_rlu87.art_aktuell_nv ed_fil_rlu87.fehler_aufrufe_nv ed_fil_rlu87.filter_max_nv ed_fil_rlu87.filter_nv ed_fil_rlu87.zyklus_filter_nv ed_fil_s_getr_hs.art_aktuell_nv ed_fil_s_getr_hs.fehler_aufrufe_nv ed_fil_s_getr_hs.filter_max_nv ed_fil_s_getr_hs.filter_nv ed_fil_s_getr_hs.zyklus_filter_nv ed_fil_s_kupp_hs.art_aktuell_nv ed_fil_s_kupp_hs.fehler_aufrufe_nv ed_fil_s_kupp_hs.filter_max_nv ed_fil_s_kupp_hs.filter_nv ed_fil_s_kupp_hs.zyklus_filter_nv ed_fil_s_poel_diag.art_aktuell_nv ed_fil_s_poel_diag.fehler_aufrufe_nv ed_fil_s_poel_diag.filter_max_nv ed_fil_s_poel_diag.filter_nv ed_fil_s_poel_diag.zyklus_filter_nv ed_fil_sg_inj.art_aktuell_nv ed_fil_sg_inj.fehler_aufrufe_nv ed_fil_sg_inj.filter_max_nv ed_fil_sg_inj.filter_nv ed_fil_sg_inj.zyklus_filter_nv ed_fil_sk_manager_inj.art_aktuell_nv ed_fil_sk_manager_inj.fehler_aufrufe_nv ed_fil_sk_manager_inj.filter_max_nv ed_fil_sk_manager_inj.filter_nv ed_fil_sk_manager_inj.zyklus_filter_nv ed_fil_sk_tr_inj.art_aktuell_nv ed_fil_sk_tr_inj.fehler_aufrufe_nv ed_fil_sk_tr_inj.filter_max_nv ed_fil_sk_tr_inj.filter_nv ed_fil_sk_tr_inj.zyklus_filter_nv ed_fil_sl_durchs_b1.art_aktuell_nv ed_fil_sl_durchs_b1.fehler_aufrufe_nv ed_fil_sl_durchs_b1.filter_max_nv ed_fil_sl_durchs_b1.filter_nv ed_fil_sl_durchs_b1.zyklus_filter_nv ed_fil_sl_durchs_b2.art_aktuell_nv ed_fil_sl_durchs_b2.fehler_aufrufe_nv ed_fil_sl_durchs_b2.filter_max_nv ed_fil_sl_durchs_b2.filter_nv ed_fil_sl_durchs_b2.zyklus_filter_nv ed_fil_sl_durchs_hstrang.art_aktuell_nv ed_fil_sl_durchs_hstrang.fehler_aufrufe_nv ed_fil_sl_durchs_hstrang.filter_max_nv ed_fil_sl_durchs_hstrang.filter_nv ed_fil_sl_durchs_hstrang.zyklus_filter_nv ed_fil_sl_ml_hfm.art_aktuell_nv ed_fil_sl_ml_hfm.fehler_aufrufe_nv ed_fil_sl_ml_hfm.filter_max_nv ed_fil_sl_ml_hfm.filter_nv ed_fil_sl_ml_hfm.zyklus_filter_nv ed_fil_sl_ml_hfm_obd.art_aktuell_nv ed_fil_sl_ml_hfm_obd.fehler_aufrufe_nv ed_fil_sl_ml_hfm_obd.filter_max_nv ed_fil_sl_ml_hfm_obd.filter_nv ed_fil_sl_ml_hfm_obd.zyklus_filter_nv ed_fil_slp.art_aktuell_nv ed_fil_slp.fehler_aufrufe_nv ed_fil_slp.filter_max_nv ed_fil_slp.filter_nv ed_fil_slp.zyklus_filter_nv ed_fil_slv.art_aktuell_nv ed_fil_slv.fehler_aufrufe_nv ed_fil_slv.filter_max_nv ed_fil_slv.filter_nv ed_fil_slv.zyklus_filter_nv ed_fil_ssp.art_aktuell_nv ed_fil_ssp.fehler_aufrufe_nv ed_fil_ssp.filter_max_nv ed_fil_ssp.filter_nv ed_fil_ssp.zyklus_filter_nv ed_fil_ssp_diag.art_aktuell_nv ed_fil_ssp_diag.fehler_aufrufe_nv ed_fil_ssp_diag.filter_max_nv ed_fil_ssp_diag.filter_nv ed_fil_ssp_diag.zyklus_filter_nv ed_fil_tank_leer.art_aktuell_nv ed_fil_tank_leer.fehler_aufrufe_nv ed_fil_tank_leer.filter_max_nv ed_fil_tank_leer.filter_nv ed_fil_tank_leer.zyklus_filter_nv ed_fil_td.art_aktuell_nv ed_fil_td.fehler_aufrufe_nv ed_fil_td.filter_max_nv ed_fil_td.filter_nv ed_fil_td.zyklus_filter_nv ed_fil_te_obd_1.art_aktuell_nv ed_fil_te_obd_1.fehler_aufrufe_nv ed_fil_te_obd_1.filter_max_nv ed_fil_te_obd_1.filter_nv ed_fil_te_obd_1.zyklus_filter_nv ed_fil_te_obd_2.art_aktuell_nv ed_fil_te_obd_2.fehler_aufrufe_nv ed_fil_te_obd_2.filter_max_nv ed_fil_te_obd_2.filter_nv ed_fil_te_obd_2.zyklus_filter_nv ed_fil_tev1.art_aktuell_nv ed_fil_tev1.fehler_aufrufe_nv ed_fil_tev1.filter_max_nv ed_fil_tev1.filter_nv ed_fil_tev1.zyklus_filter_nv ed_fil_tev2.art_aktuell_nv ed_fil_tev2.fehler_aufrufe_nv ed_fil_tev2.filter_max_nv ed_fil_tev2.filter_nv ed_fil_tev2.zyklus_filter_nv ed_fil_tgetr_hs.art_aktuell_nv ed_fil_tgetr_hs.fehler_aufrufe_nv ed_fil_tgetr_hs.filter_max_nv ed_fil_tgetr_hs.filter_nv ed_fil_tgetr_hs.zyklus_filter_nv ed_fil_tz1.art_aktuell_nv ed_fil_tz1.fehler_aufrufe_nv ed_fil_tz1.filter_max_nv ed_fil_tz1.filter_nv ed_fil_tz1.zyklus_filter_nv ed_fil_tz10.art_aktuell_nv ed_fil_tz10.fehler_aufrufe_nv ed_fil_tz10.filter_max_nv ed_fil_tz10.filter_nv ed_fil_tz10.zyklus_filter_nv ed_fil_tz2.art_aktuell_nv ed_fil_tz2.fehler_aufrufe_nv ed_fil_tz2.filter_max_nv ed_fil_tz2.filter_nv ed_fil_tz2.zyklus_filter_nv ed_fil_tz3.art_aktuell_nv ed_fil_tz3.fehler_aufrufe_nv ed_fil_tz3.filter_max_nv ed_fil_tz3.filter_nv ed_fil_tz3.zyklus_filter_nv ed_fil_tz4.art_aktuell_nv ed_fil_tz4.fehler_aufrufe_nv ed_fil_tz4.filter_max_nv ed_fil_tz4.filter_nv ed_fil_tz4.zyklus_filter_nv ed_fil_tz5.art_aktuell_nv ed_fil_tz5.fehler_aufrufe_nv ed_fil_tz5.filter_max_nv ed_fil_tz5.filter_nv ed_fil_tz5.zyklus_filter_nv ed_fil_tz6.art_aktuell_nv ed_fil_tz6.fehler_aufrufe_nv ed_fil_tz6.filter_max_nv ed_fil_tz6.filter_nv ed_fil_tz6.zyklus_filter_nv ed_fil_tz7.art_aktuell_nv ed_fil_tz7.fehler_aufrufe_nv ed_fil_tz7.filter_max_nv ed_fil_tz7.filter_nv ed_fil_tz7.zyklus_filter_nv ed_fil_tz8.art_aktuell_nv ed_fil_tz8.fehler_aufrufe_nv ed_fil_tz8.filter_max_nv ed_fil_tz8.filter_nv ed_fil_tz8.zyklus_filter_nv ed_fil_tz9.art_aktuell_nv ed_fil_tz9.fehler_aufrufe_nv ed_fil_tz9.filter_max_nv ed_fil_tz9.filter_nv ed_fil_tz9.zyklus_filter_nv ed_fil_van_anschl_a1.art_aktuell_nv ed_fil_van_anschl_a1.fehler_aufrufe_nv ed_fil_van_anschl_a1.filter_max_nv ed_fil_van_anschl_a1.filter_nv ed_fil_van_anschl_a1.zyklus_filter_nv ed_fil_van_anschl_a2.art_aktuell_nv ed_fil_van_anschl_a2.fehler_aufrufe_nv ed_fil_van_anschl_a2.filter_max_nv ed_fil_van_anschl_a2.filter_nv ed_fil_van_anschl_a2.zyklus_filter_nv ed_fil_van_anschl_e1.art_aktuell_nv ed_fil_van_anschl_e1.fehler_aufrufe_nv ed_fil_van_anschl_e1.filter_max_nv ed_fil_van_anschl_e1.filter_nv ed_fil_van_anschl_e1.zyklus_filter_nv ed_fil_van_anschl_e2.art_aktuell_nv ed_fil_van_anschl_e2.fehler_aufrufe_nv ed_fil_van_anschl_e2.filter_max_nv ed_fil_van_anschl_e2.filter_nv ed_fil_van_anschl_e2.zyklus_filter_nv ed_fil_van_druck.art_aktuell_nv ed_fil_van_druck.fehler_aufrufe_nv ed_fil_van_druck.filter_max_nv ed_fil_van_druck.filter_nv ed_fil_van_druck.zyklus_filter_nv ed_fil_van_dsv.art_aktuell_nv ed_fil_van_dsv.fehler_aufrufe_nv ed_fil_van_dsv.filter_max_nv ed_fil_van_dsv.filter_nv ed_fil_van_dsv.zyklus_filter_nv ed_fil_van_hall_a1.art_aktuell_nv ed_fil_van_hall_a1.fehler_aufrufe_nv ed_fil_van_hall_a1.filter_max_nv ed_fil_van_hall_a1.filter_nv ed_fil_van_hall_a1.zyklus_filter_nv ed_fil_van_hall_a2.art_aktuell_nv ed_fil_van_hall_a2.fehler_aufrufe_nv ed_fil_van_hall_a2.filter_max_nv ed_fil_van_hall_a2.filter_nv ed_fil_van_hall_a2.zyklus_filter_nv ed_fil_van_hall_e1.art_aktuell_nv ed_fil_van_hall_e1.fehler_aufrufe_nv ed_fil_van_hall_e1.filter_max_nv ed_fil_van_hall_e1.filter_nv ed_fil_van_hall_e1.zyklus_filter_nv ed_fil_van_hall_e2.art_aktuell_nv ed_fil_van_hall_e2.fehler_aufrufe_nv ed_fil_van_hall_e2.filter_max_nv ed_fil_van_hall_e2.filter_nv ed_fil_van_hall_e2.zyklus_filter_nv ed_fil_van_regl_a1.art_aktuell_nv ed_fil_van_regl_a1.fehler_aufrufe_nv ed_fil_van_regl_a1.filter_max_nv ed_fil_van_regl_a1.filter_nv ed_fil_van_regl_a1.zyklus_filter_nv ed_fil_van_regl_a2.art_aktuell_nv ed_fil_van_regl_a2.fehler_aufrufe_nv ed_fil_van_regl_a2.filter_max_nv ed_fil_van_regl_a2.filter_nv ed_fil_van_regl_a2.zyklus_filter_nv ed_fil_van_regl_e1.art_aktuell_nv ed_fil_van_regl_e1.fehler_aufrufe_nv ed_fil_van_regl_e1.filter_max_nv ed_fil_van_regl_e1.filter_nv ed_fil_van_regl_e1.zyklus_filter_nv ed_fil_van_regl_e2.art_aktuell_nv ed_fil_van_regl_e2.fehler_aufrufe_nv ed_fil_van_regl_e2.filter_max_nv ed_fil_van_regl_e2.filter_nv ed_fil_van_regl_e2.zyklus_filter_nv ed_fil_van_vent_a1.art_aktuell_nv ed_fil_van_vent_a1.fehler_aufrufe_nv ed_fil_van_vent_a1.filter_max_nv ed_fil_van_vent_a1.filter_nv ed_fil_van_vent_a1.zyklus_filter_nv ed_fil_van_vent_a2.art_aktuell_nv ed_fil_van_vent_a2.fehler_aufrufe_nv ed_fil_van_vent_a2.filter_max_nv ed_fil_van_vent_a2.filter_nv ed_fil_van_vent_a2.zyklus_filter_nv ed_fil_van_vent_e1.art_aktuell_nv ed_fil_van_vent_e1.fehler_aufrufe_nv ed_fil_van_vent_e1.filter_max_nv ed_fil_van_vent_e1.filter_nv ed_fil_van_vent_e1.zyklus_filter_nv ed_fil_van_vent_e2.art_aktuell_nv ed_fil_van_vent_e2.fehler_aufrufe_nv ed_fil_van_vent_e2.filter_max_nv ed_fil_van_vent_e2.filter_nv ed_fil_van_vent_e2.zyklus_filter_nv ed_fsp_10of20_.ed_fil_index_nv ed_fsp_10of20_.fehlerart_nv ed_fsp_10of20_.fehlercode_nv ed_fsp_10of20_.ff_egas_abs_dk_b1_nv ed_fsp_10of20_.ff_egas_ist_dk_b1_nv ed_fsp_10of20_.ff_egas_soll_dk_b1_nv ed_fsp_10of20_.ff_fst_nv ed_fsp_10of20_.ff_laa_f_ber_b1_nv ed_fsp_10of20_.ff_laa_f_ber_b2_nv ed_fsp_10of20_.ff_lam_reg_b1_nv ed_fsp_10of20_.ff_lam_reg_b2_nv ed_fsp_10of20_.ff_lam_reg_f_b1_nv ed_fsp_10of20_.ff_lam_reg_f_b2_nv ed_fsp_10of20_.ff_lam_soll_b1_nv ed_fsp_10of20_.ff_ml_b1_nv ed_fsp_10of20_.ff_n_nv ed_fsp_10of20_.ff_p_code_nv ed_fsp_10of20_.ff_pks_ist_nv ed_fsp_10of20_.ff_pumg_nv ed_fsp_10of20_.ff_pwg1_abs_roh_nv ed_fsp_10of20_.ff_pwg2_abs_roh_nv ed_fsp_10of20_.ff_rf_b1_berech_nv ed_fsp_10of20_.ff_rf_b1_nv ed_fsp_10of20_.ff_sl_st_nv ed_fsp_10of20_.ff_tan_b1_nv ed_fsp_10of20_.ff_tev_b1_nv ed_fsp_10of20_.ff_time_ml_nv ed_fsp_10of20_.ff_tmot_nv ed_fsp_10of20_.ff_tumg_nv ed_fsp_10of20_.ff_tz1_nv ed_fsp_10of20_.ff_ub_nv ed_fsp_10of20_.ff_v_vorne_nv ed_fsp_10of20_.haeufigkeitszaehler_nv ed_fsp_10of20_.inj_fehlerzaehler_nv ed_fsp_10of20_.logistikzaehler_nv ed_fsp_10of20_.mil_filter_nv ed_fsp_10of20_.mil_filter_scdn_nv ed_fsp_10of20_.scdn_nenner_nv ed_fsp_10of20_.scdn_zaehler_nv ed_fsp_10of20_.uw_satz_1of3_.uw_km_stand_nv ed_fsp_10of20_.uw_satz_1of3_.uw_wert_nv_1of4_ ed_fsp_10of20_.uw_satz_1of3_.uw_wert_nv_2of4_ ed_fsp_10of20_.uw_satz_1of3_.uw_wert_nv_3of4_ ed_fsp_10of20_.uw_satz_1of3_.uw_wert_nv_4of4_ ed_fsp_10of20_.uw_satz_2of3_.uw_km_stand_nv ed_fsp_10of20_.uw_satz_2of3_.uw_wert_nv_1of4_ ed_fsp_10of20_.uw_satz_2of3_.uw_wert_nv_2of4_ ed_fsp_10of20_.uw_satz_2of3_.uw_wert_nv_3of4_ ed_fsp_10of20_.uw_satz_2of3_.uw_wert_nv_4of4_ ed_fsp_10of20_.uw_satz_3of3_.uw_km_stand_nv ed_fsp_10of20_.uw_satz_3of3_.uw_wert_nv_1of4_ ed_fsp_10of20_.uw_satz_3of3_.uw_wert_nv_2of4_ ed_fsp_10of20_.uw_satz_3of3_.uw_wert_nv_3of4_ ed_fsp_10of20_.uw_satz_3of3_.uw_wert_nv_4of4_ ed_fsp_11of20_.ed_fil_index_nv ed_fsp_11of20_.fehlerart_nv ed_fsp_11of20_.fehlercode_nv ed_fsp_11of20_.ff_egas_abs_dk_b1_nv ed_fsp_11of20_.ff_egas_ist_dk_b1_nv ed_fsp_11of20_.ff_egas_soll_dk_b1_nv ed_fsp_11of20_.ff_fst_nv ed_fsp_11of20_.ff_laa_f_ber_b1_nv ed_fsp_11of20_.ff_laa_f_ber_b2_nv ed_fsp_11of20_.ff_lam_reg_b1_nv ed_fsp_11of20_.ff_lam_reg_b2_nv ed_fsp_11of20_.ff_lam_reg_f_b1_nv ed_fsp_11of20_.ff_lam_reg_f_b2_nv ed_fsp_11of20_.ff_lam_soll_b1_nv ed_fsp_11of20_.ff_ml_b1_nv ed_fsp_11of20_.ff_n_nv ed_fsp_11of20_.ff_p_code_nv ed_fsp_11of20_.ff_pks_ist_nv ed_fsp_11of20_.ff_pumg_nv ed_fsp_11of20_.ff_pwg1_abs_roh_nv ed_fsp_11of20_.ff_pwg2_abs_roh_nv ed_fsp_11of20_.ff_rf_b1_berech_nv ed_fsp_11of20_.ff_rf_b1_nv ed_fsp_11of20_.ff_sl_st_nv ed_fsp_11of20_.ff_tan_b1_nv ed_fsp_11of20_.ff_tev_b1_nv ed_fsp_11of20_.ff_time_ml_nv ed_fsp_11of20_.ff_tmot_nv ed_fsp_11of20_.ff_tumg_nv ed_fsp_11of20_.ff_tz1_nv ed_fsp_11of20_.ff_ub_nv ed_fsp_11of20_.ff_v_vorne_nv ed_fsp_11of20_.haeufigkeitszaehler_nv ed_fsp_11of20_.inj_fehlerzaehler_nv ed_fsp_11of20_.logistikzaehler_nv ed_fsp_11of20_.mil_filter_nv ed_fsp_11of20_.mil_filter_scdn_nv ed_fsp_11of20_.scdn_nenner_nv ed_fsp_11of20_.scdn_zaehler_nv ed_fsp_11of20_.uw_satz_1of3_.uw_km_stand_nv ed_fsp_11of20_.uw_satz_1of3_.uw_wert_nv_1of4_ ed_fsp_11of20_.uw_satz_1of3_.uw_wert_nv_2of4_ ed_fsp_11of20_.uw_satz_1of3_.uw_wert_nv_3of4_ ed_fsp_11of20_.uw_satz_1of3_.uw_wert_nv_4of4_ ed_fsp_11of20_.uw_satz_2of3_.uw_km_stand_nv ed_fsp_11of20_.uw_satz_2of3_.uw_wert_nv_1of4_ ed_fsp_11of20_.uw_satz_2of3_.uw_wert_nv_2of4_ ed_fsp_11of20_.uw_satz_2of3_.uw_wert_nv_3of4_ ed_fsp_11of20_.uw_satz_2of3_.uw_wert_nv_4of4_ ed_fsp_11of20_.uw_satz_3of3_.uw_km_stand_nv ed_fsp_11of20_.uw_satz_3of3_.uw_wert_nv_1of4_ ed_fsp_11of20_.uw_satz_3of3_.uw_wert_nv_2of4_ ed_fsp_11of20_.uw_satz_3of3_.uw_wert_nv_3of4_ ed_fsp_11of20_.uw_satz_3of3_.uw_wert_nv_4of4_ ed_fsp_12of20_.ed_fil_index_nv ed_fsp_12of20_.fehlerart_nv ed_fsp_12of20_.fehlercode_nv ed_fsp_12of20_.ff_egas_abs_dk_b1_nv ed_fsp_12of20_.ff_egas_ist_dk_b1_nv ed_fsp_12of20_.ff_egas_soll_dk_b1_nv ed_fsp_12of20_.ff_fst_nv ed_fsp_12of20_.ff_laa_f_ber_b1_nv ed_fsp_12of20_.ff_laa_f_ber_b2_nv ed_fsp_12of20_.ff_lam_reg_b1_nv ed_fsp_12of20_.ff_lam_reg_b2_nv ed_fsp_12of20_.ff_lam_reg_f_b1_nv ed_fsp_12of20_.ff_lam_reg_f_b2_nv ed_fsp_12of20_.ff_lam_soll_b1_nv ed_fsp_12of20_.ff_ml_b1_nv ed_fsp_12of20_.ff_n_nv ed_fsp_12of20_.ff_p_code_nv ed_fsp_12of20_.ff_pks_ist_nv ed_fsp_12of20_.ff_pumg_nv ed_fsp_12of20_.ff_pwg1_abs_roh_nv ed_fsp_12of20_.ff_pwg2_abs_roh_nv ed_fsp_12of20_.ff_rf_b1_berech_nv ed_fsp_12of20_.ff_rf_b1_nv ed_fsp_12of20_.ff_sl_st_nv ed_fsp_12of20_.ff_tan_b1_nv ed_fsp_12of20_.ff_tev_b1_nv ed_fsp_12of20_.ff_time_ml_nv ed_fsp_12of20_.ff_tmot_nv ed_fsp_12of20_.ff_tumg_nv ed_fsp_12of20_.ff_tz1_nv ed_fsp_12of20_.ff_ub_nv ed_fsp_12of20_.ff_v_vorne_nv ed_fsp_12of20_.haeufigkeitszaehler_nv ed_fsp_12of20_.inj_fehlerzaehler_nv ed_fsp_12of20_.logistikzaehler_nv ed_fsp_12of20_.mil_filter_nv ed_fsp_12of20_.mil_filter_scdn_nv ed_fsp_12of20_.scdn_nenner_nv ed_fsp_12of20_.scdn_zaehler_nv ed_fsp_12of20_.uw_satz_1of3_.uw_km_stand_nv ed_fsp_12of20_.uw_satz_1of3_.uw_wert_nv_1of4_ ed_fsp_12of20_.uw_satz_1of3_.uw_wert_nv_2of4_ ed_fsp_12of20_.uw_satz_1of3_.uw_wert_nv_3of4_ ed_fsp_12of20_.uw_satz_1of3_.uw_wert_nv_4of4_ ed_fsp_12of20_.uw_satz_2of3_.uw_km_stand_nv ed_fsp_12of20_.uw_satz_2of3_.uw_wert_nv_1of4_ ed_fsp_12of20_.uw_satz_2of3_.uw_wert_nv_2of4_ ed_fsp_12of20_.uw_satz_2of3_.uw_wert_nv_3of4_ ed_fsp_12of20_.uw_satz_2of3_.uw_wert_nv_4of4_ ed_fsp_12of20_.uw_satz_3of3_.uw_km_stand_nv ed_fsp_12of20_.uw_satz_3of3_.uw_wert_nv_1of4_ ed_fsp_12of20_.uw_satz_3of3_.uw_wert_nv_2of4_ ed_fsp_12of20_.uw_satz_3of3_.uw_wert_nv_3of4_ ed_fsp_12of20_.uw_satz_3of3_.uw_wert_nv_4of4_ ed_fsp_13of20_.ed_fil_index_nv ed_fsp_13of20_.fehlerart_nv ed_fsp_13of20_.fehlercode_nv ed_fsp_13of20_.ff_egas_abs_dk_b1_nv ed_fsp_13of20_.ff_egas_ist_dk_b1_nv ed_fsp_13of20_.ff_egas_soll_dk_b1_nv ed_fsp_13of20_.ff_fst_nv ed_fsp_13of20_.ff_laa_f_ber_b1_nv ed_fsp_13of20_.ff_laa_f_ber_b2_nv ed_fsp_13of20_.ff_lam_reg_b1_nv ed_fsp_13of20_.ff_lam_reg_b2_nv ed_fsp_13of20_.ff_lam_reg_f_b1_nv ed_fsp_13of20_.ff_lam_reg_f_b2_nv ed_fsp_13of20_.ff_lam_soll_b1_nv ed_fsp_13of20_.ff_ml_b1_nv ed_fsp_13of20_.ff_n_nv ed_fsp_13of20_.ff_p_code_nv ed_fsp_13of20_.ff_pks_ist_nv ed_fsp_13of20_.ff_pumg_nv ed_fsp_13of20_.ff_pwg1_abs_roh_nv ed_fsp_13of20_.ff_pwg2_abs_roh_nv ed_fsp_13of20_.ff_rf_b1_berech_nv ed_fsp_13of20_.ff_rf_b1_nv ed_fsp_13of20_.ff_sl_st_nv ed_fsp_13of20_.ff_tan_b1_nv ed_fsp_13of20_.ff_tev_b1_nv ed_fsp_13of20_.ff_time_ml_nv ed_fsp_13of20_.ff_tmot_nv ed_fsp_13of20_.ff_tumg_nv ed_fsp_13of20_.ff_tz1_nv ed_fsp_13of20_.ff_ub_nv ed_fsp_13of20_.ff_v_vorne_nv ed_fsp_13of20_.haeufigkeitszaehler_nv ed_fsp_13of20_.inj_fehlerzaehler_nv ed_fsp_13of20_.logistikzaehler_nv ed_fsp_13of20_.mil_filter_nv ed_fsp_13of20_.mil_filter_scdn_nv ed_fsp_13of20_.scdn_nenner_nv ed_fsp_13of20_.scdn_zaehler_nv ed_fsp_13of20_.uw_satz_1of3_.uw_km_stand_nv ed_fsp_13of20_.uw_satz_1of3_.uw_wert_nv_1of4_ ed_fsp_13of20_.uw_satz_1of3_.uw_wert_nv_2of4_ ed_fsp_13of20_.uw_satz_1of3_.uw_wert_nv_3of4_ ed_fsp_13of20_.uw_satz_1of3_.uw_wert_nv_4of4_ ed_fsp_13of20_.uw_satz_2of3_.uw_km_stand_nv ed_fsp_13of20_.uw_satz_2of3_.uw_wert_nv_1of4_ ed_fsp_13of20_.uw_satz_2of3_.uw_wert_nv_2of4_ ed_fsp_13of20_.uw_satz_2of3_.uw_wert_nv_3of4_ ed_fsp_13of20_.uw_satz_2of3_.uw_wert_nv_4of4_ ed_fsp_13of20_.uw_satz_3of3_.uw_km_stand_nv ed_fsp_13of20_.uw_satz_3of3_.uw_wert_nv_1of4_ ed_fsp_13of20_.uw_satz_3of3_.uw_wert_nv_2of4_ ed_fsp_13of20_.uw_satz_3of3_.uw_wert_nv_3of4_ ed_fsp_13of20_.uw_satz_3of3_.uw_wert_nv_4of4_ ed_fsp_14of20_.ed_fil_index_nv ed_fsp_14of20_.fehlerart_nv ed_fsp_14of20_.fehlercode_nv ed_fsp_14of20_.ff_egas_abs_dk_b1_nv ed_fsp_14of20_.ff_egas_ist_dk_b1_nv ed_fsp_14of20_.ff_egas_soll_dk_b1_nv ed_fsp_14of20_.ff_fst_nv ed_fsp_14of20_.ff_laa_f_ber_b1_nv ed_fsp_14of20_.ff_laa_f_ber_b2_nv ed_fsp_14of20_.ff_lam_reg_b1_nv ed_fsp_14of20_.ff_lam_reg_b2_nv ed_fsp_14of20_.ff_lam_reg_f_b1_nv ed_fsp_14of20_.ff_lam_reg_f_b2_nv ed_fsp_14of20_.ff_lam_soll_b1_nv ed_fsp_14of20_.ff_ml_b1_nv ed_fsp_14of20_.ff_n_nv ed_fsp_14of20_.ff_p_code_nv ed_fsp_14of20_.ff_pks_ist_nv ed_fsp_14of20_.ff_pumg_nv /end OUT_MEASUREMENT
/end FUNCTION
/end MODULE
/end PROJECT
