/begin PROJECT MSS65-inj-V452 "MSS65 INJ - V452.01-B204.00, data set 0569Q60Z160E"
/begin HEADER "" VERSION "V452.01-B204.00" /end HEADER
/begin MODULE _MSS65-inj "MSS65 INJ - V452.01-B204.00, calibration xxxxxxxx"
/begin MOD_COMMON "" BYTE_ORDER MSB_FIRST /* Default byteorder (Motorola) */ /end MOD_COMMON
/* ------------------ Abschnitt erzeugt aus adapt_common.dat ------------------ */
/begin COMPU_METHOD FORMULA_0000 "FORMULA_0000" RAT_FUNC "%7.0" "-" COEFFS 0 1 0 0 0 1 /end COMPU_METHOD
/begin COMPU_METHOD FORMULA_0003 "FORMULA_0003" RAT_FUNC "%3.0" "-" COEFFS 0 1 0 0 0 1 /end COMPU_METHOD
/begin COMPU_METHOD FORMULA_0006 "FORMULA_0006" RAT_FUNC "%5.0" "Upm" COEFFS 0 1 0 0 0 1 /end COMPU_METHOD
/begin COMPU_METHOD FORMULA_0007 "FORMULA_0007" RAT_FUNC "%8.3" "-" COEFFS 0 10000 0 0 0 1 /end COMPU_METHOD
/begin COMPU_METHOD FORMULA_0008 "FORMULA_0008" RAT_FUNC "%6.1" "V" COEFFS 0 10 0 0 0 1 /end COMPU_METHOD
/begin COMPU_METHOD FORMULA_0010 "FORMULA_0010" RAT_FUNC "%5.0" "-" COEFFS 0 1 0 0 0 1 /end COMPU_METHOD
/begin COMPU_METHOD FORMULA_0021 "FORMULA_0021" RAT_FUNC "%7.2" "s" COEFFS 0 100 0 0 0 1 /end COMPU_METHOD
/* ------------------ Abschnitt erzeugt aus adapt_glob.dat ------------------ */
/begin COMPU_METHOD FORMULA_0023 "FORMULA_0023" RAT_FUNC "%6.1" "�C" COEFFS 0 10 2732 0 0 1 /end COMPU_METHOD
/begin COMPU_METHOD FORMULA_0024 "FORMULA_0024" RAT_FUNC "%9.4" "-" COEFFS 0 32768 0 0 0 1 /end COMPU_METHOD
/begin COMPU_METHOD FORMULA_0025 "FORMULA_0025" RAT_FUNC "%8.3" "-" COEFFS 0 16384 0 0 0 1 /end COMPU_METHOD
/begin COMPU_METHOD FORMULA_0032 "FORMULA_0032" RAT_FUNC "%3.0" "%" COEFFS 0 1 0 0 0 1 /end COMPU_METHOD
/* ------------------ Abschnitt erzeugt aus debug.dat ------------------ */
/begin COMPU_METHOD FORMULA_0041 "FORMULA_0041" RAT_FUNC "%9.2" "-" COEFFS 0 1 0 0 0 1 /end COMPU_METHOD
/begin COMPU_METHOD FORMULA_0062 "FORMULA_0062" RAT_FUNC "%5.0" "s" COEFFS 0 1 0 0 0 1 /end COMPU_METHOD
/begin COMPU_METHOD FORMULA_0073 "FORMULA_0073" RAT_FUNC "%6.1" "s" COEFFS 0 10 0 0 0 1 /end COMPU_METHOD
/begin COMPU_METHOD FORMULA_0075 "FORMULA_0075" RAT_FUNC "%8.3" "-" COEFFS 0 1024 0 0 0 1 /end COMPU_METHOD
/begin COMPU_METHOD FORMULA_0076 "FORMULA_0076" RAT_FUNC "%6.1" "Kelvin" COEFFS 0 10 0 0 0 1 /end COMPU_METHOD
/begin COMPU_METHOD FORMULA_0077 "FORMULA_0077" RAT_FUNC "%6.1" "mbar" COEFFS 0 16 0 0 0 1 /end COMPU_METHOD
/begin COMPU_METHOD FORMULA_0078 "FORMULA_0078" RAT_FUNC "%6.1" "km/h" COEFFS 0 16 0 0 0 1 /end COMPU_METHOD
/* ------------------ Abschnitt erzeugt aus glob.dat ------------------ */
/begin COMPU_METHOD FORMULA_0083 "FORMULA_0083" RAT_FUNC "%7.2" "-" COEFFS 0 1 0 0 0 1 /end COMPU_METHOD
/begin COMPU_METHOD FORMULA_0093 "FORMULA_0093" RAT_FUNC "%7.2" "mg" COEFFS 0 10 0 0 0 1 /end COMPU_METHOD
/begin COMPU_METHOD FORMULA_0111 "FORMULA_0111" RAT_FUNC "%6.1" "�KW" COEFFS 0 10 0 0 0 1 /end COMPU_METHOD
/begin COMPU_METHOD FORMULA_0115 "FORMULA_0115" RAT_FUNC "%7.2" "%" COEFFS 0 16384 0 0 0 100 /end COMPU_METHOD
/begin COMPU_METHOD FORMULA_0118 "FORMULA_0118" RAT_FUNC "%8.3" "bar" COEFFS 0 1000 0 0 0 1 /end COMPU_METHOD
/begin COMPU_METHOD FORMULA_0121 "FORMULA_0121" RAT_FUNC "%7.2" "Nm" COEFFS 0 10 0 0 0 1 /end COMPU_METHOD
/begin COMPU_METHOD FORMULA_0123 "FORMULA_0123" RAT_FUNC "%5.0" "digit" COEFFS 0 1 0 0 0 1 /end COMPU_METHOD
/begin COMPU_METHOD FORMULA_0147 "FORMULA_0147" RAT_FUNC "%6.1" "qmm" COEFFS 0 10 0 0 0 1 /end COMPU_METHOD
/begin COMPU_METHOD FORMULA_0148 "FORMULA_0148" RAT_FUNC "%8.3" "ml" COEFFS 0 1000 0 0 0 1 /end COMPU_METHOD
/begin COMPU_METHOD FORMULA_0317 "FORMULA_0317" RAT_FUNC "%5.2" "s" COEFFS 0 100 0 0 0 1 /end COMPU_METHOD
/* ------------------ Abschnitt erzeugt aus sc_glob.dat ------------------ */
/begin COMPU_METHOD FORMULA_0358 "FORMULA_0358" RAT_FUNC "%9.2" "ms" COEFFS 0 1000 0 0 0 1 /end COMPU_METHOD
/begin COMPU_METHOD FORMULA_0359 "FORMULA_0359" TAB_VERB "%5.2" "-" COMPU_TAB_REF FORMULA_0359_VTAB /end COMPU_METHOD
/begin COMPU_VTAB FORMULA_0359_VTAB "FORMULA_0359_VTAB" TAB_VERB 2 0 "WorkPage" 16 "RefPage" DEFAULT_VALUE "Err/RefP" /end COMPU_VTAB
/begin COMPU_METHOD FORMULA_0360 "FORMULA_0360" TAB_VERB "%5.2" "-" COMPU_TAB_REF FORMULA_0360_VTAB /end COMPU_METHOD
/begin COMPU_VTAB FORMULA_0360_VTAB "FORMULA_0360_VTAB" TAB_VERB 4 0 "idle" 1 "to WorkPage" 2 "to RefPage" 4 "ready" /end COMPU_VTAB
/begin COMPU_METHOD FORMULA_0361 "FORMULA_0361" TAB_VERB "%5.2" "-" COMPU_TAB_REF FORMULA_0361_VTAB /end COMPU_METHOD
/begin COMPU_VTAB FORMULA_0361_VTAB "FORMULA_0361_VTAB" TAB_VERB 3 0 "idle" 1 "loop" 2 "ready" /end COMPU_VTAB
/* ------------------ Abschnitt erzeugt aus dqlt.dat ------------------ */
/begin COMPU_METHOD FORMULA_0418 "FORMULA_0418" TAB_VERB "%5.2" "-" COMPU_TAB_REF FORMULA_0418_VTAB /end COMPU_METHOD
/begin COMPU_VTAB FORMULA_0418_VTAB "FORMULA_0418_VTAB" TAB_VERB 2 0 "FALSE" 1 "TRUE" DEFAULT_VALUE "TRUE" /end COMPU_VTAB
/begin COMPU_METHOD FORMULA_0419 "FORMULA_0419" TAB_VERB "%5.2" "-" COMPU_TAB_REF FORMULA_0419_VTAB /end COMPU_METHOD
/begin COMPU_VTAB FORMULA_0419_VTAB "FORMULA_0419_VTAB" TAB_VERB 2 0 "FALSE" 1 "TRUE" DEFAULT_VALUE "TRUE" /end COMPU_VTAB
/begin COMPU_METHOD FORMULA_0420 "FORMULA_0420" TAB_VERB "%5.2" "-" COMPU_TAB_REF FORMULA_0420_VTAB /end COMPU_METHOD
/begin COMPU_VTAB FORMULA_0420_VTAB "FORMULA_0420_VTAB" TAB_VERB 2 0 "FALSE" 1 "TRUE" DEFAULT_VALUE "TRUE" /end COMPU_VTAB
/begin COMPU_METHOD FORMULA_0421 "FORMULA_0421" TAB_VERB "%5.2" "-" COMPU_TAB_REF FORMULA_0421_VTAB /end COMPU_METHOD
/begin COMPU_VTAB FORMULA_0421_VTAB "FORMULA_0421_VTAB" TAB_VERB 2 0 "FALSE" 1 "TRUE" DEFAULT_VALUE "TRUE" /end COMPU_VTAB
/begin COMPU_METHOD FORMULA_0422 "FORMULA_0422" TAB_VERB "%5.2" "-" COMPU_TAB_REF FORMULA_0422_VTAB /end COMPU_METHOD
/begin COMPU_VTAB FORMULA_0422_VTAB "FORMULA_0422_VTAB" TAB_VERB 2 0 "FALSE" 1 "TRUE" DEFAULT_VALUE "TRUE" /end COMPU_VTAB
/begin COMPU_METHOD FORMULA_0423 "FORMULA_0423" TAB_VERB "%5.2" "-" COMPU_TAB_REF FORMULA_0423_VTAB /end COMPU_METHOD
/begin COMPU_VTAB FORMULA_0423_VTAB "FORMULA_0423_VTAB" TAB_VERB 2 0 "FALSE" 1 "TRUE" DEFAULT_VALUE "TRUE" /end COMPU_VTAB
/begin COMPU_METHOD FORMULA_0424 "FORMULA_0424" TAB_VERB "%5.2" "-" COMPU_TAB_REF FORMULA_0424_VTAB /end COMPU_METHOD
/begin COMPU_VTAB FORMULA_0424_VTAB "FORMULA_0424_VTAB" TAB_VERB 2 0 "FALSE" 1 "TRUE" DEFAULT_VALUE "TRUE" /end COMPU_VTAB
/begin COMPU_METHOD FORMULA_0425 "FORMULA_0425" TAB_VERB "%5.2" "-" COMPU_TAB_REF FORMULA_0425_VTAB /end COMPU_METHOD
/begin COMPU_VTAB FORMULA_0425_VTAB "FORMULA_0425_VTAB" TAB_VERB 2 0 "FALSE" 1 "TRUE" DEFAULT_VALUE "TRUE" /end COMPU_VTAB
/begin COMPU_METHOD FORMULA_0426 "FORMULA_0426" RAT_FUNC "%5.0" "�C" COEFFS 0 10 0 0 0 1 /end COMPU_METHOD
/begin COMPU_METHOD FORMULA_0432 "FORMULA_0432" RAT_FUNC "%5.0" "km" COEFFS 0 1 0 0 0 10 /end COMPU_METHOD
/begin COMPU_METHOD FORMULA_0433 "FORMULA_0433" RAT_FUNC "%7.2" "%" COEFFS 0 65536 0 0 0 100 /end COMPU_METHOD
/begin COMPU_METHOD FORMULA_0434 "FORMULA_0434" RAT_FUNC "%5.2" "-" COEFFS 0 256 0 0 0 1 /end COMPU_METHOD
/begin COMPU_METHOD FORMULA_0443 "FORMULA_0443" RAT_FUNC "%7.2" "�C" COEFFS 0 100 0 0 0 1 /end COMPU_METHOD
/begin COMPU_METHOD FORMULA_0447 "FORMULA_0447" RAT_FUNC "%5.2" "-" COEFFS 0 256 0 0 0 8 /end COMPU_METHOD
/begin COMPU_METHOD FORMULA_0453 "FORMULA_0453" RAT_FUNC "%9.4" "-" COEFFS 0 1024 0 0 0 1 /end COMPU_METHOD
/begin COMPU_METHOD FORMULA_0457 "FORMULA_0457" RAT_FUNC "%9.4" "-" COEFFS 0 65536 0 0 0 1 /end COMPU_METHOD
/* ------------------ Abschnitt erzeugt aus dgen.dat ------------------ */
/begin COMPU_METHOD FORMULA_0458 "FORMULA_0458" RAT_FUNC "%4.1" "s" COEFFS 0 10 0 0 0 1 /end COMPU_METHOD
/* ------------------ Abschnitt erzeugt aus imdgen_1pr.dat ------------------ */
/begin COMPU_METHOD FORMULA_0459 "FORMULA_0459" RAT_FUNC "%6.3" "" COEFFS 0 1 0 0 0 1 /end COMPU_METHOD
/begin COMPU_METHOD FORMULA_0460 "FORMULA_0460" RAT_FUNC "%6.3" "A" COEFFS 0 8 0 0 0 1 /end COMPU_METHOD
/begin COMPU_METHOD FORMULA_0461 "FORMULA_0461" RAT_FUNC "%5.2" "-" COEFFS 0 256 0 0 0 4 /end COMPU_METHOD
/begin COMPU_METHOD FORMULA_0462 "FORMULA_0462" RAT_FUNC "%8.3" "V" COEFFS 0 10 0 0 0 1 /end COMPU_METHOD
/begin COMPU_METHOD FORMULA_0463 "FORMULA_0463" RAT_FUNC "%9.2" "-" COEFFS 0 524288 0 0 0 1 /end COMPU_METHOD
/begin COMPU_METHOD FORMULA_0464 "FORMULA_0464" RAT_FUNC "%10.3" "" COEFFS 0 65536 0 0 0 2048 /end COMPU_METHOD
/begin COMPU_METHOD FORMULA_0465 "FORMULA_0465" RAT_FUNC "%8.3" "A" COEFFS 0 1 0 0 0 1 /end COMPU_METHOD
/begin COMPU_METHOD FORMULA_0466 "FORMULA_0466" RAT_FUNC "%7.2" "%" COEFFS 0 65536 0 0 0 2048 /end COMPU_METHOD
/begin COMPU_METHOD FORMULA_0467 "FORMULA_0467" RAT_FUNC "%7.2" "�C" COEFFS 0 1 0 0 0 0.75 /end COMPU_METHOD
/begin COMPU_METHOD FORMULA_0468 "FORMULA_0468" RAT_FUNC "%8.3" "-" COEFFS 0 2048 0 0 0 1 /end COMPU_METHOD
/begin COMPU_METHOD FORMULA_0469 "FORMULA_0469" RAT_FUNC "%8.3" "A" COEFFS 0 65536 0 0 0 2048 /end COMPU_METHOD
/begin COMPU_METHOD FORMULA_0470 "FORMULA_0470" RAT_FUNC "%5.0" "km/h" COEFFS 0 1 0 0 0 1 /end COMPU_METHOD
/begin COMPU_METHOD FORMULA_0471 "FORMULA_0471" RAT_FUNC "%5.2" "%" COEFFS 0 256 0 0 0 100 /end COMPU_METHOD
/begin COMPU_METHOD FORMULA_0472 "FORMULA_0472" RAT_FUNC "%5.2" "min" COEFFS 0 1 0 0 0 1 /end COMPU_METHOD
/begin COMPU_METHOD FORMULA_0473 "FORMULA_0473" RAT_FUNC "%5.2" "-" COEFFS 0 256 0 0 0 2 /end COMPU_METHOD
/begin COMPU_METHOD FORMULA_0474 "FORMULA_0474" RAT_FUNC "%4.1" "-" COEFFS 0 1 0 0 0 1 /end COMPU_METHOD
/* ------------------ Abschnitt erzeugt aus loadresp.dat ------------------ */
/begin COMPU_METHOD FORMULA_0475 "FORMULA_0475" RAT_FUNC "%7.2" "-" COEFFS 0 32768 0 0 0 100 /end COMPU_METHOD
/begin COMPU_METHOD FORMULA_0476 "FORMULA_0476" RAT_FUNC "%9.4" "%" COEFFS 0 100 0 0 0 1 /end COMPU_METHOD
/begin COMPU_METHOD FORMULA_0477 "FORMULA_0477" RAT_FUNC "%5.2" "sec" COEFFS 0 1 0 0 0 1 /end COMPU_METHOD
/begin COMPU_METHOD FORMULA_0529 "FORMULA_0529" RAT_FUNC "%7.2" "mg" COEFFS 0 4 0 0 0 1 /end COMPU_METHOD
/begin COMPU_METHOD FORMULA_0538 "FORMULA_0538" RAT_FUNC "%5.0" "ms" COEFFS 0 1 0 0 0 10 /end COMPU_METHOD
/begin COMPU_METHOD FORMULA_0539 "FORMULA_0539" RAT_FUNC "%5.0" "ms" COEFFS 0 1 0 0 0 100 /end COMPU_METHOD
/begin COMPU_METHOD FORMULA_0600 "FORMULA_0600" RAT_FUNC "%7.2" "min" COEFFS 0 60 0 0 0 1 /end COMPU_METHOD
/begin COMPU_METHOD FORMULA_0616 "FORMULA_0616" RAT_FUNC "%5.0" "km" COEFFS 0 1 0 0 0 1 /end COMPU_METHOD
/begin COMPU_METHOD FORMULA_0626 "FORMULA_0626" RAT_FUNC "%4.1" "%" COEFFS 0 10 0 0 0 1 /end COMPU_METHOD
/begin COMPU_METHOD FORMULA_0651 "FORMULA_0651" RAT_FUNC "%6.3" "s" COEFFS 0 0 1.28 0 1 0 /end COMPU_METHOD
/begin COMPU_METHOD FORMULA_0666 "FORMULA_0666" RAT_FUNC "%5.0" ".Gang" COEFFS 0 1 0 0 0 1 /end COMPU_METHOD
/* ------------------ Abschnitt erzeugt aus elu.dat ------------------ */
/begin COMPU_METHOD FORMULA_0670 "FORMULA_0670" TAB_VERB "%3.0" "-" COMPU_TAB_REF FORMULA_0670_VTAB /end COMPU_METHOD
/begin COMPU_VTAB FORMULA_0670_VTAB "FORMULA_0670_VTAB" TAB_VERB 3 0 "Ansteuerung inaktiv" 3 "Ansteuerung bei ML" 5 "Ansteuerung bei MS" DEFAULT_VALUE "undefiniert" /end COMPU_VTAB
/begin COMPU_METHOD FORMULA_0671 "FORMULA_0671" RAT_FUNC "%6.1" "%" COEFFS 0 512 0 0 0 1 /end COMPU_METHOD
/begin COMPU_METHOD FORMULA_0672 "FORMULA_0672" RAT_FUNC "%6.1" "ms" COEFFS 0 10 0 0 0 6 /end COMPU_METHOD
/begin COMPU_METHOD FORMULA_0673 "FORMULA_0673" TAB_VERB "%3.0" "-" COMPU_TAB_REF FORMULA_0673_VTAB /end COMPU_METHOD
/begin COMPU_VTAB FORMULA_0673_VTAB "FORMULA_0673_VTAB" TAB_VERB 7 0 "Adaption fehlt" 1 "Typ-Identifikation" 2 "Funktionssperre" 4 "Weckfunktion" 8 "Luefterbetrieb" 16 "Nachlaufanforderung" 32 "aus" DEFAULT_VALUE "undefiniert" /end COMPU_VTAB
/begin COMPU_METHOD FORMULA_0674 "FORMULA_0674" TAB_VERB "%3.0" "-" COMPU_TAB_REF FORMULA_0674_VTAB /end COMPU_METHOD
/begin COMPU_VTAB FORMULA_0674_VTAB "FORMULA_0674_VTAB" TAB_VERB 5 0 "NO_FEHLER" 1 "SH_TO_UB" 2 "SH_TO_GND" 4 "OPENLOAD" 8 "UNPLAUSIBEL" DEFAULT_VALUE "undefiniert" /end COMPU_VTAB
/begin COMPU_METHOD FORMULA_0675 "FORMULA_0675" TAB_VERB "%3.0" "-" COMPU_TAB_REF FORMULA_0675_VTAB /end COMPU_METHOD
/begin COMPU_VTAB FORMULA_0675_VTAB "FORMULA_0675_VTAB" TAB_VERB 4 0 "aut. Typerkennung" 1 "600W" 2 "850W" 128 "TEMIC DC 850W invers" DEFAULT_VALUE "undef" /end COMPU_VTAB
/begin COMPU_METHOD FORMULA_0676 "FORMULA_0676" RAT_FUNC "%7.2" "%/100ms" COEFFS 0 512 0 0 0 1 /end COMPU_METHOD
/begin COMPU_METHOD FORMULA_0677 "FORMULA_0677" RAT_FUNC "%6.3" "-" COEFFS 0 128 0 0 0 1 /end COMPU_METHOD
/begin COMPU_METHOD FORMULA_0683 "FORMULA_0683" RAT_FUNC "%5.2" "s" COEFFS 0 0 25.6 0 1 0 /end COMPU_METHOD
/* ------------------ Abschnitt erzeugt aus kva.dat ------------------ */
/begin COMPU_METHOD FORMULA_0746 "FORMULA_0746" RAT_FUNC "%6.1" "l/h" COEFFS 0 8 0 0 0 1 /end COMPU_METHOD
/begin COMPU_METHOD FORMULA_0747 "FORMULA_0747" RAT_FUNC "%9.4" "kg/l=mg/ul" COEFFS 0 8192 0 0 0 1 /end COMPU_METHOD
/begin COMPU_METHOD FORMULA_0752 "FORMULA_0752" RAT_FUNC "%7.2" "mg" COEFFS 0 64 0 0 0 1 /end COMPU_METHOD
/begin COMPU_METHOD FORMULA_0763 "FORMULA_0763" RAT_FUNC "%8.3" "-" COEFFS 0 8192 0 0 0 1 /end COMPU_METHOD
/begin COMPU_METHOD FORMULA_0768 "FORMULA_0768" TAB_VERB "%7.2" "-" COMPU_TAB_REF FORMULA_0768_VTAB /end COMPU_METHOD
/begin COMPU_VTAB FORMULA_0768_VTAB "FORMULA_0768_VTAB" TAB_VERB 1 0 "inaktiv" DEFAULT_VALUE "aktiv" /end COMPU_VTAB
/begin COMPU_METHOD FORMULA_0770 "FORMULA_0770" TAB_VERB "%7.2" "-" COMPU_TAB_REF FORMULA_0770_VTAB /end COMPU_METHOD
/begin COMPU_VTAB FORMULA_0770_VTAB "FORMULA_0770_VTAB" TAB_VERB 1 0 "inaktiv" DEFAULT_VALUE "aktiv" /end COMPU_VTAB
/begin COMPU_METHOD FORMULA_0771 "FORMULA_0771" TAB_VERB "%7.2" "-" COMPU_TAB_REF FORMULA_0771_VTAB /end COMPU_METHOD
/begin COMPU_VTAB FORMULA_0771_VTAB "FORMULA_0771_VTAB" TAB_VERB 1 0 "inaktiv" DEFAULT_VALUE "aktiv" /end COMPU_VTAB
/begin COMPU_METHOD FORMULA_0772 "FORMULA_0772" TAB_VERB "%7.2" "-" COMPU_TAB_REF FORMULA_0772_VTAB /end COMPU_METHOD
/begin COMPU_VTAB FORMULA_0772_VTAB "FORMULA_0772_VTAB" TAB_VERB 1 0 "inaktiv" DEFAULT_VALUE "aktiv" /end COMPU_VTAB
/begin COMPU_METHOD FORMULA_0786 "FORMULA_0786" RAT_FUNC "%7.2" "ms" COEFFS 0 1000 0 0 0 1 /end COMPU_METHOD
/begin COMPU_METHOD FORMULA_0805 "FORMULA_0805" RAT_FUNC "%7.2" "-" COEFFS 0 128 0 0 0 1 /end COMPU_METHOD
/begin COMPU_METHOD FORMULA_0827 "FORMULA_0827" TAB_VERB "%7.2" "-" COMPU_TAB_REF FORMULA_0827_VTAB /end COMPU_METHOD
/begin COMPU_VTAB FORMULA_0827_VTAB "FORMULA_0827_VTAB" TAB_VERB 1 0 "inaktiv" DEFAULT_VALUE "aktiv" /end COMPU_VTAB
/begin COMPU_METHOD FORMULA_0836 "FORMULA_0836" TAB_VERB "%7.2" "-" COMPU_TAB_REF FORMULA_0836_VTAB /end COMPU_METHOD
/begin COMPU_VTAB FORMULA_0836_VTAB "FORMULA_0836_VTAB" TAB_VERB 1 0 "inaktiv" DEFAULT_VALUE "aktiv" /end COMPU_VTAB
/begin COMPU_METHOD FORMULA_0852 "FORMULA_0852" TAB_VERB "%7.2" "-" COMPU_TAB_REF FORMULA_0852_VTAB /end COMPU_METHOD
/begin COMPU_VTAB FORMULA_0852_VTAB "FORMULA_0852_VTAB" TAB_VERB 1 0 "inaktiv" DEFAULT_VALUE "aktiv" /end COMPU_VTAB
/* ------------------ Abschnitt erzeugt aus la_trim.dat ------------------ */
/begin COMPU_METHOD FORMULA_0895 "FORMULA_0895" TAB_VERB "%7.2" "-" COMPU_TAB_REF FORMULA_0895_VTAB /end COMPU_METHOD
/begin COMPU_VTAB FORMULA_0895_VTAB "FORMULA_0895_VTAB" TAB_VERB 1 0 "inaktiv" DEFAULT_VALUE "aktiv" /end COMPU_VTAB
/begin COMPU_METHOD FORMULA_1011 "FORMULA_1011" TAB_VERB "%3.0" "-" COMPU_TAB_REF FORMULA_1011_VTAB /end COMPU_METHOD
/begin COMPU_VTAB FORMULA_1011_VTAB "FORMULA_1011_VTAB" TAB_VERB 2 0 "Speichern" 1 "Reset" DEFAULT_VALUE "undef" /end COMPU_VTAB
/begin COMPU_METHOD FORMULA_1030 "FORMULA_1030" RAT_FUNC "%7.2" "s" COEFFS 0 1000 0 0 0 1 /end COMPU_METHOD
/* ------------------ Abschnitt erzeugt aus tgetr.dat ------------------ */
/begin COMPU_METHOD FORMULA_1159 "FORMULA_1159" RAT_FUNC "%8.3" "�C" COEFFS 0 40 10926 0 0 1 /end COMPU_METHOD
/begin COMPU_METHOD FORMULA_1160 "FORMULA_1160" TAB_VERB "%3.0" "-" COMPU_TAB_REF FORMULA_1160_VTAB /end COMPU_METHOD
/begin COMPU_VTAB FORMULA_1160_VTAB "FORMULA_1160_VTAB" TAB_VERB 2 0 "Lampe aus" 1 "Lampe an" /end COMPU_VTAB
/begin COMPU_METHOD FORMULA_1161 "FORMULA_1161" RAT_FUNC "%8.3" "�C" COEFFS 0 40 0 0 0 1 /end COMPU_METHOD
/* ------------------ Abschnitt erzeugt aus ti.dat ------------------ */
/begin COMPU_METHOD FORMULA_1162 "FORMULA_1162" RAT_FUNC "%8.3" "mg/ms" COEFFS 0 1024 0 0 0 1 /end COMPU_METHOD
/begin COMPU_METHOD FORMULA_1163 "FORMULA_1163" RAT_FUNC "%7.2" "mg/ASP" COEFFS 0 32 0 0 0 1 /end COMPU_METHOD
/begin COMPU_METHOD FORMULA_1164 "FORMULA_1164" RAT_FUNC "%7.2" "m/s" COEFFS 0 10 0 0 0 1 /end COMPU_METHOD
/begin COMPU_METHOD FORMULA_1165 "FORMULA_1165" RAT_FUNC "%8.3" "m2/s2" COEFFS 0 40 0 0 0 1 /end COMPU_METHOD
/begin COMPU_METHOD FORMULA_1166 "FORMULA_1166" TAB_VERB "%7.2" "-" COMPU_TAB_REF FORMULA_1166_VTAB /end COMPU_METHOD
/begin COMPU_VTAB FORMULA_1166_VTAB "FORMULA_1166_VTAB" TAB_VERB 1 0 "inaktiv" DEFAULT_VALUE "aktiv" /end COMPU_VTAB
/begin COMPU_METHOD FORMULA_1167 "FORMULA_1167" RAT_FUNC "%5.0" "Segmente" COEFFS 0 1 0 0 0 1 /end COMPU_METHOD
/begin COMPU_METHOD FORMULA_1168 "FORMULA_1168" TAB_VERB "%7.2" "-" COMPU_TAB_REF FORMULA_1168_VTAB /end COMPU_METHOD
/begin COMPU_VTAB FORMULA_1168_VTAB "FORMULA_1168_VTAB" TAB_VERB 1 0 "no" DEFAULT_VALUE "yes" /end COMPU_VTAB
/begin COMPU_METHOD FORMULA_1169 "FORMULA_1169" TAB_VERB "%7.2" "-" COMPU_TAB_REF FORMULA_1169_VTAB /end COMPU_METHOD
/begin COMPU_VTAB FORMULA_1169_VTAB "FORMULA_1169_VTAB" TAB_VERB 1 0 "-" DEFAULT_VALUE "max" /end COMPU_VTAB
/begin COMPU_METHOD FORMULA_1170 "FORMULA_1170" TAB_VERB "%7.2" "-" COMPU_TAB_REF FORMULA_1170_VTAB /end COMPU_METHOD
/begin COMPU_VTAB FORMULA_1170_VTAB "FORMULA_1170_VTAB" TAB_VERB 1 0 "-" DEFAULT_VALUE "min" /end COMPU_VTAB
/begin COMPU_METHOD FORMULA_1171 "FORMULA_1171" RAT_FUNC "%5.0" "Zylinder" COEFFS 0 1 0 0 0 1 /end COMPU_METHOD
/begin COMPU_METHOD FORMULA_1172 "FORMULA_1172" TAB_VERB "%7.2" "-" COMPU_TAB_REF FORMULA_1172_VTAB /end COMPU_METHOD
/begin COMPU_VTAB FORMULA_1172_VTAB "FORMULA_1172_VTAB" TAB_VERB 2 0 "Einfluss" 1 "kein Einfluss" /end COMPU_VTAB
/begin COMPU_METHOD FORMULA_1173 "FORMULA_1173" TAB_VERB "%5.2" "-" COMPU_TAB_REF FORMULA_1173_VTAB /end COMPU_METHOD
/begin COMPU_VTAB FORMULA_1173_VTAB "FORMULA_1173_VTAB" TAB_VERB 2 0 "kein TE-Einfluss" 1 "mit TE-Einfluss" /end COMPU_VTAB
/begin COMPU_METHOD FORMULA_1174 "FORMULA_1174" TAB_VERB "%5.2" "-" COMPU_TAB_REF FORMULA_1174_VTAB /end COMPU_METHOD
/begin COMPU_VTAB FORMULA_1174_VTAB "FORMULA_1174_VTAB" TAB_VERB 2 0 "kein OELV-Einfluss" 1 "mit OELV-Einfluss" /end COMPU_VTAB
/begin COMPU_METHOD FORMULA_1175 "FORMULA_1175" TAB_VERB "%5.2" "-" COMPU_TAB_REF FORMULA_1175_VTAB /end COMPU_METHOD
/begin COMPU_VTAB FORMULA_1175_VTAB "FORMULA_1175_VTAB" TAB_VERB 2 0 "kein LWV-Einfluss" 1 "mit LWV-Einfluss" /end COMPU_VTAB
/begin COMPU_METHOD FORMULA_1176 "FORMULA_1176" TAB_VERB "%5.2" "-" COMPU_TAB_REF FORMULA_1176_VTAB /end COMPU_METHOD
/begin COMPU_VTAB FORMULA_1176_VTAB "FORMULA_1176_VTAB" TAB_VERB 2 0 "mks_start" 1 "mks_grund" /end COMPU_VTAB
/begin COMPU_METHOD FORMULA_1177 "FORMULA_1177" TAB_VERB "%5.2" "-" COMPU_TAB_REF FORMULA_1177_VTAB /end COMPU_METHOD
/begin COMPU_VTAB FORMULA_1177_VTAB "FORMULA_1177_VTAB" TAB_VERB 2 0 "kein Einfluss" 1 "mit START-Einfluss" /end COMPU_VTAB
/begin COMPU_METHOD FORMULA_1178 "FORMULA_1178" TAB_VERB "%5.2" "-" COMPU_TAB_REF FORMULA_1178_VTAB /end COMPU_METHOD
/begin COMPU_VTAB FORMULA_1178_VTAB "FORMULA_1178_VTAB" TAB_VERB 2 0 "ohne AQ-Einfluss" 1 "mit AQ-Einfluss" /end COMPU_VTAB
/begin COMPU_METHOD FORMULA_1179 "FORMULA_1179" RAT_FUNC "%7.2" "mm2" COEFFS 0 10 0 0 0 1 /end COMPU_METHOD
/begin COMPU_METHOD FORMULA_1180 "FORMULA_1180" RAT_FUNC "%7.2" "mm" COEFFS 0 10 0 0 0 1 /end COMPU_METHOD
/begin COMPU_METHOD FORMULA_1181 "FORMULA_1181" RAT_FUNC "%7.2" "kg/dm3" COEFFS 0 100 0 0 0 1 /end COMPU_METHOD
/begin COMPU_METHOD FORMULA_1182 "FORMULA_1182" RAT_FUNC "%9.4" "m" COEFFS 0 16384 0 0 0 1 /end COMPU_METHOD
/begin COMPU_METHOD FORMULA_1183 "FORMULA_1183" TAB_VERB "%5.2" "-" COMPU_TAB_REF FORMULA_1183_VTAB /end COMPU_METHOD
/begin COMPU_VTAB FORMULA_1183_VTAB "FORMULA_1183_VTAB" TAB_VERB 2 0 "lam_ist" 1 "lam_ist_seg" /end COMPU_VTAB
/begin COMPU_METHOD FORMULA_1184 "FORMULA_1184" RAT_FUNC "%8.3" "ms" COEFFS 0 1000 0 0 0 32 /end COMPU_METHOD
/begin COMPU_METHOD FORMULA_1185 "FORMULA_1185" TAB_VERB "%5.2" "-" COMPU_TAB_REF FORMULA_1185_VTAB /end COMPU_METHOD
/begin COMPU_VTAB FORMULA_1185_VTAB "FORMULA_1185_VTAB" TAB_VERB 2 0 "keine Adaption" 1 "Adaption" /end COMPU_VTAB
/begin COMPU_METHOD FORMULA_1186 "FORMULA_1186" TAB_VERB "%5.2" "-" COMPU_TAB_REF FORMULA_1186_VTAB /end COMPU_METHOD
/begin COMPU_VTAB FORMULA_1186_VTAB "FORMULA_1186_VTAB" TAB_VERB 2 0 "-" 1 "RESET" /end COMPU_VTAB
/begin COMPU_METHOD FORMULA_1187 "FORMULA_1187" RAT_FUNC "%5.0" "-" COEFFS 0 -1 1 0 0 -1 /end COMPU_METHOD
/begin COMPU_METHOD FORMULA_1188 "FORMULA_1188" RAT_FUNC "%5.0" "-" COEFFS 0 10 0 0 0 1 /end COMPU_METHOD
/* ------------------ Abschnitt erzeugt aus vfz.dat ------------------ */
/begin COMPU_METHOD FORMULA_1229 "FORMULA_1229" TAB_VERB "%3.0" "-" COMPU_TAB_REF FORMULA_1229_VTAB /end COMPU_METHOD
/begin COMPU_VTAB FORMULA_1229_VTAB "FORMULA_1229_VTAB" TAB_VERB 2 0 "v_direkt" 1 "v_CAN" DEFAULT_VALUE "undef" /end COMPU_VTAB
/begin COMPU_METHOD FORMULA_1230 "FORMULA_1230" TAB_VERB "%5.2" "-" COMPU_TAB_REF FORMULA_1230_VTAB /end COMPU_METHOD
/begin COMPU_VTAB FORMULA_1230_VTAB "FORMULA_1230_VTAB" TAB_VERB 2 0 "Inaktiv" 1 "Aktiv" DEFAULT_VALUE "undef" /end COMPU_VTAB
/* ------------------ Abschnitt erzeugt aus sc_glob.dat ------------------ */
/begin CHARACTERISTIC K_DIAGNOSE_INDEX_LO "Diagnoseindex | EN: Diagnostic index" VALUE 0x7024C TKW_VV_VV_UB 100.0 FORMULA_0003 0.0 255.0000 /end CHARACTERISTIC
/begin CHARACTERISTIC K_DIAGNOSE_INDEX_HI "Diagnoseindex | EN: Diagnostic index" VALUE 0x7024B TKW_VV_VV_UB 100.0 FORMULA_0003 0.0 255.0000 /end CHARACTERISTIC
/begin MEASUREMENT tm_Sync1.netTime "Netozeit" ULONG FORMULA_0358 0 0 0.0 1000.0000 ECU_ADDRESS 0x3F8EE0 /end MEASUREMENT
/begin MEASUREMENT tm_Sync1.maxTime "Maxzeit" ULONG FORMULA_0358 0 0 0.0 1000.0000 ECU_ADDRESS 0x3F8EE8 /end MEASUREMENT
/begin MEASUREMENT tm_Sync1.dT "Maxzeit" ULONG FORMULA_0358 0 0 0.0 1000.0000 ECU_ADDRESS 0x3F8EEC /end MEASUREMENT
/begin MEASUREMENT tm_Sync1.lastTask "vorherige Task" ULONG FORMULA_0000 0 0 0.0 1000.0000 ECU_ADDRESS 0x3F8EF0 /end MEASUREMENT
/begin MEASUREMENT tm_Sync2.netTime "Netozeit" ULONG FORMULA_0358 0 0 0.0 1000.0000 ECU_ADDRESS 0x3F8F08 /end MEASUREMENT
/begin MEASUREMENT tm_Sync2.maxTime "Maxzeit" ULONG FORMULA_0358 0 0 0.0 1000.0000 ECU_ADDRESS 0x3F8F10 /end MEASUREMENT
/begin MEASUREMENT tm_Sync2.dT "Maxzeit" ULONG FORMULA_0358 0 0 0.0 1000.0000 ECU_ADDRESS 0x3F8F14 /end MEASUREMENT
/begin MEASUREMENT tm_Sync2.lastTask "vorherige Task" ULONG FORMULA_0000 0 0 0.0 1000.0000 ECU_ADDRESS 0x3F8F18 /end MEASUREMENT
/begin MEASUREMENT tm_5ms.netTime "Netozeit" ULONG FORMULA_0358 0 0 0.0 1000.0000 ECU_ADDRESS 0x3F8F80 /end MEASUREMENT
/begin MEASUREMENT tm_5ms.maxTime "Maxzeit" ULONG FORMULA_0358 0 0 0.0 1000.0000 ECU_ADDRESS 0x3F8F88 /end MEASUREMENT
/begin MEASUREMENT tm_5ms.dT "Maxzeit" ULONG FORMULA_0358 0 0 0.0 1000.0000 ECU_ADDRESS 0x3F8F8C /end MEASUREMENT
/begin MEASUREMENT tm_5ms.lastTask "vorherige Task" ULONG FORMULA_0000 0 0 0.0 1000.0000 ECU_ADDRESS 0x3F8F90 /end MEASUREMENT
/begin MEASUREMENT tm_10ms.netTime "Netozeit" ULONG FORMULA_0358 0 0 0.0 1000.0000 ECU_ADDRESS 0x3F8FA8 /end MEASUREMENT
/begin MEASUREMENT tm_10ms.maxTime "Maxzeit" ULONG FORMULA_0358 0 0 0.0 1000.0000 ECU_ADDRESS 0x3F8FB0 /end MEASUREMENT
/begin MEASUREMENT tm_10ms.dT "Maxzeit" ULONG FORMULA_0358 0 0 0.0 1000.0000 ECU_ADDRESS 0x3F8FB4 /end MEASUREMENT
/begin MEASUREMENT tm_10ms.lastTask "vorherige Task" ULONG FORMULA_0000 0 0 0.0 1000.0000 ECU_ADDRESS 0x3F8FB8 /end MEASUREMENT
/begin MEASUREMENT tm_100ms.netTime "Netozeit" ULONG FORMULA_0358 0 0 0.0 1000.0000 ECU_ADDRESS 0x3F8FD0 /end MEASUREMENT
/begin MEASUREMENT tm_100ms.maxTime "Maxzeit" ULONG FORMULA_0358 0 0 0.0 1000.0000 ECU_ADDRESS 0x3F8FD8 /end MEASUREMENT
/begin MEASUREMENT tm_100ms.dT "Maxzeit" ULONG FORMULA_0358 0 0 0.0 1000.0000 ECU_ADDRESS 0x3F8FDC /end MEASUREMENT
/begin MEASUREMENT tm_100ms.lastTask "vorherige Task" ULONG FORMULA_0000 0 0 0.0 1000.0000 ECU_ADDRESS 0x3F8FE0 /end MEASUREMENT
/begin MEASUREMENT tm_bgnd.grossRunTime "grossRunTime" ULONG FORMULA_0358 0 0 0.0 1000.0000 ECU_ADDRESS 0x3F901C /end MEASUREMENT
/begin MEASUREMENT tm_bgnd.netTime "Netozeit" ULONG FORMULA_0358 0 0 0.0 1000.0000 ECU_ADDRESS 0x3F9020 /end MEASUREMENT
/begin MEASUREMENT tm_bgnd.maxTime "Maxzeit" ULONG FORMULA_0358 0 0 0.0 1000.0000 ECU_ADDRESS 0x3F9028 /end MEASUREMENT
/begin MEASUREMENT tm_bgnd.dT "Maxzeit" ULONG FORMULA_0358 0 0 0.0 1000.0000 ECU_ADDRESS 0x3F902C /end MEASUREMENT
/begin MEASUREMENT tm_bgnd.lastTask "vorherige Task" ULONG FORMULA_0000 0 0 0.0 1000.0000 ECU_ADDRESS 0x3F9030 /end MEASUREMENT
/begin MEASUREMENT stack_status "Stackstatus" ULONG FORMULA_0000 0 0 0.0 1000.0000 ECU_ADDRESS 0x3F9174 /end MEASUREMENT
/begin MEASUREMENT stack_usedUser "Userstack" ULONG FORMULA_0000 0 0 0.0 1000.0000 ECU_ADDRESS 0x3F9178 /end MEASUREMENT
/begin MEASUREMENT stack_usedErcosek "Ercosekstack" ULONG FORMULA_0000 0 0 0.0 1000.0000 ECU_ADDRESS 0x3F917C /end MEASUREMENT
/begin MEASUREMENT ccp_aramStatus "CCP RAM-Status" UBYTE FORMULA_0359 0 0 0.0 255.0 ECU_ADDRESS 0x3FB2AC /end MEASUREMENT
/begin MEASUREMENT ccp_reqSwitch "CCP Umschalt-Status" UBYTE FORMULA_0360 0 0 0.0 255.0 ECU_ADDRESS 0x3FB2AD /end MEASUREMENT
/begin MEASUREMENT ccp_moveStatus "CCP Move-Status" UBYTE FORMULA_0361 0 0 0.0 255.0 ECU_ADDRESS 0x3FB2D0 /end MEASUREMENT
/begin MEASUREMENT ccp_stateChecksum "CCP ChkSum-Status" UBYTE FORMULA_0361 0 0 0.0 255.0 ECU_ADDRESS 0x3FB2C0 /end MEASUREMENT
/begin MEASUREMENT ccp_checksum "CCP ChkSum" UWORD FORMULA_0010 0 0 0.0 65535.0000 ECU_ADDRESS 0x3FB2C4 /end MEASUREMENT
/* ------------------ Abschnitt erzeugt aus dgen.dat ------------------ */
/begin CHARACTERISTIC K_GEN_DNMIN "Motordrehzahlschwelle  f�r Auswertung der Generatorfehler" VALUE 0x70796 TKW_VV_VV_SW 100.0 FORMULA_0006 -32768.0000 32767.0000 /end CHARACTERISTIC
/begin CHARACTERISTIC K_SNMBSDKL61 "" VALUE 0x70798 TKW_VV_VV_SW 100.0 FORMULA_0006 -32768.0000 32767.0000 /end CHARACTERISTIC
/begin CHARACTERISTIC K_GENPDTIME "Predrivetime f�r Ladekontrollampe KL61 | EN: Predrivetime für Ladekontrollampe KL61" VALUE 0x7079A TKW_VV_VV_UB 100.0 FORMULA_0458 0.0 25.5000 /end CHARACTERISTIC
/begin CHARACTERISTIC K_MSKGENDFP "Bitmaske Generator Fehler-> DFP" VALUE 0x7079B TKW_VV_VV_UB 100.0 FORMULA_0003 0.0 255.0000 /end CHARACTERISTIC
/begin CHARACTERISTIC K_MSKGENKL61 "Bitmaske fuer Generatorfehler -> Ladekontrolle | EN: Hier könnte Ihr Langbezeichner stehen" VALUE 0x7079C TKW_VV_VV_UB 100.0 FORMULA_0003 0.0 255.0000 /end CHARACTERISTIC
/begin MEASUREMENT St_dgen0.B_1stbsder "" UBYTE FORMULA_0418 0 0 0.0 255.0 ECU_ADDRESS 0x3FBEAC BIT_MASK 0x1 /end MEASUREMENT
/begin MEASUREMENT St_dgen0.B_kl61 "Bedingung Ladekontroll Laempchen an" UBYTE FORMULA_0419 0 0 0.0 255.0 ECU_ADDRESS 0x3FBEAC BIT_MASK 0x2 /end MEASUREMENT
/begin MEASUREMENT St_dgen0.B_genfprl "Bedingung Generatorfehler entprellt" UBYTE FORMULA_0420 0 0 0.0 255.0 ECU_ADDRESS 0x3FBEAC BIT_MASK 0x4 /end MEASUREMENT
/begin MEASUREMENT St_dgen0.B_gfbsupak "Generator Typ unplausibel^aus Fehlerspeicher" UBYTE FORMULA_0421 0 0 0.0 255.0 ECU_ADDRESS 0x3FBEAC BIT_MASK 0x8 /end MEASUREMENT
/begin MEASUREMENT St_dgen0.B_gfelak "Generatorfehler elektrisch aus Fehlerspeicher" UBYTE FORMULA_0422 0 0 0.0 255.0 ECU_ADDRESS 0x3FBEAC BIT_MASK 0x10 /end MEASUREMENT
/begin MEASUREMENT St_dgen0.B_gfhtak "Generatorfehler Uebertemperatur aus Fehlerspeicher" UBYTE FORMULA_0423 0 0 0.0 255.0 ECU_ADDRESS 0x3FBEAC BIT_MASK 0x20 /end MEASUREMENT
/begin MEASUREMENT St_dgen0.B_gfmeak "Generatorfehler mechanisch aus Fehlerspeicher" UBYTE FORMULA_0424 0 0 0.0 255.0 ECU_ADDRESS 0x3FBEAC BIT_MASK 0x40 /end MEASUREMENT
/begin MEASUREMENT St_dgen0.B_gfnobsak "Generator BSD Kommunikationsverlust aus Fehlerspeicher" UBYTE FORMULA_0425 0 0 0.0 255.0 ECU_ADDRESS 0x3FBEAC BIT_MASK 0x80 /end MEASUREMENT
/begin MEASUREMENT St_dgen0 "Statuswort" UBYTE FORMULA_0003 0 0 0.0 255.0000 ECU_ADDRESS 0x3FBEAC /end MEASUREMENT
/begin MEASUREMENT St_gen "Generatorstatus" UBYTE FORMULA_0003 0 0 0.0 255.0000 ECU_ADDRESS 0x3FBEAD /end MEASUREMENT
/begin MEASUREMENT St_genbsd "" UWORD FORMULA_0010 0 0 0.0 65535.0000 ECU_ADDRESS 0x3FAB5E /end MEASUREMENT
/begin MEASUREMENT St_gengen "" UWORD FORMULA_0010 0 0 0.0 65535.0000 ECU_ADDRESS 0x3FAB60 /end MEASUREMENT
/begin MEASUREMENT Gen_fbsak "BSD Uebertragungsfehler kodiert fuer FSPVDGEN" UBYTE FORMULA_0003 0 0 0.0 255.0000 ECU_ADDRESS 0x3FAB62 /end MEASUREMENT
/begin MEASUREMENT Gen_statroh "Generatorfehler kodiert fuer FSPVDGEN" UBYTE FORMULA_0003 0 0 0.0 255.0000 ECU_ADDRESS 0x3FAB63 /end MEASUREMENT
/* ------------------ Abschnitt erzeugt aus imdgen_1pr.dat ------------------ */
/begin CHARACTERISTIC K_GENUEBSETZ1 "Generatoruebersetzung1" VALUE 0x724CE TKW_VV_VV_UB 100.0 FORMULA_0461 0.0 3.9843 /end CHARACTERISTIC
/begin CHARACTERISTIC K_GENUEBSETZ2 "Generatoruebersetzung2" VALUE 0x724CF TKW_VV_VV_UB 100.0 FORMULA_0461 0.0 3.9843 /end CHARACTERISTIC
/begin CHARACTERISTIC K_GENUEBSETZ3 "Generatoruebersetzung3" VALUE 0x724D0 TKW_VV_VV_UB 100.0 FORMULA_0461 0.0 3.9843 /end CHARACTERISTIC
/begin CHARACTERISTIC K_GENUEBSETZ4 "Generatoruebersetzung4" VALUE 0x724D1 TKW_VV_VV_UB 100.0 FORMULA_0461 0.0 3.9843 /end CHARACTERISTIC
/begin CHARACTERISTIC KF_IGENKA2 "Kaltkennfeld 2 Generator" MAP 0x724D2 TKF_SW_UW_UB 100.0 FORMULA_0459 0.0 255.0000 /begin AXIS_DESCR STD_AXIS U_gen FORMULA_0462 7 0.0 6553.5000 FORMAT "%6.3" /end AXIS_DESCR /begin AXIS_DESCR STD_AXIS N_gen FORMULA_0006 9 -32768.0000 32767.0000 /end AXIS_DESCR /end CHARACTERISTIC
/begin CHARACTERISTIC KF_IGENWA2 "Warmkennfeld 2 Generator" MAP 0x72534 TKF_SW_UB_UB 100.0 FORMULA_0459 0.0 255.0000 /begin AXIS_DESCR STD_AXIS Gen_i_kaltun FORMULA_0459 6 0.0 255.0000 /end AXIS_DESCR /begin AXIS_DESCR STD_AXIS Tgen_end FORMULA_0426 7 -3276.8000 3276.7000 /end AXIS_DESCR /end CHARACTERISTIC
/begin CHARACTERISTIC KF_IGENWA1 "Warmkennfeld 1 Generator" MAP 0x72574 TKF_SW_UB_UB 100.0 FORMULA_0459 0.0 255.0000 /begin AXIS_DESCR STD_AXIS Gen_i_kaltun FORMULA_0459 6 0.0 255.0000 /end AXIS_DESCR /begin AXIS_DESCR STD_AXIS Tgen_end FORMULA_0426 7 -3276.8000 3276.7000 /end AXIS_DESCR /end CHARACTERISTIC
/begin CHARACTERISTIC KF_IGENKA3 "Kaltkennfeld 3 Generator" MAP 0x725B4 TKF_SW_UW_UB 100.0 FORMULA_0459 0.0 255.0000 /begin AXIS_DESCR STD_AXIS U_gen FORMULA_0462 7 0.0 6553.5000 FORMAT "%6.3" /end AXIS_DESCR /begin AXIS_DESCR STD_AXIS N_gen FORMULA_0006 9 -32768.0000 32767.0000 /end AXIS_DESCR /end CHARACTERISTIC
/begin CHARACTERISTIC KF_IGENWA4 "Warmkennfeld 4 Generator" MAP 0x72616 TKF_SW_UB_UB 100.0 FORMULA_0459 0.0 255.0000 /begin AXIS_DESCR STD_AXIS Gen_i_kaltun FORMULA_0459 6 0.0 255.0000 /end AXIS_DESCR /begin AXIS_DESCR STD_AXIS Tgen_end FORMULA_0426 7 -3276.8000 3276.7000 /end AXIS_DESCR /end CHARACTERISTIC
/begin CHARACTERISTIC KF_IGENWA3 "Warmkennfeld  3 Generator" MAP 0x72656 TKF_SW_UB_UB 100.0 FORMULA_0459 0.0 255.0000 /begin AXIS_DESCR STD_AXIS Gen_i_kaltun FORMULA_0459 6 0.0 255.0000 /end AXIS_DESCR /begin AXIS_DESCR STD_AXIS Tgen_end FORMULA_0426 7 -3276.8000 3276.7000 /end AXIS_DESCR /end CHARACTERISTIC
/begin CHARACTERISTIC KF_IGENKA1 "Kaltkennfeld 1 Generator" MAP 0x72696 TKF_SW_UW_UB 100.0 FORMULA_0459 0.0 255.0000 /begin AXIS_DESCR STD_AXIS U_gen FORMULA_0462 7 0.0 6553.5000 FORMAT "%6.3" /end AXIS_DESCR /begin AXIS_DESCR STD_AXIS N_gen FORMULA_0006 9 -32768.0000 32767.0000 /end AXIS_DESCR /end CHARACTERISTIC
/begin CHARACTERISTIC KF_IGENKA4 "Kaltkennfeld 4 Generator" MAP 0x726F8 TKF_SW_UW_UB 100.0 FORMULA_0459 0.0 255.0000 /begin AXIS_DESCR STD_AXIS U_gen FORMULA_0462 7 0.0 6553.5000 FORMAT "%6.3" /end AXIS_DESCR /begin AXIS_DESCR STD_AXIS N_gen FORMULA_0006 9 -32768.0000 32767.0000 /end AXIS_DESCR /end CHARACTERISTIC
/begin CHARACTERISTIC K_ENGENTANS "Schwelle Motortemperatur fuer Freigabe Generaturansaugluft " VALUE 0x7275A TKW_VV_VV_SW 100.0 FORMULA_0426 -3276.8000 3276.7000 /end CHARACTERISTIC
/begin CHARACTERISTIC K_GENMDNMOF "Offset des Generatormoments" VALUE 0x7275C TKW_VV_VV_SW 100.0 FORMULA_0121 -3276.8000 3276.7000 FORMAT "%5.2" /end CHARACTERISTIC
/begin CHARACTERISTIC K_GENTEMPAPP "Geneeratortemperatur mauelle Vorgabe" VALUE 0x7275E TKW_VV_VV_SW 100.0 FORMULA_0426 -3276.8000 3276.7000 /end CHARACTERISTIC
/begin CHARACTERISTIC K_GENTMOTDT "" VALUE 0x72760 TKW_VV_VV_SW 100.0 FORMULA_0426 -3276.8000 3276.7000 /end CHARACTERISTIC
/begin CHARACTERISTIC K_GENTMOTOF1 "Offset Generatoransaugluft" VALUE 0x72762 TKW_VV_VV_SW 100.0 FORMULA_0426 -3276.8000 3276.7000 /end CHARACTERISTIC
/begin CHARACTERISTIC K_GENTMOTOF2 "Offset Generatoransaugluft" VALUE 0x72764 TKW_VV_VV_SW 100.0 FORMULA_0426 -3276.8000 3276.7000 /end CHARACTERISTIC
/begin CHARACTERISTIC K_GENTMOTOF3 "Offset Generatoransaugluft" VALUE 0x72766 TKW_VV_VV_SW 100.0 FORMULA_0426 -3276.8000 3276.7000 /end CHARACTERISTIC
/begin CHARACTERISTIC K_GENTMOTOF4 "Offset Generatoransaugluft" VALUE 0x72768 TKW_VV_VV_SW 100.0 FORMULA_0426 -3276.8000 3276.7000 /end CHARACTERISTIC
/begin CHARACTERISTIC K_GENRS0_1 "Generatorstatorwiderstand1 bei 25�" VALUE 0x7276A TKW_VV_VV_UW 100.0 FORMULA_0457 0.0 9.99984741210938e-1 FORMAT "%7.4" /end CHARACTERISTIC
/begin CHARACTERISTIC K_GENRS0_2 "Generatorstatorwiderstand2 bei 25�" VALUE 0x7276C TKW_VV_VV_UW 100.0 FORMULA_0457 0.0 9.99984741210938e-1 FORMAT "%7.4" /end CHARACTERISTIC
/begin CHARACTERISTIC K_GENRS0_3 "Generatorstatorwiderstand3 bei 25�" VALUE 0x7276E TKW_VV_VV_UW 100.0 FORMULA_0457 0.0 9.99984741210938e-1 FORMAT "%7.4" /end CHARACTERISTIC
/begin CHARACTERISTIC K_GENRS0_4 "Generatorstatorwiderstand4 bei 25�" VALUE 0x72770 TKW_VV_VV_UW 100.0 FORMULA_0457 0.0 9.99984741210938e-1 FORMAT "%7.4" /end CHARACTERISTIC
/begin CHARACTERISTIC K_GENVFZGSW "geschwindigkeitsabh�ngige Generatoransaugluftschwelle" VALUE 0x72772 TKW_VV_VV_UW 100.0 FORMULA_0470 0.0 65535.0000 /end CHARACTERISTIC
/begin CHARACTERISTIC K_GEN_IGOF "Offsetwert Generatorstrom" VALUE 0x72774 TKW_VV_VV_UW 100.0 FORMULA_0466 0.0 254.0000 FORMAT "%5.2" /end CHARACTERISTIC
/begin CHARACTERISTIC K_TSTFIL_IN "" VALUE 0x72776 TKW_VV_VV_UW 100.0 FORMULA_0467 0.0 49151.2500 FORMAT "%5.2" /end CHARACTERISTIC
/begin CHARACTERISTIC K_ZMGENIG "" VALUE 0x72778 TKW_VV_VV_UW 100.0 FORMULA_0457 0.0 9.99984741210938e-1 FORMAT "%7.4" /end CHARACTERISTIC
/begin CHARACTERISTIC K_ZMGENS0HZ1 "Zeitkonstante Generatorstator1 Aufheizung im Stand" VALUE 0x7277A TKW_VV_VV_UW 100.0 FORMULA_0457 0.0 9.99984741210938e-1 FORMAT "%7.4" /end CHARACTERISTIC
/begin CHARACTERISTIC K_ZMGENS0HZ2 "Zeitkonstante Generatorstator2 Aufheizung im Stand" VALUE 0x7277C TKW_VV_VV_UW 100.0 FORMULA_0457 0.0 9.99984741210938e-1 FORMAT "%7.4" /end CHARACTERISTIC
/begin CHARACTERISTIC K_ZMGENS0HZ3 "Zeitkonstante Generatorstator3 Aufheizung im Stand" VALUE 0x7277E TKW_VV_VV_UW 100.0 FORMULA_0457 0.0 9.99984741210938e-1 FORMAT "%7.4" /end CHARACTERISTIC
/begin CHARACTERISTIC K_ZMGENS0HZ4 "Zeitkonstante Generatorstator4 Aufheizung im Stand" VALUE 0x72780 TKW_VV_VV_UW 100.0 FORMULA_0457 0.0 9.99984741210938e-1 FORMAT "%7.4" /end CHARACTERISTIC
/begin CHARACTERISTIC K_ZMGENS0KL1 "Zeitkonstante Abk�hlung Generator im Stand1" VALUE 0x72782 TKW_VV_VV_UW 100.0 FORMULA_0457 0.0 9.99984741210938e-1 FORMAT "%7.4" /end CHARACTERISTIC
/begin CHARACTERISTIC K_ZMGENS0KL2 "Zeitkonstante Abk�hlung Generator im Stand2" VALUE 0x72784 TKW_VV_VV_UW 100.0 FORMULA_0457 0.0 9.99984741210938e-1 FORMAT "%7.4" /end CHARACTERISTIC
/begin CHARACTERISTIC K_ZMGENS0KL3 "Zeitkonstante Abk�hlung Generator im Stand3" VALUE 0x72786 TKW_VV_VV_UW 100.0 FORMULA_0457 0.0 9.99984741210938e-1 FORMAT "%7.4" /end CHARACTERISTIC
/begin CHARACTERISTIC K_ZMGENS0KL4 "Zeitkonstante Abk�hlung Generator im Stand4" VALUE 0x72788 TKW_VV_VV_UW 100.0 FORMULA_0457 0.0 9.99984741210938e-1 FORMAT "%7.4" /end CHARACTERISTIC
/begin CHARACTERISTIC K_ZMGENSTHZ1 "Zeitkonstante Generatorstator1 Aufheizung" VALUE 0x7278A TKW_VV_VV_UW 100.0 FORMULA_0457 0.0 9.99984741210938e-1 FORMAT "%7.4" /end CHARACTERISTIC
/begin CHARACTERISTIC K_ZMGENSTHZ2 "Zeitkonstante Generatorstator2 Aufheizung" VALUE 0x7278C TKW_VV_VV_UW 100.0 FORMULA_0457 0.0 9.99984741210938e-1 FORMAT "%7.4" /end CHARACTERISTIC
/begin CHARACTERISTIC K_ZMGENSTHZ3 "Zeitkonstante Generatorstator3 Aufheizung" VALUE 0x7278E TKW_VV_VV_UW 100.0 FORMULA_0457 0.0 9.99984741210938e-1 FORMAT "%7.4" /end CHARACTERISTIC
/begin CHARACTERISTIC K_ZMGENSTHZ4 "Zeitkonstante Generatorstator4 Aufheizung" VALUE 0x72790 TKW_VV_VV_UW 100.0 FORMULA_0457 0.0 9.99984741210938e-1 FORMAT "%7.4" /end CHARACTERISTIC
/begin CHARACTERISTIC K_ZMGENSTKL1 "Zeitkonstante Abk�hlung Generator1" VALUE 0x72792 TKW_VV_VV_UW 100.0 FORMULA_0457 0.0 9.99984741210938e-1 FORMAT "%7.4" /end CHARACTERISTIC
/begin CHARACTERISTIC K_ZMGENSTKL2 "Zeitkonstante Abk�hlung Generator2" VALUE 0x72794 TKW_VV_VV_UW 100.0 FORMULA_0457 0.0 9.99984741210938e-1 FORMAT "%7.4" /end CHARACTERISTIC
/begin CHARACTERISTIC K_ZMGENSTKL3 "Zeitkonstante Abk�hlung Generator3" VALUE 0x72796 TKW_VV_VV_UW 100.0 FORMULA_0457 0.0 9.99984741210938e-1 FORMAT "%7.4" /end CHARACTERISTIC
/begin CHARACTERISTIC K_ZMGENSTKL4 "Zeitkonstante Abk�hlung Generator4" VALUE 0x72798 TKW_VV_VV_UW 100.0 FORMULA_0457 0.0 9.99984741210938e-1 FORMAT "%7.4" /end CHARACTERISTIC
/begin CHARACTERISTIC K_ZMGENTWA "" VALUE 0x7279A TKW_VV_VV_UW 100.0 FORMULA_0457 0.0 9.99984741210938e-1 FORMAT "%7.4" /end CHARACTERISTIC
/begin CHARACTERISTIC K_ZMGN0TANS1 "Zeitkonstante Generatoransaugluft1 bei vfzg = 0" VALUE 0x7279C TKW_VV_VV_UW 100.0 FORMULA_0457 0.0 9.99984741210938e-1 FORMAT "%7.4" /end CHARACTERISTIC
/begin CHARACTERISTIC K_ZMGN0TANS2 "Zeitkonstante Generatoransaugluft2 bei vfzg = 0" VALUE 0x7279E TKW_VV_VV_UW 100.0 FORMULA_0457 0.0 9.99984741210938e-1 FORMAT "%7.4" /end CHARACTERISTIC
/begin CHARACTERISTIC K_ZMGN0TANS3 "Zeitkonstante Generatoransaugluft3 bei vfzg = 0" VALUE 0x727A0 TKW_VV_VV_UW 100.0 FORMULA_0457 0.0 9.99984741210938e-1 FORMAT "%7.4" /end CHARACTERISTIC
/begin CHARACTERISTIC K_ZMGN0TANS4 "Zeitkonstante Generatoransaugluft4 bei vfzg = 0" VALUE 0x727A2 TKW_VV_VV_UW 100.0 FORMULA_0457 0.0 9.99984741210938e-1 FORMAT "%7.4" /end CHARACTERISTIC
/begin CHARACTERISTIC K_ZMGNTANS1 "Zeitkonstante Generatoransaugluft1" VALUE 0x727A4 TKW_VV_VV_UW 100.0 FORMULA_0457 0.0 9.99984741210938e-1 FORMAT "%7.4" /end CHARACTERISTIC
/begin CHARACTERISTIC K_ZMGNTANS2 "Zeitkonstante Generatoransaugluft2" VALUE 0x727A6 TKW_VV_VV_UW 100.0 FORMULA_0457 0.0 9.99984741210938e-1 FORMAT "%7.4" /end CHARACTERISTIC
/begin CHARACTERISTIC K_ZMGNTANS3 "Zeitkonstante Generatoransaugluft3" VALUE 0x727A8 TKW_VV_VV_UW 100.0 FORMULA_0457 0.0 9.99984741210938e-1 FORMAT "%7.4" /end CHARACTERISTIC
/begin CHARACTERISTIC K_ZMGNTANS4 "Zeitkonstante Generatoransaugluft3" VALUE 0x727AA TKW_VV_VV_UW 100.0 FORMULA_0457 0.0 9.99984741210938e-1 FORMAT "%7.4" /end CHARACTERISTIC
/begin CHARACTERISTIC K_ZMIGMISCH "Zeitkonstante IG Mischung" VALUE 0x727AC TKW_VV_VV_UW 100.0 FORMULA_0457 0.0 9.99984741210938e-1 FORMAT "%7.4" /end CHARACTERISTIC
/begin CHARACTERISTIC K_ZMTESTFIL "" VALUE 0x727AE TKW_VV_VV_UW 100.0 FORMULA_0457 0.0 9.99984741210938e-1 FORMAT "%7.4" /end CHARACTERISTIC
/begin CHARACTERISTIC K_DF_DEAKAPP "Df-Schwelle f�r IG 0A Zwangssetzung" VALUE 0x727B0 TKW_VV_VV_UB 100.0 FORMULA_0471 0.0 99.6093 /end CHARACTERISTIC
/begin CHARACTERISTIC K_EN_MDGEN "" VALUE 0x727B1 TKW_VV_VV_UB 100.0 FORMULA_0003 0.0 255.0000 /end CHARACTERISTIC
/begin CHARACTERISTIC K_GENDIFAK1 "Stromfaktor Diode1" VALUE 0x727B2 TKW_VV_VV_UB 100.0 FORMULA_0434 0.0 0.9960 /end CHARACTERISTIC
/begin CHARACTERISTIC K_GENDIFAK2 "Stromfaktor Diode2" VALUE 0x727B3 TKW_VV_VV_UB 100.0 FORMULA_0434 0.0 0.9960 /end CHARACTERISTIC
/begin CHARACTERISTIC K_GENDIFAK3 "Stromfaktor Diode3" VALUE 0x727B4 TKW_VV_VV_UB 100.0 FORMULA_0434 0.0 0.9960 /end CHARACTERISTIC
/begin CHARACTERISTIC K_GENDIFAK4 "Stromfaktor Diode4" VALUE 0x727B5 TKW_VV_VV_UB 100.0 FORMULA_0434 0.0 0.9960 /end CHARACTERISTIC
/begin CHARACTERISTIC K_GENITYP "Generatorstrotyp 0=gerechnet / 1=gemessen" VALUE 0x727B6 TKW_VV_VV_UB 100.0 FORMULA_0003 0.0 1.0000 /end CHARACTERISTIC
/begin CHARACTERISTIC K_GENSTFAK1 "Stromfaktor Statorspule" VALUE 0x727B7 TKW_VV_VV_UB 100.0 FORMULA_0434 0.0 0.9960 /end CHARACTERISTIC
/begin CHARACTERISTIC K_GENSTFAK2 "Stromfaktor Statorspule2" VALUE 0x727B8 TKW_VV_VV_UB 100.0 FORMULA_0434 0.0 0.9960 /end CHARACTERISTIC
/begin CHARACTERISTIC K_GENSTFAK3 "Stromfaktor Statorspule3" VALUE 0x727B9 TKW_VV_VV_UB 100.0 FORMULA_0434 0.0 0.9960 /end CHARACTERISTIC
/begin CHARACTERISTIC K_GENSTFAK4 "Stromfaktor Statorspule4" VALUE 0x727BA TKW_VV_VV_UB 100.0 FORMULA_0434 0.0 0.9960 /end CHARACTERISTIC
/begin CHARACTERISTIC K_GENTEMPMAN "Manuelle Generatorvorgabe" VALUE 0x727BB TKW_VV_VV_UB 100.0 FORMULA_0003 0.0 255.0000 /end CHARACTERISTIC
/begin CHARACTERISTIC K_GENTYP "Generatortyp" VALUE 0x727BC TKW_VV_VV_UB 100.0 FORMULA_0003 0.0 255.0000 /end CHARACTERISTIC
/begin CHARACTERISTIC K_GENUMGTYP "" VALUE 0x727BD TKW_VV_VV_UB 100.0 FORMULA_0003 0.0 255.0000 /end CHARACTERISTIC
/begin CHARACTERISTIC K_IGBASIS "Generatorgrundstrombedarf FZG " VALUE 0x727BE TKW_VV_VV_UB 100.0 FORMULA_0459 0.0 255.0000 /end CHARACTERISTIC
/begin CHARACTERISTIC K_IGBASISOFF "Generatorgrundstrombedarf FZG bei Genred" VALUE 0x727BF TKW_VV_VV_UB 100.0 FORMULA_0459 0.0 255.0000 /end CHARACTERISTIC
/begin CHARACTERISTIC K_IGNOTWERT "" VALUE 0x727C0 TKW_VV_VV_UB 100.0 FORMULA_0459 0.0 255.0000 /end CHARACTERISTIC
/begin CHARACTERISTIC K_MANAWNUMM "" VALUE 0x727C1 TKW_VV_VV_UB 100.0 FORMULA_0003 0.0 255.0000 /end CHARACTERISTIC
/begin CHARACTERISTIC K_PRELLGTMOT "Prellzeit f�r Tmot-Schwelle" VALUE 0x727C2 TKW_VV_VV_UB 100.0 FORMULA_0472 0.0 255.0000 /end CHARACTERISTIC
/begin CHARACTERISTIC K_TIGMISCH "" VALUE 0x727C3 TKW_VV_VV_UB 100.0 FORMULA_0317 0.0 2.5500 /end CHARACTERISTIC
/begin CHARACTERISTIC K_TSTCNTEN "" VALUE 0x727C4 TKW_VV_VV_UB 100.0 FORMULA_0003 0.0 255.0000 /end CHARACTERISTIC
/begin CHARACTERISTIC K_TSTFIL_INI "" VALUE 0x727C5 TKW_VV_VV_UB 100.0 FORMULA_0003 0.0 255.0000 /end CHARACTERISTIC
/begin CHARACTERISTIC K_UDIODERMS1 "RMS-Schwellspannung Generatordiode1" VALUE 0x727C6 TKW_VV_VV_UB 100.0 FORMULA_0473 0.0 1.9921 /end CHARACTERISTIC
/begin CHARACTERISTIC K_UDIODERMS2 "RMS-Schwellspannung Generatordiode2" VALUE 0x727C7 TKW_VV_VV_UB 100.0 FORMULA_0473 0.0 1.9921 /end CHARACTERISTIC
/begin CHARACTERISTIC K_UDIODERMS3 "RMS-Schwellspannung Generatordiode3" VALUE 0x727C8 TKW_VV_VV_UB 100.0 FORMULA_0473 0.0 1.9921 /end CHARACTERISTIC
/begin CHARACTERISTIC K_UDIODERMS4 "RMS-Schwellspannung Generatordiode3" VALUE 0x727C9 TKW_VV_VV_UB 100.0 FORMULA_0473 0.0 1.9921 /end CHARACTERISTIC
/begin CHARACTERISTIC S_IGMISCH "" VALUE 0x727CA TKW_VV_VV_UB 100.0 FORMULA_0474 0.0 1.0000 /end CHARACTERISTIC
/begin CHARACTERISTIC S_RDGENTYP "" VALUE 0x727CB TKW_VV_VV_UB 100.0 FORMULA_0003 0.0 255.0000 /end CHARACTERISTIC
/begin CHARACTERISTIC K_GENTYPFELD_1of33_ "Generatorkennfeldzuordnung" VALUE 0x727CC TKW_VV_VV_UB 100.0 FORMULA_0003 0.0 255.0000 /end CHARACTERISTIC
/begin CHARACTERISTIC K_GENTYPFELD_2of33_ "Generatorkennfeldzuordnung" VALUE 0x727CD TKW_VV_VV_UB 100.0 FORMULA_0003 0.0 255.0000 /end CHARACTERISTIC
/begin CHARACTERISTIC K_GENTYPFELD_3of33_ "Generatorkennfeldzuordnung" VALUE 0x727CE TKW_VV_VV_UB 100.0 FORMULA_0003 0.0 255.0000 /end CHARACTERISTIC
/begin CHARACTERISTIC K_GENTYPFELD_4of33_ "Generatorkennfeldzuordnung" VALUE 0x727CF TKW_VV_VV_UB 100.0 FORMULA_0003 0.0 255.0000 /end CHARACTERISTIC
/begin CHARACTERISTIC K_GENTYPFELD_5of33_ "Generatorkennfeldzuordnung" VALUE 0x727D0 TKW_VV_VV_UB 100.0 FORMULA_0003 0.0 255.0000 /end CHARACTERISTIC
/begin CHARACTERISTIC K_GENTYPFELD_6of33_ "Generatorkennfeldzuordnung" VALUE 0x727D1 TKW_VV_VV_UB 100.0 FORMULA_0003 0.0 255.0000 /end CHARACTERISTIC
/begin CHARACTERISTIC K_GENTYPFELD_7of33_ "Generatorkennfeldzuordnung" VALUE 0x727D2 TKW_VV_VV_UB 100.0 FORMULA_0003 0.0 255.0000 /end CHARACTERISTIC
/begin CHARACTERISTIC K_GENTYPFELD_8of33_ "Generatorkennfeldzuordnung" VALUE 0x727D3 TKW_VV_VV_UB 100.0 FORMULA_0003 0.0 255.0000 /end CHARACTERISTIC
/begin CHARACTERISTIC K_GENTYPFELD_9of33_ "Generatorkennfeldzuordnung" VALUE 0x727D4 TKW_VV_VV_UB 100.0 FORMULA_0003 0.0 255.0000 /end CHARACTERISTIC
/begin CHARACTERISTIC K_GENTYPFELD_10of33_ "Generatorkennfeldzuordnung" VALUE 0x727D5 TKW_VV_VV_UB 100.0 FORMULA_0003 0.0 255.0000 /end CHARACTERISTIC
/begin CHARACTERISTIC K_GENTYPFELD_11of33_ "Generatorkennfeldzuordnung" VALUE 0x727D6 TKW_VV_VV_UB 100.0 FORMULA_0003 0.0 255.0000 /end CHARACTERISTIC
/begin CHARACTERISTIC K_GENTYPFELD_12of33_ "Generatorkennfeldzuordnung" VALUE 0x727D7 TKW_VV_VV_UB 100.0 FORMULA_0003 0.0 255.0000 /end CHARACTERISTIC
/begin CHARACTERISTIC K_GENTYPFELD_13of33_ "Generatorkennfeldzuordnung" VALUE 0x727D8 TKW_VV_VV_UB 100.0 FORMULA_0003 0.0 255.0000 /end CHARACTERISTIC
/begin CHARACTERISTIC K_GENTYPFELD_14of33_ "Generatorkennfeldzuordnung" VALUE 0x727D9 TKW_VV_VV_UB 100.0 FORMULA_0003 0.0 255.0000 /end CHARACTERISTIC
/begin CHARACTERISTIC K_GENTYPFELD_15of33_ "Generatorkennfeldzuordnung" VALUE 0x727DA TKW_VV_VV_UB 100.0 FORMULA_0003 0.0 255.0000 /end CHARACTERISTIC
/begin CHARACTERISTIC K_GENTYPFELD_16of33_ "Generatorkennfeldzuordnung" VALUE 0x727DB TKW_VV_VV_UB 100.0 FORMULA_0003 0.0 255.0000 /end CHARACTERISTIC
/begin CHARACTERISTIC K_GENTYPFELD_17of33_ "Generatorkennfeldzuordnung" VALUE 0x727DC TKW_VV_VV_UB 100.0 FORMULA_0003 0.0 255.0000 /end CHARACTERISTIC
/begin CHARACTERISTIC K_GENTYPFELD_18of33_ "Generatorkennfeldzuordnung" VALUE 0x727DD TKW_VV_VV_UB 100.0 FORMULA_0003 0.0 255.0000 /end CHARACTERISTIC
/begin CHARACTERISTIC K_GENTYPFELD_19of33_ "Generatorkennfeldzuordnung" VALUE 0x727DE TKW_VV_VV_UB 100.0 FORMULA_0003 0.0 255.0000 /end CHARACTERISTIC
/begin CHARACTERISTIC K_GENTYPFELD_20of33_ "Generatorkennfeldzuordnung" VALUE 0x727DF TKW_VV_VV_UB 100.0 FORMULA_0003 0.0 255.0000 /end CHARACTERISTIC
/begin CHARACTERISTIC K_GENTYPFELD_21of33_ "Generatorkennfeldzuordnung" VALUE 0x727E0 TKW_VV_VV_UB 100.0 FORMULA_0003 0.0 255.0000 /end CHARACTERISTIC
/begin CHARACTERISTIC K_GENTYPFELD_22of33_ "Generatorkennfeldzuordnung" VALUE 0x727E1 TKW_VV_VV_UB 100.0 FORMULA_0003 0.0 255.0000 /end CHARACTERISTIC
/begin CHARACTERISTIC K_GENTYPFELD_23of33_ "Generatorkennfeldzuordnung" VALUE 0x727E2 TKW_VV_VV_UB 100.0 FORMULA_0003 0.0 255.0000 /end CHARACTERISTIC
/begin CHARACTERISTIC K_GENTYPFELD_24of33_ "Generatorkennfeldzuordnung" VALUE 0x727E3 TKW_VV_VV_UB 100.0 FORMULA_0003 0.0 255.0000 /end CHARACTERISTIC
/begin CHARACTERISTIC K_GENTYPFELD_25of33_ "Generatorkennfeldzuordnung" VALUE 0x727E4 TKW_VV_VV_UB 100.0 FORMULA_0003 0.0 255.0000 /end CHARACTERISTIC
/begin CHARACTERISTIC K_GENTYPFELD_26of33_ "Generatorkennfeldzuordnung" VALUE 0x727E5 TKW_VV_VV_UB 100.0 FORMULA_0003 0.0 255.0000 /end CHARACTERISTIC
/begin CHARACTERISTIC K_GENTYPFELD_27of33_ "Generatorkennfeldzuordnung" VALUE 0x727E6 TKW_VV_VV_UB 100.0 FORMULA_0003 0.0 255.0000 /end CHARACTERISTIC
/begin CHARACTERISTIC K_GENTYPFELD_28of33_ "Generatorkennfeldzuordnung" VALUE 0x727E7 TKW_VV_VV_UB 100.0 FORMULA_0003 0.0 255.0000 /end CHARACTERISTIC
/begin CHARACTERISTIC K_GENTYPFELD_29of33_ "Generatorkennfeldzuordnung" VALUE 0x727E8 TKW_VV_VV_UB 100.0 FORMULA_0003 0.0 255.0000 /end CHARACTERISTIC
/begin CHARACTERISTIC K_GENTYPFELD_30of33_ "Generatorkennfeldzuordnung" VALUE 0x727E9 TKW_VV_VV_UB 100.0 FORMULA_0003 0.0 255.0000 /end CHARACTERISTIC
/begin CHARACTERISTIC K_GENTYPFELD_31of33_ "Generatorkennfeldzuordnung" VALUE 0x727EA TKW_VV_VV_UB 100.0 FORMULA_0003 0.0 255.0000 /end CHARACTERISTIC
/begin CHARACTERISTIC K_GENTYPFELD_32of33_ "Generatorkennfeldzuordnung" VALUE 0x727EB TKW_VV_VV_UB 100.0 FORMULA_0003 0.0 255.0000 /end CHARACTERISTIC
/begin CHARACTERISTIC K_GENTYPFELD_33of33_ "Generatorkennfeldzuordnung" VALUE 0x727EC TKW_VV_VV_UB 100.0 FORMULA_0003 0.0 255.0000 /end CHARACTERISTIC
/begin CHARACTERISTIC KL_RTH0FAK3 "RTHfaktor3 ueber Generatorstrom" CURVE 0x727ED TKL_UB_VV_UB 100.0 FORMULA_0461 0.0 3.9843 /begin AXIS_DESCR STD_AXIS I_gen_end FORMULA_0459 11 0.0 255.0000 /end AXIS_DESCR /end CHARACTERISTIC
/begin CHARACTERISTIC KL_GENTETA4 "Temperatur_eta_faktor Generator4" CURVE 0x72806 TKL_SW_VV_UW 100.0 FORMULA_0024 0.0 1.9999 /begin AXIS_DESCR STD_AXIS Tgen FORMULA_0426 3 -3276.8000 3276.7000 /end AXIS_DESCR FORMAT "%7.4" /end CHARACTERISTIC
/begin CHARACTERISTIC KL_RTHGEN2 "RTH-Kennfeld Generator2" CURVE 0x72814 TKL_SW_VV_UW 100.0 FORMULA_0453 0.0 1.0000 /begin AXIS_DESCR STD_AXIS N_gen FORMULA_0006 6 -32768.0000 32767.0000 /end AXIS_DESCR FORMAT "%7.4" /end CHARACTERISTIC
/begin CHARACTERISTIC KL_GENTETA3 "Temperatur_eta_faktor Generator3" CURVE 0x7282E TKL_SW_VV_UW 100.0 FORMULA_0024 0.0 1.9999 /begin AXIS_DESCR STD_AXIS Tgen FORMULA_0426 3 -3276.8000 3276.7000 /end AXIS_DESCR FORMAT "%7.4" /end CHARACTERISTIC
/begin CHARACTERISTIC KL_RTH0FAK1 "RTHfaktor1 ueber Generatorstrom" CURVE 0x7283C TKL_UB_VV_UB 100.0 FORMULA_0461 0.0 3.9843 /begin AXIS_DESCR STD_AXIS I_gen_end FORMULA_0459 11 0.0 255.0000 /end AXIS_DESCR /end CHARACTERISTIC
/begin CHARACTERISTIC KL_RTHGEN1 "RTH-Kennfeld Generator1" CURVE 0x72854 TKL_SW_VV_UW 100.0 FORMULA_0453 0.0 1.0000 /begin AXIS_DESCR STD_AXIS N_gen FORMULA_0006 6 -32768.0000 32767.0000 /end AXIS_DESCR FORMAT "%7.4" /end CHARACTERISTIC
/begin CHARACTERISTIC KL_RTH0FAK4 "RTHfaktor4 ueber Generatorstrom" CURVE 0x7286E TKL_UB_VV_UB 100.0 FORMULA_0461 0.0 3.9843 /begin AXIS_DESCR STD_AXIS I_gen_end FORMULA_0459 11 0.0 255.0000 /end AXIS_DESCR /end CHARACTERISTIC
/begin CHARACTERISTIC KL_GENEXP2 "Abk�hlkurve Generator2" CURVE 0x72886 TKL_UW_VV_UB 100.0 FORMULA_0434 0.0 0.9960 /begin AXIS_DESCR STD_AXIS Tn_abstell FORMULA_0010 13 0.0 65535.0000 /end AXIS_DESCR /end CHARACTERISTIC
/begin CHARACTERISTIC KL_RTHGEN3 "RTH-Kennfeld Generator3" CURVE 0x728B0 TKL_SW_VV_UW 100.0 FORMULA_0453 0.0 1.0000 /begin AXIS_DESCR STD_AXIS N_gen FORMULA_0006 6 -32768.0000 32767.0000 /end AXIS_DESCR FORMAT "%7.4" /end CHARACTERISTIC
/begin CHARACTERISTIC KL_RTHFAK2 "RTHfaktor2 ueber Generatorstrom Fahrt" CURVE 0x728CA TKL_UB_VV_UB 100.0 FORMULA_0461 0.0 3.9843 /begin AXIS_DESCR STD_AXIS I_gen_end FORMULA_0459 11 0.0 255.0000 /end AXIS_DESCR /end CHARACTERISTIC
/begin CHARACTERISTIC KL_GENEXP1 "Abk�hlkurve Generator1" CURVE 0x728E2 TKL_UW_VV_UB 100.0 FORMULA_0434 0.0 0.9960 /begin AXIS_DESCR STD_AXIS Tn_abstell FORMULA_0010 13 0.0 65535.0000 /end AXIS_DESCR /end CHARACTERISTIC
/begin CHARACTERISTIC KL_TANSGEN4 "Kennlinie Generatoransaugluft4" CURVE 0x7290C TKL_UW_VV_SW 100.0 FORMULA_0426 -3276.8000 3276.7000 /begin AXIS_DESCR STD_AXIS V FORMULA_0470 10 0.0 360.0000 /end AXIS_DESCR /end CHARACTERISTIC
/begin CHARACTERISTIC KL_GENEXP4 "Abk�hlkurve Generator4" CURVE 0x72936 TKL_UW_VV_UB 100.0 FORMULA_0434 0.0 0.9960 /begin AXIS_DESCR STD_AXIS Tn_abstell FORMULA_0010 13 0.0 65535.0000 /end AXIS_DESCR /end CHARACTERISTIC
/begin CHARACTERISTIC KL_TANSGEN3 "Kennlinie Generatoransaugluft3" CURVE 0x72960 TKL_UW_VV_SW 100.0 FORMULA_0426 -3276.8000 3276.7000 /begin AXIS_DESCR STD_AXIS V FORMULA_0470 10 0.0 360.0000 /end AXIS_DESCR /end CHARACTERISTIC
/begin CHARACTERISTIC KL_TANSGEN1 "Kennlinie Generatoransaugluft1" CURVE 0x7298A TKL_UW_VV_SW 100.0 FORMULA_0426 -3276.8000 3276.7000 /begin AXIS_DESCR STD_AXIS V FORMULA_0470 10 0.0 360.0000 /end AXIS_DESCR /end CHARACTERISTIC
/begin CHARACTERISTIC KL_RTHFAK3 "RTHfaktor3 ueber Generatorstrom Fahrt" CURVE 0x729B4 TKL_UB_VV_UB 100.0 FORMULA_0461 0.0 3.9843 /begin AXIS_DESCR STD_AXIS I_gen_end FORMULA_0459 11 0.0 255.0000 /end AXIS_DESCR /end CHARACTERISTIC
/begin CHARACTERISTIC KL_TANSGEN2 "Kennlinie Generatoransaugluft2" CURVE 0x729CC TKL_UW_VV_SW 100.0 FORMULA_0426 -3276.8000 3276.7000 /begin AXIS_DESCR STD_AXIS V FORMULA_0470 10 0.0 360.0000 /end AXIS_DESCR /end CHARACTERISTIC
/begin CHARACTERISTIC KL_RTHFAK4 "RTHfaktor4 ueber Generatorstrom Fahrt" CURVE 0x729F6 TKL_UB_VV_UB 100.0 FORMULA_0461 0.0 3.9843 /begin AXIS_DESCR STD_AXIS I_gen_end FORMULA_0459 11 0.0 255.0000 /end AXIS_DESCR /end CHARACTERISTIC
/begin CHARACTERISTIC KL_GENEXP3 "Abk�hlkurve Generator3" CURVE 0x72A0E TKL_UW_VV_UB 100.0 FORMULA_0434 0.0 0.9960 /begin AXIS_DESCR STD_AXIS Tn_abstell FORMULA_0010 13 0.0 65535.0000 /end AXIS_DESCR /end CHARACTERISTIC
/begin CHARACTERISTIC KL_FPDIODE3 "Verlustleistungsfaktor eines Diodenpaars" CURVE 0x72A38 TKL_SW_VV_UB 100.0 FORMULA_0473 0.0 1.9921 /begin AXIS_DESCR STD_AXIS Tgen FORMULA_0426 5 -3276.8000 3276.7000 /end AXIS_DESCR /end CHARACTERISTIC
/begin CHARACTERISTIC KL_GENTETA1 "Temperatur_eta_faktor Generator1" CURVE 0x72A4A TKL_SW_VV_UW 100.0 FORMULA_0024 0.0 1.9999 /begin AXIS_DESCR STD_AXIS Tgen FORMULA_0426 3 -3276.8000 3276.7000 /end AXIS_DESCR FORMAT "%7.4" /end CHARACTERISTIC
/begin CHARACTERISTIC KL_RTH0FAK2 "RTHfaktor 2 ueber Generatorstrom" CURVE 0x72A58 TKL_UB_VV_UB 100.0 FORMULA_0461 0.0 3.9843 /begin AXIS_DESCR STD_AXIS I_gen_end FORMULA_0459 11 0.0 255.0000 /end AXIS_DESCR /end CHARACTERISTIC
/begin CHARACTERISTIC KL_FPDIODE1 "Verlustleistungsfaktor eines Diodenpaars1" CURVE 0x72A70 TKL_SW_VV_UB 100.0 FORMULA_0473 0.0 1.9921 /begin AXIS_DESCR STD_AXIS Tgen FORMULA_0426 5 -3276.8000 3276.7000 /end AXIS_DESCR /end CHARACTERISTIC
/begin CHARACTERISTIC KL_RTHGEN4 "RTH-Kennfeld Generator4" CURVE 0x72A82 TKL_SW_VV_UW 100.0 FORMULA_0453 0.0 1.0000 /begin AXIS_DESCR STD_AXIS N_gen FORMULA_0006 6 -32768.0000 32767.0000 /end AXIS_DESCR FORMAT "%7.4" /end CHARACTERISTIC
/begin CHARACTERISTIC KL_GENTETA2 "Temperatur_eta_faktor Generator2" CURVE 0x72A9C TKL_SW_VV_UW 100.0 FORMULA_0024 0.0 1.9999 /begin AXIS_DESCR STD_AXIS Tgen FORMULA_0426 3 -3276.8000 3276.7000 /end AXIS_DESCR FORMAT "%7.4" /end CHARACTERISTIC
/begin CHARACTERISTIC KL_RTHFAK1 "RTHfaktor ueber Generatorstrom" CURVE 0x72AAA TKL_UB_VV_UB 100.0 FORMULA_0461 0.0 3.9843 /begin AXIS_DESCR STD_AXIS I_gen_end FORMULA_0459 11 0.0 255.0000 /end AXIS_DESCR /end CHARACTERISTIC
/begin CHARACTERISTIC KL_FPDIODE4 "Verlustleistungsfaktor eines Diodenpaars4" CURVE 0x72AC2 TKL_SW_VV_UB 100.0 FORMULA_0473 0.0 1.9921 /begin AXIS_DESCR STD_AXIS Tgen FORMULA_0426 5 -3276.8000 3276.7000 /end AXIS_DESCR /end CHARACTERISTIC
/begin CHARACTERISTIC KL_FPDIODE2 "Verlustleistungsfaktor eines Diodenpaars2" CURVE 0x72AD4 TKL_SW_VV_UB 100.0 FORMULA_0473 0.0 1.9921 /begin AXIS_DESCR STD_AXIS Tgen FORMULA_0426 5 -3276.8000 3276.7000 /end AXIS_DESCR /end CHARACTERISTIC
/begin CHARACTERISTIC KF_GENWETA1 "Wirkungsgrad1 Generator mit 2*PI" MAP 0x72AE6 TKF_SW_UB_UB 100.0 FORMULA_0447 0.0 7.9687 /begin AXIS_DESCR STD_AXIS I_gm FORMULA_0459 8 0.0 255.0000 /end AXIS_DESCR /begin AXIS_DESCR STD_AXIS N_gen FORMULA_0006 8 -32768.0000 32767.0000 /end AXIS_DESCR /end CHARACTERISTIC
/begin CHARACTERISTIC KF_GENWETA2 "Wirkungsgrad2 Generator mit 2*PI" MAP 0x72B40 TKF_SW_UB_UB 100.0 FORMULA_0447 0.0 7.9687 /begin AXIS_DESCR STD_AXIS I_gm FORMULA_0459 8 0.0 255.0000 /end AXIS_DESCR /begin AXIS_DESCR STD_AXIS N_gen FORMULA_0006 8 -32768.0000 32767.0000 /end AXIS_DESCR /end CHARACTERISTIC
/begin CHARACTERISTIC KF_MDGENFIL "Filterung Generatormoment" MAP 0x72B9A TKF_SW_SW_UW 100.0 FORMULA_0457 0.0 9.99984741210938e-1
 /begin AXIS_DESCR STD_AXIS Md_gennmufi FORMULA_0121 6 -3276.8000 3276.7000 FORMAT "%5.2" /end AXIS_DESCR
 /begin AXIS_DESCR STD_AXIS Nkw FORMULA_0006 6 -32768.0000 32767.0000 /end AXIS_DESCR
 FORMAT "%7.4" /end CHARACTERISTIC
/begin CHARACTERISTIC KF_GENWETA4 "Wirkungsgrad4 Generator mit 2*PI" MAP 0x72BFC TKF_SW_UB_UB 100.0 FORMULA_0447 0.0 7.9687 /begin AXIS_DESCR STD_AXIS I_gm FORMULA_0459 8 0.0 255.0000 /end AXIS_DESCR /begin AXIS_DESCR STD_AXIS N_gen FORMULA_0006 8 -32768.0000 32767.0000 /end AXIS_DESCR /end CHARACTERISTIC
/begin CHARACTERISTIC KF_GENWETA3 "Wirkungsgrad3 Generator mit 2*PI" MAP 0x72C56 TKF_SW_UB_UB 100.0 FORMULA_0447 0.0 7.9687 /begin AXIS_DESCR STD_AXIS I_gm FORMULA_0459 8 0.0 255.0000 /end AXIS_DESCR /begin AXIS_DESCR STD_AXIS N_gen FORMULA_0006 8 -32768.0000 32767.0000 /end AXIS_DESCR /end CHARACTERISTIC
/begin CHARACTERISTIC KF_IGENDF2 "Generatorstrom2 DF-Kennfeld" MAP 0x72CB0 TKF_UB_UB_UB 100.0 FORMULA_0459 0.0 255.0000 /begin AXIS_DESCR STD_AXIS Dffgen FORMULA_0471 7 0.0 99.6093 /end AXIS_DESCR /begin AXIS_DESCR STD_AXIS I_genmax FORMULA_0459 8 0.0 255.0000 /end AXIS_DESCR /end CHARACTERISTIC
/begin CHARACTERISTIC KF_IGENDF1 "Generatorstrom1 DF-Kennfeld" MAP 0x72CF9 TKF_UB_UB_UB 100.0 FORMULA_0459 0.0 255.0000 /begin AXIS_DESCR STD_AXIS Dffgen FORMULA_0471 7 0.0 99.6093 /end AXIS_DESCR /begin AXIS_DESCR STD_AXIS I_genmax FORMULA_0459 8 0.0 255.0000 /end AXIS_DESCR /end CHARACTERISTIC
/begin CHARACTERISTIC KF_IGENDF4 "Generatorstrom4 DF-Kennfeld" MAP 0x72D42 TKF_UB_UB_UB 100.0 FORMULA_0459 0.0 255.0000 /begin AXIS_DESCR STD_AXIS Dffgen FORMULA_0471 7 0.0 99.6093 /end AXIS_DESCR /begin AXIS_DESCR STD_AXIS I_genmax FORMULA_0459 8 0.0 255.0000 /end AXIS_DESCR /end CHARACTERISTIC
/begin CHARACTERISTIC KF_IGENDF3 "Generatorstrom3 DF-Kennfeld" MAP 0x72D8B TKF_UB_UB_UB 100.0 FORMULA_0459 0.0 255.0000 /begin AXIS_DESCR STD_AXIS Dffgen FORMULA_0471 7 0.0 99.6093 /end AXIS_DESCR /begin AXIS_DESCR STD_AXIS I_genmax FORMULA_0459 8 0.0 255.0000 /end AXIS_DESCR /end CHARACTERISTIC
/begin MEASUREMENT St_imdgen0.B_firstemp "Bedingung Generatorstarttemperatur-Berechnung" UBYTE FORMULA_0418 0 0 0.0 255.0 ECU_ADDRESS 0x3FC18E BIT_MASK 0x1 /end MEASUREMENT
/begin MEASUREMENT St_imdgen0.B_gene "Generatormoment enable/disable" UBYTE FORMULA_0419 0 0 0.0 255.0 ECU_ADDRESS 0x3FC18E BIT_MASK 0x2 /end MEASUREMENT
/begin MEASUREMENT St_imdgen0.B_generken "" UBYTE FORMULA_0420 0 0 0.0 255.0 ECU_ADDRESS 0x3FC18E BIT_MASK 0x4 /end MEASUREMENT
/begin MEASUREMENT St_imdgen0 "Statuswort" UBYTE FORMULA_0003 0 0 0.0 255.0000 ECU_ADDRESS 0x3FC18E /end MEASUREMENT
/begin MEASUREMENT St_imdgen_nv0.B_genfkupl "Generatortyp unplausibel" UBYTE FORMULA_0418 0 0 0.0 255.0 ECU_ADDRESS 0x3FC18F BIT_MASK 0x1 /end MEASUREMENT
/begin MEASUREMENT St_imdgen_nv0.B_heizen "Bedingung Generator in Heizphase" UBYTE FORMULA_0419 0 0 0.0 255.0 ECU_ADDRESS 0x3FC18F BIT_MASK 0x2 /end MEASUREMENT
/begin MEASUREMENT St_imdgen_nv0 "Statuswort" UBYTE FORMULA_0003 0 0 0.0 255.0000 ECU_ADDRESS 0x3FC18F /end MEASUREMENT
/begin MEASUREMENT Md_gennm "gefiltertes Generatormoment absolut Ausgang" SWORD FORMULA_0121 0 0 -3276.8000 3276.7000 ECU_ADDRESS 0x3FC190 /end MEASUREMENT
/begin MEASUREMENT Tgen "Generatortemperatur" SWORD FORMULA_0426 0 0 -3276.8000 3276.7000 ECU_ADDRESS 0x3FC192 /end MEASUREMENT
/begin MEASUREMENT Tgen_end "Generatortemperatur endg�ltig" SWORD FORMULA_0426 0 0 -3276.8000 3276.7000 ECU_ADDRESS 0x3FC194 /end MEASUREMENT
/begin MEASUREMENT Md_genvf "relatives Generatordrehmoment" UWORD FORMULA_0433 0 0 0.0 99.9984 ECU_ADDRESS 0x3FC196 /end MEASUREMENT
/begin MEASUREMENT I_gen "Generatorstrom" UBYTE FORMULA_0459 0 0 0.0 255.0000 ECU_ADDRESS 0x3FC198 /end MEASUREMENT
/begin MEASUREMENT I_genmax "korrigiertes DF Signal ueber Temperatur, Generatordrehzahl, Generatorspannung" UBYTE FORMULA_0459 0 0 0.0 255.0000 ECU_ADDRESS 0x3FC199 /end MEASUREMENT
/begin MEASUREMENT Ierrgrenz "Grenzertrregerstrom" UBYTE FORMULA_0460 0 0 0.0 31.8750 ECU_ADDRESS 0x3FC19A /end MEASUREMENT
/begin MEASUREMENT Tgen_ab "Abstelltemperatur Generator" SWORD FORMULA_0426 0 0 -3276.8000 3276.7000 ECU_ADDRESS 0x3FA960 /end MEASUREMENT
/begin MEASUREMENT Gen_awnumm "Generatorkennfeldnummer" UBYTE FORMULA_0003 0 0 0.0 255.0000 ECU_ADDRESS 0x3FA962 /end MEASUREMENT
/begin MEASUREMENT Gen_feta "Generatorwirkungsgrad Berechnnugsterm" ULONG FORMULA_0463 0 0 1.9073486328125e-6 5000.0000 ECU_ADDRESS 0x3FADC4 /end MEASUREMENT
/begin MEASUREMENT P_gen_ab "elektrische Generatorleistung" ULONG FORMULA_0464 0 0 0.0 4096.0000 ECU_ADDRESS 0x3FADC8 /end MEASUREMENT
/begin MEASUREMENT Gen_dts "Temperaturerhoehung im Generatorstator" SWORD FORMULA_0426 0 0 -3276.8000 3276.7000 ECU_ADDRESS 0x3FADCC /end MEASUREMENT
/begin MEASUREMENT Gen_tansend "Generatoransaugluftendwert" SWORD FORMULA_0426 0 0 -3276.8000 3276.7000 ECU_ADDRESS 0x3FADCE /end MEASUREMENT
/begin MEASUREMENT Tgen_fil "gefilterte Generatortemperatur" SWORD FORMULA_0426 0 0 -3276.8000 3276.7000 ECU_ADDRESS 0x3FADD0 /end MEASUREMENT
/begin MEASUREMENT Fdib_ig "" SWORD FORMULA_0465 0 0 -32768.0000 32767.0000 ECU_ADDRESS 0x3FADD2 /end MEASUREMENT
/begin MEASUREMENT Gen_sttemp "Generatorstarttemperatur" SWORD FORMULA_0426 0 0 -3276.8000 3276.7000 ECU_ADDRESS 0x3FADD4 /end MEASUREMENT
/begin MEASUREMENT Gen_tans "Generatoransauglufttemperatur" SWORD FORMULA_0426 0 0 -3276.8000 3276.7000 ECU_ADDRESS 0x3FADD6 /end MEASUREMENT
/begin MEASUREMENT Md_genfil "gefiltertes Generatormoment absolut" SWORD FORMULA_0121 0 0 -3276.8000 3276.7000 ECU_ADDRESS 0x3FADD8 /end MEASUREMENT
/begin MEASUREMENT Md_gennmufi "Generatormoment absolut" SWORD FORMULA_0121 0 0 -3276.8000 3276.7000 ECU_ADDRESS 0x3FADDA /end MEASUREMENT
/begin MEASUREMENT N_gen "Generatordrehzahl" SWORD FORMULA_0006 0 0 0.0 32767.0000 ECU_ADDRESS 0x3FADDC /end MEASUREMENT
/begin MEASUREMENT Nkw_s "Motordrehzahl U/s" SWORD FORMULA_0006 0 0 -32768.0000 32767.0000 ECU_ADDRESS 0x3FADDE /end MEASUREMENT
/begin MEASUREMENT Tgen_dt "Temperaturdifferenz zwischen Abstelltemperatur und Umgebungstemperatur" SWORD FORMULA_0426 0 0 -48.0000 384.0000 ECU_ADDRESS 0x3FADE0 /end MEASUREMENT
/begin MEASUREMENT Tgen_exp "Delta Abk�hltemperatur" SWORD FORMULA_0426 0 0 -48.0000 384.0000 ECU_ADDRESS 0x3FADE2 /end MEASUREMENT
/begin MEASUREMENT Gen_rs "Statorwiderstand" UWORD FORMULA_0457 0 0 0.0 9.99984741210938e-1 ECU_ADDRESS 0x3FADE4 /end MEASUREMENT
/begin MEASUREMENT Gen_spv "Generatorstatorverlustleistung" UWORD FORMULA_0466 0 0 0.0 2047.9687 ECU_ADDRESS 0x3FADE6 /end MEASUREMENT
/begin MEASUREMENT Tst_countv "Testcounter-Wert" UWORD FORMULA_0010 0 0 0.0 65535.0000 ECU_ADDRESS 0x3FADE8 /end MEASUREMENT
/begin MEASUREMENT Tst_fil_out "Testfilter Ausgang" UWORD FORMULA_0467 0 0 0.0 768.0000 ECU_ADDRESS 0x3FADEA /end MEASUREMENT
/begin MEASUREMENT Gen_teta "Wirkungsgrad Generator W*PI temperaturkompensiert" UWORD FORMULA_0468 0 0 0.0 31.9995 ECU_ADDRESS 0x3FADEC /end MEASUREMENT
/begin MEASUREMENT Gen_weta "Wirkungsgrad Generator mit Omega*PI" UWORD FORMULA_0468 0 0 0.0 31.9995 ECU_ADDRESS 0x3FADEE /end MEASUREMENT
/begin MEASUREMENT I_gen_nafil "Generatorstrom nach Filter" UWORD FORMULA_0469 0 0 0.0 256.0000 ECU_ADDRESS 0x3FADF0 /end MEASUREMENT
/begin MEASUREMENT I_gen_vorfil "Generatorstrom vor Filter" UWORD FORMULA_0469 0 0 0.0 256.0000 ECU_ADDRESS 0x3FADF2 /end MEASUREMENT
/begin MEASUREMENT Md_genrel "relatives Generatormoment Ausgang" UWORD FORMULA_0433 0 0 0.0 99.9984 ECU_ADDRESS 0x3FADF4 /end MEASUREMENT
/begin MEASUREMENT Gen_i_kaltun "DF korrektiert ueber Generatordrehzahl" UBYTE FORMULA_0459 0 0 0.0 255.0000 ECU_ADDRESS 0x3FADF6 /end MEASUREMENT
/begin MEASUREMENT Gen_nummer "Erkannte Generatornummer" UBYTE FORMULA_0003 0 0 0.0 255.0000 ECU_ADDRESS 0x3FADF7 /end MEASUREMENT
/begin MEASUREMENT I_basis "Basis Strombedarf FZG mit SLP" UBYTE FORMULA_0459 0 0 0.0 255.0000 ECU_ADDRESS 0x3FADF8 /end MEASUREMENT
/begin MEASUREMENT I_gen_end "Generatorstrom gemessen / gerechnet" UBYTE FORMULA_0459 0 0 0.0 254.0000 ECU_ADDRESS 0x3FADF9 /end MEASUREMENT
/begin MEASUREMENT I_gen_g "Generatorstrom gesamt" UBYTE FORMULA_0459 0 0 0.0 255.0000 ECU_ADDRESS 0x3FADFA /end MEASUREMENT
/begin MEASUREMENT I_gm "Generatormischstrom" UBYTE FORMULA_0459 0 0 0.0 255.0000 ECU_ADDRESS 0x3FADFB /end MEASUREMENT
/begin MEASUREMENT I_gvor "Stromwert nach �berblendung" UBYTE FORMULA_0459 0 0 0.0 255.0000 ECU_ADDRESS 0x3FADFC /end MEASUREMENT
/* ------------------ Abschnitt erzeugt aus ldstgen.dat ------------------ */
/begin CHARACTERISTIC K_TNNSTART "Zeittriggerschwelle nach Motorstart" VALUE 0x74462 TKW_VV_VV_UW 100.0 FORMULA_0021 0.0 655.3500 FORMAT "%5.2" /end CHARACTERISTIC
/begin CHARACTERISTIC K_APPUPLLDST "Applikationswert St_ldstgen f�r Nachlauf | EN: Calibration value St_ldstgen for run-on" VALUE 0x74464 TKW_VV_VV_UB 100.0 FORMULA_0003 0.0 255.0000 /end CHARACTERISTIC
/begin CHARACTERISTIC K_DFMODE "DF-Mode-Schalter themermisch/elektrisch | EN: DF-Mode-Schalter themermisch/elektrisch" VALUE 0x74465 TKW_VV_VV_UB 100.0 FORMULA_0003 0.0 255.0000 /end CHARACTERISTIC
/begin CHARACTERISTIC K_DFS_MAX "DF-Auslastung Maximalschwelle | EN: DF-Auslastung Maximalschwelle" VALUE 0x74466 TKW_VV_VV_UB 100.0 FORMULA_0471 0.0 99.6093 /end CHARACTERISTIC
/begin CHARACTERISTIC K_DFS_MIN "DF-Auslastung Minimalschwelle | EN: DF-Auslastung Minimalschwelle" VALUE 0x74467 TKW_VV_VV_UB 100.0 FORMULA_0471 0.0 99.6093 /end CHARACTERISTIC
/begin CHARACTERISTIC K_DFS_MITT "DF-Auslastung Mittelschwelle | EN: DF-Auslastung Mittelschwelle" VALUE 0x74468 TKW_VV_VV_UB 100.0 FORMULA_0471 0.0 99.6093 /end CHARACTERISTIC
/begin CHARACTERISTIC K_GENLDDFMAX "Schwell Anzeige maximaler Auslastungsgrad Generator | EN: Schwell Anzeige maximaler Auslastungsgrad Generator" VALUE 0x74469 TKW_VV_VV_UB 100.0 FORMULA_0471 0.0 99.6093 /end CHARACTERISTIC
/begin CHARACTERISTIC K_IERRFIL "Filterkonstante f�r Filterung Erregerstrom | EN: 0x0 FALSE 0x1 TRUE ELSE TRUE Bed. Motorstart für Startauswertung PM durch Erkennung Spannngseinbruch" VALUE 0x7446A TKW_VV_VV_UB 100.0 FORMULA_0434 0.0040 0.9960 /end CHARACTERISTIC
/begin CHARACTERISTIC KL_GENLDST "Auslastungsgrad Generator | EN: Generator utilisation" CURVE 0x7446C TKL_SW_VV_UB 100.0 FORMULA_0471 0.0 99.6093 /begin AXIS_DESCR STD_AXIS Tgen FORMULA_0426 6 -3276.8000 3276.7000 /end AXIS_DESCR /end CHARACTERISTIC
/begin MEASUREMENT N_nstart "Motordrehzahl nach Motorstart" SWORD FORMULA_0006 0 0 -32768.0000 32767.0000 ECU_ADDRESS 0x3FC80C /end MEASUREMENT
/begin MEASUREMENT Dfpropval "" UWORD FORMULA_0468 0 0 0.0 31.9995 ECU_ADDRESS 0x3FC80E /end MEASUREMENT
/begin MEASUREMENT Dffgen "ss_msv.dat" UBYTE FORMULA_0471 0 0 0.0 99.6093 ECU_ADDRESS 0x3FC810 /end MEASUREMENT
/begin MEASUREMENT St_ldstgen "Lastzustand Generator elektrisch/thermisch" UBYTE FORMULA_0003 0 0 0.0 255.0000 ECU_ADDRESS 0x3FC811 /end MEASUREMENT
/begin MEASUREMENT Dfsumme "DFMonitor Summe FASTA" FLOAT32_IEEE FORMULA_0041 0 0 1.0000 340282346638528860000000000000000000000.0000 ECU_ADDRESS 0x3FA96C /end MEASUREMENT
/begin MEASUREMENT Dfwanzahl "DF-Wertez�hler" FLOAT32_IEEE FORMULA_0041 0 0 1.0000 340282346638528860000000000000000000000.0000 ECU_ADDRESS 0x3FA970 /end MEASUREMENT
/begin MEASUREMENT Dfmonitor "DF-Monitor f�r FASTA" UBYTE FORMULA_0471 0 0 0.0 99.6093 ECU_ADDRESS 0x3FA974 /end MEASUREMENT
/begin MEASUREMENT Ierr_fil "Gefilterter Erregerstrom" UBYTE FORMULA_0460 0 0 0.0 31.8750 ECU_ADDRESS 0x3FB000 /end MEASUREMENT
/* ------------------ Abschnitt erzeugt aus llranh.dat ------------------ */
/begin CHARACTERISTIC K_NSUBO "N_soll bei Batterieladebilanz zu niedrig" VALUE 0x7448C TKW_VV_VV_SW 100.0 FORMULA_0006 0.0 32767.0000 /end CHARACTERISTIC
/begin CHARACTERISTIC K_NSUBU "N_soll bei Ladebilanz iO | EN: N_soll bei Ladebilanz iO" VALUE 0x7448E TKW_VV_VV_SW 100.0 FORMULA_0006 0.0 32767.0000 /end CHARACTERISTIC
/begin CHARACTERISTIC K_APP_LLAH "Kennwert zum Umschalten auf Applikationskonstante" VALUE 0x74490 TKW_VV_VV_UB 100.0 FORMULA_0003 0.0 255.0000 /end CHARACTERISTIC
/begin CHARACTERISTIC K_GENLLAHAPP "Applikationskonstente zum Setzen B_idlespec" VALUE 0x74491 TKW_VV_VV_UB 100.0 FORMULA_0003 0.0 255.0000 /end CHARACTERISTIC
/begin MEASUREMENT St_llranh0.B_idlgspec "" UBYTE FORMULA_0418 0 0 0.0 255.0 ECU_ADDRESS 0x3FC814 BIT_MASK 0x1 /end MEASUREMENT
/begin MEASUREMENT St_llranh0.B_nsub "Bedingung f�r Solldrehzahlanhebung bei niedriger Batteriespannung" UBYTE FORMULA_0419 0 0 0.0 255.0 ECU_ADDRESS 0x3FC814 BIT_MASK 0x2 /end MEASUREMENT
/begin MEASUREMENT St_llranh0.B_idl_tp "Tempor�res Berechnungsbit" UBYTE FORMULA_0420 0 0 0.0 255.0 ECU_ADDRESS 0x3FC814 BIT_MASK 0x4 /end MEASUREMENT
/begin MEASUREMENT St_llranh0 "Statuswort" UBYTE FORMULA_0003 0 0 0.0 255.0000 ECU_ADDRESS 0x3FC814 /end MEASUREMENT
/begin MEASUREMENT Nslb "N_soll Korrektur von Ladebilanz Batterie" SWORD FORMULA_0006 0 0 0.0 32767.0000 ECU_ADDRESS 0x3FC816 /end MEASUREMENT
/* ------------------ Abschnitt erzeugt aus loadresp.dat ------------------ */
/begin CHARACTERISTIC K_NKW_SCH "Drehzahlschwelle f�r Grenzmomentberechnung" VALUE 0x74492 TKW_VV_VV_SW 100.0 FORMULA_0006 0.0 32767.0000 /end CHARACTERISTIC
/begin CHARACTERISTIC K_DMDGEN_SCHMN "" VALUE 0x74494 TKW_VV_VV_SW 100.0 FORMULA_0121 -3276.8000 3276.7000 FORMAT "%5.2" /end CHARACTERISTIC
/begin CHARACTERISTIC K_DMDGEN_SCHMX "" VALUE 0x74496 TKW_VV_VV_SW 100.0 FORMULA_0121 -3276.8000 3276.7000 FORMAT "%5.2" /end CHARACTERISTIC
/begin CHARACTERISTIC K_DSOCMIN "" VALUE 0x74498 TKW_VV_VV_SW 100.0 FORMULA_0475 -100.0000 99.9969 FORMAT "%5.2" /end CHARACTERISTIC
/begin CHARACTERISTIC K_MDGNHYS "Hysterese f�r Drehzahlschwelle Generator-Maximalmomentbegrenzung | EN: Hysterese fï¿½r Drehzahlschwelle Generator-Maximalmomentbegrenzung" VALUE 0x7449A TKW_VV_VV_SW 100.0 FORMULA_0006 -32768.0000 32767.0000 /end CHARACTERISTIC
/begin CHARACTERISTIC K_MDGNMAX "Maximaldrehzahl f�r Generator-Maximalmomentbegrenzung | EN: Maximaldrehzahl fï¿½r Generator-Maximalmomentbegrenzung" VALUE 0x7449C TKW_VV_VV_SW 100.0 FORMULA_0006 -32768.0000 32767.0000 /end CHARACTERISTIC
/begin CHARACTERISTIC K_MGMAXAPP "Applikationswert Genratormaximalmoment | EN: Applikationswert Genratormaximalmoment" VALUE 0x7449E TKW_VV_VV_SW 100.0 FORMULA_0121 -3276.8000 3276.7000 FORMAT "%5.2" /end CHARACTERISTIC
/begin CHARACTERISTIC K_NGENOFMN " | EN: 0x0 FALSE 0x1 TRUE ELSE TRUE" VALUE 0x744A0 TKW_VV_VV_SW 100.0 FORMULA_0006 -32768.0000 32767.0000 /end CHARACTERISTIC
/begin CHARACTERISTIC K_NGENOFMX "" VALUE 0x744A2 TKW_VV_VV_SW 100.0 FORMULA_0006 -32768.0000 32767.0000 /end CHARACTERISTIC
/begin CHARACTERISTIC K_NMXGENOF "Motordrehzahlschwelle f�r Generatorzuschaltung" VALUE 0x744A4 TKW_VV_VV_SW 100.0 FORMULA_0006 -32768.0000 32767.0000 /end CHARACTERISTIC
/begin CHARACTERISTIC K_RLMXGENOF "relative Luftf�llungschwelle f�r Generatorzuschaltung" VALUE 0x744A6 TKW_VV_VV_SW 100.0 FORMULA_0476 -327.6800 327.6700 FORMAT "%7.4" /end CHARACTERISTIC
/begin CHARACTERISTIC K_TATMGENOF "Motordrehzahlschwelle  Katalysatortemperatur" VALUE 0x744A8 TKW_VV_VV_SW 100.0 FORMULA_0426 -3276.8000 3276.7000 /end CHARACTERISTIC
/begin CHARACTERISTIC K_TGENOFMN "" VALUE 0x744AA TKW_VV_VV_SW 100.0 FORMULA_0426 -3276.8000 3276.7000 /end CHARACTERISTIC
/begin CHARACTERISTIC K_TGENOFMX "" VALUE 0x744AC TKW_VV_VV_SW 100.0 FORMULA_0426 -3276.8000 3276.7000 /end CHARACTERISTIC
/begin CHARACTERISTIC K_TMOTABGNMN "minimale Motorabstelltemperatur f�r Generatorreduzierung" VALUE 0x744AE TKW_VV_VV_SW 100.0 FORMULA_0443 -327.6800 327.6700 FORMAT "%5.2" /end CHARACTERISTIC
/begin CHARACTERISTIC K_TUMGGNMN "minimale Umgebungstemperatur f�r Generatorreduzierung" VALUE 0x744B0 TKW_VV_VV_SW 100.0 FORMULA_0426 -3276.8000 3276.7000 /end CHARACTERISTIC
/begin CHARACTERISTIC K_TUMGGNMX "maximale Umgebungstemperatur f�r Generatorreduzierung" VALUE 0x744B2 TKW_VV_VV_SW 100.0 FORMULA_0426 -3276.8000 3276.7000 /end CHARACTERISTIC
/begin CHARACTERISTIC K_TABSTGNMN "minimale Abstellzeit f�r Generatorreduzierung" VALUE 0x744B4 TKW_VV_VV_UW 100.0 FORMULA_0010 0.0 65535.0000 /end CHARACTERISTIC
/begin CHARACTERISTIC K_TABSTGNMX "maximale Abstellzeit f�r Generatorreduzierung" VALUE 0x744B6 TKW_VV_VV_UW 100.0 FORMULA_0010 0.0 65535.0000 /end CHARACTERISTIC
/begin CHARACTERISTIC K_TDMDGEN_VERZAUS "" VALUE 0x744B8 TKW_VV_VV_UW 100.0 FORMULA_0021 0.0 655.3500 FORMAT "%5.2" /end CHARACTERISTIC
/begin CHARACTERISTIC K_TDMDGEN_VERZEIN "" VALUE 0x744BA TKW_VV_VV_UW 100.0 FORMULA_0021 0.0 655.3500 FORMAT "%5.2" /end CHARACTERISTIC
/begin CHARACTERISTIC K_VGENOFMN "Geschwindigkeitgeneratorabschaltschwelle bei Vollastbeschleunigung" VALUE 0x744BC TKW_VV_VV_UW 100.0 FORMULA_0470 0.0 65535.0000 /end CHARACTERISTIC
/begin CHARACTERISTIC K_VGENOGMX "Geschwindigkeitgeneratorzuschaltschwelle bei Vollastbeschleunigung" VALUE 0x744BE TKW_VV_VV_UW 100.0 FORMULA_0470 0.0 65535.0000 /end CHARACTERISTIC
/begin CHARACTERISTIC K_VZLORESOFV "Geschwindigkeitsschwelle f�r Generatorzuschaltung" VALUE 0x744C0 TKW_VV_VV_UW 100.0 FORMULA_0470 0.0 65535.0000 /end CHARACTERISTIC
/begin CHARACTERISTIC CW_BNS_LR "Codewort zur Einrechnung Bordnetzstabilit�t in Loadresponse" VALUE 0x744C2 TKW_VV_VV_UB 100.0 FORMULA_0003 0.0 1.0000 /end CHARACTERISTIC
/begin CHARACTERISTIC K_APPLROFF "" VALUE 0x744C3 TKW_VV_VV_UB 100.0 FORMULA_0474 0.0 1.0000 /end CHARACTERISTIC
/begin CHARACTERISTIC K_BGAPP "Applikationswert Generatorbegrenzung �ber Maximalmoment" VALUE 0x744C4 TKW_VV_VV_UB 100.0 FORMULA_0474 0.0 1.0000 /end CHARACTERISTIC
/begin CHARACTERISTIC K_ENAPPLGOFF "Enable Generatorauschaltsteuerung" VALUE 0x744C5 TKW_VV_VV_UB 100.0 FORMULA_0003 0.0 255.0000 /end CHARACTERISTIC
/begin CHARACTERISTIC K_ENAPPLRESP "Enable Handsteuerung Loadresponse | EN: Enable Handsteuerung Loadresponse" VALUE 0x744C6 TKW_VV_VV_UB 100.0 FORMULA_0003 0.0 255.0000 /end CHARACTERISTIC
/begin CHARACTERISTIC K_FHOGNMN "minimaler Wichtungsfaktor fuer minimale HFM-Luftmassen Schwelle in Abhaengigkeit von d.Hoehe fuer Generatorreduzierung" VALUE 0x744C7 TKW_VV_VV_UB 100.0 FORMULA_0461 0.0 3.9843 /end CHARACTERISTIC
/begin CHARACTERISTIC K_LRBNS "Loadrespo�nse bei Warnung Bordnetzstabilit�t gef�hrdet | EN: Loadrespo´nse bei Warnun g Bordnetzstabilität gefährdet" VALUE 0x744C8 TKW_VV_VV_UB 100.0 FORMULA_0458 0.0 25.5000 /end CHARACTERISTIC
/begin CHARACTERISTIC K_LRESPAPP "Load-Response Applikation" VALUE 0x744C9 TKW_VV_VV_UB 100.0 FORMULA_0458 0.0 25.5000 /end CHARACTERISTIC
/begin CHARACTERISTIC K_TGENOFVL "Generatorsabschaltzeit bei Vollastbeschleunigung" VALUE 0x744CA TKW_VV_VV_UB 100.0 FORMULA_0003 0.0 255.0000 /end CHARACTERISTIC
/begin CHARACTERISTIC K_TLORESPST "Startloadresponse" VALUE 0x744CB TKW_VV_VV_UB 100.0 FORMULA_0458 0.0 25.5000 /end CHARACTERISTIC
/begin CHARACTERISTIC K_TVLOFHYST "Hysterese Generatorvollastabschaltung | EN: Hysterese Generatorvollastabschaltung" VALUE 0x744CC TKW_VV_VV_UB 100.0 FORMULA_0003 0.0 255.0000 /end CHARACTERISTIC
/begin CHARACTERISTIC S_LORESLL "Schalter Kennlinienausschaltzeit  | EN: Schalter Kennlinienausschaltzeit" VALUE 0x744CD TKW_VV_VV_UB 100.0 FORMULA_0474 0.0 1.0000 /end CHARACTERISTIC
/begin CHARACTERISTIC S_MGAPP "Schalter f�r Applikationswert Genratormaximalmoment | EN: Schalter fï¿½r Applikationswert Genratormaximalmoment" VALUE 0x744CE TKW_VV_VV_UB 100.0 FORMULA_0474 0.0 1.0000 /end CHARACTERISTIC
/begin CHARACTERISTIC S_SAPP "Schalter f�r Applikationswert Begrenzungsstrategie" VALUE 0x744CF TKW_VV_VV_UB 100.0 FORMULA_0474 0.0 1.0000 /end CHARACTERISTIC
/begin CHARACTERISTIC S_TLACTIV "Schalter, um Grenzmoment in allen Motorzust�nden freizugeben" VALUE 0x744D0 TKW_VV_VV_UB 100.0 FORMULA_0474 0.0 1.0000 /end CHARACTERISTIC
/begin CHARACTERISTIC KL_LORESPM "Motorabh�ngiger Loadresponse-Faktor | EN: Engine-dependent load-response factor" CURVE 0x744D2 TKL_SW_VV_UB 100.0 FORMULA_0461 0.0 3.9843
 /begin AXIS_DESCR STD_AXIS Tmot FORMULA_0443 6 -327.6800 327.6700 FORMAT "%5.2" /end AXIS_DESCR
/end CHARACTERISTIC
/begin CHARACTERISTIC KF_ZLRRESOFV "Kennfeld Generatorausschaltzeit bei Fahrt" MAP 0x744E6 TKF_UW_SW_UB 100.0 FORMULA_0477 0.0 255.0000
 /begin AXIS_DESCR STD_AXIS Tmot_start FORMULA_0443 4 -327.6800 327.6700 FORMAT "%5.2" /end AXIS_DESCR
 /begin AXIS_DESCR STD_AXIS Km_st FORMULA_0432 4 0.0 655350.0000 /end AXIS_DESCR
/end CHARACTERISTIC
/begin CHARACTERISTIC KF_LRMAXG "Loadresponse bei begrenztem Generatormoment" MAP 0x74508 TKF_SW_UB_UB 100.0 FORMULA_0458 0.0 25.5000 /begin AXIS_DESCR STD_AXIS Na_bnanteil FORMULA_0473 8 0.0 1.9921 /end AXIS_DESCR
 /begin AXIS_DESCR STD_AXIS Rf FORMULA_0476 8 -327.6800 327.6700 FORMAT "%7.4" /end AXIS_DESCR
/end CHARACTERISTIC
/begin CHARACTERISTIC KF_ZLRESOF "Kennfeld Generatorausschaltzeit bei Stillstand | EN: Map: generator switch-off time at standstill" MAP 0x74562 TKF_UW_SW_UB 100.0 FORMULA_0477 0.0 255.0000
 /begin AXIS_DESCR STD_AXIS Tmot_start FORMULA_0443 4 -327.6800 327.6700 FORMAT "%5.2" /end AXIS_DESCR
 /begin AXIS_DESCR STD_AXIS Km_st FORMULA_0432 4 0.0 655350.0000 /end AXIS_DESCR
/end CHARACTERISTIC
/begin CHARACTERISTIC KF_LORESP "Kennfeld Loadresponse ueber Motordrehzahl und rel. Luftmasse | EN: Kennfeld Loadresponse ueber Motordrehzahl und rel. Luftmasse" MAP 0x74584 TKF_SW_SW_UB 100.0 FORMULA_0458 0.0 25.5000 /begin AXIS_DESCR STD_AXIS Nkw FORMULA_0006 6 -32768.0000 32767.0000 /end AXIS_DESCR
 /begin AXIS_DESCR STD_AXIS Rf FORMULA_0476 6 -327.6800 327.6700 FORMAT "%7.4" /end AXIS_DESCR
/end CHARACTERISTIC
/begin MEASUREMENT St_dmdblock.B_timmin "" UBYTE FORMULA_0418 0 0 0.0 255.0 ECU_ADDRESS 0x3FC818 BIT_MASK 0x1 /end MEASUREMENT
/begin MEASUREMENT St_dmdblock.B_timmax "" UBYTE FORMULA_0419 0 0 0.0 255.0 ECU_ADDRESS 0x3FC818 BIT_MASK 0x2 /end MEASUREMENT
/begin MEASUREMENT St_dmdblock.B_dmd_frei "" UBYTE FORMULA_0420 0 0 0.0 255.0 ECU_ADDRESS 0x3FC818 BIT_MASK 0x4 /end MEASUREMENT
/begin MEASUREMENT St_dmdblock "Statuswort" UBYTE FORMULA_0003 0 0 0.0 255.0000 ECU_ADDRESS 0x3FC818 /end MEASUREMENT
/begin MEASUREMENT St_loadresp.B_lroff "" UBYTE FORMULA_0418 0 0 0.0 255.0 ECU_ADDRESS 0x3FC819 BIT_MASK 0x1 /end MEASUREMENT
/begin MEASUREMENT St_loadresp.B_lroff2 "" UBYTE FORMULA_0419 0 0 0.0 255.0 ECU_ADDRESS 0x3FC819 BIT_MASK 0x2 /end MEASUREMENT
/begin MEASUREMENT St_loadresp "Statuswort" UBYTE FORMULA_0003 0 0 0.0 255.0000 ECU_ADDRESS 0x3FC819 /end MEASUREMENT
/begin MEASUREMENT St_loadresp0.B_genoffst "Bedingung Generatorabschaltung im Start" UBYTE FORMULA_0418 0 0 0.0 255.0 ECU_ADDRESS 0x3FC81A BIT_MASK 0x1 /end MEASUREMENT
/begin MEASUREMENT St_loadresp0.B_genoffmd "Abschaltung Generator angefordert" UBYTE FORMULA_0419 0 0 0.0 255.0 ECU_ADDRESS 0x3FC81A BIT_MASK 0x2 /end MEASUREMENT
/begin MEASUREMENT St_loadresp0.B_fub "Bedingung: Fehler Batteriespannungssensor" UBYTE FORMULA_0420 0 0 0.0 255.0 ECU_ADDRESS 0x3FC81A BIT_MASK 0x4 /end MEASUREMENT
/begin MEASUREMENT St_loadresp0 "Statuswort" UBYTE FORMULA_0003 0 0 0.0 255.0000 ECU_ADDRESS 0x3FC81A /end MEASUREMENT
/begin MEASUREMENT St_loadresp10ms.B_mdgrenz "Bedingung Generator im Modus Momentenbegrenzung" UBYTE FORMULA_0418 0 0 0.0 255.0 ECU_ADDRESS 0x3FC81B BIT_MASK 0x1 /end MEASUREMENT
/begin MEASUREMENT St_loadresp10ms "Statuswort" UBYTE FORMULA_0003 0 0 0.0 255.0000 ECU_ADDRESS 0x3FC81B /end MEASUREMENT
/begin MEASUREMENT St_loadresp_nv0.B_genoffvl "Bedingung Generatorabschaltung bei Vollast" UBYTE FORMULA_0418 0 0 0.0 255.0 ECU_ADDRESS 0x3FA975 BIT_MASK 0x1 /end MEASUREMENT
/begin MEASUREMENT St_loadresp_nv0 "Statuswort" UBYTE FORMULA_0003 0 0 0.0 255.0000 ECU_ADDRESS 0x3FA975 /end MEASUREMENT
/begin MEASUREMENT Md_grenz "Maximalmoment Generator an BSDII" SWORD FORMULA_0121 0 0 -3276.8000 3276.7000 ECU_ADDRESS 0x3FC81C /end MEASUREMENT
/begin MEASUREMENT Tlrgen "Sollwert Load- Response- Zeit Generator" UBYTE FORMULA_0458 0 0 0.0 25.5000 ECU_ADDRESS 0x3FC81E /end MEASUREMENT
/begin MEASUREMENT Tlrgen2 "Sollwert Load- Response- Zeit Generator2" UBYTE FORMULA_0458 0 0 0.0 25.5000 ECU_ADDRESS 0x3FC81F /end MEASUREMENT
/begin MEASUREMENT Z_dmdblock "" UBYTE FORMULA_0003 0 0 0.0 255.0000 ECU_ADDRESS 0x3FA976 /end MEASUREMENT
/begin MEASUREMENT Loadresp "Loadresponse Zeit aus Kennfeldrechnung (alte Version)" UBYTE FORMULA_0458 0 0 0.0 25.5000 ECU_ADDRESS 0x3FB006 /end MEASUREMENT
/* ------------------ Abschnitt erzeugt aus ugenkor.dat ------------------ */
/begin CHARACTERISTIC K_GENOFFTIME "maximale Generatorauszeit" VALUE 0x781DE TKW_VV_VV_UW 100.0 FORMULA_0073 0.0 6553.5000 FORMAT "%4.1" /end CHARACTERISTIC
/begin CHARACTERISTIC K_GENUMAX "maximale Generatorspannung" VALUE 0x781E0 TKW_VV_VV_UW 100.0 FORMULA_0462 0.0 6553.5000 FORMAT "%6.3" /end CHARACTERISTIC
/begin CHARACTERISTIC K_GENURAMP "Spannungsinkrement fuer Rampe" VALUE 0x781E2 TKW_VV_VV_UW 100.0 FORMULA_0462 0.0 6553.5000 FORMAT "%6.3" /end CHARACTERISTIC
/begin CHARACTERISTIC K_GENURAMPOF "Spannungsinkrement fuer Rampe, Generator ausschalten" VALUE 0x781E4 TKW_VV_VV_UW 100.0 FORMULA_0462 0.0 6553.5000 FORMAT "%6.3" /end CHARACTERISTIC
/begin CHARACTERISTIC K_GEN_APPUG "Manuelle Generatorspannungsvorgabe" VALUE 0x781E6 TKW_VV_VV_UW 100.0 FORMULA_0462 0.0 6553.5000 FORMAT "%6.3" /end CHARACTERISTIC
/begin CHARACTERISTIC K_PMSA_RST "Untere Hystereseschwelle iGR Reaktivieren" VALUE 0x781E8 TKW_VV_VV_UW 100.0 FORMULA_0010 0.0 65535.0000 /end CHARACTERISTIC
/begin CHARACTERISTIC K_PMSA_SET "Obere Hystereseschwelle iGR Deaktivieren" VALUE 0x781EA TKW_VV_VV_UW 100.0 FORMULA_0010 0.0 65535.0000 /end CHARACTERISTIC
/begin CHARACTERISTIC K_T_IGRNACHL "Nachlaufzeit iGR aktiv" VALUE 0x781EC TKW_VV_VV_UW 100.0 FORMULA_0073 0.0 6553.5000 FORMAT "%4.1" /end CHARACTERISTIC
/begin CHARACTERISTIC K_UBNS "Spannungswert f�r krit. Bordnetzzustand" VALUE 0x781EE TKW_VV_VV_UW 100.0 FORMULA_0462 0.0 6553.5000 FORMAT "%6.3" /end CHARACTERISTIC
/begin CHARACTERISTIC K_UGENDELTA "Spannungsdelta bei Betrieb von 2 Generatoren" VALUE 0x781F0 TKW_VV_VV_UW 100.0 FORMULA_0462 0.0 6553.5000 FORMAT "%6.3" /end CHARACTERISTIC
/begin CHARACTERISTIC K_UGENMAXE65 "Maximale Generatorspannung im E65" VALUE 0x781F2 TKW_VV_VV_UW 100.0 FORMULA_0462 0.0 6553.5000 FORMAT "%6.3" /end CHARACTERISTIC
/begin CHARACTERISTIC K_UGENOFF "Generatorauschaltspannung bei vfzg != 0" VALUE 0x781F4 TKW_VV_VV_UW 100.0 FORMULA_0462 0.0 6553.5000 FORMAT "%6.3" /end CHARACTERISTIC
/begin CHARACTERISTIC K_UGENOFFSTART "Spannung im Start Generator" VALUE 0x781F6 TKW_VV_VV_UW 100.0 FORMULA_0462 0.0 6553.5000 FORMAT "%6.3" /end CHARACTERISTIC
/begin CHARACTERISTIC K_UGENOFFV0 "Generatorauschaltspannung bei vfzg = 0" VALUE 0x781F8 TKW_VV_VV_UW 100.0 FORMULA_0462 0.0 6553.5000 FORMAT "%6.3" /end CHARACTERISTIC
/begin CHARACTERISTIC K_U_BNMAX "Maximale Bordnetzspannung" VALUE 0x781FA TKW_VV_VV_UW 100.0 FORMULA_0462 0.0 6553.5000 FORMAT "%6.3" /end CHARACTERISTIC
/begin CHARACTERISTIC K_U_IGRRAMP "iGR Spannungsrampe" VALUE 0x781FC TKW_VV_VV_UW 100.0 FORMULA_0462 0.0 6553.5000 FORMAT "%6.3" /end CHARACTERISTIC
/begin CHARACTERISTIC CW_BNSUMAX "Freischatung Ber�cksichtigung Bordnetzstabilit�t" VALUE 0x781FE TKW_VV_VV_UB 100.0 FORMULA_0003 0.0 255.0000 /end CHARACTERISTIC
/begin CHARACTERISTIC CW_GENOFFSLP "Codewort zum Sperren Eingriff Sekund�rluftpumpe" VALUE 0x781FF TKW_VV_VV_UB 100.0 FORMULA_0474 0.0 1.0000 /end CHARACTERISTIC
/begin CHARACTERISTIC K_APP_UGEN "Umschaltung auf manuelle Generatorspannungsvorgabe" VALUE 0x78200 TKW_VV_VV_UB 100.0 FORMULA_0003 0.0 255.0000 /end CHARACTERISTIC
/begin CHARACTERISTIC K_ENGENTOGGL "Freigabe Generatortoggeln" VALUE 0x78201 TKW_VV_VV_UB 100.0 FORMULA_0474 0.0 1.0000 /end CHARACTERISTIC
/begin CHARACTERISTIC K_PMSA_DEC "Pmigrlowctr dekrementfaktor" VALUE 0x78202 TKW_VV_VV_UB 100.0 FORMULA_0003 0.0 255.0000 /end CHARACTERISTIC
/begin CHARACTERISTIC K_PMSA_INC "Pmigrlowctr inkrementfaktor" VALUE 0x78203 TKW_VV_VV_UB 100.0 FORMULA_0003 0.0 255.0000 /end CHARACTERISTIC
/begin CHARACTERISTIC K_TDGENOFFST "Zeitverz�gerung B_start f�r Spannung im Start Generator" VALUE 0x78204 TKW_VV_VV_UB 100.0 FORMULA_0458 0.0 25.5000 /end CHARACTERISTIC
/begin CHARACTERISTIC K_T_VERBON "Verzugszeit Verbraucherzuschaltung nach Aufhebung Genertorreduzierung" VALUE 0x78205 TKW_VV_VV_UB 100.0 FORMULA_0458 0.0 25.5000 /end CHARACTERISTIC
/begin CHARACTERISTIC S_ENTLENA "Schalter Generatorentlastungsrampe aktivieren" VALUE 0x78206 TKW_VV_VV_UB 100.0 FORMULA_0474 0.0 1.0000 /end CHARACTERISTIC
/begin CHARACTERISTIC S_GENOFFSTART "Schalter zum Freischalten Startausschaltspannung" VALUE 0x78207 TKW_VV_VV_UB 100.0 FORMULA_0474 0.0 1.0000 /end CHARACTERISTIC
/begin CHARACTERISTIC S_GOFFRAMP "Schalter Sprung auf 10,6V unverzoegert" VALUE 0x78208 TKW_VV_VV_UB 100.0 FORMULA_0003 0.0 255.0000 /end CHARACTERISTIC
/begin CHARACTERISTIC S_IGRLOW "Schalter iGR Low Funktion aktiv" VALUE 0x78209 TKW_VV_VV_UB 100.0 FORMULA_0474 0.0 1.0000 /end CHARACTERISTIC
/begin MEASUREMENT St_ugenkor0.B_1stugen "Bedingung ctrgenutar noch nicht gueltig" UBYTE FORMULA_0418 0 0 0.0 255.0 ECU_ADDRESS 0x3FD490 BIT_MASK 0x1 /end MEASUREMENT
/begin MEASUREMENT St_ugenkor0.B_genoffout "Bedingung Abschaltung Generator" UBYTE FORMULA_0419 0 0 0.0 255.0 ECU_ADDRESS 0x3FD490 BIT_MASK 0x2 /end MEASUREMENT
/begin MEASUREMENT St_ugenkor0.B_ugenini "Initialisierung Generatorspannung" UBYTE FORMULA_0420 0 0 0.0 255.0 ECU_ADDRESS 0x3FD490 BIT_MASK 0x4 /end MEASUREMENT
/begin MEASUREMENT St_ugenkor0.B_genoff "Bedingung Generator ausgeschaltet" UBYTE FORMULA_0421 0 0 0.0 255.0 ECU_ADDRESS 0x3FD490 BIT_MASK 0x8 /end MEASUREMENT
/begin MEASUREMENT St_ugenkor0.B_genoff2 "Bedingung Generator2 ausgeschaltet" UBYTE FORMULA_0422 0 0 0.0 255.0 ECU_ADDRESS 0x3FD490 BIT_MASK 0x10 /end MEASUREMENT
/begin MEASUREMENT St_ugenkor0.B_genoffok "Bedingung Generatorabschaltfreigabe Sicherheitstimer" UBYTE FORMULA_0423 0 0 0.0 255.0 ECU_ADDRESS 0x3FD490 BIT_MASK 0x20 /end MEASUREMENT
/begin MEASUREMENT St_ugenkor0.B_noctrgen "Bedingung Ladespannungvorgabe ignoriert" UBYTE FORMULA_0424 0 0 0.0 255.0 ECU_ADDRESS 0x3FD490 BIT_MASK 0x40 /end MEASUREMENT
/begin MEASUREMENT St_ugenkor0.B_verb_off "Bedingung elektr. Verbraucher AUS" UBYTE FORMULA_0425 0 0 0.0 255.0 ECU_ADDRESS 0x3FD490 BIT_MASK 0x80 /end MEASUREMENT
/begin MEASUREMENT St_ugenkor0 "Statuswort" UBYTE FORMULA_0003 0 0 0.0 255.0000 ECU_ADDRESS 0x3FD490 /end MEASUREMENT
/begin MEASUREMENT St_ugenkor2.B_saaktiv "Modulspezifische Bedingung f�r Schubabschalten" UBYTE FORMULA_0418 0 0 0.0 255.0 ECU_ADDRESS 0x3FD491 BIT_MASK 0x1 /end MEASUREMENT
/begin MEASUREMENT St_ugenkor2.B_saset "Freigabe f�r modulspezifisches Schubabschalten" UBYTE FORMULA_0419 0 0 0.0 255.0 ECU_ADDRESS 0x3FD491 BIT_MASK 0x2 /end MEASUREMENT
/begin MEASUREMENT St_ugenkor2 "Statuswort" UBYTE FORMULA_0003 0 0 0.0 255.0000 ECU_ADDRESS 0x3FD491 /end MEASUREMENT
/begin MEASUREMENT St_ugenkor1.B_gentoggl "Bedindung Toggel Generatorauswahl" UBYTE FORMULA_0418 0 0 0.0 255.0 ECU_ADDRESS 0x3FAA6C BIT_MASK 0x1 /end MEASUREMENT
/begin MEASUREMENT St_ugenkor1 "Statuswort" UBYTE FORMULA_0003 0 0 0.0 255.0000 ECU_ADDRESS 0x3FAA6C /end MEASUREMENT
/begin MEASUREMENT T_batt "Batterietemperatur" SWORD FORMULA_0426 0 0 -3276.8000 3276.7000 ECU_ADDRESS 0x3FD492 /end MEASUREMENT
/begin MEASUREMENT U_gen "Sollwert Generatorspannung" UWORD FORMULA_0462 0 0 0.0 6553.5000 ECU_ADDRESS 0x3FD494 /end MEASUREMENT
/begin MEASUREMENT U_gen2 "Generatosspannungssollwert f�r Generator2" UWORD FORMULA_0462 0 0 0.0 16.0000 ECU_ADDRESS 0x3FD496 /end MEASUREMENT
/begin MEASUREMENT U_gsoll "Generatorsollspannung Basis" UWORD FORMULA_0462 0 0 0.0 6553.5000 ECU_ADDRESS 0x3FD498 /end MEASUREMENT
/begin MEASUREMENT U_gsoll_off "Generatorsollspannung Basis" UWORD FORMULA_0462 0 0 0.0 6553.5000 ECU_ADDRESS 0x3FD49A /end MEASUREMENT
/begin MEASUREMENT U_gsoll_tp "Generatorsollspannung Basis" UWORD FORMULA_0462 0 0 0.0 6553.5000 ECU_ADDRESS 0x3FD49C /end MEASUREMENT
/begin MEASUREMENT U_gsoll_tp3 "Generatorsollspannung Basis 3" UWORD FORMULA_0462 0 0 0.0 6553.5000 ECU_ADDRESS 0x3FD49E /end MEASUREMENT
/begin MEASUREMENT Pmigrlowctr "PM iGR Low Massnahmen Counter" UWORD FORMULA_0010 0 0 0.0 65535.0000 ECU_ADDRESS 0x3FB18C /end MEASUREMENT
/begin MEASUREMENT U_gen_igr "Leitungskompensierte Generatorspg f�r iGR" UWORD FORMULA_0462 0 0 0.0 6553.5000 ECU_ADDRESS 0x3FB18E /end MEASUREMENT
/begin MEASUREMENT U_gsoll_tp2 "Generatorsollspannung Basis" UWORD FORMULA_0462 0 0 0.0 6553.5000 ECU_ADDRESS 0x3FB190 /end MEASUREMENT
/begin MEASUREMENT U_gsollred "reduzierte Generatorsollspannung" UWORD FORMULA_0462 0 0 0.0 6553.5000 ECU_ADDRESS 0x3FB192 /end MEASUREMENT
/begin MEASUREMENT U_gsolltmp "reduzierte Zwischengeneratorsollspannung" UWORD FORMULA_0462 0 0 0.0 6553.5000 ECU_ADDRESS 0x3FB194 /end MEASUREMENT
/* ------------------ Abschnitt erzeugt aus elu.dat ------------------ */
/begin CHARACTERISTIC K_ELU_TCR2_TICS "Periodendauer | EN: Periodendauer" VALUE 0x71FF0 TKW_VV_VV_UW 100.0 FORMULA_0672 9.6000 79.8000 FORMAT "%4.1" /end CHARACTERISTIC
/begin CHARACTERISTIC K_ELU_TCR2_TICS_NL "Periodendauer bei Nachlaufanforderung | EN: Periodendauer bei Nachlaufanforderung" VALUE 0x71FF2 TKW_VV_VV_UW 100.0 FORMULA_0672 91.2000 111.0000 FORMAT "%4.1" /end CHARACTERISTIC
/begin CHARACTERISTIC K_ELU_TYP_CFG "Schalter fuer ELU-Typ" VALUE 0x71FF4 TKW_VV_VV_UB 100.0 FORMULA_0675 0.0 255.0 /end CHARACTERISTIC
/begin CHARACTERISTIC K_ELU_HYS_SCHLEPP "Hysterese Schleppzeiger | EN: Hysterese Schleppzeiger" VALUE 0x71FF5 TKW_VV_VV_UB 100.0 FORMULA_0032 0.0 100.0000 /end CHARACTERISTIC
/begin CHARACTERISTIC K_ELU_TKA_TMOT_DIFF "Differenz zu tmot bei defektem Kuehleraustritt" VALUE 0x71FF6 TKW_VV_VV_SW 100.0 FORMULA_0076 -1000.0000 1000.0000 FORMAT "%4.1" /end CHARACTERISTIC
/begin CHARACTERISTIC K_ELU_PWM_OFFS "Offset fuer berechnetes Tastverhaeltnis bei Luefterfunktion | EN: Offset fuer berechnetes Tastverhaeltnis bei Luefterfunktion" VALUE 0x71FF8 TKW_VV_VV_SB 100.0 FORMULA_0032 -30.0000 30.0000 /end CHARACTERISTIC
/begin CHARACTERISTIC K_ELU_PWM_MIN_ML "Minimal ausgegebenes Tastverhaeltnis bei Luefterfunktion | EN: Minimal ausgegebenes Tastverhaeltnis bei Luefterfunktion" VALUE 0x71FF9 TKW_VV_VV_UB 100.0 FORMULA_0032 0.0 49.0000 /end CHARACTERISTIC
/begin CHARACTERISTIC K_ELU_PWM_MAX_ML "Maximal ausgegebenes Tastverhaeltnis | EN: Maximal ausgegebenes Tastverhaeltnis" VALUE 0x71FFA TKW_VV_VV_UB 100.0 FORMULA_0032 50.0000 100.0000 /end CHARACTERISTIC
/begin CHARACTERISTIC K_ELU_PWM_AUS "Tastverhaeltnis bei ausgeschaltenem Luefter | EN: Tastverhaeltnis bei ausgeschaltenem Luefter" VALUE 0x71FFB TKW_VV_VV_UB 100.0 FORMULA_0032 5.0000 9.0000 /end CHARACTERISTIC
/begin CHARACTERISTIC K_ELU_PWM_MIN_MS "minimal ausgegebenes Tastverhaeltnis bei Nachlaufanforderung | EN: minimal ausgegebenes Tastverhaeltnis bei Nachlaufanforderung" VALUE 0x71FFC TKW_VV_VV_UB 100.0 FORMULA_0032 0.0 49.0000 /end CHARACTERISTIC
/begin CHARACTERISTIC K_ELU_PWM_MAX_MS "Maximal ausgegebenes Tastverhaeltnis bei Nachlaufanforderung | EN: Maximal ausgegebenes Tastverhaeltnis bei Nachlaufanforderung" VALUE 0x71FFD TKW_VV_VV_UB 100.0 FORMULA_0032 50.0000 100.0000 /end CHARACTERISTIC
/begin CHARACTERISTIC K_ELU_PWM_GRAD_ZUL "max. zulaessiger Gradient des Tastverhaeltnisses | EN: max. zulaessiger Gradient des Tastverhaeltnisses" VALUE 0x71FFE TKW_VV_VV_UW 100.0 FORMULA_0676 0.0 5.0000 FORMAT "%5.2" /end CHARACTERISTIC
/begin CHARACTERISTIC K_ELU_T_ML_MIN "Verweilzeit nach Startende | EN: Verweilzeit nach Startende" VALUE 0x72000 TKW_VV_VV_UW 100.0 FORMULA_0538 0.0 655350.0000 /end CHARACTERISTIC
/begin CHARACTERISTIC K_ELU_T_MS_MAX "zeitliche Begr. des PWM-Signals der NL-Anforderung | EN: zeitliche Begr. des PWM -Signals der NL-Anforderung" VALUE 0x72002 TKW_VV_VV_UW 100.0 FORMULA_0062 0.0 15.0000 /end CHARACTERISTIC
/begin CHARACTERISTIC K_ELU_TAN_DREH_ERSATZ "Ersatzluefterdrehzahl bei TAN-Fehler | EN: Ersatzluefterdrehzahl bei TAN-Fehler" VALUE 0x72004 TKW_VV_VV_UB 100.0 FORMULA_0032 0.0 100.0000 /end CHARACTERISTIC
/begin CHARACTERISTIC K_ELU_IDENT_CYCLE_TIME_BEGR "Begrenzung der ELU-Identifikationszykluszeit" VALUE 0x72006 TKW_VV_VV_UW 100.0 FORMULA_0539 0.0 30000.0000 /end CHARACTERISTIC
/begin CHARACTERISTIC K_ELU_IDENT_CYCLE_CNT_BEGR "Begrenzung der durchlaufenen ELU-Identifikationszyklen" VALUE 0x72008 TKW_VV_VV_UB 100.0 FORMULA_0003 0.0 255.0000 /end CHARACTERISTIC
/begin CHARACTERISTIC K_ELU_PWM_IDENT "Tastverhaeltnis fuer Schnittstellendiagnose" VALUE 0x72009 TKW_VV_VV_UB 100.0 FORMULA_0032 96.0000 99.0000 /end CHARACTERISTIC
/begin CHARACTERISTIC K_ELU_IDENT_RESP_600W_MIN "untere Grenze Antwortzeit 600W-ELU" VALUE 0x7200A TKW_VV_VV_UW 100.0 FORMULA_0539 1200.0000 2300.0000 /end CHARACTERISTIC
/begin CHARACTERISTIC K_ELU_IDENT_RESP_600W_MAX "obere Grenze Antwortzeit 600W-ELU" VALUE 0x7200C TKW_VV_VV_UW 100.0 FORMULA_0539 1200.0000 2300.0000 /end CHARACTERISTIC
/begin CHARACTERISTIC K_ELU_IDENT_RESP_850W_MIN "untere Grenze Antwortzeit 850W-ELU" VALUE 0x7200E TKW_VV_VV_UW 100.0 FORMULA_0539 2200.0000 3300.0000 /end CHARACTERISTIC
/begin CHARACTERISTIC K_ELU_IDENT_RESP_850W_MAX "obere Grenze Antwortzeit 850W-ELU" VALUE 0x72010 TKW_VV_VV_UW 100.0 FORMULA_0539 2200.0000 3300.0000 /end CHARACTERISTIC
/begin CHARACTERISTIC K_ELU_ED_SH_TO_UB_DELAY "Delay fuer Entprellung von SH_TO_UB | EN: Delay for debouncing short to battery [ms]" VALUE 0x72012 TKW_VV_VV_UW 100.0 FORMULA_0539 0.0 3000.0000 /end CHARACTERISTIC
/begin CHARACTERISTIC K_ELU_ED_SH_TO_UB_OFF_TIME "Abschaltzeit der ATIC39-Endstufe bei SH_TO_UB | EN: Switch-off time of ATIC39 output stage on short to battery [ms]" VALUE 0x72014 TKW_VV_VV_UW 100.0 FORMULA_0539 5000.0000 20000.0000 /end CHARACTERISTIC
/begin CHARACTERISTIC K_ELU_ED_BLOCKIERT_MAX "max. Zeitdauer fuer die Erkennung der ELU-Fehlermeldung | EN: Maximum time for detecting the fan fault message [ms]" VALUE 0x72016 TKW_VV_VV_UW 100.0 FORMULA_0539 4700.0000 7300.0000 /end CHARACTERISTIC
/begin CHARACTERISTIC K_ELU_ED_BLOCKIERT_MIN "min. Zeitdauer fuer die Erkennung der ELU-Fehlermeldung | EN: Minimum time for detecting the fan fault message [ms]" VALUE 0x72018 TKW_VV_VV_UW 100.0 FORMULA_0539 4700.0000 7300.0000 /end CHARACTERISTIC
/begin CHARACTERISTIC K_ELU_ED_BLOCKIER_ZYKLUS_TIME "Zeitdauer bis zur naechsten erwarteten ELU-Fehlermeldung | EN: Time until the next expected fan fault message [ms]" VALUE 0x7201A TKW_VV_VV_UW 100.0 FORMULA_0539 25000.0000 35000.0000 /end CHARACTERISTIC
/begin CHARACTERISTIC K_ELU_ED_BLOCKIERT_CNT "Counter zur zusaetzlichen Entprellung von ELU_BLOCKIERT | EN: Counter for additional debouncing of fan blocked" VALUE 0x7201C TKW_VV_VV_UB 100.0 FORMULA_0003 0.0 255.0000 /end CHARACTERISTIC
/begin CHARACTERISTIC K_ELU_ED_SH_TO_GND_CNT "Counter zur zusaetzlichen Entprellung von SH_TO_GND | EN: Counter for additional debouncing of short to ground" VALUE 0x7201D TKW_VV_VV_UB 100.0 FORMULA_0003 0.0 255.0000 /end CHARACTERISTIC
/begin CHARACTERISTIC K_ELU_ED_OPENLOAD_CNT "Counter zur zusaetzlichen Entprellung von OPENLOAD | EN: Counter for additional debouncing of open load" VALUE 0x7201E TKW_VV_VV_UB 100.0 FORMULA_0003 0.0 255.0000 /end CHARACTERISTIC
/begin CHARACTERISTIC KL_ELU_TKA "Kennlinie ELU-Drehzahl von TKA" CURVE 0x72020 TKL_SW_VV_UB 100.0 FORMULA_0032 0.0 100.0000
 /begin AXIS_DESCR STD_AXIS tka FORMULA_0023 6 -50.0000 170.0000 FORMAT "%4.1" /end AXIS_DESCR
/end CHARACTERISTIC
/begin CHARACTERISTIC KL_ELU_TKAT "Kennlinie ELU-Drehzahl von TKAT | EN: Curve: electric-fan speed from catalyst temperature" CURVE 0x72034 TKL_SW_VV_UB 100.0 FORMULA_0032 0.0 100.0000
 /begin AXIS_DESCR STD_AXIS elu_tabg_nkat FORMULA_0023 6 400.0000 1100.0000 FORMAT "%4.1" /end AXIS_DESCR
/end CHARACTERISTIC
/begin CHARACTERISTIC KL_ELU_KKOS "Kennlinie ELU-Drehzahl bei CAN-KKOS-Anforderung | EN: Curve: electric-fan speed on CAN A/C request" CURVE 0x72048 TKL_UB_VV_UB 100.0 FORMULA_0032 0.0 100.0000 /begin AXIS_DESCR STD_AXIS can_kkos_elu FORMULA_0003 16 0.0 15.0000 /end AXIS_DESCR /end CHARACTERISTIC
/begin CHARACTERISTIC KL_ELU_TAN "Kennlinie ELU-Drehzahl von TAN | EN: Curve: electric-fan speed from intake air temperature" CURVE 0x7206A TKL_SW_VV_UB 100.0 FORMULA_0032 0.0 100.0000
 /begin AXIS_DESCR STD_AXIS elu_tan FORMULA_0023 6 -50.0000 170.0000 FORMAT "%4.1" /end AXIS_DESCR
/end CHARACTERISTIC
/begin CHARACTERISTIC KL_ELU_V_KORR "Kennlinie ELU_V" CURVE 0x7207E TKL_SW_VV_UB 100.0 FORMULA_0677 0.0 1.0000
 /begin AXIS_DESCR STD_AXIS v_vorne FORMULA_0078 6 -80.0000 360.0000 FORMAT "%4.1" /end AXIS_DESCR
/end CHARACTERISTIC
/begin CHARACTERISTIC KF_ELU_PWM_MS "Kennfeld E-Luefter-Nachlaufanforderung | EN: Map: electric-fan run-on request" MAP 0x72092 TKF_SW_SW_UB 100.0 FORMULA_0032 0.0 255.0000
 /begin AXIS_DESCR STD_AXIS elu_tabg_nkat FORMULA_0023 5 400.0000 1100.0000 FORMAT "%4.1" /end AXIS_DESCR
 /begin AXIS_DESCR STD_AXIS tmot FORMULA_0023 6 -50.0000 170.0000 FORMAT "%4.1" /end AXIS_DESCR
/end CHARACTERISTIC
/begin MEASUREMENT elu_st "Status ELU-Ansteuerung" UBYTE FORMULA_0670 0 0 0.0 255.0 ECU_ADDRESS 0x3FBF68 /end MEASUREMENT
/begin MEASUREMENT elu_dreh "geforderte, v-korrigierte E-Luefterdrehzahl in %" UBYTE FORMULA_0032 0 0 0.0 100.0000 ECU_ADDRESS 0x3FBF69 /end MEASUREMENT
/begin MEASUREMENT elu_min_hys "minimale ELU-Hysterese" UBYTE FORMULA_0032 0 0 0.0 100.0000 ECU_ADDRESS 0x3FBF6A /end MEASUREMENT
/begin MEASUREMENT elu_dreh_sch "Schleppzeiger gefilterte ELU-Drehzahl" UBYTE FORMULA_0032 0 0 0.0 255.0000 ECU_ADDRESS 0x3FBF6B /end MEASUREMENT
/begin MEASUREMENT elu_pwm_ml "berechnetes PWM-Signal bei ML" UBYTE FORMULA_0032 0 0 0.0 255.0000 ECU_ADDRESS 0x3FBF6C /end MEASUREMENT
/begin MEASUREMENT elu_pwm_ml_filt "gefiltertes Tastverhaeltnis des PWM-Signals" UWORD FORMULA_0671 0 0 0.0 127.9980 ECU_ADDRESS 0x3FBF6E /end MEASUREMENT
/begin MEASUREMENT elu_pwm_ms "berechnetes PWM-Signal bei MS" UBYTE FORMULA_0032 0 0 0.0 255.0000 ECU_ADDRESS 0x3FBF70 /end MEASUREMENT
/begin MEASUREMENT elu_pwm "ausgegebenes PWM-Signal" UBYTE FORMULA_0032 0 0 0.0 100.0000 ECU_ADDRESS 0x3FBF71 /end MEASUREMENT
/begin MEASUREMENT elu_t_periode "ausgegebene Periodendauer" UWORD FORMULA_0672 0 0 0.0 39321.0000 ECU_ADDRESS 0x3FBF72 /end MEASUREMENT
/begin MEASUREMENT elu_exd_timeout "KWP-Ansteuerzeit" UBYTE FORMULA_0458 0 0 0.0 25.5000 ECU_ADDRESS 0x3FBF74 /end MEASUREMENT
/begin MEASUREMENT elu_fkt_st "ELU-Funktionsstatus" UBYTE FORMULA_0673 0 0 0.0 255.0 ECU_ADDRESS 0x3FBF75 /end MEASUREMENT
/begin MEASUREMENT elu_ident_cycle_time "Zeitdauer des Identifikationszyklus der ELU-Typerkennung" UWORD FORMULA_0539 0 0 0.0 6553500.0000 ECU_ADDRESS 0x3FBF76 /end MEASUREMENT
/begin MEASUREMENT elu_ident_cycle_cnt "Anzahl Identifikationszyklen der ELU-Typerkennung" UBYTE FORMULA_0003 0 0 0.0 255.0000 ECU_ADDRESS 0x3FBF78 /end MEASUREMENT
/begin MEASUREMENT elu_ident_timer "ELU-Anwortzeit nach GND waehrend der ELU-Typerkennung" UWORD FORMULA_0539 0 0 0.0 6553500.0000 ECU_ADDRESS 0x3FBF7C /end MEASUREMENT
/begin MEASUREMENT elu_ed_fart_merker "ELU-Fehlerartmerker fuer nachfolgenden elu_ed-Zyklus" UBYTE FORMULA_0674 0 0 0.0 255.0 ECU_ADDRESS 0x3FBF7E /end MEASUREMENT
/begin MEASUREMENT elu_ed_error_cycle_time "Zeitdauer des ELU-ED-Zyklus" UWORD FORMULA_0539 0 0 0.0 6553500.0000 ECU_ADDRESS 0x3FBF80 /end MEASUREMENT
/begin MEASUREMENT elu_ed_sh_to_ub_off_timer "Timer fuer Endstufe OFF bei SH_TO_UB" UWORD FORMULA_0539 0 0 0.0 6553500.0000 ECU_ADDRESS 0x3FBF84 /end MEASUREMENT
/begin MEASUREMENT elu_ed_sh_to_ub_delay "Timer zur Entprellung von SH_TO_UB" UWORD FORMULA_0539 0 0 0.0 6553500.0000 ECU_ADDRESS 0x3FBF88 /end MEASUREMENT
/begin MEASUREMENT elu_ed_blockiert_timer "Timer zur Entprellung der ELU-Fehlermeldung" UWORD FORMULA_0539 0 0 0.0 6553500.0000 ECU_ADDRESS 0x3FBF90 /end MEASUREMENT
/begin MEASUREMENT elu_ed_blockiert_zyklus_delay "Delay bis zur Wiederholung der ELU-Fehlermeldung" UWORD FORMULA_0539 0 0 0.0 6553500.0000 ECU_ADDRESS 0x3FBF94 /end MEASUREMENT
/begin MEASUREMENT elu_ed_sh_to_gnd_cnt "Counter zur Entprellung eines SH_TO_GND-Fehlers" UBYTE FORMULA_0003 0 0 0.0 255.0000 ECU_ADDRESS 0x3FBF96 /end MEASUREMENT
/begin MEASUREMENT elu_ed_openload_cnt "Counter zur Entprellung eines OPENLOAD-Fehlers" UBYTE FORMULA_0003 0 0 0.0 255.0000 ECU_ADDRESS 0x3FBF97 /end MEASUREMENT
/begin MEASUREMENT elu_ed_blockiert_cnt "Counter zur Entprellung eines ELU_BLOCKIERT-Fehlers" UBYTE FORMULA_0003 0 0 0.0 255.0000 ECU_ADDRESS 0x3FBF98 /end MEASUREMENT
/* ------------------ Abschnitt erzeugt aus kva.dat ------------------ */
/begin CHARACTERISTIC K_KVA_Q_MOT_TAU "Tau Kraftstoffverbrauch Motor." VALUE 0x72EC2 TKW_VV_VV_UB 100.0 FORMULA_0651 0.0051 1.2800 /end CHARACTERISTIC
/begin CHARACTERISTIC K_KVA_SPEC_WEIGHT "Dichte von Ottokraftstoff unverbleit." VALUE 0x72EC4 TKW_VV_VV_UW 100.0 FORMULA_0747 0.0002 0.9998 FORMAT "%7.4" /end CHARACTERISTIC
/begin MEASUREMENT kva_mks_out_sum_last "Letzter Kraftstoffverbrauchszaehler." ULONG FORMULA_0041 0 0 0.0 4294967295.0000 ECU_ADDRESS 0x3FC2D0 /end MEASUREMENT
/begin MEASUREMENT kva_mks_out_sum "Kraftstoffverbrauchszaehler." ULONG FORMULA_0041 0 0 0.0 4294967295.0000 ECU_ADDRESS 0x3FC2D4 /end MEASUREMENT
/begin MEASUREMENT kva_q_mot "Kraftstoffverbrauch Motor" SWORD FORMULA_0746 0 0 0.0 256.0000 ECU_ADDRESS 0x3FC2D8 /end MEASUREMENT
/begin MEASUREMENT kva_can_cnt "Letzter Kraftstoffverbrauch in ul." UWORD FORMULA_0148 0 0 0.0 65.5350 ECU_ADDRESS 0x3FC2DA /end MEASUREMENT
/* ------------------ Abschnitt erzeugt aus tgetr.dat ------------------ */
/begin CHARACTERISTIC K_TGETR_DIAG_TUMG_MIN "Untere Diagnosegrenze Umgebungstemperatur | EN: Untere Diagnosegrenze Umgebungstemperatur" VALUE 0x77574 TKW_VV_VV_SW 100.0 FORMULA_0023 -50.0000 170.0000 FORMAT "%4.1" /end CHARACTERISTIC
/begin CHARACTERISTIC K_TGETR_DIAG_MIN "Untere Grenze Getriebetemperatur | EN: Untere Grenze Getriebetemperatur" VALUE 0x77576 TKW_VV_VV_SW 100.0 FORMULA_1159 -50.0000 190.0000 FORMAT "%6.3" /end CHARACTERISTIC
/begin CHARACTERISTIC K_TGETR_DIAG_MAX "Obere Grenze Getriebetemperatur | EN: Obere Grenze Getriebetemperatur" VALUE 0x77578 TKW_VV_VV_SW 100.0 FORMULA_1159 -50.0000 190.0000 FORMAT "%6.3" /end CHARACTERISTIC
/begin CHARACTERISTIC K_TGETR_CC_HIGH "Obere Grenze CC Meldung Getriebetemperatur | EN: Obere Grenze CC Meldung Getriebetemperatur" VALUE 0x7757A TKW_VV_VV_SW 100.0 FORMULA_1159 -50.0000 190.0000 FORMAT "%6.3" /end CHARACTERISTIC
/begin CHARACTERISTIC K_TGETR_CC_HYST "Hysterese CC Meldung Getriebetemperatur | EN: Hysterese CC Meldung Getriebetemperatur" VALUE 0x7757C TKW_VV_VV_SW 100.0 FORMULA_1161 -50.0000 170.0000 FORMAT "%6.3" /end CHARACTERISTIC
/begin CHARACTERISTIC K_TGETR_TAU "Filterkonstante fuer die Getriebetemperatur | EN: Filterkonstante fuer die Getriebetemperatur" VALUE 0x7757E TKW_VV_VV_UB 100.0 FORMULA_0683 0.1004 25.6000 /end CHARACTERISTIC
/begin CHARACTERISTIC KL_TGETR_NTC "Kennlinie Getriebetemperatur | EN: Gearbox temperature curve" CURVE 0x77580 TKL_SW_VV_SW 100.0 FORMULA_1159 -50.0000 190.0000 /begin AXIS_DESCR STD_AXIS tgetr_ad FORMULA_0123 8 0.0 1023.0000 /end AXIS_DESCR FORMAT "%6.3" /end CHARACTERISTIC
/begin MEASUREMENT tgetr_ad "Eingelesener Spannungswert fuer Getriebetemperatur" SWORD FORMULA_0123 0 0 0.0 1023.0000 ECU_ADDRESS 0x3FD240 /end MEASUREMENT
/begin MEASUREMENT tgetr_filter "Gefilterter Messwert der Getriebetemperatur" SWORD FORMULA_0123 0 0 0.0 1023.0000 ECU_ADDRESS 0x3FD242 /end MEASUREMENT
/begin MEASUREMENT tgetr_ipol "Ungefilterter Messwert der Getriebetemperatur" SWORD FORMULA_1159 0 0 -50.0000 190.0000 ECU_ADDRESS 0x3FD244 /end MEASUREMENT
/begin MEASUREMENT tgetr_sta "Status Uebertemperaturanzeige" UBYTE FORMULA_1160 0 0 0.0 255.0 ECU_ADDRESS 0x3FD246 /end MEASUREMENT
/* ------------------ Abschnitt erzeugt aus ti.dat ------------------ */
/begin CHARACTERISTIC K_TI_MAX_RESET "Einfluss von ti_rf_max unterdruecken | EN: 0 Einfluss 1 kein Einfluss Einfluss von ti_rf_max unter- druecken | [Code V452 INJ 0x60654] <> 0 clears ti_pks_up_st every cycle (suppresses the ti_rf_max influence)." VALUE 0x775A2 TKW_VV_VV_UW 100.0 FORMULA_1172 0.0 1.0 FORMAT "%5.2" /end CHARACTERISTIC
/begin CHARACTERISTIC K_TI_MKS_TE_CFG "Einrechnung TE-MKS | EN: Include tank-vent fuel mass in MKS (0/1)" VALUE 0x775A4 TKW_VV_VV_UB 100.0 FORMULA_1173 0.0 1.0 /end CHARACTERISTIC
/begin CHARACTERISTIC K_TI_MKS_OELV_CFG "Einrechnung OELV-MKS" VALUE 0x775A5 TKW_VV_VV_UB 100.0 FORMULA_1174 0.0 1.0 /end CHARACTERISTIC
/begin CHARACTERISTIC K_TI_MKS_LWV_CFG "Einrechnung LWV-MKS | EN: Include LWV fuel mass in MKS (0/1)" VALUE 0x775A6 TKW_VV_VV_UB 100.0 FORMULA_1175 0.0 1.0 /end CHARACTERISTIC
/begin CHARACTERISTIC K_TI_NS_CFG "Motor laeuft ueber... | EN: Post-start base: 0 ti_mks_start, 1 ti_mks_grund, 2 ti_mks_roh" VALUE 0x775A7 TKW_VV_VV_UB 100.0 FORMULA_1176 0.0 1.0 /end CHARACTERISTIC
/begin CHARACTERISTIC K_TI_MKS_START_CFG "Einrechnung START-MKS | EN: Include START/post-start fuel mass in MKS (0/1)" VALUE 0x775A8 TKW_VV_VV_UB 100.0 FORMULA_1177 0.0 1.0 /end CHARACTERISTIC
/begin CHARACTERISTIC K_TI_WL_CFG "WL-Korrektur waehrend KH | EN: 0 ohne AQ/Hoehen- Korr. 1 mit AQ/ohne Hoe- hen-Korr 2 ohne AQ/mit Hoe- hen-Korr 3 mit AQ/Hoehen- Kor" VALUE 0x775A9 TKW_VV_VV_UB 100.0 FORMULA_1178 0.0 1.0 /end CHARACTERISTIC
/begin CHARACTERISTIC K_TI_GA "Grundadaptionsfaktor | EN: Base adaptation factor | [Code V452 INJ 0x60654] Global factor applied to every cylinder right after KF_TI_TU_F (x/128): ti_tpu = ti x KF_TI_TU_F x K_TI_GA. 1.00 here. Changes all cylinders equally (lambda control will correct it back)." VALUE 0x775AA TKW_VV_VV_UW 100.0 FORMULA_0805 0.0 10.0000 FORMAT "%5.2" /end CHARACTERISTIC
/begin CHARACTERISTIC K_TI_GRUND_STOECH "stoechometrischer Faktor | EN: Stoichiometric factor | [Code V452 INJ 0x60654] Stoichiometric factor (14.2) used to convert the ti headroom into ti_b[j].ml_max -> ti_rf_max (max. relative fill the injectors can serve)." VALUE 0x775AC TKW_VV_VV_UW 100.0 FORMULA_0805 0.0 511.9921 FORMAT "%5.2" /end CHARACTERISTIC
/begin CHARACTERISTIC K_TI_MAX_OFFS "Offset f. max. TI | EN: Offset for maximum injection time | [Code V452 INJ 0x60654] Offset subtracted from ti_max (= available time per 720 degKW from n) together with ub_offs -> ti_max_lim, the threshold for the fuel-pressure-raise request." VALUE 0x775AE TKW_VV_VV_SW 100.0 FORMULA_0786 -32.7680 32.7670 FORMAT "%5.2" /end CHARACTERISTIC
/begin CHARACTERISTIC K_TI_MIN_MAX_HYS "Hysterese f. MIN/MAX-TI | EN: Hysteresis for MIN/MAX injection time [ms] | [Code V452 INJ 0x60654] Hysteresis below ti_max_lim for clearing the per-cylinder pressure-raise bit (ti_pks_up_st)." VALUE 0x775B0 TKW_VV_VV_UW 100.0 FORMULA_0786 0.0 65.5350 FORMAT "%5.2" /end CHARACTERISTIC
/begin CHARACTERISTIC K_TI_PHI_ENDE_A_ZYL "Zylinderflaeche | EN: Cylinder (bore) area [mm2]" VALUE 0x775B2 TKW_VV_VV_UW 100.0 FORMULA_1179 0.0 6553.5000 FORMAT "%5.2" /end CHARACTERISTIC
/begin CHARACTERISTIC K_TI_PHI_ENDE_S_HUB "Kolbenhub | EN: Piston stroke [mm]" VALUE 0x775B4 TKW_VV_VV_UW 100.0 FORMULA_1180 0.0 150.0000 FORMAT "%5.2" /end CHARACTERISTIC
/begin CHARACTERISTIC K_TI_PHI_ENDE_A_SAUG "mittlerer Saugrohrquerschnitt | EN: Mean intake-runner cross-section [mm2]" VALUE 0x775B6 TKW_VV_VV_UW 100.0 FORMULA_1179 0.0 2000.0000 FORMAT "%5.2" /end CHARACTERISTIC
/begin CHARACTERISTIC K_TI_PHI_ENDE_ROH_KST "Kraftstoffdichte | EN: Fuel density [kg/dm3]" VALUE 0x775B8 TKW_VV_VV_UW 100.0 FORMULA_1181 0.0 2.0000 FORMAT "%5.2" /end CHARACTERISTIC
/begin CHARACTERISTIC K_TI_PHI_ENDE_S_ESV_EV "Strecke zwischen EV zu EV | EN: Distance from injector to intake valve [m]" VALUE 0x775BA TKW_VV_VV_UW 100.0 FORMULA_1182 0.0 0.6103 FORMAT "%7.4" /end CHARACTERISTIC
/begin CHARACTERISTIC K_TI_MIN_OFF_TIME "Minimale Ventilauszeit. | EN: Minimum valve off-time [us, x/1000 ms]" VALUE 0x775BC TKW_VV_VV_UW 100.0 FORMULA_0786 0.0 65.5350 FORMAT "%5.2" /end CHARACTERISTIC
/begin CHARACTERISTIC K_TI_NMIN_KL50OFF "N-Einschaltschwelle bei !S_KL50 | EN: Injection enable speed threshold when starter (KL50) is off" VALUE 0x775BE TKW_VV_VV_SW 100.0 FORMULA_0006 0.0 10000.0000 /end CHARACTERISTIC
/begin CHARACTERISTIC K_TI_OFF_CFG "TI-Abschaltung | EN: Injection cut-off cylinder mask (bitmask)" VALUE 0x775C0 TKW_VV_VV_UW 100.0 FORMULA_0010 0.0 1023.0000 /end CHARACTERISTIC
/begin CHARACTERISTIC K_TI_RF_MAX_DLY "Verzoegerungszeit ueber Anzahl Segmente | EN: Delay (segments) before ti_rf_max torque limit request is withdrawn | [Code V452 INJ 0x60654] Hold time (segments) for ti_rf_max_dly after a cylinder reaches ti_max_lim." VALUE 0x775C2 TKW_VV_VV_UW 100.0 FORMULA_1167 0.0 65535.0000 /end CHARACTERISTIC
/begin CHARACTERISTIC K_ZGLA_N_MAX "max. N-Schwelle fuer Zylindergleichstellung" VALUE 0x775C4 TKW_VV_VV_SW 100.0 FORMULA_0006 0.0 10000.0000 /end CHARACTERISTIC
/begin CHARACTERISTIC K_ZGLA_RF_MAX "max. RF-Schwelle fuer Zylindergleichstellung" VALUE 0x775C6 TKW_VV_VV_SW 100.0 FORMULA_0007 0.0 2.0000 FORMAT "%6.3" /end CHARACTERISTIC
/begin CHARACTERISTIC K_ZGLA_RF_MIN "min. RF-Schwelle fuer Zylindergleichstellung" VALUE 0x775C8 TKW_VV_VV_SW 100.0 FORMULA_0007 0.0 2.0000 FORMAT "%6.3" /end CHARACTERISTIC
/begin CHARACTERISTIC K_ZGLA_TMOT_MIN "min. TMOT-Schwelle fuer Zylindergleichstellung" VALUE 0x775CA TKW_VV_VV_SW 100.0 FORMULA_0023 -50.0000 170.0000 FORMAT "%4.1" /end CHARACTERISTIC
/begin CHARACTERISTIC K_ZGLA_LAM_IST_MAX "max. LAM-IST-MW-Schwelle fuer Zylindergleichstellung" VALUE 0x775CC TKW_VV_VV_UW 100.0 FORMULA_0025 0.0 3.9990 FORMAT "%6.3" /end CHARACTERISTIC
/begin CHARACTERISTIC K_ZGLA_LAM_IST_MIN "min. LAM-IST-MW-Schwelle fuer Zylindergleichstellung" VALUE 0x775CE TKW_VV_VV_UW 100.0 FORMULA_0025 0.0 3.9990 FORMAT "%6.3" /end CHARACTERISTIC
/begin CHARACTERISTIC K_ZGLA_INPUT_CFG "Auswahl Input - Zylindergleichstellung" VALUE 0x775D0 TKW_VV_VV_UB 100.0 FORMULA_1183 0.0 1.0 /end CHARACTERISTIC
/begin CHARACTERISTIC K_ZGLA_FILT_T1 "Filterzeit" VALUE 0x775D2 TKW_VV_VV_UW 100.0 FORMULA_1184 0.0 2097.0000 FORMAT "%6.3" /end CHARACTERISTIC
/begin CHARACTERISTIC K_ZGLA_ADAPT_CFG "Freigabe Adaption - Zylindergleichstellung" VALUE 0x775D4 TKW_VV_VV_UB 100.0 FORMULA_1185 0.0 1.0 /end CHARACTERISTIC
/begin CHARACTERISTIC K_ZGLA_RESET_CFG "RESET Adaption - Zylindergleichstellung" VALUE 0x775D5 TKW_VV_VV_UB 100.0 FORMULA_1186 0.0 1.0 /end CHARACTERISTIC
/begin CHARACTERISTIC K_ZGLA_I "Integratoranteil - Zylindergleichstellung" VALUE 0x775D6 TKW_VV_VV_UW 100.0 FORMULA_0024 0.0 1.9990 FORMAT "%7.4" /end CHARACTERISTIC
/begin CHARACTERISTIC K_ZGLA_F_MAX "max. Adaptionsschwelle - Zylindergleichstellung" VALUE 0x775D8 TKW_VV_VV_UW 100.0 FORMULA_0024 0.0 1.9990 FORMAT "%7.4" /end CHARACTERISTIC
/begin CHARACTERISTIC K_ZGLA_F_MIN "min. Adaptionsschwelle - Zylindergleichstellung" VALUE 0x775DA TKW_VV_VV_UW 100.0 FORMULA_0024 0.0 1.9990 FORMAT "%7.4" /end CHARACTERISTIC
/begin CHARACTERISTIC K_TI_OFF_EXD_N_MAX "max. Drehzahl f. externe TI_OFF-Ansteuerung" VALUE 0x775DC TKW_VV_VV_SW 100.0 FORMULA_0006 0.0 10000.0000 /end CHARACTERISTIC
/begin CHARACTERISTIC KL_TI_SOLL_RHO_F "Kompensationsfak. Kraftsoffdichte | EN: Fuel-density compensation factor | [Code V452 INJ 0x60654] Fuel-density factor over fuel temperature tksm; numerator of ti_soll_zyl = ti_mks_soll x RHO_F / QSTAT_F (applied to all cylinders before the trim)." CURVE 0x775DE TKL_SW_VV_UW 100.0 FORMULA_0805 0.0 10.0000
 /begin AXIS_DESCR STD_AXIS tksm FORMULA_0023 4 -50.0000 170.0000 FORMAT "%4.1" /end AXIS_DESCR
 FORMAT "%5.2" /end CHARACTERISTIC
/begin CHARACTERISTIC KL_TI_SOLL_QSTAT_F "proportionaler Ventilparameter | EN: Proportional injector valve parameter | [Code V452 INJ 0x60654] Injector static flow (mg/ms) over pressure difference pdiff = pks_ist - psau; divisor of ti_soll_zyl (all cylinders, before the trim). Injector-change table." CURVE 0x775F0 TKL_SW_VV_UW 100.0 FORMULA_1162 0.0 6.0000 /begin AXIS_DESCR STD_AXIS pdiff FORMULA_0118 8 0.0 10.0000 FORMAT "%6.3" /end AXIS_DESCR FORMAT "%6.3" /end CHARACTERISTIC
/begin CHARACTERISTIC KL_TI_SOLL_LIN_OFFS "Linearisierungskompensation | EN: Linearisation compensation | [Code V452 INJ 0x60654] Small-pulse linearisation offset over ti_soll, added per cylinder: ti_berech_zyl = ti_soll_zyl + this (before KF_TI_SOLL_MIN and the trim)." CURVE 0x77612 TKL_UW_VV_SW 100.0 FORMULA_0786 -2.0000 2.0000 /begin AXIS_DESCR STD_AXIS ti_soll FORMULA_0786 6 0.0 65.5350 FORMAT "%5.2" /end AXIS_DESCR FORMAT "%5.2" /end CHARACTERISTIC
/begin CHARACTERISTIC KL_TI_PHI_ENDE_START "ti_ende im START | EN: End of injection during start" CURVE 0x7762C TKL_SW_VV_SW 100.0 FORMULA_0111 -72.0000 1440.0000
 /begin AXIS_DESCR STD_AXIS tmot FORMULA_0023 7 -50.0000 170.0000 FORMAT "%4.1" /end AXIS_DESCR
 FORMAT "%4.1" /end CHARACTERISTIC
/begin CHARACTERISTIC KL_TI_PHI_ENDE_GRAD "Gradient fuer Aenderungsbegr. ti_ende | EN: Gradient for rate limit of ti_ende" CURVE 0x7764A TKL_SW_VV_SW 100.0 FORMULA_0111 0.0 1440.0000
 /begin AXIS_DESCR STD_AXIS ti_phi_ende FORMULA_0111 3 -72.0000 1440.0000 FORMAT "%4.1" /end AXIS_DESCR
 FORMAT "%4.1" /end CHARACTERISTIC
/begin CHARACTERISTIC KL_TI_PHI_EV_WURZEL "Darstellung Wurzel-Fluggeschwindigkeit | EN: Square-root representation of flow velocity" CURVE 0x77658 TKL_UW_VV_SW 100.0 FORMULA_1164 0.0 220.0000
 /begin AXIS_DESCR STD_AXIS ti_phi_ev_v_wurz FORMULA_1165 10 0.0 1638.3750 FORMAT "%6.3" /end AXIS_DESCR
 FORMAT "%5.2" /end CHARACTERISTIC
/begin CHARACTERISTIC KL_TI_SOLL_UB_OFFS_T_KORR_F "Kraftsofftemperatur Faktor | EN: Fuel-temperature factor | [Code V452 INJ 0x60654] Fuel-temperature factor (tsgrw) on KF_TI_SOLL_UB_OFFS (x/1024). All 1.00 here." CURVE 0x77682 TKL_SW_VV_UW 100.0 FORMULA_0075 0.0 4.0000
 /begin AXIS_DESCR STD_AXIS tksm FORMULA_0023 6 -50.0000 170.0000 FORMAT "%4.1" /end AXIS_DESCR
 FORMAT "%6.3" /end CHARACTERISTIC
/begin CHARACTERISTIC KL_TI_NS_VERLUSTE "Verluste Kraftsoffmenge | EN: Fuel quantity losses" CURVE 0x7769C TKL_SW_VV_UW 100.0 FORMULA_0075 0.0 4.0000
 /begin AXIS_DESCR STD_AXIS tsgrw FORMULA_0023 7 -50.0000 170.0000 FORMAT "%4.1" /end AXIS_DESCR
 FORMAT "%6.3" /end CHARACTERISTIC
/begin CHARACTERISTIC KL_TI_PHI_ENDE_ES "Schliesswinkel Einlassventil | EN: Intake valve closing angle" CURVE 0x776BA TKL_SW_VV_SW 100.0 FORMULA_0111 -72.0000 1440.0000 /begin AXIS_DESCR STD_AXIS n FORMULA_0006 3 0.0 10000.0000 /end AXIS_DESCR FORMAT "%4.1" /end CHARACTERISTIC
/begin CHARACTERISTIC KL_TI_START_PUMG_F "Umgebungsdruckwichtung im START | EN: Ambient-pressure weighting during start" CURVE 0x776C8 TKL_SW_VV_UW 100.0 FORMULA_0075 0.0 4.0000
 /begin AXIS_DESCR STD_AXIS pumg FORMULA_0077 5 400.0000 1200.0000 FORMAT "%4.1" /end AXIS_DESCR
 FORMAT "%6.3" /end CHARACTERISTIC
/begin CHARACTERISTIC KF_TI_SOLL_UB_OFFS "UB-abhaengiger TI-Offset  | EN: Battery-voltage-dependent injection offset (dead time) | [Code V452 INJ 0x60654] Injector opening (battery) offset over ub x pdiff, x KL_TI_SOLL_UB_OFFS_T_KORR_F/1024 -> ti_b[j].ub_offs. Added by the TPU to ti_tpu_zyl (not scaled by KF_TI_TU_F). Also lowers ti_max_lim." MAP 0x776DE TKF_SW_SW_UW 100.0 FORMULA_0786 0.0 65.5350 /begin AXIS_DESCR STD_AXIS ub FORMULA_0008 5 0.0 28.0000 FORMAT "%4.1" /end AXIS_DESCR /begin AXIS_DESCR STD_AXIS pks-psau FORMULA_0118 8 0.0 10.0000 FORMAT "%6.3" /end AXIS_DESCR FORMAT "%5.2" /end CHARACTERISTIC
/begin CHARACTERISTIC KF_TI_SOLL_MIN "minimale Einspritzzeit | EN: Minimum injection time | [Code V452 INJ 0x60654] Minimum injection time over ub x pdiff (pks-psau). Applied BEFORE KF_TI_TU_F/K_TI_GA (ti = max(ti_berech, this)), so a trim < 1.0 can take the output below this value." MAP 0x7774A TKF_SW_SW_UW 100.0 FORMULA_0786 0.0 65.5350 /begin AXIS_DESCR STD_AXIS ub FORMULA_0008 5 0.0 28.0000 FORMAT "%4.1" /end AXIS_DESCR /begin AXIS_DESCR STD_AXIS pks-psau FORMULA_0118 4 0.0 10.0000 FORMAT "%6.3" /end AXIS_DESCR FORMAT "%5.2" /end CHARACTERISTIC
/begin CHARACTERISTIC KF_TI_PHI_ENDE_OFFS "Offset Einspritzendewinkel | EN: End-of-injection angle offset" MAP 0x77786 TKF_SW_SW_SW 100.0 FORMULA_0111 -720.0000 720.0000
 /begin AXIS_DESCR STD_AXIS tmot FORMULA_0023 7 -50.0000 170.0000 FORMAT "%4.1" /end AXIS_DESCR
 /begin AXIS_DESCR STD_AXIS dr_rel FORMULA_0115 7 0.0 199.9938 FORMAT "%5.2" /end AXIS_DESCR
 FORMAT "%4.1" /end CHARACTERISTIC
/begin CHARACTERISTIC KF_TI_PHI_ENDE_GRUND "Vorlagerungswinkel aus Grundkennfeld | EN: End-of-injection angle from base map" MAP 0x77806 TKF_SW_SW_SW 100.0 FORMULA_0111 0.0 1440.0000 /begin AXIS_DESCR STD_AXIS n FORMULA_0006 10 0.0 10000.0000 /end AXIS_DESCR /begin AXIS_DESCR STD_AXIS dr_rel FORMULA_0115 8 0.0 199.9938 FORMAT "%5.2" /end AXIS_DESCR FORMAT "%4.1" /end CHARACTERISTIC
/begin CHARACTERISTIC KF_TI_TU_F "Tuning-Faktor f. TI | [Code V452 INJ 0x60654] Per-cylinder injection trim - the S85/MSS65 form of MSS60 GKF_TI_TU_F_ZYL[i] (PSB: 'S85 MS_S65: KF_TI_TU_F(n,ZYL), K_TI_GA'). Final step: ti_tpu_zyl[i] = max(ti_berech_zyl[i], KF_TI_SOLL_MIN) x KF_TI_TU_F(n, i) x K_TI_GA, then limited to ti_max. Y = cylinder 1..10 (index = bank x 5 + k: 1-5 bank 1, 6-10 bank 2; rows 11-12 unused). Exact per cylinder (no interpolation between rows), linear over n only - no load axis, and no transient weighting (MSS60 KL_TI_TU_F_WICHT does not exist in V452). Step 1/128 = 0.78 %. All 1.00 in this file. Lambda control/LAA removes any bank-average change; only the spread within a bank remains." MAP 0x778CC TKF_SW_SW_UW 100.0 FORMULA_0805 0.0 10.0000 /begin AXIS_DESCR STD_AXIS n FORMULA_0006 6 0.0 10000.0000 /end AXIS_DESCR /begin AXIS_DESCR STD_AXIS Zylinder FORMULA_1187 12 1.0000 12.0000 /end AXIS_DESCR FORMAT "%5.2" /end CHARACTERISTIC
/begin CHARACTERISTIC KF_TI_LAA_OFFS_WICHT_F "Korrekturfaktor - Lambdaadaptionsoffset | EN: Correction factor - lambda adaptation offset" MAP 0x77982 TKF_SW_SW_UW 100.0 FORMULA_0075 0.0 4.0000 /begin AXIS_DESCR STD_AXIS n FORMULA_0006 4 0.0 10000.0000 /end AXIS_DESCR
 /begin AXIS_DESCR STD_AXIS ti_ml_mg_la_f FORMULA_1163 4 -1023.9687 1023.9687 FORMAT "%5.2" /end AXIS_DESCR
 FORMAT "%6.3" /end CHARACTERISTIC
/begin CHARACTERISTIC KF_TI_GRUND_F "Wichtungsfaktor auf ti.ml_mg_zyl | EN: Weighting factor on fuel mass per cylinder (main fuel trim map)" MAP 0x779B4 TKF_SW_SW_UW 100.0 FORMULA_0075 0.0 4.0000 /begin AXIS_DESCR STD_AXIS n FORMULA_0006 10 0.0 10000.0000 /end AXIS_DESCR /begin AXIS_DESCR STD_AXIS rf FORMULA_0007 10 0.0 2.0000 FORMAT "%6.3" /end AXIS_DESCR FORMAT "%6.3" /end CHARACTERISTIC
/begin CHARACTERISTIC KF_ZGLA_ZYL_NR_OFFS "OFFSET auf aktuellen Zylinder - Zylindergleichstellung" MAP 0x77AA6 TKF_SW_SW_UW 100.0 FORMULA_1188 0.0 5.0000 /begin AXIS_DESCR STD_AXIS n FORMULA_0006 10 0.0 10000.0000 /end AXIS_DESCR /begin AXIS_DESCR STD_AXIS rf FORMULA_0007 10 0.0 2.0000 FORMAT "%6.3" /end AXIS_DESCR /end CHARACTERISTIC
/begin CHARACTERISTIC KF_TI_MKS_NS_GRUND "Grundeinspritzmasse Nachstart" MAP 0x77B98 TKF_SW_SW_UW 100.0 FORMULA_0529 0.0 16383.7500
 /begin AXIS_DESCR STD_AXIS tsgrw FORMULA_0023 10 -50.0000 170.0000 FORMAT "%4.1" /end AXIS_DESCR
 /begin AXIS_DESCR STD_AXIS pumg FORMULA_0077 5 400.0000 1200.0000 FORMAT "%4.1" /end AXIS_DESCR
 FORMAT "%5.2" /end CHARACTERISTIC
/begin CHARACTERISTIC KF_TI_NS_F "Nachstartfaktor auf Grundeinspritzmenge | EN: Post-start base factor" MAP 0x77C1C TKF_SW_SW_UW 100.0 FORMULA_0075 0.0 4.0000
 /begin AXIS_DESCR STD_AXIS tsgrw FORMULA_0023 10 -50.0000 170.0000 FORMAT "%4.1" /end AXIS_DESCR
 /begin AXIS_DESCR STD_AXIS ti_segm_cnt FORMULA_0010 10 0.0 32767.0000 /end AXIS_DESCR
 FORMAT "%6.3" /end CHARACTERISTIC
/begin CHARACTERISTIC KF_TI_SEG_TIME_F "Nachstart-Manipulationsfaktor" MAP 0x77D0E TKF_UW_UW_UW 100.0 FORMULA_0075 0.0 4.0000
 /begin AXIS_DESCR STD_AXIS ti_mks_ns_rel FORMULA_0075 10 0.0 4.0000 FORMAT "%6.3" /end AXIS_DESCR
 /begin AXIS_DESCR STD_AXIS time_ms FORMULA_0600 10 0.0 1092.2500 FORMAT "%5.2" /end AXIS_DESCR
 FORMAT "%6.3" /end CHARACTERISTIC
/begin CHARACTERISTIC KF_TI_WL_OFFS "TI-Warmlaufoffset | EN: Injection warm-up offset" MAP 0x77E00 TKF_SW_SW_SW 100.0 FORMULA_0075 -1.0000 1.0000 /begin AXIS_DESCR STD_AXIS n FORMULA_0006 8 0.0 10000.0000 /end AXIS_DESCR /begin AXIS_DESCR STD_AXIS rf FORMULA_0007 8 0.0 2.0000 FORMAT "%6.3" /end AXIS_DESCR FORMAT "%6.3" /end CHARACTERISTIC
/begin CHARACTERISTIC KF_TI_WL_KORR_F "Korrektur - TI-Warmlauffaktor | EN: Correction - injection warm-up factor" MAP 0x77EA2 TKF_SW_SW_UW 100.0 FORMULA_0075 0.0 4.0000
 /begin AXIS_DESCR STD_AXIS zust_tmot_start FORMULA_0023 8 -50.0000 170.0000 FORMAT "%4.1" /end AXIS_DESCR
 /begin AXIS_DESCR STD_AXIS time_ml FORMULA_0021 8 0.0 327.0000 FORMAT "%5.2" /end AXIS_DESCR
 FORMAT "%6.3" /end CHARACTERISTIC
/begin CHARACTERISTIC KF_TI_MKS_START "START-MKS Grundkennfeld | EN: Start base map, injection with clutch closed" MAP 0x77F44 TKF_SW_SW_UW 100.0 FORMULA_0752 0.0 1023.9843
 /begin AXIS_DESCR STD_AXIS tsgrw_m FORMULA_0023 8 -50.0000 170.0000 FORMAT "%4.1" /end AXIS_DESCR
 /begin AXIS_DESCR STD_AXIS time_ms FORMULA_0600 3 0.0 546.1166 FORMAT "%5.2" /end AXIS_DESCR
 FORMAT "%5.2" /end CHARACTERISTIC
/begin CHARACTERISTIC KF_TI_START_F "Abregelfaktor im START | EN: Start fade-out factor" MAP 0x77F8C TKF_SW_SW_UW 100.0 FORMULA_0075 0.0 4.0000
 /begin AXIS_DESCR STD_AXIS tsgrw_m FORMULA_0023 5 -50.0000 170.0000 FORMAT "%4.1" /end AXIS_DESCR
 /begin AXIS_DESCR STD_AXIS ti_segm_cnt FORMULA_0010 10 0.0 32767.0000 /end AXIS_DESCR
 FORMAT "%6.3" /end CHARACTERISTIC
/begin CHARACTERISTIC KF_TI_WL_OFFS_KH "TI-Warmlaufoffset waehrend KH | EN: Injection warm-up offset during catalyst heating" MAP 0x78010 TKF_SW_SW_SW 100.0 FORMULA_0075 -1.0000 1.0000 /begin AXIS_DESCR STD_AXIS n FORMULA_0006 8 0.0 10000.0000 /end AXIS_DESCR
 /begin AXIS_DESCR STD_AXIS egas_aq_soll_roh FORMULA_0147 8 0.0 3276.7000 FORMAT "%4.1" /end AXIS_DESCR
 FORMAT "%6.3" /end CHARACTERISTIC
/begin CHARACTERISTIC KF_TI_WL_KORR_F_KH "TI-Warmlaufkorrekturfaktor waehrend KH | EN: Injection warm-up correction factor during catalyst heating" MAP 0x780B2 TKF_SW_SW_UW 100.0 FORMULA_0075 0.0 4.0000
 /begin AXIS_DESCR STD_AXIS zust_tmot_start FORMULA_0023 8 -50.0000 170.0000 FORMAT "%4.1" /end AXIS_DESCR
 /begin AXIS_DESCR STD_AXIS time_ml FORMULA_0021 8 0.0 327.0000 FORMAT "%5.2" /end AXIS_DESCR
 FORMAT "%6.3" /end CHARACTERISTIC
/begin MEASUREMENT ti_b1.pdiff "Differenz pks-psau" SWORD FORMULA_0118 0 0 0.0 10.0000 ECU_ADDRESS 0x3FD248 /end MEASUREMENT
/begin MEASUREMENT ti_b2.pdiff "Differenz pks-psau" SWORD FORMULA_0118 0 0 0.0 10.0000 ECU_ADDRESS 0x3FD276 /end MEASUREMENT
/begin MEASUREMENT ti_b1.rho_f "Kompensationsfak. Kraftsoffdichte" UWORD FORMULA_0805 0 0 0.0 511.9921 ECU_ADDRESS 0x3FD24A /end MEASUREMENT
/begin MEASUREMENT ti_b2.rho_f "Kompensationsfak. Kraftsoffdichte" UWORD FORMULA_0805 0 0 0.0 511.9921 ECU_ADDRESS 0x3FD278 /end MEASUREMENT
/begin MEASUREMENT ti_b1.qstat_f "proportionaler Ventilparameter" UWORD FORMULA_1162 0 0 0.0 6.0000 ECU_ADDRESS 0x3FD24C /end MEASUREMENT
/begin MEASUREMENT ti_b2.qstat_f "proportionaler Ventilparameter" UWORD FORMULA_1162 0 0 0.0 6.0000 ECU_ADDRESS 0x3FD27A /end MEASUREMENT
/begin MEASUREMENT ti_b1.ub_offs "UB-abhaengiger TI-Offset" UWORD FORMULA_0786 0 0 0.0 65.5350 ECU_ADDRESS 0x3FD24E /end MEASUREMENT
/begin MEASUREMENT ti_b2.ub_offs "UB-abhaengiger TI-Offset" UWORD FORMULA_0786 0 0 0.0 65.5350 ECU_ADDRESS 0x3FD27C /end MEASUREMENT
/begin MEASUREMENT ti_b1.t_korr_f "saugrohrwandtemperaturabh. Faktor" UWORD FORMULA_0075 0 0 0.0 4.0000 ECU_ADDRESS 0x3FD250 /end MEASUREMENT
/begin MEASUREMENT ti_b2.t_korr_f "saugrohrwandtemperaturabh. Faktor" UWORD FORMULA_0075 0 0 0.0 4.0000 ECU_ADDRESS 0x3FD27E /end MEASUREMENT
/begin MEASUREMENT ti_b1.laa_offs_wicht_f "Korrekturfaktor - Lambdaadaptionsoffset" UWORD FORMULA_0075 0 0 0.0 4.0000 ECU_ADDRESS 0x3FD252 /end MEASUREMENT
/begin MEASUREMENT ti_b2.laa_offs_wicht_f "Korrekturfaktor - Lambdaadaptionsoffset" UWORD FORMULA_0075 0 0 0.0 4.0000 ECU_ADDRESS 0x3FD280 /end MEASUREMENT
/begin MEASUREMENT ti_b1.min "min. TI-Zeit" UWORD FORMULA_0786 0 0 0.0 65.5350 ECU_ADDRESS 0x3FD254 /end MEASUREMENT
/begin MEASUREMENT ti_b2.min "min. TI-Zeit" UWORD FORMULA_0786 0 0 0.0 65.5350 ECU_ADDRESS 0x3FD282 /end MEASUREMENT
/begin MEASUREMENT ti_b1.ml_mg_zyl "zyl. Luftmasse in mg/ASP" SWORD FORMULA_0093 0 0 -3276.7000 3276.7000 ECU_ADDRESS 0x3FD256 /end MEASUREMENT
/begin MEASUREMENT ti_b2.ml_mg_zyl "zyl. Luftmasse in mg/ASP" SWORD FORMULA_0093 0 0 -3276.7000 3276.7000 ECU_ADDRESS 0x3FD284 /end MEASUREMENT
/begin MEASUREMENT ti_b1.ml_mg_la "Luftmasse/Zyl incl. LA-Einfl." UWORD FORMULA_0752 0 0 0.0 1023.9843 ECU_ADDRESS 0x3FD258 /end MEASUREMENT
/begin MEASUREMENT ti_b2.ml_mg_la "Luftmasse/Zyl incl. LA-Einfl." UWORD FORMULA_0752 0 0 0.0 1023.9843 ECU_ADDRESS 0x3FD286 /end MEASUREMENT
/begin MEASUREMENT ti_b1.ml_mg_la_f "Luftmasse/Zyl nur mit LA-F-Einfl." SWORD FORMULA_1163 0 0 -1023.9687 1023.9687 ECU_ADDRESS 0x3FD25A /end MEASUREMENT
/begin MEASUREMENT ti_b2.ml_mg_la_f "Luftmasse/Zyl nur mit LA-F-Einfl." SWORD FORMULA_1163 0 0 -1023.9687 1023.9687 ECU_ADDRESS 0x3FD288 /end MEASUREMENT
/begin MEASUREMENT ti_b1.mks_roh "Einspritzmasse ohne WL" UWORD FORMULA_0752 0 0 0.0 1023.9843 ECU_ADDRESS 0x3FD25C /end MEASUREMENT
/begin MEASUREMENT ti_b2.mks_roh "Einspritzmasse ohne WL" UWORD FORMULA_0752 0 0 0.0 1023.9843 ECU_ADDRESS 0x3FD28A /end MEASUREMENT
/begin MEASUREMENT ti_b1.mks_grund "Grundeinspritzmasse mit WL" UWORD FORMULA_0752 0 0 0.0 1023.9843 ECU_ADDRESS 0x3FD25E /end MEASUREMENT
/begin MEASUREMENT ti_b2.mks_grund "Grundeinspritzmasse mit WL" UWORD FORMULA_0752 0 0 0.0 1023.9843 ECU_ADDRESS 0x3FD28C /end MEASUREMENT
/begin MEASUREMENT ti_b1.phi_ende_grad "Gradient fuer Aenderungsbegr." SWORD FORMULA_0111 0 0 -72.0000 1440.0000 ECU_ADDRESS 0x3FD260 /end MEASUREMENT
/begin MEASUREMENT ti_b2.phi_ende_grad "Gradient fuer Aenderungsbegr." SWORD FORMULA_0111 0 0 -72.0000 1440.0000 ECU_ADDRESS 0x3FD28E /end MEASUREMENT
/begin MEASUREMENT ti_b1.phi_ende_roh "Einspritzendewinkel vor Aenderungsbegr." SWORD FORMULA_0111 0 0 -72.0000 1440.0000 ECU_ADDRESS 0x3FD262 /end MEASUREMENT
/begin MEASUREMENT ti_b2.phi_ende_roh "Einspritzendewinkel vor Aenderungsbegr." SWORD FORMULA_0111 0 0 -72.0000 1440.0000 ECU_ADDRESS 0x3FD290 /end MEASUREMENT
/begin MEASUREMENT ti_b1.phi_ende "Einspritzendewinkel" SWORD FORMULA_0111 0 0 -72.0000 1440.0000 ECU_ADDRESS 0x3FD264 /end MEASUREMENT
/begin MEASUREMENT ti_b2.phi_ende "Einspritzendewinkel" SWORD FORMULA_0111 0 0 -72.0000 1440.0000 ECU_ADDRESS 0x3FD292 /end MEASUREMENT
/begin MEASUREMENT ti_b1.phi_ende_grund "Vorlagerungsgrundwinkel" SWORD FORMULA_0111 0 0 -72.0000 1440.0000 ECU_ADDRESS 0x3FD266 /end MEASUREMENT
/begin MEASUREMENT ti_b2.phi_ende_grund "Vorlagerungsgrundwinkel" SWORD FORMULA_0111 0 0 -72.0000 1440.0000 ECU_ADDRESS 0x3FD294 /end MEASUREMENT
/begin MEASUREMENT ti_b1.phi_ev_v "Fluggeschwindigkeit Kraftstoff" SWORD FORMULA_1164 0 0 0.0 220.0000 ECU_ADDRESS 0x3FD268 /end MEASUREMENT
/begin MEASUREMENT ti_b2.phi_ev_v "Fluggeschwindigkeit Kraftstoff" SWORD FORMULA_1164 0 0 0.0 220.0000 ECU_ADDRESS 0x3FD296 /end MEASUREMENT
/begin MEASUREMENT ti_b1.phi_ks_v "Fluggeschwindigkeit Kraftstoff" SWORD FORMULA_1164 0 0 0.0 220.0000 ECU_ADDRESS 0x3FD26A /end MEASUREMENT
/begin MEASUREMENT ti_b2.phi_ks_v "Fluggeschwindigkeit Kraftstoff" SWORD FORMULA_1164 0 0 0.0 220.0000 ECU_ADDRESS 0x3FD298 /end MEASUREMENT
/begin MEASUREMENT ti_b1.phi_ende_flug "Flugwinkel Kraftstoff" SWORD FORMULA_0111 0 0 -72.0000 1440.0000 ECU_ADDRESS 0x3FD26C /end MEASUREMENT
/begin MEASUREMENT ti_b2.phi_ende_flug "Flugwinkel Kraftstoff" SWORD FORMULA_0111 0 0 -72.0000 1440.0000 ECU_ADDRESS 0x3FD29A /end MEASUREMENT
/begin MEASUREMENT ti_b1.phi_ende_min "min. Einspritzendewinkel" SWORD FORMULA_0111 0 0 -72.0000 1440.0000 ECU_ADDRESS 0x3FD26E /end MEASUREMENT
/begin MEASUREMENT ti_b2.phi_ende_min "min. Einspritzendewinkel" SWORD FORMULA_0111 0 0 -72.0000 1440.0000 ECU_ADDRESS 0x3FD29C /end MEASUREMENT
/begin MEASUREMENT ti_b1.mks_max "max. MKS fuer TI" UWORD FORMULA_0752 0 0 0.0 1023.9843 ECU_ADDRESS 0x3FD270 /end MEASUREMENT
/begin MEASUREMENT ti_b2.mks_max "max. MKS fuer TI" UWORD FORMULA_0752 0 0 0.0 1023.9843 ECU_ADDRESS 0x3FD29E /end MEASUREMENT
/begin MEASUREMENT ti_b1.ml_max "max. ML aus ti_mks_max" UWORD FORMULA_0093 0 0 0.0 6553.5000 ECU_ADDRESS 0x3FD272 /end MEASUREMENT
/begin MEASUREMENT ti_b2.ml_max "max. ML aus ti_mks_max" UWORD FORMULA_0093 0 0 0.0 6553.5000 ECU_ADDRESS 0x3FD2A0 /end MEASUREMENT
/begin MEASUREMENT ti_max_lim "ti_max f. Ermittlung von B_TIM_MAX u. Druckerhoehung" ULONG FORMULA_0358 0 0 0.0 655.3600 ECU_ADDRESS 0x3FD2A4 /end MEASUREMENT
/begin MEASUREMENT ti_tpu_start "TI-TPU-Start-Status" UWORD FORMULA_0010 0 0 0.0 65535.0000 ECU_ADDRESS 0x3FD2A8 /end MEASUREMENT
/begin MEASUREMENT ti_segm_cnt "TI Segmentzaehler" UWORD FORMULA_0010 0 0 0.0 65535.0000 ECU_ADDRESS 0x3FD2AA /end MEASUREMENT
/begin MEASUREMENT ti_lin_offs_zyl1 "Kompensationsoffset" SWORD FORMULA_0786 0 0 -32.3680 32.7670 ECU_ADDRESS 0x3FD2AC /end MEASUREMENT
/begin MEASUREMENT ti_lin_offs_zyl2 "Kompensationsoffset" SWORD FORMULA_0786 0 0 -32.3680 32.7670 ECU_ADDRESS 0x3FD2AE /end MEASUREMENT
/begin MEASUREMENT ti_lin_offs_zyl3 "Kompensationsoffset" SWORD FORMULA_0786 0 0 -32.3680 32.7670 ECU_ADDRESS 0x3FD2B0 /end MEASUREMENT
/begin MEASUREMENT ti_lin_offs_zyl4 "Kompensationsoffset" SWORD FORMULA_0786 0 0 -32.3680 32.7670 ECU_ADDRESS 0x3FD2B2 /end MEASUREMENT
/begin MEASUREMENT ti_lin_offs_zyl5 "Kompensationsoffset" SWORD FORMULA_0786 0 0 -32.3680 32.7670 ECU_ADDRESS 0x3FD2B4 /end MEASUREMENT
/begin MEASUREMENT ti_lin_offs_zyl6 "Kompensationsoffset" SWORD FORMULA_0786 0 0 -32.3680 32.7670 ECU_ADDRESS 0x3FD2B6 /end MEASUREMENT
/begin MEASUREMENT ti_lin_offs_zyl7 "Kompensationsoffset" SWORD FORMULA_0786 0 0 -32.3680 32.7670 ECU_ADDRESS 0x3FD2B8 /end MEASUREMENT
/begin MEASUREMENT ti_lin_offs_zyl8 "Kompensationsoffset" SWORD FORMULA_0786 0 0 -32.3680 32.7670 ECU_ADDRESS 0x3FD2BA /end MEASUREMENT
/begin MEASUREMENT ti_lin_offs_zyl9 "Kompensationsoffset" SWORD FORMULA_0786 0 0 -32.3680 32.7670 ECU_ADDRESS 0x3FD2BC /end MEASUREMENT
/begin MEASUREMENT ti_lin_offs_zyl10 "Kompensationsoffset" SWORD FORMULA_0786 0 0 -32.3680 32.7670 ECU_ADDRESS 0x3FD2BE /end MEASUREMENT
/begin MEASUREMENT ti_mks_start_roh "START-Grundkennfeldwert" UWORD FORMULA_0752 0 0 0.0 1023.9843 ECU_ADDRESS 0x3FD2C0 /end MEASUREMENT
/begin MEASUREMENT ti_mks_start_korr "druckkorr. START-Grundkennfeldwert" UWORD FORMULA_0752 0 0 0.0 1023.9843 ECU_ADDRESS 0x3FD2C2 /end MEASUREMENT
/begin MEASUREMENT ti_mks_start "START-Grundeinspritzmasse" UWORD FORMULA_0752 0 0 0.0 1023.9843 ECU_ADDRESS 0x3FD2C4 /end MEASUREMENT
/begin MEASUREMENT ti_start_pumg_f "Umgebungsdruckwichtung im START" UWORD FORMULA_0075 0 0 0.0 4.0000 ECU_ADDRESS 0x3FD2C6 /end MEASUREMENT
/begin MEASUREMENT ti_start_f "Abregelfaktor im START" UWORD FORMULA_0075 0 0 0.0 4.0000 ECU_ADDRESS 0x3FD2C8 /end MEASUREMENT
/begin MEASUREMENT ti_mks_soll_zyl1 "SOLL-Einspritzmasse" UWORD FORMULA_0752 0 0 0.0 1023.9843 ECU_ADDRESS 0x3FD2CA /end MEASUREMENT
/begin MEASUREMENT ti_mks_soll_zyl2 "SOLL-Einspritzmasse" UWORD FORMULA_0752 0 0 0.0 1023.9843 ECU_ADDRESS 0x3FD2CC /end MEASUREMENT
/begin MEASUREMENT ti_mks_soll_zyl3 "SOLL-Einspritzmasse" UWORD FORMULA_0752 0 0 0.0 1023.9843 ECU_ADDRESS 0x3FD2CE /end MEASUREMENT
/begin MEASUREMENT ti_mks_soll_zyl4 "SOLL-Einspritzmasse" UWORD FORMULA_0752 0 0 0.0 1023.9843 ECU_ADDRESS 0x3FD2D0 /end MEASUREMENT
/begin MEASUREMENT ti_mks_soll_zyl5 "SOLL-Einspritzmasse" UWORD FORMULA_0752 0 0 0.0 1023.9843 ECU_ADDRESS 0x3FD2D2 /end MEASUREMENT
/begin MEASUREMENT ti_mks_soll_zyl6 "SOLL-Einspritzmasse" UWORD FORMULA_0752 0 0 0.0 1023.9843 ECU_ADDRESS 0x3FD2D4 /end MEASUREMENT
/begin MEASUREMENT ti_mks_soll_zyl7 "SOLL-Einspritzmasse" UWORD FORMULA_0752 0 0 0.0 1023.9843 ECU_ADDRESS 0x3FD2D6 /end MEASUREMENT
/begin MEASUREMENT ti_mks_soll_zyl8 "SOLL-Einspritzmasse" UWORD FORMULA_0752 0 0 0.0 1023.9843 ECU_ADDRESS 0x3FD2D8 /end MEASUREMENT
/begin MEASUREMENT ti_mks_soll_zyl9 "SOLL-Einspritzmasse" UWORD FORMULA_0752 0 0 0.0 1023.9843 ECU_ADDRESS 0x3FD2DA /end MEASUREMENT
/begin MEASUREMENT ti_mks_soll_zyl10 "SOLL-Einspritzmasse" UWORD FORMULA_0752 0 0 0.0 1023.9843 ECU_ADDRESS 0x3FD2DC /end MEASUREMENT
/begin MEASUREMENT ti_mks_ns_grund "Grundeinspritzmasse Nachstart" UWORD FORMULA_0529 0 0 0.0 16383.7500 ECU_ADDRESS 0x3FD2DE /end MEASUREMENT
/begin MEASUREMENT ti_mks_ns_zyl1 "Einspritzmasse Nachstart" UWORD FORMULA_0752 0 0 0.0 1023.9843 ECU_ADDRESS 0x3FD2E0 /end MEASUREMENT
/begin MEASUREMENT ti_mks_ns_zyl2 "Einspritzmasse Nachstart" UWORD FORMULA_0752 0 0 0.0 1023.9843 ECU_ADDRESS 0x3FD2E2 /end MEASUREMENT
/begin MEASUREMENT ti_mks_ns_zyl3 "Einspritzmasse Nachstart" UWORD FORMULA_0752 0 0 0.0 1023.9843 ECU_ADDRESS 0x3FD2E4 /end MEASUREMENT
/begin MEASUREMENT ti_mks_ns_zyl4 "Einspritzmasse Nachstart" UWORD FORMULA_0752 0 0 0.0 1023.9843 ECU_ADDRESS 0x3FD2E6 /end MEASUREMENT
/begin MEASUREMENT ti_mks_ns_zyl5 "Einspritzmasse Nachstart" UWORD FORMULA_0752 0 0 0.0 1023.9843 ECU_ADDRESS 0x3FD2E8 /end MEASUREMENT
/begin MEASUREMENT ti_mks_ns_zyl6 "Einspritzmasse Nachstart" UWORD FORMULA_0752 0 0 0.0 1023.9843 ECU_ADDRESS 0x3FD2EA /end MEASUREMENT
/begin MEASUREMENT ti_mks_ns_zyl7 "Einspritzmasse Nachstart" UWORD FORMULA_0752 0 0 0.0 1023.9843 ECU_ADDRESS 0x3FD2EC /end MEASUREMENT
/begin MEASUREMENT ti_mks_ns_zyl8 "Einspritzmasse Nachstart" UWORD FORMULA_0752 0 0 0.0 1023.9843 ECU_ADDRESS 0x3FD2EE /end MEASUREMENT
/begin MEASUREMENT ti_mks_ns_zyl9 "Einspritzmasse Nachstart" UWORD FORMULA_0752 0 0 0.0 1023.9843 ECU_ADDRESS 0x3FD2F0 /end MEASUREMENT
/begin MEASUREMENT ti_mks_ns_zyl10 "Einspritzmasse Nachstart" UWORD FORMULA_0752 0 0 0.0 1023.9843 ECU_ADDRESS 0x3FD2F2 /end MEASUREMENT
/begin MEASUREMENT ti_mks_ns_ist_zyl1 "IST-Kraftstoffmenge im NS" UWORD FORMULA_0529 0 0 0.0 16383.7500 ECU_ADDRESS 0x3FD2F4 /end MEASUREMENT
/begin MEASUREMENT ti_mks_ns_ist_zyl2 "IST-Kraftstoffmenge im NS" UWORD FORMULA_0529 0 0 0.0 16383.7500 ECU_ADDRESS 0x3FD2F6 /end MEASUREMENT
/begin MEASUREMENT ti_mks_ns_ist_zyl3 "IST-Kraftstoffmenge im NS" UWORD FORMULA_0529 0 0 0.0 16383.7500 ECU_ADDRESS 0x3FD2F8 /end MEASUREMENT
/begin MEASUREMENT ti_mks_ns_ist_zyl4 "IST-Kraftstoffmenge im NS" UWORD FORMULA_0529 0 0 0.0 16383.7500 ECU_ADDRESS 0x3FD2FA /end MEASUREMENT
/begin MEASUREMENT ti_mks_ns_ist_zyl5 "IST-Kraftstoffmenge im NS" UWORD FORMULA_0529 0 0 0.0 16383.7500 ECU_ADDRESS 0x3FD2FC /end MEASUREMENT
/begin MEASUREMENT ti_mks_ns_ist_zyl6 "IST-Kraftstoffmenge im NS" UWORD FORMULA_0529 0 0 0.0 16383.7500 ECU_ADDRESS 0x3FD2FE /end MEASUREMENT
/begin MEASUREMENT ti_mks_ns_ist_zyl7 "IST-Kraftstoffmenge im NS" UWORD FORMULA_0529 0 0 0.0 16383.7500 ECU_ADDRESS 0x3FD300 /end MEASUREMENT
/begin MEASUREMENT ti_mks_ns_ist_zyl8 "IST-Kraftstoffmenge im NS" UWORD FORMULA_0529 0 0 0.0 16383.7500 ECU_ADDRESS 0x3FD302 /end MEASUREMENT
/begin MEASUREMENT ti_mks_ns_ist_zyl9 "IST-Kraftstoffmenge im NS" UWORD FORMULA_0529 0 0 0.0 16383.7500 ECU_ADDRESS 0x3FD304 /end MEASUREMENT
/begin MEASUREMENT ti_mks_ns_ist_zyl10 "IST-Kraftstoffmenge im NS" UWORD FORMULA_0529 0 0 0.0 16383.7500 ECU_ADDRESS 0x3FD306 /end MEASUREMENT
/begin MEASUREMENT ti_mks_ns_ist_init_b1 "INIT - Einspritzmasse Nachstart" UWORD FORMULA_0529 0 0 0.0 16383.7500 ECU_ADDRESS 0x3FD308 /end MEASUREMENT
/begin MEASUREMENT ti_mks_ns_ist_init_b2 "INIT - Einspritzmasse Nachstart" UWORD FORMULA_0529 0 0 0.0 16383.7500 ECU_ADDRESS 0x3FD30A /end MEASUREMENT
/begin MEASUREMENT ti_mks_ns_rel_zyl1 "rel. Kraftstoffeintrag in NS" UWORD FORMULA_0075 0 0 0.0 4.0000 ECU_ADDRESS 0x3FD30C /end MEASUREMENT
/begin MEASUREMENT ti_mks_ns_rel_zyl2 "rel. Kraftstoffeintrag in NS" UWORD FORMULA_0075 0 0 0.0 4.0000 ECU_ADDRESS 0x3FD30E /end MEASUREMENT
/begin MEASUREMENT ti_mks_ns_rel_zyl3 "rel. Kraftstoffeintrag in NS" UWORD FORMULA_0075 0 0 0.0 4.0000 ECU_ADDRESS 0x3FD310 /end MEASUREMENT
/begin MEASUREMENT ti_mks_ns_rel_zyl4 "rel. Kraftstoffeintrag in NS" UWORD FORMULA_0075 0 0 0.0 4.0000 ECU_ADDRESS 0x3FD312 /end MEASUREMENT
/begin MEASUREMENT ti_mks_ns_rel_zyl5 "rel. Kraftstoffeintrag in NS" UWORD FORMULA_0075 0 0 0.0 4.0000 ECU_ADDRESS 0x3FD314 /end MEASUREMENT
/begin MEASUREMENT ti_mks_ns_rel_zyl6 "rel. Kraftstoffeintrag in NS" UWORD FORMULA_0075 0 0 0.0 4.0000 ECU_ADDRESS 0x3FD316 /end MEASUREMENT
/begin MEASUREMENT ti_mks_ns_rel_zyl7 "rel. Kraftstoffeintrag in NS" UWORD FORMULA_0075 0 0 0.0 4.0000 ECU_ADDRESS 0x3FD318 /end MEASUREMENT
/begin MEASUREMENT ti_mks_ns_rel_zyl8 "rel. Kraftstoffeintrag in NS" UWORD FORMULA_0075 0 0 0.0 4.0000 ECU_ADDRESS 0x3FD31A /end MEASUREMENT
/begin MEASUREMENT ti_mks_ns_rel_zyl9 "rel. Kraftstoffeintrag in NS" UWORD FORMULA_0075 0 0 0.0 4.0000 ECU_ADDRESS 0x3FD31C /end MEASUREMENT
/begin MEASUREMENT ti_mks_ns_rel_zyl10 "rel. Kraftstoffeintrag in NS" UWORD FORMULA_0075 0 0 0.0 4.0000 ECU_ADDRESS 0x3FD31E /end MEASUREMENT
/begin MEASUREMENT ti_seg_time_f_zyl1 "Nachstart-Manipulationsfaktor" UWORD FORMULA_0075 0 0 0.0 4.0000 ECU_ADDRESS 0x3FD320 /end MEASUREMENT
/begin MEASUREMENT ti_seg_time_f_zyl2 "Nachstart-Manipulationsfaktor" UWORD FORMULA_0075 0 0 0.0 4.0000 ECU_ADDRESS 0x3FD322 /end MEASUREMENT
/begin MEASUREMENT ti_seg_time_f_zyl3 "Nachstart-Manipulationsfaktor" UWORD FORMULA_0075 0 0 0.0 4.0000 ECU_ADDRESS 0x3FD324 /end MEASUREMENT
/begin MEASUREMENT ti_seg_time_f_zyl4 "Nachstart-Manipulationsfaktor" UWORD FORMULA_0075 0 0 0.0 4.0000 ECU_ADDRESS 0x3FD326 /end MEASUREMENT
/begin MEASUREMENT ti_seg_time_f_zyl5 "Nachstart-Manipulationsfaktor" UWORD FORMULA_0075 0 0 0.0 4.0000 ECU_ADDRESS 0x3FD328 /end MEASUREMENT
/begin MEASUREMENT ti_seg_time_f_zyl6 "Nachstart-Manipulationsfaktor" UWORD FORMULA_0075 0 0 0.0 4.0000 ECU_ADDRESS 0x3FD32A /end MEASUREMENT
/begin MEASUREMENT ti_seg_time_f_zyl7 "Nachstart-Manipulationsfaktor" UWORD FORMULA_0075 0 0 0.0 4.0000 ECU_ADDRESS 0x3FD32C /end MEASUREMENT
/begin MEASUREMENT ti_seg_time_f_zyl8 "Nachstart-Manipulationsfaktor" UWORD FORMULA_0075 0 0 0.0 4.0000 ECU_ADDRESS 0x3FD32E /end MEASUREMENT
/begin MEASUREMENT ti_seg_time_f_zyl9 "Nachstart-Manipulationsfaktor" UWORD FORMULA_0075 0 0 0.0 4.0000 ECU_ADDRESS 0x3FD330 /end MEASUREMENT
/begin MEASUREMENT ti_seg_time_f_zyl10 "Nachstart-Manipulationsfaktor" UWORD FORMULA_0075 0 0 0.0 4.0000 ECU_ADDRESS 0x3FD332 /end MEASUREMENT
/begin MEASUREMENT ti_ns_f "Nachstartfaktor auf Grundeinspritzmenge" UWORD FORMULA_0075 0 0 0.0 4.0000 ECU_ADDRESS 0x3FD334 /end MEASUREMENT
/begin MEASUREMENT ti_nw_asp_cnt "720� Arbeitsspielzaehler - aktueller Motorlauf" SWORD FORMULA_0010 0 0 0.0 32767.0000 ECU_ADDRESS 0x3FD336 /end MEASUREMENT
/begin MEASUREMENT ti_max "max. TI" ULONG FORMULA_0358 0 0 0.0 655.3600 ECU_ADDRESS 0x3FD338 /end MEASUREMENT
/begin MEASUREMENT ti_soll_zyl1 "SOLL-TI ohne Korrekturen" ULONG FORMULA_0358 0 0 0.0 655.3600 ECU_ADDRESS 0x3FD33C /end MEASUREMENT
/begin MEASUREMENT ti_soll_zyl2 "SOLL-TI ohne Korrekturen" ULONG FORMULA_0358 0 0 0.0 655.3600 ECU_ADDRESS 0x3FD340 /end MEASUREMENT
/begin MEASUREMENT ti_soll_zyl3 "SOLL-TI ohne Korrekturen" ULONG FORMULA_0358 0 0 0.0 655.3600 ECU_ADDRESS 0x3FD344 /end MEASUREMENT
/begin MEASUREMENT ti_soll_zyl4 "SOLL-TI ohne Korrekturen" ULONG FORMULA_0358 0 0 0.0 655.3600 ECU_ADDRESS 0x3FD348 /end MEASUREMENT
/begin MEASUREMENT ti_soll_zyl5 "SOLL-TI ohne Korrekturen" ULONG FORMULA_0358 0 0 0.0 655.3600 ECU_ADDRESS 0x3FD34C /end MEASUREMENT
/begin MEASUREMENT ti_soll_zyl6 "SOLL-TI ohne Korrekturen" ULONG FORMULA_0358 0 0 0.0 655.3600 ECU_ADDRESS 0x3FD350 /end MEASUREMENT
/begin MEASUREMENT ti_soll_zyl7 "SOLL-TI ohne Korrekturen" ULONG FORMULA_0358 0 0 0.0 655.3600 ECU_ADDRESS 0x3FD354 /end MEASUREMENT
/begin MEASUREMENT ti_soll_zyl8 "SOLL-TI ohne Korrekturen" ULONG FORMULA_0358 0 0 0.0 655.3600 ECU_ADDRESS 0x3FD358 /end MEASUREMENT
/begin MEASUREMENT ti_soll_zyl9 "SOLL-TI ohne Korrekturen" ULONG FORMULA_0358 0 0 0.0 655.3600 ECU_ADDRESS 0x3FD35C /end MEASUREMENT
/begin MEASUREMENT ti_soll_zyl10 "SOLL-TI ohne Korrekturen" ULONG FORMULA_0358 0 0 0.0 655.3600 ECU_ADDRESS 0x3FD360 /end MEASUREMENT
/begin MEASUREMENT ti_berech_zyl1 "TI mit allen Korrekturen" ULONG FORMULA_0358 0 0 0.0 655.3600 ECU_ADDRESS 0x3FD364 /end MEASUREMENT
/begin MEASUREMENT ti_berech_zyl2 "TI mit allen Korrekturen" ULONG FORMULA_0358 0 0 0.0 655.3600 ECU_ADDRESS 0x3FD368 /end MEASUREMENT
/begin MEASUREMENT ti_berech_zyl3 "TI mit allen Korrekturen" ULONG FORMULA_0358 0 0 0.0 655.3600 ECU_ADDRESS 0x3FD36C /end MEASUREMENT
/begin MEASUREMENT ti_berech_zyl4 "TI mit allen Korrekturen" ULONG FORMULA_0358 0 0 0.0 655.3600 ECU_ADDRESS 0x3FD370 /end MEASUREMENT
/begin MEASUREMENT ti_berech_zyl5 "TI mit allen Korrekturen" ULONG FORMULA_0358 0 0 0.0 655.3600 ECU_ADDRESS 0x3FD374 /end MEASUREMENT
/begin MEASUREMENT ti_berech_zyl6 "TI mit allen Korrekturen" ULONG FORMULA_0358 0 0 0.0 655.3600 ECU_ADDRESS 0x3FD378 /end MEASUREMENT
/begin MEASUREMENT ti_berech_zyl7 "TI mit allen Korrekturen" ULONG FORMULA_0358 0 0 0.0 655.3600 ECU_ADDRESS 0x3FD37C /end MEASUREMENT
/begin MEASUREMENT ti_berech_zyl8 "TI mit allen Korrekturen" ULONG FORMULA_0358 0 0 0.0 655.3600 ECU_ADDRESS 0x3FD380 /end MEASUREMENT
/begin MEASUREMENT ti_berech_zyl9 "TI mit allen Korrekturen" ULONG FORMULA_0358 0 0 0.0 655.3600 ECU_ADDRESS 0x3FD384 /end MEASUREMENT
/begin MEASUREMENT ti_berech_zyl10 "TI mit allen Korrekturen" ULONG FORMULA_0358 0 0 0.0 655.3600 ECU_ADDRESS 0x3FD388 /end MEASUREMENT
/begin MEASUREMENT ti_tpu_zyl1 "begrenztes, ausgegebenes TI" ULONG FORMULA_0358 0 0 0.0 655.3600 ECU_ADDRESS 0x3FD38C /end MEASUREMENT
/begin MEASUREMENT ti_tpu_zyl2 "begrenztes, ausgegebenes TI" ULONG FORMULA_0358 0 0 0.0 655.3600 ECU_ADDRESS 0x3FD390 /end MEASUREMENT
/begin MEASUREMENT ti_tpu_zyl3 "begrenztes, ausgegebenes TI" ULONG FORMULA_0358 0 0 0.0 655.3600 ECU_ADDRESS 0x3FD394 /end MEASUREMENT
/begin MEASUREMENT ti_tpu_zyl4 "begrenztes, ausgegebenes TI" ULONG FORMULA_0358 0 0 0.0 655.3600 ECU_ADDRESS 0x3FD398 /end MEASUREMENT
/begin MEASUREMENT ti_tpu_zyl5 "begrenztes, ausgegebenes TI" ULONG FORMULA_0358 0 0 0.0 655.3600 ECU_ADDRESS 0x3FD39C /end MEASUREMENT
/begin MEASUREMENT ti_tpu_zyl6 "begrenztes, ausgegebenes TI" ULONG FORMULA_0358 0 0 0.0 655.3600 ECU_ADDRESS 0x3FD3A0 /end MEASUREMENT
/begin MEASUREMENT ti_tpu_zyl7 "begrenztes, ausgegebenes TI" ULONG FORMULA_0358 0 0 0.0 655.3600 ECU_ADDRESS 0x3FD3A4 /end MEASUREMENT
/begin MEASUREMENT ti_tpu_zyl8 "begrenztes, ausgegebenes TI" ULONG FORMULA_0358 0 0 0.0 655.3600 ECU_ADDRESS 0x3FD3A8 /end MEASUREMENT
/begin MEASUREMENT ti_tpu_zyl9 "begrenztes, ausgegebenes TI" ULONG FORMULA_0358 0 0 0.0 655.3600 ECU_ADDRESS 0x3FD3AC /end MEASUREMENT
/begin MEASUREMENT ti_tpu_zyl10 "begrenztes, ausgegebenes TI" ULONG FORMULA_0358 0 0 0.0 655.3600 ECU_ADDRESS 0x3FD3B0 /end MEASUREMENT
/begin MEASUREMENT ti_phi_ende_start "ti_ende im START" SWORD FORMULA_0111 0 0 -72.0000 1440.0000 ECU_ADDRESS 0x3FD3B4 /end MEASUREMENT
/begin MEASUREMENT ti_phi_ende_offs_b1 "Offset Einspritzendewinkel" SWORD FORMULA_0111 0 0 -720.0000 720.0000 ECU_ADDRESS 0x3FD3B6 /end MEASUREMENT
/begin MEASUREMENT ti_phi_ende_offs_b2 "Offset Einspritzendewinkel" SWORD FORMULA_0111 0 0 -720.0000 720.0000 ECU_ADDRESS 0x3FD3B8 /end MEASUREMENT
/begin MEASUREMENT ti_phi_flug_v "Fluggeschwindigkeit Kraftstoff" SWORD FORMULA_1164 0 0 0.0 220.0000 ECU_ADDRESS 0x3FD3BA /end MEASUREMENT
/begin MEASUREMENT ti_phi_ev_v_wurz "Beschleunigung Kraftstoff" UWORD FORMULA_1165 0 0 0.0 1638.3750 ECU_ADDRESS 0x3FD3BC /end MEASUREMENT
/begin MEASUREMENT lwv_mks "MKS aus Ladungswechselmodell" SWORD FORMULA_0752 0 0 -512.0000 511.0000 ECU_ADDRESS 0x3FD3BE /end MEASUREMENT
/begin MEASUREMENT ti_out_zyl1 "Ausgegebene Einspritzzeit im letzten Arbeitsspiel." ULONG FORMULA_0358 0 0 4194.3030 0.0 ECU_ADDRESS 0x3FD3C0 /end MEASUREMENT
/begin MEASUREMENT ti_out_zyl2 "Ausgegebene Einspritzzeit im letzten Arbeitsspiel." ULONG FORMULA_0358 0 0 4194.3030 0.0 ECU_ADDRESS 0x3FD3C4 /end MEASUREMENT
/begin MEASUREMENT ti_out_zyl3 "Ausgegebene Einspritzzeit im letzten Arbeitsspiel." ULONG FORMULA_0358 0 0 4194.3030 0.0 ECU_ADDRESS 0x3FD3C8 /end MEASUREMENT
/begin MEASUREMENT ti_out_zyl4 "Ausgegebene Einspritzzeit im letzten Arbeitsspiel." ULONG FORMULA_0358 0 0 4194.3030 0.0 ECU_ADDRESS 0x3FD3CC /end MEASUREMENT
/begin MEASUREMENT ti_out_zyl5 "Ausgegebene Einspritzzeit im letzten Arbeitsspiel." ULONG FORMULA_0358 0 0 4194.3030 0.0 ECU_ADDRESS 0x3FD3D0 /end MEASUREMENT
/begin MEASUREMENT ti_out_zyl6 "Ausgegebene Einspritzzeit im letzten Arbeitsspiel." ULONG FORMULA_0358 0 0 4194.3030 0.0 ECU_ADDRESS 0x3FD3D4 /end MEASUREMENT
/begin MEASUREMENT ti_out_zyl7 "Ausgegebene Einspritzzeit im letzten Arbeitsspiel." ULONG FORMULA_0358 0 0 4194.3030 0.0 ECU_ADDRESS 0x3FD3D8 /end MEASUREMENT
/begin MEASUREMENT ti_out_zyl8 "Ausgegebene Einspritzzeit im letzten Arbeitsspiel." ULONG FORMULA_0358 0 0 4194.3030 0.0 ECU_ADDRESS 0x3FD3DC /end MEASUREMENT
/begin MEASUREMENT ti_out_zyl9 "Ausgegebene Einspritzzeit im letzten Arbeitsspiel." ULONG FORMULA_0358 0 0 4194.3030 0.0 ECU_ADDRESS 0x3FD3E0 /end MEASUREMENT
/begin MEASUREMENT ti_out_zyl10 "Ausgegebene Einspritzzeit im letzten Arbeitsspiel." ULONG FORMULA_0358 0 0 4194.3030 0.0 ECU_ADDRESS 0x3FD3E4 /end MEASUREMENT
/begin MEASUREMENT ti_asp_cnt_zyl1 "Arbeitsspielzaehler der Einspritzkanaele." UBYTE FORMULA_0003 0 0 0.0 255.0000 ECU_ADDRESS 0x3FD3E8 /end MEASUREMENT
/begin MEASUREMENT ti_asp_cnt_zyl2 "Arbeitsspielzaehler der Einspritzkanaele." UBYTE FORMULA_0003 0 0 0.0 255.0000 ECU_ADDRESS 0x3FD3E9 /end MEASUREMENT
/begin MEASUREMENT ti_asp_cnt_zyl3 "Arbeitsspielzaehler der Einspritzkanaele." UBYTE FORMULA_0003 0 0 0.0 255.0000 ECU_ADDRESS 0x3FD3EA /end MEASUREMENT
/begin MEASUREMENT ti_asp_cnt_zyl4 "Arbeitsspielzaehler der Einspritzkanaele." UBYTE FORMULA_0003 0 0 0.0 255.0000 ECU_ADDRESS 0x3FD3EB /end MEASUREMENT
/begin MEASUREMENT ti_asp_cnt_zyl5 "Arbeitsspielzaehler der Einspritzkanaele." UBYTE FORMULA_0003 0 0 0.0 255.0000 ECU_ADDRESS 0x3FD3EC /end MEASUREMENT
/begin MEASUREMENT ti_asp_cnt_zyl6 "Arbeitsspielzaehler der Einspritzkanaele." UBYTE FORMULA_0003 0 0 0.0 255.0000 ECU_ADDRESS 0x3FD3ED /end MEASUREMENT
/begin MEASUREMENT ti_asp_cnt_zyl7 "Arbeitsspielzaehler der Einspritzkanaele." UBYTE FORMULA_0003 0 0 0.0 255.0000 ECU_ADDRESS 0x3FD3EE /end MEASUREMENT
/begin MEASUREMENT ti_asp_cnt_zyl8 "Arbeitsspielzaehler der Einspritzkanaele." UBYTE FORMULA_0003 0 0 0.0 255.0000 ECU_ADDRESS 0x3FD3EF /end MEASUREMENT
/begin MEASUREMENT ti_asp_cnt_zyl9 "Arbeitsspielzaehler der Einspritzkanaele." UBYTE FORMULA_0003 0 0 0.0 255.0000 ECU_ADDRESS 0x3FD3F0 /end MEASUREMENT
/begin MEASUREMENT ti_asp_cnt_zyl10 "Arbeitsspielzaehler der Einspritzkanaele." UBYTE FORMULA_0003 0 0 0.0 255.0000 ECU_ADDRESS 0x3FD3F1 /end MEASUREMENT
/begin MEASUREMENT ti_status "TI-Status" UWORD FORMULA_0083 0 0 0.0 65535.0000 ECU_ADDRESS 0x3FD3F2 /end MEASUREMENT
/begin MEASUREMENT ti_status_aus_ti "reine TI-Komplettausblendung" UWORD FORMULA_0895 0 0 0.0 65535.0 ECU_ADDRESS 0x3FD3F2 BIT_MASK 0x1 /end MEASUREMENT
/begin MEASUREMENT ti_status_aus_ti_tz "TI/TZ-Komplettausblendung" UWORD FORMULA_0852 0 0 0.0 65535.0 ECU_ADDRESS 0x3FD3F2 BIT_MASK 0x2 /end MEASUREMENT
/begin MEASUREMENT ti_status_aus_treiber "TI-Ausblendung - Treiberdiagnose" UWORD FORMULA_0768 0 0 0.0 65535.0 ECU_ADDRESS 0x3FD3F2 BIT_MASK 0x4 /end MEASUREMENT
/begin MEASUREMENT ti_status_aus_auss "TI-Ausblendung - Aussetzer" UWORD FORMULA_0836 0 0 0.0 65535.0 ECU_ADDRESS 0x3FD3F2 BIT_MASK 0x8 /end MEASUREMENT
/begin MEASUREMENT ti_status_aus_sk "TI-Ausblendung - Sicherheitsmanager" UWORD FORMULA_0770 0 0 0.0 65535.0 ECU_ADDRESS 0x3FD3F2 BIT_MASK 0x10 /end MEASUREMENT
/begin MEASUREMENT ti_status_aus_egas "TI-Ausblendung - EGAS" UWORD FORMULA_0771 0 0 0.0 65535.0 ECU_ADDRESS 0x3FD3F2 BIT_MASK 0x20 /end MEASUREMENT
/begin MEASUREMENT ti_status_off_cfg "TI-Ausblendung - ueber CFG" UWORD FORMULA_1166 0 0 0.0 65535.0 ECU_ADDRESS 0x3FD3F2 BIT_MASK 0x40 /end MEASUREMENT
/begin MEASUREMENT ti_status_aus_md "TI-Ausblendung - Teilfeuerung" UWORD FORMULA_0827 0 0 0.0 65535.0 ECU_ADDRESS 0x3FD3F2 BIT_MASK 0x80 /end MEASUREMENT
/begin MEASUREMENT ti_status_off_exd "TI-Ausblendung - externe Anforderung" UWORD FORMULA_0772 0 0 0.0 65535.0 ECU_ADDRESS 0x3FD3F2 BIT_MASK 0x100 /end MEASUREMENT
/begin MEASUREMENT ti_wl_f_roh_b1 "ROH-Warmlauffaktor auf TI" UWORD FORMULA_0075 0 0 0.0 4.0000 ECU_ADDRESS 0x3FD3F4 /end MEASUREMENT
/begin MEASUREMENT ti_wl_f_roh_b2 "ROH-Warmlauffaktor auf TI" UWORD FORMULA_0075 0 0 0.0 4.0000 ECU_ADDRESS 0x3FD3F6 /end MEASUREMENT
/begin MEASUREMENT ti_wl_f_kh_b1 "Warmlauffaktor auf TI waehrend KH" UWORD FORMULA_0075 0 0 0.0 4.0000 ECU_ADDRESS 0x3FD3F8 /end MEASUREMENT
/begin MEASUREMENT ti_wl_f_kh_b2 "Warmlauffaktor auf TI waehrend KH" UWORD FORMULA_0075 0 0 0.0 4.0000 ECU_ADDRESS 0x3FD3FA /end MEASUREMENT
/begin MEASUREMENT ti_wl_f_b1 "Warmlauffaktor auf TI" UWORD FORMULA_0075 0 0 0.0 4.0000 ECU_ADDRESS 0x3FD3FC /end MEASUREMENT
/begin MEASUREMENT ti_wl_f_b2 "Warmlauffaktor auf TI" UWORD FORMULA_0075 0 0 0.0 4.0000 ECU_ADDRESS 0x3FD3FE /end MEASUREMENT
/begin MEASUREMENT ti_off_exd "TI-OFF-Status - externe Anforderung" UWORD FORMULA_0010 0 0 0.0 65535.0000 ECU_ADDRESS 0x3FD400 /end MEASUREMENT
/begin MEASUREMENT ti_off_exd_timeout "KWP-Ansteuerzeit" UWORD FORMULA_1030 0 0 0.0 65.5350 ECU_ADDRESS 0x3FD402 /end MEASUREMENT
/begin MEASUREMENT ti_rf_max_dly "Verzoegerungszeit ueber Anzahl Segmente" UWORD FORMULA_1167 0 0 0.0 65535.0000 ECU_ADDRESS 0x3FD404 /end MEASUREMENT
/begin MEASUREMENT zgla_st "Status Zylindergleichstellung" UWORD FORMULA_0083 0 0 0.0 65535.0000 ECU_ADDRESS 0x3FD406 /end MEASUREMENT
/begin MEASUREMENT zgla_st_freigabe "Freigabe Zylindergleichstellung" UWORD FORMULA_1168 0 0 0.0 65535.0 ECU_ADDRESS 0x3FD406 BIT_MASK 0x1 /end MEASUREMENT
/begin MEASUREMENT zgla_st_f_max "Zylindergleichstellung - max. Begrenzung" UWORD FORMULA_1169 0 0 0.0 65535.0 ECU_ADDRESS 0x3FD406 BIT_MASK 0x2 /end MEASUREMENT
/begin MEASUREMENT zgla_st_f_min "Zylindergleichstellung - min. Begrenzung" UWORD FORMULA_1170 0 0 0.0 65535.0 ECU_ADDRESS 0x3FD406 BIT_MASK 0x4 /end MEASUREMENT
/begin MEASUREMENT zgla_zyl_nr_b1 "zu aktualisierender Zylinder" UWORD FORMULA_1171 0 0 0.0 4.0000 ECU_ADDRESS 0x3FD408 /end MEASUREMENT
/begin MEASUREMENT zgla_zyl_nr_b2 "zu aktualisierender Zylinder" UWORD FORMULA_1171 0 0 0.0 4.0000 ECU_ADDRESS 0x3FD40A /end MEASUREMENT
/begin MEASUREMENT zgla_lam_delta_1of2_1of5_ "Delta Einzellambda zu Lambdamittelwert" SWORD FORMULA_0025 0 0 -2.0000 1.9999 ECU_ADDRESS 0x3FD40C /end MEASUREMENT
/begin MEASUREMENT zgla_lam_delta_1of2_2of5_ "Delta Einzellambda zu Lambdamittelwert" SWORD FORMULA_0025 0 0 -2.0000 1.9999 ECU_ADDRESS 0x3FD40E /end MEASUREMENT
/begin MEASUREMENT zgla_lam_delta_1of2_3of5_ "Delta Einzellambda zu Lambdamittelwert" SWORD FORMULA_0025 0 0 -2.0000 1.9999 ECU_ADDRESS 0x3FD410 /end MEASUREMENT
/begin MEASUREMENT zgla_lam_delta_1of2_4of5_ "Delta Einzellambda zu Lambdamittelwert" SWORD FORMULA_0025 0 0 -2.0000 1.9999 ECU_ADDRESS 0x3FD412 /end MEASUREMENT
/begin MEASUREMENT zgla_lam_delta_1of2_5of5_ "Delta Einzellambda zu Lambdamittelwert" SWORD FORMULA_0025 0 0 -2.0000 1.9999 ECU_ADDRESS 0x3FD414 /end MEASUREMENT
/begin MEASUREMENT zgla_lam_delta_2of2_1of5_ "Delta Einzellambda zu Lambdamittelwert" SWORD FORMULA_0025 0 0 -2.0000 1.9999 ECU_ADDRESS 0x3FD416 /end MEASUREMENT
/begin MEASUREMENT zgla_lam_delta_2of2_2of5_ "Delta Einzellambda zu Lambdamittelwert" SWORD FORMULA_0025 0 0 -2.0000 1.9999 ECU_ADDRESS 0x3FD418 /end MEASUREMENT
/begin MEASUREMENT zgla_lam_delta_2of2_3of5_ "Delta Einzellambda zu Lambdamittelwert" SWORD FORMULA_0025 0 0 -2.0000 1.9999 ECU_ADDRESS 0x3FD41A /end MEASUREMENT
/begin MEASUREMENT zgla_lam_delta_2of2_4of5_ "Delta Einzellambda zu Lambdamittelwert" SWORD FORMULA_0025 0 0 -2.0000 1.9999 ECU_ADDRESS 0x3FD41C /end MEASUREMENT
/begin MEASUREMENT zgla_lam_delta_2of2_5of5_ "Delta Einzellambda zu Lambdamittelwert" SWORD FORMULA_0025 0 0 -2.0000 1.9999 ECU_ADDRESS 0x3FD41E /end MEASUREMENT
/begin MEASUREMENT zgla_lam_delta_filt_b1_1of5_ "gefiltertes Delta Einzellambda zu Lambdamittelwert" SWORD FORMULA_0025 0 0 -2.0000 1.9999 ECU_ADDRESS 0x3FD420 /end MEASUREMENT
/begin MEASUREMENT zgla_lam_delta_filt_b1_2of5_ "gefiltertes Delta Einzellambda zu Lambdamittelwert" SWORD FORMULA_0025 0 0 -2.0000 1.9999 ECU_ADDRESS 0x3FD422 /end MEASUREMENT
/begin MEASUREMENT zgla_lam_delta_filt_b1_3of5_ "gefiltertes Delta Einzellambda zu Lambdamittelwert" SWORD FORMULA_0025 0 0 -2.0000 1.9999 ECU_ADDRESS 0x3FD424 /end MEASUREMENT
/begin MEASUREMENT zgla_lam_delta_filt_b1_4of5_ "gefiltertes Delta Einzellambda zu Lambdamittelwert" SWORD FORMULA_0025 0 0 -2.0000 1.9999 ECU_ADDRESS 0x3FD426 /end MEASUREMENT
/begin MEASUREMENT zgla_lam_delta_filt_b1_5of5_ "gefiltertes Delta Einzellambda zu Lambdamittelwert" SWORD FORMULA_0025 0 0 -2.0000 1.9999 ECU_ADDRESS 0x3FD428 /end MEASUREMENT
/begin MEASUREMENT zgla_lam_delta_filt_b2_1of5_ "gefiltertes Delta Einzellambda zu Lambdamittelwert" SWORD FORMULA_0025 0 0 -2.0000 1.9999 ECU_ADDRESS 0x3FD42A /end MEASUREMENT
/begin MEASUREMENT zgla_lam_delta_filt_b2_2of5_ "gefiltertes Delta Einzellambda zu Lambdamittelwert" SWORD FORMULA_0025 0 0 -2.0000 1.9999 ECU_ADDRESS 0x3FD42C /end MEASUREMENT
/begin MEASUREMENT zgla_lam_delta_filt_b2_3of5_ "gefiltertes Delta Einzellambda zu Lambdamittelwert" SWORD FORMULA_0025 0 0 -2.0000 1.9999 ECU_ADDRESS 0x3FD42E /end MEASUREMENT
/begin MEASUREMENT zgla_lam_delta_filt_b2_4of5_ "gefiltertes Delta Einzellambda zu Lambdamittelwert" SWORD FORMULA_0025 0 0 -2.0000 1.9999 ECU_ADDRESS 0x3FD430 /end MEASUREMENT
/begin MEASUREMENT zgla_lam_delta_filt_b2_5of5_ "gefiltertes Delta Einzellambda zu Lambdamittelwert" SWORD FORMULA_0025 0 0 -2.0000 1.9999 ECU_ADDRESS 0x3FD432 /end MEASUREMENT
/begin MEASUREMENT zgla_lam_filt_konst_b1 "Filterkonstante - Zylindergleichstellung" UWORD FORMULA_0763 0 0 0.0 7.9998 ECU_ADDRESS 0x3FD434 /end MEASUREMENT
/begin MEASUREMENT zgla_lam_filt_konst_b2 "Filterkonstante - Zylindergleichstellung" UWORD FORMULA_0763 0 0 0.0 7.9998 ECU_ADDRESS 0x3FD436 /end MEASUREMENT
/begin MEASUREMENT zgla_f_i_ant_1of2_1of5_ "Integratoranteil - Zylindergleichstellung" SWORD FORMULA_0024 0 0 -1.0000 0.9999 ECU_ADDRESS 0x3FD438 /end MEASUREMENT
/begin MEASUREMENT zgla_f_i_ant_1of2_2of5_ "Integratoranteil - Zylindergleichstellung" SWORD FORMULA_0024 0 0 -1.0000 0.9999 ECU_ADDRESS 0x3FD43A /end MEASUREMENT
/begin MEASUREMENT zgla_f_i_ant_1of2_3of5_ "Integratoranteil - Zylindergleichstellung" SWORD FORMULA_0024 0 0 -1.0000 0.9999 ECU_ADDRESS 0x3FD43C /end MEASUREMENT
/begin MEASUREMENT zgla_f_i_ant_1of2_4of5_ "Integratoranteil - Zylindergleichstellung" SWORD FORMULA_0024 0 0 -1.0000 0.9999 ECU_ADDRESS 0x3FD43E /end MEASUREMENT
/begin MEASUREMENT zgla_f_i_ant_1of2_5of5_ "Integratoranteil - Zylindergleichstellung" SWORD FORMULA_0024 0 0 -1.0000 0.9999 ECU_ADDRESS 0x3FD440 /end MEASUREMENT
/begin MEASUREMENT zgla_f_i_ant_2of2_1of5_ "Integratoranteil - Zylindergleichstellung" SWORD FORMULA_0024 0 0 -1.0000 0.9999 ECU_ADDRESS 0x3FD442 /end MEASUREMENT
/begin MEASUREMENT zgla_f_i_ant_2of2_2of5_ "Integratoranteil - Zylindergleichstellung" SWORD FORMULA_0024 0 0 -1.0000 0.9999 ECU_ADDRESS 0x3FD444 /end MEASUREMENT
/begin MEASUREMENT zgla_f_i_ant_2of2_3of5_ "Integratoranteil - Zylindergleichstellung" SWORD FORMULA_0024 0 0 -1.0000 0.9999 ECU_ADDRESS 0x3FD446 /end MEASUREMENT
/begin MEASUREMENT zgla_f_i_ant_2of2_4of5_ "Integratoranteil - Zylindergleichstellung" SWORD FORMULA_0024 0 0 -1.0000 0.9999 ECU_ADDRESS 0x3FD448 /end MEASUREMENT
/begin MEASUREMENT zgla_f_i_ant_2of2_5of5_ "Integratoranteil - Zylindergleichstellung" SWORD FORMULA_0024 0 0 -1.0000 0.9999 ECU_ADDRESS 0x3FD44A /end MEASUREMENT
/* ------------------ Abschnitt erzeugt aus vfz.dat ------------------ */
/begin CHARACTERISTIC K_V_RAD_TOL_CFG "Schalter RadToleranz" VALUE 0x78DAA TKW_VV_VV_UB 100.0 FORMULA_1230 0.0 255.0 /end CHARACTERISTIC
/begin CHARACTERISTIC K_V_RAD_TOL_TAU "Filterkonstante RadToleranz | EN: Filterkonstante RadToleranz" VALUE 0x78DAB TKW_VV_VV_UB 100.0 FORMULA_0651 0.0051 1.2800 /end CHARACTERISTIC
/begin CHARACTERISTIC K_V_MAX_FF_RESET "FF-Reset fuer meinen INCA-Spezl | EN: 0 Speichern 1 Reset ELSE undef FF-Reset fuer meinen INCA-Spezl" VALUE 0x78DAC TKW_VV_VV_UB 100.0 FORMULA_1011 0.0 255.0 /end CHARACTERISTIC
/begin CHARACTERISTIC K_V_MAX_MAX "Stoll'sche v_max-Konstante | EN: Stoll'sche v_max-Konstante" VALUE 0x78DAE TKW_VV_VV_SW 100.0 FORMULA_0078 -80.0000 360.0000 FORMAT "%4.1" /end CHARACTERISTIC
/begin CHARACTERISTIC K_V_MAX_ANH_KM_STAND "minimaler km-Stand fuer v_max-Anhebung | EN: minimaler km -Stand fuer v_max -Anhebung" VALUE 0x78DB0 TKW_VV_VV_UW 100.0 FORMULA_0616 0.0 65535.0000 /end CHARACTERISTIC
/begin CHARACTERISTIC K_V_MAX_ANH_MAX_CNT "Begrenzung v_max-Anhebungen per Tester | EN: Begrenzung v_max-Anhebungen per Tester" VALUE 0x78DB2 TKW_VV_VV_UB 100.0 FORMULA_0003 0.0 4.0000 /end CHARACTERISTIC
/begin CHARACTERISTIC KL_V_MAX_GANG_LIMOUSINE "Maximalgeschwindigkeit angehoben f. Limousine | EN: Maximum vehicle speed, raised, Saloon" CURVE 0x78DB4 TKL_SW_VV_SW 100.0 FORMULA_0078 -80.0000 360.0000 /begin AXIS_DESCR STD_AXIS gang FORMULA_0666 8 -1.0000 10.0000 /end AXIS_DESCR FORMAT "%4.1" /end CHARACTERISTIC
/begin CHARACTERISTIC KL_V_MAX_GANG_TOURING "Maximalgeschwindigkeit angehoben f. Touring | EN: Maximum vehicle speed, raised, Touring" CURVE 0x78DD6 TKL_SW_VV_SW 100.0 FORMULA_0078 -80.0000 360.0000 /begin AXIS_DESCR STD_AXIS gang FORMULA_0666 8 -1.0000 10.0000 /end AXIS_DESCR FORMAT "%4.1" /end CHARACTERISTIC
/begin CHARACTERISTIC KL_V_MAX_GANG_COUPE "Maximalgeschwindigkeit angehoben f. Coupe | EN: Maximum vehicle speed, raised, Coupe" CURVE 0x78DF8 TKL_SW_VV_SW 100.0 FORMULA_0078 -80.0000 360.0000 /begin AXIS_DESCR STD_AXIS gang FORMULA_0666 8 -1.0000 10.0000 /end AXIS_DESCR FORMAT "%4.1" /end CHARACTERISTIC
/begin CHARACTERISTIC KL_V_MAX_GANG_CABRIO "Maximalgeschwindigkeit angehoben f. Cabrio | EN: Maximum vehicle speed, raised, Convertible" CURVE 0x78E1A TKL_SW_VV_SW 100.0 FORMULA_0078 -80.0000 360.0000 /begin AXIS_DESCR STD_AXIS gang FORMULA_0666 8 -1.0000 10.0000 /end AXIS_DESCR FORMAT "%4.1" /end CHARACTERISTIC
/begin CHARACTERISTIC KL_V_MAX_GANG_BEGRENZT "Maximalgeschwindigkeit | EN: Maximum vehicle speed (Vmax)" CURVE 0x78E3C TKL_SW_VV_SW 100.0 FORMULA_0078 -80.0000 360.0000 /begin AXIS_DESCR STD_AXIS gang FORMULA_0666 8 -1.0000 10.0000 /end AXIS_DESCR FORMAT "%4.1" /end CHARACTERISTIC
/begin CHARACTERISTIC KL_V_MAX_SK "Maximalgeschwindigkeit bei SK-Fehler | EN: Maximum vehicle speed with safety-concept fault" CURVE 0x78E5E TKL_UB_VV_SW 100.0 FORMULA_0078 -80.0000 360.0000 /begin AXIS_DESCR STD_AXIS Stufe FORMULA_0003 6 0.0 255.0000 /end AXIS_DESCR FORMAT "%4.1" /end CHARACTERISTIC
/begin MEASUREMENT v_max_st "Status Maximalgeschwindigkeit" UBYTE FORMULA_1229 0 0 0.0 255.0 ECU_ADDRESS 0x3FD680 /end MEASUREMENT
/begin MEASUREMENT v_st "Status Geschwindigkeit" UBYTE FORMULA_0003 0 0 0.0 255.0000 ECU_ADDRESS 0x3FD681 /end MEASUREMENT
/begin MEASUREMENT v_max_schw_sk "Maximalgeschwindigkeit bei SK-Fehler" SWORD FORMULA_0078 0 0 -80.0000 360.0000 ECU_ADDRESS 0x3FD682 /end MEASUREMENT
/begin MEASUREMENT v_rad_tol_vl "gefilt. RadToleranz VL" SBYTE FORMULA_0626 0 0 -12.8000 12.7000 ECU_ADDRESS 0x3FD684 /end MEASUREMENT
/begin MEASUREMENT v_rad_tol_vr "gefilt. RadToleranz VR" SBYTE FORMULA_0626 0 0 -12.8000 12.7000 ECU_ADDRESS 0x3FD685 /end MEASUREMENT
/begin MEASUREMENT v_rad_tol_hl "gefilt. RadToleranz HL" SBYTE FORMULA_0626 0 0 -12.8000 12.7000 ECU_ADDRESS 0x3FD686 /end MEASUREMENT
/begin MEASUREMENT v_rad_tol_hr "gefilt. RadToleranz HR" SBYTE FORMULA_0626 0 0 -12.8000 12.7000 ECU_ADDRESS 0x3FD687 /end MEASUREMENT
/begin FUNCTION Einspritzung ""
 /begin DEF_CHARACTERISTIC KF_TI_GRUND_F KF_TI_LAA_OFFS_WICHT_F KF_TI_MKS_NS_GRUND KF_TI_MKS_START KF_TI_NS_F KF_TI_PHI_ENDE_GRUND KF_TI_PHI_ENDE_OFFS KF_TI_SEG_TIME_F KF_TI_SOLL_MIN KF_TI_SOLL_UB_OFFS KF_TI_START_F KF_TI_TU_F KF_TI_WL_KORR_F KF_TI_WL_KORR_F_KH KF_TI_WL_OFFS KF_TI_WL_OFFS_KH KF_ZGLA_ZYL_NR_OFFS KL_TI_NS_VERLUSTE KL_TI_PHI_ENDE_ES KL_TI_PHI_ENDE_GRAD KL_TI_PHI_ENDE_START KL_TI_PHI_EV_WURZEL KL_TI_SOLL_LIN_OFFS KL_TI_SOLL_QSTAT_F KL_TI_SOLL_RHO_F KL_TI_SOLL_UB_OFFS_T_KORR_F KL_TI_START_PUMG_F K_KVA_Q_MOT_TAU K_KVA_SPEC_WEIGHT K_TI_GA K_TI_GRUND_STOECH K_TI_MAX_OFFS K_TI_MAX_RESET K_TI_MIN_MAX_HYS K_TI_MIN_OFF_TIME K_TI_MKS_LWV_CFG K_TI_MKS_OELV_CFG K_TI_MKS_START_CFG K_TI_MKS_TE_CFG K_TI_NMIN_KL50OFF K_TI_NS_CFG K_TI_OFF_CFG K_TI_OFF_EXD_N_MAX K_TI_PHI_ENDE_A_SAUG K_TI_PHI_ENDE_A_ZYL K_TI_PHI_ENDE_ROH_KST K_TI_PHI_ENDE_S_ESV_EV K_TI_PHI_ENDE_S_HUB K_TI_RF_MAX_DLY K_TI_WL_CFG K_ZGLA_ADAPT_CFG K_ZGLA_FILT_T1 K_ZGLA_F_MAX K_ZGLA_F_MIN K_ZGLA_I K_ZGLA_INPUT_CFG K_ZGLA_LAM_IST_MAX K_ZGLA_LAM_IST_MIN K_ZGLA_N_MAX K_ZGLA_RESET_CFG K_ZGLA_RF_MAX K_ZGLA_RF_MIN K_ZGLA_TMOT_MIN /end DEF_CHARACTERISTIC
 /begin REF_CHARACTERISTIC /end REF_CHARACTERISTIC
 /begin IN_MEASUREMENT /end IN_MEASUREMENT
 /begin OUT_MEASUREMENT kva_can_cnt kva_mks_out_sum kva_mks_out_sum_last kva_q_mot lwv_mks ti_asp_cnt_zyl1 ti_asp_cnt_zyl10 ti_asp_cnt_zyl2 ti_asp_cnt_zyl3 ti_asp_cnt_zyl4 ti_asp_cnt_zyl5 ti_asp_cnt_zyl6 ti_asp_cnt_zyl7 ti_asp_cnt_zyl8 ti_asp_cnt_zyl9 ti_b1.laa_offs_wicht_f ti_b1.min ti_b1.mks_grund ti_b1.mks_max ti_b1.mks_roh ti_b1.ml_max ti_b1.ml_mg_la ti_b1.ml_mg_la_f ti_b1.ml_mg_zyl ti_b1.pdiff ti_b1.phi_ende ti_b1.phi_ende_flug ti_b1.phi_ende_grad ti_b1.phi_ende_grund ti_b1.phi_ende_min ti_b1.phi_ende_roh ti_b1.phi_ev_v ti_b1.phi_ks_v ti_b1.qstat_f ti_b1.rho_f ti_b1.t_korr_f ti_b1.ub_offs ti_b2.laa_offs_wicht_f ti_b2.min ti_b2.mks_grund ti_b2.mks_max ti_b2.mks_roh ti_b2.ml_max ti_b2.ml_mg_la ti_b2.ml_mg_la_f ti_b2.ml_mg_zyl ti_b2.pdiff ti_b2.phi_ende ti_b2.phi_ende_flug ti_b2.phi_ende_grad ti_b2.phi_ende_grund ti_b2.phi_ende_min ti_b2.phi_ende_roh ti_b2.phi_ev_v ti_b2.phi_ks_v ti_b2.qstat_f ti_b2.rho_f ti_b2.t_korr_f ti_b2.ub_offs ti_berech_zyl1 ti_berech_zyl10 ti_berech_zyl2 ti_berech_zyl3 ti_berech_zyl4 ti_berech_zyl5 ti_berech_zyl6 ti_berech_zyl7 ti_berech_zyl8 ti_berech_zyl9 ti_lin_offs_zyl1 ti_lin_offs_zyl10 ti_lin_offs_zyl2 ti_lin_offs_zyl3 ti_lin_offs_zyl4 ti_lin_offs_zyl5 ti_lin_offs_zyl6 ti_lin_offs_zyl7 ti_lin_offs_zyl8 ti_lin_offs_zyl9 ti_max ti_max_lim ti_mks_ns_grund ti_mks_ns_ist_init_b1 ti_mks_ns_ist_init_b2 ti_mks_ns_ist_zyl1 ti_mks_ns_ist_zyl10 ti_mks_ns_ist_zyl2 ti_mks_ns_ist_zyl3 ti_mks_ns_ist_zyl4 ti_mks_ns_ist_zyl5 ti_mks_ns_ist_zyl6 ti_mks_ns_ist_zyl7 ti_mks_ns_ist_zyl8 ti_mks_ns_ist_zyl9 ti_mks_ns_rel_zyl1 ti_mks_ns_rel_zyl10 ti_mks_ns_rel_zyl2 ti_mks_ns_rel_zyl3 ti_mks_ns_rel_zyl4 ti_mks_ns_rel_zyl5 ti_mks_ns_rel_zyl6 ti_mks_ns_rel_zyl7 ti_mks_ns_rel_zyl8 ti_mks_ns_rel_zyl9 ti_mks_ns_zyl1 ti_mks_ns_zyl10 ti_mks_ns_zyl2 ti_mks_ns_zyl3 ti_mks_ns_zyl4 ti_mks_ns_zyl5 ti_mks_ns_zyl6 ti_mks_ns_zyl7 ti_mks_ns_zyl8 ti_mks_ns_zyl9 ti_mks_soll_zyl1 ti_mks_soll_zyl10 ti_mks_soll_zyl2 ti_mks_soll_zyl3 ti_mks_soll_zyl4 ti_mks_soll_zyl5 ti_mks_soll_zyl6 ti_mks_soll_zyl7 ti_mks_soll_zyl8 ti_mks_soll_zyl9 ti_mks_start ti_mks_start_korr ti_mks_start_roh ti_ns_f ti_nw_asp_cnt ti_off_exd ti_off_exd_timeout ti_out_zyl1 ti_out_zyl10 ti_out_zyl2 ti_out_zyl3 ti_out_zyl4 ti_out_zyl5 ti_out_zyl6 ti_out_zyl7 ti_out_zyl8 ti_out_zyl9 ti_phi_ende_offs_b1 ti_phi_ende_offs_b2 ti_phi_ende_start ti_phi_ev_v_wurz ti_phi_flug_v ti_rf_max_dly ti_seg_time_f_zyl1 ti_seg_time_f_zyl10 ti_seg_time_f_zyl2 ti_seg_time_f_zyl3 ti_seg_time_f_zyl4 ti_seg_time_f_zyl5 ti_seg_time_f_zyl6 ti_seg_time_f_zyl7 ti_seg_time_f_zyl8 ti_seg_time_f_zyl9 ti_segm_cnt ti_soll_zyl1 ti_soll_zyl10 ti_soll_zyl2 ti_soll_zyl3 ti_soll_zyl4 ti_soll_zyl5 ti_soll_zyl6 ti_soll_zyl7 ti_soll_zyl8 ti_soll_zyl9 ti_start_f ti_start_pumg_f ti_status ti_status_aus_auss ti_status_aus_egas ti_status_aus_md ti_status_aus_sk ti_status_aus_ti ti_status_aus_ti_tz ti_status_aus_treiber ti_status_off_cfg ti_status_off_exd ti_tpu_start ti_tpu_zyl1 ti_tpu_zyl10 ti_tpu_zyl2 ti_tpu_zyl3 ti_tpu_zyl4 ti_tpu_zyl5 ti_tpu_zyl6 ti_tpu_zyl7 ti_tpu_zyl8 ti_tpu_zyl9 ti_wl_f_b1 ti_wl_f_b2 ti_wl_f_kh_b1 ti_wl_f_kh_b2 ti_wl_f_roh_b1 ti_wl_f_roh_b2 zgla_f_i_ant_1of2_1of5_ zgla_f_i_ant_1of2_2of5_ zgla_f_i_ant_1of2_3of5_ zgla_f_i_ant_1of2_4of5_ zgla_f_i_ant_1of2_5of5_ zgla_f_i_ant_2of2_1of5_ zgla_f_i_ant_2of2_2of5_ zgla_f_i_ant_2of2_3of5_ zgla_f_i_ant_2of2_4of5_ zgla_f_i_ant_2of2_5of5_ zgla_lam_delta_1of2_1of5_ zgla_lam_delta_1of2_2of5_ zgla_lam_delta_1of2_3of5_ zgla_lam_delta_1of2_4of5_ zgla_lam_delta_1of2_5of5_ zgla_lam_delta_2of2_1of5_ zgla_lam_delta_2of2_2of5_ zgla_lam_delta_2of2_3of5_ zgla_lam_delta_2of2_4of5_ zgla_lam_delta_2of2_5of5_ zgla_lam_delta_filt_b1_1of5_ zgla_lam_delta_filt_b1_2of5_ zgla_lam_delta_filt_b1_3of5_ zgla_lam_delta_filt_b1_4of5_ zgla_lam_delta_filt_b1_5of5_ zgla_lam_delta_filt_b2_1of5_ zgla_lam_delta_filt_b2_2of5_ zgla_lam_delta_filt_b2_3of5_ zgla_lam_delta_filt_b2_4of5_ zgla_lam_delta_filt_b2_5of5_ zgla_lam_filt_konst_b1 zgla_lam_filt_konst_b2 zgla_st zgla_st_f_max zgla_st_f_min zgla_st_freigabe zgla_zyl_nr_b1 zgla_zyl_nr_b2 /end OUT_MEASUREMENT
/end FUNCTION
/begin FUNCTION Elektroluefter ""
 /begin DEF_CHARACTERISTIC KF_ELU_PWM_MS KL_ELU_KKOS KL_ELU_TAN KL_ELU_TKA KL_ELU_TKAT KL_ELU_V_KORR K_ELU_ED_BLOCKIERT_CNT K_ELU_ED_BLOCKIERT_MAX K_ELU_ED_BLOCKIERT_MIN K_ELU_ED_BLOCKIER_ZYKLUS_TIME K_ELU_ED_OPENLOAD_CNT K_ELU_ED_SH_TO_GND_CNT K_ELU_ED_SH_TO_UB_DELAY K_ELU_ED_SH_TO_UB_OFF_TIME K_ELU_HYS_SCHLEPP K_ELU_IDENT_CYCLE_CNT_BEGR K_ELU_IDENT_CYCLE_TIME_BEGR K_ELU_IDENT_RESP_600W_MAX K_ELU_IDENT_RESP_600W_MIN K_ELU_IDENT_RESP_850W_MAX K_ELU_IDENT_RESP_850W_MIN K_ELU_PWM_AUS K_ELU_PWM_GRAD_ZUL K_ELU_PWM_IDENT K_ELU_PWM_MAX_ML K_ELU_PWM_MAX_MS K_ELU_PWM_MIN_ML K_ELU_PWM_MIN_MS K_ELU_PWM_OFFS K_ELU_TAN_DREH_ERSATZ K_ELU_TCR2_TICS K_ELU_TCR2_TICS_NL K_ELU_TKA_TMOT_DIFF K_ELU_TYP_CFG K_ELU_T_ML_MIN K_ELU_T_MS_MAX /end DEF_CHARACTERISTIC
 /begin REF_CHARACTERISTIC /end REF_CHARACTERISTIC
 /begin IN_MEASUREMENT /end IN_MEASUREMENT
 /begin OUT_MEASUREMENT elu_dreh elu_dreh_sch elu_ed_blockiert_cnt elu_ed_blockiert_timer elu_ed_blockiert_zyklus_delay elu_ed_error_cycle_time elu_ed_fart_merker elu_ed_openload_cnt elu_ed_sh_to_gnd_cnt elu_ed_sh_to_ub_delay elu_ed_sh_to_ub_off_timer elu_exd_timeout elu_fkt_st elu_ident_cycle_cnt elu_ident_cycle_time elu_ident_timer elu_min_hys elu_pwm elu_pwm_ml elu_pwm_ml_filt elu_pwm_ms elu_st elu_t_periode /end OUT_MEASUREMENT
/end FUNCTION
/begin FUNCTION Ercosek_SC "" /begin DEF_CHARACTERISTIC K_DIAGNOSE_INDEX_HI K_DIAGNOSE_INDEX_LO /end DEF_CHARACTERISTIC /begin REF_CHARACTERISTIC /end REF_CHARACTERISTIC /begin IN_MEASUREMENT /end IN_MEASUREMENT
 /begin OUT_MEASUREMENT ccp_aramStatus ccp_checksum ccp_moveStatus ccp_reqSwitch ccp_stateChecksum stack_status stack_usedErcosek stack_usedUser tm_100ms.dT tm_100ms.lastTask tm_100ms.maxTime tm_100ms.netTime tm_10ms.dT tm_10ms.lastTask tm_10ms.maxTime tm_10ms.netTime tm_5ms.dT tm_5ms.lastTask tm_5ms.maxTime tm_5ms.netTime tm_Sync1.dT tm_Sync1.lastTask tm_Sync1.maxTime tm_Sync1.netTime tm_Sync2.dT tm_Sync2.lastTask tm_Sync2.maxTime tm_Sync2.netTime tm_bgnd.dT tm_bgnd.grossRunTime tm_bgnd.lastTask tm_bgnd.maxTime tm_bgnd.netTime /end OUT_MEASUREMENT
/end FUNCTION
/begin FUNCTION Fahrzeuggeschwindigkeit ""
 /begin DEF_CHARACTERISTIC KL_V_MAX_GANG_BEGRENZT KL_V_MAX_GANG_CABRIO KL_V_MAX_GANG_COUPE KL_V_MAX_GANG_LIMOUSINE KL_V_MAX_GANG_TOURING KL_V_MAX_SK K_V_MAX_ANH_KM_STAND K_V_MAX_ANH_MAX_CNT K_V_MAX_FF_RESET K_V_MAX_MAX K_V_RAD_TOL_CFG K_V_RAD_TOL_TAU /end DEF_CHARACTERISTIC
 /begin REF_CHARACTERISTIC /end REF_CHARACTERISTIC
 /begin IN_MEASUREMENT /end IN_MEASUREMENT
 /begin OUT_MEASUREMENT v_max_schw_sk v_max_st v_rad_tol_hl v_rad_tol_hr v_rad_tol_vl v_rad_tol_vr v_st /end OUT_MEASUREMENT
/end FUNCTION
/begin FUNCTION Flashservice "" /begin DEF_CHARACTERISTIC /end DEF_CHARACTERISTIC /begin REF_CHARACTERISTIC /end REF_CHARACTERISTIC /begin IN_MEASUREMENT /end IN_MEASUREMENT /begin OUT_MEASUREMENT /end OUT_MEASUREMENT /end FUNCTION
/begin FUNCTION Generator-Module ""
 /begin DEF_CHARACTERISTIC CW_BNSUMAX CW_BNS_LR CW_GENOFFSLP KF_GENWETA1 KF_GENWETA2 KF_GENWETA3 KF_GENWETA4 KF_IGENDF1 KF_IGENDF2 KF_IGENDF3 KF_IGENDF4 KF_IGENKA1 KF_IGENKA2 KF_IGENKA3 KF_IGENKA4 KF_IGENWA1 KF_IGENWA2 KF_IGENWA3 KF_IGENWA4 KF_LORESP KF_LRMAXG KF_MDGENFIL KF_ZLRESOF KF_ZLRRESOFV KL_FPDIODE1 KL_FPDIODE2 KL_FPDIODE3 KL_FPDIODE4 KL_GENEXP1 KL_GENEXP2 KL_GENEXP3 KL_GENEXP4 KL_GENLDST KL_GENTETA1 KL_GENTETA2 KL_GENTETA3 KL_GENTETA4 KL_LORESPM KL_RTH0FAK1 KL_RTH0FAK2 KL_RTH0FAK3 KL_RTH0FAK4 KL_RTHFAK1 KL_RTHFAK2 KL_RTHFAK3 KL_RTHFAK4 KL_RTHGEN1 KL_RTHGEN2 KL_RTHGEN3 KL_RTHGEN4 KL_TANSGEN1 KL_TANSGEN2 KL_TANSGEN3 KL_TANSGEN4 K_APPLROFF K_APPUPLLDST K_APP_LLAH K_APP_UGEN K_BGAPP K_DFMODE K_DFS_MAX K_DFS_MIN K_DFS_MITT K_DF_DEAKAPP K_DMDGEN_SCHMN K_DMDGEN_SCHMX K_DSOCMIN K_ENAPPLGOFF K_ENAPPLRESP K_ENGENTANS K_ENGENTOGGL K_EN_MDGEN K_FHOGNMN K_GENDIFAK1 K_GENDIFAK2 K_GENDIFAK3 K_GENDIFAK4 K_GENITYP K_GENLDDFMAX K_GENLLAHAPP K_GENMDNMOF K_GENOFFTIME K_GENPDTIME K_GENRS0_1 K_GENRS0_2 K_GENRS0_3 K_GENRS0_4 K_GENSTFAK1 K_GENSTFAK2 K_GENSTFAK3 K_GENSTFAK4 K_GENTEMPAPP K_GENTEMPMAN K_GENTMOTDT K_GENTMOTOF1 K_GENTMOTOF2 K_GENTMOTOF3 K_GENTMOTOF4 K_GENTYP K_GENTYPFELD_10of33_ K_GENTYPFELD_11of33_ K_GENTYPFELD_12of33_ K_GENTYPFELD_13of33_ K_GENTYPFELD_14of33_ K_GENTYPFELD_15of33_ K_GENTYPFELD_16of33_ K_GENTYPFELD_17of33_ K_GENTYPFELD_18of33_ K_GENTYPFELD_19of33_ K_GENTYPFELD_1of33_ K_GENTYPFELD_20of33_ K_GENTYPFELD_21of33_ K_GENTYPFELD_22of33_ K_GENTYPFELD_23of33_ K_GENTYPFELD_24of33_ K_GENTYPFELD_25of33_ K_GENTYPFELD_26of33_ K_GENTYPFELD_27of33_ K_GENTYPFELD_28of33_ K_GENTYPFELD_29of33_ K_GENTYPFELD_2of33_ K_GENTYPFELD_30of33_ K_GENTYPFELD_31of33_ K_GENTYPFELD_32of33_ K_GENTYPFELD_33of33_ K_GENTYPFELD_3of33_ K_GENTYPFELD_4of33_ K_GENTYPFELD_5of33_ K_GENTYPFELD_6of33_ K_GENTYPFELD_7of33_ K_GENTYPFELD_8of33_ K_GENTYPFELD_9of33_ K_GENUEBSETZ1 K_GENUEBSETZ2 K_GENUEBSETZ3 K_GENUEBSETZ4 K_GENUMAX K_GENUMGTYP K_GENURAMP K_GENURAMPOF K_GENVFZGSW K_GEN_APPUG K_GEN_DNMIN K_GEN_IGOF K_IERRFIL K_IGBASIS K_IGBASISOFF K_IGNOTWERT K_LRBNS K_LRESPAPP K_MANAWNUMM K_MDGNHYS K_MDGNMAX K_MGMAXAPP K_MSKGENDFP K_MSKGENKL61 K_NGENOFMN K_NGENOFMX K_NKW_SCH K_NMXGENOF K_NSUBO K_NSUBU K_PMSA_DEC K_PMSA_INC K_PMSA_RST K_PMSA_SET K_PRELLGTMOT K_RLMXGENOF K_SNMBSDKL61 K_TABSTGNMN K_TABSTGNMX K_TATMGENOF K_TDGENOFFST K_TDMDGEN_VERZAUS K_TDMDGEN_VERZEIN K_TGENOFMN K_TGENOFMX K_TGENOFVL K_TIGMISCH K_TLORESPST K_TMOTABGNMN K_TNNSTART K_TSTCNTEN K_TSTFIL_IN K_TSTFIL_INI K_TUMGGNMN K_TUMGGNMX K_TVLOFHYST K_T_IGRNACHL K_T_VERBON K_UBNS K_UDIODERMS1 K_UDIODERMS2 K_UDIODERMS3 K_UDIODERMS4 K_UGENDELTA K_UGENMAXE65 K_UGENOFF K_UGENOFFSTART K_UGENOFFV0 K_U_BNMAX K_U_IGRRAMP K_VGENOFMN K_VGENOGMX K_VZLORESOFV K_ZMGENIG K_ZMGENS0HZ1 K_ZMGENS0HZ2 K_ZMGENS0HZ3 K_ZMGENS0HZ4 K_ZMGENS0KL1 K_ZMGENS0KL2 K_ZMGENS0KL3 K_ZMGENS0KL4 K_ZMGENSTHZ1 K_ZMGENSTHZ2 K_ZMGENSTHZ3 K_ZMGENSTHZ4 K_ZMGENSTKL1 K_ZMGENSTKL2 K_ZMGENSTKL3 K_ZMGENSTKL4 K_ZMGENTWA K_ZMGN0TANS1 K_ZMGN0TANS2 K_ZMGN0TANS3 K_ZMGN0TANS4 K_ZMGNTANS1 K_ZMGNTANS2 K_ZMGNTANS3 K_ZMGNTANS4 K_ZMIGMISCH K_ZMTESTFIL S_ENTLENA S_GENOFFSTART S_GOFFRAMP S_IGMISCH S_IGRLOW S_LORESLL S_MGAPP S_RDGENTYP S_SAPP S_TLACTIV /end DEF_CHARACTERISTIC
 /begin REF_CHARACTERISTIC /end REF_CHARACTERISTIC
 /begin IN_MEASUREMENT /end IN_MEASUREMENT
 /begin OUT_MEASUREMENT Dffgen Dfmonitor Dfpropval Dfsumme Dfwanzahl Fdib_ig Gen_awnumm Gen_dts Gen_fbsak Gen_feta Gen_i_kaltun Gen_nummer Gen_rs Gen_spv Gen_statroh Gen_sttemp Gen_tans Gen_tansend Gen_teta Gen_weta I_basis I_gen I_gen_end I_gen_g I_gen_nafil I_gen_vorfil I_genmax I_gm I_gvor Ierr_fil Ierrgrenz Loadresp Md_genfil Md_gennm Md_gennmufi Md_genrel Md_genvf Md_grenz N_gen N_nstart Nkw_s Nslb P_gen_ab Pmigrlowctr St_dgen0 St_dgen0.B_1stbsder St_dgen0.B_genfprl St_dgen0.B_gfbsupak St_dgen0.B_gfelak St_dgen0.B_gfhtak St_dgen0.B_gfmeak St_dgen0.B_gfnobsak St_dgen0.B_kl61 St_dmdblock St_dmdblock.B_dmd_frei St_dmdblock.B_timmax St_dmdblock.B_timmin St_gen St_genbsd St_gengen St_imdgen0 St_imdgen0.B_firstemp St_imdgen0.B_gene St_imdgen0.B_generken St_imdgen_nv0 St_imdgen_nv0.B_genfkupl St_imdgen_nv0.B_heizen St_ldstgen St_llranh0 St_llranh0.B_idl_tp St_llranh0.B_idlgspec St_llranh0.B_nsub St_loadresp St_loadresp.B_lroff St_loadresp.B_lroff2 St_loadresp0 St_loadresp0.B_fub St_loadresp0.B_genoffmd St_loadresp0.B_genoffst St_loadresp10ms St_loadresp10ms.B_mdgrenz St_loadresp_nv0 St_loadresp_nv0.B_genoffvl St_ugenkor0 St_ugenkor0.B_1stugen St_ugenkor0.B_genoff St_ugenkor0.B_genoff2 St_ugenkor0.B_genoffok St_ugenkor0.B_genoffout St_ugenkor0.B_noctrgen St_ugenkor0.B_ugenini St_ugenkor0.B_verb_off St_ugenkor1 St_ugenkor1.B_gentoggl St_ugenkor2 St_ugenkor2.B_saaktiv St_ugenkor2.B_saset T_batt Tgen Tgen_ab Tgen_dt Tgen_end Tgen_exp Tgen_fil Tlrgen Tlrgen2 Tst_countv Tst_fil_out U_gen U_gen2 U_gen_igr U_gsoll U_gsoll_off U_gsoll_tp U_gsoll_tp2 U_gsoll_tp3 U_gsollred U_gsolltmp Z_dmdblock /end OUT_MEASUREMENT
/end FUNCTION
/begin FUNCTION Getriebetemperatur ""
 /begin DEF_CHARACTERISTIC KL_TGETR_NTC K_TGETR_CC_HIGH K_TGETR_CC_HYST K_TGETR_DIAG_MAX K_TGETR_DIAG_MIN K_TGETR_DIAG_TUMG_MIN K_TGETR_TAU /end DEF_CHARACTERISTIC
 /begin REF_CHARACTERISTIC /end REF_CHARACTERISTIC
 /begin IN_MEASUREMENT /end IN_MEASUREMENT
 /begin OUT_MEASUREMENT tgetr_ad tgetr_filter tgetr_ipol tgetr_sta /end OUT_MEASUREMENT
/end FUNCTION
/begin RECORD_LAYOUT TKW_VV_VV_UB FNC_VALUES 1 UBYTE COLUMN_DIR DIRECT /end RECORD_LAYOUT
/begin RECORD_LAYOUT TKW_VV_VV_SB FNC_VALUES 1 SBYTE COLUMN_DIR DIRECT /end RECORD_LAYOUT
/begin RECORD_LAYOUT TKW_VV_VV_UW FNC_VALUES 1 UWORD COLUMN_DIR DIRECT /end RECORD_LAYOUT
/begin RECORD_LAYOUT TKW_VV_VV_SW FNC_VALUES 1 SWORD COLUMN_DIR DIRECT /end RECORD_LAYOUT
/begin RECORD_LAYOUT TKL_UB_VV_UB NO_AXIS_PTS_X 1 UBYTE RESERVED 2 BYTE AXIS_PTS_X 3 UBYTE INDEX_INCR DIRECT FNC_VALUES 4 UBYTE COLUMN_DIR DIRECT /end RECORD_LAYOUT
/begin RECORD_LAYOUT TKL_UB_VV_SW NO_AXIS_PTS_X 1 UBYTE RESERVED 2 BYTE AXIS_PTS_X 3 UBYTE INDEX_INCR DIRECT FNC_VALUES 4 SWORD COLUMN_DIR DIRECT /end RECORD_LAYOUT
/begin RECORD_LAYOUT TKL_UW_VV_UB NO_AXIS_PTS_X 1 UBYTE RESERVED 2 BYTE AXIS_PTS_X 3 UWORD INDEX_INCR DIRECT FNC_VALUES 4 UBYTE COLUMN_DIR DIRECT /end RECORD_LAYOUT
/begin RECORD_LAYOUT TKL_UW_VV_SW NO_AXIS_PTS_X 1 UBYTE RESERVED 2 BYTE AXIS_PTS_X 3 UWORD INDEX_INCR DIRECT FNC_VALUES 4 SWORD COLUMN_DIR DIRECT /end RECORD_LAYOUT
/begin RECORD_LAYOUT TKL_SW_VV_UB NO_AXIS_PTS_X 1 UBYTE RESERVED 2 BYTE AXIS_PTS_X 3 SWORD INDEX_INCR DIRECT FNC_VALUES 4 UBYTE COLUMN_DIR DIRECT /end RECORD_LAYOUT
/begin RECORD_LAYOUT TKL_SW_VV_UW NO_AXIS_PTS_X 1 UBYTE RESERVED 2 BYTE AXIS_PTS_X 3 SWORD INDEX_INCR DIRECT FNC_VALUES 4 UWORD COLUMN_DIR DIRECT /end RECORD_LAYOUT
/begin RECORD_LAYOUT TKL_SW_VV_SW NO_AXIS_PTS_X 1 UBYTE RESERVED 2 BYTE AXIS_PTS_X 3 SWORD INDEX_INCR DIRECT FNC_VALUES 4 SWORD COLUMN_DIR DIRECT /end RECORD_LAYOUT
/begin RECORD_LAYOUT TKF_UB_UB_UB NO_AXIS_PTS_X 1 UBYTE NO_AXIS_PTS_Y 2 UBYTE AXIS_PTS_X 3 UBYTE INDEX_INCR DIRECT AXIS_PTS_Y 4 UBYTE INDEX_INCR DIRECT FNC_VALUES 5 UBYTE COLUMN_DIR DIRECT /end RECORD_LAYOUT
/begin RECORD_LAYOUT TKF_UW_UW_UW NO_AXIS_PTS_X 1 UBYTE NO_AXIS_PTS_Y 2 UBYTE AXIS_PTS_X 3 UWORD INDEX_INCR DIRECT AXIS_PTS_Y 4 UWORD INDEX_INCR DIRECT FNC_VALUES 5 UWORD COLUMN_DIR DIRECT /end RECORD_LAYOUT
/begin RECORD_LAYOUT TKF_UW_SW_UB NO_AXIS_PTS_X 1 UBYTE NO_AXIS_PTS_Y 2 UBYTE AXIS_PTS_X 3 SWORD INDEX_INCR DIRECT AXIS_PTS_Y 4 UWORD INDEX_INCR DIRECT FNC_VALUES 5 UBYTE COLUMN_DIR DIRECT /end RECORD_LAYOUT
/begin RECORD_LAYOUT TKF_SW_UB_UB NO_AXIS_PTS_X 1 UBYTE NO_AXIS_PTS_Y 2 UBYTE AXIS_PTS_X 3 UBYTE INDEX_INCR DIRECT AXIS_PTS_Y 4 SWORD INDEX_INCR DIRECT FNC_VALUES 5 UBYTE COLUMN_DIR DIRECT /end RECORD_LAYOUT
/begin RECORD_LAYOUT TKF_SW_UW_UB NO_AXIS_PTS_X 1 UBYTE NO_AXIS_PTS_Y 2 UBYTE AXIS_PTS_X 3 UWORD INDEX_INCR DIRECT AXIS_PTS_Y 4 SWORD INDEX_INCR DIRECT FNC_VALUES 5 UBYTE COLUMN_DIR DIRECT /end RECORD_LAYOUT
/begin RECORD_LAYOUT TKF_SW_SW_UB NO_AXIS_PTS_X 1 UBYTE NO_AXIS_PTS_Y 2 UBYTE AXIS_PTS_X 3 SWORD INDEX_INCR DIRECT AXIS_PTS_Y 4 SWORD INDEX_INCR DIRECT FNC_VALUES 5 UBYTE COLUMN_DIR DIRECT /end RECORD_LAYOUT
/begin RECORD_LAYOUT TKF_SW_SW_UW NO_AXIS_PTS_X 1 UBYTE NO_AXIS_PTS_Y 2 UBYTE AXIS_PTS_X 3 SWORD INDEX_INCR DIRECT AXIS_PTS_Y 4 SWORD INDEX_INCR DIRECT FNC_VALUES 5 UWORD COLUMN_DIR DIRECT /end RECORD_LAYOUT
/begin RECORD_LAYOUT TKF_SW_SW_SW NO_AXIS_PTS_X 1 UBYTE NO_AXIS_PTS_Y 2 UBYTE AXIS_PTS_X 3 SWORD INDEX_INCR DIRECT AXIS_PTS_Y 4 SWORD INDEX_INCR DIRECT FNC_VALUES 5 SWORD COLUMN_DIR DIRECT /end RECORD_LAYOUT
/end MODULE
/end PROJECT
