/begin PROJECT MSS65-inj-V452 "MSS65 INJ - V452.01-B204.00, data set 0569Q60Z160E"
/begin HEADER "" VERSION "V452.01-B204.00" /end HEADER
/begin MODULE _MSS65-inj "MSS65 INJ - V452.01-B204.00, calibration xxxxxxxx"
/begin MOD_COMMON "" BYTE_ORDER MSB_FIRST /* Default byteorder (Motorola) */ /end MOD_COMMON
/begin COMPU_METHOD FORMULA_0003 "FORMULA_0003" RAT_FUNC "%3.0" "-" COEFFS 0 1 0 0 0 1 /end COMPU_METHOD
/begin COMPU_METHOD FORMULA_0010 "FORMULA_0010" RAT_FUNC "%5.0" "-" COEFFS 0 1 0 0 0 1 /end COMPU_METHOD
/begin COMPU_METHOD FORMULA_0024 "FORMULA_0024" RAT_FUNC "%9.4" "-" COEFFS 0 32768 0 0 0 1 /end COMPU_METHOD
/begin COMPU_METHOD FORMULA_0027 "FORMULA_0027" RAT_FUNC "%7.0" "km" COEFFS 0 1 0 0 0 1 /end COMPU_METHOD
/begin COMPU_METHOD FORMULA_0033 "FORMULA_0033" RAT_FUNC "%5.2" "-" COEFFS 0 1 0 0 0 1 /end COMPU_METHOD
/begin COMPU_METHOD FORMULA_0050 "FORMULA_0050" TAB_VERB "%5.0" "-" COMPU_TAB_REF FORMULA_0050_VTAB /end COMPU_METHOD
/begin COMPU_VTAB FORMULA_0050_VTAB "FORMULA_0050_VTAB" TAB_VERB 352 10000 "SK_INJ_TESTFEHLER" 10001 "PUMG_FEHLER" 10002 "HFM1_FEHLER" 10003 "HFM2_FEHLER" 10004 "PSAU1_FEHLER" 10005 "PSAU2_FEHLER" 10006 "VAN_HALL_E1_FEHLER" 10007 "VAN_HALL_A1_FEHLER" 10008 "VAN_HALL_E2_FEHLER" 10009 "VAN_HALL_A2_FEHLER" 10010 "VAN_REGL_E1_FEHLER" 10011 "VAN_REGL_A1_FEHLER" 10012 "VAN_REGL_E2_FEHLER" 10013 "VAN_REGL_A2_FEHLER" 10014 "NW1_SYNC_FEHLER" 10015 "NW2_SYNC_FEHLER" 10016 "PCTRL_IGN_FEHLER" 10017 "PT_TORQDKG_FEHLER" 10018 "PKS_FEHLER" 10019 "PT_STATUSR_FEHLER" 10020 "LAVK1_FEHLER" 10021 "LAVK2_FEHLER" 10022 "LAVK1_OBD_PLAU_FEHLER" 10023 "LAVK2_OBD_PLAU_FEHLER" 10024 "LAVK1_OBD_SA_FEHLER" 10025 "LAVK2_OBD_SA_FEHLER" 10026 "LANK1_FEHLER" 10027 "LANK2_FEHLER" 10028 "LSHNK1_FEHLER" 10029 "LSHNK2_FEHLER" 52615 "PT_BUSOFF" 52632 "PT_TORQDSC_FEHLER" 52645 "PT_STDSC_FEHLER" 52667 "PT_VRAD_FEHLER" 52636 "PT_VFZG_FEHLER" 52628 "PT_ATEMP_FEHLER" 52640 "PT_KLST_FEHLER" 52649 "PT_KKOS_FEHLER" 52641 "PT_LRW_FEHLER" 10039 "FPLAU1_FEHLER" 10040 "FPLAU2_FEHLER" 10041 "SL_ML_HFM_FEHLER" 10042 "LANK1_OBD_S_FEHLER" 10043 "LANK2_OBD_S_FEHLER" 10044 "LAVK1_OBD_TL_FEHLER" 10045 "LAVK2_OBD_TL_FEHLER" 10046 "LSHVK1_FEHLER" 10047 "LSHVK2_FEHLER" 10048 "LSRVK1_OBD_REG_FEHLER" 10049 "LSRVK2_OBD_REG_FEHLER" 10050 "LSHVK1_R_FEHLER" 10051 "LSHVK2_R_FEHLER" 10052 "LSRVK1_OBD_START_FEHLER" 10053 "LSRVK2_OBD_START_FEHLER" 10054 "LSRVK1_OBD_REF_FEHLER" 10055 "LSRVK2_OBD_REF_FEHLER" 10056 "LAVK1_DIAG_FEHLER" 10057 "LAVK2_DIAG_FEHLER" 10058 "LAVK1_IA_OPENLOAD_FEHLER" 10059 "LAVK2_IA_OPENLOAD_FEHLER" 10060 "PT_GRB_FEHLER" 10061 "PT_GRB2_FEHLER" 10062 "LAVK1_UN_OPENLOAD_FEHLER" 10063 "LAVK2_UN_OPENLOAD_FEHLER" 10064 "LAVK1_IP_OPENLOAD_FEHLER" 10065 "LAVK2_IP_OPENLOAD_FEHLER" 10066 "APPL_DATA_INJ" 10067 "TZ1_FEHLER" 10068 "TZ2_FEHLER" 10069 "TZ3_FEHLER" 10070 "TZ4_FEHLER" 10071 "TZ5_FEHLER" 10072 "TZ6_FEHLER" 10073 "TZ7_FEHLER" 10074 "TZ8_FEHLER" 10075 "TZ9_FEHLER" 10076 "TZ10_FEHLER" 10077 "LAM1_REG_FEHLER" 10078 "LAM2_REG_FEHLER" 10079 "VAN_ANSCHL_E1_FEHLER" 10080 "VAN_ANSCHL_A1_FEHLER" 10081 "VAN_ANSCHL_E2_FEHLER" 10082 "VAN_ANSCHL_A2_FEHLER" 10083 "VAN_VENT_E1_FEHLER" 10084 "VAN_VENT_A1_FEHLER" 10085 "VAN_VENT_E2_FEHLER" 10086 "VAN_VENT_A2_FEHLER" 10087 "EV1_FEHLER" 10088 "EV2_FEHLER" 10089 "EV3_FEHLER" 10090 "EV4_FEHLER" 10091 "EV5_FEHLER" 10092 "EV6_FEHLER" 10093 "EV7_FEHLER" 10094 "EV8_FEHLER" 10095 "EV9_FEHLER" 10096 "EV10_FEHLER" 10097 "LAVK1_OBD_DYN_FEHLER" 10098 "LAVK2_OBD_DYN_FEHLER" 52650 "PT_CRASH_FEHLER" 52635 "PT_VEHMOD_FEHLER" 52629 "PT_BEDFGR_FEHLER" 10102 "DMTL_P_FEHLER" 10103 "DMTL_V_FEHLER" 10104 "DMTL_H_FEHLER" 10105 "DMTL_GROBLECK_FEHLER" 10106 "DMTL_FEUCHT_FEHLER" 10107 "DMTL_DECKEL_MELDUNG" 10108 "LA1_TRIM_FEHLER" 10109 "LA2_TRIM_FEHLER" 10110 "RLU87_FEHLER" 10111 "EKP_PWM_FEHLER" 10112 "SSP_FEHLER" 10113 "TD_FEHLER" 10114 "RLSLP_FEHLER" 10115 "SLV_FEHLER" 52639 "PT_KMST_FEHLER" 52648 "PT_STATKOM_FEHLER" 10118 "PKS_LL_FEHLER" 10119 "PKS_TL_FEHLER" 10120 "PKS_Q_FEHLER" 10121 "KAT_OBD1_FEHLER" 10122 "KAT_OBD2_FEHLER" 10123 "VAN_DSV_FEHLER" 10124 "FI_GEN" 10125 "FI_BSD" 10126 "FI_QLT" 10127 "FI_IBS1" 10128 "FI_IBS2" 10129 "FI_IBS3" 10130 "FI_PMBN" 10131 "FI_PMBATT" 10132 "MVAC_DRUCKSENSOR" 52668 "PT_BEDAT_FEHLER" 10134 "SK_MANAGER_INJ" 10135 "SSP_DIAG_FEHLER" 10136 "EWS_SCI_FEHLER" 10137 "EWS_MAN_FEHLER" 10138 "FI_BSD_0" 10139 "FI_BSD_6" 10140 "FI_BSDGLOB" 10141 "FI_PMRUHVERL" 10142 "FI_TOENS" 10143 "EBOX_ELU_FEHLER" 10144 "SG_INJ_FEHLER" 10145 "EGAS_ENLTG1_DIAG" 10146 "EGAS_ENLTG2_DIAG" 10147 "S_POEL_FEHLER" 10148 "TEV1_OBD_FEHLER" 10149 "TEV2_OBD_FEHLER" 10150 "TEV1_FEHLER" 10151 "TEV2_FEHLER" 10152 "EBENE2_INJ_FEHLER" 10153 "KW_FEHLER" 10154 "LA1_ADAPT_FEHLER" 10155 "LA2_ADAPT_FEHLER" 10156 "KGE1_FEHLER" 10157 "KGE2_FEHLER" 10158 "FST_FEHLER" 10159 "SLP_FEHLER" 10160 "SL_DURCHS_B1" 10161 "SL_DURCHS_B2" 10162 "SL_DURCHS_HSTRANG" 10163 "FETRAWE_FEHLER" 10164 "S_GETR_HS_FEHLER" 10165 "S_KUPP_HS_FEHLER" 10166 "VAN_DRUCK_FEHLER" 10167 "ELUP_FEHLER" 10168 "ELU_FEHLER" 52655 "PT_STATANH_FEHLER" 10170 "KSD1_FEHLER" 10171 "KSD2_FEHLER" 10172 "KATS1_FEHLER" 10173 "KATS2_FEHLER" 10174 "PT_STATGRB_FEHLER" 10175 "PT_ANFRADMOM_FEHLER" 10176 "FST_GEBER_FEHLER" 10177 "TANK_LEER_INFO" 10178 "PT_TOMA_FEHLER" 10179 "DMTL_FEINLECK_FEHLER" 10180 "PUMG_OBD_FEHLER" 10181 "SL_ML_HFM_OBD_FEHLER" 10182 "LA1_TRIM_AD_FEHLER" 10183 "LA2_TRIM_AD_FEHLER" 10184 "LANK1_OPENLOAD_FEHLER" 10185 "LANK2_OPENLOAD_FEHLER" 10186 "LANK1_OBD_WE_FEHLER" 10187 "LANK2_OBD_WE_FEHLER" 10188 "LSHNK1_R_FEHLER" 10189 "LSHNK2_R_FEHLER" 10190 "PKS_MODELL_FEHLER" 10191 "PKS_PAUFBAU_FEHLER" 10192 "PKSR_ADAPT_ANSCHL_FEHLER" 10193 "TGETR_FEHLER" 10194 "LAVK_ATIC42_FEHLER" 10195 "PT_ALAENGS_FEHLER" 10196 "PT_OBD_ED_FEHLER" 10197 "FST_GEBER_LI_FEHLER" 10198 "FST_GEBER_RE_FEHLER" 10199 "LANK1_OBD_SLOPE_FEHLER" 10200 "LANK2_OBD_SLOPE_FEHLER" 10201 "MVAC_OBD_FEHLER" 10202 "ELUP_OBD_FEHLER" 10203 "LAVK2_ATIC42_FEHLER" 10204 "INDEX_204_INJ" 10205 "INDEX_205_INJ" 10206 "INDEX_206_INJ" 10207 "INDEX_207_INJ" 10208 "INDEX_208_INJ" 10209 "INDEX_209_INJ" 10210 "INDEX_210_INJ" 10211 "INDEX_211_INJ" 10212 "INDEX_212_INJ" 10213 "INDEX_213_INJ" 10214 "INDEX_214_INJ" 10215 "INDEX_215_INJ" 10216 "INDEX_216_INJ" 10217 "INDEX_217_INJ" 10218 "INDEX_218_INJ" 10219 "INDEX_219_INJ" 10220 "INDEX_220_INJ" 10221 "INDEX_221_INJ" 10222 "INDEX_222_INJ" 10223 "INDEX_223_INJ" 11000 "SK_IGN_TESTFEHLER" 11001 "TMOT_FEHLER" 11002 "TMOT_OBD_FEHLER" 11003 "TAN1_FEHLER" 11004 "TAN2_FEHLER" 11005 "TIME_REL_OBD_FEHLER" 11006 "UB_FEHLER" 11007 "TKA_FEHLER" 11008 "TDME_FEHLER" 11009 "UEXT_111_219_514_FEHLER" 11010 "UEXT_124_512_FEHLER" 11011 "APPL_DATA_IGN" 11012 "TKA_OBD_FEHLER" 11013 "PWG1_FEHLER" 11014 "PWG2_FEHLER" 11015 "PWG_VGL_FEHLER" 11016 "PCTRL_INJ_FEHLER" 52669 "EC_LLS1_FEHLER" 52670 "EC_LLS2_FEHLER" 52671 "EC_DK1_FEHLER" 52672 "EC_DK2_FEHLER" 11021 "LLS1_SK_FEHLER" 11022 "LLS2_SK_FEHLER" 11023 "SMG_SCHALTABLAUF" 11024 "SMG_SK_FEHLER" 11025 "SMG_SK_N_UEBERWACHUNG" 11026 "TUMG_OBD_FEHLER" 11027 "V_FEHLER" 11028 "DK_INIT_FEHLER" 11029 "DK1_REG_FEHLER" 11030 "DK2_REG_FEHLER" 11031 "DK1_ADAPT_FEHLER" 11032 "DK2_ADAPT_FEHLER" 11033 "IONVERST_B1" 11034 "IONSPG_B1" 11035 "IONVERST_B2" 11036 "IONSPG_B2" 11037 "TABG1_FEHLER" 11038 "TABG2_FEHLER" 11039 "DK1_WDK_FEHLER" 11040 "DK2_WDK_FEHLER" 11041 "DK1_PDR_FEHLER" 11042 "DK2_PDR_FEHLER" 11043 "LLS1_REG_FEHLER" 11044 "LLS2_REG_FEHLER" 11045 "DK1_SK_FEHLER" 11046 "DK2_SK_FEHLER" 11047 "DK1_FT_FEHLER" 11048 "DK2_FT_FEHLER" 11049 "MD_SK_ERR" 11050 "LLS_INIT_FEHLER" 11051 "DSC_EINGR_FEHLER" 11052 "DK1_CMD_FEHLER" 11053 "DK2_CMD_FEHLER" 11054 "LLS1_CMD_FEHLER" 11055 "LLS2_CMD_FEHLER" 52673 "SC_SMG1_FEHLER" 52674 "SC_SMG2_FEHLER" 52675 "SC_SMG3_FEHLER" 52619 "SC_BUSOFF_FEHLER" 52627 "EC_BUSOFF_FEHLER" 11061 "AUSS_KAT_Z1_FEHLER" 11062 "AUSS_KAT_Z2_FEHLER" 11063 "AUSS_KAT_Z3_FEHLER" 11064 "AUSS_KAT_Z4_FEHLER" 11065 "AUSS_KAT_Z5_FEHLER" 11066 "AUSS_KAT_Z6_FEHLER" 11067 "AUSS_KAT_Z7_FEHLER" 11068 "AUSS_KAT_Z8_FEHLER" 11069 "AUSS_KAT_Z9_FEHLER" 11070 "AUSS_KAT_Z10_FEHLER" 11071 "ION_SIG_BANK_1" 11072 "ION_SIG_BANK_2" 11073 "AUSS_KAT_MULT_FEHLER" 11074 "AUSS_ABG_Z1_FEHLER" 11075 "AUSS_ABG_Z2_FEHLER" 11076 "AUSS_ABG_Z3_FEHLER" 11077 "AUSS_ABG_Z4_FEHLER" 11078 "AUSS_ABG_Z5_FEHLER" 11079 "AUSS_ABG_Z6_FEHLER" 11080 "AUSS_ABG_Z7_FEHLER" 11081 "AUSS_ABG_Z8_FEHLER" 11082 "AUSS_ABG_Z9_FEHLER" 11083 "AUSS_ABG_Z10_FEHLER" 11084 "ION_SAT_BANK_1" 11085 "ION_SAT_BANK_2" 11086 "AUSS_ABG_MULT_FEHLER" 11087 "TAN_OBD_B1_FEHLER" 11088 "DKG_EINGR_FEHLER" 11089 "SC_PKS_FEHLER" 11090 "ZOELP1_FEHLER" 11091 "ZOELP2_FEHLER" 11092 "SG_IGN_FEHLER" 11093 "EBENE2_IGN_FEHLER" 11094 "BLS_PLAU_FEHLER" 11095 "SK_MANAGER_IGN" 11096 "LLR_DIAGNOSE" 11097 "THERMOSTAT_FEHLER" 11098 "TAN_OBD_B2_FEHLER" 11099 "DK1_ZUSTAND" 11100 "DK2_ZUSTAND" 11101 "FGR_ABWURF" 11102 "PWG_BLS_FEHLER" 11103 "START_RL_FEHLER" 11104 "AFZ_FEHLER" 11105 "N_GETR_EIN_HS_FEHLER" 11106 "TUMG_FEHLER" 11107 "LLR_DIAGNOSE_CSS" 11108 "TMOT_HIGH_FEHLER" 11109 "AFZ_NA_FEHLER" 11110 "INDEX_110_IGN" 11111 "INDEX_111_IGN" 11112 "INDEX_112_IGN" 11113 "INDEX_113_IGN" 11114 "INDEX_114_IGN" 11115 "INDEX_115_IGN" 11116 "INDEX_116_IGN" 11117 "INDEX_117_IGN" 11118 "INDEX_118_IGN" 11119 "INDEX_119_IGN" 11120 "INDEX_120_IGN" 11121 "INDEX_121_IGN" 11122 "INDEX_122_IGN" 11123 "INDEX_123_IGN" 11124 "INDEX_124_IGN" 11125 "INDEX_125_IGN" 11126 "INDEX_126_IGN" 11127 "INDEX_127_IGN" /end COMPU_VTAB
/begin COMPU_METHOD FORMULA_0051 "FORMULA_0051" RAT_FUNC "%5.0" "km" COEFFS 0 1 0 0 0 8 /end COMPU_METHOD
/begin COMPU_METHOD FORMULA_0052 "FORMULA_0052" RAT_FUNC "%5.0" "-" COEFFS 0 4 0 0 0 1 /end COMPU_METHOD
/begin COMPU_METHOD FORMULA_0053 "FORMULA_0053" RAT_FUNC "%7.2" "g/s" COEFFS 0 100 0 0 0 1 /end COMPU_METHOD
/begin COMPU_METHOD FORMULA_0054 "FORMULA_0054" TAB_VERB "%3.0" "-" COMPU_TAB_REF FORMULA_0054_VTAB /end COMPU_METHOD
/begin COMPU_VTAB FORMULA_0054_VTAB "FORMULA_0054_VTAB" TAB_VERB 4 1 "Regler noch aus" 2 "Regler aktiv" 4 "Schubabschalten" 8 "Sonde defekt" /end COMPU_VTAB
/begin COMPU_METHOD FORMULA_0055 "FORMULA_0055" RAT_FUNC "%7.4" "-" COEFFS 0 128 0 0 0 1 /end COMPU_METHOD
/begin COMPU_METHOD FORMULA_0056 "FORMULA_0056" RAT_FUNC "%7.4" "%" COEFFS 0 255 0 0 0 100 /end COMPU_METHOD
/begin COMPU_METHOD FORMULA_0057 "FORMULA_0057" RAT_FUNC "%3.0" "�C" COEFFS 0 1 40 0 0 1 /end COMPU_METHOD
/begin COMPU_METHOD FORMULA_0058 "FORMULA_0058" RAT_FUNC "%3.0" "kPa" COEFFS 0 1 0 0 0 3 /end COMPU_METHOD
/begin COMPU_METHOD FORMULA_0059 "FORMULA_0059" RAT_FUNC "%3.0" "km/h" COEFFS 0 1 0 0 0 1 /end COMPU_METHOD
/begin COMPU_METHOD FORMULA_0060 "FORMULA_0060" RAT_FUNC "%4.1" "�KW" COEFFS 0 2 128 0 0 1 /end COMPU_METHOD
/begin COMPU_METHOD FORMULA_0061 "FORMULA_0061" TAB_VERB "%3.0" "-" COMPU_TAB_REF FORMULA_0061_VTAB /end COMPU_METHOD
/begin COMPU_VTAB FORMULA_0061_VTAB "FORMULA_0061_VTAB" TAB_VERB 2 1 "Einblasung" 4 "Keine Einblasung" /end COMPU_VTAB
/begin COMPU_METHOD FORMULA_0062 "FORMULA_0062" RAT_FUNC "%5.0" "s" COEFFS 0 1 0 0 0 1 /end COMPU_METHOD
/begin COMPU_METHOD FORMULA_0063 "FORMULA_0063" RAT_FUNC "%8.3" "V" COEFFS 0 1000 0 0 0 1 /end COMPU_METHOD
/begin COMPU_METHOD FORMULA_0064 "FORMULA_0064" RAT_FUNC "%9.4" "%" COEFFS 0 255 0 0 0 1 /end COMPU_METHOD
/begin COMPU_METHOD FORMULA_0065 "FORMULA_0065" RAT_FUNC "%5.2" "%" COEFFS 0 255 0 0 0 100 /end COMPU_METHOD
/begin COMPU_METHOD FORMULA_0066 "FORMULA_0066" RAT_FUNC "%3.0" "kPa" COEFFS 0 1 0 0 0 1 /end COMPU_METHOD
/begin COMPU_METHOD FORMULA_0067 "FORMULA_0067" TAB_VERB "%5.2" "-" COMPU_TAB_REF FORMULA_0067_VTAB /end COMPU_METHOD
/begin COMPU_VTAB FORMULA_0067_VTAB "FORMULA_0067_VTAB" TAB_VERB 1 0 "MIL aus" DEFAULT_VALUE "MIL an" /end COMPU_VTAB
/begin COMPU_METHOD FORMULA_0068 "FORMULA_0068" TAB_VERB "%5.2" "-" COMPU_TAB_REF FORMULA_0068_VTAB /end COMPU_METHOD
/begin COMPU_VTAB FORMULA_0068_VTAB "FORMULA_0068_VTAB" TAB_VERB 1 0 "PRE-MIL aus" DEFAULT_VALUE "PRE-MIL an" /end COMPU_VTAB
/begin COMPU_METHOD FORMULA_0069 "FORMULA_0069" TAB_VERB "%5.2" "-" COMPU_TAB_REF FORMULA_0069_VTAB /end COMPU_METHOD
/begin COMPU_VTAB FORMULA_0069_VTAB "FORMULA_0069_VTAB" TAB_VERB 1 0 "DME-MIL aus" DEFAULT_VALUE "DME-MIL an" /end COMPU_VTAB
/begin COMPU_METHOD FORMULA_0070 "FORMULA_0070" TAB_VERB "%5.2" "-" COMPU_TAB_REF FORMULA_0070_VTAB /end COMPU_METHOD
/begin COMPU_VTAB FORMULA_0070_VTAB "FORMULA_0070_VTAB" TAB_VERB 1 0 "ZYL_OFF-MIL aus" DEFAULT_VALUE "ZYL_OFF-MIL an" /end COMPU_VTAB
/begin COMPU_METHOD FORMULA_0071 "FORMULA_0071" TAB_VERB "%5.2" "-" COMPU_TAB_REF FORMULA_0071_VTAB /end COMPU_METHOD
/begin COMPU_VTAB FORMULA_0071_VTAB "FORMULA_0071_VTAB" TAB_VERB 1 0 "SMG-MIL aus" DEFAULT_VALUE "SMG-MIL an" /end COMPU_VTAB
/begin COMPU_METHOD FORMULA_0072 "FORMULA_0072" TAB_VERB "%3.0" "-" COMPU_TAB_REF FORMULA_0072_VTAB /end COMPU_METHOD
/begin COMPU_VTAB FORMULA_0072_VTAB "FORMULA_0072_VTAB" TAB_VERB 1 165 "fsp_loeschen" DEFAULT_VALUE "fsp_sichern" /end COMPU_VTAB
/begin MEASUREMENT ed_rbm_denominator_nv "Status der Denominatorerhoehung" UBYTE FORMULA_0003 0 0 0.0 255.0000 ECU_ADDRESS 0x3F9861 /end MEASUREMENT
/begin MEASUREMENT ed_mil_on_km_stand_nv "Kilometerstand MIL on" ULONG FORMULA_0027 0 0 0.0 16777214.0000 ECU_ADDRESS 0x3F9864 /end MEASUREMENT
/begin MEASUREMENT ed_mil_off_km_stand_nv "Kilometerstand MIL off" ULONG FORMULA_0027 0 0 0.0 16777214.0000 ECU_ADDRESS 0x3F9868 /end MEASUREMENT
/begin MEASUREMENT ed_rbm_appl_data_inj.numerator_nv "Diagnosezyklen" UWORD FORMULA_0010 0 0 0.0 65535.0000 ECU_ADDRESS 0x3F9EB8 /end MEASUREMENT
/begin MEASUREMENT ed_rbm_ev1.numerator_nv "Diagnosezyklen" UWORD FORMULA_0010 0 0 0.0 65535.0000 ECU_ADDRESS 0x3F9F0C /end MEASUREMENT
/begin MEASUREMENT ed_rbm_ev2.numerator_nv "Diagnosezyklen" UWORD FORMULA_0010 0 0 0.0 65535.0000 ECU_ADDRESS 0x3F9F10 /end MEASUREMENT
/begin MEASUREMENT ed_rbm_ev3.numerator_nv "Diagnosezyklen" UWORD FORMULA_0010 0 0 0.0 65535.0000 ECU_ADDRESS 0x3F9F14 /end MEASUREMENT
/begin MEASUREMENT ed_rbm_ev4.numerator_nv "Diagnosezyklen" UWORD FORMULA_0010 0 0 0.0 65535.0000 ECU_ADDRESS 0x3F9F18 /end MEASUREMENT
/begin MEASUREMENT ed_rbm_ev5.numerator_nv "Diagnosezyklen" UWORD FORMULA_0010 0 0 0.0 65535.0000 ECU_ADDRESS 0x3F9F1C /end MEASUREMENT
/begin MEASUREMENT ed_rbm_ev10.numerator_nv "Diagnosezyklen" UWORD FORMULA_0010 0 0 0.0 65535.0000 ECU_ADDRESS 0x3F9F30 /end MEASUREMENT
/begin MEASUREMENT ed_rbm_dmtl_p.numerator_nv "Diagnosezyklen" UWORD FORMULA_0010 0 0 0.0 65535.0000 ECU_ADDRESS 0x3F9F48 /end MEASUREMENT
/begin MEASUREMENT ed_rbm_dmtl_v.numerator_nv "Diagnosezyklen" UWORD FORMULA_0010 0 0 0.0 65535.0000 ECU_ADDRESS 0x3F9F4C /end MEASUREMENT
/begin MEASUREMENT ed_rbm_dmtl_h.numerator_nv "Diagnosezyklen" UWORD FORMULA_0010 0 0 0.0 65535.0000 ECU_ADDRESS 0x3F9F50 /end MEASUREMENT
/begin MEASUREMENT ed_rbm_dmtl_grobleck.numerator_nv "Diagnosezyklen" UWORD FORMULA_0010 0 0 0.0 65535.0000 ECU_ADDRESS 0x3F9F54 /end MEASUREMENT
/begin MEASUREMENT ed_rbm_dmtl_feucht.numerator_nv "Diagnosezyklen" UWORD FORMULA_0010 0 0 0.0 65535.0000 ECU_ADDRESS 0x3F9F58 /end MEASUREMENT
/begin MEASUREMENT ed_rbm_dmtl_deckel.numerator_nv "Diagnosezyklen" UWORD FORMULA_0010 0 0 0.0 65535.0000 ECU_ADDRESS 0x3F9F5C /end MEASUREMENT
/begin MEASUREMENT ed_rbm_ekp_pwm.numerator_nv "Diagnosezyklen" UWORD FORMULA_0010 0 0 0.0 65535.0000 ECU_ADDRESS 0x3F9F6C /end MEASUREMENT
/begin MEASUREMENT ed_rbm_ebox_elu.numerator_nv "Diagnosezyklen" UWORD FORMULA_0010 0 0 0.0 65535.0000 ECU_ADDRESS 0x3F9FEC /end MEASUREMENT
/begin MEASUREMENT ed_rbm_dk1_enltg.numerator_nv "Diagnosezyklen" UWORD FORMULA_0010 0 0 0.0 65535.0000 ECU_ADDRESS 0x3F9FF4 /end MEASUREMENT
/begin MEASUREMENT ed_rbm_dk2_enltg.numerator_nv "Diagnosezyklen" UWORD FORMULA_0010 0 0 0.0 65535.0000 ECU_ADDRESS 0x3F9FF8 /end MEASUREMENT
/begin MEASUREMENT ed_rbm_e2_inj.numerator_nv "Diagnosezyklen" UWORD FORMULA_0010 0 0 0.0 65535.0000 ECU_ADDRESS 0x3FA010 /end MEASUREMENT
/begin MEASUREMENT ed_rbm_elup.numerator_nv "Diagnosezyklen" UWORD FORMULA_0010 0 0 0.0 65535.0000 ECU_ADDRESS 0x3FA04C /end MEASUREMENT
/begin MEASUREMENT ed_rbm_elu.numerator_nv "Diagnosezyklen" UWORD FORMULA_0010 0 0 0.0 65535.0000 ECU_ADDRESS 0x3FA050 /end MEASUREMENT
/begin MEASUREMENT ed_rbm_dmtl_feinleck.numerator_nv "Diagnosezyklen" UWORD FORMULA_0010 0 0 0.0 65535.0000 ECU_ADDRESS 0x3FA07C /end MEASUREMENT
/begin MEASUREMENT ed_rbm_elup_obd.numerator_nv "Diagnosezyklen" UWORD FORMULA_0010 0 0 0.0 65535.0000 ECU_ADDRESS 0x3FA0D8 /end MEASUREMENT
/begin MEASUREMENT ed_rbm_appl_data_inj.denominator_nv "Fahrzyklen" UWORD FORMULA_0010 0 0 0.0 65535.0000 ECU_ADDRESS 0x3F9EBA /end MEASUREMENT
/begin MEASUREMENT ed_rbm_ev1.denominator_nv "Fahrzyklen" UWORD FORMULA_0010 0 0 0.0 65535.0000 ECU_ADDRESS 0x3F9F0E /end MEASUREMENT
/begin MEASUREMENT ed_rbm_ev2.denominator_nv "Fahrzyklen" UWORD FORMULA_0010 0 0 0.0 65535.0000 ECU_ADDRESS 0x3F9F12 /end MEASUREMENT
/begin MEASUREMENT ed_rbm_ev3.denominator_nv "Fahrzyklen" UWORD FORMULA_0010 0 0 0.0 65535.0000 ECU_ADDRESS 0x3F9F16 /end MEASUREMENT
/begin MEASUREMENT ed_rbm_ev4.denominator_nv "Fahrzyklen" UWORD FORMULA_0010 0 0 0.0 65535.0000 ECU_ADDRESS 0x3F9F1A /end MEASUREMENT
/begin MEASUREMENT ed_rbm_ev5.denominator_nv "Fahrzyklen" UWORD FORMULA_0010 0 0 0.0 65535.0000 ECU_ADDRESS 0x3F9F1E /end MEASUREMENT
/begin MEASUREMENT ed_rbm_ev6.denominator_nv "Fahrzyklen" UWORD FORMULA_0010 0 0 0.0 65535.0000 ECU_ADDRESS 0x3F9F22 /end MEASUREMENT
/begin MEASUREMENT ed_rbm_ev10.denominator_nv "Fahrzyklen" UWORD FORMULA_0010 0 0 0.0 65535.0000 ECU_ADDRESS 0x3F9F32 /end MEASUREMENT
/begin MEASUREMENT ed_rbm_dmtl_p.denominator_nv "Fahrzyklen" UWORD FORMULA_0010 0 0 0.0 65535.0000 ECU_ADDRESS 0x3F9F4A /end MEASUREMENT
/begin MEASUREMENT ed_rbm_dmtl_v.denominator_nv "Fahrzyklen" UWORD FORMULA_0010 0 0 0.0 65535.0000 ECU_ADDRESS 0x3F9F4E /end MEASUREMENT
/begin MEASUREMENT ed_rbm_dmtl_h.denominator_nv "Fahrzyklen" UWORD FORMULA_0010 0 0 0.0 65535.0000 ECU_ADDRESS 0x3F9F52 /end MEASUREMENT
/begin MEASUREMENT ed_rbm_dmtl_grobleck.denominator_nv "Fahrzyklen" UWORD FORMULA_0010 0 0 0.0 65535.0000 ECU_ADDRESS 0x3F9F56 /end MEASUREMENT
/begin MEASUREMENT ed_rbm_dmtl_feucht.denominator_nv "Fahrzyklen" UWORD FORMULA_0010 0 0 0.0 65535.0000 ECU_ADDRESS 0x3F9F5A /end MEASUREMENT
/begin MEASUREMENT ed_rbm_dmtl_deckel.denominator_nv "Fahrzyklen" UWORD FORMULA_0010 0 0 0.0 65535.0000 ECU_ADDRESS 0x3F9F5E /end MEASUREMENT
/begin MEASUREMENT ed_rbm_ekp_pwm.denominator_nv "Fahrzyklen" UWORD FORMULA_0010 0 0 0.0 65535.0000 ECU_ADDRESS 0x3F9F6E /end MEASUREMENT
/begin MEASUREMENT ed_rbm_ebox_elu.denominator_nv "Fahrzyklen" UWORD FORMULA_0010 0 0 0.0 65535.0000 ECU_ADDRESS 0x3F9FEE /end MEASUREMENT
/begin MEASUREMENT ed_rbm_dk1_enltg.denominator_nv "Fahrzyklen" UWORD FORMULA_0010 0 0 0.0 65535.0000 ECU_ADDRESS 0x3F9FF6 /end MEASUREMENT
/begin MEASUREMENT ed_rbm_dk2_enltg.denominator_nv "Fahrzyklen" UWORD FORMULA_0010 0 0 0.0 65535.0000 ECU_ADDRESS 0x3F9FFA /end MEASUREMENT
/begin MEASUREMENT ed_rbm_e2_inj.denominator_nv "Fahrzyklen" UWORD FORMULA_0010 0 0 0.0 65535.0000 ECU_ADDRESS 0x3FA012 /end MEASUREMENT
/begin MEASUREMENT ed_rbm_elup.denominator_nv "Fahrzyklen" UWORD FORMULA_0010 0 0 0.0 65535.0000 ECU_ADDRESS 0x3FA04E /end MEASUREMENT
/begin MEASUREMENT ed_rbm_elu.denominator_nv "Fahrzyklen" UWORD FORMULA_0010 0 0 0.0 65535.0000 ECU_ADDRESS 0x3FA052 /end MEASUREMENT
/begin MEASUREMENT ed_rbm_dmtl_feinleck.denominator_nv "Fahrzyklen" UWORD FORMULA_0010 0 0 0.0 65535.0000 ECU_ADDRESS 0x3FA07E /end MEASUREMENT
/begin MEASUREMENT ed_rbm_elup_obd.denominator_nv "Fahrzyklen" UWORD FORMULA_0010 0 0 0.0 65535.0000 ECU_ADDRESS 0x3FA0DA /end MEASUREMENT
/begin MEASUREMENT ed_fsp_1of20_.fehlercode_nv "Externer Fehlerort" UWORD FORMULA_0050 0 0 0.0 65535.0 ECU_ADDRESS 0x3FA130 /end MEASUREMENT
/begin MEASUREMENT ed_fsp_2of20_.fehlercode_nv "Externer Fehlerort" UWORD FORMULA_0050 0 0 0.0 65535.0 ECU_ADDRESS 0x3FA182 /end MEASUREMENT
/begin MEASUREMENT ed_fsp_3of20_.fehlercode_nv "Externer Fehlerort" UWORD FORMULA_0050 0 0 0.0 65535.0 ECU_ADDRESS 0x3FA1D4 /end MEASUREMENT
/begin MEASUREMENT ed_fsp_4of20_.fehlercode_nv "Externer Fehlerort" UWORD FORMULA_0050 0 0 0.0 65535.0 ECU_ADDRESS 0x3FA226 /end MEASUREMENT
/begin MEASUREMENT ed_fsp_5of20_.fehlercode_nv "Externer Fehlerort" UWORD FORMULA_0050 0 0 0.0 65535.0 ECU_ADDRESS 0x3FA278 /end MEASUREMENT
/begin MEASUREMENT ed_fsp_6of20_.fehlercode_nv "Externer Fehlerort" UWORD FORMULA_0050 0 0 0.0 65535.0 ECU_ADDRESS 0x3FA2CA /end MEASUREMENT
/begin MEASUREMENT ed_fsp_7of20_.fehlercode_nv "Externer Fehlerort" UWORD FORMULA_0050 0 0 0.0 65535.0 ECU_ADDRESS 0x3FA31C /end MEASUREMENT
/begin MEASUREMENT ed_fsp_8of20_.fehlercode_nv "Externer Fehlerort" UWORD FORMULA_0050 0 0 0.0 65535.0 ECU_ADDRESS 0x3FA36E /end MEASUREMENT
/begin MEASUREMENT ed_fsp_9of20_.fehlercode_nv "Externer Fehlerort" UWORD FORMULA_0050 0 0 0.0 65535.0 ECU_ADDRESS 0x3FA3C0 /end MEASUREMENT
/begin MEASUREMENT ed_fsp_15of20_.fehlercode_nv "Externer Fehlerort" UWORD FORMULA_0050 0 0 0.0 65535.0 ECU_ADDRESS 0x3FA5AC /end MEASUREMENT
/begin MEASUREMENT ed_fsp_16of20_.fehlercode_nv "Externer Fehlerort" UWORD FORMULA_0050 0 0 0.0 65535.0 ECU_ADDRESS 0x3FA5FE /end MEASUREMENT
/begin MEASUREMENT ed_fsp_17of20_.fehlercode_nv "Externer Fehlerort" UWORD FORMULA_0050 0 0 0.0 65535.0 ECU_ADDRESS 0x3FA650 /end MEASUREMENT
/begin MEASUREMENT ed_fsp_18of20_.fehlercode_nv "Externer Fehlerort" UWORD FORMULA_0050 0 0 0.0 65535.0 ECU_ADDRESS 0x3FA6A2 /end MEASUREMENT
/begin MEASUREMENT ed_fsp_19of20_.fehlercode_nv "Externer Fehlerort" UWORD FORMULA_0050 0 0 0.0 65535.0 ECU_ADDRESS 0x3FA6F4 /end MEASUREMENT
/begin MEASUREMENT ed_fsp_20of20_.fehlercode_nv "Externer Fehlerort" UWORD FORMULA_0050 0 0 0.0 65535.0 ECU_ADDRESS 0x3FA746 /end MEASUREMENT
/begin MEASUREMENT ed_fsp_1of20_.fehlerart_nv "Fehlerart und Statusbits" UWORD FORMULA_0010 0 0 0.0 65535.0000 ECU_ADDRESS 0x3FA132 /end MEASUREMENT
/begin MEASUREMENT ed_fsp_2of20_.fehlerart_nv "Fehlerart und Statusbits" UWORD FORMULA_0010 0 0 0.0 65535.0000 ECU_ADDRESS 0x3FA184 /end MEASUREMENT
/begin MEASUREMENT ed_fsp_3of20_.fehlerart_nv "Fehlerart und Statusbits" UWORD FORMULA_0010 0 0 0.0 65535.0000 ECU_ADDRESS 0x3FA1D6 /end MEASUREMENT
/begin MEASUREMENT ed_fsp_4of20_.fehlerart_nv "Fehlerart und Statusbits" UWORD FORMULA_0010 0 0 0.0 65535.0000 ECU_ADDRESS 0x3FA228 /end MEASUREMENT
/begin MEASUREMENT ed_fsp_5of20_.fehlerart_nv "Fehlerart und Statusbits" UWORD FORMULA_0010 0 0 0.0 65535.0000 ECU_ADDRESS 0x3FA27A /end MEASUREMENT
/begin MEASUREMENT ed_fsp_6of20_.fehlerart_nv "Fehlerart und Statusbits" UWORD FORMULA_0010 0 0 0.0 65535.0000 ECU_ADDRESS 0x3FA2CC /end MEASUREMENT
/begin MEASUREMENT ed_fsp_7of20_.fehlerart_nv "Fehlerart und Statusbits" UWORD FORMULA_0010 0 0 0.0 65535.0000 ECU_ADDRESS 0x3FA31E /end MEASUREMENT
/begin MEASUREMENT ed_fsp_8of20_.fehlerart_nv "Fehlerart und Statusbits" UWORD FORMULA_0010 0 0 0.0 65535.0000 ECU_ADDRESS 0x3FA370 /end MEASUREMENT
/begin MEASUREMENT ed_fsp_9of20_.fehlerart_nv "Fehlerart und Statusbits" UWORD FORMULA_0010 0 0 0.0 65535.0000 ECU_ADDRESS 0x3FA3C2 /end MEASUREMENT
/begin MEASUREMENT ed_fsp_15of20_.fehlerart_nv "Fehlerart und Statusbits" UWORD FORMULA_0010 0 0 0.0 65535.0000 ECU_ADDRESS 0x3FA5AE /end MEASUREMENT
/begin MEASUREMENT ed_fsp_16of20_.fehlerart_nv "Fehlerart und Statusbits" UWORD FORMULA_0010 0 0 0.0 65535.0000 ECU_ADDRESS 0x3FA600 /end MEASUREMENT
/begin MEASUREMENT ed_fsp_17of20_.fehlerart_nv "Fehlerart und Statusbits" UWORD FORMULA_0010 0 0 0.0 65535.0000 ECU_ADDRESS 0x3FA652 /end MEASUREMENT
/begin MEASUREMENT ed_fsp_18of20_.fehlerart_nv "Fehlerart und Statusbits" UWORD FORMULA_0010 0 0 0.0 65535.0000 ECU_ADDRESS 0x3FA6A4 /end MEASUREMENT
/begin MEASUREMENT ed_fsp_19of20_.fehlerart_nv "Fehlerart und Statusbits" UWORD FORMULA_0010 0 0 0.0 65535.0000 ECU_ADDRESS 0x3FA6F6 /end MEASUREMENT
/begin MEASUREMENT ed_fsp_20of20_.fehlerart_nv "Fehlerart und Statusbits" UWORD FORMULA_0010 0 0 0.0 65535.0000 ECU_ADDRESS 0x3FA748 /end MEASUREMENT
/begin MEASUREMENT ed_fsp_1of20_.haeufigkeitszaehler_nv "Uebergangszaehler von i.O. -> n.i.O" UBYTE FORMULA_0003 0 0 0.0 255.0000 ECU_ADDRESS 0x3FA134 /end MEASUREMENT
/begin MEASUREMENT ed_fsp_2of20_.haeufigkeitszaehler_nv "Uebergangszaehler von i.O. -> n.i.O" UBYTE FORMULA_0003 0 0 0.0 255.0000 ECU_ADDRESS 0x3FA186 /end MEASUREMENT
/begin MEASUREMENT ed_fsp_3of20_.haeufigkeitszaehler_nv "Uebergangszaehler von i.O. -> n.i.O" UBYTE FORMULA_0003 0 0 0.0 255.0000 ECU_ADDRESS 0x3FA1D8 /end MEASUREMENT
/begin MEASUREMENT ed_fsp_4of20_.haeufigkeitszaehler_nv "Uebergangszaehler von i.O. -> n.i.O" UBYTE FORMULA_0003 0 0 0.0 255.0000 ECU_ADDRESS 0x3FA22A /end MEASUREMENT
/begin MEASUREMENT ed_fsp_5of20_.haeufigkeitszaehler_nv "Uebergangszaehler von i.O. -> n.i.O" UBYTE FORMULA_0003 0 0 0.0 255.0000 ECU_ADDRESS 0x3FA27C /end MEASUREMENT
/begin MEASUREMENT ed_fsp_6of20_.haeufigkeitszaehler_nv "Uebergangszaehler von i.O. -> n.i.O" UBYTE FORMULA_0003 0 0 0.0 255.0000 ECU_ADDRESS 0x3FA2CE /end MEASUREMENT
/begin MEASUREMENT ed_fsp_7of20_.haeufigkeitszaehler_nv "Uebergangszaehler von i.O. -> n.i.O" UBYTE FORMULA_0003 0 0 0.0 255.0000 ECU_ADDRESS 0x3FA320 /end MEASUREMENT
/begin MEASUREMENT ed_fsp_8of20_.haeufigkeitszaehler_nv "Uebergangszaehler von i.O. -> n.i.O" UBYTE FORMULA_0003 0 0 0.0 255.0000 ECU_ADDRESS 0x3FA372 /end MEASUREMENT
/begin MEASUREMENT ed_fsp_9of20_.haeufigkeitszaehler_nv "Uebergangszaehler von i.O. -> n.i.O" UBYTE FORMULA_0003 0 0 0.0 255.0000 ECU_ADDRESS 0x3FA3C4 /end MEASUREMENT
/begin MEASUREMENT ed_fsp_14of20_.haeufigkeitszaehler_nv "Uebergangszaehler von i.O. -> n.i.O" UBYTE FORMULA_0003 0 0 0.0 255.0000 ECU_ADDRESS 0x3FA55E /end MEASUREMENT
/begin MEASUREMENT ed_fsp_15of20_.haeufigkeitszaehler_nv "Uebergangszaehler von i.O. -> n.i.O" UBYTE FORMULA_0003 0 0 0.0 255.0000 ECU_ADDRESS 0x3FA5B0 /end MEASUREMENT
/begin MEASUREMENT ed_fsp_16of20_.haeufigkeitszaehler_nv "Uebergangszaehler von i.O. -> n.i.O" UBYTE FORMULA_0003 0 0 0.0 255.0000 ECU_ADDRESS 0x3FA602 /end MEASUREMENT
/begin MEASUREMENT ed_fsp_17of20_.haeufigkeitszaehler_nv "Uebergangszaehler von i.O. -> n.i.O" UBYTE FORMULA_0003 0 0 0.0 255.0000 ECU_ADDRESS 0x3FA654 /end MEASUREMENT
/begin MEASUREMENT ed_fsp_18of20_.haeufigkeitszaehler_nv "Uebergangszaehler von i.O. -> n.i.O" UBYTE FORMULA_0003 0 0 0.0 255.0000 ECU_ADDRESS 0x3FA6A6 /end MEASUREMENT
/begin MEASUREMENT ed_fsp_19of20_.haeufigkeitszaehler_nv "Uebergangszaehler von i.O. -> n.i.O" UBYTE FORMULA_0003 0 0 0.0 255.0000 ECU_ADDRESS 0x3FA6F8 /end MEASUREMENT
/begin MEASUREMENT ed_fsp_20of20_.haeufigkeitszaehler_nv "Uebergangszaehler von i.O. -> n.i.O" UBYTE FORMULA_0003 0 0 0.0 255.0000 ECU_ADDRESS 0x3FA74A /end MEASUREMENT
/begin MEASUREMENT ed_fsp_1of20_.logistikzaehler_nv "Warm-Up-Cycling-Zaehler" UBYTE FORMULA_0003 0 0 0.0 255.0000 ECU_ADDRESS 0x3FA135 /end MEASUREMENT
/begin MEASUREMENT ed_fsp_2of20_.logistikzaehler_nv "Warm-Up-Cycling-Zaehler" UBYTE FORMULA_0003 0 0 0.0 255.0000 ECU_ADDRESS 0x3FA187 /end MEASUREMENT
/begin MEASUREMENT ed_fsp_3of20_.logistikzaehler_nv "Warm-Up-Cycling-Zaehler" UBYTE FORMULA_0003 0 0 0.0 255.0000 ECU_ADDRESS 0x3FA1D9 /end MEASUREMENT
/begin MEASUREMENT ed_fsp_4of20_.logistikzaehler_nv "Warm-Up-Cycling-Zaehler" UBYTE FORMULA_0003 0 0 0.0 255.0000 ECU_ADDRESS 0x3FA22B /end MEASUREMENT
/begin MEASUREMENT ed_fsp_5of20_.logistikzaehler_nv "Warm-Up-Cycling-Zaehler" UBYTE FORMULA_0003 0 0 0.0 255.0000 ECU_ADDRESS 0x3FA27D /end MEASUREMENT
/begin MEASUREMENT ed_fsp_6of20_.logistikzaehler_nv "Warm-Up-Cycling-Zaehler" UBYTE FORMULA_0003 0 0 0.0 255.0000 ECU_ADDRESS 0x3FA2CF /end MEASUREMENT
/begin MEASUREMENT ed_fsp_7of20_.logistikzaehler_nv "Warm-Up-Cycling-Zaehler" UBYTE FORMULA_0003 0 0 0.0 255.0000 ECU_ADDRESS 0x3FA321 /end MEASUREMENT
/begin MEASUREMENT ed_fsp_8of20_.logistikzaehler_nv "Warm-Up-Cycling-Zaehler" UBYTE FORMULA_0003 0 0 0.0 255.0000 ECU_ADDRESS 0x3FA373 /end MEASUREMENT
/begin MEASUREMENT ed_fsp_9of20_.logistikzaehler_nv "Warm-Up-Cycling-Zaehler" UBYTE FORMULA_0003 0 0 0.0 255.0000 ECU_ADDRESS 0x3FA3C5 /end MEASUREMENT
/begin MEASUREMENT ed_fsp_14of20_.logistikzaehler_nv "Warm-Up-Cycling-Zaehler" UBYTE FORMULA_0003 0 0 0.0 255.0000 ECU_ADDRESS 0x3FA55F /end MEASUREMENT
/begin MEASUREMENT ed_fsp_15of20_.logistikzaehler_nv "Warm-Up-Cycling-Zaehler" UBYTE FORMULA_0003 0 0 0.0 255.0000 ECU_ADDRESS 0x3FA5B1 /end MEASUREMENT
/begin MEASUREMENT ed_fsp_16of20_.logistikzaehler_nv "Warm-Up-Cycling-Zaehler" UBYTE FORMULA_0003 0 0 0.0 255.0000 ECU_ADDRESS 0x3FA603 /end MEASUREMENT
/begin MEASUREMENT ed_fsp_17of20_.logistikzaehler_nv "Warm-Up-Cycling-Zaehler" UBYTE FORMULA_0003 0 0 0.0 255.0000 ECU_ADDRESS 0x3FA655 /end MEASUREMENT
/begin MEASUREMENT ed_fsp_18of20_.logistikzaehler_nv "Warm-Up-Cycling-Zaehler" UBYTE FORMULA_0003 0 0 0.0 255.0000 ECU_ADDRESS 0x3FA6A7 /end MEASUREMENT
/begin MEASUREMENT ed_fsp_19of20_.logistikzaehler_nv "Warm-Up-Cycling-Zaehler" UBYTE FORMULA_0003 0 0 0.0 255.0000 ECU_ADDRESS 0x3FA6F9 /end MEASUREMENT
/begin MEASUREMENT ed_fsp_20of20_.logistikzaehler_nv "Warm-Up-Cycling-Zaehler" UBYTE FORMULA_0003 0 0 0.0 255.0000 ECU_ADDRESS 0x3FA74B /end MEASUREMENT
/begin MEASUREMENT ed_fsp_1of20_.uw_satz_1of3_.uw_km_stand_nv "Kilometerstand beim Fehlereintrag" UWORD FORMULA_0051 0 0 0.0 524280.0000 ECU_ADDRESS 0x3FA136 /end MEASUREMENT
/begin MEASUREMENT ed_fsp_1of20_.uw_satz_2of3_.uw_km_stand_nv "Kilometerstand beim Fehlereintrag" UWORD FORMULA_0051 0 0 0.0 524280.0000 ECU_ADDRESS 0x3FA140 /end MEASUREMENT
/begin MEASUREMENT ed_fsp_1of20_.uw_satz_3of3_.uw_km_stand_nv "Kilometerstand beim Fehlereintrag" UWORD FORMULA_0051 0 0 0.0 524280.0000 ECU_ADDRESS 0x3FA14A /end MEASUREMENT
/begin MEASUREMENT ed_fsp_2of20_.uw_satz_1of3_.uw_km_stand_nv "Kilometerstand beim Fehlereintrag" UWORD FORMULA_0051 0 0 0.0 524280.0000 ECU_ADDRESS 0x3FA188 /end MEASUREMENT
/begin MEASUREMENT ed_fsp_2of20_.uw_satz_2of3_.uw_km_stand_nv "Kilometerstand beim Fehlereintrag" UWORD FORMULA_0051 0 0 0.0 524280.0000 ECU_ADDRESS 0x3FA192 /end MEASUREMENT
/begin MEASUREMENT ed_fsp_2of20_.uw_satz_3of3_.uw_km_stand_nv "Kilometerstand beim Fehlereintrag" UWORD FORMULA_0051 0 0 0.0 524280.0000 ECU_ADDRESS 0x3FA19C /end MEASUREMENT
/begin MEASUREMENT ed_fsp_3of20_.uw_satz_1of3_.uw_km_stand_nv "Kilometerstand beim Fehlereintrag" UWORD FORMULA_0051 0 0 0.0 524280.0000 ECU_ADDRESS 0x3FA1DA /end MEASUREMENT
/begin MEASUREMENT ed_fsp_3of20_.uw_satz_2of3_.uw_km_stand_nv "Kilometerstand beim Fehlereintrag" UWORD FORMULA_0051 0 0 0.0 524280.0000 ECU_ADDRESS 0x3FA1E4 /end MEASUREMENT
/begin MEASUREMENT ed_fsp_3of20_.uw_satz_3of3_.uw_km_stand_nv "Kilometerstand beim Fehlereintrag" UWORD FORMULA_0051 0 0 0.0 524280.0000 ECU_ADDRESS 0x3FA1EE /end MEASUREMENT
/begin MEASUREMENT ed_fsp_4of20_.uw_satz_1of3_.uw_km_stand_nv "Kilometerstand beim Fehlereintrag" UWORD FORMULA_0051 0 0 0.0 524280.0000 ECU_ADDRESS 0x3FA22C /end MEASUREMENT
/begin MEASUREMENT ed_fsp_4of20_.uw_satz_2of3_.uw_km_stand_nv "Kilometerstand beim Fehlereintrag" UWORD FORMULA_0051 0 0 0.0 524280.0000 ECU_ADDRESS 0x3FA236 /end MEASUREMENT
/begin MEASUREMENT ed_fsp_4of20_.uw_satz_3of3_.uw_km_stand_nv "Kilometerstand beim Fehlereintrag" UWORD FORMULA_0051 0 0 0.0 524280.0000 ECU_ADDRESS 0x3FA240 /end MEASUREMENT
/begin MEASUREMENT ed_fsp_5of20_.uw_satz_1of3_.uw_km_stand_nv "Kilometerstand beim Fehlereintrag" UWORD FORMULA_0051 0 0 0.0 524280.0000 ECU_ADDRESS 0x3FA27E /end MEASUREMENT
/begin MEASUREMENT ed_fsp_5of20_.uw_satz_2of3_.uw_km_stand_nv "Kilometerstand beim Fehlereintrag" UWORD FORMULA_0051 0 0 0.0 524280.0000 ECU_ADDRESS 0x3FA288 /end MEASUREMENT
/begin MEASUREMENT ed_fsp_5of20_.uw_satz_3of3_.uw_km_stand_nv "Kilometerstand beim Fehlereintrag" UWORD FORMULA_0051 0 0 0.0 524280.0000 ECU_ADDRESS 0x3FA292 /end MEASUREMENT
/begin MEASUREMENT ed_fsp_6of20_.uw_satz_1of3_.uw_km_stand_nv "Kilometerstand beim Fehlereintrag" UWORD FORMULA_0051 0 0 0.0 524280.0000 ECU_ADDRESS 0x3FA2D0 /end MEASUREMENT
/begin MEASUREMENT ed_fsp_6of20_.uw_satz_2of3_.uw_km_stand_nv "Kilometerstand beim Fehlereintrag" UWORD FORMULA_0051 0 0 0.0 524280.0000 ECU_ADDRESS 0x3FA2DA /end MEASUREMENT
/begin MEASUREMENT ed_fsp_6of20_.uw_satz_3of3_.uw_km_stand_nv "Kilometerstand beim Fehlereintrag" UWORD FORMULA_0051 0 0 0.0 524280.0000 ECU_ADDRESS 0x3FA2E4 /end MEASUREMENT
/begin MEASUREMENT ed_fsp_7of20_.uw_satz_1of3_.uw_km_stand_nv "Kilometerstand beim Fehlereintrag" UWORD FORMULA_0051 0 0 0.0 524280.0000 ECU_ADDRESS 0x3FA322 /end MEASUREMENT
/begin MEASUREMENT ed_fsp_7of20_.uw_satz_2of3_.uw_km_stand_nv "Kilometerstand beim Fehlereintrag" UWORD FORMULA_0051 0 0 0.0 524280.0000 ECU_ADDRESS 0x3FA32C /end MEASUREMENT
/begin MEASUREMENT ed_fsp_7of20_.uw_satz_3of3_.uw_km_stand_nv "Kilometerstand beim Fehlereintrag" UWORD FORMULA_0051 0 0 0.0 524280.0000 ECU_ADDRESS 0x3FA336 /end MEASUREMENT
/begin MEASUREMENT ed_fsp_8of20_.uw_satz_1of3_.uw_km_stand_nv "Kilometerstand beim Fehlereintrag" UWORD FORMULA_0051 0 0 0.0 524280.0000 ECU_ADDRESS 0x3FA374 /end MEASUREMENT
/begin MEASUREMENT ed_fsp_8of20_.uw_satz_2of3_.uw_km_stand_nv "Kilometerstand beim Fehlereintrag" UWORD FORMULA_0051 0 0 0.0 524280.0000 ECU_ADDRESS 0x3FA37E /end MEASUREMENT
/begin MEASUREMENT ed_fsp_8of20_.uw_satz_3of3_.uw_km_stand_nv "Kilometerstand beim Fehlereintrag" UWORD FORMULA_0051 0 0 0.0 524280.0000 ECU_ADDRESS 0x3FA388 /end MEASUREMENT
/begin MEASUREMENT ed_fsp_9of20_.uw_satz_1of3_.uw_km_stand_nv "Kilometerstand beim Fehlereintrag" UWORD FORMULA_0051 0 0 0.0 524280.0000 ECU_ADDRESS 0x3FA3C6 /end MEASUREMENT
/begin MEASUREMENT ed_fsp_9of20_.uw_satz_2of3_.uw_km_stand_nv "Kilometerstand beim Fehlereintrag" UWORD FORMULA_0051 0 0 0.0 524280.0000 ECU_ADDRESS 0x3FA3D0 /end MEASUREMENT
/begin MEASUREMENT ed_fsp_9of20_.uw_satz_3of3_.uw_km_stand_nv "Kilometerstand beim Fehlereintrag" UWORD FORMULA_0051 0 0 0.0 524280.0000 ECU_ADDRESS 0x3FA3DA /end MEASUREMENT
/begin MEASUREMENT ed_fsp_14of20_.uw_satz_1of3_.uw_km_stand_nv "Kilometerstand beim Fehlereintrag" UWORD FORMULA_0051 0 0 0.0 524280.0000 ECU_ADDRESS 0x3FA560 /end MEASUREMENT
/begin MEASUREMENT ed_fsp_14of20_.uw_satz_2of3_.uw_km_stand_nv "Kilometerstand beim Fehlereintrag" UWORD FORMULA_0051 0 0 0.0 524280.0000 ECU_ADDRESS 0x3FA56A /end MEASUREMENT
/begin MEASUREMENT ed_fsp_14of20_.uw_satz_3of3_.uw_km_stand_nv "Kilometerstand beim Fehlereintrag" UWORD FORMULA_0051 0 0 0.0 524280.0000 ECU_ADDRESS 0x3FA574 /end MEASUREMENT
/begin MEASUREMENT ed_fsp_15of20_.uw_satz_1of3_.uw_km_stand_nv "Kilometerstand beim Fehlereintrag" UWORD FORMULA_0051 0 0 0.0 524280.0000 ECU_ADDRESS 0x3FA5B2 /end MEASUREMENT
/begin MEASUREMENT ed_fsp_15of20_.uw_satz_2of3_.uw_km_stand_nv "Kilometerstand beim Fehlereintrag" UWORD FORMULA_0051 0 0 0.0 524280.0000 ECU_ADDRESS 0x3FA5BC /end MEASUREMENT
/begin MEASUREMENT ed_fsp_15of20_.uw_satz_3of3_.uw_km_stand_nv "Kilometerstand beim Fehlereintrag" UWORD FORMULA_0051 0 0 0.0 524280.0000 ECU_ADDRESS 0x3FA5C6 /end MEASUREMENT
/begin MEASUREMENT ed_fsp_16of20_.uw_satz_1of3_.uw_km_stand_nv "Kilometerstand beim Fehlereintrag" UWORD FORMULA_0051 0 0 0.0 524280.0000 ECU_ADDRESS 0x3FA604 /end MEASUREMENT
/begin MEASUREMENT ed_fsp_16of20_.uw_satz_2of3_.uw_km_stand_nv "Kilometerstand beim Fehlereintrag" UWORD FORMULA_0051 0 0 0.0 524280.0000 ECU_ADDRESS 0x3FA60E /end MEASUREMENT
/begin MEASUREMENT ed_fsp_16of20_.uw_satz_3of3_.uw_km_stand_nv "Kilometerstand beim Fehlereintrag" UWORD FORMULA_0051 0 0 0.0 524280.0000 ECU_ADDRESS 0x3FA618 /end MEASUREMENT
/begin MEASUREMENT ed_fsp_17of20_.uw_satz_1of3_.uw_km_stand_nv "Kilometerstand beim Fehlereintrag" UWORD FORMULA_0051 0 0 0.0 524280.0000 ECU_ADDRESS 0x3FA656 /end MEASUREMENT
/begin MEASUREMENT ed_fsp_17of20_.uw_satz_2of3_.uw_km_stand_nv "Kilometerstand beim Fehlereintrag" UWORD FORMULA_0051 0 0 0.0 524280.0000 ECU_ADDRESS 0x3FA660 /end MEASUREMENT
/begin MEASUREMENT ed_fsp_17of20_.uw_satz_3of3_.uw_km_stand_nv "Kilometerstand beim Fehlereintrag" UWORD FORMULA_0051 0 0 0.0 524280.0000 ECU_ADDRESS 0x3FA66A /end MEASUREMENT
/begin MEASUREMENT ed_fsp_18of20_.uw_satz_1of3_.uw_km_stand_nv "Kilometerstand beim Fehlereintrag" UWORD FORMULA_0051 0 0 0.0 524280.0000 ECU_ADDRESS 0x3FA6A8 /end MEASUREMENT
/begin MEASUREMENT ed_fsp_18of20_.uw_satz_2of3_.uw_km_stand_nv "Kilometerstand beim Fehlereintrag" UWORD FORMULA_0051 0 0 0.0 524280.0000 ECU_ADDRESS 0x3FA6B2 /end MEASUREMENT
/begin MEASUREMENT ed_fsp_18of20_.uw_satz_3of3_.uw_km_stand_nv "Kilometerstand beim Fehlereintrag" UWORD FORMULA_0051 0 0 0.0 524280.0000 ECU_ADDRESS 0x3FA6BC /end MEASUREMENT
/begin MEASUREMENT ed_fsp_19of20_.uw_satz_1of3_.uw_km_stand_nv "Kilometerstand beim Fehlereintrag" UWORD FORMULA_0051 0 0 0.0 524280.0000 ECU_ADDRESS 0x3FA6FA /end MEASUREMENT
/begin MEASUREMENT ed_fsp_19of20_.uw_satz_2of3_.uw_km_stand_nv "Kilometerstand beim Fehlereintrag" UWORD FORMULA_0051 0 0 0.0 524280.0000 ECU_ADDRESS 0x3FA704 /end MEASUREMENT
/begin MEASUREMENT ed_fsp_19of20_.uw_satz_3of3_.uw_km_stand_nv "Kilometerstand beim Fehlereintrag" UWORD FORMULA_0051 0 0 0.0 524280.0000 ECU_ADDRESS 0x3FA70E /end MEASUREMENT
/begin MEASUREMENT ed_fsp_20of20_.uw_satz_1of3_.uw_km_stand_nv "Kilometerstand beim Fehlereintrag" UWORD FORMULA_0051 0 0 0.0 524280.0000 ECU_ADDRESS 0x3FA74C /end MEASUREMENT
/begin MEASUREMENT ed_fsp_20of20_.uw_satz_2of3_.uw_km_stand_nv "Kilometerstand beim Fehlereintrag" UWORD FORMULA_0051 0 0 0.0 524280.0000 ECU_ADDRESS 0x3FA756 /end MEASUREMENT
/begin MEASUREMENT ed_fsp_20of20_.uw_satz_3of3_.uw_km_stand_nv "Kilometerstand beim Fehlereintrag" UWORD FORMULA_0051 0 0 0.0 524280.0000 ECU_ADDRESS 0x3FA760 /end MEASUREMENT
/begin MEASUREMENT ed_fsp_1of20_.uw_satz_1of3_.uw_wert_nv_1of4_ "Umweltbedingung beim Fehlereintrag" UWORD FORMULA_0010 0 0 0.0 65535.0000 ECU_ADDRESS 0x3FA138 /end MEASUREMENT
/begin MEASUREMENT ed_fsp_1of20_.uw_satz_1of3_.uw_wert_nv_2of4_ "Umweltbedingung beim Fehlereintrag" UWORD FORMULA_0010 0 0 0.0 65535.0000 ECU_ADDRESS 0x3FA13A /end MEASUREMENT
/begin MEASUREMENT ed_fsp_1of20_.uw_satz_1of3_.uw_wert_nv_3of4_ "Umweltbedingung beim Fehlereintrag" UWORD FORMULA_0010 0 0 0.0 65535.0000 ECU_ADDRESS 0x3FA13C /end MEASUREMENT
/begin MEASUREMENT ed_fsp_1of20_.uw_satz_1of3_.uw_wert_nv_4of4_ "Umweltbedingung beim Fehlereintrag" UWORD FORMULA_0010 0 0 0.0 65535.0000 ECU_ADDRESS 0x3FA13E /end MEASUREMENT
/begin MEASUREMENT ed_fsp_1of20_.uw_satz_2of3_.uw_wert_nv_1of4_ "Umweltbedingung beim Fehlereintrag" UWORD FORMULA_0010 0 0 0.0 65535.0000 ECU_ADDRESS 0x3FA142 /end MEASUREMENT
/begin MEASUREMENT ed_fsp_1of20_.uw_satz_2of3_.uw_wert_nv_2of4_ "Umweltbedingung beim Fehlereintrag" UWORD FORMULA_0010 0 0 0.0 65535.0000 ECU_ADDRESS 0x3FA144 /end MEASUREMENT
/begin MEASUREMENT ed_fsp_1of20_.uw_satz_2of3_.uw_wert_nv_3of4_ "Umweltbedingung beim Fehlereintrag" UWORD FORMULA_0010 0 0 0.0 65535.0000 ECU_ADDRESS 0x3FA146 /end MEASUREMENT
/begin MEASUREMENT ed_fsp_1of20_.uw_satz_2of3_.uw_wert_nv_4of4_ "Umweltbedingung beim Fehlereintrag" UWORD FORMULA_0010 0 0 0.0 65535.0000 ECU_ADDRESS 0x3FA148 /end MEASUREMENT
/begin MEASUREMENT ed_fsp_1of20_.uw_satz_3of3_.uw_wert_nv_1of4_ "Umweltbedingung beim Fehlereintrag" UWORD FORMULA_0010 0 0 0.0 65535.0000 ECU_ADDRESS 0x3FA14C /end MEASUREMENT
/begin MEASUREMENT ed_fsp_1of20_.uw_satz_3of3_.uw_wert_nv_2of4_ "Umweltbedingung beim Fehlereintrag" UWORD FORMULA_0010 0 0 0.0 65535.0000 ECU_ADDRESS 0x3FA14E /end MEASUREMENT
/begin MEASUREMENT ed_fsp_1of20_.uw_satz_3of3_.uw_wert_nv_3of4_ "Umweltbedingung beim Fehlereintrag" UWORD FORMULA_0010 0 0 0.0 65535.0000 ECU_ADDRESS 0x3FA150 /end MEASUREMENT
/begin MEASUREMENT ed_fsp_1of20_.uw_satz_3of3_.uw_wert_nv_4of4_ "Umweltbedingung beim Fehlereintrag" UWORD FORMULA_0010 0 0 0.0 65535.0000 ECU_ADDRESS 0x3FA152 /end MEASUREMENT
/begin MEASUREMENT ed_fsp_2of20_.uw_satz_1of3_.uw_wert_nv_1of4_ "Umweltbedingung beim Fehlereintrag" UWORD FORMULA_0010 0 0 0.0 65535.0000 ECU_ADDRESS 0x3FA18A /end MEASUREMENT
/begin MEASUREMENT ed_fsp_2of20_.uw_satz_1of3_.uw_wert_nv_2of4_ "Umweltbedingung beim Fehlereintrag" UWORD FORMULA_0010 0 0 0.0 65535.0000 ECU_ADDRESS 0x3FA18C /end MEASUREMENT
/begin MEASUREMENT ed_fsp_2of20_.uw_satz_1of3_.uw_wert_nv_3of4_ "Umweltbedingung beim Fehlereintrag" UWORD FORMULA_0010 0 0 0.0 65535.0000 ECU_ADDRESS 0x3FA18E /end MEASUREMENT
/begin MEASUREMENT ed_fsp_2of20_.uw_satz_1of3_.uw_wert_nv_4of4_ "Umweltbedingung beim Fehlereintrag" UWORD FORMULA_0010 0 0 0.0 65535.0000 ECU_ADDRESS 0x3FA190 /end MEASUREMENT
/begin MEASUREMENT ed_fsp_2of20_.uw_satz_2of3_.uw_wert_nv_1of4_ "Umweltbedingung beim Fehlereintrag" UWORD FORMULA_0010 0 0 0.0 65535.0000 ECU_ADDRESS 0x3FA194 /end MEASUREMENT
/begin MEASUREMENT ed_fsp_2of20_.uw_satz_2of3_.uw_wert_nv_2of4_ "Umweltbedingung beim Fehlereintrag" UWORD FORMULA_0010 0 0 0.0 65535.0000 ECU_ADDRESS 0x3FA196 /end MEASUREMENT
/begin MEASUREMENT ed_fsp_2of20_.uw_satz_2of3_.uw_wert_nv_3of4_ "Umweltbedingung beim Fehlereintrag" UWORD FORMULA_0010 0 0 0.0 65535.0000 ECU_ADDRESS 0x3FA198 /end MEASUREMENT
/begin MEASUREMENT ed_fsp_2of20_.uw_satz_2of3_.uw_wert_nv_4of4_ "Umweltbedingung beim Fehlereintrag" UWORD FORMULA_0010 0 0 0.0 65535.0000 ECU_ADDRESS 0x3FA19A /end MEASUREMENT
/begin MEASUREMENT ed_fsp_2of20_.uw_satz_3of3_.uw_wert_nv_1of4_ "Umweltbedingung beim Fehlereintrag" UWORD FORMULA_0010 0 0 0.0 65535.0000 ECU_ADDRESS 0x3FA19E /end MEASUREMENT
/begin MEASUREMENT ed_fsp_2of20_.uw_satz_3of3_.uw_wert_nv_2of4_ "Umweltbedingung beim Fehlereintrag" UWORD FORMULA_0010 0 0 0.0 65535.0000 ECU_ADDRESS 0x3FA1A0 /end MEASUREMENT
/begin MEASUREMENT ed_fsp_2of20_.uw_satz_3of3_.uw_wert_nv_3of4_ "Umweltbedingung beim Fehlereintrag" UWORD FORMULA_0010 0 0 0.0 65535.0000 ECU_ADDRESS 0x3FA1A2 /end MEASUREMENT
/begin MEASUREMENT ed_fsp_2of20_.uw_satz_3of3_.uw_wert_nv_4of4_ "Umweltbedingung beim Fehlereintrag" UWORD FORMULA_0010 0 0 0.0 65535.0000 ECU_ADDRESS 0x3FA1A4 /end MEASUREMENT
/begin MEASUREMENT ed_fsp_3of20_.uw_satz_1of3_.uw_wert_nv_1of4_ "Umweltbedingung beim Fehlereintrag" UWORD FORMULA_0010 0 0 0.0 65535.0000 ECU_ADDRESS 0x3FA1DC /end MEASUREMENT
/begin MEASUREMENT ed_fsp_3of20_.uw_satz_1of3_.uw_wert_nv_2of4_ "Umweltbedingung beim Fehlereintrag" UWORD FORMULA_0010 0 0 0.0 65535.0000 ECU_ADDRESS 0x3FA1DE /end MEASUREMENT
/begin MEASUREMENT ed_fsp_3of20_.uw_satz_1of3_.uw_wert_nv_3of4_ "Umweltbedingung beim Fehlereintrag" UWORD FORMULA_0010 0 0 0.0 65535.0000 ECU_ADDRESS 0x3FA1E0 /end MEASUREMENT
/begin MEASUREMENT ed_fsp_3of20_.uw_satz_1of3_.uw_wert_nv_4of4_ "Umweltbedingung beim Fehlereintrag" UWORD FORMULA_0010 0 0 0.0 65535.0000 ECU_ADDRESS 0x3FA1E2 /end MEASUREMENT
/begin MEASUREMENT ed_fsp_3of20_.uw_satz_2of3_.uw_wert_nv_1of4_ "Umweltbedingung beim Fehlereintrag" UWORD FORMULA_0010 0 0 0.0 65535.0000 ECU_ADDRESS 0x3FA1E6 /end MEASUREMENT
/begin MEASUREMENT ed_fsp_3of20_.uw_satz_2of3_.uw_wert_nv_2of4_ "Umweltbedingung beim Fehlereintrag" UWORD FORMULA_0010 0 0 0.0 65535.0000 ECU_ADDRESS 0x3FA1E8 /end MEASUREMENT
/begin MEASUREMENT ed_fsp_3of20_.uw_satz_2of3_.uw_wert_nv_3of4_ "Umweltbedingung beim Fehlereintrag" UWORD FORMULA_0010 0 0 0.0 65535.0000 ECU_ADDRESS 0x3FA1EA /end MEASUREMENT
/begin MEASUREMENT ed_fsp_3of20_.uw_satz_2of3_.uw_wert_nv_4of4_ "Umweltbedingung beim Fehlereintrag" UWORD FORMULA_0010 0 0 0.0 65535.0000 ECU_ADDRESS 0x3FA1EC /end MEASUREMENT
/begin MEASUREMENT ed_fsp_3of20_.uw_satz_3of3_.uw_wert_nv_1of4_ "Umweltbedingung beim Fehlereintrag" UWORD FORMULA_0010 0 0 0.0 65535.0000 ECU_ADDRESS 0x3FA1F0 /end MEASUREMENT
/begin MEASUREMENT ed_fsp_3of20_.uw_satz_3of3_.uw_wert_nv_2of4_ "Umweltbedingung beim Fehlereintrag" UWORD FORMULA_0010 0 0 0.0 65535.0000 ECU_ADDRESS 0x3FA1F2 /end MEASUREMENT
/begin MEASUREMENT ed_fsp_3of20_.uw_satz_3of3_.uw_wert_nv_3of4_ "Umweltbedingung beim Fehlereintrag" UWORD FORMULA_0010 0 0 0.0 65535.0000 ECU_ADDRESS 0x3FA1F4 /end MEASUREMENT
/begin MEASUREMENT ed_fsp_3of20_.uw_satz_3of3_.uw_wert_nv_4of4_ "Umweltbedingung beim Fehlereintrag" UWORD FORMULA_0010 0 0 0.0 65535.0000 ECU_ADDRESS 0x3FA1F6 /end MEASUREMENT
/begin MEASUREMENT ed_fsp_4of20_.uw_satz_1of3_.uw_wert_nv_1of4_ "Umweltbedingung beim Fehlereintrag" UWORD FORMULA_0010 0 0 0.0 65535.0000 ECU_ADDRESS 0x3FA22E /end MEASUREMENT
/begin MEASUREMENT ed_fsp_4of20_.uw_satz_1of3_.uw_wert_nv_2of4_ "Umweltbedingung beim Fehlereintrag" UWORD FORMULA_0010 0 0 0.0 65535.0000 ECU_ADDRESS 0x3FA230 /end MEASUREMENT
/begin MEASUREMENT ed_fsp_4of20_.uw_satz_1of3_.uw_wert_nv_3of4_ "Umweltbedingung beim Fehlereintrag" UWORD FORMULA_0010 0 0 0.0 65535.0000 ECU_ADDRESS 0x3FA232 /end MEASUREMENT
/begin MEASUREMENT ed_fsp_4of20_.uw_satz_1of3_.uw_wert_nv_4of4_ "Umweltbedingung beim Fehlereintrag" UWORD FORMULA_0010 0 0 0.0 65535.0000 ECU_ADDRESS 0x3FA234 /end MEASUREMENT
/begin MEASUREMENT ed_fsp_4of20_.uw_satz_2of3_.uw_wert_nv_1of4_ "Umweltbedingung beim Fehlereintrag" UWORD FORMULA_0010 0 0 0.0 65535.0000 ECU_ADDRESS 0x3FA238 /end MEASUREMENT
/begin MEASUREMENT ed_fsp_4of20_.uw_satz_2of3_.uw_wert_nv_2of4_ "Umweltbedingung beim Fehlereintrag" UWORD FORMULA_0010 0 0 0.0 65535.0000 ECU_ADDRESS 0x3FA23A /end MEASUREMENT
/begin MEASUREMENT ed_fsp_4of20_.uw_satz_2of3_.uw_wert_nv_3of4_ "Umweltbedingung beim Fehlereintrag" UWORD FORMULA_0010 0 0 0.0 65535.0000 ECU_ADDRESS 0x3FA23C /end MEASUREMENT
/begin MEASUREMENT ed_fsp_4of20_.uw_satz_2of3_.uw_wert_nv_4of4_ "Umweltbedingung beim Fehlereintrag" UWORD FORMULA_0010 0 0 0.0 65535.0000 ECU_ADDRESS 0x3FA23E /end MEASUREMENT
/begin MEASUREMENT ed_fsp_4of20_.uw_satz_3of3_.uw_wert_nv_1of4_ "Umweltbedingung beim Fehlereintrag" UWORD FORMULA_0010 0 0 0.0 65535.0000 ECU_ADDRESS 0x3FA242 /end MEASUREMENT
/begin MEASUREMENT ed_fsp_4of20_.uw_satz_3of3_.uw_wert_nv_2of4_ "Umweltbedingung beim Fehlereintrag" UWORD FORMULA_0010 0 0 0.0 65535.0000 ECU_ADDRESS 0x3FA244 /end MEASUREMENT
/begin MEASUREMENT ed_fsp_4of20_.uw_satz_3of3_.uw_wert_nv_3of4_ "Umweltbedingung beim Fehlereintrag" UWORD FORMULA_0010 0 0 0.0 65535.0000 ECU_ADDRESS 0x3FA246 /end MEASUREMENT
/begin MEASUREMENT ed_fsp_4of20_.uw_satz_3of3_.uw_wert_nv_4of4_ "Umweltbedingung beim Fehlereintrag" UWORD FORMULA_0010 0 0 0.0 65535.0000 ECU_ADDRESS 0x3FA248 /end MEASUREMENT
/begin MEASUREMENT ed_fsp_5of20_.uw_satz_1of3_.uw_wert_nv_1of4_ "Umweltbedingung beim Fehlereintrag" UWORD FORMULA_0010 0 0 0.0 65535.0000 ECU_ADDRESS 0x3FA280 /end MEASUREMENT
/begin MEASUREMENT ed_fsp_5of20_.uw_satz_1of3_.uw_wert_nv_2of4_ "Umweltbedingung beim Fehlereintrag" UWORD FORMULA_0010 0 0 0.0 65535.0000 ECU_ADDRESS 0x3FA282 /end MEASUREMENT
/begin MEASUREMENT ed_fsp_5of20_.uw_satz_1of3_.uw_wert_nv_3of4_ "Umweltbedingung beim Fehlereintrag" UWORD FORMULA_0010 0 0 0.0 65535.0000 ECU_ADDRESS 0x3FA284 /end MEASUREMENT
/begin MEASUREMENT ed_fsp_5of20_.uw_satz_1of3_.uw_wert_nv_4of4_ "Umweltbedingung beim Fehlereintrag" UWORD FORMULA_0010 0 0 0.0 65535.0000 ECU_ADDRESS 0x3FA286 /end MEASUREMENT
/begin MEASUREMENT ed_fsp_5of20_.uw_satz_2of3_.uw_wert_nv_1of4_ "Umweltbedingung beim Fehlereintrag" UWORD FORMULA_0010 0 0 0.0 65535.0000 ECU_ADDRESS 0x3FA28A /end MEASUREMENT
/begin MEASUREMENT ed_fsp_5of20_.uw_satz_2of3_.uw_wert_nv_2of4_ "Umweltbedingung beim Fehlereintrag" UWORD FORMULA_0010 0 0 0.0 65535.0000 ECU_ADDRESS 0x3FA28C /end MEASUREMENT
/begin MEASUREMENT ed_fsp_5of20_.uw_satz_2of3_.uw_wert_nv_3of4_ "Umweltbedingung beim Fehlereintrag" UWORD FORMULA_0010 0 0 0.0 65535.0000 ECU_ADDRESS 0x3FA28E /end MEASUREMENT
/begin MEASUREMENT ed_fsp_5of20_.uw_satz_2of3_.uw_wert_nv_4of4_ "Umweltbedingung beim Fehlereintrag" UWORD FORMULA_0010 0 0 0.0 65535.0000 ECU_ADDRESS 0x3FA290 /end MEASUREMENT
/begin MEASUREMENT ed_fsp_5of20_.uw_satz_3of3_.uw_wert_nv_1of4_ "Umweltbedingung beim Fehlereintrag" UWORD FORMULA_0010 0 0 0.0 65535.0000 ECU_ADDRESS 0x3FA294 /end MEASUREMENT
/begin MEASUREMENT ed_fsp_5of20_.uw_satz_3of3_.uw_wert_nv_2of4_ "Umweltbedingung beim Fehlereintrag" UWORD FORMULA_0010 0 0 0.0 65535.0000 ECU_ADDRESS 0x3FA296 /end MEASUREMENT
/begin MEASUREMENT ed_fsp_5of20_.uw_satz_3of3_.uw_wert_nv_3of4_ "Umweltbedingung beim Fehlereintrag" UWORD FORMULA_0010 0 0 0.0 65535.0000 ECU_ADDRESS 0x3FA298 /end MEASUREMENT
/begin MEASUREMENT ed_fsp_5of20_.uw_satz_3of3_.uw_wert_nv_4of4_ "Umweltbedingung beim Fehlereintrag" UWORD FORMULA_0010 0 0 0.0 65535.0000 ECU_ADDRESS 0x3FA29A /end MEASUREMENT
/begin MEASUREMENT ed_fsp_6of20_.uw_satz_1of3_.uw_wert_nv_1of4_ "Umweltbedingung beim Fehlereintrag" UWORD FORMULA_0010 0 0 0.0 65535.0000 ECU_ADDRESS 0x3FA2D2 /end MEASUREMENT
/begin MEASUREMENT ed_fsp_6of20_.uw_satz_1of3_.uw_wert_nv_2of4_ "Umweltbedingung beim Fehlereintrag" UWORD FORMULA_0010 0 0 0.0 65535.0000 ECU_ADDRESS 0x3FA2D4 /end MEASUREMENT
/begin MEASUREMENT ed_fsp_6of20_.uw_satz_1of3_.uw_wert_nv_3of4_ "Umweltbedingung beim Fehlereintrag" UWORD FORMULA_0010 0 0 0.0 65535.0000 ECU_ADDRESS 0x3FA2D6 /end MEASUREMENT
/begin MEASUREMENT ed_fsp_6of20_.uw_satz_1of3_.uw_wert_nv_4of4_ "Umweltbedingung beim Fehlereintrag" UWORD FORMULA_0010 0 0 0.0 65535.0000 ECU_ADDRESS 0x3FA2D8 /end MEASUREMENT
/begin MEASUREMENT ed_fsp_6of20_.uw_satz_2of3_.uw_wert_nv_1of4_ "Umweltbedingung beim Fehlereintrag" UWORD FORMULA_0010 0 0 0.0 65535.0000 ECU_ADDRESS 0x3FA2DC /end MEASUREMENT
/begin MEASUREMENT ed_fsp_6of20_.uw_satz_2of3_.uw_wert_nv_2of4_ "Umweltbedingung beim Fehlereintrag" UWORD FORMULA_0010 0 0 0.0 65535.0000 ECU_ADDRESS 0x3FA2DE /end MEASUREMENT
/begin MEASUREMENT ed_fsp_6of20_.uw_satz_2of3_.uw_wert_nv_3of4_ "Umweltbedingung beim Fehlereintrag" UWORD FORMULA_0010 0 0 0.0 65535.0000 ECU_ADDRESS 0x3FA2E0 /end MEASUREMENT
/begin MEASUREMENT ed_fsp_6of20_.uw_satz_2of3_.uw_wert_nv_4of4_ "Umweltbedingung beim Fehlereintrag" UWORD FORMULA_0010 0 0 0.0 65535.0000 ECU_ADDRESS 0x3FA2E2 /end MEASUREMENT
/begin MEASUREMENT ed_fsp_6of20_.uw_satz_3of3_.uw_wert_nv_1of4_ "Umweltbedingung beim Fehlereintrag" UWORD FORMULA_0010 0 0 0.0 65535.0000 ECU_ADDRESS 0x3FA2E6 /end MEASUREMENT
/begin MEASUREMENT ed_fsp_6of20_.uw_satz_3of3_.uw_wert_nv_2of4_ "Umweltbedingung beim Fehlereintrag" UWORD FORMULA_0010 0 0 0.0 65535.0000 ECU_ADDRESS 0x3FA2E8 /end MEASUREMENT
/begin MEASUREMENT ed_fsp_6of20_.uw_satz_3of3_.uw_wert_nv_3of4_ "Umweltbedingung beim Fehlereintrag" UWORD FORMULA_0010 0 0 0.0 65535.0000 ECU_ADDRESS 0x3FA2EA /end MEASUREMENT
/begin MEASUREMENT ed_fsp_6of20_.uw_satz_3of3_.uw_wert_nv_4of4_ "Umweltbedingung beim Fehlereintrag" UWORD FORMULA_0010 0 0 0.0 65535.0000 ECU_ADDRESS 0x3FA2EC /end MEASUREMENT
/begin MEASUREMENT ed_fsp_7of20_.uw_satz_1of3_.uw_wert_nv_1of4_ "Umweltbedingung beim Fehlereintrag" UWORD FORMULA_0010 0 0 0.0 65535.0000 ECU_ADDRESS 0x3FA324 /end MEASUREMENT
/begin MEASUREMENT ed_fsp_7of20_.uw_satz_1of3_.uw_wert_nv_2of4_ "Umweltbedingung beim Fehlereintrag" UWORD FORMULA_0010 0 0 0.0 65535.0000 ECU_ADDRESS 0x3FA326 /end MEASUREMENT
/begin MEASUREMENT ed_fsp_7of20_.uw_satz_1of3_.uw_wert_nv_3of4_ "Umweltbedingung beim Fehlereintrag" UWORD FORMULA_0010 0 0 0.0 65535.0000 ECU_ADDRESS 0x3FA328 /end MEASUREMENT
/begin MEASUREMENT ed_fsp_7of20_.uw_satz_1of3_.uw_wert_nv_4of4_ "Umweltbedingung beim Fehlereintrag" UWORD FORMULA_0010 0 0 0.0 65535.0000 ECU_ADDRESS 0x3FA32A /end MEASUREMENT
/begin MEASUREMENT ed_fsp_7of20_.uw_satz_2of3_.uw_wert_nv_1of4_ "Umweltbedingung beim Fehlereintrag" UWORD FORMULA_0010 0 0 0.0 65535.0000 ECU_ADDRESS 0x3FA32E /end MEASUREMENT
/begin MEASUREMENT ed_fsp_7of20_.uw_satz_2of3_.uw_wert_nv_2of4_ "Umweltbedingung beim Fehlereintrag" UWORD FORMULA_0010 0 0 0.0 65535.0000 ECU_ADDRESS 0x3FA330 /end MEASUREMENT
/begin MEASUREMENT ed_fsp_7of20_.uw_satz_2of3_.uw_wert_nv_3of4_ "Umweltbedingung beim Fehlereintrag" UWORD FORMULA_0010 0 0 0.0 65535.0000 ECU_ADDRESS 0x3FA332 /end MEASUREMENT
/begin MEASUREMENT ed_fsp_7of20_.uw_satz_2of3_.uw_wert_nv_4of4_ "Umweltbedingung beim Fehlereintrag" UWORD FORMULA_0010 0 0 0.0 65535.0000 ECU_ADDRESS 0x3FA334 /end MEASUREMENT
/begin MEASUREMENT ed_fsp_7of20_.uw_satz_3of3_.uw_wert_nv_1of4_ "Umweltbedingung beim Fehlereintrag" UWORD FORMULA_0010 0 0 0.0 65535.0000 ECU_ADDRESS 0x3FA338 /end MEASUREMENT
/begin MEASUREMENT ed_fsp_7of20_.uw_satz_3of3_.uw_wert_nv_2of4_ "Umweltbedingung beim Fehlereintrag" UWORD FORMULA_0010 0 0 0.0 65535.0000 ECU_ADDRESS 0x3FA33A /end MEASUREMENT
/begin MEASUREMENT ed_fsp_7of20_.uw_satz_3of3_.uw_wert_nv_3of4_ "Umweltbedingung beim Fehlereintrag" UWORD FORMULA_0010 0 0 0.0 65535.0000 ECU_ADDRESS 0x3FA33C /end MEASUREMENT
/begin MEASUREMENT ed_fsp_7of20_.uw_satz_3of3_.uw_wert_nv_4of4_ "Umweltbedingung beim Fehlereintrag" UWORD FORMULA_0010 0 0 0.0 65535.0000 ECU_ADDRESS 0x3FA33E /end MEASUREMENT
/begin MEASUREMENT ed_fsp_8of20_.uw_satz_1of3_.uw_wert_nv_1of4_ "Umweltbedingung beim Fehlereintrag" UWORD FORMULA_0010 0 0 0.0 65535.0000 ECU_ADDRESS 0x3FA376 /end MEASUREMENT
/begin MEASUREMENT ed_fsp_8of20_.uw_satz_1of3_.uw_wert_nv_2of4_ "Umweltbedingung beim Fehlereintrag" UWORD FORMULA_0010 0 0 0.0 65535.0000 ECU_ADDRESS 0x3FA378 /end MEASUREMENT
/begin MEASUREMENT ed_fsp_8of20_.uw_satz_1of3_.uw_wert_nv_3of4_ "Umweltbedingung beim Fehlereintrag" UWORD FORMULA_0010 0 0 0.0 65535.0000 ECU_ADDRESS 0x3FA37A /end MEASUREMENT
/begin MEASUREMENT ed_fsp_8of20_.uw_satz_1of3_.uw_wert_nv_4of4_ "Umweltbedingung beim Fehlereintrag" UWORD FORMULA_0010 0 0 0.0 65535.0000 ECU_ADDRESS 0x3FA37C /end MEASUREMENT
/begin MEASUREMENT ed_fsp_8of20_.uw_satz_2of3_.uw_wert_nv_1of4_ "Umweltbedingung beim Fehlereintrag" UWORD FORMULA_0010 0 0 0.0 65535.0000 ECU_ADDRESS 0x3FA380 /end MEASUREMENT
/begin MEASUREMENT ed_fsp_8of20_.uw_satz_2of3_.uw_wert_nv_2of4_ "Umweltbedingung beim Fehlereintrag" UWORD FORMULA_0010 0 0 0.0 65535.0000 ECU_ADDRESS 0x3FA382 /end MEASUREMENT
/begin MEASUREMENT ed_fsp_8of20_.uw_satz_2of3_.uw_wert_nv_3of4_ "Umweltbedingung beim Fehlereintrag" UWORD FORMULA_0010 0 0 0.0 65535.0000 ECU_ADDRESS 0x3FA384 /end MEASUREMENT
/begin MEASUREMENT ed_fsp_8of20_.uw_satz_2of3_.uw_wert_nv_4of4_ "Umweltbedingung beim Fehlereintrag" UWORD FORMULA_0010 0 0 0.0 65535.0000 ECU_ADDRESS 0x3FA386 /end MEASUREMENT
/begin MEASUREMENT ed_fsp_8of20_.uw_satz_3of3_.uw_wert_nv_1of4_ "Umweltbedingung beim Fehlereintrag" UWORD FORMULA_0010 0 0 0.0 65535.0000 ECU_ADDRESS 0x3FA38A /end MEASUREMENT
/begin MEASUREMENT ed_fsp_8of20_.uw_satz_3of3_.uw_wert_nv_2of4_ "Umweltbedingung beim Fehlereintrag" UWORD FORMULA_0010 0 0 0.0 65535.0000 ECU_ADDRESS 0x3FA38C /end MEASUREMENT
/begin MEASUREMENT ed_fsp_8of20_.uw_satz_3of3_.uw_wert_nv_3of4_ "Umweltbedingung beim Fehlereintrag" UWORD FORMULA_0010 0 0 0.0 65535.0000 ECU_ADDRESS 0x3FA38E /end MEASUREMENT
/begin MEASUREMENT ed_fsp_8of20_.uw_satz_3of3_.uw_wert_nv_4of4_ "Umweltbedingung beim Fehlereintrag" UWORD FORMULA_0010 0 0 0.0 65535.0000 ECU_ADDRESS 0x3FA390 /end MEASUREMENT
/begin MEASUREMENT ed_fsp_9of20_.uw_satz_1of3_.uw_wert_nv_1of4_ "Umweltbedingung beim Fehlereintrag" UWORD FORMULA_0010 0 0 0.0 65535.0000 ECU_ADDRESS 0x3FA3C8 /end MEASUREMENT
/begin MEASUREMENT ed_fsp_9of20_.uw_satz_1of3_.uw_wert_nv_2of4_ "Umweltbedingung beim Fehlereintrag" UWORD FORMULA_0010 0 0 0.0 65535.0000 ECU_ADDRESS 0x3FA3CA /end MEASUREMENT
/begin MEASUREMENT ed_fsp_9of20_.uw_satz_1of3_.uw_wert_nv_3of4_ "Umweltbedingung beim Fehlereintrag" UWORD FORMULA_0010 0 0 0.0 65535.0000 ECU_ADDRESS 0x3FA3CC /end MEASUREMENT
/begin MEASUREMENT ed_fsp_9of20_.uw_satz_1of3_.uw_wert_nv_4of4_ "Umweltbedingung beim Fehlereintrag" UWORD FORMULA_0010 0 0 0.0 65535.0000 ECU_ADDRESS 0x3FA3CE /end MEASUREMENT
/begin MEASUREMENT ed_fsp_9of20_.uw_satz_2of3_.uw_wert_nv_1of4_ "Umweltbedingung beim Fehlereintrag" UWORD FORMULA_0010 0 0 0.0 65535.0000 ECU_ADDRESS 0x3FA3D2 /end MEASUREMENT
/begin MEASUREMENT ed_fsp_9of20_.uw_satz_2of3_.uw_wert_nv_2of4_ "Umweltbedingung beim Fehlereintrag" UWORD FORMULA_0010 0 0 0.0 65535.0000 ECU_ADDRESS 0x3FA3D4 /end MEASUREMENT
/begin MEASUREMENT ed_fsp_9of20_.uw_satz_2of3_.uw_wert_nv_3of4_ "Umweltbedingung beim Fehlereintrag" UWORD FORMULA_0010 0 0 0.0 65535.0000 ECU_ADDRESS 0x3FA3D6 /end MEASUREMENT
/begin MEASUREMENT ed_fsp_9of20_.uw_satz_2of3_.uw_wert_nv_4of4_ "Umweltbedingung beim Fehlereintrag" UWORD FORMULA_0010 0 0 0.0 65535.0000 ECU_ADDRESS 0x3FA3D8 /end MEASUREMENT
/begin MEASUREMENT ed_fsp_9of20_.uw_satz_3of3_.uw_wert_nv_1of4_ "Umweltbedingung beim Fehlereintrag" UWORD FORMULA_0010 0 0 0.0 65535.0000 ECU_ADDRESS 0x3FA3DC /end MEASUREMENT
/begin MEASUREMENT ed_fsp_9of20_.uw_satz_3of3_.uw_wert_nv_2of4_ "Umweltbedingung beim Fehlereintrag" UWORD FORMULA_0010 0 0 0.0 65535.0000 ECU_ADDRESS 0x3FA3DE /end MEASUREMENT
/begin MEASUREMENT ed_fsp_9of20_.uw_satz_3of3_.uw_wert_nv_3of4_ "Umweltbedingung beim Fehlereintrag" UWORD FORMULA_0010 0 0 0.0 65535.0000 ECU_ADDRESS 0x3FA3E0 /end MEASUREMENT
/begin MEASUREMENT ed_fsp_9of20_.uw_satz_3of3_.uw_wert_nv_4of4_ "Umweltbedingung beim Fehlereintrag" UWORD FORMULA_0010 0 0 0.0 65535.0000 ECU_ADDRESS 0x3FA3E2 /end MEASUREMENT
/begin MEASUREMENT ed_fsp_14of20_.uw_satz_1of3_.uw_wert_nv_1of4_ "Umweltbedingung beim Fehlereintrag" UWORD FORMULA_0010 0 0 0.0 65535.0000 ECU_ADDRESS 0x3FA562 /end MEASUREMENT
/begin MEASUREMENT ed_fsp_14of20_.uw_satz_1of3_.uw_wert_nv_2of4_ "Umweltbedingung beim Fehlereintrag" UWORD FORMULA_0010 0 0 0.0 65535.0000 ECU_ADDRESS 0x3FA564 /end MEASUREMENT
/begin MEASUREMENT ed_fsp_14of20_.uw_satz_1of3_.uw_wert_nv_3of4_ "Umweltbedingung beim Fehlereintrag" UWORD FORMULA_0010 0 0 0.0 65535.0000 ECU_ADDRESS 0x3FA566 /end MEASUREMENT
/begin MEASUREMENT ed_fsp_14of20_.uw_satz_1of3_.uw_wert_nv_4of4_ "Umweltbedingung beim Fehlereintrag" UWORD FORMULA_0010 0 0 0.0 65535.0000 ECU_ADDRESS 0x3FA568 /end MEASUREMENT
/begin MEASUREMENT ed_fsp_14of20_.uw_satz_2of3_.uw_wert_nv_1of4_ "Umweltbedingung beim Fehlereintrag" UWORD FORMULA_0010 0 0 0.0 65535.0000 ECU_ADDRESS 0x3FA56C /end MEASUREMENT
/begin MEASUREMENT ed_fsp_14of20_.uw_satz_2of3_.uw_wert_nv_2of4_ "Umweltbedingung beim Fehlereintrag" UWORD FORMULA_0010 0 0 0.0 65535.0000 ECU_ADDRESS 0x3FA56E /end MEASUREMENT
/begin MEASUREMENT ed_fsp_14of20_.uw_satz_2of3_.uw_wert_nv_3of4_ "Umweltbedingung beim Fehlereintrag" UWORD FORMULA_0010 0 0 0.0 65535.0000 ECU_ADDRESS 0x3FA570 /end MEASUREMENT
/begin MEASUREMENT ed_fsp_14of20_.uw_satz_2of3_.uw_wert_nv_4of4_ "Umweltbedingung beim Fehlereintrag" UWORD FORMULA_0010 0 0 0.0 65535.0000 ECU_ADDRESS 0x3FA572 /end MEASUREMENT
/begin MEASUREMENT ed_fsp_14of20_.uw_satz_3of3_.uw_wert_nv_1of4_ "Umweltbedingung beim Fehlereintrag" UWORD FORMULA_0010 0 0 0.0 65535.0000 ECU_ADDRESS 0x3FA576 /end MEASUREMENT
/begin MEASUREMENT ed_fsp_14of20_.uw_satz_3of3_.uw_wert_nv_2of4_ "Umweltbedingung beim Fehlereintrag" UWORD FORMULA_0010 0 0 0.0 65535.0000 ECU_ADDRESS 0x3FA578 /end MEASUREMENT
/begin MEASUREMENT ed_fsp_14of20_.uw_satz_3of3_.uw_wert_nv_3of4_ "Umweltbedingung beim Fehlereintrag" UWORD FORMULA_0010 0 0 0.0 65535.0000 ECU_ADDRESS 0x3FA57A /end MEASUREMENT
/begin MEASUREMENT ed_fsp_14of20_.uw_satz_3of3_.uw_wert_nv_4of4_ "Umweltbedingung beim Fehlereintrag" UWORD FORMULA_0010 0 0 0.0 65535.0000 ECU_ADDRESS 0x3FA57C /end MEASUREMENT
/begin MEASUREMENT ed_fsp_15of20_.uw_satz_1of3_.uw_wert_nv_1of4_ "Umweltbedingung beim Fehlereintrag" UWORD FORMULA_0010 0 0 0.0 65535.0000 ECU_ADDRESS 0x3FA5B4 /end MEASUREMENT
/begin MEASUREMENT ed_fsp_15of20_.uw_satz_1of3_.uw_wert_nv_2of4_ "Umweltbedingung beim Fehlereintrag" UWORD FORMULA_0010 0 0 0.0 65535.0000 ECU_ADDRESS 0x3FA5B6 /end MEASUREMENT
/begin MEASUREMENT ed_fsp_15of20_.uw_satz_1of3_.uw_wert_nv_3of4_ "Umweltbedingung beim Fehlereintrag" UWORD FORMULA_0010 0 0 0.0 65535.0000 ECU_ADDRESS 0x3FA5B8 /end MEASUREMENT
/begin MEASUREMENT ed_fsp_15of20_.uw_satz_1of3_.uw_wert_nv_4of4_ "Umweltbedingung beim Fehlereintrag" UWORD FORMULA_0010 0 0 0.0 65535.0000 ECU_ADDRESS 0x3FA5BA /end MEASUREMENT
/begin MEASUREMENT ed_fsp_15of20_.uw_satz_2of3_.uw_wert_nv_1of4_ "Umweltbedingung beim Fehlereintrag" UWORD FORMULA_0010 0 0 0.0 65535.0000 ECU_ADDRESS 0x3FA5BE /end MEASUREMENT
/begin MEASUREMENT ed_fsp_15of20_.uw_satz_2of3_.uw_wert_nv_2of4_ "Umweltbedingung beim Fehlereintrag" UWORD FORMULA_0010 0 0 0.0 65535.0000 ECU_ADDRESS 0x3FA5C0 /end MEASUREMENT
/begin MEASUREMENT ed_fsp_15of20_.uw_satz_2of3_.uw_wert_nv_3of4_ "Umweltbedingung beim Fehlereintrag" UWORD FORMULA_0010 0 0 0.0 65535.0000 ECU_ADDRESS 0x3FA5C2 /end MEASUREMENT
/begin MEASUREMENT ed_fsp_15of20_.uw_satz_2of3_.uw_wert_nv_4of4_ "Umweltbedingung beim Fehlereintrag" UWORD FORMULA_0010 0 0 0.0 65535.0000 ECU_ADDRESS 0x3FA5C4 /end MEASUREMENT
/begin MEASUREMENT ed_fsp_15of20_.uw_satz_3of3_.uw_wert_nv_1of4_ "Umweltbedingung beim Fehlereintrag" UWORD FORMULA_0010 0 0 0.0 65535.0000 ECU_ADDRESS 0x3FA5C8 /end MEASUREMENT
/begin MEASUREMENT ed_fsp_15of20_.uw_satz_3of3_.uw_wert_nv_2of4_ "Umweltbedingung beim Fehlereintrag" UWORD FORMULA_0010 0 0 0.0 65535.0000 ECU_ADDRESS 0x3FA5CA /end MEASUREMENT
/begin MEASUREMENT ed_fsp_15of20_.uw_satz_3of3_.uw_wert_nv_3of4_ "Umweltbedingung beim Fehlereintrag" UWORD FORMULA_0010 0 0 0.0 65535.0000 ECU_ADDRESS 0x3FA5CC /end MEASUREMENT
/begin MEASUREMENT ed_fsp_15of20_.uw_satz_3of3_.uw_wert_nv_4of4_ "Umweltbedingung beim Fehlereintrag" UWORD FORMULA_0010 0 0 0.0 65535.0000 ECU_ADDRESS 0x3FA5CE /end MEASUREMENT
/begin MEASUREMENT ed_fsp_16of20_.uw_satz_1of3_.uw_wert_nv_1of4_ "Umweltbedingung beim Fehlereintrag" UWORD FORMULA_0010 0 0 0.0 65535.0000 ECU_ADDRESS 0x3FA606 /end MEASUREMENT
/begin MEASUREMENT ed_fsp_16of20_.uw_satz_1of3_.uw_wert_nv_2of4_ "Umweltbedingung beim Fehlereintrag" UWORD FORMULA_0010 0 0 0.0 65535.0000 ECU_ADDRESS 0x3FA608 /end MEASUREMENT
/begin MEASUREMENT ed_fsp_16of20_.uw_satz_1of3_.uw_wert_nv_3of4_ "Umweltbedingung beim Fehlereintrag" UWORD FORMULA_0010 0 0 0.0 65535.0000 ECU_ADDRESS 0x3FA60A /end MEASUREMENT
/begin MEASUREMENT ed_fsp_16of20_.uw_satz_1of3_.uw_wert_nv_4of4_ "Umweltbedingung beim Fehlereintrag" UWORD FORMULA_0010 0 0 0.0 65535.0000 ECU_ADDRESS 0x3FA60C /end MEASUREMENT
/begin MEASUREMENT ed_fsp_16of20_.uw_satz_2of3_.uw_wert_nv_1of4_ "Umweltbedingung beim Fehlereintrag" UWORD FORMULA_0010 0 0 0.0 65535.0000 ECU_ADDRESS 0x3FA610 /end MEASUREMENT
/begin MEASUREMENT ed_fsp_16of20_.uw_satz_2of3_.uw_wert_nv_2of4_ "Umweltbedingung beim Fehlereintrag" UWORD FORMULA_0010 0 0 0.0 65535.0000 ECU_ADDRESS 0x3FA612 /end MEASUREMENT
/begin MEASUREMENT ed_fsp_16of20_.uw_satz_2of3_.uw_wert_nv_3of4_ "Umweltbedingung beim Fehlereintrag" UWORD FORMULA_0010 0 0 0.0 65535.0000 ECU_ADDRESS 0x3FA614 /end MEASUREMENT
/begin MEASUREMENT ed_fsp_16of20_.uw_satz_2of3_.uw_wert_nv_4of4_ "Umweltbedingung beim Fehlereintrag" UWORD FORMULA_0010 0 0 0.0 65535.0000 ECU_ADDRESS 0x3FA616 /end MEASUREMENT
/begin MEASUREMENT ed_fsp_16of20_.uw_satz_3of3_.uw_wert_nv_1of4_ "Umweltbedingung beim Fehlereintrag" UWORD FORMULA_0010 0 0 0.0 65535.0000 ECU_ADDRESS 0x3FA61A /end MEASUREMENT
/begin MEASUREMENT ed_fsp_16of20_.uw_satz_3of3_.uw_wert_nv_2of4_ "Umweltbedingung beim Fehlereintrag" UWORD FORMULA_0010 0 0 0.0 65535.0000 ECU_ADDRESS 0x3FA61C /end MEASUREMENT
/begin MEASUREMENT ed_fsp_16of20_.uw_satz_3of3_.uw_wert_nv_3of4_ "Umweltbedingung beim Fehlereintrag" UWORD FORMULA_0010 0 0 0.0 65535.0000 ECU_ADDRESS 0x3FA61E /end MEASUREMENT
/begin MEASUREMENT ed_fsp_16of20_.uw_satz_3of3_.uw_wert_nv_4of4_ "Umweltbedingung beim Fehlereintrag" UWORD FORMULA_0010 0 0 0.0 65535.0000 ECU_ADDRESS 0x3FA620 /end MEASUREMENT
/begin MEASUREMENT ed_fsp_17of20_.uw_satz_1of3_.uw_wert_nv_1of4_ "Umweltbedingung beim Fehlereintrag" UWORD FORMULA_0010 0 0 0.0 65535.0000 ECU_ADDRESS 0x3FA658 /end MEASUREMENT
/begin MEASUREMENT ed_fsp_17of20_.uw_satz_1of3_.uw_wert_nv_2of4_ "Umweltbedingung beim Fehlereintrag" UWORD FORMULA_0010 0 0 0.0 65535.0000 ECU_ADDRESS 0x3FA65A /end MEASUREMENT
/begin MEASUREMENT ed_fsp_17of20_.uw_satz_1of3_.uw_wert_nv_3of4_ "Umweltbedingung beim Fehlereintrag" UWORD FORMULA_0010 0 0 0.0 65535.0000 ECU_ADDRESS 0x3FA65C /end MEASUREMENT
/begin MEASUREMENT ed_fsp_17of20_.uw_satz_1of3_.uw_wert_nv_4of4_ "Umweltbedingung beim Fehlereintrag" UWORD FORMULA_0010 0 0 0.0 65535.0000 ECU_ADDRESS 0x3FA65E /end MEASUREMENT
/begin MEASUREMENT ed_fsp_17of20_.uw_satz_2of3_.uw_wert_nv_1of4_ "Umweltbedingung beim Fehlereintrag" UWORD FORMULA_0010 0 0 0.0 65535.0000 ECU_ADDRESS 0x3FA662 /end MEASUREMENT
/begin MEASUREMENT ed_fsp_17of20_.uw_satz_2of3_.uw_wert_nv_2of4_ "Umweltbedingung beim Fehlereintrag" UWORD FORMULA_0010 0 0 0.0 65535.0000 ECU_ADDRESS 0x3FA664 /end MEASUREMENT
/begin MEASUREMENT ed_fsp_17of20_.uw_satz_2of3_.uw_wert_nv_3of4_ "Umweltbedingung beim Fehlereintrag" UWORD FORMULA_0010 0 0 0.0 65535.0000 ECU_ADDRESS 0x3FA666 /end MEASUREMENT
/begin MEASUREMENT ed_fsp_17of20_.uw_satz_2of3_.uw_wert_nv_4of4_ "Umweltbedingung beim Fehlereintrag" UWORD FORMULA_0010 0 0 0.0 65535.0000 ECU_ADDRESS 0x3FA668 /end MEASUREMENT
/begin MEASUREMENT ed_fsp_17of20_.uw_satz_3of3_.uw_wert_nv_1of4_ "Umweltbedingung beim Fehlereintrag" UWORD FORMULA_0010 0 0 0.0 65535.0000 ECU_ADDRESS 0x3FA66C /end MEASUREMENT
/begin MEASUREMENT ed_fsp_17of20_.uw_satz_3of3_.uw_wert_nv_2of4_ "Umweltbedingung beim Fehlereintrag" UWORD FORMULA_0010 0 0 0.0 65535.0000 ECU_ADDRESS 0x3FA66E /end MEASUREMENT
/begin MEASUREMENT ed_fsp_17of20_.uw_satz_3of3_.uw_wert_nv_3of4_ "Umweltbedingung beim Fehlereintrag" UWORD FORMULA_0010 0 0 0.0 65535.0000 ECU_ADDRESS 0x3FA670 /end MEASUREMENT
/begin MEASUREMENT ed_fsp_17of20_.uw_satz_3of3_.uw_wert_nv_4of4_ "Umweltbedingung beim Fehlereintrag" UWORD FORMULA_0010 0 0 0.0 65535.0000 ECU_ADDRESS 0x3FA672 /end MEASUREMENT
/begin MEASUREMENT ed_fsp_18of20_.uw_satz_1of3_.uw_wert_nv_1of4_ "Umweltbedingung beim Fehlereintrag" UWORD FORMULA_0010 0 0 0.0 65535.0000 ECU_ADDRESS 0x3FA6AA /end MEASUREMENT
/begin MEASUREMENT ed_fsp_18of20_.uw_satz_1of3_.uw_wert_nv_2of4_ "Umweltbedingung beim Fehlereintrag" UWORD FORMULA_0010 0 0 0.0 65535.0000 ECU_ADDRESS 0x3FA6AC /end MEASUREMENT
/begin MEASUREMENT ed_fsp_18of20_.uw_satz_1of3_.uw_wert_nv_3of4_ "Umweltbedingung beim Fehlereintrag" UWORD FORMULA_0010 0 0 0.0 65535.0000 ECU_ADDRESS 0x3FA6AE /end MEASUREMENT
/begin MEASUREMENT ed_fsp_18of20_.uw_satz_1of3_.uw_wert_nv_4of4_ "Umweltbedingung beim Fehlereintrag" UWORD FORMULA_0010 0 0 0.0 65535.0000 ECU_ADDRESS 0x3FA6B0 /end MEASUREMENT
/begin MEASUREMENT ed_fsp_18of20_.uw_satz_2of3_.uw_wert_nv_1of4_ "Umweltbedingung beim Fehlereintrag" UWORD FORMULA_0010 0 0 0.0 65535.0000 ECU_ADDRESS 0x3FA6B4 /end MEASUREMENT
/begin MEASUREMENT ed_fsp_18of20_.uw_satz_2of3_.uw_wert_nv_2of4_ "Umweltbedingung beim Fehlereintrag" UWORD FORMULA_0010 0 0 0.0 65535.0000 ECU_ADDRESS 0x3FA6B6 /end MEASUREMENT
/begin MEASUREMENT ed_fsp_18of20_.uw_satz_2of3_.uw_wert_nv_3of4_ "Umweltbedingung beim Fehlereintrag" UWORD FORMULA_0010 0 0 0.0 65535.0000 ECU_ADDRESS 0x3FA6B8 /end MEASUREMENT
/begin MEASUREMENT ed_fsp_18of20_.uw_satz_2of3_.uw_wert_nv_4of4_ "Umweltbedingung beim Fehlereintrag" UWORD FORMULA_0010 0 0 0.0 65535.0000 ECU_ADDRESS 0x3FA6BA /end MEASUREMENT
/begin MEASUREMENT ed_fsp_18of20_.uw_satz_3of3_.uw_wert_nv_1of4_ "Umweltbedingung beim Fehlereintrag" UWORD FORMULA_0010 0 0 0.0 65535.0000 ECU_ADDRESS 0x3FA6BE /end MEASUREMENT
/begin MEASUREMENT ed_fsp_18of20_.uw_satz_3of3_.uw_wert_nv_2of4_ "Umweltbedingung beim Fehlereintrag" UWORD FORMULA_0010 0 0 0.0 65535.0000 ECU_ADDRESS 0x3FA6C0 /end MEASUREMENT
/begin MEASUREMENT ed_fsp_18of20_.uw_satz_3of3_.uw_wert_nv_3of4_ "Umweltbedingung beim Fehlereintrag" UWORD FORMULA_0010 0 0 0.0 65535.0000 ECU_ADDRESS 0x3FA6C2 /end MEASUREMENT
/begin MEASUREMENT ed_fsp_18of20_.uw_satz_3of3_.uw_wert_nv_4of4_ "Umweltbedingung beim Fehlereintrag" UWORD FORMULA_0010 0 0 0.0 65535.0000 ECU_ADDRESS 0x3FA6C4 /end MEASUREMENT
/begin MEASUREMENT ed_fsp_19of20_.uw_satz_1of3_.uw_wert_nv_1of4_ "Umweltbedingung beim Fehlereintrag" UWORD FORMULA_0010 0 0 0.0 65535.0000 ECU_ADDRESS 0x3FA6FC /end MEASUREMENT
/begin MEASUREMENT ed_fsp_19of20_.uw_satz_1of3_.uw_wert_nv_2of4_ "Umweltbedingung beim Fehlereintrag" UWORD FORMULA_0010 0 0 0.0 65535.0000 ECU_ADDRESS 0x3FA6FE /end MEASUREMENT
/begin MEASUREMENT ed_fsp_19of20_.uw_satz_1of3_.uw_wert_nv_3of4_ "Umweltbedingung beim Fehlereintrag" UWORD FORMULA_0010 0 0 0.0 65535.0000 ECU_ADDRESS 0x3FA700 /end MEASUREMENT
/begin MEASUREMENT ed_fsp_19of20_.uw_satz_1of3_.uw_wert_nv_4of4_ "Umweltbedingung beim Fehlereintrag" UWORD FORMULA_0010 0 0 0.0 65535.0000 ECU_ADDRESS 0x3FA702 /end MEASUREMENT
/begin MEASUREMENT ed_fsp_19of20_.uw_satz_2of3_.uw_wert_nv_1of4_ "Umweltbedingung beim Fehlereintrag" UWORD FORMULA_0010 0 0 0.0 65535.0000 ECU_ADDRESS 0x3FA706 /end MEASUREMENT
/begin MEASUREMENT ed_fsp_19of20_.uw_satz_2of3_.uw_wert_nv_2of4_ "Umweltbedingung beim Fehlereintrag" UWORD FORMULA_0010 0 0 0.0 65535.0000 ECU_ADDRESS 0x3FA708 /end MEASUREMENT
/begin MEASUREMENT ed_fsp_19of20_.uw_satz_2of3_.uw_wert_nv_3of4_ "Umweltbedingung beim Fehlereintrag" UWORD FORMULA_0010 0 0 0.0 65535.0000 ECU_ADDRESS 0x3FA70A /end MEASUREMENT
/begin MEASUREMENT ed_fsp_19of20_.uw_satz_2of3_.uw_wert_nv_4of4_ "Umweltbedingung beim Fehlereintrag" UWORD FORMULA_0010 0 0 0.0 65535.0000 ECU_ADDRESS 0x3FA70C /end MEASUREMENT
/begin MEASUREMENT ed_fsp_19of20_.uw_satz_3of3_.uw_wert_nv_1of4_ "Umweltbedingung beim Fehlereintrag" UWORD FORMULA_0010 0 0 0.0 65535.0000 ECU_ADDRESS 0x3FA710 /end MEASUREMENT
/begin MEASUREMENT ed_fsp_19of20_.uw_satz_3of3_.uw_wert_nv_2of4_ "Umweltbedingung beim Fehlereintrag" UWORD FORMULA_0010 0 0 0.0 65535.0000 ECU_ADDRESS 0x3FA712 /end MEASUREMENT
/begin MEASUREMENT ed_fsp_19of20_.uw_satz_3of3_.uw_wert_nv_3of4_ "Umweltbedingung beim Fehlereintrag" UWORD FORMULA_0010 0 0 0.0 65535.0000 ECU_ADDRESS 0x3FA714 /end MEASUREMENT
/begin MEASUREMENT ed_fsp_19of20_.uw_satz_3of3_.uw_wert_nv_4of4_ "Umweltbedingung beim Fehlereintrag" UWORD FORMULA_0010 0 0 0.0 65535.0000 ECU_ADDRESS 0x3FA716 /end MEASUREMENT
/begin MEASUREMENT ed_fsp_20of20_.uw_satz_1of3_.uw_wert_nv_1of4_ "Umweltbedingung beim Fehlereintrag" UWORD FORMULA_0010 0 0 0.0 65535.0000 ECU_ADDRESS 0x3FA74E /end MEASUREMENT
/begin MEASUREMENT ed_fsp_20of20_.uw_satz_1of3_.uw_wert_nv_2of4_ "Umweltbedingung beim Fehlereintrag" UWORD FORMULA_0010 0 0 0.0 65535.0000 ECU_ADDRESS 0x3FA750 /end MEASUREMENT
/begin MEASUREMENT ed_fsp_20of20_.uw_satz_1of3_.uw_wert_nv_3of4_ "Umweltbedingung beim Fehlereintrag" UWORD FORMULA_0010 0 0 0.0 65535.0000 ECU_ADDRESS 0x3FA752 /end MEASUREMENT
/begin MEASUREMENT ed_fsp_20of20_.uw_satz_1of3_.uw_wert_nv_4of4_ "Umweltbedingung beim Fehlereintrag" UWORD FORMULA_0010 0 0 0.0 65535.0000 ECU_ADDRESS 0x3FA754 /end MEASUREMENT
/begin MEASUREMENT ed_fsp_20of20_.uw_satz_2of3_.uw_wert_nv_1of4_ "Umweltbedingung beim Fehlereintrag" UWORD FORMULA_0010 0 0 0.0 65535.0000 ECU_ADDRESS 0x3FA758 /end MEASUREMENT
/begin MEASUREMENT ed_fsp_20of20_.uw_satz_2of3_.uw_wert_nv_2of4_ "Umweltbedingung beim Fehlereintrag" UWORD FORMULA_0010 0 0 0.0 65535.0000 ECU_ADDRESS 0x3FA75A /end MEASUREMENT
/begin MEASUREMENT ed_fsp_20of20_.uw_satz_2of3_.uw_wert_nv_3of4_ "Umweltbedingung beim Fehlereintrag" UWORD FORMULA_0010 0 0 0.0 65535.0000 ECU_ADDRESS 0x3FA75C /end MEASUREMENT
/begin MEASUREMENT ed_fsp_20of20_.uw_satz_2of3_.uw_wert_nv_4of4_ "Umweltbedingung beim Fehlereintrag" UWORD FORMULA_0010 0 0 0.0 65535.0000 ECU_ADDRESS 0x3FA75E /end MEASUREMENT
/begin MEASUREMENT ed_fsp_20of20_.uw_satz_3of3_.uw_wert_nv_1of4_ "Umweltbedingung beim Fehlereintrag" UWORD FORMULA_0010 0 0 0.0 65535.0000 ECU_ADDRESS 0x3FA762 /end MEASUREMENT
/begin MEASUREMENT ed_fsp_20of20_.uw_satz_3of3_.uw_wert_nv_2of4_ "Umweltbedingung beim Fehlereintrag" UWORD FORMULA_0010 0 0 0.0 65535.0000 ECU_ADDRESS 0x3FA764 /end MEASUREMENT
/begin MEASUREMENT ed_fsp_20of20_.uw_satz_3of3_.uw_wert_nv_3of4_ "Umweltbedingung beim Fehlereintrag" UWORD FORMULA_0010 0 0 0.0 65535.0000 ECU_ADDRESS 0x3FA766 /end MEASUREMENT
/begin MEASUREMENT ed_fsp_20of20_.uw_satz_3of3_.uw_wert_nv_4of4_ "Umweltbedingung beim Fehlereintrag" UWORD FORMULA_0010 0 0 0.0 65535.0000 ECU_ADDRESS 0x3FA768 /end MEASUREMENT
/begin MEASUREMENT ed_fsp_1of20_.inj_fehlerzaehler_nv "INJ-Fehlerzaehler" UWORD FORMULA_0010 0 0 0.0 65535.0000 ECU_ADDRESS 0x3FA154 /end MEASUREMENT
/begin MEASUREMENT ed_fsp_2of20_.inj_fehlerzaehler_nv "INJ-Fehlerzaehler" UWORD FORMULA_0010 0 0 0.0 65535.0000 ECU_ADDRESS 0x3FA1A6 /end MEASUREMENT
/begin MEASUREMENT ed_fsp_3of20_.inj_fehlerzaehler_nv "INJ-Fehlerzaehler" UWORD FORMULA_0010 0 0 0.0 65535.0000 ECU_ADDRESS 0x3FA1F8 /end MEASUREMENT
/begin MEASUREMENT ed_fsp_4of20_.inj_fehlerzaehler_nv "INJ-Fehlerzaehler" UWORD FORMULA_0010 0 0 0.0 65535.0000 ECU_ADDRESS 0x3FA24A /end MEASUREMENT
/begin MEASUREMENT ed_fsp_5of20_.inj_fehlerzaehler_nv "INJ-Fehlerzaehler" UWORD FORMULA_0010 0 0 0.0 65535.0000 ECU_ADDRESS 0x3FA29C /end MEASUREMENT
/begin MEASUREMENT ed_fsp_6of20_.inj_fehlerzaehler_nv "INJ-Fehlerzaehler" UWORD FORMULA_0010 0 0 0.0 65535.0000 ECU_ADDRESS 0x3FA2EE /end MEASUREMENT
/begin MEASUREMENT ed_fsp_7of20_.inj_fehlerzaehler_nv "INJ-Fehlerzaehler" UWORD FORMULA_0010 0 0 0.0 65535.0000 ECU_ADDRESS 0x3FA340 /end MEASUREMENT
/begin MEASUREMENT ed_fsp_8of20_.inj_fehlerzaehler_nv "INJ-Fehlerzaehler" UWORD FORMULA_0010 0 0 0.0 65535.0000 ECU_ADDRESS 0x3FA392 /end MEASUREMENT
/begin MEASUREMENT ed_fsp_9of20_.inj_fehlerzaehler_nv "INJ-Fehlerzaehler" UWORD FORMULA_0010 0 0 0.0 65535.0000 ECU_ADDRESS 0x3FA3E4 /end MEASUREMENT
/begin MEASUREMENT ed_fsp_14of20_.inj_fehlerzaehler_nv "INJ-Fehlerzaehler" UWORD FORMULA_0010 0 0 0.0 65535.0000 ECU_ADDRESS 0x3FA57E /end MEASUREMENT
/begin MEASUREMENT ed_fsp_15of20_.inj_fehlerzaehler_nv "INJ-Fehlerzaehler" UWORD FORMULA_0010 0 0 0.0 65535.0000 ECU_ADDRESS 0x3FA5D0 /end MEASUREMENT
/begin MEASUREMENT ed_fsp_16of20_.inj_fehlerzaehler_nv "INJ-Fehlerzaehler" UWORD FORMULA_0010 0 0 0.0 65535.0000 ECU_ADDRESS 0x3FA622 /end MEASUREMENT
/begin MEASUREMENT ed_fsp_17of20_.inj_fehlerzaehler_nv "INJ-Fehlerzaehler" UWORD FORMULA_0010 0 0 0.0 65535.0000 ECU_ADDRESS 0x3FA674 /end MEASUREMENT
/begin MEASUREMENT ed_fsp_18of20_.inj_fehlerzaehler_nv "INJ-Fehlerzaehler" UWORD FORMULA_0010 0 0 0.0 65535.0000 ECU_ADDRESS 0x3FA6C6 /end MEASUREMENT
/begin MEASUREMENT ed_fsp_19of20_.inj_fehlerzaehler_nv "INJ-Fehlerzaehler" UWORD FORMULA_0010 0 0 0.0 65535.0000 ECU_ADDRESS 0x3FA718 /end MEASUREMENT
/begin MEASUREMENT ed_fsp_20of20_.inj_fehlerzaehler_nv "INJ-Fehlerzaehler" UWORD FORMULA_0010 0 0 0.0 65535.0000 ECU_ADDRESS 0x3FA76A /end MEASUREMENT
/begin MEASUREMENT ed_fsp_1of20_.ed_fil_index_nv "Verweis auf Fehlerfilter" UWORD FORMULA_0010 0 0 0.0 65535.0000 ECU_ADDRESS 0x3FA156 /end MEASUREMENT
/begin MEASUREMENT ed_fsp_2of20_.ed_fil_index_nv "Verweis auf Fehlerfilter" UWORD FORMULA_0010 0 0 0.0 65535.0000 ECU_ADDRESS 0x3FA1A8 /end MEASUREMENT
/begin MEASUREMENT ed_fsp_3of20_.ed_fil_index_nv "Verweis auf Fehlerfilter" UWORD FORMULA_0010 0 0 0.0 65535.0000 ECU_ADDRESS 0x3FA1FA /end MEASUREMENT
/begin MEASUREMENT ed_fsp_4of20_.ed_fil_index_nv "Verweis auf Fehlerfilter" UWORD FORMULA_0010 0 0 0.0 65535.0000 ECU_ADDRESS 0x3FA24C /end MEASUREMENT
/begin MEASUREMENT ed_fsp_5of20_.ed_fil_index_nv "Verweis auf Fehlerfilter" UWORD FORMULA_0010 0 0 0.0 65535.0000 ECU_ADDRESS 0x3FA29E /end MEASUREMENT
/begin MEASUREMENT ed_fsp_6of20_.ed_fil_index_nv "Verweis auf Fehlerfilter" UWORD FORMULA_0010 0 0 0.0 65535.0000 ECU_ADDRESS 0x3FA2F0 /end MEASUREMENT
/begin MEASUREMENT ed_fsp_7of20_.ed_fil_index_nv "Verweis auf Fehlerfilter" UWORD FORMULA_0010 0 0 0.0 65535.0000 ECU_ADDRESS 0x3FA342 /end MEASUREMENT
/begin MEASUREMENT ed_fsp_8of20_.ed_fil_index_nv "Verweis auf Fehlerfilter" UWORD FORMULA_0010 0 0 0.0 65535.0000 ECU_ADDRESS 0x3FA394 /end MEASUREMENT
/begin MEASUREMENT ed_fsp_9of20_.ed_fil_index_nv "Verweis auf Fehlerfilter" UWORD FORMULA_0010 0 0 0.0 65535.0000 ECU_ADDRESS 0x3FA3E6 /end MEASUREMENT
/begin MEASUREMENT ed_fsp_15of20_.ed_fil_index_nv "Verweis auf Fehlerfilter" UWORD FORMULA_0010 0 0 0.0 65535.0000 ECU_ADDRESS 0x3FA5D2 /end MEASUREMENT
/begin MEASUREMENT ed_fsp_16of20_.ed_fil_index_nv "Verweis auf Fehlerfilter" UWORD FORMULA_0010 0 0 0.0 65535.0000 ECU_ADDRESS 0x3FA624 /end MEASUREMENT
/begin MEASUREMENT ed_fsp_17of20_.ed_fil_index_nv "Verweis auf Fehlerfilter" UWORD FORMULA_0010 0 0 0.0 65535.0000 ECU_ADDRESS 0x3FA676 /end MEASUREMENT
/begin MEASUREMENT ed_fsp_18of20_.ed_fil_index_nv "Verweis auf Fehlerfilter" UWORD FORMULA_0010 0 0 0.0 65535.0000 ECU_ADDRESS 0x3FA6C8 /end MEASUREMENT
/begin MEASUREMENT ed_fsp_19of20_.ed_fil_index_nv "Verweis auf Fehlerfilter" UWORD FORMULA_0010 0 0 0.0 65535.0000 ECU_ADDRESS 0x3FA71A /end MEASUREMENT
/begin MEASUREMENT ed_fsp_20of20_.ed_fil_index_nv "Verweis auf Fehlerfilter" UWORD FORMULA_0010 0 0 0.0 65535.0000 ECU_ADDRESS 0x3FA76C /end MEASUREMENT
/begin MEASUREMENT ed_fsp_1of20_.mil_filter_nv "Filterwert der Milansteuerung" SBYTE FORMULA_0003 0 0 -128.0000 127.0000 ECU_ADDRESS 0x3FA158 /end MEASUREMENT
/begin MEASUREMENT ed_fsp_2of20_.mil_filter_nv "Filterwert der Milansteuerung" SBYTE FORMULA_0003 0 0 -128.0000 127.0000 ECU_ADDRESS 0x3FA1AA /end MEASUREMENT
/begin MEASUREMENT ed_fsp_3of20_.mil_filter_nv "Filterwert der Milansteuerung" SBYTE FORMULA_0003 0 0 -128.0000 127.0000 ECU_ADDRESS 0x3FA1FC /end MEASUREMENT
/begin MEASUREMENT ed_fsp_4of20_.mil_filter_nv "Filterwert der Milansteuerung" SBYTE FORMULA_0003 0 0 -128.0000 127.0000 ECU_ADDRESS 0x3FA24E /end MEASUREMENT
/begin MEASUREMENT ed_fsp_5of20_.mil_filter_nv "Filterwert der Milansteuerung" SBYTE FORMULA_0003 0 0 -128.0000 127.0000 ECU_ADDRESS 0x3FA2A0 /end MEASUREMENT
/begin MEASUREMENT ed_fsp_6of20_.mil_filter_nv "Filterwert der Milansteuerung" SBYTE FORMULA_0003 0 0 -128.0000 127.0000 ECU_ADDRESS 0x3FA2F2 /end MEASUREMENT
/begin MEASUREMENT ed_fsp_7of20_.mil_filter_nv "Filterwert der Milansteuerung" SBYTE FORMULA_0003 0 0 -128.0000 127.0000 ECU_ADDRESS 0x3FA344 /end MEASUREMENT
/begin MEASUREMENT ed_fsp_8of20_.mil_filter_nv "Filterwert der Milansteuerung" SBYTE FORMULA_0003 0 0 -128.0000 127.0000 ECU_ADDRESS 0x3FA396 /end MEASUREMENT
/begin MEASUREMENT ed_fsp_9of20_.mil_filter_nv "Filterwert der Milansteuerung" SBYTE FORMULA_0003 0 0 -128.0000 127.0000 ECU_ADDRESS 0x3FA3E8 /end MEASUREMENT
/begin MEASUREMENT ed_fsp_14of20_.mil_filter_nv "Filterwert der Milansteuerung" SBYTE FORMULA_0003 0 0 -128.0000 127.0000 ECU_ADDRESS 0x3FA582 /end MEASUREMENT
/begin MEASUREMENT ed_fsp_15of20_.mil_filter_nv "Filterwert der Milansteuerung" SBYTE FORMULA_0003 0 0 -128.0000 127.0000 ECU_ADDRESS 0x3FA5D4 /end MEASUREMENT
/begin MEASUREMENT ed_fsp_16of20_.mil_filter_nv "Filterwert der Milansteuerung" SBYTE FORMULA_0003 0 0 -128.0000 127.0000 ECU_ADDRESS 0x3FA626 /end MEASUREMENT
/begin MEASUREMENT ed_fsp_17of20_.mil_filter_nv "Filterwert der Milansteuerung" SBYTE FORMULA_0003 0 0 -128.0000 127.0000 ECU_ADDRESS 0x3FA678 /end MEASUREMENT
/begin MEASUREMENT ed_fsp_18of20_.mil_filter_nv "Filterwert der Milansteuerung" SBYTE FORMULA_0003 0 0 -128.0000 127.0000 ECU_ADDRESS 0x3FA6CA /end MEASUREMENT
/begin MEASUREMENT ed_fsp_19of20_.mil_filter_nv "Filterwert der Milansteuerung" SBYTE FORMULA_0003 0 0 -128.0000 127.0000 ECU_ADDRESS 0x3FA71C /end MEASUREMENT
/begin MEASUREMENT ed_fsp_20of20_.mil_filter_nv "Filterwert der Milansteuerung" SBYTE FORMULA_0003 0 0 -128.0000 127.0000 ECU_ADDRESS 0x3FA76E /end MEASUREMENT
/begin MEASUREMENT ed_fsp_1of20_.mil_filter_scdn_nv "Similar Conditions Eintragsfilterwert der Milansteuerung" UBYTE FORMULA_0003 0 0 0.0 255.0000 ECU_ADDRESS 0x3FA159 /end MEASUREMENT
/begin MEASUREMENT ed_fsp_2of20_.mil_filter_scdn_nv "Similar Conditions Eintragsfilterwert der Milansteuerung" UBYTE FORMULA_0003 0 0 0.0 255.0000 ECU_ADDRESS 0x3FA1AB /end MEASUREMENT
/begin MEASUREMENT ed_fsp_3of20_.mil_filter_scdn_nv "Similar Conditions Eintragsfilterwert der Milansteuerung" UBYTE FORMULA_0003 0 0 0.0 255.0000 ECU_ADDRESS 0x3FA1FD /end MEASUREMENT
/begin MEASUREMENT ed_fsp_4of20_.mil_filter_scdn_nv "Similar Conditions Eintragsfilterwert der Milansteuerung" UBYTE FORMULA_0003 0 0 0.0 255.0000 ECU_ADDRESS 0x3FA24F /end MEASUREMENT
/begin MEASUREMENT ed_fsp_5of20_.mil_filter_scdn_nv "Similar Conditions Eintragsfilterwert der Milansteuerung" UBYTE FORMULA_0003 0 0 0.0 255.0000 ECU_ADDRESS 0x3FA2A1 /end MEASUREMENT
/begin MEASUREMENT ed_fsp_6of20_.mil_filter_scdn_nv "Similar Conditions Eintragsfilterwert der Milansteuerung" UBYTE FORMULA_0003 0 0 0.0 255.0000 ECU_ADDRESS 0x3FA2F3 /end MEASUREMENT
/begin MEASUREMENT ed_fsp_7of20_.mil_filter_scdn_nv "Similar Conditions Eintragsfilterwert der Milansteuerung" UBYTE FORMULA_0003 0 0 0.0 255.0000 ECU_ADDRESS 0x3FA345 /end MEASUREMENT
/begin MEASUREMENT ed_fsp_8of20_.mil_filter_scdn_nv "Similar Conditions Eintragsfilterwert der Milansteuerung" UBYTE FORMULA_0003 0 0 0.0 255.0000 ECU_ADDRESS 0x3FA397 /end MEASUREMENT
/begin MEASUREMENT ed_fsp_9of20_.mil_filter_scdn_nv "Similar Conditions Eintragsfilterwert der Milansteuerung" UBYTE FORMULA_0003 0 0 0.0 255.0000 ECU_ADDRESS 0x3FA3E9 /end MEASUREMENT
/begin MEASUREMENT ed_fsp_14of20_.mil_filter_scdn_nv "Similar Conditions Eintragsfilterwert der Milansteuerung" UBYTE FORMULA_0003 0 0 0.0 255.0000 ECU_ADDRESS 0x3FA583 /end MEASUREMENT
/begin MEASUREMENT ed_fsp_15of20_.mil_filter_scdn_nv "Similar Conditions Eintragsfilterwert der Milansteuerung" UBYTE FORMULA_0003 0 0 0.0 255.0000 ECU_ADDRESS 0x3FA5D5 /end MEASUREMENT
/begin MEASUREMENT ed_fsp_16of20_.mil_filter_scdn_nv "Similar Conditions Eintragsfilterwert der Milansteuerung" UBYTE FORMULA_0003 0 0 0.0 255.0000 ECU_ADDRESS 0x3FA627 /end MEASUREMENT
/begin MEASUREMENT ed_fsp_17of20_.mil_filter_scdn_nv "Similar Conditions Eintragsfilterwert der Milansteuerung" UBYTE FORMULA_0003 0 0 0.0 255.0000 ECU_ADDRESS 0x3FA679 /end MEASUREMENT
/begin MEASUREMENT ed_fsp_18of20_.mil_filter_scdn_nv "Similar Conditions Eintragsfilterwert der Milansteuerung" UBYTE FORMULA_0003 0 0 0.0 255.0000 ECU_ADDRESS 0x3FA6CB /end MEASUREMENT
/begin MEASUREMENT ed_fsp_19of20_.mil_filter_scdn_nv "Similar Conditions Eintragsfilterwert der Milansteuerung" UBYTE FORMULA_0003 0 0 0.0 255.0000 ECU_ADDRESS 0x3FA71D /end MEASUREMENT
/begin MEASUREMENT ed_fsp_20of20_.mil_filter_scdn_nv "Similar Conditions Eintragsfilterwert der Milansteuerung" UBYTE FORMULA_0003 0 0 0.0 255.0000 ECU_ADDRESS 0x3FA76F /end MEASUREMENT
/begin MEASUREMENT ed_fsp_1of20_.scdn_zaehler_nv "Im similar Fenster" UWORD FORMULA_0010 0 0 0.0 65535.0000 ECU_ADDRESS 0x3FA15A /end MEASUREMENT
/begin MEASUREMENT ed_fsp_2of20_.scdn_zaehler_nv "Im similar Fenster" UWORD FORMULA_0010 0 0 0.0 65535.0000 ECU_ADDRESS 0x3FA1AC /end MEASUREMENT
/begin MEASUREMENT ed_fsp_3of20_.scdn_zaehler_nv "Im similar Fenster" UWORD FORMULA_0010 0 0 0.0 65535.0000 ECU_ADDRESS 0x3FA1FE /end MEASUREMENT
/begin MEASUREMENT ed_fsp_4of20_.scdn_zaehler_nv "Im similar Fenster" UWORD FORMULA_0010 0 0 0.0 65535.0000 ECU_ADDRESS 0x3FA250 /end MEASUREMENT
/begin MEASUREMENT ed_fsp_5of20_.scdn_zaehler_nv "Im similar Fenster" UWORD FORMULA_0010 0 0 0.0 65535.0000 ECU_ADDRESS 0x3FA2A2 /end MEASUREMENT
/begin MEASUREMENT ed_fsp_6of20_.scdn_zaehler_nv "Im similar Fenster" UWORD FORMULA_0010 0 0 0.0 65535.0000 ECU_ADDRESS 0x3FA2F4 /end MEASUREMENT
/begin MEASUREMENT ed_fsp_7of20_.scdn_zaehler_nv "Im similar Fenster" UWORD FORMULA_0010 0 0 0.0 65535.0000 ECU_ADDRESS 0x3FA346 /end MEASUREMENT
/begin MEASUREMENT ed_fsp_8of20_.scdn_zaehler_nv "Im similar Fenster" UWORD FORMULA_0010 0 0 0.0 65535.0000 ECU_ADDRESS 0x3FA398 /end MEASUREMENT
/begin MEASUREMENT ed_fsp_9of20_.scdn_zaehler_nv "Im similar Fenster" UWORD FORMULA_0010 0 0 0.0 65535.0000 ECU_ADDRESS 0x3FA3EA /end MEASUREMENT
/begin MEASUREMENT ed_fsp_14of20_.scdn_zaehler_nv "Im similar Fenster" UWORD FORMULA_0010 0 0 0.0 65535.0000 ECU_ADDRESS 0x3FA584 /end MEASUREMENT
/begin MEASUREMENT ed_fsp_15of20_.scdn_zaehler_nv "Im similar Fenster" UWORD FORMULA_0010 0 0 0.0 65535.0000 ECU_ADDRESS 0x3FA5D6 /end MEASUREMENT
/begin MEASUREMENT ed_fsp_16of20_.scdn_zaehler_nv "Im similar Fenster" UWORD FORMULA_0010 0 0 0.0 65535.0000 ECU_ADDRESS 0x3FA628 /end MEASUREMENT
/begin MEASUREMENT ed_fsp_17of20_.scdn_zaehler_nv "Im similar Fenster" UWORD FORMULA_0010 0 0 0.0 65535.0000 ECU_ADDRESS 0x3FA67A /end MEASUREMENT
/begin MEASUREMENT ed_fsp_18of20_.scdn_zaehler_nv "Im similar Fenster" UWORD FORMULA_0010 0 0 0.0 65535.0000 ECU_ADDRESS 0x3FA6CC /end MEASUREMENT
/begin MEASUREMENT ed_fsp_19of20_.scdn_zaehler_nv "Im similar Fenster" UWORD FORMULA_0010 0 0 0.0 65535.0000 ECU_ADDRESS 0x3FA71E /end MEASUREMENT
/begin MEASUREMENT ed_fsp_20of20_.scdn_zaehler_nv "Im similar Fenster" UWORD FORMULA_0010 0 0 0.0 65535.0000 ECU_ADDRESS 0x3FA770 /end MEASUREMENT
/begin MEASUREMENT ed_fsp_1of20_.scdn_nenner_nv "Gesamte Anzahl" UWORD FORMULA_0010 0 0 0.0 65535.0000 ECU_ADDRESS 0x3FA15C /end MEASUREMENT
/begin MEASUREMENT ed_fsp_2of20_.scdn_nenner_nv "Gesamte Anzahl" UWORD FORMULA_0010 0 0 0.0 65535.0000 ECU_ADDRESS 0x3FA1AE /end MEASUREMENT
/begin MEASUREMENT ed_fsp_3of20_.scdn_nenner_nv "Gesamte Anzahl" UWORD FORMULA_0010 0 0 0.0 65535.0000 ECU_ADDRESS 0x3FA200 /end MEASUREMENT
/begin MEASUREMENT ed_fsp_4of20_.scdn_nenner_nv "Gesamte Anzahl" UWORD FORMULA_0010 0 0 0.0 65535.0000 ECU_ADDRESS 0x3FA252 /end MEASUREMENT
/begin MEASUREMENT ed_fsp_5of20_.scdn_nenner_nv "Gesamte Anzahl" UWORD FORMULA_0010 0 0 0.0 65535.0000 ECU_ADDRESS 0x3FA2A4 /end MEASUREMENT
/begin MEASUREMENT ed_fsp_6of20_.scdn_nenner_nv "Gesamte Anzahl" UWORD FORMULA_0010 0 0 0.0 65535.0000 ECU_ADDRESS 0x3FA2F6 /end MEASUREMENT
/begin MEASUREMENT ed_fsp_7of20_.scdn_nenner_nv "Gesamte Anzahl" UWORD FORMULA_0010 0 0 0.0 65535.0000 ECU_ADDRESS 0x3FA348 /end MEASUREMENT
/begin MEASUREMENT ed_fsp_8of20_.scdn_nenner_nv "Gesamte Anzahl" UWORD FORMULA_0010 0 0 0.0 65535.0000 ECU_ADDRESS 0x3FA39A /end MEASUREMENT
/begin MEASUREMENT ed_fsp_9of20_.scdn_nenner_nv "Gesamte Anzahl" UWORD FORMULA_0010 0 0 0.0 65535.0000 ECU_ADDRESS 0x3FA3EC /end MEASUREMENT
/begin MEASUREMENT ed_fsp_14of20_.scdn_nenner_nv "Gesamte Anzahl" UWORD FORMULA_0010 0 0 0.0 65535.0000 ECU_ADDRESS 0x3FA586 /end MEASUREMENT
/begin MEASUREMENT ed_fsp_15of20_.scdn_nenner_nv "Gesamte Anzahl" UWORD FORMULA_0010 0 0 0.0 65535.0000 ECU_ADDRESS 0x3FA5D8 /end MEASUREMENT
/begin MEASUREMENT ed_fsp_16of20_.scdn_nenner_nv "Gesamte Anzahl" UWORD FORMULA_0010 0 0 0.0 65535.0000 ECU_ADDRESS 0x3FA62A /end MEASUREMENT
/begin MEASUREMENT ed_fsp_17of20_.scdn_nenner_nv "Gesamte Anzahl" UWORD FORMULA_0010 0 0 0.0 65535.0000 ECU_ADDRESS 0x3FA67C /end MEASUREMENT
/begin MEASUREMENT ed_fsp_18of20_.scdn_nenner_nv "Gesamte Anzahl" UWORD FORMULA_0010 0 0 0.0 65535.0000 ECU_ADDRESS 0x3FA6CE /end MEASUREMENT
/begin MEASUREMENT ed_fsp_19of20_.scdn_nenner_nv "Gesamte Anzahl" UWORD FORMULA_0010 0 0 0.0 65535.0000 ECU_ADDRESS 0x3FA720 /end MEASUREMENT
/begin MEASUREMENT ed_fsp_20of20_.scdn_nenner_nv "Gesamte Anzahl" UWORD FORMULA_0010 0 0 0.0 65535.0000 ECU_ADDRESS 0x3FA772 /end MEASUREMENT
/begin MEASUREMENT ed_fsp_1of20_.ff_p_code_nv "P-Code des Freeze Frame" UWORD FORMULA_0010 0 0 0.0 65535.0000 ECU_ADDRESS 0x3FA15E /end MEASUREMENT
/begin MEASUREMENT ed_fsp_2of20_.ff_p_code_nv "P-Code des Freeze Frame" UWORD FORMULA_0010 0 0 0.0 65535.0000 ECU_ADDRESS 0x3FA1B0 /end MEASUREMENT
/begin MEASUREMENT ed_fsp_3of20_.ff_p_code_nv "P-Code des Freeze Frame" UWORD FORMULA_0010 0 0 0.0 65535.0000 ECU_ADDRESS 0x3FA202 /end MEASUREMENT
/begin MEASUREMENT ed_fsp_4of20_.ff_p_code_nv "P-Code des Freeze Frame" UWORD FORMULA_0010 0 0 0.0 65535.0000 ECU_ADDRESS 0x3FA254 /end MEASUREMENT
/begin MEASUREMENT ed_fsp_5of20_.ff_p_code_nv "P-Code des Freeze Frame" UWORD FORMULA_0010 0 0 0.0 65535.0000 ECU_ADDRESS 0x3FA2A6 /end MEASUREMENT
/begin MEASUREMENT ed_fsp_6of20_.ff_p_code_nv "P-Code des Freeze Frame" UWORD FORMULA_0010 0 0 0.0 65535.0000 ECU_ADDRESS 0x3FA2F8 /end MEASUREMENT
/begin MEASUREMENT ed_fsp_7of20_.ff_p_code_nv "P-Code des Freeze Frame" UWORD FORMULA_0010 0 0 0.0 65535.0000 ECU_ADDRESS 0x3FA34A /end MEASUREMENT
/begin MEASUREMENT ed_fsp_8of20_.ff_p_code_nv "P-Code des Freeze Frame" UWORD FORMULA_0010 0 0 0.0 65535.0000 ECU_ADDRESS 0x3FA39C /end MEASUREMENT
/begin MEASUREMENT ed_fsp_9of20_.ff_p_code_nv "P-Code des Freeze Frame" UWORD FORMULA_0010 0 0 0.0 65535.0000 ECU_ADDRESS 0x3FA3EE /end MEASUREMENT
/begin MEASUREMENT ed_fsp_15of20_.ff_p_code_nv "P-Code des Freeze Frame" UWORD FORMULA_0010 0 0 0.0 65535.0000 ECU_ADDRESS 0x3FA5DA /end MEASUREMENT
/begin MEASUREMENT ed_fsp_16of20_.ff_p_code_nv "P-Code des Freeze Frame" UWORD FORMULA_0010 0 0 0.0 65535.0000 ECU_ADDRESS 0x3FA62C /end MEASUREMENT
/begin MEASUREMENT ed_fsp_17of20_.ff_p_code_nv "P-Code des Freeze Frame" UWORD FORMULA_0010 0 0 0.0 65535.0000 ECU_ADDRESS 0x3FA67E /end MEASUREMENT
/begin MEASUREMENT ed_fsp_18of20_.ff_p_code_nv "P-Code des Freeze Frame" UWORD FORMULA_0010 0 0 0.0 65535.0000 ECU_ADDRESS 0x3FA6D0 /end MEASUREMENT
/begin MEASUREMENT ed_fsp_19of20_.ff_p_code_nv "P-Code des Freeze Frame" UWORD FORMULA_0010 0 0 0.0 65535.0000 ECU_ADDRESS 0x3FA722 /end MEASUREMENT
/begin MEASUREMENT ed_fsp_20of20_.ff_p_code_nv "P-Code des Freeze Frame" UWORD FORMULA_0010 0 0 0.0 65535.0000 ECU_ADDRESS 0x3FA774 /end MEASUREMENT
/begin MEASUREMENT ed_fsp_1of20_.ff_n_nv "Drehzahl des Freeze Frame" UWORD FORMULA_0052 0 0 0.0 16383.7500 ECU_ADDRESS 0x3FA160 /end MEASUREMENT
/begin MEASUREMENT ed_fsp_2of20_.ff_n_nv "Drehzahl des Freeze Frame" UWORD FORMULA_0052 0 0 0.0 16383.7500 ECU_ADDRESS 0x3FA1B2 /end MEASUREMENT
/begin MEASUREMENT ed_fsp_3of20_.ff_n_nv "Drehzahl des Freeze Frame" UWORD FORMULA_0052 0 0 0.0 16383.7500 ECU_ADDRESS 0x3FA204 /end MEASUREMENT
/begin MEASUREMENT ed_fsp_4of20_.ff_n_nv "Drehzahl des Freeze Frame" UWORD FORMULA_0052 0 0 0.0 16383.7500 ECU_ADDRESS 0x3FA256 /end MEASUREMENT
/begin MEASUREMENT ed_fsp_5of20_.ff_n_nv "Drehzahl des Freeze Frame" UWORD FORMULA_0052 0 0 0.0 16383.7500 ECU_ADDRESS 0x3FA2A8 /end MEASUREMENT
/begin MEASUREMENT ed_fsp_6of20_.ff_n_nv "Drehzahl des Freeze Frame" UWORD FORMULA_0052 0 0 0.0 16383.7500 ECU_ADDRESS 0x3FA2FA /end MEASUREMENT
/begin MEASUREMENT ed_fsp_7of20_.ff_n_nv "Drehzahl des Freeze Frame" UWORD FORMULA_0052 0 0 0.0 16383.7500 ECU_ADDRESS 0x3FA34C /end MEASUREMENT
/begin MEASUREMENT ed_fsp_8of20_.ff_n_nv "Drehzahl des Freeze Frame" UWORD FORMULA_0052 0 0 0.0 16383.7500 ECU_ADDRESS 0x3FA39E /end MEASUREMENT
/begin MEASUREMENT ed_fsp_9of20_.ff_n_nv "Drehzahl des Freeze Frame" UWORD FORMULA_0052 0 0 0.0 16383.7500 ECU_ADDRESS 0x3FA3F0 /end MEASUREMENT
/begin MEASUREMENT ed_fsp_15of20_.ff_n_nv "Drehzahl des Freeze Frame" UWORD FORMULA_0052 0 0 0.0 16383.7500 ECU_ADDRESS 0x3FA5DC /end MEASUREMENT
/begin MEASUREMENT ed_fsp_16of20_.ff_n_nv "Drehzahl des Freeze Frame" UWORD FORMULA_0052 0 0 0.0 16383.7500 ECU_ADDRESS 0x3FA62E /end MEASUREMENT
/begin MEASUREMENT ed_fsp_17of20_.ff_n_nv "Drehzahl des Freeze Frame" UWORD FORMULA_0052 0 0 0.0 16383.7500 ECU_ADDRESS 0x3FA680 /end MEASUREMENT
/begin MEASUREMENT ed_fsp_18of20_.ff_n_nv "Drehzahl des Freeze Frame" UWORD FORMULA_0052 0 0 0.0 16383.7500 ECU_ADDRESS 0x3FA6D2 /end MEASUREMENT
/begin MEASUREMENT ed_fsp_19of20_.ff_n_nv "Drehzahl des Freeze Frame" UWORD FORMULA_0052 0 0 0.0 16383.7500 ECU_ADDRESS 0x3FA724 /end MEASUREMENT
/begin MEASUREMENT ed_fsp_20of20_.ff_n_nv "Drehzahl des Freeze Frame" UWORD FORMULA_0052 0 0 0.0 16383.7500 ECU_ADDRESS 0x3FA776 /end MEASUREMENT
/begin MEASUREMENT ed_fsp_1of20_.ff_ml_b1_nv "Luftmasse des Freeze Frame" UWORD FORMULA_0053 0 0 0.0 655.3500 ECU_ADDRESS 0x3FA162 /end MEASUREMENT
/begin MEASUREMENT ed_fsp_2of20_.ff_ml_b1_nv "Luftmasse des Freeze Frame" UWORD FORMULA_0053 0 0 0.0 655.3500 ECU_ADDRESS 0x3FA1B4 /end MEASUREMENT
/begin MEASUREMENT ed_fsp_3of20_.ff_ml_b1_nv "Luftmasse des Freeze Frame" UWORD FORMULA_0053 0 0 0.0 655.3500 ECU_ADDRESS 0x3FA206 /end MEASUREMENT
/begin MEASUREMENT ed_fsp_4of20_.ff_ml_b1_nv "Luftmasse des Freeze Frame" UWORD FORMULA_0053 0 0 0.0 655.3500 ECU_ADDRESS 0x3FA258 /end MEASUREMENT
/begin MEASUREMENT ed_fsp_5of20_.ff_ml_b1_nv "Luftmasse des Freeze Frame" UWORD FORMULA_0053 0 0 0.0 655.3500 ECU_ADDRESS 0x3FA2AA /end MEASUREMENT
/begin MEASUREMENT ed_fsp_6of20_.ff_ml_b1_nv "Luftmasse des Freeze Frame" UWORD FORMULA_0053 0 0 0.0 655.3500 ECU_ADDRESS 0x3FA2FC /end MEASUREMENT
/begin MEASUREMENT ed_fsp_7of20_.ff_ml_b1_nv "Luftmasse des Freeze Frame" UWORD FORMULA_0053 0 0 0.0 655.3500 ECU_ADDRESS 0x3FA34E /end MEASUREMENT
/begin MEASUREMENT ed_fsp_8of20_.ff_ml_b1_nv "Luftmasse des Freeze Frame" UWORD FORMULA_0053 0 0 0.0 655.3500 ECU_ADDRESS 0x3FA3A0 /end MEASUREMENT
/begin MEASUREMENT ed_fsp_9of20_.ff_ml_b1_nv "Luftmasse des Freeze Frame" UWORD FORMULA_0053 0 0 0.0 655.3500 ECU_ADDRESS 0x3FA3F2 /end MEASUREMENT
/begin MEASUREMENT ed_fsp_15of20_.ff_ml_b1_nv "Luftmasse des Freeze Frame" UWORD FORMULA_0053 0 0 0.0 655.3500 ECU_ADDRESS 0x3FA5DE /end MEASUREMENT
/begin MEASUREMENT ed_fsp_16of20_.ff_ml_b1_nv "Luftmasse des Freeze Frame" UWORD FORMULA_0053 0 0 0.0 655.3500 ECU_ADDRESS 0x3FA630 /end MEASUREMENT
/begin MEASUREMENT ed_fsp_17of20_.ff_ml_b1_nv "Luftmasse des Freeze Frame" UWORD FORMULA_0053 0 0 0.0 655.3500 ECU_ADDRESS 0x3FA682 /end MEASUREMENT
/begin MEASUREMENT ed_fsp_18of20_.ff_ml_b1_nv "Luftmasse des Freeze Frame" UWORD FORMULA_0053 0 0 0.0 655.3500 ECU_ADDRESS 0x3FA6D4 /end MEASUREMENT
/begin MEASUREMENT ed_fsp_19of20_.ff_ml_b1_nv "Luftmasse des Freeze Frame" UWORD FORMULA_0053 0 0 0.0 655.3500 ECU_ADDRESS 0x3FA726 /end MEASUREMENT
/begin MEASUREMENT ed_fsp_20of20_.ff_ml_b1_nv "Luftmasse des Freeze Frame" UWORD FORMULA_0053 0 0 0.0 655.3500 ECU_ADDRESS 0x3FA778 /end MEASUREMENT
/begin MEASUREMENT ed_fsp_1of20_.ff_lam_reg_b1_nv "Einspritzsystem des Freeze Frame" UBYTE FORMULA_0054 0 0 0.0 255.0 ECU_ADDRESS 0x3FA164 /end MEASUREMENT
/begin MEASUREMENT ed_fsp_2of20_.ff_lam_reg_b1_nv "Einspritzsystem des Freeze Frame" UBYTE FORMULA_0054 0 0 0.0 255.0 ECU_ADDRESS 0x3FA1B6 /end MEASUREMENT
/begin MEASUREMENT ed_fsp_3of20_.ff_lam_reg_b1_nv "Einspritzsystem des Freeze Frame" UBYTE FORMULA_0054 0 0 0.0 255.0 ECU_ADDRESS 0x3FA208 /end MEASUREMENT
/begin MEASUREMENT ed_fsp_4of20_.ff_lam_reg_b1_nv "Einspritzsystem des Freeze Frame" UBYTE FORMULA_0054 0 0 0.0 255.0 ECU_ADDRESS 0x3FA25A /end MEASUREMENT
/begin MEASUREMENT ed_fsp_5of20_.ff_lam_reg_b1_nv "Einspritzsystem des Freeze Frame" UBYTE FORMULA_0054 0 0 0.0 255.0 ECU_ADDRESS 0x3FA2AC /end MEASUREMENT
/begin MEASUREMENT ed_fsp_6of20_.ff_lam_reg_b1_nv "Einspritzsystem des Freeze Frame" UBYTE FORMULA_0054 0 0 0.0 255.0 ECU_ADDRESS 0x3FA2FE /end MEASUREMENT
/begin MEASUREMENT ed_fsp_7of20_.ff_lam_reg_b1_nv "Einspritzsystem des Freeze Frame" UBYTE FORMULA_0054 0 0 0.0 255.0 ECU_ADDRESS 0x3FA350 /end MEASUREMENT
/begin MEASUREMENT ed_fsp_8of20_.ff_lam_reg_b1_nv "Einspritzsystem des Freeze Frame" UBYTE FORMULA_0054 0 0 0.0 255.0 ECU_ADDRESS 0x3FA3A2 /end MEASUREMENT
/begin MEASUREMENT ed_fsp_9of20_.ff_lam_reg_b1_nv "Einspritzsystem des Freeze Frame" UBYTE FORMULA_0054 0 0 0.0 255.0 ECU_ADDRESS 0x3FA3F4 /end MEASUREMENT
/begin MEASUREMENT ed_fsp_15of20_.ff_lam_reg_b1_nv "Einspritzsystem des Freeze Frame" UBYTE FORMULA_0054 0 0 0.0 255.0 ECU_ADDRESS 0x3FA5E0 /end MEASUREMENT
/begin MEASUREMENT ed_fsp_16of20_.ff_lam_reg_b1_nv "Einspritzsystem des Freeze Frame" UBYTE FORMULA_0054 0 0 0.0 255.0 ECU_ADDRESS 0x3FA632 /end MEASUREMENT
/begin MEASUREMENT ed_fsp_17of20_.ff_lam_reg_b1_nv "Einspritzsystem des Freeze Frame" UBYTE FORMULA_0054 0 0 0.0 255.0 ECU_ADDRESS 0x3FA684 /end MEASUREMENT
/begin MEASUREMENT ed_fsp_18of20_.ff_lam_reg_b1_nv "Einspritzsystem des Freeze Frame" UBYTE FORMULA_0054 0 0 0.0 255.0 ECU_ADDRESS 0x3FA6D6 /end MEASUREMENT
/begin MEASUREMENT ed_fsp_19of20_.ff_lam_reg_b1_nv "Einspritzsystem des Freeze Frame" UBYTE FORMULA_0054 0 0 0.0 255.0 ECU_ADDRESS 0x3FA728 /end MEASUREMENT
/begin MEASUREMENT ed_fsp_20of20_.ff_lam_reg_b1_nv "Einspritzsystem des Freeze Frame" UBYTE FORMULA_0054 0 0 0.0 255.0 ECU_ADDRESS 0x3FA77A /end MEASUREMENT
/begin MEASUREMENT ed_fsp_1of20_.ff_lam_reg_b2_nv "Einspritzsystem des Freeze Frame" UBYTE FORMULA_0054 0 0 0.0 255.0 ECU_ADDRESS 0x3FA165 /end MEASUREMENT
/begin MEASUREMENT ed_fsp_2of20_.ff_lam_reg_b2_nv "Einspritzsystem des Freeze Frame" UBYTE FORMULA_0054 0 0 0.0 255.0 ECU_ADDRESS 0x3FA1B7 /end MEASUREMENT
/begin MEASUREMENT ed_fsp_3of20_.ff_lam_reg_b2_nv "Einspritzsystem des Freeze Frame" UBYTE FORMULA_0054 0 0 0.0 255.0 ECU_ADDRESS 0x3FA209 /end MEASUREMENT
/begin MEASUREMENT ed_fsp_4of20_.ff_lam_reg_b2_nv "Einspritzsystem des Freeze Frame" UBYTE FORMULA_0054 0 0 0.0 255.0 ECU_ADDRESS 0x3FA25B /end MEASUREMENT
/begin MEASUREMENT ed_fsp_5of20_.ff_lam_reg_b2_nv "Einspritzsystem des Freeze Frame" UBYTE FORMULA_0054 0 0 0.0 255.0 ECU_ADDRESS 0x3FA2AD /end MEASUREMENT
/begin MEASUREMENT ed_fsp_6of20_.ff_lam_reg_b2_nv "Einspritzsystem des Freeze Frame" UBYTE FORMULA_0054 0 0 0.0 255.0 ECU_ADDRESS 0x3FA2FF /end MEASUREMENT
/begin MEASUREMENT ed_fsp_7of20_.ff_lam_reg_b2_nv "Einspritzsystem des Freeze Frame" UBYTE FORMULA_0054 0 0 0.0 255.0 ECU_ADDRESS 0x3FA351 /end MEASUREMENT
/begin MEASUREMENT ed_fsp_8of20_.ff_lam_reg_b2_nv "Einspritzsystem des Freeze Frame" UBYTE FORMULA_0054 0 0 0.0 255.0 ECU_ADDRESS 0x3FA3A3 /end MEASUREMENT
/begin MEASUREMENT ed_fsp_9of20_.ff_lam_reg_b2_nv "Einspritzsystem des Freeze Frame" UBYTE FORMULA_0054 0 0 0.0 255.0 ECU_ADDRESS 0x3FA3F5 /end MEASUREMENT
/begin MEASUREMENT ed_fsp_15of20_.ff_lam_reg_b2_nv "Einspritzsystem des Freeze Frame" UBYTE FORMULA_0054 0 0 0.0 255.0 ECU_ADDRESS 0x3FA5E1 /end MEASUREMENT
/begin MEASUREMENT ed_fsp_16of20_.ff_lam_reg_b2_nv "Einspritzsystem des Freeze Frame" UBYTE FORMULA_0054 0 0 0.0 255.0 ECU_ADDRESS 0x3FA633 /end MEASUREMENT
/begin MEASUREMENT ed_fsp_17of20_.ff_lam_reg_b2_nv "Einspritzsystem des Freeze Frame" UBYTE FORMULA_0054 0 0 0.0 255.0 ECU_ADDRESS 0x3FA685 /end MEASUREMENT
/begin MEASUREMENT ed_fsp_18of20_.ff_lam_reg_b2_nv "Einspritzsystem des Freeze Frame" UBYTE FORMULA_0054 0 0 0.0 255.0 ECU_ADDRESS 0x3FA6D7 /end MEASUREMENT
/begin MEASUREMENT ed_fsp_19of20_.ff_lam_reg_b2_nv "Einspritzsystem des Freeze Frame" UBYTE FORMULA_0054 0 0 0.0 255.0 ECU_ADDRESS 0x3FA729 /end MEASUREMENT
/begin MEASUREMENT ed_fsp_20of20_.ff_lam_reg_b2_nv "Einspritzsystem des Freeze Frame" UBYTE FORMULA_0054 0 0 0.0 255.0 ECU_ADDRESS 0x3FA77B /end MEASUREMENT
/begin MEASUREMENT ed_fsp_1of20_.ff_lam_reg_f_b1_nv "Lambdaregelfaktor des Freeze Frame" UBYTE FORMULA_0055 0 0 0.0 1.9921 ECU_ADDRESS 0x3FA166 /end MEASUREMENT
/begin MEASUREMENT ed_fsp_2of20_.ff_lam_reg_f_b1_nv "Lambdaregelfaktor des Freeze Frame" UBYTE FORMULA_0055 0 0 0.0 1.9921 ECU_ADDRESS 0x3FA1B8 /end MEASUREMENT
/begin MEASUREMENT ed_fsp_3of20_.ff_lam_reg_f_b1_nv "Lambdaregelfaktor des Freeze Frame" UBYTE FORMULA_0055 0 0 0.0 1.9921 ECU_ADDRESS 0x3FA20A /end MEASUREMENT
/begin MEASUREMENT ed_fsp_4of20_.ff_lam_reg_f_b1_nv "Lambdaregelfaktor des Freeze Frame" UBYTE FORMULA_0055 0 0 0.0 1.9921 ECU_ADDRESS 0x3FA25C /end MEASUREMENT
/begin MEASUREMENT ed_fsp_5of20_.ff_lam_reg_f_b1_nv "Lambdaregelfaktor des Freeze Frame" UBYTE FORMULA_0055 0 0 0.0 1.9921 ECU_ADDRESS 0x3FA2AE /end MEASUREMENT
/begin MEASUREMENT ed_fsp_6of20_.ff_lam_reg_f_b1_nv "Lambdaregelfaktor des Freeze Frame" UBYTE FORMULA_0055 0 0 0.0 1.9921 ECU_ADDRESS 0x3FA300 /end MEASUREMENT
/begin MEASUREMENT ed_fsp_7of20_.ff_lam_reg_f_b1_nv "Lambdaregelfaktor des Freeze Frame" UBYTE FORMULA_0055 0 0 0.0 1.9921 ECU_ADDRESS 0x3FA352 /end MEASUREMENT
/begin MEASUREMENT ed_fsp_8of20_.ff_lam_reg_f_b1_nv "Lambdaregelfaktor des Freeze Frame" UBYTE FORMULA_0055 0 0 0.0 1.9921 ECU_ADDRESS 0x3FA3A4 /end MEASUREMENT
/begin MEASUREMENT ed_fsp_9of20_.ff_lam_reg_f_b1_nv "Lambdaregelfaktor des Freeze Frame" UBYTE FORMULA_0055 0 0 0.0 1.9921 ECU_ADDRESS 0x3FA3F6 /end MEASUREMENT
/begin MEASUREMENT ed_fsp_15of20_.ff_lam_reg_f_b1_nv "Lambdaregelfaktor des Freeze Frame" UBYTE FORMULA_0055 0 0 0.0 1.9921 ECU_ADDRESS 0x3FA5E2 /end MEASUREMENT
/begin MEASUREMENT ed_fsp_16of20_.ff_lam_reg_f_b1_nv "Lambdaregelfaktor des Freeze Frame" UBYTE FORMULA_0055 0 0 0.0 1.9921 ECU_ADDRESS 0x3FA634 /end MEASUREMENT
/begin MEASUREMENT ed_fsp_17of20_.ff_lam_reg_f_b1_nv "Lambdaregelfaktor des Freeze Frame" UBYTE FORMULA_0055 0 0 0.0 1.9921 ECU_ADDRESS 0x3FA686 /end MEASUREMENT
/begin MEASUREMENT ed_fsp_18of20_.ff_lam_reg_f_b1_nv "Lambdaregelfaktor des Freeze Frame" UBYTE FORMULA_0055 0 0 0.0 1.9921 ECU_ADDRESS 0x3FA6D8 /end MEASUREMENT
/begin MEASUREMENT ed_fsp_19of20_.ff_lam_reg_f_b1_nv "Lambdaregelfaktor des Freeze Frame" UBYTE FORMULA_0055 0 0 0.0 1.9921 ECU_ADDRESS 0x3FA72A /end MEASUREMENT
/begin MEASUREMENT ed_fsp_20of20_.ff_lam_reg_f_b1_nv "Lambdaregelfaktor des Freeze Frame" UBYTE FORMULA_0055 0 0 0.0 1.9921 ECU_ADDRESS 0x3FA77C /end MEASUREMENT
/begin MEASUREMENT ed_fsp_1of20_.ff_lam_reg_f_b2_nv "Lambdaregelfaktor des Freeze Frame" UBYTE FORMULA_0055 0 0 0.0 1.9921 ECU_ADDRESS 0x3FA167 /end MEASUREMENT
/begin MEASUREMENT ed_fsp_2of20_.ff_lam_reg_f_b2_nv "Lambdaregelfaktor des Freeze Frame" UBYTE FORMULA_0055 0 0 0.0 1.9921 ECU_ADDRESS 0x3FA1B9 /end MEASUREMENT
/begin MEASUREMENT ed_fsp_3of20_.ff_lam_reg_f_b2_nv "Lambdaregelfaktor des Freeze Frame" UBYTE FORMULA_0055 0 0 0.0 1.9921 ECU_ADDRESS 0x3FA20B /end MEASUREMENT
/begin MEASUREMENT ed_fsp_4of20_.ff_lam_reg_f_b2_nv "Lambdaregelfaktor des Freeze Frame" UBYTE FORMULA_0055 0 0 0.0 1.9921 ECU_ADDRESS 0x3FA25D /end MEASUREMENT
/begin MEASUREMENT ed_fsp_5of20_.ff_lam_reg_f_b2_nv "Lambdaregelfaktor des Freeze Frame" UBYTE FORMULA_0055 0 0 0.0 1.9921 ECU_ADDRESS 0x3FA2AF /end MEASUREMENT
/begin MEASUREMENT ed_fsp_6of20_.ff_lam_reg_f_b2_nv "Lambdaregelfaktor des Freeze Frame" UBYTE FORMULA_0055 0 0 0.0 1.9921 ECU_ADDRESS 0x3FA301 /end MEASUREMENT
/begin MEASUREMENT ed_fsp_7of20_.ff_lam_reg_f_b2_nv "Lambdaregelfaktor des Freeze Frame" UBYTE FORMULA_0055 0 0 0.0 1.9921 ECU_ADDRESS 0x3FA353 /end MEASUREMENT
/begin MEASUREMENT ed_fsp_8of20_.ff_lam_reg_f_b2_nv "Lambdaregelfaktor des Freeze Frame" UBYTE FORMULA_0055 0 0 0.0 1.9921 ECU_ADDRESS 0x3FA3A5 /end MEASUREMENT
/begin MEASUREMENT ed_fsp_9of20_.ff_lam_reg_f_b2_nv "Lambdaregelfaktor des Freeze Frame" UBYTE FORMULA_0055 0 0 0.0 1.9921 ECU_ADDRESS 0x3FA3F7 /end MEASUREMENT
/begin MEASUREMENT ed_fsp_15of20_.ff_lam_reg_f_b2_nv "Lambdaregelfaktor des Freeze Frame" UBYTE FORMULA_0055 0 0 0.0 1.9921 ECU_ADDRESS 0x3FA5E3 /end MEASUREMENT
/begin MEASUREMENT ed_fsp_16of20_.ff_lam_reg_f_b2_nv "Lambdaregelfaktor des Freeze Frame" UBYTE FORMULA_0055 0 0 0.0 1.9921 ECU_ADDRESS 0x3FA635 /end MEASUREMENT
/begin MEASUREMENT ed_fsp_17of20_.ff_lam_reg_f_b2_nv "Lambdaregelfaktor des Freeze Frame" UBYTE FORMULA_0055 0 0 0.0 1.9921 ECU_ADDRESS 0x3FA687 /end MEASUREMENT
/begin MEASUREMENT ed_fsp_18of20_.ff_lam_reg_f_b2_nv "Lambdaregelfaktor des Freeze Frame" UBYTE FORMULA_0055 0 0 0.0 1.9921 ECU_ADDRESS 0x3FA6D9 /end MEASUREMENT
/begin MEASUREMENT ed_fsp_19of20_.ff_lam_reg_f_b2_nv "Lambdaregelfaktor des Freeze Frame" UBYTE FORMULA_0055 0 0 0.0 1.9921 ECU_ADDRESS 0x3FA72B /end MEASUREMENT
/begin MEASUREMENT ed_fsp_20of20_.ff_lam_reg_f_b2_nv "Lambdaregelfaktor des Freeze Frame" UBYTE FORMULA_0055 0 0 0.0 1.9921 ECU_ADDRESS 0x3FA77D /end MEASUREMENT
/begin MEASUREMENT ed_fsp_1of20_.ff_laa_f_ber_b1_nv "Lambdaadaptionsfaktor ohne TE des Freeze Frame" UBYTE FORMULA_0055 0 0 0.0 1.9921 ECU_ADDRESS 0x3FA168 /end MEASUREMENT
/begin MEASUREMENT ed_fsp_2of20_.ff_laa_f_ber_b1_nv "Lambdaadaptionsfaktor ohne TE des Freeze Frame" UBYTE FORMULA_0055 0 0 0.0 1.9921 ECU_ADDRESS 0x3FA1BA /end MEASUREMENT
/begin MEASUREMENT ed_fsp_3of20_.ff_laa_f_ber_b1_nv "Lambdaadaptionsfaktor ohne TE des Freeze Frame" UBYTE FORMULA_0055 0 0 0.0 1.9921 ECU_ADDRESS 0x3FA20C /end MEASUREMENT
/begin MEASUREMENT ed_fsp_4of20_.ff_laa_f_ber_b1_nv "Lambdaadaptionsfaktor ohne TE des Freeze Frame" UBYTE FORMULA_0055 0 0 0.0 1.9921 ECU_ADDRESS 0x3FA25E /end MEASUREMENT
/begin MEASUREMENT ed_fsp_5of20_.ff_laa_f_ber_b1_nv "Lambdaadaptionsfaktor ohne TE des Freeze Frame" UBYTE FORMULA_0055 0 0 0.0 1.9921 ECU_ADDRESS 0x3FA2B0 /end MEASUREMENT
/begin MEASUREMENT ed_fsp_6of20_.ff_laa_f_ber_b1_nv "Lambdaadaptionsfaktor ohne TE des Freeze Frame" UBYTE FORMULA_0055 0 0 0.0 1.9921 ECU_ADDRESS 0x3FA302 /end MEASUREMENT
/begin MEASUREMENT ed_fsp_7of20_.ff_laa_f_ber_b1_nv "Lambdaadaptionsfaktor ohne TE des Freeze Frame" UBYTE FORMULA_0055 0 0 0.0 1.9921 ECU_ADDRESS 0x3FA354 /end MEASUREMENT
/begin MEASUREMENT ed_fsp_8of20_.ff_laa_f_ber_b1_nv "Lambdaadaptionsfaktor ohne TE des Freeze Frame" UBYTE FORMULA_0055 0 0 0.0 1.9921 ECU_ADDRESS 0x3FA3A6 /end MEASUREMENT
/begin MEASUREMENT ed_fsp_9of20_.ff_laa_f_ber_b1_nv "Lambdaadaptionsfaktor ohne TE des Freeze Frame" UBYTE FORMULA_0055 0 0 0.0 1.9921 ECU_ADDRESS 0x3FA3F8 /end MEASUREMENT
/begin MEASUREMENT ed_fsp_15of20_.ff_laa_f_ber_b1_nv "Lambdaadaptionsfaktor ohne TE des Freeze Frame" UBYTE FORMULA_0055 0 0 0.0 1.9921 ECU_ADDRESS 0x3FA5E4 /end MEASUREMENT
/begin MEASUREMENT ed_fsp_16of20_.ff_laa_f_ber_b1_nv "Lambdaadaptionsfaktor ohne TE des Freeze Frame" UBYTE FORMULA_0055 0 0 0.0 1.9921 ECU_ADDRESS 0x3FA636 /end MEASUREMENT
/begin MEASUREMENT ed_fsp_17of20_.ff_laa_f_ber_b1_nv "Lambdaadaptionsfaktor ohne TE des Freeze Frame" UBYTE FORMULA_0055 0 0 0.0 1.9921 ECU_ADDRESS 0x3FA688 /end MEASUREMENT
/begin MEASUREMENT ed_fsp_18of20_.ff_laa_f_ber_b1_nv "Lambdaadaptionsfaktor ohne TE des Freeze Frame" UBYTE FORMULA_0055 0 0 0.0 1.9921 ECU_ADDRESS 0x3FA6DA /end MEASUREMENT
/begin MEASUREMENT ed_fsp_19of20_.ff_laa_f_ber_b1_nv "Lambdaadaptionsfaktor ohne TE des Freeze Frame" UBYTE FORMULA_0055 0 0 0.0 1.9921 ECU_ADDRESS 0x3FA72C /end MEASUREMENT
/begin MEASUREMENT ed_fsp_20of20_.ff_laa_f_ber_b1_nv "Lambdaadaptionsfaktor ohne TE des Freeze Frame" UBYTE FORMULA_0055 0 0 0.0 1.9921 ECU_ADDRESS 0x3FA77E /end MEASUREMENT
/begin MEASUREMENT ed_fsp_1of20_.ff_laa_f_ber_b2_nv "Lambdaadaptionsfaktor ohne TE des Freeze Frame" UBYTE FORMULA_0055 0 0 0.0 1.9921 ECU_ADDRESS 0x3FA169 /end MEASUREMENT
/begin MEASUREMENT ed_fsp_2of20_.ff_laa_f_ber_b2_nv "Lambdaadaptionsfaktor ohne TE des Freeze Frame" UBYTE FORMULA_0055 0 0 0.0 1.9921 ECU_ADDRESS 0x3FA1BB /end MEASUREMENT
/begin MEASUREMENT ed_fsp_3of20_.ff_laa_f_ber_b2_nv "Lambdaadaptionsfaktor ohne TE des Freeze Frame" UBYTE FORMULA_0055 0 0 0.0 1.9921 ECU_ADDRESS 0x3FA20D /end MEASUREMENT
/begin MEASUREMENT ed_fsp_4of20_.ff_laa_f_ber_b2_nv "Lambdaadaptionsfaktor ohne TE des Freeze Frame" UBYTE FORMULA_0055 0 0 0.0 1.9921 ECU_ADDRESS 0x3FA25F /end MEASUREMENT
/begin MEASUREMENT ed_fsp_5of20_.ff_laa_f_ber_b2_nv "Lambdaadaptionsfaktor ohne TE des Freeze Frame" UBYTE FORMULA_0055 0 0 0.0 1.9921 ECU_ADDRESS 0x3FA2B1 /end MEASUREMENT
/begin MEASUREMENT ed_fsp_6of20_.ff_laa_f_ber_b2_nv "Lambdaadaptionsfaktor ohne TE des Freeze Frame" UBYTE FORMULA_0055 0 0 0.0 1.9921 ECU_ADDRESS 0x3FA303 /end MEASUREMENT
/begin MEASUREMENT ed_fsp_7of20_.ff_laa_f_ber_b2_nv "Lambdaadaptionsfaktor ohne TE des Freeze Frame" UBYTE FORMULA_0055 0 0 0.0 1.9921 ECU_ADDRESS 0x3FA355 /end MEASUREMENT
/begin MEASUREMENT ed_fsp_8of20_.ff_laa_f_ber_b2_nv "Lambdaadaptionsfaktor ohne TE des Freeze Frame" UBYTE FORMULA_0055 0 0 0.0 1.9921 ECU_ADDRESS 0x3FA3A7 /end MEASUREMENT
/begin MEASUREMENT ed_fsp_9of20_.ff_laa_f_ber_b2_nv "Lambdaadaptionsfaktor ohne TE des Freeze Frame" UBYTE FORMULA_0055 0 0 0.0 1.9921 ECU_ADDRESS 0x3FA3F9 /end MEASUREMENT
/begin MEASUREMENT ed_fsp_15of20_.ff_laa_f_ber_b2_nv "Lambdaadaptionsfaktor ohne TE des Freeze Frame" UBYTE FORMULA_0055 0 0 0.0 1.9921 ECU_ADDRESS 0x3FA5E5 /end MEASUREMENT
/begin MEASUREMENT ed_fsp_16of20_.ff_laa_f_ber_b2_nv "Lambdaadaptionsfaktor ohne TE des Freeze Frame" UBYTE FORMULA_0055 0 0 0.0 1.9921 ECU_ADDRESS 0x3FA637 /end MEASUREMENT
/begin MEASUREMENT ed_fsp_17of20_.ff_laa_f_ber_b2_nv "Lambdaadaptionsfaktor ohne TE des Freeze Frame" UBYTE FORMULA_0055 0 0 0.0 1.9921 ECU_ADDRESS 0x3FA689 /end MEASUREMENT
/begin MEASUREMENT ed_fsp_18of20_.ff_laa_f_ber_b2_nv "Lambdaadaptionsfaktor ohne TE des Freeze Frame" UBYTE FORMULA_0055 0 0 0.0 1.9921 ECU_ADDRESS 0x3FA6DB /end MEASUREMENT
/begin MEASUREMENT ed_fsp_19of20_.ff_laa_f_ber_b2_nv "Lambdaadaptionsfaktor ohne TE des Freeze Frame" UBYTE FORMULA_0055 0 0 0.0 1.9921 ECU_ADDRESS 0x3FA72D /end MEASUREMENT
/begin MEASUREMENT ed_fsp_20of20_.ff_laa_f_ber_b2_nv "Lambdaadaptionsfaktor ohne TE des Freeze Frame" UBYTE FORMULA_0055 0 0 0.0 1.9921 ECU_ADDRESS 0x3FA77F /end MEASUREMENT
/begin MEASUREMENT ed_fsp_1of20_.ff_rf_b1_berech_nv "Berechnete_Last des Freeze Frame" UBYTE FORMULA_0056 0 0 0.0 100.0000 ECU_ADDRESS 0x3FA16A /end MEASUREMENT
/begin MEASUREMENT ed_fsp_2of20_.ff_rf_b1_berech_nv "Berechnete_Last des Freeze Frame" UBYTE FORMULA_0056 0 0 0.0 100.0000 ECU_ADDRESS 0x3FA1BC /end MEASUREMENT
/begin MEASUREMENT ed_fsp_3of20_.ff_rf_b1_berech_nv "Berechnete_Last des Freeze Frame" UBYTE FORMULA_0056 0 0 0.0 100.0000 ECU_ADDRESS 0x3FA20E /end MEASUREMENT
/begin MEASUREMENT ed_fsp_4of20_.ff_rf_b1_berech_nv "Berechnete_Last des Freeze Frame" UBYTE FORMULA_0056 0 0 0.0 100.0000 ECU_ADDRESS 0x3FA260 /end MEASUREMENT
/begin MEASUREMENT ed_fsp_5of20_.ff_rf_b1_berech_nv "Berechnete_Last des Freeze Frame" UBYTE FORMULA_0056 0 0 0.0 100.0000 ECU_ADDRESS 0x3FA2B2 /end MEASUREMENT
/begin MEASUREMENT ed_fsp_6of20_.ff_rf_b1_berech_nv "Berechnete_Last des Freeze Frame" UBYTE FORMULA_0056 0 0 0.0 100.0000 ECU_ADDRESS 0x3FA304 /end MEASUREMENT
/begin MEASUREMENT ed_fsp_7of20_.ff_rf_b1_berech_nv "Berechnete_Last des Freeze Frame" UBYTE FORMULA_0056 0 0 0.0 100.0000 ECU_ADDRESS 0x3FA356 /end MEASUREMENT
/begin MEASUREMENT ed_fsp_8of20_.ff_rf_b1_berech_nv "Berechnete_Last des Freeze Frame" UBYTE FORMULA_0056 0 0 0.0 100.0000 ECU_ADDRESS 0x3FA3A8 /end MEASUREMENT
/begin MEASUREMENT ed_fsp_9of20_.ff_rf_b1_berech_nv "Berechnete_Last des Freeze Frame" UBYTE FORMULA_0056 0 0 0.0 100.0000 ECU_ADDRESS 0x3FA3FA /end MEASUREMENT
/begin MEASUREMENT ed_fsp_14of20_.ff_rf_b1_berech_nv "Berechnete_Last des Freeze Frame" UBYTE FORMULA_0056 0 0 0.0 100.0000 ECU_ADDRESS 0x3FA594 /end MEASUREMENT
/begin MEASUREMENT ed_fsp_15of20_.ff_rf_b1_berech_nv "Berechnete_Last des Freeze Frame" UBYTE FORMULA_0056 0 0 0.0 100.0000 ECU_ADDRESS 0x3FA5E6 /end MEASUREMENT
/begin MEASUREMENT ed_fsp_16of20_.ff_rf_b1_berech_nv "Berechnete_Last des Freeze Frame" UBYTE FORMULA_0056 0 0 0.0 100.0000 ECU_ADDRESS 0x3FA638 /end MEASUREMENT
/begin MEASUREMENT ed_fsp_17of20_.ff_rf_b1_berech_nv "Berechnete_Last des Freeze Frame" UBYTE FORMULA_0056 0 0 0.0 100.0000 ECU_ADDRESS 0x3FA68A /end MEASUREMENT
/begin MEASUREMENT ed_fsp_18of20_.ff_rf_b1_berech_nv "Berechnete_Last des Freeze Frame" UBYTE FORMULA_0056 0 0 0.0 100.0000 ECU_ADDRESS 0x3FA6DC /end MEASUREMENT
/begin MEASUREMENT ed_fsp_19of20_.ff_rf_b1_berech_nv "Berechnete_Last des Freeze Frame" UBYTE FORMULA_0056 0 0 0.0 100.0000 ECU_ADDRESS 0x3FA72E /end MEASUREMENT
/begin MEASUREMENT ed_fsp_20of20_.ff_rf_b1_berech_nv "Berechnete_Last des Freeze Frame" UBYTE FORMULA_0056 0 0 0.0 100.0000 ECU_ADDRESS 0x3FA780 /end MEASUREMENT
/begin MEASUREMENT ed_fsp_1of20_.ff_tmot_nv "Kuehlwassertemperatur des Freeze Frame" UBYTE FORMULA_0057 0 0 -40.0000 215.0000 ECU_ADDRESS 0x3FA16B /end MEASUREMENT
/begin MEASUREMENT ed_fsp_2of20_.ff_tmot_nv "Kuehlwassertemperatur des Freeze Frame" UBYTE FORMULA_0057 0 0 -40.0000 215.0000 ECU_ADDRESS 0x3FA1BD /end MEASUREMENT
/begin MEASUREMENT ed_fsp_3of20_.ff_tmot_nv "Kuehlwassertemperatur des Freeze Frame" UBYTE FORMULA_0057 0 0 -40.0000 215.0000 ECU_ADDRESS 0x3FA20F /end MEASUREMENT
/begin MEASUREMENT ed_fsp_4of20_.ff_tmot_nv "Kuehlwassertemperatur des Freeze Frame" UBYTE FORMULA_0057 0 0 -40.0000 215.0000 ECU_ADDRESS 0x3FA261 /end MEASUREMENT
/begin MEASUREMENT ed_fsp_5of20_.ff_tmot_nv "Kuehlwassertemperatur des Freeze Frame" UBYTE FORMULA_0057 0 0 -40.0000 215.0000 ECU_ADDRESS 0x3FA2B3 /end MEASUREMENT
/begin MEASUREMENT ed_fsp_6of20_.ff_tmot_nv "Kuehlwassertemperatur des Freeze Frame" UBYTE FORMULA_0057 0 0 -40.0000 215.0000 ECU_ADDRESS 0x3FA305 /end MEASUREMENT
/begin MEASUREMENT ed_fsp_7of20_.ff_tmot_nv "Kuehlwassertemperatur des Freeze Frame" UBYTE FORMULA_0057 0 0 -40.0000 215.0000 ECU_ADDRESS 0x3FA357 /end MEASUREMENT
/begin MEASUREMENT ed_fsp_8of20_.ff_tmot_nv "Kuehlwassertemperatur des Freeze Frame" UBYTE FORMULA_0057 0 0 -40.0000 215.0000 ECU_ADDRESS 0x3FA3A9 /end MEASUREMENT
/begin MEASUREMENT ed_fsp_9of20_.ff_tmot_nv "Kuehlwassertemperatur des Freeze Frame" UBYTE FORMULA_0057 0 0 -40.0000 215.0000 ECU_ADDRESS 0x3FA3FB /end MEASUREMENT
/begin MEASUREMENT ed_fsp_14of20_.ff_tmot_nv "Kuehlwassertemperatur des Freeze Frame" UBYTE FORMULA_0057 0 0 -40.0000 215.0000 ECU_ADDRESS 0x3FA595 /end MEASUREMENT
/begin MEASUREMENT ed_fsp_15of20_.ff_tmot_nv "Kuehlwassertemperatur des Freeze Frame" UBYTE FORMULA_0057 0 0 -40.0000 215.0000 ECU_ADDRESS 0x3FA5E7 /end MEASUREMENT
/begin MEASUREMENT ed_fsp_16of20_.ff_tmot_nv "Kuehlwassertemperatur des Freeze Frame" UBYTE FORMULA_0057 0 0 -40.0000 215.0000 ECU_ADDRESS 0x3FA639 /end MEASUREMENT
/begin MEASUREMENT ed_fsp_17of20_.ff_tmot_nv "Kuehlwassertemperatur des Freeze Frame" UBYTE FORMULA_0057 0 0 -40.0000 215.0000 ECU_ADDRESS 0x3FA68B /end MEASUREMENT
/begin MEASUREMENT ed_fsp_18of20_.ff_tmot_nv "Kuehlwassertemperatur des Freeze Frame" UBYTE FORMULA_0057 0 0 -40.0000 215.0000 ECU_ADDRESS 0x3FA6DD /end MEASUREMENT
/begin MEASUREMENT ed_fsp_19of20_.ff_tmot_nv "Kuehlwassertemperatur des Freeze Frame" UBYTE FORMULA_0057 0 0 -40.0000 215.0000 ECU_ADDRESS 0x3FA72F /end MEASUREMENT
/begin MEASUREMENT ed_fsp_20of20_.ff_tmot_nv "Kuehlwassertemperatur des Freeze Frame" UBYTE FORMULA_0057 0 0 -40.0000 215.0000 ECU_ADDRESS 0x3FA781 /end MEASUREMENT
/begin MEASUREMENT ed_fsp_1of20_.ff_pks_ist_nv "Kraftstoffdruck des Freeze Frame" UBYTE FORMULA_0058 0 0 0.0 765.0000 ECU_ADDRESS 0x3FA16C /end MEASUREMENT
/begin MEASUREMENT ed_fsp_2of20_.ff_pks_ist_nv "Kraftstoffdruck des Freeze Frame" UBYTE FORMULA_0058 0 0 0.0 765.0000 ECU_ADDRESS 0x3FA1BE /end MEASUREMENT
/begin MEASUREMENT ed_fsp_3of20_.ff_pks_ist_nv "Kraftstoffdruck des Freeze Frame" UBYTE FORMULA_0058 0 0 0.0 765.0000 ECU_ADDRESS 0x3FA210 /end MEASUREMENT
/begin MEASUREMENT ed_fsp_4of20_.ff_pks_ist_nv "Kraftstoffdruck des Freeze Frame" UBYTE FORMULA_0058 0 0 0.0 765.0000 ECU_ADDRESS 0x3FA262 /end MEASUREMENT
/begin MEASUREMENT ed_fsp_5of20_.ff_pks_ist_nv "Kraftstoffdruck des Freeze Frame" UBYTE FORMULA_0058 0 0 0.0 765.0000 ECU_ADDRESS 0x3FA2B4 /end MEASUREMENT
/begin MEASUREMENT ed_fsp_6of20_.ff_pks_ist_nv "Kraftstoffdruck des Freeze Frame" UBYTE FORMULA_0058 0 0 0.0 765.0000 ECU_ADDRESS 0x3FA306 /end MEASUREMENT
/begin MEASUREMENT ed_fsp_7of20_.ff_pks_ist_nv "Kraftstoffdruck des Freeze Frame" UBYTE FORMULA_0058 0 0 0.0 765.0000 ECU_ADDRESS 0x3FA358 /end MEASUREMENT
/begin MEASUREMENT ed_fsp_8of20_.ff_pks_ist_nv "Kraftstoffdruck des Freeze Frame" UBYTE FORMULA_0058 0 0 0.0 765.0000 ECU_ADDRESS 0x3FA3AA /end MEASUREMENT
/begin MEASUREMENT ed_fsp_9of20_.ff_pks_ist_nv "Kraftstoffdruck des Freeze Frame" UBYTE FORMULA_0058 0 0 0.0 765.0000 ECU_ADDRESS 0x3FA3FC /end MEASUREMENT
/begin MEASUREMENT ed_fsp_15of20_.ff_pks_ist_nv "Kraftstoffdruck des Freeze Frame" UBYTE FORMULA_0058 0 0 0.0 765.0000 ECU_ADDRESS 0x3FA5E8 /end MEASUREMENT
/begin MEASUREMENT ed_fsp_16of20_.ff_pks_ist_nv "Kraftstoffdruck des Freeze Frame" UBYTE FORMULA_0058 0 0 0.0 765.0000 ECU_ADDRESS 0x3FA63A /end MEASUREMENT
/begin MEASUREMENT ed_fsp_17of20_.ff_pks_ist_nv "Kraftstoffdruck des Freeze Frame" UBYTE FORMULA_0058 0 0 0.0 765.0000 ECU_ADDRESS 0x3FA68C /end MEASUREMENT
/begin MEASUREMENT ed_fsp_18of20_.ff_pks_ist_nv "Kraftstoffdruck des Freeze Frame" UBYTE FORMULA_0058 0 0 0.0 765.0000 ECU_ADDRESS 0x3FA6DE /end MEASUREMENT
/begin MEASUREMENT ed_fsp_19of20_.ff_pks_ist_nv "Kraftstoffdruck des Freeze Frame" UBYTE FORMULA_0058 0 0 0.0 765.0000 ECU_ADDRESS 0x3FA730 /end MEASUREMENT
/begin MEASUREMENT ed_fsp_20of20_.ff_pks_ist_nv "Kraftstoffdruck des Freeze Frame" UBYTE FORMULA_0058 0 0 0.0 765.0000 ECU_ADDRESS 0x3FA782 /end MEASUREMENT
/begin MEASUREMENT ed_fsp_1of20_.ff_v_vorne_nv "Geschwindigkeit des Freeze Frame" UBYTE FORMULA_0059 0 0 0.0 255.0000 ECU_ADDRESS 0x3FA16D /end MEASUREMENT
/begin MEASUREMENT ed_fsp_2of20_.ff_v_vorne_nv "Geschwindigkeit des Freeze Frame" UBYTE FORMULA_0059 0 0 0.0 255.0000 ECU_ADDRESS 0x3FA1BF /end MEASUREMENT
/begin MEASUREMENT ed_fsp_3of20_.ff_v_vorne_nv "Geschwindigkeit des Freeze Frame" UBYTE FORMULA_0059 0 0 0.0 255.0000 ECU_ADDRESS 0x3FA211 /end MEASUREMENT
/begin MEASUREMENT ed_fsp_4of20_.ff_v_vorne_nv "Geschwindigkeit des Freeze Frame" UBYTE FORMULA_0059 0 0 0.0 255.0000 ECU_ADDRESS 0x3FA263 /end MEASUREMENT
/begin MEASUREMENT ed_fsp_5of20_.ff_v_vorne_nv "Geschwindigkeit des Freeze Frame" UBYTE FORMULA_0059 0 0 0.0 255.0000 ECU_ADDRESS 0x3FA2B5 /end MEASUREMENT
/begin MEASUREMENT ed_fsp_6of20_.ff_v_vorne_nv "Geschwindigkeit des Freeze Frame" UBYTE FORMULA_0059 0 0 0.0 255.0000 ECU_ADDRESS 0x3FA307 /end MEASUREMENT
/begin MEASUREMENT ed_fsp_7of20_.ff_v_vorne_nv "Geschwindigkeit des Freeze Frame" UBYTE FORMULA_0059 0 0 0.0 255.0000 ECU_ADDRESS 0x3FA359 /end MEASUREMENT
/begin MEASUREMENT ed_fsp_8of20_.ff_v_vorne_nv "Geschwindigkeit des Freeze Frame" UBYTE FORMULA_0059 0 0 0.0 255.0000 ECU_ADDRESS 0x3FA3AB /end MEASUREMENT
/begin MEASUREMENT ed_fsp_9of20_.ff_v_vorne_nv "Geschwindigkeit des Freeze Frame" UBYTE FORMULA_0059 0 0 0.0 255.0000 ECU_ADDRESS 0x3FA3FD /end MEASUREMENT
/begin MEASUREMENT ed_fsp_14of20_.ff_v_vorne_nv "Geschwindigkeit des Freeze Frame" UBYTE FORMULA_0059 0 0 0.0 255.0000 ECU_ADDRESS 0x3FA597 /end MEASUREMENT
/begin MEASUREMENT ed_fsp_15of20_.ff_v_vorne_nv "Geschwindigkeit des Freeze Frame" UBYTE FORMULA_0059 0 0 0.0 255.0000 ECU_ADDRESS 0x3FA5E9 /end MEASUREMENT
/begin MEASUREMENT ed_fsp_16of20_.ff_v_vorne_nv "Geschwindigkeit des Freeze Frame" UBYTE FORMULA_0059 0 0 0.0 255.0000 ECU_ADDRESS 0x3FA63B /end MEASUREMENT
/begin MEASUREMENT ed_fsp_17of20_.ff_v_vorne_nv "Geschwindigkeit des Freeze Frame" UBYTE FORMULA_0059 0 0 0.0 255.0000 ECU_ADDRESS 0x3FA68D /end MEASUREMENT
/begin MEASUREMENT ed_fsp_18of20_.ff_v_vorne_nv "Geschwindigkeit des Freeze Frame" UBYTE FORMULA_0059 0 0 0.0 255.0000 ECU_ADDRESS 0x3FA6DF /end MEASUREMENT
/begin MEASUREMENT ed_fsp_19of20_.ff_v_vorne_nv "Geschwindigkeit des Freeze Frame" UBYTE FORMULA_0059 0 0 0.0 255.0000 ECU_ADDRESS 0x3FA731 /end MEASUREMENT
/begin MEASUREMENT ed_fsp_20of20_.ff_v_vorne_nv "Geschwindigkeit des Freeze Frame" UBYTE FORMULA_0059 0 0 0.0 255.0000 ECU_ADDRESS 0x3FA783 /end MEASUREMENT
/begin MEASUREMENT ed_fsp_1of20_.ff_tz1_nv "Zuendwinkel 1 des Freeze Frame" UBYTE FORMULA_0060 0 0 -64.0000 63.5000 ECU_ADDRESS 0x3FA16E /end MEASUREMENT
/begin MEASUREMENT ed_fsp_2of20_.ff_tz1_nv "Zuendwinkel 1 des Freeze Frame" UBYTE FORMULA_0060 0 0 -64.0000 63.5000 ECU_ADDRESS 0x3FA1C0 /end MEASUREMENT
/begin MEASUREMENT ed_fsp_3of20_.ff_tz1_nv "Zuendwinkel 1 des Freeze Frame" UBYTE FORMULA_0060 0 0 -64.0000 63.5000 ECU_ADDRESS 0x3FA212 /end MEASUREMENT
/begin MEASUREMENT ed_fsp_4of20_.ff_tz1_nv "Zuendwinkel 1 des Freeze Frame" UBYTE FORMULA_0060 0 0 -64.0000 63.5000 ECU_ADDRESS 0x3FA264 /end MEASUREMENT
/begin MEASUREMENT ed_fsp_5of20_.ff_tz1_nv "Zuendwinkel 1 des Freeze Frame" UBYTE FORMULA_0060 0 0 -64.0000 63.5000 ECU_ADDRESS 0x3FA2B6 /end MEASUREMENT
/begin MEASUREMENT ed_fsp_6of20_.ff_tz1_nv "Zuendwinkel 1 des Freeze Frame" UBYTE FORMULA_0060 0 0 -64.0000 63.5000 ECU_ADDRESS 0x3FA308 /end MEASUREMENT
/begin MEASUREMENT ed_fsp_7of20_.ff_tz1_nv "Zuendwinkel 1 des Freeze Frame" UBYTE FORMULA_0060 0 0 -64.0000 63.5000 ECU_ADDRESS 0x3FA35A /end MEASUREMENT
/begin MEASUREMENT ed_fsp_8of20_.ff_tz1_nv "Zuendwinkel 1 des Freeze Frame" UBYTE FORMULA_0060 0 0 -64.0000 63.5000 ECU_ADDRESS 0x3FA3AC /end MEASUREMENT
/begin MEASUREMENT ed_fsp_9of20_.ff_tz1_nv "Zuendwinkel 1 des Freeze Frame" UBYTE FORMULA_0060 0 0 -64.0000 63.5000 ECU_ADDRESS 0x3FA3FE /end MEASUREMENT
/begin MEASUREMENT ed_fsp_14of20_.ff_tz1_nv "Zuendwinkel 1 des Freeze Frame" UBYTE FORMULA_0060 0 0 -64.0000 63.5000 ECU_ADDRESS 0x3FA598 /end MEASUREMENT
/begin MEASUREMENT ed_fsp_15of20_.ff_tz1_nv "Zuendwinkel 1 des Freeze Frame" UBYTE FORMULA_0060 0 0 -64.0000 63.5000 ECU_ADDRESS 0x3FA5EA /end MEASUREMENT
/begin MEASUREMENT ed_fsp_16of20_.ff_tz1_nv "Zuendwinkel 1 des Freeze Frame" UBYTE FORMULA_0060 0 0 -64.0000 63.5000 ECU_ADDRESS 0x3FA63C /end MEASUREMENT
/begin MEASUREMENT ed_fsp_17of20_.ff_tz1_nv "Zuendwinkel 1 des Freeze Frame" UBYTE FORMULA_0060 0 0 -64.0000 63.5000 ECU_ADDRESS 0x3FA68E /end MEASUREMENT
/begin MEASUREMENT ed_fsp_18of20_.ff_tz1_nv "Zuendwinkel 1 des Freeze Frame" UBYTE FORMULA_0060 0 0 -64.0000 63.5000 ECU_ADDRESS 0x3FA6E0 /end MEASUREMENT
/begin MEASUREMENT ed_fsp_19of20_.ff_tz1_nv "Zuendwinkel 1 des Freeze Frame" UBYTE FORMULA_0060 0 0 -64.0000 63.5000 ECU_ADDRESS 0x3FA732 /end MEASUREMENT
/begin MEASUREMENT ed_fsp_20of20_.ff_tz1_nv "Zuendwinkel 1 des Freeze Frame" UBYTE FORMULA_0060 0 0 -64.0000 63.5000 ECU_ADDRESS 0x3FA784 /end MEASUREMENT
/begin MEASUREMENT ed_fsp_1of20_.ff_tan_b1_nv "Ansauglufttemperatur des Freeze Frame" UBYTE FORMULA_0057 0 0 -40.0000 215.0000 ECU_ADDRESS 0x3FA16F /end MEASUREMENT
/begin MEASUREMENT ed_fsp_2of20_.ff_tan_b1_nv "Ansauglufttemperatur des Freeze Frame" UBYTE FORMULA_0057 0 0 -40.0000 215.0000 ECU_ADDRESS 0x3FA1C1 /end MEASUREMENT
/begin MEASUREMENT ed_fsp_3of20_.ff_tan_b1_nv "Ansauglufttemperatur des Freeze Frame" UBYTE FORMULA_0057 0 0 -40.0000 215.0000 ECU_ADDRESS 0x3FA213 /end MEASUREMENT
/begin MEASUREMENT ed_fsp_4of20_.ff_tan_b1_nv "Ansauglufttemperatur des Freeze Frame" UBYTE FORMULA_0057 0 0 -40.0000 215.0000 ECU_ADDRESS 0x3FA265 /end MEASUREMENT
/begin MEASUREMENT ed_fsp_5of20_.ff_tan_b1_nv "Ansauglufttemperatur des Freeze Frame" UBYTE FORMULA_0057 0 0 -40.0000 215.0000 ECU_ADDRESS 0x3FA2B7 /end MEASUREMENT
/begin MEASUREMENT ed_fsp_6of20_.ff_tan_b1_nv "Ansauglufttemperatur des Freeze Frame" UBYTE FORMULA_0057 0 0 -40.0000 215.0000 ECU_ADDRESS 0x3FA309 /end MEASUREMENT
/begin MEASUREMENT ed_fsp_7of20_.ff_tan_b1_nv "Ansauglufttemperatur des Freeze Frame" UBYTE FORMULA_0057 0 0 -40.0000 215.0000 ECU_ADDRESS 0x3FA35B /end MEASUREMENT
/begin MEASUREMENT ed_fsp_8of20_.ff_tan_b1_nv "Ansauglufttemperatur des Freeze Frame" UBYTE FORMULA_0057 0 0 -40.0000 215.0000 ECU_ADDRESS 0x3FA3AD /end MEASUREMENT
/begin MEASUREMENT ed_fsp_9of20_.ff_tan_b1_nv "Ansauglufttemperatur des Freeze Frame" UBYTE FORMULA_0057 0 0 -40.0000 215.0000 ECU_ADDRESS 0x3FA3FF /end MEASUREMENT
/begin MEASUREMENT ed_fsp_14of20_.ff_tan_b1_nv "Ansauglufttemperatur des Freeze Frame" UBYTE FORMULA_0057 0 0 -40.0000 215.0000 ECU_ADDRESS 0x3FA599 /end MEASUREMENT
/begin MEASUREMENT ed_fsp_15of20_.ff_tan_b1_nv "Ansauglufttemperatur des Freeze Frame" UBYTE FORMULA_0057 0 0 -40.0000 215.0000 ECU_ADDRESS 0x3FA5EB /end MEASUREMENT
/begin MEASUREMENT ed_fsp_16of20_.ff_tan_b1_nv "Ansauglufttemperatur des Freeze Frame" UBYTE FORMULA_0057 0 0 -40.0000 215.0000 ECU_ADDRESS 0x3FA63D /end MEASUREMENT
/begin MEASUREMENT ed_fsp_17of20_.ff_tan_b1_nv "Ansauglufttemperatur des Freeze Frame" UBYTE FORMULA_0057 0 0 -40.0000 215.0000 ECU_ADDRESS 0x3FA68F /end MEASUREMENT
/begin MEASUREMENT ed_fsp_18of20_.ff_tan_b1_nv "Ansauglufttemperatur des Freeze Frame" UBYTE FORMULA_0057 0 0 -40.0000 215.0000 ECU_ADDRESS 0x3FA6E1 /end MEASUREMENT
/begin MEASUREMENT ed_fsp_19of20_.ff_tan_b1_nv "Ansauglufttemperatur des Freeze Frame" UBYTE FORMULA_0057 0 0 -40.0000 215.0000 ECU_ADDRESS 0x3FA733 /end MEASUREMENT
/begin MEASUREMENT ed_fsp_20of20_.ff_tan_b1_nv "Ansauglufttemperatur des Freeze Frame" UBYTE FORMULA_0057 0 0 -40.0000 215.0000 ECU_ADDRESS 0x3FA785 /end MEASUREMENT
/begin MEASUREMENT ed_fsp_1of20_.ff_egas_abs_dk_b1_nv "Absolute Drosselklappenposition des Freeze Frame" UBYTE FORMULA_0056 0 0 0.0 100.0000 ECU_ADDRESS 0x3FA170 /end MEASUREMENT
/begin MEASUREMENT ed_fsp_2of20_.ff_egas_abs_dk_b1_nv "Absolute Drosselklappenposition des Freeze Frame" UBYTE FORMULA_0056 0 0 0.0 100.0000 ECU_ADDRESS 0x3FA1C2 /end MEASUREMENT
/begin MEASUREMENT ed_fsp_3of20_.ff_egas_abs_dk_b1_nv "Absolute Drosselklappenposition des Freeze Frame" UBYTE FORMULA_0056 0 0 0.0 100.0000 ECU_ADDRESS 0x3FA214 /end MEASUREMENT
/begin MEASUREMENT ed_fsp_4of20_.ff_egas_abs_dk_b1_nv "Absolute Drosselklappenposition des Freeze Frame" UBYTE FORMULA_0056 0 0 0.0 100.0000 ECU_ADDRESS 0x3FA266 /end MEASUREMENT
/begin MEASUREMENT ed_fsp_5of20_.ff_egas_abs_dk_b1_nv "Absolute Drosselklappenposition des Freeze Frame" UBYTE FORMULA_0056 0 0 0.0 100.0000 ECU_ADDRESS 0x3FA2B8 /end MEASUREMENT
/begin MEASUREMENT ed_fsp_6of20_.ff_egas_abs_dk_b1_nv "Absolute Drosselklappenposition des Freeze Frame" UBYTE FORMULA_0056 0 0 0.0 100.0000 ECU_ADDRESS 0x3FA30A /end MEASUREMENT
/begin MEASUREMENT ed_fsp_7of20_.ff_egas_abs_dk_b1_nv "Absolute Drosselklappenposition des Freeze Frame" UBYTE FORMULA_0056 0 0 0.0 100.0000 ECU_ADDRESS 0x3FA35C /end MEASUREMENT
/begin MEASUREMENT ed_fsp_8of20_.ff_egas_abs_dk_b1_nv "Absolute Drosselklappenposition des Freeze Frame" UBYTE FORMULA_0056 0 0 0.0 100.0000 ECU_ADDRESS 0x3FA3AE /end MEASUREMENT
/begin MEASUREMENT ed_fsp_9of20_.ff_egas_abs_dk_b1_nv "Absolute Drosselklappenposition des Freeze Frame" UBYTE FORMULA_0056 0 0 0.0 100.0000 ECU_ADDRESS 0x3FA400 /end MEASUREMENT
/begin MEASUREMENT ed_fsp_15of20_.ff_egas_abs_dk_b1_nv "Absolute Drosselklappenposition des Freeze Frame" UBYTE FORMULA_0056 0 0 0.0 100.0000 ECU_ADDRESS 0x3FA5EC /end MEASUREMENT
/begin MEASUREMENT ed_fsp_16of20_.ff_egas_abs_dk_b1_nv "Absolute Drosselklappenposition des Freeze Frame" UBYTE FORMULA_0056 0 0 0.0 100.0000 ECU_ADDRESS 0x3FA63E /end MEASUREMENT
/begin MEASUREMENT ed_fsp_17of20_.ff_egas_abs_dk_b1_nv "Absolute Drosselklappenposition des Freeze Frame" UBYTE FORMULA_0056 0 0 0.0 100.0000 ECU_ADDRESS 0x3FA690 /end MEASUREMENT
/begin MEASUREMENT ed_fsp_18of20_.ff_egas_abs_dk_b1_nv "Absolute Drosselklappenposition des Freeze Frame" UBYTE FORMULA_0056 0 0 0.0 100.0000 ECU_ADDRESS 0x3FA6E2 /end MEASUREMENT
/begin MEASUREMENT ed_fsp_19of20_.ff_egas_abs_dk_b1_nv "Absolute Drosselklappenposition des Freeze Frame" UBYTE FORMULA_0056 0 0 0.0 100.0000 ECU_ADDRESS 0x3FA734 /end MEASUREMENT
/begin MEASUREMENT ed_fsp_20of20_.ff_egas_abs_dk_b1_nv "Absolute Drosselklappenposition des Freeze Frame" UBYTE FORMULA_0056 0 0 0.0 100.0000 ECU_ADDRESS 0x3FA786 /end MEASUREMENT
/begin MEASUREMENT ed_fsp_1of20_.ff_sl_st_nv "Sekundaerluftstatus des Freeze Frame" UBYTE FORMULA_0061 0 0 0.0 255.0 ECU_ADDRESS 0x3FA171 /end MEASUREMENT
/begin MEASUREMENT ed_fsp_2of20_.ff_sl_st_nv "Sekundaerluftstatus des Freeze Frame" UBYTE FORMULA_0061 0 0 0.0 255.0 ECU_ADDRESS 0x3FA1C3 /end MEASUREMENT
/begin MEASUREMENT ed_fsp_3of20_.ff_sl_st_nv "Sekundaerluftstatus des Freeze Frame" UBYTE FORMULA_0061 0 0 0.0 255.0 ECU_ADDRESS 0x3FA215 /end MEASUREMENT
/begin MEASUREMENT ed_fsp_4of20_.ff_sl_st_nv "Sekundaerluftstatus des Freeze Frame" UBYTE FORMULA_0061 0 0 0.0 255.0 ECU_ADDRESS 0x3FA267 /end MEASUREMENT
/begin MEASUREMENT ed_fsp_5of20_.ff_sl_st_nv "Sekundaerluftstatus des Freeze Frame" UBYTE FORMULA_0061 0 0 0.0 255.0 ECU_ADDRESS 0x3FA2B9 /end MEASUREMENT
/begin MEASUREMENT ed_fsp_6of20_.ff_sl_st_nv "Sekundaerluftstatus des Freeze Frame" UBYTE FORMULA_0061 0 0 0.0 255.0 ECU_ADDRESS 0x3FA30B /end MEASUREMENT
/begin MEASUREMENT ed_fsp_7of20_.ff_sl_st_nv "Sekundaerluftstatus des Freeze Frame" UBYTE FORMULA_0061 0 0 0.0 255.0 ECU_ADDRESS 0x3FA35D /end MEASUREMENT
/begin MEASUREMENT ed_fsp_8of20_.ff_sl_st_nv "Sekundaerluftstatus des Freeze Frame" UBYTE FORMULA_0061 0 0 0.0 255.0 ECU_ADDRESS 0x3FA3AF /end MEASUREMENT
/begin MEASUREMENT ed_fsp_9of20_.ff_sl_st_nv "Sekundaerluftstatus des Freeze Frame" UBYTE FORMULA_0061 0 0 0.0 255.0 ECU_ADDRESS 0x3FA401 /end MEASUREMENT
/begin MEASUREMENT ed_fsp_14of20_.ff_sl_st_nv "Sekundaerluftstatus des Freeze Frame" UBYTE FORMULA_0061 0 0 0.0 255.0 ECU_ADDRESS 0x3FA59B /end MEASUREMENT
/begin MEASUREMENT ed_fsp_15of20_.ff_sl_st_nv "Sekundaerluftstatus des Freeze Frame" UBYTE FORMULA_0061 0 0 0.0 255.0 ECU_ADDRESS 0x3FA5ED /end MEASUREMENT
/begin MEASUREMENT ed_fsp_16of20_.ff_sl_st_nv "Sekundaerluftstatus des Freeze Frame" UBYTE FORMULA_0061 0 0 0.0 255.0 ECU_ADDRESS 0x3FA63F /end MEASUREMENT
/begin MEASUREMENT ed_fsp_17of20_.ff_sl_st_nv "Sekundaerluftstatus des Freeze Frame" UBYTE FORMULA_0061 0 0 0.0 255.0 ECU_ADDRESS 0x3FA691 /end MEASUREMENT
/begin MEASUREMENT ed_fsp_18of20_.ff_sl_st_nv "Sekundaerluftstatus des Freeze Frame" UBYTE FORMULA_0061 0 0 0.0 255.0 ECU_ADDRESS 0x3FA6E3 /end MEASUREMENT
/begin MEASUREMENT ed_fsp_19of20_.ff_sl_st_nv "Sekundaerluftstatus des Freeze Frame" UBYTE FORMULA_0061 0 0 0.0 255.0 ECU_ADDRESS 0x3FA735 /end MEASUREMENT
/begin MEASUREMENT ed_fsp_20of20_.ff_sl_st_nv "Sekundaerluftstatus des Freeze Frame" UBYTE FORMULA_0061 0 0 0.0 255.0 ECU_ADDRESS 0x3FA787 /end MEASUREMENT
/begin MEASUREMENT ed_fsp_1of20_.ff_time_ml_nv "Zeit seit Motorstart des Freeze Frame" UWORD FORMULA_0062 0 0 0.0 65535.0000 ECU_ADDRESS 0x3FA172 /end MEASUREMENT
/begin MEASUREMENT ed_fsp_2of20_.ff_time_ml_nv "Zeit seit Motorstart des Freeze Frame" UWORD FORMULA_0062 0 0 0.0 65535.0000 ECU_ADDRESS 0x3FA1C4 /end MEASUREMENT
/begin MEASUREMENT ed_fsp_3of20_.ff_time_ml_nv "Zeit seit Motorstart des Freeze Frame" UWORD FORMULA_0062 0 0 0.0 65535.0000 ECU_ADDRESS 0x3FA216 /end MEASUREMENT
/begin MEASUREMENT ed_fsp_4of20_.ff_time_ml_nv "Zeit seit Motorstart des Freeze Frame" UWORD FORMULA_0062 0 0 0.0 65535.0000 ECU_ADDRESS 0x3FA268 /end MEASUREMENT
/begin MEASUREMENT ed_fsp_5of20_.ff_time_ml_nv "Zeit seit Motorstart des Freeze Frame" UWORD FORMULA_0062 0 0 0.0 65535.0000 ECU_ADDRESS 0x3FA2BA /end MEASUREMENT
/begin MEASUREMENT ed_fsp_6of20_.ff_time_ml_nv "Zeit seit Motorstart des Freeze Frame" UWORD FORMULA_0062 0 0 0.0 65535.0000 ECU_ADDRESS 0x3FA30C /end MEASUREMENT
/begin MEASUREMENT ed_fsp_7of20_.ff_time_ml_nv "Zeit seit Motorstart des Freeze Frame" UWORD FORMULA_0062 0 0 0.0 65535.0000 ECU_ADDRESS 0x3FA35E /end MEASUREMENT
/begin MEASUREMENT ed_fsp_8of20_.ff_time_ml_nv "Zeit seit Motorstart des Freeze Frame" UWORD FORMULA_0062 0 0 0.0 65535.0000 ECU_ADDRESS 0x3FA3B0 /end MEASUREMENT
/begin MEASUREMENT ed_fsp_9of20_.ff_time_ml_nv "Zeit seit Motorstart des Freeze Frame" UWORD FORMULA_0062 0 0 0.0 65535.0000 ECU_ADDRESS 0x3FA402 /end MEASUREMENT
/begin MEASUREMENT ed_fsp_14of20_.ff_time_ml_nv "Zeit seit Motorstart des Freeze Frame" UWORD FORMULA_0062 0 0 0.0 65535.0000 ECU_ADDRESS 0x3FA59C /end MEASUREMENT
/begin MEASUREMENT ed_fsp_15of20_.ff_time_ml_nv "Zeit seit Motorstart des Freeze Frame" UWORD FORMULA_0062 0 0 0.0 65535.0000 ECU_ADDRESS 0x3FA5EE /end MEASUREMENT
/begin MEASUREMENT ed_fsp_16of20_.ff_time_ml_nv "Zeit seit Motorstart des Freeze Frame" UWORD FORMULA_0062 0 0 0.0 65535.0000 ECU_ADDRESS 0x3FA640 /end MEASUREMENT
/begin MEASUREMENT ed_fsp_17of20_.ff_time_ml_nv "Zeit seit Motorstart des Freeze Frame" UWORD FORMULA_0062 0 0 0.0 65535.0000 ECU_ADDRESS 0x3FA692 /end MEASUREMENT
/begin MEASUREMENT ed_fsp_18of20_.ff_time_ml_nv "Zeit seit Motorstart des Freeze Frame" UWORD FORMULA_0062 0 0 0.0 65535.0000 ECU_ADDRESS 0x3FA6E4 /end MEASUREMENT
/begin MEASUREMENT ed_fsp_19of20_.ff_time_ml_nv "Zeit seit Motorstart des Freeze Frame" UWORD FORMULA_0062 0 0 0.0 65535.0000 ECU_ADDRESS 0x3FA736 /end MEASUREMENT
/begin MEASUREMENT ed_fsp_20of20_.ff_time_ml_nv "Zeit seit Motorstart des Freeze Frame" UWORD FORMULA_0062 0 0 0.0 65535.0000 ECU_ADDRESS 0x3FA788 /end MEASUREMENT
/begin MEASUREMENT ed_fsp_1of20_.ff_ub_nv "Systemspannung fuer Steuergeraet des Freeze Frame" UWORD FORMULA_0063 0 0 0.0 65.5350 ECU_ADDRESS 0x3FA174 /end MEASUREMENT
/begin MEASUREMENT ed_fsp_2of20_.ff_ub_nv "Systemspannung fuer Steuergeraet des Freeze Frame" UWORD FORMULA_0063 0 0 0.0 65.5350 ECU_ADDRESS 0x3FA1C6 /end MEASUREMENT
/begin MEASUREMENT ed_fsp_3of20_.ff_ub_nv "Systemspannung fuer Steuergeraet des Freeze Frame" UWORD FORMULA_0063 0 0 0.0 65.5350 ECU_ADDRESS 0x3FA218 /end MEASUREMENT
/begin MEASUREMENT ed_fsp_4of20_.ff_ub_nv "Systemspannung fuer Steuergeraet des Freeze Frame" UWORD FORMULA_0063 0 0 0.0 65.5350 ECU_ADDRESS 0x3FA26A /end MEASUREMENT
/begin MEASUREMENT ed_fsp_5of20_.ff_ub_nv "Systemspannung fuer Steuergeraet des Freeze Frame" UWORD FORMULA_0063 0 0 0.0 65.5350 ECU_ADDRESS 0x3FA2BC /end MEASUREMENT
/begin MEASUREMENT ed_fsp_6of20_.ff_ub_nv "Systemspannung fuer Steuergeraet des Freeze Frame" UWORD FORMULA_0063 0 0 0.0 65.5350 ECU_ADDRESS 0x3FA30E /end MEASUREMENT
/begin MEASUREMENT ed_fsp_7of20_.ff_ub_nv "Systemspannung fuer Steuergeraet des Freeze Frame" UWORD FORMULA_0063 0 0 0.0 65.5350 ECU_ADDRESS 0x3FA360 /end MEASUREMENT
/begin MEASUREMENT ed_fsp_8of20_.ff_ub_nv "Systemspannung fuer Steuergeraet des Freeze Frame" UWORD FORMULA_0063 0 0 0.0 65.5350 ECU_ADDRESS 0x3FA3B2 /end MEASUREMENT
/begin MEASUREMENT ed_fsp_9of20_.ff_ub_nv "Systemspannung fuer Steuergeraet des Freeze Frame" UWORD FORMULA_0063 0 0 0.0 65.5350 ECU_ADDRESS 0x3FA404 /end MEASUREMENT
/begin MEASUREMENT ed_fsp_14of20_.ff_ub_nv "Systemspannung fuer Steuergeraet des Freeze Frame" UWORD FORMULA_0063 0 0 0.0 65.5350 ECU_ADDRESS 0x3FA59E /end MEASUREMENT
/begin MEASUREMENT ed_fsp_15of20_.ff_ub_nv "Systemspannung fuer Steuergeraet des Freeze Frame" UWORD FORMULA_0063 0 0 0.0 65.5350 ECU_ADDRESS 0x3FA5F0 /end MEASUREMENT
/begin MEASUREMENT ed_fsp_16of20_.ff_ub_nv "Systemspannung fuer Steuergeraet des Freeze Frame" UWORD FORMULA_0063 0 0 0.0 65.5350 ECU_ADDRESS 0x3FA642 /end MEASUREMENT
/begin MEASUREMENT ed_fsp_17of20_.ff_ub_nv "Systemspannung fuer Steuergeraet des Freeze Frame" UWORD FORMULA_0063 0 0 0.0 65.5350 ECU_ADDRESS 0x3FA694 /end MEASUREMENT
/begin MEASUREMENT ed_fsp_18of20_.ff_ub_nv "Systemspannung fuer Steuergeraet des Freeze Frame" UWORD FORMULA_0063 0 0 0.0 65.5350 ECU_ADDRESS 0x3FA6E6 /end MEASUREMENT
/begin MEASUREMENT ed_fsp_19of20_.ff_ub_nv "Systemspannung fuer Steuergeraet des Freeze Frame" UWORD FORMULA_0063 0 0 0.0 65.5350 ECU_ADDRESS 0x3FA738 /end MEASUREMENT
/begin MEASUREMENT ed_fsp_20of20_.ff_ub_nv "Systemspannung fuer Steuergeraet des Freeze Frame" UWORD FORMULA_0063 0 0 0.0 65.5350 ECU_ADDRESS 0x3FA78A /end MEASUREMENT
/begin MEASUREMENT ed_fsp_1of20_.ff_rf_b1_nv "Absolute Lastwert des Freeze Frame" UWORD FORMULA_0064 0 0 0.0 257.0000 ECU_ADDRESS 0x3FA176 /end MEASUREMENT
/begin MEASUREMENT ed_fsp_2of20_.ff_rf_b1_nv "Absolute Lastwert des Freeze Frame" UWORD FORMULA_0064 0 0 0.0 257.0000 ECU_ADDRESS 0x3FA1C8 /end MEASUREMENT
/begin MEASUREMENT ed_fsp_3of20_.ff_rf_b1_nv "Absolute Lastwert des Freeze Frame" UWORD FORMULA_0064 0 0 0.0 257.0000 ECU_ADDRESS 0x3FA21A /end MEASUREMENT
/begin MEASUREMENT ed_fsp_4of20_.ff_rf_b1_nv "Absolute Lastwert des Freeze Frame" UWORD FORMULA_0064 0 0 0.0 257.0000 ECU_ADDRESS 0x3FA26C /end MEASUREMENT
/begin MEASUREMENT ed_fsp_5of20_.ff_rf_b1_nv "Absolute Lastwert des Freeze Frame" UWORD FORMULA_0064 0 0 0.0 257.0000 ECU_ADDRESS 0x3FA2BE /end MEASUREMENT
/begin MEASUREMENT ed_fsp_6of20_.ff_rf_b1_nv "Absolute Lastwert des Freeze Frame" UWORD FORMULA_0064 0 0 0.0 257.0000 ECU_ADDRESS 0x3FA310 /end MEASUREMENT
/begin MEASUREMENT ed_fsp_7of20_.ff_rf_b1_nv "Absolute Lastwert des Freeze Frame" UWORD FORMULA_0064 0 0 0.0 257.0000 ECU_ADDRESS 0x3FA362 /end MEASUREMENT
/begin MEASUREMENT ed_fsp_8of20_.ff_rf_b1_nv "Absolute Lastwert des Freeze Frame" UWORD FORMULA_0064 0 0 0.0 257.0000 ECU_ADDRESS 0x3FA3B4 /end MEASUREMENT
/begin MEASUREMENT ed_fsp_9of20_.ff_rf_b1_nv "Absolute Lastwert des Freeze Frame" UWORD FORMULA_0064 0 0 0.0 257.0000 ECU_ADDRESS 0x3FA406 /end MEASUREMENT
/begin MEASUREMENT ed_fsp_14of20_.ff_rf_b1_nv "Absolute Lastwert des Freeze Frame" UWORD FORMULA_0064 0 0 0.0 257.0000 ECU_ADDRESS 0x3FA5A0 /end MEASUREMENT
/begin MEASUREMENT ed_fsp_15of20_.ff_rf_b1_nv "Absolute Lastwert des Freeze Frame" UWORD FORMULA_0064 0 0 0.0 257.0000 ECU_ADDRESS 0x3FA5F2 /end MEASUREMENT
/begin MEASUREMENT ed_fsp_16of20_.ff_rf_b1_nv "Absolute Lastwert des Freeze Frame" UWORD FORMULA_0064 0 0 0.0 257.0000 ECU_ADDRESS 0x3FA644 /end MEASUREMENT
/begin MEASUREMENT ed_fsp_17of20_.ff_rf_b1_nv "Absolute Lastwert des Freeze Frame" UWORD FORMULA_0064 0 0 0.0 257.0000 ECU_ADDRESS 0x3FA696 /end MEASUREMENT
/begin MEASUREMENT ed_fsp_18of20_.ff_rf_b1_nv "Absolute Lastwert des Freeze Frame" UWORD FORMULA_0064 0 0 0.0 257.0000 ECU_ADDRESS 0x3FA6E8 /end MEASUREMENT
/begin MEASUREMENT ed_fsp_19of20_.ff_rf_b1_nv "Absolute Lastwert des Freeze Frame" UWORD FORMULA_0064 0 0 0.0 257.0000 ECU_ADDRESS 0x3FA73A /end MEASUREMENT
/begin MEASUREMENT ed_fsp_20of20_.ff_rf_b1_nv "Absolute Lastwert des Freeze Frame" UWORD FORMULA_0064 0 0 0.0 257.0000 ECU_ADDRESS 0x3FA78C /end MEASUREMENT
/begin MEASUREMENT ed_fsp_1of20_.ff_lam_soll_b1_nv "Lambdaregelfaktor des Freeze Frame" UWORD FORMULA_0024 0 0 0.0 1.9999 ECU_ADDRESS 0x3FA178 /end MEASUREMENT
/begin MEASUREMENT ed_fsp_2of20_.ff_lam_soll_b1_nv "Lambdaregelfaktor des Freeze Frame" UWORD FORMULA_0024 0 0 0.0 1.9999 ECU_ADDRESS 0x3FA1CA /end MEASUREMENT
/begin MEASUREMENT ed_fsp_3of20_.ff_lam_soll_b1_nv "Lambdaregelfaktor des Freeze Frame" UWORD FORMULA_0024 0 0 0.0 1.9999 ECU_ADDRESS 0x3FA21C /end MEASUREMENT
/begin MEASUREMENT ed_fsp_4of20_.ff_lam_soll_b1_nv "Lambdaregelfaktor des Freeze Frame" UWORD FORMULA_0024 0 0 0.0 1.9999 ECU_ADDRESS 0x3FA26E /end MEASUREMENT
/begin MEASUREMENT ed_fsp_5of20_.ff_lam_soll_b1_nv "Lambdaregelfaktor des Freeze Frame" UWORD FORMULA_0024 0 0 0.0 1.9999 ECU_ADDRESS 0x3FA2C0 /end MEASUREMENT
/begin MEASUREMENT ed_fsp_6of20_.ff_lam_soll_b1_nv "Lambdaregelfaktor des Freeze Frame" UWORD FORMULA_0024 0 0 0.0 1.9999 ECU_ADDRESS 0x3FA312 /end MEASUREMENT
/begin MEASUREMENT ed_fsp_7of20_.ff_lam_soll_b1_nv "Lambdaregelfaktor des Freeze Frame" UWORD FORMULA_0024 0 0 0.0 1.9999 ECU_ADDRESS 0x3FA364 /end MEASUREMENT
/begin MEASUREMENT ed_fsp_8of20_.ff_lam_soll_b1_nv "Lambdaregelfaktor des Freeze Frame" UWORD FORMULA_0024 0 0 0.0 1.9999 ECU_ADDRESS 0x3FA3B6 /end MEASUREMENT
/begin MEASUREMENT ed_fsp_9of20_.ff_lam_soll_b1_nv "Lambdaregelfaktor des Freeze Frame" UWORD FORMULA_0024 0 0 0.0 1.9999 ECU_ADDRESS 0x3FA408 /end MEASUREMENT
/begin MEASUREMENT ed_fsp_15of20_.ff_lam_soll_b1_nv "Lambdaregelfaktor des Freeze Frame" UWORD FORMULA_0024 0 0 0.0 1.9999 ECU_ADDRESS 0x3FA5F4 /end MEASUREMENT
/begin MEASUREMENT ed_fsp_16of20_.ff_lam_soll_b1_nv "Lambdaregelfaktor des Freeze Frame" UWORD FORMULA_0024 0 0 0.0 1.9999 ECU_ADDRESS 0x3FA646 /end MEASUREMENT
/begin MEASUREMENT ed_fsp_17of20_.ff_lam_soll_b1_nv "Lambdaregelfaktor des Freeze Frame" UWORD FORMULA_0024 0 0 0.0 1.9999 ECU_ADDRESS 0x3FA698 /end MEASUREMENT
/begin MEASUREMENT ed_fsp_18of20_.ff_lam_soll_b1_nv "Lambdaregelfaktor des Freeze Frame" UWORD FORMULA_0024 0 0 0.0 1.9999 ECU_ADDRESS 0x3FA6EA /end MEASUREMENT
/begin MEASUREMENT ed_fsp_19of20_.ff_lam_soll_b1_nv "Lambdaregelfaktor des Freeze Frame" UWORD FORMULA_0024 0 0 0.0 1.9999 ECU_ADDRESS 0x3FA73C /end MEASUREMENT
/begin MEASUREMENT ed_fsp_20of20_.ff_lam_soll_b1_nv "Lambdaregelfaktor des Freeze Frame" UWORD FORMULA_0024 0 0 0.0 1.9999 ECU_ADDRESS 0x3FA78E /end MEASUREMENT
/begin MEASUREMENT ed_fsp_1of20_.ff_tev_b1_nv "Tankentlueftungsventil des Freeze Frame" UBYTE FORMULA_0065 0 0 0.0 100.0000 ECU_ADDRESS 0x3FA17A /end MEASUREMENT
/begin MEASUREMENT ed_fsp_2of20_.ff_tev_b1_nv "Tankentlueftungsventil des Freeze Frame" UBYTE FORMULA_0065 0 0 0.0 100.0000 ECU_ADDRESS 0x3FA1CC /end MEASUREMENT
/begin MEASUREMENT ed_fsp_3of20_.ff_tev_b1_nv "Tankentlueftungsventil des Freeze Frame" UBYTE FORMULA_0065 0 0 0.0 100.0000 ECU_ADDRESS 0x3FA21E /end MEASUREMENT
/begin MEASUREMENT ed_fsp_4of20_.ff_tev_b1_nv "Tankentlueftungsventil des Freeze Frame" UBYTE FORMULA_0065 0 0 0.0 100.0000 ECU_ADDRESS 0x3FA270 /end MEASUREMENT
/begin MEASUREMENT ed_fsp_5of20_.ff_tev_b1_nv "Tankentlueftungsventil des Freeze Frame" UBYTE FORMULA_0065 0 0 0.0 100.0000 ECU_ADDRESS 0x3FA2C2 /end MEASUREMENT
/begin MEASUREMENT ed_fsp_6of20_.ff_tev_b1_nv "Tankentlueftungsventil des Freeze Frame" UBYTE FORMULA_0065 0 0 0.0 100.0000 ECU_ADDRESS 0x3FA314 /end MEASUREMENT
/begin MEASUREMENT ed_fsp_7of20_.ff_tev_b1_nv "Tankentlueftungsventil des Freeze Frame" UBYTE FORMULA_0065 0 0 0.0 100.0000 ECU_ADDRESS 0x3FA366 /end MEASUREMENT
/begin MEASUREMENT ed_fsp_8of20_.ff_tev_b1_nv "Tankentlueftungsventil des Freeze Frame" UBYTE FORMULA_0065 0 0 0.0 100.0000 ECU_ADDRESS 0x3FA3B8 /end MEASUREMENT
/begin MEASUREMENT ed_fsp_9of20_.ff_tev_b1_nv "Tankentlueftungsventil des Freeze Frame" UBYTE FORMULA_0065 0 0 0.0 100.0000 ECU_ADDRESS 0x3FA40A /end MEASUREMENT
/begin MEASUREMENT ed_fsp_14of20_.ff_tev_b1_nv "Tankentlueftungsventil des Freeze Frame" UBYTE FORMULA_0065 0 0 0.0 100.0000 ECU_ADDRESS 0x3FA5A4 /end MEASUREMENT
/begin MEASUREMENT ed_fsp_15of20_.ff_tev_b1_nv "Tankentlueftungsventil des Freeze Frame" UBYTE FORMULA_0065 0 0 0.0 100.0000 ECU_ADDRESS 0x3FA5F6 /end MEASUREMENT
/begin MEASUREMENT ed_fsp_16of20_.ff_tev_b1_nv "Tankentlueftungsventil des Freeze Frame" UBYTE FORMULA_0065 0 0 0.0 100.0000 ECU_ADDRESS 0x3FA648 /end MEASUREMENT
/begin MEASUREMENT ed_fsp_17of20_.ff_tev_b1_nv "Tankentlueftungsventil des Freeze Frame" UBYTE FORMULA_0065 0 0 0.0 100.0000 ECU_ADDRESS 0x3FA69A /end MEASUREMENT
/begin MEASUREMENT ed_fsp_18of20_.ff_tev_b1_nv "Tankentlueftungsventil des Freeze Frame" UBYTE FORMULA_0065 0 0 0.0 100.0000 ECU_ADDRESS 0x3FA6EC /end MEASUREMENT
/begin MEASUREMENT ed_fsp_19of20_.ff_tev_b1_nv "Tankentlueftungsventil des Freeze Frame" UBYTE FORMULA_0065 0 0 0.0 100.0000 ECU_ADDRESS 0x3FA73E /end MEASUREMENT
/begin MEASUREMENT ed_fsp_20of20_.ff_tev_b1_nv "Tankentlueftungsventil des Freeze Frame" UBYTE FORMULA_0065 0 0 0.0 100.0000 ECU_ADDRESS 0x3FA790 /end MEASUREMENT
/begin MEASUREMENT ed_fsp_1of20_.ff_fst_nv "Tankfuellstand des Freeze Frame" UBYTE FORMULA_0065 0 0 0.0 100.0000 ECU_ADDRESS 0x3FA17B /end MEASUREMENT
/begin MEASUREMENT ed_fsp_2of20_.ff_fst_nv "Tankfuellstand des Freeze Frame" UBYTE FORMULA_0065 0 0 0.0 100.0000 ECU_ADDRESS 0x3FA1CD /end MEASUREMENT
/begin MEASUREMENT ed_fsp_3of20_.ff_fst_nv "Tankfuellstand des Freeze Frame" UBYTE FORMULA_0065 0 0 0.0 100.0000 ECU_ADDRESS 0x3FA21F /end MEASUREMENT
/begin MEASUREMENT ed_fsp_4of20_.ff_fst_nv "Tankfuellstand des Freeze Frame" UBYTE FORMULA_0065 0 0 0.0 100.0000 ECU_ADDRESS 0x3FA271 /end MEASUREMENT
/begin MEASUREMENT ed_fsp_5of20_.ff_fst_nv "Tankfuellstand des Freeze Frame" UBYTE FORMULA_0065 0 0 0.0 100.0000 ECU_ADDRESS 0x3FA2C3 /end MEASUREMENT
/begin MEASUREMENT ed_fsp_6of20_.ff_fst_nv "Tankfuellstand des Freeze Frame" UBYTE FORMULA_0065 0 0 0.0 100.0000 ECU_ADDRESS 0x3FA315 /end MEASUREMENT
/begin MEASUREMENT ed_fsp_7of20_.ff_fst_nv "Tankfuellstand des Freeze Frame" UBYTE FORMULA_0065 0 0 0.0 100.0000 ECU_ADDRESS 0x3FA367 /end MEASUREMENT
/begin MEASUREMENT ed_fsp_8of20_.ff_fst_nv "Tankfuellstand des Freeze Frame" UBYTE FORMULA_0065 0 0 0.0 100.0000 ECU_ADDRESS 0x3FA3B9 /end MEASUREMENT
/begin MEASUREMENT ed_fsp_9of20_.ff_fst_nv "Tankfuellstand des Freeze Frame" UBYTE FORMULA_0065 0 0 0.0 100.0000 ECU_ADDRESS 0x3FA40B /end MEASUREMENT
/begin MEASUREMENT ed_fsp_15of20_.ff_fst_nv "Tankfuellstand des Freeze Frame" UBYTE FORMULA_0065 0 0 0.0 100.0000 ECU_ADDRESS 0x3FA5F7 /end MEASUREMENT
/begin MEASUREMENT ed_fsp_16of20_.ff_fst_nv "Tankfuellstand des Freeze Frame" UBYTE FORMULA_0065 0 0 0.0 100.0000 ECU_ADDRESS 0x3FA649 /end MEASUREMENT
/begin MEASUREMENT ed_fsp_17of20_.ff_fst_nv "Tankfuellstand des Freeze Frame" UBYTE FORMULA_0065 0 0 0.0 100.0000 ECU_ADDRESS 0x3FA69B /end MEASUREMENT
/begin MEASUREMENT ed_fsp_18of20_.ff_fst_nv "Tankfuellstand des Freeze Frame" UBYTE FORMULA_0065 0 0 0.0 100.0000 ECU_ADDRESS 0x3FA6ED /end MEASUREMENT
/begin MEASUREMENT ed_fsp_19of20_.ff_fst_nv "Tankfuellstand des Freeze Frame" UBYTE FORMULA_0065 0 0 0.0 100.0000 ECU_ADDRESS 0x3FA73F /end MEASUREMENT
/begin MEASUREMENT ed_fsp_20of20_.ff_fst_nv "Tankfuellstand des Freeze Frame" UBYTE FORMULA_0065 0 0 0.0 100.0000 ECU_ADDRESS 0x3FA791 /end MEASUREMENT
/begin MEASUREMENT ed_fsp_1of20_.ff_pumg_nv "Barometrischer Druck des Freeze Frame" UBYTE FORMULA_0066 0 0 0.0 255.0000 ECU_ADDRESS 0x3FA17C /end MEASUREMENT
/begin MEASUREMENT ed_fsp_2of20_.ff_pumg_nv "Barometrischer Druck des Freeze Frame" UBYTE FORMULA_0066 0 0 0.0 255.0000 ECU_ADDRESS 0x3FA1CE /end MEASUREMENT
/begin MEASUREMENT ed_fsp_3of20_.ff_pumg_nv "Barometrischer Druck des Freeze Frame" UBYTE FORMULA_0066 0 0 0.0 255.0000 ECU_ADDRESS 0x3FA220 /end MEASUREMENT
/begin MEASUREMENT ed_fsp_4of20_.ff_pumg_nv "Barometrischer Druck des Freeze Frame" UBYTE FORMULA_0066 0 0 0.0 255.0000 ECU_ADDRESS 0x3FA272 /end MEASUREMENT
/begin MEASUREMENT ed_fsp_5of20_.ff_pumg_nv "Barometrischer Druck des Freeze Frame" UBYTE FORMULA_0066 0 0 0.0 255.0000 ECU_ADDRESS 0x3FA2C4 /end MEASUREMENT
/begin MEASUREMENT ed_fsp_6of20_.ff_pumg_nv "Barometrischer Druck des Freeze Frame" UBYTE FORMULA_0066 0 0 0.0 255.0000 ECU_ADDRESS 0x3FA316 /end MEASUREMENT
/begin MEASUREMENT ed_fsp_7of20_.ff_pumg_nv "Barometrischer Druck des Freeze Frame" UBYTE FORMULA_0066 0 0 0.0 255.0000 ECU_ADDRESS 0x3FA368 /end MEASUREMENT
/begin MEASUREMENT ed_fsp_8of20_.ff_pumg_nv "Barometrischer Druck des Freeze Frame" UBYTE FORMULA_0066 0 0 0.0 255.0000 ECU_ADDRESS 0x3FA3BA /end MEASUREMENT
/begin MEASUREMENT ed_fsp_9of20_.ff_pumg_nv "Barometrischer Druck des Freeze Frame" UBYTE FORMULA_0066 0 0 0.0 255.0000 ECU_ADDRESS 0x3FA40C /end MEASUREMENT
/begin MEASUREMENT ed_fsp_15of20_.ff_pumg_nv "Barometrischer Druck des Freeze Frame" UBYTE FORMULA_0066 0 0 0.0 255.0000 ECU_ADDRESS 0x3FA5F8 /end MEASUREMENT
/begin MEASUREMENT ed_fsp_16of20_.ff_pumg_nv "Barometrischer Druck des Freeze Frame" UBYTE FORMULA_0066 0 0 0.0 255.0000 ECU_ADDRESS 0x3FA64A /end MEASUREMENT
/begin MEASUREMENT ed_fsp_17of20_.ff_pumg_nv "Barometrischer Druck des Freeze Frame" UBYTE FORMULA_0066 0 0 0.0 255.0000 ECU_ADDRESS 0x3FA69C /end MEASUREMENT
/begin MEASUREMENT ed_fsp_18of20_.ff_pumg_nv "Barometrischer Druck des Freeze Frame" UBYTE FORMULA_0066 0 0 0.0 255.0000 ECU_ADDRESS 0x3FA6EE /end MEASUREMENT
/begin MEASUREMENT ed_fsp_19of20_.ff_pumg_nv "Barometrischer Druck des Freeze Frame" UBYTE FORMULA_0066 0 0 0.0 255.0000 ECU_ADDRESS 0x3FA740 /end MEASUREMENT
/begin MEASUREMENT ed_fsp_20of20_.ff_pumg_nv "Barometrischer Druck des Freeze Frame" UBYTE FORMULA_0066 0 0 0.0 255.0000 ECU_ADDRESS 0x3FA792 /end MEASUREMENT
/begin MEASUREMENT ed_fsp_1of20_.ff_egas_ist_dk_b1_nv "Relative Drosselklappen des Freeze Frame" UBYTE FORMULA_0065 0 0 0.0 100.0000 ECU_ADDRESS 0x3FA17D /end MEASUREMENT
/begin MEASUREMENT ed_fsp_2of20_.ff_egas_ist_dk_b1_nv "Relative Drosselklappen des Freeze Frame" UBYTE FORMULA_0065 0 0 0.0 100.0000 ECU_ADDRESS 0x3FA1CF /end MEASUREMENT
/begin MEASUREMENT ed_fsp_3of20_.ff_egas_ist_dk_b1_nv "Relative Drosselklappen des Freeze Frame" UBYTE FORMULA_0065 0 0 0.0 100.0000 ECU_ADDRESS 0x3FA221 /end MEASUREMENT
/begin MEASUREMENT ed_fsp_4of20_.ff_egas_ist_dk_b1_nv "Relative Drosselklappen des Freeze Frame" UBYTE FORMULA_0065 0 0 0.0 100.0000 ECU_ADDRESS 0x3FA273 /end MEASUREMENT
/begin MEASUREMENT ed_fsp_5of20_.ff_egas_ist_dk_b1_nv "Relative Drosselklappen des Freeze Frame" UBYTE FORMULA_0065 0 0 0.0 100.0000 ECU_ADDRESS 0x3FA2C5 /end MEASUREMENT
/begin MEASUREMENT ed_fsp_6of20_.ff_egas_ist_dk_b1_nv "Relative Drosselklappen des Freeze Frame" UBYTE FORMULA_0065 0 0 0.0 100.0000 ECU_ADDRESS 0x3FA317 /end MEASUREMENT
/begin MEASUREMENT ed_fsp_7of20_.ff_egas_ist_dk_b1_nv "Relative Drosselklappen des Freeze Frame" UBYTE FORMULA_0065 0 0 0.0 100.0000 ECU_ADDRESS 0x3FA369 /end MEASUREMENT
/begin MEASUREMENT ed_fsp_8of20_.ff_egas_ist_dk_b1_nv "Relative Drosselklappen des Freeze Frame" UBYTE FORMULA_0065 0 0 0.0 100.0000 ECU_ADDRESS 0x3FA3BB /end MEASUREMENT
/begin MEASUREMENT ed_fsp_9of20_.ff_egas_ist_dk_b1_nv "Relative Drosselklappen des Freeze Frame" UBYTE FORMULA_0065 0 0 0.0 100.0000 ECU_ADDRESS 0x3FA40D /end MEASUREMENT
/begin MEASUREMENT ed_fsp_15of20_.ff_egas_ist_dk_b1_nv "Relative Drosselklappen des Freeze Frame" UBYTE FORMULA_0065 0 0 0.0 100.0000 ECU_ADDRESS 0x3FA5F9 /end MEASUREMENT
/begin MEASUREMENT ed_fsp_16of20_.ff_egas_ist_dk_b1_nv "Relative Drosselklappen des Freeze Frame" UBYTE FORMULA_0065 0 0 0.0 100.0000 ECU_ADDRESS 0x3FA64B /end MEASUREMENT
/begin MEASUREMENT ed_fsp_17of20_.ff_egas_ist_dk_b1_nv "Relative Drosselklappen des Freeze Frame" UBYTE FORMULA_0065 0 0 0.0 100.0000 ECU_ADDRESS 0x3FA69D /end MEASUREMENT
/begin MEASUREMENT ed_fsp_18of20_.ff_egas_ist_dk_b1_nv "Relative Drosselklappen des Freeze Frame" UBYTE FORMULA_0065 0 0 0.0 100.0000 ECU_ADDRESS 0x3FA6EF /end MEASUREMENT
/begin MEASUREMENT ed_fsp_19of20_.ff_egas_ist_dk_b1_nv "Relative Drosselklappen des Freeze Frame" UBYTE FORMULA_0065 0 0 0.0 100.0000 ECU_ADDRESS 0x3FA741 /end MEASUREMENT
/begin MEASUREMENT ed_fsp_20of20_.ff_egas_ist_dk_b1_nv "Relative Drosselklappen des Freeze Frame" UBYTE FORMULA_0065 0 0 0.0 100.0000 ECU_ADDRESS 0x3FA793 /end MEASUREMENT
/begin MEASUREMENT ed_fsp_1of20_.ff_tumg_nv "Umgebungslufttemperatur des Freeze Frame" UBYTE FORMULA_0057 0 0 -40.0000 215.0000 ECU_ADDRESS 0x3FA17E /end MEASUREMENT
/begin MEASUREMENT ed_fsp_2of20_.ff_tumg_nv "Umgebungslufttemperatur des Freeze Frame" UBYTE FORMULA_0057 0 0 -40.0000 215.0000 ECU_ADDRESS 0x3FA1D0 /end MEASUREMENT
/begin MEASUREMENT ed_fsp_3of20_.ff_tumg_nv "Umgebungslufttemperatur des Freeze Frame" UBYTE FORMULA_0057 0 0 -40.0000 215.0000 ECU_ADDRESS 0x3FA222 /end MEASUREMENT
/begin MEASUREMENT ed_fsp_4of20_.ff_tumg_nv "Umgebungslufttemperatur des Freeze Frame" UBYTE FORMULA_0057 0 0 -40.0000 215.0000 ECU_ADDRESS 0x3FA274 /end MEASUREMENT
/begin MEASUREMENT ed_fsp_5of20_.ff_tumg_nv "Umgebungslufttemperatur des Freeze Frame" UBYTE FORMULA_0057 0 0 -40.0000 215.0000 ECU_ADDRESS 0x3FA2C6 /end MEASUREMENT
/begin MEASUREMENT ed_fsp_6of20_.ff_tumg_nv "Umgebungslufttemperatur des Freeze Frame" UBYTE FORMULA_0057 0 0 -40.0000 215.0000 ECU_ADDRESS 0x3FA318 /end MEASUREMENT
/begin MEASUREMENT ed_fsp_7of20_.ff_tumg_nv "Umgebungslufttemperatur des Freeze Frame" UBYTE FORMULA_0057 0 0 -40.0000 215.0000 ECU_ADDRESS 0x3FA36A /end MEASUREMENT
/begin MEASUREMENT ed_fsp_8of20_.ff_tumg_nv "Umgebungslufttemperatur des Freeze Frame" UBYTE FORMULA_0057 0 0 -40.0000 215.0000 ECU_ADDRESS 0x3FA3BC /end MEASUREMENT
/begin MEASUREMENT ed_fsp_9of20_.ff_tumg_nv "Umgebungslufttemperatur des Freeze Frame" UBYTE FORMULA_0057 0 0 -40.0000 215.0000 ECU_ADDRESS 0x3FA40E /end MEASUREMENT
/begin MEASUREMENT ed_fsp_14of20_.ff_tumg_nv "Umgebungslufttemperatur des Freeze Frame" UBYTE FORMULA_0057 0 0 -40.0000 215.0000 ECU_ADDRESS 0x3FA5A8 /end MEASUREMENT
/begin MEASUREMENT ed_fsp_15of20_.ff_tumg_nv "Umgebungslufttemperatur des Freeze Frame" UBYTE FORMULA_0057 0 0 -40.0000 215.0000 ECU_ADDRESS 0x3FA5FA /end MEASUREMENT
/begin MEASUREMENT ed_fsp_16of20_.ff_tumg_nv "Umgebungslufttemperatur des Freeze Frame" UBYTE FORMULA_0057 0 0 -40.0000 215.0000 ECU_ADDRESS 0x3FA64C /end MEASUREMENT
/begin MEASUREMENT ed_fsp_17of20_.ff_tumg_nv "Umgebungslufttemperatur des Freeze Frame" UBYTE FORMULA_0057 0 0 -40.0000 215.0000 ECU_ADDRESS 0x3FA69E /end MEASUREMENT
/begin MEASUREMENT ed_fsp_18of20_.ff_tumg_nv "Umgebungslufttemperatur des Freeze Frame" UBYTE FORMULA_0057 0 0 -40.0000 215.0000 ECU_ADDRESS 0x3FA6F0 /end MEASUREMENT
/begin MEASUREMENT ed_fsp_19of20_.ff_tumg_nv "Umgebungslufttemperatur des Freeze Frame" UBYTE FORMULA_0057 0 0 -40.0000 215.0000 ECU_ADDRESS 0x3FA742 /end MEASUREMENT
/begin MEASUREMENT ed_fsp_20of20_.ff_tumg_nv "Umgebungslufttemperatur des Freeze Frame" UBYTE FORMULA_0057 0 0 -40.0000 215.0000 ECU_ADDRESS 0x3FA794 /end MEASUREMENT
/begin MEASUREMENT ed_fsp_1of20_.ff_pwg1_abs_roh_nv "Gaspedalposition D des Freeze Frame" UBYTE FORMULA_0065 0 0 0.0 100.0000 ECU_ADDRESS 0x3FA17F /end MEASUREMENT
/begin MEASUREMENT ed_fsp_2of20_.ff_pwg1_abs_roh_nv "Gaspedalposition D des Freeze Frame" UBYTE FORMULA_0065 0 0 0.0 100.0000 ECU_ADDRESS 0x3FA1D1 /end MEASUREMENT
/begin MEASUREMENT ed_fsp_3of20_.ff_pwg1_abs_roh_nv "Gaspedalposition D des Freeze Frame" UBYTE FORMULA_0065 0 0 0.0 100.0000 ECU_ADDRESS 0x3FA223 /end MEASUREMENT
/begin MEASUREMENT ed_fsp_4of20_.ff_pwg1_abs_roh_nv "Gaspedalposition D des Freeze Frame" UBYTE FORMULA_0065 0 0 0.0 100.0000 ECU_ADDRESS 0x3FA275 /end MEASUREMENT
/begin MEASUREMENT ed_fsp_5of20_.ff_pwg1_abs_roh_nv "Gaspedalposition D des Freeze Frame" UBYTE FORMULA_0065 0 0 0.0 100.0000 ECU_ADDRESS 0x3FA2C7 /end MEASUREMENT
/begin MEASUREMENT ed_fsp_6of20_.ff_pwg1_abs_roh_nv "Gaspedalposition D des Freeze Frame" UBYTE FORMULA_0065 0 0 0.0 100.0000 ECU_ADDRESS 0x3FA319 /end MEASUREMENT
/begin MEASUREMENT ed_fsp_7of20_.ff_pwg1_abs_roh_nv "Gaspedalposition D des Freeze Frame" UBYTE FORMULA_0065 0 0 0.0 100.0000 ECU_ADDRESS 0x3FA36B /end MEASUREMENT
/begin MEASUREMENT ed_fsp_8of20_.ff_pwg1_abs_roh_nv "Gaspedalposition D des Freeze Frame" UBYTE FORMULA_0065 0 0 0.0 100.0000 ECU_ADDRESS 0x3FA3BD /end MEASUREMENT
/begin MEASUREMENT ed_fsp_9of20_.ff_pwg1_abs_roh_nv "Gaspedalposition D des Freeze Frame" UBYTE FORMULA_0065 0 0 0.0 100.0000 ECU_ADDRESS 0x3FA40F /end MEASUREMENT
/begin MEASUREMENT ed_fsp_14of20_.ff_pwg1_abs_roh_nv "Gaspedalposition D des Freeze Frame" UBYTE FORMULA_0065 0 0 0.0 100.0000 ECU_ADDRESS 0x3FA5A9 /end MEASUREMENT
/begin MEASUREMENT ed_fsp_15of20_.ff_pwg1_abs_roh_nv "Gaspedalposition D des Freeze Frame" UBYTE FORMULA_0065 0 0 0.0 100.0000 ECU_ADDRESS 0x3FA5FB /end MEASUREMENT
/begin MEASUREMENT ed_fsp_16of20_.ff_pwg1_abs_roh_nv "Gaspedalposition D des Freeze Frame" UBYTE FORMULA_0065 0 0 0.0 100.0000 ECU_ADDRESS 0x3FA64D /end MEASUREMENT
/begin MEASUREMENT ed_fsp_17of20_.ff_pwg1_abs_roh_nv "Gaspedalposition D des Freeze Frame" UBYTE FORMULA_0065 0 0 0.0 100.0000 ECU_ADDRESS 0x3FA69F /end MEASUREMENT
/begin MEASUREMENT ed_fsp_18of20_.ff_pwg1_abs_roh_nv "Gaspedalposition D des Freeze Frame" UBYTE FORMULA_0065 0 0 0.0 100.0000 ECU_ADDRESS 0x3FA6F1 /end MEASUREMENT
/begin MEASUREMENT ed_fsp_19of20_.ff_pwg1_abs_roh_nv "Gaspedalposition D des Freeze Frame" UBYTE FORMULA_0065 0 0 0.0 100.0000 ECU_ADDRESS 0x3FA743 /end MEASUREMENT
/begin MEASUREMENT ed_fsp_20of20_.ff_pwg1_abs_roh_nv "Gaspedalposition D des Freeze Frame" UBYTE FORMULA_0065 0 0 0.0 100.0000 ECU_ADDRESS 0x3FA795 /end MEASUREMENT
/begin MEASUREMENT ed_fsp_1of20_.ff_pwg2_abs_roh_nv "Gaspedalposition E des Freeze Frame" UBYTE FORMULA_0065 0 0 0.0 100.0000 ECU_ADDRESS 0x3FA180 /end MEASUREMENT
/begin MEASUREMENT ed_fsp_2of20_.ff_pwg2_abs_roh_nv "Gaspedalposition E des Freeze Frame" UBYTE FORMULA_0065 0 0 0.0 100.0000 ECU_ADDRESS 0x3FA1D2 /end MEASUREMENT
/begin MEASUREMENT ed_fsp_3of20_.ff_pwg2_abs_roh_nv "Gaspedalposition E des Freeze Frame" UBYTE FORMULA_0065 0 0 0.0 100.0000 ECU_ADDRESS 0x3FA224 /end MEASUREMENT
/begin MEASUREMENT ed_fsp_4of20_.ff_pwg2_abs_roh_nv "Gaspedalposition E des Freeze Frame" UBYTE FORMULA_0065 0 0 0.0 100.0000 ECU_ADDRESS 0x3FA276 /end MEASUREMENT
/begin MEASUREMENT ed_fsp_5of20_.ff_pwg2_abs_roh_nv "Gaspedalposition E des Freeze Frame" UBYTE FORMULA_0065 0 0 0.0 100.0000 ECU_ADDRESS 0x3FA2C8 /end MEASUREMENT
/begin MEASUREMENT ed_fsp_6of20_.ff_pwg2_abs_roh_nv "Gaspedalposition E des Freeze Frame" UBYTE FORMULA_0065 0 0 0.0 100.0000 ECU_ADDRESS 0x3FA31A /end MEASUREMENT
/begin MEASUREMENT ed_fsp_7of20_.ff_pwg2_abs_roh_nv "Gaspedalposition E des Freeze Frame" UBYTE FORMULA_0065 0 0 0.0 100.0000 ECU_ADDRESS 0x3FA36C /end MEASUREMENT
/begin MEASUREMENT ed_fsp_8of20_.ff_pwg2_abs_roh_nv "Gaspedalposition E des Freeze Frame" UBYTE FORMULA_0065 0 0 0.0 100.0000 ECU_ADDRESS 0x3FA3BE /end MEASUREMENT
/begin MEASUREMENT ed_fsp_9of20_.ff_pwg2_abs_roh_nv "Gaspedalposition E des Freeze Frame" UBYTE FORMULA_0065 0 0 0.0 100.0000 ECU_ADDRESS 0x3FA410 /end MEASUREMENT
/begin MEASUREMENT ed_fsp_14of20_.ff_pwg2_abs_roh_nv "Gaspedalposition E des Freeze Frame" UBYTE FORMULA_0065 0 0 0.0 100.0000 ECU_ADDRESS 0x3FA5AA /end MEASUREMENT
/begin MEASUREMENT ed_fsp_15of20_.ff_pwg2_abs_roh_nv "Gaspedalposition E des Freeze Frame" UBYTE FORMULA_0065 0 0 0.0 100.0000 ECU_ADDRESS 0x3FA5FC /end MEASUREMENT
/begin MEASUREMENT ed_fsp_16of20_.ff_pwg2_abs_roh_nv "Gaspedalposition E des Freeze Frame" UBYTE FORMULA_0065 0 0 0.0 100.0000 ECU_ADDRESS 0x3FA64E /end MEASUREMENT
/begin MEASUREMENT ed_fsp_17of20_.ff_pwg2_abs_roh_nv "Gaspedalposition E des Freeze Frame" UBYTE FORMULA_0065 0 0 0.0 100.0000 ECU_ADDRESS 0x3FA6A0 /end MEASUREMENT
/begin MEASUREMENT ed_fsp_18of20_.ff_pwg2_abs_roh_nv "Gaspedalposition E des Freeze Frame" UBYTE FORMULA_0065 0 0 0.0 100.0000 ECU_ADDRESS 0x3FA6F2 /end MEASUREMENT
/begin MEASUREMENT ed_fsp_19of20_.ff_pwg2_abs_roh_nv "Gaspedalposition E des Freeze Frame" UBYTE FORMULA_0065 0 0 0.0 100.0000 ECU_ADDRESS 0x3FA744 /end MEASUREMENT
/begin MEASUREMENT ed_fsp_20of20_.ff_pwg2_abs_roh_nv "Gaspedalposition E des Freeze Frame" UBYTE FORMULA_0065 0 0 0.0 100.0000 ECU_ADDRESS 0x3FA796 /end MEASUREMENT
/begin MEASUREMENT ed_fsp_1of20_.ff_egas_soll_dk_b1_nv "Sollwert relative Drosselklappenposition des Freeze Frame" UBYTE FORMULA_0065 0 0 0.0 100.0000 ECU_ADDRESS 0x3FA181 /end MEASUREMENT
/begin MEASUREMENT ed_fsp_2of20_.ff_egas_soll_dk_b1_nv "Sollwert relative Drosselklappenposition des Freeze Frame" UBYTE FORMULA_0065 0 0 0.0 100.0000 ECU_ADDRESS 0x3FA1D3 /end MEASUREMENT
/begin MEASUREMENT ed_fsp_3of20_.ff_egas_soll_dk_b1_nv "Sollwert relative Drosselklappenposition des Freeze Frame" UBYTE FORMULA_0065 0 0 0.0 100.0000 ECU_ADDRESS 0x3FA225 /end MEASUREMENT
/begin MEASUREMENT ed_fsp_4of20_.ff_egas_soll_dk_b1_nv "Sollwert relative Drosselklappenposition des Freeze Frame" UBYTE FORMULA_0065 0 0 0.0 100.0000 ECU_ADDRESS 0x3FA277 /end MEASUREMENT
/begin MEASUREMENT ed_fsp_5of20_.ff_egas_soll_dk_b1_nv "Sollwert relative Drosselklappenposition des Freeze Frame" UBYTE FORMULA_0065 0 0 0.0 100.0000 ECU_ADDRESS 0x3FA2C9 /end MEASUREMENT
/begin MEASUREMENT ed_fsp_6of20_.ff_egas_soll_dk_b1_nv "Sollwert relative Drosselklappenposition des Freeze Frame" UBYTE FORMULA_0065 0 0 0.0 100.0000 ECU_ADDRESS 0x3FA31B /end MEASUREMENT
/begin MEASUREMENT ed_fsp_7of20_.ff_egas_soll_dk_b1_nv "Sollwert relative Drosselklappenposition des Freeze Frame" UBYTE FORMULA_0065 0 0 0.0 100.0000 ECU_ADDRESS 0x3FA36D /end MEASUREMENT
/begin MEASUREMENT ed_fsp_8of20_.ff_egas_soll_dk_b1_nv "Sollwert relative Drosselklappenposition des Freeze Frame" UBYTE FORMULA_0065 0 0 0.0 100.0000 ECU_ADDRESS 0x3FA3BF /end MEASUREMENT
/begin MEASUREMENT ed_fsp_9of20_.ff_egas_soll_dk_b1_nv "Sollwert relative Drosselklappenposition des Freeze Frame" UBYTE FORMULA_0065 0 0 0.0 100.0000 ECU_ADDRESS 0x3FA411 /end MEASUREMENT
/begin MEASUREMENT ed_fsp_15of20_.ff_egas_soll_dk_b1_nv "Sollwert relative Drosselklappenposition des Freeze Frame" UBYTE FORMULA_0065 0 0 0.0 100.0000 ECU_ADDRESS 0x3FA5FD /end MEASUREMENT
/begin MEASUREMENT ed_fsp_16of20_.ff_egas_soll_dk_b1_nv "Sollwert relative Drosselklappenposition des Freeze Frame" UBYTE FORMULA_0065 0 0 0.0 100.0000 ECU_ADDRESS 0x3FA64F /end MEASUREMENT
/begin MEASUREMENT ed_fsp_17of20_.ff_egas_soll_dk_b1_nv "Sollwert relative Drosselklappenposition des Freeze Frame" UBYTE FORMULA_0065 0 0 0.0 100.0000 ECU_ADDRESS 0x3FA6A1 /end MEASUREMENT
/begin MEASUREMENT ed_fsp_18of20_.ff_egas_soll_dk_b1_nv "Sollwert relative Drosselklappenposition des Freeze Frame" UBYTE FORMULA_0065 0 0 0.0 100.0000 ECU_ADDRESS 0x3FA6F3 /end MEASUREMENT
/begin MEASUREMENT ed_fsp_19of20_.ff_egas_soll_dk_b1_nv "Sollwert relative Drosselklappenposition des Freeze Frame" UBYTE FORMULA_0065 0 0 0.0 100.0000 ECU_ADDRESS 0x3FA745 /end MEASUREMENT
/begin MEASUREMENT ed_fsp_20of20_.ff_egas_soll_dk_b1_nv "Sollwert relative Drosselklappenposition des Freeze Frame" UBYTE FORMULA_0065 0 0 0.0 100.0000 ECU_ADDRESS 0x3FA797 /end MEASUREMENT
/begin MEASUREMENT ed_mil_st_inj "Mil-Status INJ" UBYTE FORMULA_0033 0 0 0.0 255.0000 ECU_ADDRESS 0x3F8884 /end MEASUREMENT
/begin MEASUREMENT ed_mil_bmw_inj "Mil-Status INJ" UBYTE FORMULA_0067 0 0 0.0 255.0 ECU_ADDRESS 0x3F8884 BIT_MASK 0x1 /end MEASUREMENT
/begin MEASUREMENT ed_mil_predrive_inj "Mil-Status INJ" UBYTE FORMULA_0068 0 0 0.0 255.0 ECU_ADDRESS 0x3F8884 BIT_MASK 0x2 /end MEASUREMENT
/begin MEASUREMENT ed_mil_dme_inj "Mil-Status INJ" UBYTE FORMULA_0069 0 0 0.0 255.0 ECU_ADDRESS 0x3F8884 BIT_MASK 0x80 /end MEASUREMENT
/begin MEASUREMENT ed_mil_st_ign "Mil-Status IGN" UBYTE FORMULA_0033 0 0 0.0 255.0000 ECU_ADDRESS 0x3F85A4 /end MEASUREMENT
/begin MEASUREMENT ed_mil_bmw_ign "Mil-Status IGN" UBYTE FORMULA_0067 0 0 0.0 255.0 ECU_ADDRESS 0x3F85A4 BIT_MASK 0x1 /end MEASUREMENT
/begin MEASUREMENT ed_mil_predrive_ign "Mil-Status IGN" UBYTE FORMULA_0068 0 0 0.0 255.0 ECU_ADDRESS 0x3F85A4 BIT_MASK 0x2 /end MEASUREMENT
/begin MEASUREMENT ed_mil_zyl_off_ign "Mil-Status IGN" UBYTE FORMULA_0070 0 0 0.0 255.0 ECU_ADDRESS 0x3F85A4 BIT_MASK 0x4 /end MEASUREMENT
/begin MEASUREMENT ed_mil_smg_ign "Mil-Status IGN" UBYTE FORMULA_0071 0 0 0.0 255.0 ECU_ADDRESS 0x3F85A4 BIT_MASK 0x8 /end MEASUREMENT
/begin MEASUREMENT ed_mil_dme_ign "Mil-Status IGN" UBYTE FORMULA_0069 0 0 0.0 255.0 ECU_ADDRESS 0x3F85A4 BIT_MASK 0x80 /end MEASUREMENT
/begin MEASUREMENT ed_loeschen "Uebergangsloesung zum Loeschen" UBYTE FORMULA_0072 0 0 0.0 255.0 ECU_ADDRESS 0x3FBF58 /end MEASUREMENT
/begin FUNCTION Eigendiagnose ""
 /begin OUT_MEASUREMENT ed_fsp_14of20_.ff_pwg1_abs_roh_nv ed_fsp_14of20_.ff_pwg2_abs_roh_nv ed_fsp_14of20_.ff_rf_b1_berech_nv ed_fsp_14of20_.ff_rf_b1_nv ed_fsp_14of20_.ff_sl_st_nv ed_fsp_14of20_.ff_tan_b1_nv ed_fsp_14of20_.ff_tev_b1_nv ed_fsp_14of20_.ff_time_ml_nv ed_fsp_14of20_.ff_tmot_nv ed_fsp_14of20_.ff_tumg_nv ed_fsp_14of20_.ff_tz1_nv ed_fsp_14of20_.ff_ub_nv ed_fsp_14of20_.ff_v_vorne_nv ed_fsp_14of20_.haeufigkeitszaehler_nv ed_fsp_14of20_.inj_fehlerzaehler_nv ed_fsp_14of20_.logistikzaehler_nv ed_fsp_14of20_.mil_filter_nv ed_fsp_14of20_.mil_filter_scdn_nv ed_fsp_14of20_.scdn_nenner_nv ed_fsp_14of20_.scdn_zaehler_nv ed_fsp_14of20_.uw_satz_1of3_.uw_km_stand_nv ed_fsp_14of20_.uw_satz_1of3_.uw_wert_nv_1of4_ ed_fsp_14of20_.uw_satz_1of3_.uw_wert_nv_2of4_ ed_fsp_14of20_.uw_satz_1of3_.uw_wert_nv_3of4_ ed_fsp_14of20_.uw_satz_1of3_.uw_wert_nv_4of4_ ed_fsp_14of20_.uw_satz_2of3_.uw_km_stand_nv ed_fsp_14of20_.uw_satz_2of3_.uw_wert_nv_1of4_ ed_fsp_14of20_.uw_satz_2of3_.uw_wert_nv_2of4_ ed_fsp_14of20_.uw_satz_2of3_.uw_wert_nv_3of4_ ed_fsp_14of20_.uw_satz_2of3_.uw_wert_nv_4of4_ ed_fsp_14of20_.uw_satz_3of3_.uw_km_stand_nv ed_fsp_14of20_.uw_satz_3of3_.uw_wert_nv_1of4_ ed_fsp_14of20_.uw_satz_3of3_.uw_wert_nv_2of4_ ed_fsp_14of20_.uw_satz_3of3_.uw_wert_nv_3of4_ ed_fsp_14of20_.uw_satz_3of3_.uw_wert_nv_4of4_ ed_fsp_15of20_.ed_fil_index_nv ed_fsp_15of20_.fehlerart_nv ed_fsp_15of20_.fehlercode_nv ed_fsp_15of20_.ff_egas_abs_dk_b1_nv ed_fsp_15of20_.ff_egas_ist_dk_b1_nv ed_fsp_15of20_.ff_egas_soll_dk_b1_nv ed_fsp_15of20_.ff_fst_nv ed_fsp_15of20_.ff_laa_f_ber_b1_nv ed_fsp_15of20_.ff_laa_f_ber_b2_nv ed_fsp_15of20_.ff_lam_reg_b1_nv ed_fsp_15of20_.ff_lam_reg_b2_nv ed_fsp_15of20_.ff_lam_reg_f_b1_nv ed_fsp_15of20_.ff_lam_reg_f_b2_nv ed_fsp_15of20_.ff_lam_soll_b1_nv ed_fsp_15of20_.ff_ml_b1_nv ed_fsp_15of20_.ff_n_nv ed_fsp_15of20_.ff_p_code_nv ed_fsp_15of20_.ff_pks_ist_nv ed_fsp_15of20_.ff_pumg_nv ed_fsp_15of20_.ff_pwg1_abs_roh_nv ed_fsp_15of20_.ff_pwg2_abs_roh_nv ed_fsp_15of20_.ff_rf_b1_berech_nv ed_fsp_15of20_.ff_rf_b1_nv ed_fsp_15of20_.ff_sl_st_nv ed_fsp_15of20_.ff_tan_b1_nv ed_fsp_15of20_.ff_tev_b1_nv ed_fsp_15of20_.ff_time_ml_nv ed_fsp_15of20_.ff_tmot_nv ed_fsp_15of20_.ff_tumg_nv ed_fsp_15of20_.ff_tz1_nv ed_fsp_15of20_.ff_ub_nv ed_fsp_15of20_.ff_v_vorne_nv ed_fsp_15of20_.haeufigkeitszaehler_nv ed_fsp_15of20_.inj_fehlerzaehler_nv ed_fsp_15of20_.logistikzaehler_nv ed_fsp_15of20_.mil_filter_nv ed_fsp_15of20_.mil_filter_scdn_nv ed_fsp_15of20_.scdn_nenner_nv ed_fsp_15of20_.scdn_zaehler_nv ed_fsp_15of20_.uw_satz_1of3_.uw_km_stand_nv ed_fsp_15of20_.uw_satz_1of3_.uw_wert_nv_1of4_ ed_fsp_15of20_.uw_satz_1of3_.uw_wert_nv_2of4_ ed_fsp_15of20_.uw_satz_1of3_.uw_wert_nv_3of4_ ed_fsp_15of20_.uw_satz_1of3_.uw_wert_nv_4of4_ ed_fsp_15of20_.uw_satz_2of3_.uw_km_stand_nv ed_fsp_15of20_.uw_satz_2of3_.uw_wert_nv_1of4_ ed_fsp_15of20_.uw_satz_2of3_.uw_wert_nv_2of4_ ed_fsp_15of20_.uw_satz_2of3_.uw_wert_nv_3of4_ ed_fsp_15of20_.uw_satz_2of3_.uw_wert_nv_4of4_ ed_fsp_15of20_.uw_satz_3of3_.uw_km_stand_nv ed_fsp_15of20_.uw_satz_3of3_.uw_wert_nv_1of4_ ed_fsp_15of20_.uw_satz_3of3_.uw_wert_nv_2of4_ ed_fsp_15of20_.uw_satz_3of3_.uw_wert_nv_3of4_ ed_fsp_15of20_.uw_satz_3of3_.uw_wert_nv_4of4_ ed_fsp_16of20_.ed_fil_index_nv ed_fsp_16of20_.fehlerart_nv ed_fsp_16of20_.fehlercode_nv ed_fsp_16of20_.ff_egas_abs_dk_b1_nv ed_fsp_16of20_.ff_egas_ist_dk_b1_nv ed_fsp_16of20_.ff_egas_soll_dk_b1_nv ed_fsp_16of20_.ff_fst_nv ed_fsp_16of20_.ff_laa_f_ber_b1_nv ed_fsp_16of20_.ff_laa_f_ber_b2_nv ed_fsp_16of20_.ff_lam_reg_b1_nv ed_fsp_16of20_.ff_lam_reg_b2_nv ed_fsp_16of20_.ff_lam_reg_f_b1_nv ed_fsp_16of20_.ff_lam_reg_f_b2_nv ed_fsp_16of20_.ff_lam_soll_b1_nv ed_fsp_16of20_.ff_ml_b1_nv ed_fsp_16of20_.ff_n_nv ed_fsp_16of20_.ff_p_code_nv ed_fsp_16of20_.ff_pks_ist_nv ed_fsp_16of20_.ff_pumg_nv ed_fsp_16of20_.ff_pwg1_abs_roh_nv ed_fsp_16of20_.ff_pwg2_abs_roh_nv ed_fsp_16of20_.ff_rf_b1_berech_nv ed_fsp_16of20_.ff_rf_b1_nv ed_fsp_16of20_.ff_sl_st_nv ed_fsp_16of20_.ff_tan_b1_nv ed_fsp_16of20_.ff_tev_b1_nv ed_fsp_16of20_.ff_time_ml_nv ed_fsp_16of20_.ff_tmot_nv ed_fsp_16of20_.ff_tumg_nv ed_fsp_16of20_.ff_tz1_nv ed_fsp_16of20_.ff_ub_nv ed_fsp_16of20_.ff_v_vorne_nv ed_fsp_16of20_.haeufigkeitszaehler_nv ed_fsp_16of20_.inj_fehlerzaehler_nv ed_fsp_16of20_.logistikzaehler_nv ed_fsp_16of20_.mil_filter_nv ed_fsp_16of20_.mil_filter_scdn_nv ed_fsp_16of20_.scdn_nenner_nv ed_fsp_16of20_.scdn_zaehler_nv ed_fsp_16of20_.uw_satz_1of3_.uw_km_stand_nv ed_fsp_16of20_.uw_satz_1of3_.uw_wert_nv_1of4_ ed_fsp_16of20_.uw_satz_1of3_.uw_wert_nv_2of4_ ed_fsp_16of20_.uw_satz_1of3_.uw_wert_nv_3of4_ ed_fsp_16of20_.uw_satz_1of3_.uw_wert_nv_4of4_ ed_fsp_16of20_.uw_satz_2of3_.uw_km_stand_nv ed_fsp_16of20_.uw_satz_2of3_.uw_wert_nv_1of4_ ed_fsp_16of20_.uw_satz_2of3_.uw_wert_nv_2of4_ ed_fsp_16of20_.uw_satz_2of3_.uw_wert_nv_3of4_ ed_fsp_16of20_.uw_satz_2of3_.uw_wert_nv_4of4_ ed_fsp_16of20_.uw_satz_3of3_.uw_km_stand_nv ed_fsp_16of20_.uw_satz_3of3_.uw_wert_nv_1of4_ ed_fsp_16of20_.uw_satz_3of3_.uw_wert_nv_2of4_ ed_fsp_16of20_.uw_satz_3of3_.uw_wert_nv_3of4_ ed_fsp_16of20_.uw_satz_3of3_.uw_wert_nv_4of4_ ed_fsp_17of20_.ed_fil_index_nv ed_fsp_17of20_.fehlerart_nv ed_fsp_17of20_.fehlercode_nv ed_fsp_17of20_.ff_egas_abs_dk_b1_nv ed_fsp_17of20_.ff_egas_ist_dk_b1_nv ed_fsp_17of20_.ff_egas_soll_dk_b1_nv ed_fsp_17of20_.ff_fst_nv ed_fsp_17of20_.ff_laa_f_ber_b1_nv ed_fsp_17of20_.ff_laa_f_ber_b2_nv ed_fsp_17of20_.ff_lam_reg_b1_nv ed_fsp_17of20_.ff_lam_reg_b2_nv ed_fsp_17of20_.ff_lam_reg_f_b1_nv ed_fsp_17of20_.ff_lam_reg_f_b2_nv ed_fsp_17of20_.ff_lam_soll_b1_nv ed_fsp_17of20_.ff_ml_b1_nv ed_fsp_17of20_.ff_n_nv ed_fsp_17of20_.ff_p_code_nv ed_fsp_17of20_.ff_pks_ist_nv ed_fsp_17of20_.ff_pumg_nv ed_fsp_17of20_.ff_pwg1_abs_roh_nv ed_fsp_17of20_.ff_pwg2_abs_roh_nv ed_fsp_17of20_.ff_rf_b1_berech_nv ed_fsp_17of20_.ff_rf_b1_nv ed_fsp_17of20_.ff_sl_st_nv ed_fsp_17of20_.ff_tan_b1_nv ed_fsp_17of20_.ff_tev_b1_nv ed_fsp_17of20_.ff_time_ml_nv ed_fsp_17of20_.ff_tmot_nv ed_fsp_17of20_.ff_tumg_nv ed_fsp_17of20_.ff_tz1_nv ed_fsp_17of20_.ff_ub_nv ed_fsp_17of20_.ff_v_vorne_nv ed_fsp_17of20_.haeufigkeitszaehler_nv ed_fsp_17of20_.inj_fehlerzaehler_nv ed_fsp_17of20_.logistikzaehler_nv ed_fsp_17of20_.mil_filter_nv ed_fsp_17of20_.mil_filter_scdn_nv ed_fsp_17of20_.scdn_nenner_nv ed_fsp_17of20_.scdn_zaehler_nv ed_fsp_17of20_.uw_satz_1of3_.uw_km_stand_nv ed_fsp_17of20_.uw_satz_1of3_.uw_wert_nv_1of4_ ed_fsp_17of20_.uw_satz_1of3_.uw_wert_nv_2of4_ ed_fsp_17of20_.uw_satz_1of3_.uw_wert_nv_3of4_ ed_fsp_17of20_.uw_satz_1of3_.uw_wert_nv_4of4_ ed_fsp_17of20_.uw_satz_2of3_.uw_km_stand_nv ed_fsp_17of20_.uw_satz_2of3_.uw_wert_nv_1of4_ ed_fsp_17of20_.uw_satz_2of3_.uw_wert_nv_2of4_ ed_fsp_17of20_.uw_satz_2of3_.uw_wert_nv_3of4_ ed_fsp_17of20_.uw_satz_2of3_.uw_wert_nv_4of4_ ed_fsp_17of20_.uw_satz_3of3_.uw_km_stand_nv ed_fsp_17of20_.uw_satz_3of3_.uw_wert_nv_1of4_ ed_fsp_17of20_.uw_satz_3of3_.uw_wert_nv_2of4_ ed_fsp_17of20_.uw_satz_3of3_.uw_wert_nv_3of4_ ed_fsp_17of20_.uw_satz_3of3_.uw_wert_nv_4of4_ ed_fsp_18of20_.ed_fil_index_nv ed_fsp_18of20_.fehlerart_nv ed_fsp_18of20_.fehlercode_nv ed_fsp_18of20_.ff_egas_abs_dk_b1_nv ed_fsp_18of20_.ff_egas_ist_dk_b1_nv ed_fsp_18of20_.ff_egas_soll_dk_b1_nv ed_fsp_18of20_.ff_fst_nv ed_fsp_18of20_.ff_laa_f_ber_b1_nv ed_fsp_18of20_.ff_laa_f_ber_b2_nv ed_fsp_18of20_.ff_lam_reg_b1_nv ed_fsp_18of20_.ff_lam_reg_b2_nv ed_fsp_18of20_.ff_lam_reg_f_b1_nv ed_fsp_18of20_.ff_lam_reg_f_b2_nv ed_fsp_18of20_.ff_lam_soll_b1_nv ed_fsp_18of20_.ff_ml_b1_nv ed_fsp_18of20_.ff_n_nv ed_fsp_18of20_.ff_p_code_nv ed_fsp_18of20_.ff_pks_ist_nv ed_fsp_18of20_.ff_pumg_nv ed_fsp_18of20_.ff_pwg1_abs_roh_nv ed_fsp_18of20_.ff_pwg2_abs_roh_nv ed_fsp_18of20_.ff_rf_b1_berech_nv ed_fsp_18of20_.ff_rf_b1_nv ed_fsp_18of20_.ff_sl_st_nv ed_fsp_18of20_.ff_tan_b1_nv ed_fsp_18of20_.ff_tev_b1_nv ed_fsp_18of20_.ff_time_ml_nv ed_fsp_18of20_.ff_tmot_nv ed_fsp_18of20_.ff_tumg_nv ed_fsp_18of20_.ff_tz1_nv ed_fsp_18of20_.ff_ub_nv ed_fsp_18of20_.ff_v_vorne_nv ed_fsp_18of20_.haeufigkeitszaehler_nv ed_fsp_18of20_.inj_fehlerzaehler_nv ed_fsp_18of20_.logistikzaehler_nv ed_fsp_18of20_.mil_filter_nv ed_fsp_18of20_.mil_filter_scdn_nv ed_fsp_18of20_.scdn_nenner_nv ed_fsp_18of20_.scdn_zaehler_nv ed_fsp_18of20_.uw_satz_1of3_.uw_km_stand_nv ed_fsp_18of20_.uw_satz_1of3_.uw_wert_nv_1of4_ ed_fsp_18of20_.uw_satz_1of3_.uw_wert_nv_2of4_ ed_fsp_18of20_.uw_satz_1of3_.uw_wert_nv_3of4_ ed_fsp_18of20_.uw_satz_1of3_.uw_wert_nv_4of4_ ed_fsp_18of20_.uw_satz_2of3_.uw_km_stand_nv ed_fsp_18of20_.uw_satz_2of3_.uw_wert_nv_1of4_ ed_fsp_18of20_.uw_satz_2of3_.uw_wert_nv_2of4_ ed_fsp_18of20_.uw_satz_2of3_.uw_wert_nv_3of4_ ed_fsp_18of20_.uw_satz_2of3_.uw_wert_nv_4of4_ ed_fsp_18of20_.uw_satz_3of3_.uw_km_stand_nv ed_fsp_18of20_.uw_satz_3of3_.uw_wert_nv_1of4_ ed_fsp_18of20_.uw_satz_3of3_.uw_wert_nv_2of4_ ed_fsp_18of20_.uw_satz_3of3_.uw_wert_nv_3of4_ ed_fsp_18of20_.uw_satz_3of3_.uw_wert_nv_4of4_ ed_fsp_19of20_.ed_fil_index_nv ed_fsp_19of20_.fehlerart_nv ed_fsp_19of20_.fehlercode_nv ed_fsp_19of20_.ff_egas_abs_dk_b1_nv ed_fsp_19of20_.ff_egas_ist_dk_b1_nv ed_fsp_19of20_.ff_egas_soll_dk_b1_nv ed_fsp_19of20_.ff_fst_nv ed_fsp_19of20_.ff_laa_f_ber_b1_nv ed_fsp_19of20_.ff_laa_f_ber_b2_nv ed_fsp_19of20_.ff_lam_reg_b1_nv ed_fsp_19of20_.ff_lam_reg_b2_nv ed_fsp_19of20_.ff_lam_reg_f_b1_nv ed_fsp_19of20_.ff_lam_reg_f_b2_nv ed_fsp_19of20_.ff_lam_soll_b1_nv ed_fsp_19of20_.ff_ml_b1_nv ed_fsp_19of20_.ff_n_nv ed_fsp_19of20_.ff_p_code_nv ed_fsp_19of20_.ff_pks_ist_nv ed_fsp_19of20_.ff_pumg_nv ed_fsp_19of20_.ff_pwg1_abs_roh_nv ed_fsp_19of20_.ff_pwg2_abs_roh_nv ed_fsp_19of20_.ff_rf_b1_berech_nv ed_fsp_19of20_.ff_rf_b1_nv ed_fsp_19of20_.ff_sl_st_nv ed_fsp_19of20_.ff_tan_b1_nv ed_fsp_19of20_.ff_tev_b1_nv ed_fsp_19of20_.ff_time_ml_nv ed_fsp_19of20_.ff_tmot_nv ed_fsp_19of20_.ff_tumg_nv ed_fsp_19of20_.ff_tz1_nv ed_fsp_19of20_.ff_ub_nv ed_fsp_19of20_.ff_v_vorne_nv ed_fsp_19of20_.haeufigkeitszaehler_nv ed_fsp_19of20_.inj_fehlerzaehler_nv ed_fsp_19of20_.logistikzaehler_nv ed_fsp_19of20_.mil_filter_nv ed_fsp_19of20_.mil_filter_scdn_nv ed_fsp_19of20_.scdn_nenner_nv ed_fsp_19of20_.scdn_zaehler_nv ed_fsp_19of20_.uw_satz_1of3_.uw_km_stand_nv ed_fsp_19of20_.uw_satz_1of3_.uw_wert_nv_1of4_ ed_fsp_19of20_.uw_satz_1of3_.uw_wert_nv_2of4_ ed_fsp_19of20_.uw_satz_1of3_.uw_wert_nv_3of4_ ed_fsp_19of20_.uw_satz_1of3_.uw_wert_nv_4of4_ ed_fsp_19of20_.uw_satz_2of3_.uw_km_stand_nv ed_fsp_19of20_.uw_satz_2of3_.uw_wert_nv_1of4_ ed_fsp_19of20_.uw_satz_2of3_.uw_wert_nv_2of4_ ed_fsp_19of20_.uw_satz_2of3_.uw_wert_nv_3of4_ ed_fsp_19of20_.uw_satz_2of3_.uw_wert_nv_4of4_ ed_fsp_19of20_.uw_satz_3of3_.uw_km_stand_nv ed_fsp_19of20_.uw_satz_3of3_.uw_wert_nv_1of4_ ed_fsp_19of20_.uw_satz_3of3_.uw_wert_nv_2of4_ ed_fsp_19of20_.uw_satz_3of3_.uw_wert_nv_3of4_ ed_fsp_19of20_.uw_satz_3of3_.uw_wert_nv_4of4_ ed_fsp_1of20_.ed_fil_index_nv ed_fsp_1of20_.fehlerart_nv ed_fsp_1of20_.fehlercode_nv ed_fsp_1of20_.ff_egas_abs_dk_b1_nv ed_fsp_1of20_.ff_egas_ist_dk_b1_nv ed_fsp_1of20_.ff_egas_soll_dk_b1_nv ed_fsp_1of20_.ff_fst_nv ed_fsp_1of20_.ff_laa_f_ber_b1_nv ed_fsp_1of20_.ff_laa_f_ber_b2_nv ed_fsp_1of20_.ff_lam_reg_b1_nv ed_fsp_1of20_.ff_lam_reg_b2_nv ed_fsp_1of20_.ff_lam_reg_f_b1_nv ed_fsp_1of20_.ff_lam_reg_f_b2_nv ed_fsp_1of20_.ff_lam_soll_b1_nv ed_fsp_1of20_.ff_ml_b1_nv ed_fsp_1of20_.ff_n_nv ed_fsp_1of20_.ff_p_code_nv ed_fsp_1of20_.ff_pks_ist_nv ed_fsp_1of20_.ff_pumg_nv ed_fsp_1of20_.ff_pwg1_abs_roh_nv ed_fsp_1of20_.ff_pwg2_abs_roh_nv ed_fsp_1of20_.ff_rf_b1_berech_nv ed_fsp_1of20_.ff_rf_b1_nv ed_fsp_1of20_.ff_sl_st_nv ed_fsp_1of20_.ff_tan_b1_nv ed_fsp_1of20_.ff_tev_b1_nv ed_fsp_1of20_.ff_time_ml_nv ed_fsp_1of20_.ff_tmot_nv ed_fsp_1of20_.ff_tumg_nv ed_fsp_1of20_.ff_tz1_nv ed_fsp_1of20_.ff_ub_nv ed_fsp_1of20_.ff_v_vorne_nv ed_fsp_1of20_.haeufigkeitszaehler_nv ed_fsp_1of20_.inj_fehlerzaehler_nv ed_fsp_1of20_.logistikzaehler_nv ed_fsp_1of20_.mil_filter_nv ed_fsp_1of20_.mil_filter_scdn_nv ed_fsp_1of20_.scdn_nenner_nv ed_fsp_1of20_.scdn_zaehler_nv ed_fsp_1of20_.uw_satz_1of3_.uw_km_stand_nv ed_fsp_1of20_.uw_satz_1of3_.uw_wert_nv_1of4_ ed_fsp_1of20_.uw_satz_1of3_.uw_wert_nv_2of4_ ed_fsp_1of20_.uw_satz_1of3_.uw_wert_nv_3of4_ ed_fsp_1of20_.uw_satz_1of3_.uw_wert_nv_4of4_ ed_fsp_1of20_.uw_satz_2of3_.uw_km_stand_nv ed_fsp_1of20_.uw_satz_2of3_.uw_wert_nv_1of4_ ed_fsp_1of20_.uw_satz_2of3_.uw_wert_nv_2of4_ ed_fsp_1of20_.uw_satz_2of3_.uw_wert_nv_3of4_ ed_fsp_1of20_.uw_satz_2of3_.uw_wert_nv_4of4_ ed_fsp_1of20_.uw_satz_3of3_.uw_km_stand_nv ed_fsp_1of20_.uw_satz_3of3_.uw_wert_nv_1of4_ ed_fsp_1of20_.uw_satz_3of3_.uw_wert_nv_2of4_ ed_fsp_1of20_.uw_satz_3of3_.uw_wert_nv_3of4_ ed_fsp_1of20_.uw_satz_3of3_.uw_wert_nv_4of4_ ed_fsp_20of20_.ed_fil_index_nv ed_fsp_20of20_.fehlerart_nv ed_fsp_20of20_.fehlercode_nv ed_fsp_20of20_.ff_egas_abs_dk_b1_nv ed_fsp_20of20_.ff_egas_ist_dk_b1_nv ed_fsp_20of20_.ff_egas_soll_dk_b1_nv ed_fsp_20of20_.ff_fst_nv ed_fsp_20of20_.ff_laa_f_ber_b1_nv ed_fsp_20of20_.ff_laa_f_ber_b2_nv ed_fsp_20of20_.ff_lam_reg_b1_nv ed_fsp_20of20_.ff_lam_reg_b2_nv ed_fsp_20of20_.ff_lam_reg_f_b1_nv ed_fsp_20of20_.ff_lam_reg_f_b2_nv ed_fsp_20of20_.ff_lam_soll_b1_nv ed_fsp_20of20_.ff_ml_b1_nv ed_fsp_20of20_.ff_n_nv ed_fsp_20of20_.ff_p_code_nv ed_fsp_20of20_.ff_pks_ist_nv ed_fsp_20of20_.ff_pumg_nv ed_fsp_20of20_.ff_pwg1_abs_roh_nv ed_fsp_20of20_.ff_pwg2_abs_roh_nv ed_fsp_20of20_.ff_rf_b1_berech_nv ed_fsp_20of20_.ff_rf_b1_nv ed_fsp_20of20_.ff_sl_st_nv ed_fsp_20of20_.ff_tan_b1_nv ed_fsp_20of20_.ff_tev_b1_nv ed_fsp_20of20_.ff_time_ml_nv ed_fsp_20of20_.ff_tmot_nv ed_fsp_20of20_.ff_tumg_nv ed_fsp_20of20_.ff_tz1_nv ed_fsp_20of20_.ff_ub_nv ed_fsp_20of20_.ff_v_vorne_nv ed_fsp_20of20_.haeufigkeitszaehler_nv ed_fsp_20of20_.inj_fehlerzaehler_nv ed_fsp_20of20_.logistikzaehler_nv ed_fsp_20of20_.mil_filter_nv ed_fsp_20of20_.mil_filter_scdn_nv ed_fsp_20of20_.scdn_nenner_nv ed_fsp_20of20_.scdn_zaehler_nv ed_fsp_20of20_.uw_satz_1of3_.uw_km_stand_nv ed_fsp_20of20_.uw_satz_1of3_.uw_wert_nv_1of4_ ed_fsp_20of20_.uw_satz_1of3_.uw_wert_nv_2of4_ ed_fsp_20of20_.uw_satz_1of3_.uw_wert_nv_3of4_ ed_fsp_20of20_.uw_satz_1of3_.uw_wert_nv_4of4_ ed_fsp_20of20_.uw_satz_2of3_.uw_km_stand_nv ed_fsp_20of20_.uw_satz_2of3_.uw_wert_nv_1of4_ ed_fsp_20of20_.uw_satz_2of3_.uw_wert_nv_2of4_ ed_fsp_20of20_.uw_satz_2of3_.uw_wert_nv_3of4_ ed_fsp_20of20_.uw_satz_2of3_.uw_wert_nv_4of4_ ed_fsp_20of20_.uw_satz_3of3_.uw_km_stand_nv ed_fsp_20of20_.uw_satz_3of3_.uw_wert_nv_1of4_ ed_fsp_20of20_.uw_satz_3of3_.uw_wert_nv_2of4_ ed_fsp_20of20_.uw_satz_3of3_.uw_wert_nv_3of4_ ed_fsp_20of20_.uw_satz_3of3_.uw_wert_nv_4of4_ ed_fsp_2of20_.ed_fil_index_nv ed_fsp_2of20_.fehlerart_nv ed_fsp_2of20_.fehlercode_nv ed_fsp_2of20_.ff_egas_abs_dk_b1_nv ed_fsp_2of20_.ff_egas_ist_dk_b1_nv ed_fsp_2of20_.ff_egas_soll_dk_b1_nv ed_fsp_2of20_.ff_fst_nv ed_fsp_2of20_.ff_laa_f_ber_b1_nv ed_fsp_2of20_.ff_laa_f_ber_b2_nv ed_fsp_2of20_.ff_lam_reg_b1_nv ed_fsp_2of20_.ff_lam_reg_b2_nv ed_fsp_2of20_.ff_lam_reg_f_b1_nv ed_fsp_2of20_.ff_lam_reg_f_b2_nv ed_fsp_2of20_.ff_lam_soll_b1_nv ed_fsp_2of20_.ff_ml_b1_nv ed_fsp_2of20_.ff_n_nv ed_fsp_2of20_.ff_p_code_nv ed_fsp_2of20_.ff_pks_ist_nv ed_fsp_2of20_.ff_pumg_nv ed_fsp_2of20_.ff_pwg1_abs_roh_nv ed_fsp_2of20_.ff_pwg2_abs_roh_nv ed_fsp_2of20_.ff_rf_b1_berech_nv ed_fsp_2of20_.ff_rf_b1_nv ed_fsp_2of20_.ff_sl_st_nv ed_fsp_2of20_.ff_tan_b1_nv ed_fsp_2of20_.ff_tev_b1_nv ed_fsp_2of20_.ff_time_ml_nv ed_fsp_2of20_.ff_tmot_nv ed_fsp_2of20_.ff_tumg_nv ed_fsp_2of20_.ff_tz1_nv ed_fsp_2of20_.ff_ub_nv ed_fsp_2of20_.ff_v_vorne_nv ed_fsp_2of20_.haeufigkeitszaehler_nv ed_fsp_2of20_.inj_fehlerzaehler_nv ed_fsp_2of20_.logistikzaehler_nv ed_fsp_2of20_.mil_filter_nv ed_fsp_2of20_.mil_filter_scdn_nv ed_fsp_2of20_.scdn_nenner_nv ed_fsp_2of20_.scdn_zaehler_nv ed_fsp_2of20_.uw_satz_1of3_.uw_km_stand_nv ed_fsp_2of20_.uw_satz_1of3_.uw_wert_nv_1of4_ ed_fsp_2of20_.uw_satz_1of3_.uw_wert_nv_2of4_ ed_fsp_2of20_.uw_satz_1of3_.uw_wert_nv_3of4_ ed_fsp_2of20_.uw_satz_1of3_.uw_wert_nv_4of4_ ed_fsp_2of20_.uw_satz_2of3_.uw_km_stand_nv ed_fsp_2of20_.uw_satz_2of3_.uw_wert_nv_1of4_ ed_fsp_2of20_.uw_satz_2of3_.uw_wert_nv_2of4_ ed_fsp_2of20_.uw_satz_2of3_.uw_wert_nv_3of4_ ed_fsp_2of20_.uw_satz_2of3_.uw_wert_nv_4of4_ ed_fsp_2of20_.uw_satz_3of3_.uw_km_stand_nv ed_fsp_2of20_.uw_satz_3of3_.uw_wert_nv_1of4_ ed_fsp_2of20_.uw_satz_3of3_.uw_wert_nv_2of4_ ed_fsp_2of20_.uw_satz_3of3_.uw_wert_nv_3of4_ ed_fsp_2of20_.uw_satz_3of3_.uw_wert_nv_4of4_ ed_fsp_3of20_.ed_fil_index_nv ed_fsp_3of20_.fehlerart_nv ed_fsp_3of20_.fehlercode_nv ed_fsp_3of20_.ff_egas_abs_dk_b1_nv ed_fsp_3of20_.ff_egas_ist_dk_b1_nv ed_fsp_3of20_.ff_egas_soll_dk_b1_nv ed_fsp_3of20_.ff_fst_nv ed_fsp_3of20_.ff_laa_f_ber_b1_nv ed_fsp_3of20_.ff_laa_f_ber_b2_nv ed_fsp_3of20_.ff_lam_reg_b1_nv ed_fsp_3of20_.ff_lam_reg_b2_nv ed_fsp_3of20_.ff_lam_reg_f_b1_nv ed_fsp_3of20_.ff_lam_reg_f_b2_nv ed_fsp_3of20_.ff_lam_soll_b1_nv ed_fsp_3of20_.ff_ml_b1_nv ed_fsp_3of20_.ff_n_nv ed_fsp_3of20_.ff_p_code_nv ed_fsp_3of20_.ff_pks_ist_nv ed_fsp_3of20_.ff_pumg_nv ed_fsp_3of20_.ff_pwg1_abs_roh_nv ed_fsp_3of20_.ff_pwg2_abs_roh_nv ed_fsp_3of20_.ff_rf_b1_berech_nv ed_fsp_3of20_.ff_rf_b1_nv ed_fsp_3of20_.ff_sl_st_nv ed_fsp_3of20_.ff_tan_b1_nv ed_fsp_3of20_.ff_tev_b1_nv ed_fsp_3of20_.ff_time_ml_nv ed_fsp_3of20_.ff_tmot_nv ed_fsp_3of20_.ff_tumg_nv ed_fsp_3of20_.ff_tz1_nv ed_fsp_3of20_.ff_ub_nv ed_fsp_3of20_.ff_v_vorne_nv ed_fsp_3of20_.haeufigkeitszaehler_nv ed_fsp_3of20_.inj_fehlerzaehler_nv ed_fsp_3of20_.logistikzaehler_nv ed_fsp_3of20_.mil_filter_nv ed_fsp_3of20_.mil_filter_scdn_nv ed_fsp_3of20_.scdn_nenner_nv ed_fsp_3of20_.scdn_zaehler_nv ed_fsp_3of20_.uw_satz_1of3_.uw_km_stand_nv ed_fsp_3of20_.uw_satz_1of3_.uw_wert_nv_1of4_ ed_fsp_3of20_.uw_satz_1of3_.uw_wert_nv_2of4_ ed_fsp_3of20_.uw_satz_1of3_.uw_wert_nv_3of4_ ed_fsp_3of20_.uw_satz_1of3_.uw_wert_nv_4of4_ ed_fsp_3of20_.uw_satz_2of3_.uw_km_stand_nv ed_fsp_3of20_.uw_satz_2of3_.uw_wert_nv_1of4_ ed_fsp_3of20_.uw_satz_2of3_.uw_wert_nv_2of4_ ed_fsp_3of20_.uw_satz_2of3_.uw_wert_nv_3of4_ ed_fsp_3of20_.uw_satz_2of3_.uw_wert_nv_4of4_ ed_fsp_3of20_.uw_satz_3of3_.uw_km_stand_nv ed_fsp_3of20_.uw_satz_3of3_.uw_wert_nv_1of4_ ed_fsp_3of20_.uw_satz_3of3_.uw_wert_nv_2of4_ ed_fsp_3of20_.uw_satz_3of3_.uw_wert_nv_3of4_ ed_fsp_3of20_.uw_satz_3of3_.uw_wert_nv_4of4_ ed_fsp_4of20_.ed_fil_index_nv ed_fsp_4of20_.fehlerart_nv ed_fsp_4of20_.fehlercode_nv ed_fsp_4of20_.ff_egas_abs_dk_b1_nv ed_fsp_4of20_.ff_egas_ist_dk_b1_nv ed_fsp_4of20_.ff_egas_soll_dk_b1_nv ed_fsp_4of20_.ff_fst_nv ed_fsp_4of20_.ff_laa_f_ber_b1_nv ed_fsp_4of20_.ff_laa_f_ber_b2_nv ed_fsp_4of20_.ff_lam_reg_b1_nv ed_fsp_4of20_.ff_lam_reg_b2_nv ed_fsp_4of20_.ff_lam_reg_f_b1_nv ed_fsp_4of20_.ff_lam_reg_f_b2_nv ed_fsp_4of20_.ff_lam_soll_b1_nv ed_fsp_4of20_.ff_ml_b1_nv ed_fsp_4of20_.ff_n_nv ed_fsp_4of20_.ff_p_code_nv ed_fsp_4of20_.ff_pks_ist_nv ed_fsp_4of20_.ff_pumg_nv ed_fsp_4of20_.ff_pwg1_abs_roh_nv ed_fsp_4of20_.ff_pwg2_abs_roh_nv ed_fsp_4of20_.ff_rf_b1_berech_nv ed_fsp_4of20_.ff_rf_b1_nv ed_fsp_4of20_.ff_sl_st_nv ed_fsp_4of20_.ff_tan_b1_nv ed_fsp_4of20_.ff_tev_b1_nv ed_fsp_4of20_.ff_time_ml_nv ed_fsp_4of20_.ff_tmot_nv ed_fsp_4of20_.ff_tumg_nv ed_fsp_4of20_.ff_tz1_nv ed_fsp_4of20_.ff_ub_nv ed_fsp_4of20_.ff_v_vorne_nv ed_fsp_4of20_.haeufigkeitszaehler_nv ed_fsp_4of20_.inj_fehlerzaehler_nv ed_fsp_4of20_.logistikzaehler_nv ed_fsp_4of20_.mil_filter_nv ed_fsp_4of20_.mil_filter_scdn_nv ed_fsp_4of20_.scdn_nenner_nv ed_fsp_4of20_.scdn_zaehler_nv ed_fsp_4of20_.uw_satz_1of3_.uw_km_stand_nv ed_fsp_4of20_.uw_satz_1of3_.uw_wert_nv_1of4_ ed_fsp_4of20_.uw_satz_1of3_.uw_wert_nv_2of4_ ed_fsp_4of20_.uw_satz_1of3_.uw_wert_nv_3of4_ ed_fsp_4of20_.uw_satz_1of3_.uw_wert_nv_4of4_ ed_fsp_4of20_.uw_satz_2of3_.uw_km_stand_nv ed_fsp_4of20_.uw_satz_2of3_.uw_wert_nv_1of4_ ed_fsp_4of20_.uw_satz_2of3_.uw_wert_nv_2of4_ ed_fsp_4of20_.uw_satz_2of3_.uw_wert_nv_3of4_ ed_fsp_4of20_.uw_satz_2of3_.uw_wert_nv_4of4_ ed_fsp_4of20_.uw_satz_3of3_.uw_km_stand_nv ed_fsp_4of20_.uw_satz_3of3_.uw_wert_nv_1of4_ ed_fsp_4of20_.uw_satz_3of3_.uw_wert_nv_2of4_ ed_fsp_4of20_.uw_satz_3of3_.uw_wert_nv_3of4_ ed_fsp_4of20_.uw_satz_3of3_.uw_wert_nv_4of4_ ed_fsp_5of20_.ed_fil_index_nv ed_fsp_5of20_.fehlerart_nv ed_fsp_5of20_.fehlercode_nv ed_fsp_5of20_.ff_egas_abs_dk_b1_nv ed_fsp_5of20_.ff_egas_ist_dk_b1_nv ed_fsp_5of20_.ff_egas_soll_dk_b1_nv ed_fsp_5of20_.ff_fst_nv ed_fsp_5of20_.ff_laa_f_ber_b1_nv ed_fsp_5of20_.ff_laa_f_ber_b2_nv ed_fsp_5of20_.ff_lam_reg_b1_nv ed_fsp_5of20_.ff_lam_reg_b2_nv ed_fsp_5of20_.ff_lam_reg_f_b1_nv ed_fsp_5of20_.ff_lam_reg_f_b2_nv ed_fsp_5of20_.ff_lam_soll_b1_nv ed_fsp_5of20_.ff_ml_b1_nv ed_fsp_5of20_.ff_n_nv ed_fsp_5of20_.ff_p_code_nv ed_fsp_5of20_.ff_pks_ist_nv ed_fsp_5of20_.ff_pumg_nv ed_fsp_5of20_.ff_pwg1_abs_roh_nv ed_fsp_5of20_.ff_pwg2_abs_roh_nv ed_fsp_5of20_.ff_rf_b1_berech_nv ed_fsp_5of20_.ff_rf_b1_nv ed_fsp_5of20_.ff_sl_st_nv ed_fsp_5of20_.ff_tan_b1_nv ed_fsp_5of20_.ff_tev_b1_nv ed_fsp_5of20_.ff_time_ml_nv ed_fsp_5of20_.ff_tmot_nv ed_fsp_5of20_.ff_tumg_nv ed_fsp_5of20_.ff_tz1_nv ed_fsp_5of20_.ff_ub_nv ed_fsp_5of20_.ff_v_vorne_nv ed_fsp_5of20_.haeufigkeitszaehler_nv ed_fsp_5of20_.inj_fehlerzaehler_nv ed_fsp_5of20_.logistikzaehler_nv ed_fsp_5of20_.mil_filter_nv ed_fsp_5of20_.mil_filter_scdn_nv ed_fsp_5of20_.scdn_nenner_nv ed_fsp_5of20_.scdn_zaehler_nv ed_fsp_5of20_.uw_satz_1of3_.uw_km_stand_nv ed_fsp_5of20_.uw_satz_1of3_.uw_wert_nv_1of4_ ed_fsp_5of20_.uw_satz_1of3_.uw_wert_nv_2of4_ ed_fsp_5of20_.uw_satz_1of3_.uw_wert_nv_3of4_ ed_fsp_5of20_.uw_satz_1of3_.uw_wert_nv_4of4_ ed_fsp_5of20_.uw_satz_2of3_.uw_km_stand_nv ed_fsp_5of20_.uw_satz_2of3_.uw_wert_nv_1of4_ ed_fsp_5of20_.uw_satz_2of3_.uw_wert_nv_2of4_ ed_fsp_5of20_.uw_satz_2of3_.uw_wert_nv_3of4_ ed_fsp_5of20_.uw_satz_2of3_.uw_wert_nv_4of4_ ed_fsp_5of20_.uw_satz_3of3_.uw_km_stand_nv ed_fsp_5of20_.uw_satz_3of3_.uw_wert_nv_1of4_ ed_fsp_5of20_.uw_satz_3of3_.uw_wert_nv_2of4_ ed_fsp_5of20_.uw_satz_3of3_.uw_wert_nv_3of4_ ed_fsp_5of20_.uw_satz_3of3_.uw_wert_nv_4of4_ ed_fsp_6of20_.ed_fil_index_nv ed_fsp_6of20_.fehlerart_nv ed_fsp_6of20_.fehlercode_nv ed_fsp_6of20_.ff_egas_abs_dk_b1_nv ed_fsp_6of20_.ff_egas_ist_dk_b1_nv ed_fsp_6of20_.ff_egas_soll_dk_b1_nv ed_fsp_6of20_.ff_fst_nv ed_fsp_6of20_.ff_laa_f_ber_b1_nv ed_fsp_6of20_.ff_laa_f_ber_b2_nv ed_fsp_6of20_.ff_lam_reg_b1_nv ed_fsp_6of20_.ff_lam_reg_b2_nv ed_fsp_6of20_.ff_lam_reg_f_b1_nv ed_fsp_6of20_.ff_lam_reg_f_b2_nv ed_fsp_6of20_.ff_lam_soll_b1_nv ed_fsp_6of20_.ff_ml_b1_nv ed_fsp_6of20_.ff_n_nv ed_fsp_6of20_.ff_p_code_nv ed_fsp_6of20_.ff_pks_ist_nv ed_fsp_6of20_.ff_pumg_nv ed_fsp_6of20_.ff_pwg1_abs_roh_nv ed_fsp_6of20_.ff_pwg2_abs_roh_nv ed_fsp_6of20_.ff_rf_b1_berech_nv ed_fsp_6of20_.ff_rf_b1_nv ed_fsp_6of20_.ff_sl_st_nv ed_fsp_6of20_.ff_tan_b1_nv ed_fsp_6of20_.ff_tev_b1_nv ed_fsp_6of20_.ff_time_ml_nv ed_fsp_6of20_.ff_tmot_nv ed_fsp_6of20_.ff_tumg_nv ed_fsp_6of20_.ff_tz1_nv ed_fsp_6of20_.ff_ub_nv ed_fsp_6of20_.ff_v_vorne_nv ed_fsp_6of20_.haeufigkeitszaehler_nv ed_fsp_6of20_.inj_fehlerzaehler_nv ed_fsp_6of20_.logistikzaehler_nv ed_fsp_6of20_.mil_filter_nv ed_fsp_6of20_.mil_filter_scdn_nv ed_fsp_6of20_.scdn_nenner_nv ed_fsp_6of20_.scdn_zaehler_nv ed_fsp_6of20_.uw_satz_1of3_.uw_km_stand_nv ed_fsp_6of20_.uw_satz_1of3_.uw_wert_nv_1of4_ ed_fsp_6of20_.uw_satz_1of3_.uw_wert_nv_2of4_ ed_fsp_6of20_.uw_satz_1of3_.uw_wert_nv_3of4_ ed_fsp_6of20_.uw_satz_1of3_.uw_wert_nv_4of4_ ed_fsp_6of20_.uw_satz_2of3_.uw_km_stand_nv ed_fsp_6of20_.uw_satz_2of3_.uw_wert_nv_1of4_ ed_fsp_6of20_.uw_satz_2of3_.uw_wert_nv_2of4_ ed_fsp_6of20_.uw_satz_2of3_.uw_wert_nv_3of4_ ed_fsp_6of20_.uw_satz_2of3_.uw_wert_nv_4of4_ ed_fsp_6of20_.uw_satz_3of3_.uw_km_stand_nv ed_fsp_6of20_.uw_satz_3of3_.uw_wert_nv_1of4_ ed_fsp_6of20_.uw_satz_3of3_.uw_wert_nv_2of4_ ed_fsp_6of20_.uw_satz_3of3_.uw_wert_nv_3of4_ ed_fsp_6of20_.uw_satz_3of3_.uw_wert_nv_4of4_ ed_fsp_7of20_.ed_fil_index_nv ed_fsp_7of20_.fehlerart_nv ed_fsp_7of20_.fehlercode_nv ed_fsp_7of20_.ff_egas_abs_dk_b1_nv ed_fsp_7of20_.ff_egas_ist_dk_b1_nv ed_fsp_7of20_.ff_egas_soll_dk_b1_nv ed_fsp_7of20_.ff_fst_nv ed_fsp_7of20_.ff_laa_f_ber_b1_nv ed_fsp_7of20_.ff_laa_f_ber_b2_nv ed_fsp_7of20_.ff_lam_reg_b1_nv ed_fsp_7of20_.ff_lam_reg_b2_nv ed_fsp_7of20_.ff_lam_reg_f_b1_nv ed_fsp_7of20_.ff_lam_reg_f_b2_nv ed_fsp_7of20_.ff_lam_soll_b1_nv ed_fsp_7of20_.ff_ml_b1_nv ed_fsp_7of20_.ff_n_nv ed_fsp_7of20_.ff_p_code_nv ed_fsp_7of20_.ff_pks_ist_nv ed_fsp_7of20_.ff_pumg_nv ed_fsp_7of20_.ff_pwg1_abs_roh_nv ed_fsp_7of20_.ff_pwg2_abs_roh_nv ed_fsp_7of20_.ff_rf_b1_berech_nv ed_fsp_7of20_.ff_rf_b1_nv ed_fsp_7of20_.ff_sl_st_nv ed_fsp_7of20_.ff_tan_b1_nv ed_fsp_7of20_.ff_tev_b1_nv ed_fsp_7of20_.ff_time_ml_nv ed_fsp_7of20_.ff_tmot_nv ed_fsp_7of20_.ff_tumg_nv ed_fsp_7of20_.ff_tz1_nv ed_fsp_7of20_.ff_ub_nv ed_fsp_7of20_.ff_v_vorne_nv ed_fsp_7of20_.haeufigkeitszaehler_nv ed_fsp_7of20_.inj_fehlerzaehler_nv ed_fsp_7of20_.logistikzaehler_nv ed_fsp_7of20_.mil_filter_nv ed_fsp_7of20_.mil_filter_scdn_nv ed_fsp_7of20_.scdn_nenner_nv ed_fsp_7of20_.scdn_zaehler_nv ed_fsp_7of20_.uw_satz_1of3_.uw_km_stand_nv ed_fsp_7of20_.uw_satz_1of3_.uw_wert_nv_1of4_ ed_fsp_7of20_.uw_satz_1of3_.uw_wert_nv_2of4_ ed_fsp_7of20_.uw_satz_1of3_.uw_wert_nv_3of4_ ed_fsp_7of20_.uw_satz_1of3_.uw_wert_nv_4of4_ ed_fsp_7of20_.uw_satz_2of3_.uw_km_stand_nv ed_fsp_7of20_.uw_satz_2of3_.uw_wert_nv_1of4_ ed_fsp_7of20_.uw_satz_2of3_.uw_wert_nv_2of4_ ed_fsp_7of20_.uw_satz_2of3_.uw_wert_nv_3of4_ ed_fsp_7of20_.uw_satz_2of3_.uw_wert_nv_4of4_ ed_fsp_7of20_.uw_satz_3of3_.uw_km_stand_nv ed_fsp_7of20_.uw_satz_3of3_.uw_wert_nv_1of4_ ed_fsp_7of20_.uw_satz_3of3_.uw_wert_nv_2of4_ ed_fsp_7of20_.uw_satz_3of3_.uw_wert_nv_3of4_ ed_fsp_7of20_.uw_satz_3of3_.uw_wert_nv_4of4_ ed_fsp_8of20_.ed_fil_index_nv ed_fsp_8of20_.fehlerart_nv ed_fsp_8of20_.fehlercode_nv ed_fsp_8of20_.ff_egas_abs_dk_b1_nv ed_fsp_8of20_.ff_egas_ist_dk_b1_nv ed_fsp_8of20_.ff_egas_soll_dk_b1_nv ed_fsp_8of20_.ff_fst_nv ed_fsp_8of20_.ff_laa_f_ber_b1_nv ed_fsp_8of20_.ff_laa_f_ber_b2_nv ed_fsp_8of20_.ff_lam_reg_b1_nv ed_fsp_8of20_.ff_lam_reg_b2_nv ed_fsp_8of20_.ff_lam_reg_f_b1_nv ed_fsp_8of20_.ff_lam_reg_f_b2_nv ed_fsp_8of20_.ff_lam_soll_b1_nv ed_fsp_8of20_.ff_ml_b1_nv ed_fsp_8of20_.ff_n_nv ed_fsp_8of20_.ff_p_code_nv ed_fsp_8of20_.ff_pks_ist_nv ed_fsp_8of20_.ff_pumg_nv ed_fsp_8of20_.ff_pwg1_abs_roh_nv ed_fsp_8of20_.ff_pwg2_abs_roh_nv ed_fsp_8of20_.ff_rf_b1_berech_nv ed_fsp_8of20_.ff_rf_b1_nv ed_fsp_8of20_.ff_sl_st_nv ed_fsp_8of20_.ff_tan_b1_nv ed_fsp_8of20_.ff_tev_b1_nv ed_fsp_8of20_.ff_time_ml_nv ed_fsp_8of20_.ff_tmot_nv ed_fsp_8of20_.ff_tumg_nv ed_fsp_8of20_.ff_tz1_nv ed_fsp_8of20_.ff_ub_nv ed_fsp_8of20_.ff_v_vorne_nv ed_fsp_8of20_.haeufigkeitszaehler_nv ed_fsp_8of20_.inj_fehlerzaehler_nv ed_fsp_8of20_.logistikzaehler_nv ed_fsp_8of20_.mil_filter_nv ed_fsp_8of20_.mil_filter_scdn_nv ed_fsp_8of20_.scdn_nenner_nv ed_fsp_8of20_.scdn_zaehler_nv ed_fsp_8of20_.uw_satz_1of3_.uw_km_stand_nv ed_fsp_8of20_.uw_satz_1of3_.uw_wert_nv_1of4_ ed_fsp_8of20_.uw_satz_1of3_.uw_wert_nv_2of4_ ed_fsp_8of20_.uw_satz_1of3_.uw_wert_nv_3of4_ ed_fsp_8of20_.uw_satz_1of3_.uw_wert_nv_4of4_ ed_fsp_8of20_.uw_satz_2of3_.uw_km_stand_nv ed_fsp_8of20_.uw_satz_2of3_.uw_wert_nv_1of4_ ed_fsp_8of20_.uw_satz_2of3_.uw_wert_nv_2of4_ ed_fsp_8of20_.uw_satz_2of3_.uw_wert_nv_3of4_ ed_fsp_8of20_.uw_satz_2of3_.uw_wert_nv_4of4_ ed_fsp_8of20_.uw_satz_3of3_.uw_km_stand_nv ed_fsp_8of20_.uw_satz_3of3_.uw_wert_nv_1of4_ ed_fsp_8of20_.uw_satz_3of3_.uw_wert_nv_2of4_ ed_fsp_8of20_.uw_satz_3of3_.uw_wert_nv_3of4_ ed_fsp_8of20_.uw_satz_3of3_.uw_wert_nv_4of4_ ed_fsp_9of20_.ed_fil_index_nv ed_fsp_9of20_.fehlerart_nv ed_fsp_9of20_.fehlercode_nv ed_fsp_9of20_.ff_egas_abs_dk_b1_nv ed_fsp_9of20_.ff_egas_ist_dk_b1_nv ed_fsp_9of20_.ff_egas_soll_dk_b1_nv ed_fsp_9of20_.ff_fst_nv ed_fsp_9of20_.ff_laa_f_ber_b1_nv ed_fsp_9of20_.ff_laa_f_ber_b2_nv ed_fsp_9of20_.ff_lam_reg_b1_nv ed_fsp_9of20_.ff_lam_reg_b2_nv ed_fsp_9of20_.ff_lam_reg_f_b1_nv ed_fsp_9of20_.ff_lam_reg_f_b2_nv ed_fsp_9of20_.ff_lam_soll_b1_nv ed_fsp_9of20_.ff_ml_b1_nv ed_fsp_9of20_.ff_n_nv ed_fsp_9of20_.ff_p_code_nv ed_fsp_9of20_.ff_pks_ist_nv ed_fsp_9of20_.ff_pumg_nv ed_fsp_9of20_.ff_pwg1_abs_roh_nv ed_fsp_9of20_.ff_pwg2_abs_roh_nv ed_fsp_9of20_.ff_rf_b1_berech_nv ed_fsp_9of20_.ff_rf_b1_nv ed_fsp_9of20_.ff_sl_st_nv ed_fsp_9of20_.ff_tan_b1_nv ed_fsp_9of20_.ff_tev_b1_nv ed_fsp_9of20_.ff_time_ml_nv ed_fsp_9of20_.ff_tmot_nv ed_fsp_9of20_.ff_tumg_nv ed_fsp_9of20_.ff_tz1_nv ed_fsp_9of20_.ff_ub_nv ed_fsp_9of20_.ff_v_vorne_nv ed_fsp_9of20_.haeufigkeitszaehler_nv ed_fsp_9of20_.inj_fehlerzaehler_nv ed_fsp_9of20_.logistikzaehler_nv ed_fsp_9of20_.mil_filter_nv ed_fsp_9of20_.mil_filter_scdn_nv ed_fsp_9of20_.scdn_nenner_nv ed_fsp_9of20_.scdn_zaehler_nv ed_fsp_9of20_.uw_satz_1of3_.uw_km_stand_nv ed_fsp_9of20_.uw_satz_1of3_.uw_wert_nv_1of4_ ed_fsp_9of20_.uw_satz_1of3_.uw_wert_nv_2of4_ ed_fsp_9of20_.uw_satz_1of3_.uw_wert_nv_3of4_ ed_fsp_9of20_.uw_satz_1of3_.uw_wert_nv_4of4_ ed_fsp_9of20_.uw_satz_2of3_.uw_km_stand_nv ed_fsp_9of20_.uw_satz_2of3_.uw_wert_nv_1of4_ ed_fsp_9of20_.uw_satz_2of3_.uw_wert_nv_2of4_ ed_fsp_9of20_.uw_satz_2of3_.uw_wert_nv_3of4_ ed_fsp_9of20_.uw_satz_2of3_.uw_wert_nv_4of4_ ed_fsp_9of20_.uw_satz_3of3_.uw_km_stand_nv ed_fsp_9of20_.uw_satz_3of3_.uw_wert_nv_1of4_ ed_fsp_9of20_.uw_satz_3of3_.uw_wert_nv_2of4_ ed_fsp_9of20_.uw_satz_3of3_.uw_wert_nv_3of4_ ed_fsp_9of20_.uw_satz_3of3_.uw_wert_nv_4of4_ ed_loeschen ed_mil_bmw_ign ed_mil_bmw_inj ed_mil_dme_ign ed_mil_dme_inj ed_mil_off_km_stand_nv ed_mil_on_km_stand_nv ed_mil_predrive_ign ed_mil_predrive_inj ed_mil_smg_ign ed_mil_st_ign ed_mil_st_inj ed_mil_zyl_off_ign ed_rbm_appl_data_inj.denominator_nv ed_rbm_appl_data_inj.numerator_nv ed_rbm_denominator_nv ed_rbm_dk1_enltg.denominator_nv ed_rbm_dk1_enltg.numerator_nv ed_rbm_dk2_enltg.denominator_nv ed_rbm_dk2_enltg.numerator_nv ed_rbm_dmtl_deckel.denominator_nv ed_rbm_dmtl_deckel.numerator_nv ed_rbm_dmtl_feinleck.denominator_nv ed_rbm_dmtl_feinleck.numerator_nv ed_rbm_dmtl_feucht.denominator_nv ed_rbm_dmtl_feucht.numerator_nv ed_rbm_dmtl_grobleck.denominator_nv ed_rbm_dmtl_grobleck.numerator_nv ed_rbm_dmtl_h.denominator_nv ed_rbm_dmtl_h.numerator_nv ed_rbm_dmtl_p.denominator_nv ed_rbm_dmtl_p.numerator_nv ed_rbm_dmtl_v.denominator_nv ed_rbm_dmtl_v.numerator_nv ed_rbm_e2_inj.denominator_nv ed_rbm_e2_inj.numerator_nv ed_rbm_ebox_elu.denominator_nv ed_rbm_ebox_elu.numerator_nv ed_rbm_ekp_pwm.denominator_nv ed_rbm_ekp_pwm.numerator_nv ed_rbm_elu.denominator_nv ed_rbm_elu.numerator_nv ed_rbm_elup.denominator_nv ed_rbm_elup.numerator_nv ed_rbm_elup_obd.denominator_nv ed_rbm_elup_obd.numerator_nv ed_rbm_ev1.denominator_nv ed_rbm_ev1.numerator_nv ed_rbm_ev10.denominator_nv ed_rbm_ev10.numerator_nv ed_rbm_ev2.denominator_nv ed_rbm_ev2.numerator_nv ed_rbm_ev3.denominator_nv ed_rbm_ev3.numerator_nv ed_rbm_ev4.denominator_nv ed_rbm_ev4.numerator_nv ed_rbm_ev5.denominator_nv ed_rbm_ev5.numerator_nv ed_rbm_ev6.denominator_nv /end OUT_MEASUREMENT
/end FUNCTION
/end MODULE
/end PROJECT
