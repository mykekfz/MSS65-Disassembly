/begin PROJECT MSS65-inj-V452 "MSS65 INJ - V452.01-B204.00, data set 0569Q60Z160E"
/begin HEADER "" VERSION "V452.01-B204.00" /end HEADER
/begin MODULE _MSS65-inj "MSS65 INJ - V452.01-B204.00, calibration xxxxxxxx"
/begin MOD_COMMON "" BYTE_ORDER MSB_FIRST /* Default byteorder (Motorola) */ /end MOD_COMMON
/begin COMPU_METHOD FORMULA_0001 "FORMULA_0001" RAT_FUNC "%6.1" "%" COEFFS 0 10 0 0 0 1 /end COMPU_METHOD
/begin COMPU_METHOD FORMULA_0003 "FORMULA_0003" RAT_FUNC "%3.0" "-" COEFFS 0 1 0 0 0 1 /end COMPU_METHOD
/begin COMPU_METHOD FORMULA_0006 "FORMULA_0006" RAT_FUNC "%5.0" "Upm" COEFFS 0 1 0 0 0 1 /end COMPU_METHOD
/begin COMPU_METHOD FORMULA_0007 "FORMULA_0007" RAT_FUNC "%8.3" "-" COEFFS 0 10000 0 0 0 1 /end COMPU_METHOD
/begin COMPU_METHOD FORMULA_0008 "FORMULA_0008" RAT_FUNC "%6.1" "V" COEFFS 0 10 0 0 0 1 /end COMPU_METHOD
/begin COMPU_METHOD FORMULA_0010 "FORMULA_0010" RAT_FUNC "%5.0" "-" COEFFS 0 1 0 0 0 1 /end COMPU_METHOD
/begin COMPU_METHOD FORMULA_0021 "FORMULA_0021" RAT_FUNC "%7.2" "s" COEFFS 0 100 0 0 0 1 /end COMPU_METHOD
/* ------------------ Abschnitt erzeugt aus adapt_glob.dat ------------------ */
/begin COMPU_METHOD FORMULA_0023 "FORMULA_0023" RAT_FUNC "%6.1" "�C" COEFFS 0 10 2732 0 0 1 /end COMPU_METHOD
/begin COMPU_METHOD FORMULA_0024 "FORMULA_0024" RAT_FUNC "%9.4" "-" COEFFS 0 32768 0 0 0 1 /end COMPU_METHOD
/begin COMPU_METHOD FORMULA_0025 "FORMULA_0025" RAT_FUNC "%8.3" "-" COEFFS 0 16384 0 0 0 1 /end COMPU_METHOD
/begin COMPU_METHOD FORMULA_0033 "FORMULA_0033" RAT_FUNC "%5.2" "-" COEFFS 0 1 0 0 0 1 /end COMPU_METHOD
/begin COMPU_METHOD FORMULA_0062 "FORMULA_0062" RAT_FUNC "%5.0" "s" COEFFS 0 1 0 0 0 1 /end COMPU_METHOD
/begin COMPU_METHOD FORMULA_0073 "FORMULA_0073" RAT_FUNC "%6.1" "s" COEFFS 0 10 0 0 0 1 /end COMPU_METHOD
/begin COMPU_METHOD FORMULA_0074 "FORMULA_0074" RAT_FUNC "%7.0" "us" COEFFS 0 1 0 0 0 1 /end COMPU_METHOD
/begin COMPU_METHOD FORMULA_0075 "FORMULA_0075" RAT_FUNC "%8.3" "-" COEFFS 0 1024 0 0 0 1 /end COMPU_METHOD
/begin COMPU_METHOD FORMULA_0077 "FORMULA_0077" RAT_FUNC "%6.1" "mbar" COEFFS 0 16 0 0 0 1 /end COMPU_METHOD
/begin COMPU_METHOD FORMULA_0078 "FORMULA_0078" RAT_FUNC "%6.1" "km/h" COEFFS 0 16 0 0 0 1 /end COMPU_METHOD
/* ------------------ Abschnitt erzeugt aus glob.dat ------------------ */
/begin COMPU_METHOD FORMULA_0083 "FORMULA_0083" RAT_FUNC "%7.2" "-" COEFFS 0 1 0 0 0 1 /end COMPU_METHOD
/begin COMPU_METHOD FORMULA_0111 "FORMULA_0111" RAT_FUNC "%6.1" "�KW" COEFFS 0 10 0 0 0 1 /end COMPU_METHOD
/begin COMPU_METHOD FORMULA_0115 "FORMULA_0115" RAT_FUNC "%7.2" "%" COEFFS 0 16384 0 0 0 100 /end COMPU_METHOD
/begin COMPU_METHOD FORMULA_0123 "FORMULA_0123" RAT_FUNC "%5.0" "digit" COEFFS 0 1 0 0 0 1 /end COMPU_METHOD
/begin COMPU_METHOD FORMULA_0132 "FORMULA_0132" RAT_FUNC "%7.2" "m/(s*s)" COEFFS 0 40 0 0 0 1 /end COMPU_METHOD
/begin COMPU_METHOD FORMULA_0152 "FORMULA_0152" RAT_FUNC "%9.2" "s" COEFFS 0 100 0 0 0 1 /end COMPU_METHOD
/begin COMPU_METHOD FORMULA_0216 "FORMULA_0216" TAB_VERB "%5.2" "-" COMPU_TAB_REF FORMULA_0216_VTAB /end COMPU_METHOD
/begin COMPU_VTAB FORMULA_0216_VTAB "FORMULA_0216_VTAB" TAB_VERB 2 0 "nein" 1 "ja" /end COMPU_VTAB
/begin COMPU_METHOD FORMULA_0217 "FORMULA_0217" TAB_VERB "%5.2" "-" COMPU_TAB_REF FORMULA_0217_VTAB /end COMPU_METHOD
/begin COMPU_VTAB FORMULA_0217_VTAB "FORMULA_0217_VTAB" TAB_VERB 2 0 "nein" 1 "ja" /end COMPU_VTAB
/begin COMPU_METHOD FORMULA_0218 "FORMULA_0218" TAB_VERB "%5.2" "-" COMPU_TAB_REF FORMULA_0218_VTAB /end COMPU_METHOD
/begin COMPU_VTAB FORMULA_0218_VTAB "FORMULA_0218_VTAB" TAB_VERB 2 0 "nein" 1 "ja" /end COMPU_VTAB
/begin COMPU_METHOD FORMULA_0219 "FORMULA_0219" TAB_VERB "%5.2" "-" COMPU_TAB_REF FORMULA_0219_VTAB /end COMPU_METHOD
/begin COMPU_VTAB FORMULA_0219_VTAB "FORMULA_0219_VTAB" TAB_VERB 2 0 "nein" 1 "ja" /end COMPU_VTAB
/begin COMPU_METHOD FORMULA_0220 "FORMULA_0220" TAB_VERB "%5.2" "-" COMPU_TAB_REF FORMULA_0220_VTAB /end COMPU_METHOD
/begin COMPU_VTAB FORMULA_0220_VTAB "FORMULA_0220_VTAB" TAB_VERB 2 0 "nein" 1 "ja" /end COMPU_VTAB
/begin COMPU_METHOD FORMULA_0221 "FORMULA_0221" TAB_VERB "%5.2" "-" COMPU_TAB_REF FORMULA_0221_VTAB /end COMPU_METHOD
/begin COMPU_VTAB FORMULA_0221_VTAB "FORMULA_0221_VTAB" TAB_VERB 2 0 "nein" 1 "ja" /end COMPU_VTAB
/begin COMPU_METHOD FORMULA_0222 "FORMULA_0222" TAB_VERB "%5.2" "-" COMPU_TAB_REF FORMULA_0222_VTAB /end COMPU_METHOD
/begin COMPU_VTAB FORMULA_0222_VTAB "FORMULA_0222_VTAB" TAB_VERB 2 0 "nein" 1 "ja" /end COMPU_VTAB
/begin COMPU_METHOD FORMULA_0232 "FORMULA_0232" RAT_FUNC "%3.0" "s" COEFFS 0 1 0 0 0 1 /end COMPU_METHOD
/begin COMPU_METHOD FORMULA_0277 "FORMULA_0277" RAT_FUNC "%8.3" "V" COEFFS 0 1 0 0 0 0.00155892 /end COMPU_METHOD
/begin COMPU_METHOD FORMULA_0295 "FORMULA_0295" RAT_FUNC "%9.4" "-" COEFFS 0 16384 0 0 0 1 /end COMPU_METHOD
/begin COMPU_METHOD FORMULA_0317 "FORMULA_0317" RAT_FUNC "%5.2" "s" COEFFS 0 100 0 0 0 1 /end COMPU_METHOD
/* ------------------ Abschnitt erzeugt aus version.dat ------------------ */
/begin COMPU_METHOD FORMULA_0414 "FORMULA_0414" TAB_VERB "%3.0" "-" COMPU_TAB_REF FORMULA_0414_VTAB /end COMPU_METHOD
/begin COMPU_VTAB FORMULA_0414_VTAB "FORMULA_0414_VTAB" TAB_VERB 63 45 "-" 48 "0" 49 "1" 50 "2" 51 "3" 52 "4" 53 "5" 54 "6" 55 "7" 56 "8" 57 "9" 65 "A" 66 "B" 67 "C" 68 "D" 69 "E" 70 "F" 71 "G" 72 "H" 73 "I" 74 "J" 75 "K" 76 "L" 77 "M" 78 "N" 79 "O" 80 "P" 81 "Q" 82 "R" 83 "S" 84 "T" 85 "U" 86 "V" 87 "W" 88 "X" 89 "Y" 90 "Z" 97 "a" 98 "b" 99 "c" 100 "d" 101 "e" 102 "f" 103 "g" 104 "h" 105 "i" 106 "j" 107 "k" 108 "l" 109 "m" 110 "n" 111 "o" 112 "p" 113 "q" 114 "r" 115 "s" 116 "t" 117 "u" 118 "v" 119 "w" 120 "x" 121 "y" 122 "z" DEFAULT_VALUE "DEZ" /end COMPU_VTAB
/begin COMPU_METHOD FORMULA_0415 "FORMULA_0415" TAB_VERB "%5.2" "-" COMPU_TAB_REF FORMULA_0415_VTAB /end COMPU_METHOD
/begin COMPU_VTAB FORMULA_0415_VTAB "FORMULA_0415_VTAB" TAB_VERB 29 0 "Labordaten" 1 "ZS-E-45" 2 "Master" 3 "Prerauer" 4 "Erler" 5 "Heiss" 6 "Lutz" 7 "Maier" 8 "Andritzky" 9 "Neumann" 10 "Wilke" 11 "Scherer" 12 "Erdoedy" 13 "Fischer" 14 "May" 15 "ECE" 16 "US" 17 "Habermann" 18 "Moesbauer" 19 "Hartke" 20 "Renner" 21 "Stoll" 22 "Schaefer" 23 "Ast" 24 "Eickmeyer" 25 "Biebl" 26 "Betz" 27 "NN2" 28 "NN2" DEFAULT_VALUE "unbekannt" /end COMPU_VTAB
/begin COMPU_METHOD FORMULA_0416 "FORMULA_0416" TAB_VERB "%5.2" "-" COMPU_TAB_REF FORMULA_0416_VTAB /end COMPU_METHOD
/begin COMPU_VTAB FORMULA_0416_VTAB "FORMULA_0416_VTAB" TAB_VERB 6 177 "B1-Muster" 178 "B2-Muster" 179 "B3-Muster" 193 "C1-Muster" 194 "C2-Muster" 255 "ohne Kennung" /end COMPU_VTAB
/begin COMPU_METHOD FORMULA_0417 "FORMULA_0417" TAB_VERB "%5.2" "-" COMPU_TAB_REF FORMULA_0417_VTAB /end COMPU_METHOD
/begin COMPU_VTAB FORMULA_0417_VTAB "FORMULA_0417_VTAB" TAB_VERB 2 1 "INJ" 2 "IGN" DEFAULT_VALUE "undefiniert" /end COMPU_VTAB
/* ------------------ Abschnitt erzeugt aus dgen.dat ------------------ */
/begin COMPU_METHOD FORMULA_0458 "FORMULA_0458" RAT_FUNC "%4.1" "s" COEFFS 0 10 0 0 0 1 /end COMPU_METHOD
/begin COMPU_METHOD FORMULA_0530 "FORMULA_0530" RAT_FUNC "%7.2" "mg" COEFFS 0 32 0 0 0 1 /end COMPU_METHOD
/begin COMPU_METHOD FORMULA_0543 "FORMULA_0543" RAT_FUNC "%3.0" "Diags" COEFFS 0 1 0 0 0 1 /end COMPU_METHOD
/begin COMPU_METHOD FORMULA_0545 "FORMULA_0545" TAB_VERB "%5.2" "-" COMPU_TAB_REF FORMULA_0545_VTAB /end COMPU_METHOD
/begin COMPU_VTAB FORMULA_0545_VTAB "FORMULA_0545_VTAB" TAB_VERB 2 0 "nein" 1 "ja" /end COMPU_VTAB
/begin COMPU_METHOD FORMULA_0546 "FORMULA_0546" TAB_VERB "%5.2" "-" COMPU_TAB_REF FORMULA_0546_VTAB /end COMPU_METHOD
/begin COMPU_VTAB FORMULA_0546_VTAB "FORMULA_0546_VTAB" TAB_VERB 2 0 "nein" 1 "ja" /end COMPU_VTAB
/begin COMPU_METHOD FORMULA_0547 "FORMULA_0547" TAB_VERB "%5.2" "-" COMPU_TAB_REF FORMULA_0547_VTAB /end COMPU_METHOD
/begin COMPU_VTAB FORMULA_0547_VTAB "FORMULA_0547_VTAB" TAB_VERB 2 0 "nein" 1 "ja" /end COMPU_VTAB
/begin COMPU_METHOD FORMULA_0548 "FORMULA_0548" TAB_VERB "%5.2" "-" COMPU_TAB_REF FORMULA_0548_VTAB /end COMPU_METHOD
/begin COMPU_VTAB FORMULA_0548_VTAB "FORMULA_0548_VTAB" TAB_VERB 2 0 "nein" 1 "ja" /end COMPU_VTAB
/begin COMPU_METHOD FORMULA_0551 "FORMULA_0551" RAT_FUNC "%7.2" "mA" COEFFS 0 1 0 0 0 0.00225 /end COMPU_METHOD
/begin COMPU_METHOD FORMULA_0553 "FORMULA_0553" RAT_FUNC "%5.0" "min" COEFFS 0 1 0 0 0 1 /end COMPU_METHOD
/begin COMPU_METHOD FORMULA_0554 "FORMULA_0554" TAB_VERB "%5.2" "-" COMPU_TAB_REF FORMULA_0554_VTAB /end COMPU_METHOD
/begin COMPU_VTAB FORMULA_0554_VTAB "FORMULA_0554_VTAB" TAB_VERB 51 0 "AUS" 1 "BEREIT" 2 "WAIT_KLA" 3 "WAIT_V" 4 "WAIT_N" 5 "WAIT_UB" 6 "WAIT_PMIN" 7 "WAIT_TEMP" 8 "WAIT_FST" 9 "WAIT_TEV" 10 "WAIT_EXD" 11 "WAIT_FEHLER_LOESCH" 12 "WAIT_VENTIL" 13 "WAIT_AY" 14 "WAIT_FEUCHT" 20 "START" 21 "REFDIA1" 22 "VENTIL_CHK" 23 "DECKELDIA" 24 "GROBLECKDIA" 25 "FEINLECKDIA" 26 "DECKEL_REFDIA2" 27 "GROB_REFDIA2" 28 "FEIN_REFDIA2" 29 "VENTIL_CHK2" 32 "DECKEL_DICHT" 33 "GROB_DICHT" 34 "FEIN_DICHT" 35 "DECKELLECK" 36 "GROBLECK" 37 "FEINLECK" 40 "ABBRUCH_UB_DIFF" 41 "ABBRUCH_I_REF_DIFF" 42 "ABBRUCH_TEV" 43 "ABBRUCH_KL15" 44 "ABBRUCH_N" 45 "ABBRUCH_V" 46 "ABBRUCH_KS" 47 "ABBRUCH_EXD" 48 "ABBRUCH_REF_ZU_GROSS" 49 "ABBRUCH_REF_ZU_KLEIN" 50 "ABBRUCH_VERSTOPFT" 51 "ABBRUCH_NACHTANK" 52 "ABBRUCH_TANKDECKEL" 53 "ABBRUCH_AIRBAG" 54 "ABBRUCH_I_REF_1/2" 55 "ABBRUCH_DI2" 56 "ABBRUCH_AY" 57 "ABBRUCH_I_REF2_DIFF" 58 "ABBRUCH_UB_MIN" 59 "ABBRUCH_POWER_DOWN" DEFAULT_VALUE "undef" /end COMPU_VTAB
/begin COMPU_METHOD FORMULA_0557 "FORMULA_0557" RAT_FUNC "%4.1" "l" COEFFS 0 2 0 0 0 1 /end COMPU_METHOD
/begin COMPU_METHOD FORMULA_0600 "FORMULA_0600" RAT_FUNC "%7.2" "min" COEFFS 0 60 0 0 0 1 /end COMPU_METHOD
/* ------------------ Abschnitt erzeugt aus dmtl.dat ------------------ */
/begin COMPU_METHOD FORMULA_0635 "FORMULA_0635" TAB_VERB "%5.2" "-" COMPU_TAB_REF FORMULA_0635_VTAB /end COMPU_METHOD
/begin COMPU_VTAB FORMULA_0635_VTAB "FORMULA_0635_VTAB" TAB_VERB 1 0 "AUS" DEFAULT_VALUE "EIN" /end COMPU_VTAB
/begin COMPU_METHOD FORMULA_0636 "FORMULA_0636" TAB_VERB "%5.2" "-" COMPU_TAB_REF FORMULA_0636_VTAB /end COMPU_METHOD
/begin COMPU_VTAB FORMULA_0636_VTAB "FORMULA_0636_VTAB" TAB_VERB 2 0 "nein" 1 "ks_to_gnd" /end COMPU_VTAB
/begin COMPU_METHOD FORMULA_0637 "FORMULA_0637" TAB_VERB "%5.2" "-" COMPU_TAB_REF FORMULA_0637_VTAB /end COMPU_METHOD
/begin COMPU_VTAB FORMULA_0637_VTAB "FORMULA_0637_VTAB" TAB_VERB 2 0 "aus" 1 "ein" /end COMPU_VTAB
/begin COMPU_METHOD FORMULA_0638 "FORMULA_0638" TAB_VERB "%5.2" "-" COMPU_TAB_REF FORMULA_0638_VTAB /end COMPU_METHOD
/begin COMPU_VTAB FORMULA_0638_VTAB "FORMULA_0638_VTAB" TAB_VERB 2 0 "nein" 1 "angefordert" /end COMPU_VTAB
/begin COMPU_METHOD FORMULA_0639 "FORMULA_0639" TAB_VERB "%5.2" "-" COMPU_TAB_REF FORMULA_0639_VTAB /end COMPU_METHOD
/begin COMPU_VTAB FORMULA_0639_VTAB "FORMULA_0639_VTAB" TAB_VERB 2 0 "o.k" 1 "Kurzschluss" /end COMPU_VTAB
/begin COMPU_METHOD FORMULA_0640 "FORMULA_0640" TAB_VERB "%5.2" "-" COMPU_TAB_REF FORMULA_0640_VTAB /end COMPU_METHOD
/begin COMPU_VTAB FORMULA_0640_VTAB "FORMULA_0640_VTAB" TAB_VERB 2 0 "1.Stabil" 1 "2.Stabil laeuft" /end COMPU_VTAB
/begin COMPU_METHOD FORMULA_0641 "FORMULA_0641" TAB_VERB "%5.2" "-" COMPU_TAB_REF FORMULA_0641_VTAB /end COMPU_METHOD
/begin COMPU_VTAB FORMULA_0641_VTAB "FORMULA_0641_VTAB" TAB_VERB 2 0 "nein" 1 "erfuellt" /end COMPU_VTAB
/begin COMPU_METHOD FORMULA_0642 "FORMULA_0642" TAB_VERB "%5.2" "-" COMPU_TAB_REF FORMULA_0642_VTAB /end COMPU_METHOD
/begin COMPU_VTAB FORMULA_0642_VTAB "FORMULA_0642_VTAB" TAB_VERB 2 0 "aus" 1 "ein" /end COMPU_VTAB
/begin COMPU_METHOD FORMULA_0643 "FORMULA_0643" RAT_FUNC "%5.2" "" COEFFS 0 128 0 0 0 1 /end COMPU_METHOD
/begin COMPU_METHOD FORMULA_0644 "FORMULA_0644" RAT_FUNC "%7.2" "uA" COEFFS 0 65536 0 0 0 2.25 /end COMPU_METHOD
/begin COMPU_METHOD FORMULA_0645 "FORMULA_0645" RAT_FUNC "%3.0" "ms" COEFFS 0 2 0 0 0 1 /end COMPU_METHOD
/begin COMPU_METHOD FORMULA_0646 "FORMULA_0646" TAB_VERB "%5.2" "-" COMPU_TAB_REF FORMULA_0646_VTAB /end COMPU_METHOD
/begin COMPU_VTAB FORMULA_0646_VTAB "FORMULA_0646_VTAB" TAB_VERB 3 0 "Ohne DMTL" 1 "Mit DMTL" 2 "Keine Fehlerheilung" DEFAULT_VALUE "undef." /end COMPU_VTAB
/begin COMPU_METHOD FORMULA_0647 "FORMULA_0647" RAT_FUNC "%4.1" "V" COEFFS 0 10 0 0 0 1 /end COMPU_METHOD
/begin COMPU_METHOD FORMULA_0648 "FORMULA_0648" RAT_FUNC "%5.2" "" COEFFS 0 255 0 0 0 1 /end COMPU_METHOD
/begin COMPU_METHOD FORMULA_0649 "FORMULA_0649" TAB_VERB "%5.2" "-" COMPU_TAB_REF FORMULA_0649_VTAB /end COMPU_METHOD
/begin COMPU_VTAB FORMULA_0649_VTAB "FORMULA_0649_VTAB" TAB_VERB 4 0 "Aus" 1 "Deckeldia" 2 "Grobleck" 4 "Feinleck" DEFAULT_VALUE "undef." /end COMPU_VTAB
/begin COMPU_METHOD FORMULA_0650 "FORMULA_0650" RAT_FUNC "%6.1" "s" COEFFS 0 100 0 0 0 1 /end COMPU_METHOD
/begin COMPU_METHOD FORMULA_0651 "FORMULA_0651" RAT_FUNC "%6.3" "s" COEFFS 0 0 1.28 0 1 0 /end COMPU_METHOD
/begin COMPU_METHOD FORMULA_0652 "FORMULA_0652" RAT_FUNC "%3.0" "ms" COEFFS 0 1 0 0 0 1 /end COMPU_METHOD
/begin COMPU_METHOD FORMULA_0653 "FORMULA_0653" RAT_FUNC "%3.0" "ms" COEFFS 0 1 0 0 0 5 /end COMPU_METHOD
/begin COMPU_METHOD FORMULA_0654 "FORMULA_0654" RAT_FUNC "%6.1" "min" COEFFS 0 1 0 0 0 0.1706666 /end COMPU_METHOD
/begin COMPU_METHOD FORMULA_0655 "FORMULA_0655" RAT_FUNC "%5.2" "-" COEFFS 0 32 0 0 0 1 /end COMPU_METHOD
/begin COMPU_METHOD FORMULA_0656 "FORMULA_0656" TAB_VERB "%5.2" "-" COMPU_TAB_REF FORMULA_0656_VTAB /end COMPU_METHOD
/begin COMPU_VTAB FORMULA_0656_VTAB "FORMULA_0656_VTAB" TAB_VERB 2 0 "1x Stabilzeit" 1 "2x Stabilzeit" DEFAULT_VALUE "undef." /end COMPU_VTAB
/begin COMPU_METHOD FORMULA_0657 "FORMULA_0657" RAT_FUNC "%7.2" "V" COEFFS 0 640 0 0 0 1 /end COMPU_METHOD
/begin COMPU_METHOD FORMULA_0658 "FORMULA_0658" RAT_FUNC "%3.0" "s" COEFFS 0 1 0 0 0 2 /end COMPU_METHOD
/begin COMPU_METHOD FORMULA_0664 "FORMULA_0664" RAT_FUNC "%5.2" "s" COEFFS 0 0 2.56 0 1 0 /end COMPU_METHOD
/begin COMPU_METHOD FORMULA_0683 "FORMULA_0683" RAT_FUNC "%5.2" "s" COEFFS 0 0 25.6 0 1 0 /end COMPU_METHOD
/begin COMPU_METHOD FORMULA_0709 "FORMULA_0709" RAT_FUNC "%6.1" "%" COEFFS 0 100 0 0 0 1 /end COMPU_METHOD
/begin COMPU_METHOD FORMULA_0752 "FORMULA_0752" RAT_FUNC "%7.2" "mg" COEFFS 0 64 0 0 0 1 /end COMPU_METHOD
/begin COMPU_METHOD FORMULA_0755 "FORMULA_0755" RAT_FUNC "%7.2" "-" COEFFS 0 256 0 0 0 1 /end COMPU_METHOD
/begin COMPU_METHOD FORMULA_0763 "FORMULA_0763" RAT_FUNC "%8.3" "-" COEFFS 0 8192 0 0 0 1 /end COMPU_METHOD
/begin COMPU_METHOD FORMULA_0932 "FORMULA_0932" RAT_FUNC "%5.0" "s" COEFFS 0 100 0 0 0 1 /end COMPU_METHOD
/begin COMPU_METHOD FORMULA_0984 "FORMULA_0984" RAT_FUNC "%5.0" "mbar" COEFFS 0 16 0 0 0 1 /end COMPU_METHOD
/begin COMPU_METHOD FORMULA_0986 "FORMULA_0986" RAT_FUNC "%8.3" "mbar" COEFFS 0 16 0 0 0 1 /end COMPU_METHOD
/begin COMPU_METHOD FORMULA_0988 "FORMULA_0988" RAT_FUNC "%8.3" "mbar/V" COEFFS 0 80 0 0 0 1 /end COMPU_METHOD
/* ------------------ Abschnitt erzeugt aus pumg.dat ------------------ */
/begin COMPU_METHOD FORMULA_1056 "FORMULA_1056" TAB_VERB "%3.0" "-" COMPU_TAB_REF FORMULA_1056_VTAB /end COMPU_METHOD
/begin COMPU_VTAB FORMULA_1056_VTAB "FORMULA_1056_VTAB" TAB_VERB 2 0 "nein" 1 "ja" DEFAULT_VALUE "undef" /end COMPU_VTAB
/begin COMPU_METHOD FORMULA_1057 "FORMULA_1057" RAT_FUNC "%8.1" "mbar" COEFFS 0 16 0 0 0 1 /end COMPU_METHOD
/begin COMPU_METHOD FORMULA_1058 "FORMULA_1058" RAT_FUNC "%6.1" "mbar/s" COEFFS 0 16 0 0 0 10 /end COMPU_METHOD
/begin COMPU_METHOD FORMULA_1059 "FORMULA_1059" RAT_FUNC "%7.2" "s" COEFFS 0 0 6553.5 0 1 0 /end COMPU_METHOD
/begin COMPU_METHOD FORMULA_1060 "FORMULA_1060" RAT_FUNC "%7.2" "mbar" COEFFS 0 16 0 0 0 1 /end COMPU_METHOD
/begin COMPU_METHOD FORMULA_1061 "FORMULA_1061" TAB_VERB "%3.0" "-" COMPU_TAB_REF FORMULA_1061_VTAB /end COMPU_METHOD
/begin COMPU_VTAB FORMULA_1061_VTAB "FORMULA_1061_VTAB" TAB_VERB 3 0 "pumg_obd aus" 1 "Modell kontinuierlich" 2 "Modell einmalig" DEFAULT_VALUE "undef" /end COMPU_VTAB
/begin COMPU_METHOD FORMULA_1062 "FORMULA_1062" TAB_VERB "%3.0" "-" COMPU_TAB_REF FORMULA_1062_VTAB /end COMPU_METHOD
/begin COMPU_VTAB FORMULA_1062_VTAB "FORMULA_1062_VTAB" TAB_VERB 2 0 "nur via Modell" 1 "mit Zyklusvergleich" DEFAULT_VALUE "undef" /end COMPU_VTAB
/begin COMPU_METHOD FORMULA_1063 "FORMULA_1063" RAT_FUNC "%5.2" "min" COEFFS 0 60 0 0 0 1 /end COMPU_METHOD
/* ------------------ Abschnitt erzeugt aus vanos.dat ------------------ */
/begin COMPU_METHOD FORMULA_1191 "FORMULA_1191" RAT_FUNC "%5.0" "�KW/s" COEFFS 0 1 0 0 0 1 /end COMPU_METHOD
/begin COMPU_METHOD FORMULA_1192 "FORMULA_1192" RAT_FUNC "%6.1" "Hz" COEFFS 0 0 1000000 0 1 0 /end COMPU_METHOD
/begin COMPU_METHOD FORMULA_1193 "FORMULA_1193" TAB_VERB "%5.2" "-" COMPU_TAB_REF FORMULA_1193_VTAB /end COMPU_METHOD
/begin COMPU_VTAB FORMULA_1193_VTAB "FORMULA_1193_VTAB" TAB_VERB 38 0 "AUS" 1 "START" 2 "WAIT_LLR_HOCH" 3 "ANSCHL_MAX_E1" 4 "ANSCHL_MIN_E1" 5 "ANSCHL_MAX_A1" 6 "ANSCHL_MIN_A1" 7 "ANSCHL_MAX_E2" 8 "ANSCHL_MIN_E2" 9 "ANSCHL_MAX_A2" 10 "ANSCHL_MIN_A2" 11 "VERST_PRE_KLEIN_E1" 12 "VERST_KLEIN_E1" 13 "VERST_PRE_GROSS_E1" 14 "VERST_GROSS_E1" 15 "VERST_PRE_KLEIN_A1" 16 "VERST_KLEIN_A1" 17 "VERST_PRE_GROSS_A1" 18 "VERST_GROSS_A1" 19 "VERST_PRE_KLEIN_E2" 20 "VERST_KLEIN_E2" 21 "VERST_PRE_GROSS_E2" 22 "VERST_GROSS_E2" 23 "VERST_PRE_KLEIN_A2" 24 "VERST_KLEIN_A2" 25 "VERST_PRE_GROSS_A2" 26 "VERST_GROSS_A2" 27 "WAIT_LLR_NORM" 28 "MESS_GUETE" 29 "DSV1" 30 "DSV2" 31 "DSV3" 32 "DSV4" 33 "DSV5" 34 "DSV6" 35 "DSV7" 36 "DSV8" 37 "VAN_ABBRUCH" DEFAULT_VALUE "undef" /end COMPU_VTAB
/begin COMPU_METHOD FORMULA_1194 "FORMULA_1194" RAT_FUNC "%6.1" "%" COEFFS 0 10.24 0 0 0 1 /end COMPU_METHOD
/begin COMPU_METHOD FORMULA_1195 "FORMULA_1195" TAB_VERB "%5.2" "-" COMPU_TAB_REF FORMULA_1195_VTAB /end COMPU_METHOD
/begin COMPU_VTAB FORMULA_1195_VTAB "FORMULA_1195_VTAB" TAB_VERB 2 0 "kein Druck" 1 "Druck" /end COMPU_VTAB
/begin COMPU_METHOD FORMULA_1196 "FORMULA_1196" TAB_VERB "%5.2" "-" COMPU_TAB_REF FORMULA_1196_VTAB /end COMPU_METHOD
/begin COMPU_VTAB FORMULA_1196_VTAB "FORMULA_1196_VTAB" TAB_VERB 2 0 "aus" 1 "aktiv" /end COMPU_VTAB
/begin COMPU_METHOD FORMULA_1197 "FORMULA_1197" RAT_FUNC "%6.1" "min" COEFFS 0 600 0 0 0 1 /end COMPU_METHOD
/begin COMPU_METHOD FORMULA_1198 "FORMULA_1198" RAT_FUNC "%5.0" "mA" COEFFS 0 1 0 0 0 1 /end COMPU_METHOD
/begin COMPU_METHOD FORMULA_1199 "FORMULA_1199" RAT_FUNC "%7.0" "mA" COEFFS 0 65536 0 0 0 1 /end COMPU_METHOD
/begin COMPU_METHOD FORMULA_1200 "FORMULA_1200" RAT_FUNC "%9.4" "mA*s/�KW" COEFFS 0 1024 0 0 0 1 /end COMPU_METHOD
/begin COMPU_METHOD FORMULA_1201 "FORMULA_1201" RAT_FUNC "%7.2" "mA/�KW*s" COEFFS 0 65.536 0 0 0 1 /end COMPU_METHOD
/begin COMPU_METHOD FORMULA_1202 "FORMULA_1202" RAT_FUNC "%7.2" "mA/�KW" COEFFS 0 25.6 0 0 0 1 /end COMPU_METHOD
/begin COMPU_METHOD FORMULA_1203 "FORMULA_1203" RAT_FUNC "%8.3" "Ohm" COEFFS 0 1000 0 0 0 1 /end COMPU_METHOD
/begin COMPU_METHOD FORMULA_1204 "FORMULA_1204" TAB_VERB "%5.2" "-" COMPU_TAB_REF FORMULA_1204_VTAB /end COMPU_METHOD
/begin COMPU_VTAB FORMULA_1204_VTAB "FORMULA_1204_VTAB" TAB_VERB 2 0 "Kein Eingriff" 1 "SMG Schaltung" DEFAULT_VALUE "undef." /end COMPU_VTAB
/begin COMPU_METHOD FORMULA_1205 "FORMULA_1205" RAT_FUNC "%6.1" "�KW/10ms" COEFFS 0 10 0 0 0 1 /end COMPU_METHOD
/begin COMPU_METHOD FORMULA_1206 "FORMULA_1206" TAB_VERB "%5.2" "-" COMPU_TAB_REF FORMULA_1206_VTAB /end COMPU_METHOD
/begin COMPU_VTAB FORMULA_1206_VTAB "FORMULA_1206_VTAB" TAB_VERB 1 3 "ja" DEFAULT_VALUE "nein" /end COMPU_VTAB
/begin COMPU_METHOD FORMULA_1207 "FORMULA_1207" TAB_VERB "%5.2" "-" COMPU_TAB_REF FORMULA_1207_VTAB /end COMPU_METHOD
/begin COMPU_VTAB FORMULA_1207_VTAB "FORMULA_1207_VTAB" TAB_VERB 1 3 "ja" DEFAULT_VALUE "nein" /end COMPU_VTAB
/begin COMPU_METHOD FORMULA_1208 "FORMULA_1208" TAB_VERB "%5.2" "-" COMPU_TAB_REF FORMULA_1208_VTAB /end COMPU_METHOD
/begin COMPU_VTAB FORMULA_1208_VTAB "FORMULA_1208_VTAB" TAB_VERB 1 0 "nein" DEFAULT_VALUE "ja" /end COMPU_VTAB
/begin COMPU_METHOD FORMULA_1209 "FORMULA_1209" TAB_VERB "%5.2" "-" COMPU_TAB_REF FORMULA_1209_VTAB /end COMPU_METHOD
/begin COMPU_VTAB FORMULA_1209_VTAB "FORMULA_1209_VTAB" TAB_VERB 2 0 "o.k" 1 "unplausibel" DEFAULT_VALUE "undef." /end COMPU_VTAB
/begin COMPU_METHOD FORMULA_1210 "FORMULA_1210" TAB_VERB "%5.2" "-" COMPU_TAB_REF FORMULA_1210_VTAB /end COMPU_METHOD
/begin COMPU_VTAB FORMULA_1210_VTAB "FORMULA_1210_VTAB" TAB_VERB 3 0 "verriegelt" 1 "dyn begrenzt" 2 "frei" DEFAULT_VALUE "undef." /end COMPU_VTAB
/begin COMPU_METHOD FORMULA_1211 "FORMULA_1211" RAT_FUNC "%5.0" "mA/10ms" COEFFS 0 1 0 0 0 1 /end COMPU_METHOD
/begin COMPU_METHOD FORMULA_1212 "FORMULA_1212" RAT_FUNC "%5.2" "s" COEFFS 0 0 164 0 1 0 /end COMPU_METHOD
/begin COMPU_METHOD FORMULA_1213 "FORMULA_1213" TAB_VERB "%5.2" "-" COMPU_TAB_REF FORMULA_1213_VTAB /end COMPU_METHOD
/begin COMPU_VTAB FORMULA_1213_VTAB "FORMULA_1213_VTAB" TAB_VERB 3 0 "Flueg" 1 "Hochdr" 2 "MCS" DEFAULT_VALUE "undef." /end COMPU_VTAB
/begin COMPU_METHOD FORMULA_1214 "FORMULA_1214" TAB_VERB "%5.2" "-" COMPU_TAB_REF FORMULA_1214_VTAB /end COMPU_METHOD
/begin COMPU_VTAB FORMULA_1214_VTAB "FORMULA_1214_VTAB" TAB_VERB 8 0 "lls+wdk+ti" 1 "lls+ti" 2 "wdk+ti" 3 "ti" 4 "lls+wdk" 5 "lls" 6 "wdk" 7 "ignore all" DEFAULT_VALUE "undef." /end COMPU_VTAB
/begin COMPU_METHOD FORMULA_1215 "FORMULA_1215" RAT_FUNC "%6.3" "Aend/Sampl" COEFFS 0 256 0 0 0 1 /end COMPU_METHOD
/begin COMPU_METHOD FORMULA_1216 "FORMULA_1216" RAT_FUNC "%3.0" "%" COEFFS 0 2.56 0 0 0 1 /end COMPU_METHOD
/begin COMPU_METHOD FORMULA_1217 "FORMULA_1217" TAB_VERB "%5.2" "-" COMPU_TAB_REF FORMULA_1217_VTAB /end COMPU_METHOD
/begin COMPU_VTAB FORMULA_1217_VTAB "FORMULA_1217_VTAB" TAB_VERB 2 0 "normal" 1 "ohne Ueberschwinger" DEFAULT_VALUE "undef." /end COMPU_VTAB
/begin COMPU_METHOD FORMULA_1218 "FORMULA_1218" TAB_VERB "%5.2" "-" COMPU_TAB_REF FORMULA_1218_VTAB /end COMPU_METHOD
/begin COMPU_VTAB FORMULA_1218_VTAB "FORMULA_1218_VTAB" TAB_VERB 2 0 "Running" 1 "Reset" DEFAULT_VALUE "undef." /end COMPU_VTAB
/begin COMPU_METHOD FORMULA_1219 "FORMULA_1219" TAB_VERB "%5.2" "-" COMPU_TAB_REF FORMULA_1219_VTAB /end COMPU_METHOD
/begin COMPU_VTAB FORMULA_1219_VTAB "FORMULA_1219_VTAB" TAB_VERB 2 0 "normal" 1 "invers" DEFAULT_VALUE "undef." /end COMPU_VTAB
/begin COMPU_METHOD FORMULA_1220 "FORMULA_1220" RAT_FUNC "%3.0" "KW_Zahn" COEFFS 0 1 0 0 0 1 /end COMPU_METHOD
/begin COMPU_METHOD FORMULA_1221 "FORMULA_1221" TAB_VERB "%3.0" "-" COMPU_TAB_REF FORMULA_1221_VTAB /end COMPU_METHOD
/begin COMPU_VTAB FORMULA_1221_VTAB "FORMULA_1221_VTAB" TAB_VERB 2 0 "7Zahn(S54)" 1 "6Zahn" /end COMPU_VTAB
/begin COMPU_METHOD FORMULA_1222 "FORMULA_1222" RAT_FUNC "%3.0" "Zaehne/Asp" COEFFS 0 1 0 0 0 1 /end COMPU_METHOD
/begin COMPU_METHOD FORMULA_1223 "FORMULA_1223" RAT_FUNC "%7.2" "10exp-3" COEFFS 0 100 0 0 0 1 /end COMPU_METHOD
/begin COMPU_METHOD FORMULA_1224 "FORMULA_1224" TAB_VERB "%3.0" "-" COMPU_TAB_REF FORMULA_1224_VTAB /end COMPU_METHOD
/begin COMPU_VTAB FORMULA_1224_VTAB "FORMULA_1224_VTAB" TAB_VERB 2 0 "dr_rel" 1 "md_rf_soll_pt" DEFAULT_VALUE "undef." /end COMPU_VTAB
/begin COMPU_METHOD FORMULA_1225 "FORMULA_1225" RAT_FUNC "%5.0" "mA/Zahn" COEFFS 0 1 0 0 0 1 /end COMPU_METHOD
/* ------------------ Abschnitt erzeugt aus van_dsv.dat ------------------ */
/begin COMPU_METHOD FORMULA_1226 "FORMULA_1226" TAB_VERB "%3.0" "-" COMPU_TAB_REF FORMULA_1226_VTAB /end COMPU_METHOD
/begin COMPU_VTAB FORMULA_1226_VTAB "FORMULA_1226_VTAB" TAB_VERB 8 0 "AUS" 1 "EIN_BEI_START" 2 "EIN_NACH_START" 3 "ABFALLEN_START" 4 "AUS_DRUCKERKENN" 5 "EIN_BEI_DRUCK" 6 "ABFALLEN_ABSTELL" 7 "KS_AUS" DEFAULT_VALUE "undef" /end COMPU_VTAB
/begin COMPU_METHOD FORMULA_1227 "FORMULA_1227" RAT_FUNC "%6.1" "%" COEFFS 0 81.92 0 0 0 1 /end COMPU_METHOD
/begin COMPU_METHOD FORMULA_1228 "FORMULA_1228" TAB_VERB "%5.2" "-" COMPU_TAB_REF FORMULA_1228_VTAB /end COMPU_METHOD
/begin COMPU_VTAB FORMULA_1228_VTAB "FORMULA_1228_VTAB" TAB_VERB 2 0 "ohne DSV" 1 "mit DSV" DEFAULT_VALUE "undef." /end COMPU_VTAB
/* ------------------ Abschnitt erzeugt aus wf.dat ------------------ */
/begin COMPU_METHOD FORMULA_1231 "FORMULA_1231" RAT_FUNC "%5.0" "Segm" COEFFS 0 1 0 0 0 1 /end COMPU_METHOD
/begin COMPU_METHOD FORMULA_1232 "FORMULA_1232" RAT_FUNC "%5.0" "ASP" COEFFS 0 1 0 0 0 1 /end COMPU_METHOD
/begin COMPU_METHOD FORMULA_1233 "FORMULA_1233" RAT_FUNC "%5.2" "-/segm" COEFFS 0 256 0 0 0 1 /end COMPU_METHOD
/begin COMPU_METHOD FORMULA_1234 "FORMULA_1234" TAB_VERB "%5.2" "-" COMPU_TAB_REF FORMULA_1234_VTAB /end COMPU_METHOD
/begin COMPU_VTAB FORMULA_1234_VTAB "FORMULA_1234_VTAB" TAB_VERB 3 0 "PSAU" 1 "DR_REL" 2 "PSAU+DR_REL" /end COMPU_VTAB
/begin COMPU_METHOD FORMULA_1235 "FORMULA_1235" TAB_VERB "%5.2" "-" COMPU_TAB_REF FORMULA_1235_VTAB /end COMPU_METHOD
/begin COMPU_VTAB FORMULA_1235_VTAB "FORMULA_1235_VTAB" TAB_VERB 2 0 "no" 1 "yes" /end COMPU_VTAB
/begin COMPU_METHOD FORMULA_1236 "FORMULA_1236" TAB_VERB "%5.2" "-" COMPU_TAB_REF FORMULA_1236_VTAB /end COMPU_METHOD
/begin COMPU_VTAB FORMULA_1236_VTAB "FORMULA_1236_VTAB" TAB_VERB 2 0 "-" 1 "OELV_ETA" /end COMPU_VTAB
/begin COMPU_METHOD FORMULA_1237 "FORMULA_1237" RAT_FUNC "%5.2" "-/segment" COEFFS 0 256 0 0 0 1 /end COMPU_METHOD
/* ------------------ Abschnitt erzeugt aus zust_inj.dat ------------------ */
/begin COMPU_METHOD FORMULA_1238 "FORMULA_1238" TAB_VERB "%5.2" "-" COMPU_TAB_REF FORMULA_1238_VTAB /end COMPU_METHOD
/begin COMPU_VTAB FORMULA_1238_VTAB "FORMULA_1238_VTAB" TAB_VERB 2 1 "powerDown" 3 "powerDown hart" DEFAULT_VALUE "aus" /end COMPU_VTAB
/begin COMPU_METHOD FORMULA_1239 "FORMULA_1239" TAB_VERB "%5.2" "-" COMPU_TAB_REF FORMULA_1239_VTAB /end COMPU_METHOD
/begin COMPU_VTAB FORMULA_1239_VTAB "FORMULA_1239_VTAB" TAB_VERB 3 0 "Inaktiv" 1 "Aktiv" 2 "Ist-Md" /end COMPU_VTAB
/begin COMPU_METHOD FORMULA_1240 "FORMULA_1240" RAT_FUNC "%7.2" "ms" COEFFS 0 1 0 0 0 1 /end COMPU_METHOD
/* ------------------ Abschnitt erzeugt aus version.dat ------------------ */
/begin CHARACTERISTIC K_DATENKENNUNG_1_1of5_ "Datenkennsatzkennung Nr. 1" VALUE 0x70262 TKW_VV_VV_UB 100.0 FORMULA_0414 0.0 255.0 /end CHARACTERISTIC
/begin CHARACTERISTIC K_DATENKENNUNG_1_2of5_ "Datenkennsatzkennung Nr. 1" VALUE 0x70263 TKW_VV_VV_UB 100.0 FORMULA_0414 0.0 255.0 /end CHARACTERISTIC
/begin CHARACTERISTIC K_DATENKENNUNG_1_3of5_ "Datenkennsatzkennung Nr. 1" VALUE 0x70264 TKW_VV_VV_UB 100.0 FORMULA_0414 0.0 255.0 /end CHARACTERISTIC
/begin CHARACTERISTIC K_DATENKENNUNG_1_4of5_ "Datenkennsatzkennung Nr. 1" VALUE 0x70265 TKW_VV_VV_UB 100.0 FORMULA_0414 0.0 255.0 /end CHARACTERISTIC
/begin CHARACTERISTIC K_DATENKENNUNG_1_5of5_ "Datenkennsatzkennung Nr. 1" VALUE 0x70266 TKW_VV_VV_UB 100.0 FORMULA_0414 0.0 255.0 /end CHARACTERISTIC
/begin CHARACTERISTIC K_DATENKENNUNG_2_1of5_ "Datenkennsatzkennung Nr. 2" VALUE 0x70273 TKW_VV_VV_UB 100.0 FORMULA_0414 0.0 255.0 /end CHARACTERISTIC
/begin CHARACTERISTIC K_DATENKENNUNG_2_2of5_ "Datenkennsatzkennung Nr. 2" VALUE 0x70274 TKW_VV_VV_UB 100.0 FORMULA_0414 0.0 255.0 /end CHARACTERISTIC
/begin CHARACTERISTIC K_DATENKENNUNG_2_3of5_ "Datenkennsatzkennung Nr. 2" VALUE 0x70275 TKW_VV_VV_UB 100.0 FORMULA_0414 0.0 255.0 /end CHARACTERISTIC
/begin CHARACTERISTIC K_DATENKENNUNG_2_4of5_ "Datenkennsatzkennung Nr. 2" VALUE 0x70276 TKW_VV_VV_UB 100.0 FORMULA_0414 0.0 255.0 /end CHARACTERISTIC
/begin CHARACTERISTIC K_DATENKENNUNG_2_5of5_ "Datenkennsatzkennung Nr. 2" VALUE 0x70277 TKW_VV_VV_UB 100.0 FORMULA_0414 0.0 255.0 /end CHARACTERISTIC
/begin CHARACTERISTIC K_DATENKENNUNG_3_1of5_ "Datenkennsatzkennung Nr. 3" VALUE 0x70284 TKW_VV_VV_UB 100.0 FORMULA_0414 0.0 255.0 /end CHARACTERISTIC
/begin CHARACTERISTIC K_DATENKENNUNG_3_2of5_ "Datenkennsatzkennung Nr. 3" VALUE 0x70285 TKW_VV_VV_UB 100.0 FORMULA_0414 0.0 255.0 /end CHARACTERISTIC
/begin CHARACTERISTIC K_DATENKENNUNG_3_3of5_ "Datenkennsatzkennung Nr. 3" VALUE 0x70286 TKW_VV_VV_UB 100.0 FORMULA_0414 0.0 255.0 /end CHARACTERISTIC
/begin CHARACTERISTIC K_DATENKENNUNG_3_4of5_ "Datenkennsatzkennung Nr. 3" VALUE 0x70287 TKW_VV_VV_UB 100.0 FORMULA_0414 0.0 255.0 /end CHARACTERISTIC
/begin CHARACTERISTIC K_DATENKENNUNG_3_5of5_ "Datenkennsatzkennung Nr. 3" VALUE 0x70288 TKW_VV_VV_UB 100.0 FORMULA_0414 0.0 255.0 /end CHARACTERISTIC
/begin CHARACTERISTIC K_VERS_PROG "Programmversion | EN: Program version" VALUE 0x70250 TKW_VV_VV_UW 100.0 FORMULA_0010 0.0 65535.0000 /end CHARACTERISTIC
/begin CHARACTERISTIC K_VERS_PROZ "Prozessorkennung | EN: Processor ID" VALUE 0x70252 TKW_VV_VV_UB 100.0 FORMULA_0417 0.0 255.0 /end CHARACTERISTIC
/begin CHARACTERISTIC K_VERS_NAME "Applikateur | EN: Calibrator ID" VALUE 0x70253 TKW_VV_VV_UB 100.0 FORMULA_0415 0.0 255.0 /end CHARACTERISTIC
/begin CHARACTERISTIC K_VERS_DATEN "Datenversion | EN: Data version" VALUE 0x70254 TKW_VV_VV_UW 100.0 FORMULA_0010 0.0 65535.0000 /end CHARACTERISTIC
/begin MEASUREMENT vers_prog "Programmversion" UWORD FORMULA_0010 0 0 0.0 65535.0000 ECU_ADDRESS 0x3FD67A /end MEASUREMENT
/begin MEASUREMENT vers_index "Programmindex" UBYTE FORMULA_0003 0 0 0.0 255.0000 ECU_ADDRESS 0x3FD67C /end MEASUREMENT
/begin MEASUREMENT vers_name "Applikateur der Ref-Page" UBYTE FORMULA_0415 0 0 0.0 255.0 ECU_ADDRESS 0x3FD67D /end MEASUREMENT
/begin MEASUREMENT vers_sg "verbautes Steuergeraet" UBYTE FORMULA_0416 0 0 0.0 255.0 ECU_ADDRESS 0x3FD67E /end MEASUREMENT
/* ------------------ Abschnitt erzeugt aus dmtl.dat ------------------ */
/begin CHARACTERISTIC K_DMTL_ANZ_DECKEL "Anzahl Deckeldiagnose-Versuche | EN: Diags   0   Anzahl Deckeldiagnose -Versuche" VALUE 0x707A8 TKW_VV_VV_UB 100.0 FORMULA_0543 0.0 255.0000 /end CHARACTERISTIC
/begin CHARACTERISTIC K_DMTL_ANZ_DECKEL_LECK "Max. Anzahl Deckeldiagnosen mit Ergebnis Leck | EN: Diags   0   Max. Anzahl Deckeldiagn osen mit Ergebnis Leck" VALUE 0x707A9 TKW_VV_VV_UB 100.0 FORMULA_0543 0.0 255.0000 /end CHARACTERISTIC
/begin CHARACTERISTIC K_DMTL_ANZ_FAHRTEN "Anzahl der langen Fahrten  | EN: 0   Anzahl der langen Fahrten" VALUE 0x707AA TKW_VV_VV_UB 100.0 FORMULA_0003 0.0 255.0000 /end CHARACTERISTIC
/begin CHARACTERISTIC K_DMTL_ABBR_FEIN "Anzahl abgebrochene Feindiags | EN: Diags   0   Anzahl abgebrochene Feindiags" VALUE 0x707AB TKW_VV_VV_UB 100.0 FORMULA_0543 0.0 255.0000 /end CHARACTERISTIC
/begin CHARACTERISTIC K_DMTL_ABBR_FEUCHT "Max Anzahl Feuchteabbrueche ohne MIL | EN: Diags   0   Max Anzahl  Feuchteabbrueche ohne MIL" VALUE 0x707AC TKW_VV_VV_UB 100.0 FORMULA_0543 0.0 255.0000 /end CHARACTERISTIC
/begin CHARACTERISTIC K_DMTL_AY_MAX "Maximale Querbeschleunigung bei Deckeldiagnose | EN: Maximale Querbeschleun igung bei Deckeldiagnose" VALUE 0x707AE TKW_VV_VV_SW 100.0 FORMULA_0132 -20.0000 20.0000 FORMAT "%5.2" /end CHARACTERISTIC
/begin CHARACTERISTIC K_DMTL_CFG "Konfiguration DMTL | EN: 0x0 Ohne DMTL 0x1 Mit DMTL 0x2 Keine Fehle r- heilung ELSE undef. Konfiguration DMTL" VALUE 0x707B0 TKW_VV_VV_UB 100.0 FORMULA_0646 0.0 255.0 /end CHARACTERISTIC
/begin CHARACTERISTIC K_DMTL_DI_BETANK "DMTL DeltaStrom Betankungserkennung | EN: DMTL DeltaStrom Betankung s-erkennung" VALUE 0x707B2 TKW_VV_VV_UW 100.0 FORMULA_0551 0.0 147.4537 FORMAT "%5.2" /end CHARACTERISTIC
/begin CHARACTERISTIC K_DMTL_DI_DECKEL "DMTL DeltaStrom Tankdeckel | EN: DMTL DeltaStrom Tankdeckel" VALUE 0x707B4 TKW_VV_VV_UW 100.0 FORMULA_0551 0.0 147.4537 FORMAT "%5.2" /end CHARACTERISTIC
/begin CHARACTERISTIC K_DMTL_DI_STABIL "DeltaStrom Stabil | EN: DeltaStrom Stabil" VALUE 0x707B6 TKW_VV_VV_UW 100.0 FORMULA_0551 0.0 147.4537 FORMAT "%5.2" /end CHARACTERISTIC
/begin CHARACTERISTIC K_DMTL_DI_TEV_OFFEN "Strom unter i_min Abbr. TEV | EN: Strom unter i_min Abbr. TEV" VALUE 0x707B8 TKW_VV_VV_UW 100.0 FORMULA_0551 0.0 147.4537 FORMAT "%5.2" /end CHARACTERISTIC
/begin CHARACTERISTIC K_DMTL_DU_MAX "Max. Spannungsaenderung ohne Abbruch | EN: Max. Spannungsaenderung ohne Abbruch" VALUE 0x707BA TKW_VV_VV_UB 100.0 FORMULA_0647 0.0 25.5000 /end CHARACTERISTIC
/begin CHARACTERISTIC K_DMTL_FST_MAX "Max. zul. Fuellstand | EN: Max. zul. Fuellstand" VALUE 0x707BB TKW_VV_VV_UB 100.0 FORMULA_0557 0.0 127.5000 /end CHARACTERISTIC
/begin CHARACTERISTIC K_DMTL_FST_MIN "Min. zul. Fuellstand | EN: Min. zul. Fuellstand" VALUE 0x707BC TKW_VV_VV_UB 100.0 FORMULA_0557 0.0 127.5000 /end CHARACTERISTIC
/begin CHARACTERISTIC K_DMTL_FST_ERSATZ "Ersatzwert bei FST-Fehler | EN: Ersatzwert bei FST-Fehler" VALUE 0x707BD TKW_VV_VV_UB 100.0 FORMULA_0557 0.0 127.5000 /end CHARACTERISTIC
/begin CHARACTERISTIC K_DMTL_FST_DECKEL_MAX "Max. zul. Fuellstand fuer Deckelmessung | EN: Max. zul. Fuellstand fuer D e-ckelmessung" VALUE 0x707BE TKW_VV_VV_UB 100.0 FORMULA_0557 0.0 127.5000 /end CHARACTERISTIC
/begin CHARACTERISTIC K_DMTL_GROB_OHNE_FEIN "Anzahl Grobleckdiags. ohne Feindiag  | EN: Diags   0   Anzahl Grobleckdiags. ohne Feindiag" VALUE 0x707BF TKW_VV_VV_UB 100.0 FORMULA_0543 0.0 255.0000 /end CHARACTERISTIC
/begin CHARACTERISTIC K_DMTL_I_FAKT_CCDECKEL "Faktor fuer I-ref zur Tankdeckelpruefung | EN: Faktor fuer I -ref zur Tankdeckel-pruefung" VALUE 0x707C0 TKW_VV_VV_UB 100.0 FORMULA_0643 0.0 1.9921 /end CHARACTERISTIC
/begin CHARACTERISTIC K_DMTL_I_FAKT_GROB "Faktor fuer I-ref zur Gobleck | EN: Faktor fuer I-ref zur Gobleck" VALUE 0x707C1 TKW_VV_VV_UB 100.0 FORMULA_0643 0.0 1.9921 /end CHARACTERISTIC
/begin CHARACTERISTIC K_DMTL_I_FAKT_P "Minimaler Strom-Abfall nach Ventil Umschalten  | EN: Minimaler Strom- Abfall nach Ventil Umschalten" VALUE 0x707C2 TKW_VV_VV_UB 100.0 FORMULA_0648 0.0 1.0000 /end CHARACTERISTIC
/begin CHARACTERISTIC K_DMTL_I_KURZSCHL "Stromschwelle fuer Kurzschlu�erkennung | EN: Stromschwelle fuer Kurzschlu ß-erkennung" VALUE 0x707C4 TKW_VV_VV_UW 100.0 FORMULA_0551 0.0 147.4537 FORMAT "%5.2" /end CHARACTERISTIC
/begin CHARACTERISTIC K_DMTL_I_REF_DIFF "max. Referenzstromschwankungen | EN: max. Referenzstromschwanku n-gen" VALUE 0x707C6 TKW_VV_VV_UW 100.0 FORMULA_0551 0.0 147.4537 FORMAT "%5.2" /end CHARACTERISTIC
/begin CHARACTERISTIC K_DMTL_I_REF_MAX "Referenzstrom max. | EN: Maximum reference current [mA]" VALUE 0x707C8 TKW_VV_VV_UW 100.0 FORMULA_0551 0.0 147.4537 FORMAT "%5.2" /end CHARACTERISTIC
/begin CHARACTERISTIC K_DMTL_I_REF_MIN "Referenzstrom min. | EN: Minimum reference current [mA]" VALUE 0x707CA TKW_VV_VV_UW 100.0 FORMULA_0551 0.0 147.4537 FORMAT "%5.2" /end CHARACTERISTIC
/begin CHARACTERISTIC K_DMTL_I_REF_1_2_DIFF "max. Unterschied Ref1 und Ref2 | EN: Maximum difference Ref1 and Ref2 [mA]" VALUE 0x707CC TKW_VV_VV_UW 100.0 FORMULA_0551 0.0 147.4537 FORMAT "%5.2" /end CHARACTERISTIC
/begin CHARACTERISTIC K_DMTL_START "Robys INCA Startknubbl" VALUE 0x707CE TKW_VV_VV_UB 100.0 FORMULA_0649 0.0 255.0 /end CHARACTERISTIC
/begin CHARACTERISTIC K_DMTL_TEMP_MAX "Maximaltemperatur fuer Diagnose | EN: Maximum temperature for diagnosis [°C]" VALUE 0x707D0 TKW_VV_VV_SW 100.0 FORMULA_0023 -50.0000 170.0000 FORMAT "%4.1" /end CHARACTERISTIC
/begin CHARACTERISTIC K_DMTL_TEMP_MIN "Mindesttemperatur fuer Diagnose | EN: Minimum temperature for diagnosis [°C]" VALUE 0x707D2 TKW_VV_VV_SW 100.0 FORMULA_0023 -50.0000 170.0000 FORMAT "%4.1" /end CHARACTERISTIC
/begin CHARACTERISTIC K_DMTL_TEMP_DECKEL_MAX "Maximaltemperatur fuer Deckeldiagnose | EN: Maximum temperature for fuel-cap diagnosis [°C]" VALUE 0x707D4 TKW_VV_VV_SW 100.0 FORMULA_0023 -50.0000 170.0000 FORMAT "%4.1" /end CHARACTERISTIC
/begin CHARACTERISTIC K_DMTL_TEMP_DECKEL_MIN "Mindesttemperatur fuer Deckeldiagnose | EN: Minimum temperature for fuel-cap diagnosis [°C]" VALUE 0x707D6 TKW_VV_VV_SW 100.0 FORMULA_0023 -50.0000 170.0000 FORMAT "%4.1" /end CHARACTERISTIC
/begin CHARACTERISTIC K_DMTL_TEMP_VENT_MIN "Mindesttemperatur fuer Ventilcheck | EN: Minimum temperature for valve check [°C]" VALUE 0x707D8 TKW_VV_VV_SW 100.0 FORMULA_0023 -50.0000 170.0000 FORMAT "%4.1" /end CHARACTERISTIC
/begin CHARACTERISTIC K_DMTL_TEMP_START_MIN "min. Motor Startemperatur | EN: Minimum engine start temperature [°C]" VALUE 0x707DA TKW_VV_VV_SW 100.0 FORMULA_0023 -50.0000 170.0000 FORMAT "%4.1" /end CHARACTERISTIC
/begin CHARACTERISTIC K_DMTL_TP_I "Filterzeitkonstante Strom" VALUE 0x707DC TKW_VV_VV_UW 100.0 FORMULA_0650 0.0 655.3500 FORMAT "%4.1" /end CHARACTERISTIC
/begin CHARACTERISTIC K_DMTL_TP_I_BEG "Filterzeitkonstante Strom zu Beginn | EN: Filter time constant, current at start [s]" VALUE 0x707DE TKW_VV_VV_UB 100.0 FORMULA_0651 0.0051 1.2800 /end CHARACTERISTIC
/begin CHARACTERISTIC K_DMTL_TP_I_ROH "Filterzeitkonstante Roh-Strom | EN: Filter time constant, raw current [ms]" VALUE 0x707DF TKW_VV_VV_UB 100.0 FORMULA_0652 0.0 255.0000 /end CHARACTERISTIC
/begin CHARACTERISTIC K_DMTL_TP_I_TANK "Filterzeitkonstante Strom Betankungserkennung" VALUE 0x707E0 TKW_VV_VV_UW 100.0 FORMULA_0650 0.0 655.3500 FORMAT "%4.1" /end CHARACTERISTIC
/begin CHARACTERISTIC K_DMTL_TP_UB "Filterzeitkonstante Spannung | EN: Filter time constant, voltage [ms]" VALUE 0x707E2 TKW_VV_VV_UB 100.0 FORMULA_0653 0.0 1275.0000 /end CHARACTERISTIC
/begin CHARACTERISTIC K_DMTL_T_ABSTELL "min. Abstellzeit fuer Diagnosebeginn | EN: Minimum engine-off time for diagnosis start [min]" VALUE 0x707E4 TKW_VV_VV_UW 100.0 FORMULA_0553 0.0 65535.0000 /end CHARACTERISTIC
/begin CHARACTERISTIC K_DMTL_T_AY_DLY "Wartezeit Querbeschleunigung | EN: Wait time, lateral acceleration [s]" VALUE 0x707E6 TKW_VV_VV_UB 100.0 FORMULA_0458 0.0 25.5000 /end CHARACTERISTIC
/begin CHARACTERISTIC K_DMTL_T_CC_DAUER "Max. Anzeigedauer CC Meldung Tankdeckel | EN: Maximum display duration of fuel-cap check-control message [s]" VALUE 0x707E8 TKW_VV_VV_UW 100.0 FORMULA_0073 0.0 6553.5000 FORMAT "%4.1" /end CHARACTERISTIC
/begin CHARACTERISTIC K_DMTL_T_DECKEL_ML_MIN "min. Motorlaufzeit fuer Deckel-Diagnosebeginn | EN: Minimum engine run time for fuel-cap diagnosis start [min]" VALUE 0x707EA TKW_VV_VV_UW 100.0 FORMULA_0654 0.0 307.1998 FORMAT "%4.1" /end CHARACTERISTIC
/begin CHARACTERISTIC K_DMTL_T_FEUCHT_DLY "Wartezeit nach Feuchteabbruch | EN: Wait time after humidity abort [s]" VALUE 0x707EC TKW_VV_VV_UW 100.0 FORMULA_0073 0.0 6553.5000 FORMAT "%4.1" /end CHARACTERISTIC
/begin CHARACTERISTIC K_DMTL_T_KURZSCHL "Wartezeit fuer Kurzschlu�erkennung | EN: Wait time for short-circuit detection [ms]" VALUE 0x707EE TKW_VV_VV_UB 100.0 FORMULA_0645 0.0 127.5000 /end CHARACTERISTIC
/begin CHARACTERISTIC K_DMTL_T_MESS_GES "Max. Gesamtmessdauer (ohne Ref-Messung) | EN: Maximum total measurement time (without reference measurement) [s]" VALUE 0x707F0 TKW_VV_VV_UW 100.0 FORMULA_0073 0.0 810.0000 FORMAT "%4.1" /end CHARACTERISTIC
/begin CHARACTERISTIC K_DMTL_T_ML_MIN "min. Motorlaufzeit fuer Diagnosebeginn | EN: Minimum engine run time for diagnosis start [min]" VALUE 0x707F2 TKW_VV_VV_UW 100.0 FORMULA_0654 0.0 307.1998 FORMAT "%4.1" /end CHARACTERISTIC
/begin CHARACTERISTIC K_DMTL_T_REF "Messzeit Referenzstrom | EN: Messzeit Referenzstrom" VALUE 0x707F4 TKW_VV_VV_UB 100.0 FORMULA_0458 0.0 25.5000 /end CHARACTERISTIC
/begin CHARACTERISTIC K_DMTL_T_START_DLY "Wartezeit nach KL15 aus | EN: Wartezeit nach KL15 aus" VALUE 0x707F5 TKW_VV_VV_UB 100.0 FORMULA_0458 0.0 25.5000 /end CHARACTERISTIC
/begin CHARACTERISTIC K_DMTL_T_VENT_CHK "Zeit fuer Strompruefung nach Ventil umschalten | EN: Zeit fuer Strompruefung nach Ventil umschalten" VALUE 0x707F6 TKW_VV_VV_UB 100.0 FORMULA_0458 0.0 25.5000 /end CHARACTERISTIC
/begin CHARACTERISTIC K_DMTL_T_VENT_UM "Zeit schnelle Stromfilterung nach Schalten | EN: Zeit schnelle Stromfilterung nach Schalten" VALUE 0x707F7 TKW_VV_VV_UB 100.0 FORMULA_0458 0.0 25.5000 /end CHARACTERISTIC
/begin CHARACTERISTIC K_DMTL_UB_MAX "max. Diagnosespannung | EN: max. Diagnosespannung" VALUE 0x707F8 TKW_VV_VV_SW 100.0 FORMULA_0008 0.0 28.0000 FORMAT "%4.1" /end CHARACTERISTIC
/begin CHARACTERISTIC K_DMTL_UB_MIN "min. Diagnosespannung | EN: min. Diagnosespannung Diagnose Modul Tank Leck Öltemperatursensor (QLT)/ Plausibilität Seite 586 von" VALUE 0x707FA TKW_VV_VV_SW 100.0 FORMULA_0008 0.0 28.0000 FORMAT "%4.1" /end CHARACTERISTIC
/begin CHARACTERISTIC K_DMTL_V_MIN "Mindestgeschwindigkeit fuer Betankungserkennung | EN: Mindestgeschwindigkeit fuer Betankungserkennung" VALUE 0x707FC TKW_VV_VV_SW 100.0 FORMULA_0078 -80.0000 360.0000 FORMAT "%4.1" /end CHARACTERISTIC
/begin CHARACTERISTIC K_DMTL_P_MIN "Minimaler Luftdruck fuer Diagnose | EN: Minimaler Luftdruck fuer Dia g-nose" VALUE 0x707FE TKW_VV_VV_SW 100.0 FORMULA_0077 400.0000 1200.0000 FORMAT "%4.1" /end CHARACTERISTIC
/begin CHARACTERISTIC K_DMTL_FAKT_T_DECKEL "Faktor fuer Deckeldiagnose auf Grobleckzeit | EN: Faktor fuer Deckeldiagnose auf Grobleckzeit" VALUE 0x70800 TKW_VV_VV_UB 100.0 FORMULA_0655 0.0 7.9687 /end CHARACTERISTIC
/begin CHARACTERISTIC K_DMTL_2_STABIL "Stabilkriterium ein oder zweimal zu erfuellen | EN: 0x0 1x Stabilzeit 0x1 2x Stabilzeit ELSE undef. Stabilkriterium ein oder zweimal zu erfuellen" VALUE 0x70801 TKW_VV_VV_UB 100.0 FORMULA_0656 0.0 255.0 /end CHARACTERISTIC
/begin CHARACTERISTIC KL_DMTL_FST_MAX_STAND "Maximaler Fuellstand f�r Diagnosen im Stand | EN: Maximum fill level for diagnoses at standstill" CURVE 0x70802 TKL_SW_VV_UB 100.0 FORMULA_0557 0.0 127.5000
 /begin AXIS_DESCR STD_AXIS can_ay FORMULA_0132 4 -20.0000 20.0000 FORMAT "%5.2" /end AXIS_DESCR
/end CHARACTERISTIC
/begin CHARACTERISTIC KL_DMTL_FST_ERS_LI "Ersatzwert bei Geber Links Fehler | EN: Ersatzwert bei Ge ber Links Fehler" CURVE 0x70810 TKL_UB_VV_UB 100.0 FORMULA_0557 0.0 127.5000 /begin AXIS_DESCR STD_AXIS fst_rechts FORMULA_0557 4 0.0 127.5000 /end AXIS_DESCR /end CHARACTERISTIC
/begin CHARACTERISTIC KL_DMTL_FST_ERS_RE "Ersatzwert bei Geber Rechts Fehler | EN: Substitute value for right sender fault" CURVE 0x7081A TKL_UB_VV_UB 100.0 FORMULA_0557 0.0 127.5000 /begin AXIS_DESCR STD_AXIS fst_links FORMULA_0557 4 0.0 127.5000 /end AXIS_DESCR /end CHARACTERISTIC
/begin CHARACTERISTIC KL_DMTL_HOEHE_KORR "Korrekturfaktor fuer DMTL T-grob/stabil ueber p_umg | EN: Correction factor for tank-leak (DMTL) coarse/stable vs ambient pressure" CURVE 0x70824 TKL_SW_VV_UB 100.0 FORMULA_0643 0.0 1.9921
 /begin AXIS_DESCR STD_AXIS pumg FORMULA_0077 3 400.0000 1200.0000 FORMAT "%4.1" /end AXIS_DESCR
/end CHARACTERISTIC
/begin CHARACTERISTIC KL_DMTL_I_REF_KORR "Korrektur Referenzstrom fuer Feinleck ueber Fuellstand | EN: Reference-current correction for fine leak vs fill level" CURVE 0x70830 TKL_UB_VV_UB 100.0 FORMULA_0643 0.0 1.9921 /begin AXIS_DESCR STD_AXIS can_fst_sum FORMULA_0557 3 0.0 127.5000 /end AXIS_DESCR /end CHARACTERISTIC
/begin CHARACTERISTIC KL_DMTL_KORR_FAKT "Korrekturfaktor Pumpenstrom ueber Spannung | EN: Pump-current correction factor vs voltage" CURVE 0x70838 TKL_UW_VV_UW 100.0 FORMULA_0075 0.0 2.0000
 /begin AXIS_DESCR STD_AXIS dmtl_ub_fil FORMULA_0657 5 0.0 25.0000 FORMAT "%5.2" /end AXIS_DESCR
 FORMAT "%6.3" /end CHARACTERISTIC
/begin CHARACTERISTIC KL_DMTL_T_FEIN_MIN "Minimale Feinleck-Messdauer | EN: Minimale Feinleck -Messdauer" CURVE 0x7084E TKL_UB_VV_UB 100.0 FORMULA_0658 0.0 510.0000 /begin AXIS_DESCR STD_AXIS can_fst_sum FORMULA_0557 6 0.0 127.5000 /end AXIS_DESCR /end CHARACTERISTIC
/begin CHARACTERISTIC KL_DMTL_T_GROB "Maximale Grobleck-Messdauer | EN: Maximale Grobleck -Messdauer" CURVE 0x7085C TKL_UB_VV_UB 100.0 FORMULA_0232 0.0 255.0000 /begin AXIS_DESCR STD_AXIS can_fst_sum FORMULA_0557 6 0.0 127.5000 /end AXIS_DESCR /end CHARACTERISTIC
/begin CHARACTERISTIC KL_DMTL_T_STABIL "Stabilzeit fuer Feinleck ueber Fuellstand | EN: Stabilzeit fuer Feinleck ueber Fuellstand" CURVE 0x7086A TKL_UB_VV_UB 100.0 FORMULA_0232 0.0 255.0000 /begin AXIS_DESCR STD_AXIS can_fst_sum FORMULA_0557 6 0.0 127.5000 /end AXIS_DESCR /end CHARACTERISTIC
/begin MEASUREMENT dmtl_anz_deckel "Anzahl durchgefuehrter Deckeldiagnoseversuche" UBYTE FORMULA_0543 0 0 0.0 255.0000 ECU_ADDRESS 0x3FBF00 /end MEASUREMENT
/begin MEASUREMENT dmtl_asc_ay "Querbeschleunigung bei KL15 aktiv" SWORD FORMULA_0132 0 0 -20.0000 20.0000 ECU_ADDRESS 0x3FBF02 /end MEASUREMENT
/begin MEASUREMENT dmtl_exd_p_st "Status externe Pumpen-Ansteuerung" UBYTE FORMULA_0635 0 0 0.0 255.0 ECU_ADDRESS 0x3FBF04 /end MEASUREMENT
/begin MEASUREMENT dmtl_exd_p_timeout "externe Pumpen-Ansteuerung Timeout" UBYTE FORMULA_0458 0 0 0.0 25.5000 ECU_ADDRESS 0x3FBF05 /end MEASUREMENT
/begin MEASUREMENT dmtl_exd_v_st "Status externe Ventil-Ansteuerung" UBYTE FORMULA_0635 0 0 0.0 255.0 ECU_ADDRESS 0x3FBF06 /end MEASUREMENT
/begin MEASUREMENT dmtl_exd_v_timeout "externe Ventil-Ansteuerung Timeout" UBYTE FORMULA_0458 0 0 0.0 25.5000 ECU_ADDRESS 0x3FBF07 /end MEASUREMENT
/begin MEASUREMENT dmtl_exd_h_st "Status externe Heizungs-Ansteuerung" UBYTE FORMULA_0635 0 0 0.0 255.0 ECU_ADDRESS 0x3FBF08 /end MEASUREMENT
/begin MEASUREMENT dmtl_exd_h_timeout "externe Heizungs-Ansteuerung Timeout " UBYTE FORMULA_0458 0 0 0.0 25.5000 ECU_ADDRESS 0x3FBF09 /end MEASUREMENT
/begin MEASUREMENT B_DMTL_VENTIL_FEHLER "Elektr. Ventilfehler sperrt TEV" UBYTE FORMULA_0636 0 0 0.0 255.0 ECU_ADDRESS 0x3FBF0A BIT_MASK 0x1 /end MEASUREMENT
/begin MEASUREMENT B_DMTL_H_EIN "DMTL-Heizungszustand" UBYTE FORMULA_0637 0 0 0.0 255.0 ECU_ADDRESS 0x3FBF0A BIT_MASK 0x2 /end MEASUREMENT
/begin MEASUREMENT B_DMTL_CLOSE_TEV "Anforderung TEV schliessen" UBYTE FORMULA_0638 0 0 0.0 255.0 ECU_ADDRESS 0x3FBF0A BIT_MASK 0x4 /end MEASUREMENT
/begin MEASUREMENT B_DMTL_KURZSCHLUSS "Pumpe hat el. Kurzschluss" UBYTE FORMULA_0639 0 0 0.0 255.0 ECU_ADDRESS 0x3FBF0A BIT_MASK 0x8 /end MEASUREMENT
/begin MEASUREMENT B_DMTL_2_STABIL "zweite Strom Stabilzeit" UBYTE FORMULA_0640 0 0 0.0 255.0 ECU_ADDRESS 0x3FBF0A BIT_MASK 0x10 /end MEASUREMENT
/begin MEASUREMENT B_DMTL_MOTORLAUFZEIT "Vorbedingung fuer Diagnose" UBYTE FORMULA_0641 0 0 0.0 255.0 ECU_ADDRESS 0x3FBF0A BIT_MASK 0x20 /end MEASUREMENT
/begin MEASUREMENT B_DMTL_RUN "Diagnose laeuft gerade" UBYTE FORMULA_0642 0 0 0.0 255.0 ECU_ADDRESS 0x3FBF0A BIT_MASK 0x80 /end MEASUREMENT
/begin MEASUREMENT dmtl_flags "Flags der DMTL" UBYTE FORMULA_0003 0 0 0.0 255.0000 ECU_ADDRESS 0x3FBF0A /end MEASUREMENT
/begin MEASUREMENT B_DMTL_START_DECKEL "Anforderung fuer Deckelpruefung" UBYTE FORMULA_0216 0 0 0.0 255.0 ECU_ADDRESS 0x3FBF0B BIT_MASK 0x1 /end MEASUREMENT
/begin MEASUREMENT B_DMTL_START_GROB "Anforderung fuer Grobleckdiag" UBYTE FORMULA_0545 0 0 0.0 255.0 ECU_ADDRESS 0x3FBF0B BIT_MASK 0x2 /end MEASUREMENT
/begin MEASUREMENT B_DMTL_START_FEIN "Anforderung fuer Feinleckdiag" UBYTE FORMULA_0546 0 0 0.0 255.0 ECU_ADDRESS 0x3FBF0B BIT_MASK 0x4 /end MEASUREMENT
/begin MEASUREMENT B_DMTL_EXD_START "Anforderung von Diagnosetester" UBYTE FORMULA_0547 0 0 0.0 255.0 ECU_ADDRESS 0x3FBF0B BIT_MASK 0x8 /end MEASUREMENT
/begin MEASUREMENT B_DMTL_START_DECKEL_GROB "Anforderung Grobleckdia ohne OBD-Relevanz" UBYTE FORMULA_0548 0 0 0.0 255.0 ECU_ADDRESS 0x3FBF0B BIT_MASK 0x10 /end MEASUREMENT
/begin MEASUREMENT dmtl_flags_start "Startbedingungen der DMTL" UBYTE FORMULA_0003 0 0 0.0 255.0000 ECU_ADDRESS 0x3FBF0B /end MEASUREMENT
/begin MEASUREMENT dmtl_fst "Verwendeter Fuellstand fuer Diagnose" UBYTE FORMULA_0557 0 0 0.0 127.5000 ECU_ADDRESS 0x3FBF0C /end MEASUREMENT
/begin MEASUREMENT dmtl_fst_max "Max. zul. Fuellstand fuer Diagnose" UBYTE FORMULA_0557 0 0 0.0 127.5000 ECU_ADDRESS 0x3FBF0D /end MEASUREMENT
/begin MEASUREMENT dmtl_i "DMTL Strom korrigiert" UWORD FORMULA_0551 0 0 0.0 147.4537 ECU_ADDRESS 0x3FBF0E /end MEASUREMENT
/begin MEASUREMENT dmtl_i_deckel "DMTL korrigierter Strom Deckeldia" UWORD FORMULA_0551 0 0 0.0 147.4537 ECU_ADDRESS 0x3FBF10 /end MEASUREMENT
/begin MEASUREMENT dmtl_i_fakt_fein "DMTL Faktor Referenzstrom fuer Feinleck" UBYTE FORMULA_0643 0 0 0.0 1.9921 ECU_ADDRESS 0x3FBF12 /end MEASUREMENT
/begin MEASUREMENT dmtl_i_filt_tank "DMTL Strom korr. und gefiltert fuer Betankung" UWORD FORMULA_0551 0 0 0.0 147.4537 ECU_ADDRESS 0x3FBF14 /end MEASUREMENT
/begin MEASUREMENT dmtl_i_filt_tank.rest "DMTL Strom korr. Filter-Rest fuer Betankung" UWORD FORMULA_0644 0 0 0.0 2.2499 ECU_ADDRESS 0x3FBF16 /end MEASUREMENT
/begin MEASUREMENT dmtl_i_grob "DMTL korrigierter Strom Grobleckdia" UWORD FORMULA_0551 0 0 0.0 147.4537 ECU_ADDRESS 0x3FBF18 /end MEASUREMENT
/begin MEASUREMENT dmtl_i_max "DMTL Strom Maximalwert" UWORD FORMULA_0551 0 0 0.0 147.4537 ECU_ADDRESS 0x3FBF1A /end MEASUREMENT
/begin MEASUREMENT dmtl_i_ref2 "DMTL Strom Referenzleck" UWORD FORMULA_0551 0 0 0.0 147.4537 ECU_ADDRESS 0x3FBF1C /end MEASUREMENT
/begin MEASUREMENT dmtl_i_ref_korr "DMTL korrigierter Strom Referenzleck" UWORD FORMULA_0551 0 0 0.0 147.4537 ECU_ADDRESS 0x3FBF1E /end MEASUREMENT
/begin MEASUREMENT dmtl_i_roh "DMTL Strom roh" UWORD FORMULA_0551 0 0 0.0 147.4537 ECU_ADDRESS 0x3FBF20 /end MEASUREMENT
/begin MEASUREMENT dmtl_i_stabil "DMTL stabiler Strom" UWORD FORMULA_0551 0 0 0.0 147.4537 ECU_ADDRESS 0x3FBF22 /end MEASUREMENT
/begin MEASUREMENT dmtl_korr_fakt "Korrekturfaktor Strom ueber Spannung" UWORD FORMULA_0075 0 0 0.0 2.0000 ECU_ADDRESS 0x3FBF24 /end MEASUREMENT
/begin MEASUREMENT dmtl_st "Betriebszustand" UBYTE FORMULA_0554 0 0 0.0 255.0 ECU_ADDRESS 0x3FBF26 /end MEASUREMENT
/begin MEASUREMENT dmtl_t_cc_dauer "Dauer Deckelmeldung seit Losfahren" UWORD FORMULA_0073 0 0 0.0 6553.5000 ECU_ADDRESS 0x3FBF28 /end MEASUREMENT
/begin MEASUREMENT dmtl_t_grob "DMTL Grobleckdauer" UWORD FORMULA_0073 0 0 0.0 6553.5000 ECU_ADDRESS 0x3FBF2A /end MEASUREMENT
/begin MEASUREMENT dmtl_t_deckel "DMTL Deckelmessdauer" UWORD FORMULA_0073 0 0 0.0 6553.5000 ECU_ADDRESS 0x3FBF2C /end MEASUREMENT
/begin MEASUREMENT dmtl_t_fein_min "DMTL min. Feinleckdauer" UWORD FORMULA_0073 0 0 0.0 6553.5000 ECU_ADDRESS 0x3FBF2E /end MEASUREMENT
/begin MEASUREMENT dmtl_t_feucht_dly "DMTL Startverzoegerung nach Feuchteabbruch" UWORD FORMULA_0073 0 0 0.0 6553.5000 ECU_ADDRESS 0x3FBF30 /end MEASUREMENT
/begin MEASUREMENT dmtl_t_i_filt_beg "Timer fuer schnelle Stromfilterung nach Ventil schalten" UBYTE FORMULA_0458 0 0 0.0 25.5000 ECU_ADDRESS 0x3FBF32 /end MEASUREMENT
/begin MEASUREMENT dmtl_t_ks "DMTL Kurzschlusszeit" UBYTE FORMULA_0645 0 0 0.0 127.5000 ECU_ADDRESS 0x3FBF33 /end MEASUREMENT
/begin MEASUREMENT dmtl_t_ref "DMTL aktuelle Referenzme�dauer" UBYTE FORMULA_0458 0 0 0.0 25.5000 ECU_ADDRESS 0x3FBF34 /end MEASUREMENT
/begin MEASUREMENT dmtl_t_stabil "DMTL Zeit seit Strom stabil" UWORD FORMULA_0073 0 0 0.0 6553.5000 ECU_ADDRESS 0x3FBF36 /end MEASUREMENT
/begin MEASUREMENT dmtl_t_stabil_max "max. DMTL Zeit fuer Strom stabil" UWORD FORMULA_0073 0 0 0.0 6553.5000 ECU_ADDRESS 0x3FBF38 /end MEASUREMENT
/begin MEASUREMENT dmtl_t_start_dly "DMTL Startverzoegerung nach KLA" UBYTE FORMULA_0458 0 0 0.0 25.5000 ECU_ADDRESS 0x3FBF3A /end MEASUREMENT
/begin MEASUREMENT dmtl_ub_filt "DMTL Gefilterte UB" SWORD FORMULA_0277 0 0 0.0 28.0000 ECU_ADDRESS 0x3FBF3C /end MEASUREMENT
/begin MEASUREMENT dmtl_ub_ref "DMTL Gefilterte UB bei Referenzmessung" SWORD FORMULA_0008 0 0 0.0 28.0000 ECU_ADDRESS 0x3FBF3E /end MEASUREMENT
/* ------------------ Abschnitt erzeugt aus pumg.dat ------------------ */
/begin CHARACTERISTIC K_PUMG_DIAG_MIN "Unter Grenze Umgebungsdruck | EN: Lower limit, ambient pressure [mbar]" VALUE 0x76044 TKW_VV_VV_SW 100.0 FORMULA_0984 400.0000 1200.0000 /end CHARACTERISTIC
/begin CHARACTERISTIC K_PUMG_DIAG_MAX "Obere Grenze Umgebungsdruck | EN: Upper limit, ambient pressure [mbar]" VALUE 0x76046 TKW_VV_VV_SW 100.0 FORMULA_0984 400.0000 1200.0000 /end CHARACTERISTIC
/begin CHARACTERISTIC K_PUMG_ERSATZ "Ersatzwert Umgebungsdruck | EN: Substitute value, ambient pressure [mbar]" VALUE 0x76048 TKW_VV_VV_SW 100.0 FORMULA_0984 400.0000 1200.0000 /end CHARACTERISTIC
/begin CHARACTERISTIC K_PUMG_SENSOR_STEIGUNG "Steigung des Drucksensors | EN: Pressure-sensor slope [mbar/V]" VALUE 0x7604A TKW_VV_VV_UW 100.0 FORMULA_0988 0.0 275.0000 FORMAT "%6.3" /end CHARACTERISTIC
/begin CHARACTERISTIC K_PUMG_SENSOR_OFFSET "Offset des Drucksensors | EN: Pressure-sensor offset [mbar]" VALUE 0x7604C TKW_VV_VV_SW 100.0 FORMULA_0986 0.0 625.0000 FORMAT "%6.3" /end CHARACTERISTIC
/begin CHARACTERISTIC K_PUMG_AEBEGR "Gradientenschwelle Sensorerfassung | EN: Gradient threshold, sensor acquisition [mbar/s]" VALUE 0x7604E TKW_VV_VV_UW 100.0 FORMULA_1058 0.0 40959.3750 FORMAT "%4.1" /end CHARACTERISTIC
/begin CHARACTERISTIC K_PUMG_TAU "Filterkonstante fuer die Umgebungsdruckerfassung | EN: Filter constant for ambient-pressure acquisition [s]" VALUE 0x76050 TKW_VV_VV_UB 100.0 FORMULA_0683 0.1004 25.6000 /end CHARACTERISTIC
/begin CHARACTERISTIC K_PUMG_OBD_PUMG_TAU "Zeitkonstante fuer pumg-Filterwert Gradienten-Check | EN: Zeitkonstante fuer pumg -Filterwert Gradienten-Check" VALUE 0x76052 TKW_VV_VV_UW 100.0 FORMULA_1059 0.1000 6553.5000 FORMAT "%5.2" /end CHARACTERISTIC
/begin CHARACTERISTIC K_PUMG_OBD_TIME_ML_MIN "Mindest-time_ml fuer Gradienten- bzw. Modellueberw. | EN: Mindest-time_ml für Gradient - bzw. Modellüberw." VALUE 0x76054 TKW_VV_VV_UL 100.0 FORMULA_0152 0.0 655.0000 FORMAT "%5.2" /end CHARACTERISTIC
/begin CHARACTERISTIC K_PUMG_OBD_ABW "max. zulaessige Abweichung von pumg zu pumg-Filterwert | EN: max. zulaessige Abweichung von pumg zu pumg-Filterwert" VALUE 0x76058 TKW_VV_VV_SW 100.0 FORMULA_1060 0.0 1000.0000 FORMAT "%5.2" /end CHARACTERISTIC
/begin CHARACTERISTIC K_PUMG_OBD_ZV_DELTA_MAX "max. Umgebungsdruckdifferenz von Stop bis Start" VALUE 0x7605A TKW_VV_VV_SW 100.0 FORMULA_0077 0.0 200.0000 FORMAT "%4.1" /end CHARACTERISTIC
/begin CHARACTERISTIC K_PUMG_OBD_MODEL_DELTA_MAX "max. zulaessige pumg-Modellwertabweichung | EN: max. zulaessige pumg -Modellwertabweichung" VALUE 0x7605C TKW_VV_VV_SW 100.0 FORMULA_0077 0.0 200.0000 FORMAT "%4.1" /end CHARACTERISTIC
/begin CHARACTERISTIC K_PUMG_OBD_MIN_MESS "Mindestanzahl Modellwerte bei VL fuer Integralbildung | EN: Mindestanzahl Modellwerte bei VL fuer Integralbildung" VALUE 0x7605E TKW_VV_VV_UW 100.0 FORMULA_0010 0.0 65535.0000 /end CHARACTERISTIC
/begin CHARACTERISTIC K_PUMG_OBD_CFG "Schalter Funktion - Ausgang | EN: 0x00 pumg_obd aus 0x01 pumg_obd an ELSE undef Schalter Funktion - Ausgang" VALUE 0x76060 TKW_VV_VV_UB 100.0 FORMULA_1061 0.0 255.0 /end CHARACTERISTIC
/begin CHARACTERISTIC K_PUMG_RBM_HEILUNG_CFG "Schalter RBM Heilung bei PUMG_OBD_IO_ZYKLUSVERGLEICH" VALUE 0x76061 TKW_VV_VV_UB 100.0 FORMULA_1062 0.0 255.0 /end CHARACTERISTIC
/begin CHARACTERISTIC K_PUMG_OBD_N_MAX "N-Max-Begrenzung pumg-Modellbewertung" VALUE 0x76062 TKW_VV_VV_SW 100.0 FORMULA_0006 0.0 10000.0000 /end CHARACTERISTIC
/begin CHARACTERISTIC K_PUMG_OBD_N_MIN "Mindest-N fuer pumg-Modellbewertung" VALUE 0x76064 TKW_VV_VV_SW 100.0 FORMULA_0006 0.0 10000.0000 /end CHARACTERISTIC
/begin CHARACTERISTIC K_PUMG_OBD_TUMG_MIN "Mindest-tumg fuer pumg-Modellbewertung | EN: Mindest-tumg fuer pumg -Modellbewertung" VALUE 0x76066 TKW_VV_VV_SW 100.0 FORMULA_0023 -50.0000 170.0000 FORMAT "%4.1" /end CHARACTERISTIC
/begin CHARACTERISTIC K_PUMG_OBD_PWG_MIN "Mindest-pwg_soll fuer pumg-Modellbewertung" VALUE 0x76068 TKW_VV_VV_SW 100.0 FORMULA_0001 -10.0000 120.0000 FORMAT "%4.1" /end CHARACTERISTIC
/begin CHARACTERISTIC K_PUMG_OBD_V_MAX "v-max-Begrenzung fuer pumg-Modellbewertung" VALUE 0x7606A TKW_VV_VV_SW 100.0 FORMULA_0078 -80.0000 360.0000 FORMAT "%4.1" /end CHARACTERISTIC
/begin CHARACTERISTIC K_PUMG_OBD_TAN_MAX "Hoechst-tan fuer pumg-Modellbewertung" VALUE 0x7606C TKW_VV_VV_SW 100.0 FORMULA_0023 -50.0000 170.0000 FORMAT "%4.1" /end CHARACTERISTIC
/begin CHARACTERISTIC K_PUMG_OBD_TAN_MIN "Mindest-tan fuer pumg-Modellbewertung" VALUE 0x7606E TKW_VV_VV_SW 100.0 FORMULA_0023 -50.0000 170.0000 FORMAT "%4.1" /end CHARACTERISTIC
/begin CHARACTERISTIC K_PUMG_OBD_ML_MS "Zeitdauer von ZUST_ML nach ZUST_MS_A fuer Init | EN: Zeitdauer von ZUST_ML nach ZUST_MS_A für Init" VALUE 0x76070 TKW_VV_VV_UB 100.0 FORMULA_1063 0.0 4.2500 /end CHARACTERISTIC
/begin CHARACTERISTIC K_PUMG_OBD_FPLAU_ABW_MAX "tolerierte fplau-Abweichung bei pumg-Modellberechnung" VALUE 0x76072 TKW_VV_VV_SW 100.0 FORMULA_0709 -200.0000 200.0000 FORMAT "%4.1" /end CHARACTERISTIC
/begin CHARACTERISTIC K_PUMG_OBD_FPLAU_ABW_MAX_T "tolerierte Zeit der fplau-Abweichung" VALUE 0x76074 TKW_VV_VV_UW 100.0 FORMULA_0073 0.0 6553.5000 FORMAT "%4.1" /end CHARACTERISTIC
/begin CHARACTERISTIC KF_PUMG_OBD_RF_MAX_P400 "tumg_obd-Kennfeld tmot-ml-Offset" MAP 0x76076 TKF_SW_SW_SW 100.0 FORMULA_0007 0.0 2.0000 /begin AXIS_DESCR STD_AXIS n FORMULA_0006 20 0.0 10000.0000 /end AXIS_DESCR
 /begin AXIS_DESCR STD_AXIS tan FORMULA_0023 8 -50.0000 170.0000 FORMAT "%4.1" /end AXIS_DESCR
 FORMAT "%6.3" /end CHARACTERISTIC
/begin CHARACTERISTIC KF_PUMG_OBD_RF_MAX_P500 "tumg_obd-Kennfeld tmot-ml-Offset" MAP 0x761F0 TKF_SW_SW_SW 100.0 FORMULA_0007 0.0 2.0000 /begin AXIS_DESCR STD_AXIS n FORMULA_0006 20 0.0 10000.0000 /end AXIS_DESCR
 /begin AXIS_DESCR STD_AXIS tan FORMULA_0023 8 -50.0000 170.0000 FORMAT "%4.1" /end AXIS_DESCR
 FORMAT "%6.3" /end CHARACTERISTIC
/begin CHARACTERISTIC KF_PUMG_OBD_P_STAU_KOMP "pumg-Staudruckkompensation | EN: Ambient-pressure ram-pressure compensation" MAP 0x7636A TKF_SW_SW_SW 100.0 FORMULA_0077 -500.0000 500.0000 /begin AXIS_DESCR STD_AXIS n FORMULA_0006 4 0.0 10000.0000 /end AXIS_DESCR
 /begin AXIS_DESCR STD_AXIS v_hinten FORMULA_0078 4 -80.0000 360.0000 FORMAT "%4.1" /end AXIS_DESCR
 FORMAT "%4.1" /end CHARACTERISTIC
/begin CHARACTERISTIC K_PUMG_MIN_E2 "min. Umgebungsdruck | EN: Min. Umgebungsdruck" VALUE 0x7959C TKW_VV_VV_SW 100.0 FORMULA_0077 250.0000 1200.0000 FORMAT "%4.1" /end CHARACTERISTIC
/begin CHARACTERISTIC K_PUMG_MAX_E2 "max. Umgebungsdruck | EN: Max. Umgebungsdruck" VALUE 0x7959E TKW_VV_VV_SW 100.0 FORMULA_0077 400.0000 1350.0000 FORMAT "%4.1" /end CHARACTERISTIC
/begin CHARACTERISTIC K_PUMG_MAX_NEG_GRAD_E2 "Gradientenschwelle Ebene 2 | EN: Gradientschwelle Ebene2" VALUE 0x795A0 TKW_VV_VV_SW 100.0 FORMULA_1058 -20480.0000 0.0 FORMAT "%4.1" /end CHARACTERISTIC
/begin CHARACTERISTIC K_PUMG_MAX_POS_GRAD_E2 "Gradientenschwelle Ebene 2 | EN: Gradientschwelle Ebene2" VALUE 0x795A2 TKW_VV_VV_SW 100.0 FORMULA_1058 0.0 20479.3750 FORMAT "%4.1" /end CHARACTERISTIC
/begin MEASUREMENT pumg_ad "Eingelesener Spannungswert fuer Umgebungsdruck" SWORD FORMULA_0123 0 0 0.0 1023.0000 ECU_ADDRESS 0x3FCE1E /end MEASUREMENT
/begin MEASUREMENT pumg_roh "Ungefilterter Messwert" SWORD FORMULA_0077 0 0 400.0000 1200.0000 ECU_ADDRESS 0x3FCE20 /end MEASUREMENT
/begin MEASUREMENT pumg_obd_filter "gradientenbasierter vorheriger Messwert" SWORD FORMULA_0077 0 0 400.0000 1200.0000 ECU_ADDRESS 0x3FCE22 /end MEASUREMENT
/begin MEASUREMENT pumg_obd_modell_freigabe "OBD-Status pumg" UBYTE FORMULA_1056 0 0 0.0 255.0 ECU_ADDRESS 0x3FCE28 /end MEASUREMENT
/begin MEASUREMENT pumg_obd_modell "pumg-Modellwert" SWORD FORMULA_0077 0 0 400.0000 1200.0000 ECU_ADDRESS 0x3FCE2A /end MEASUREMENT
/begin MEASUREMENT pumg_obd_modell_mw "pumg-Modellmittelwert" SWORD FORMULA_0077 0 0 400.0000 1200.0000 ECU_ADDRESS 0x3FCE2C /end MEASUREMENT
/begin MEASUREMENT pumg_obd_modell_integral "pumg-Modellwertintegral" SLONG FORMULA_1057 0 0 400.0000 120000.0000 ECU_ADDRESS 0x3FCE30 /end MEASUREMENT
/begin MEASUREMENT pumg_obd_modell_integral_cnt "pumg-Modellwertintegral-COUNTER" UWORD FORMULA_0010 0 0 0.0 65535.0000 ECU_ADDRESS 0x3FCE34 /end MEASUREMENT
/begin MEASUREMENT pumg_obd_rf "resultierende rf aus KF_PUMG_OBD_RF_MAX_P400/P500" SWORD FORMULA_0007 0 0 0.0 2.0000 ECU_ADDRESS 0x3FCE36 /end MEASUREMENT
/begin MEASUREMENT pumg_obd_fplau_abw_max_t "Zeit der fplau-Abweichung fuer pumg_modell-Berechnung" UWORD FORMULA_0073 0 0 0.0 6553.5000 ECU_ADDRESS 0x3FCE38 /end MEASUREMENT
/begin MEASUREMENT pumg_e2 "Umgebungsdruck Ebene 2" SWORD FORMULA_0077 0 0 400.0000 1200.0000 ECU_ADDRESS 0x3FD7DC /end MEASUREMENT
/* ------------------ Abschnitt erzeugt aus testfunktion.dat ------------------ */
/begin CHARACTERISTIC K_TEST "Maxwert" VALUE 0x7751E TKW_VV_VV_UW 100.0 FORMULA_0010 0.0 65535.0000 /end CHARACTERISTIC
/begin CHARACTERISTIC K_TEST_X "Testwert-x" VALUE 0x77520 TKW_VV_VV_UW 100.0 FORMULA_0010 0.0 65535.0000 /end CHARACTERISTIC
/begin CHARACTERISTIC K_TEST_Y "Testwert-y" VALUE 0x77522 TKW_VV_VV_UW 100.0 FORMULA_0010 0.0 65535.0000 /end CHARACTERISTIC
/begin CHARACTERISTIC K_TEST_LA_BANK1 "Testarray" VALUE 0x77524 TKW_VV_VV_UB 100.0 FORMULA_0003 0.0 255.0000 /end CHARACTERISTIC
/begin CHARACTERISTIC K_TEST_LA_BANK2 "Testarray" VALUE 0x77525 TKW_VV_VV_UB 100.0 FORMULA_0003 0.0 255.0000 /end CHARACTERISTIC
/begin CHARACTERISTIC K_TEST_MD_ZYL1 "Testarray" VALUE 0x77526 TKW_VV_VV_UB 100.0 FORMULA_0003 0.0 255.0000 /end CHARACTERISTIC
/begin CHARACTERISTIC K_TEST_MD_ZYL2 "Testarray" VALUE 0x77527 TKW_VV_VV_UB 100.0 FORMULA_0003 0.0 255.0000 /end CHARACTERISTIC
/begin CHARACTERISTIC K_TEST_MD_ZYL3 "Testarray" VALUE 0x77528 TKW_VV_VV_UB 100.0 FORMULA_0003 0.0 255.0000 /end CHARACTERISTIC
/begin CHARACTERISTIC K_TEST_MD_ZYL4 "Testarray" VALUE 0x77529 TKW_VV_VV_UB 100.0 FORMULA_0003 0.0 255.0000 /end CHARACTERISTIC
/begin CHARACTERISTIC K_TEST_MD_ZYL5 "Testarray" VALUE 0x7752A TKW_VV_VV_UB 100.0 FORMULA_0003 0.0 255.0000 /end CHARACTERISTIC
/begin CHARACTERISTIC K_TEST_MD_ZYL6 "Testarray" VALUE 0x7752B TKW_VV_VV_UB 100.0 FORMULA_0003 0.0 255.0000 /end CHARACTERISTIC
/begin CHARACTERISTIC K_TEST_MD_ZYL7 "Testarray" VALUE 0x7752C TKW_VV_VV_UB 100.0 FORMULA_0003 0.0 255.0000 /end CHARACTERISTIC
/begin CHARACTERISTIC K_TEST_MD_ZYL8 "Testarray" VALUE 0x7752D TKW_VV_VV_UB 100.0 FORMULA_0003 0.0 255.0000 /end CHARACTERISTIC
/begin CHARACTERISTIC K_TEST_MD_ZYL9 "Testarray" VALUE 0x7752E TKW_VV_VV_UB 100.0 FORMULA_0003 0.0 255.0000 /end CHARACTERISTIC
/begin CHARACTERISTIC K_TEST_MD_ZYL10 "Testarray" VALUE 0x7752F TKW_VV_VV_UB 100.0 FORMULA_0003 0.0 255.0000 /end CHARACTERISTIC
/begin CHARACTERISTIC K_TEST_MD_ZYL11 "Testarray" VALUE 0x77530 TKW_VV_VV_UB 100.0 FORMULA_0003 0.0 255.0000 /end CHARACTERISTIC
/begin CHARACTERISTIC K_TEST_MD_ZYL12 "Testarray" VALUE 0x77531 TKW_VV_VV_UB 100.0 FORMULA_0003 0.0 255.0000 /end CHARACTERISTIC
/begin CHARACTERISTIC KL_TEST_X "Testkennlinie" CURVE 0x77532 TKL_UW_VV_UW 100.0 FORMULA_0083 0.0 65535.0000 /begin AXIS_DESCR STD_AXIS ein_x FORMULA_0010 4 0.0 65535.0000 /end AXIS_DESCR FORMAT "%5.2" /end CHARACTERISTIC
/begin CHARACTERISTIC KF_TEST_XY "Testkennfeld" MAP 0x77544 TKF_UW_UW_UW 100.0 FORMULA_0010 0.0 65535.0000 /begin AXIS_DESCR STD_AXIS ein_x FORMULA_0010 5 0.0 65535.0000 /end AXIS_DESCR /begin AXIS_DESCR STD_AXIS ein_y FORMULA_0010 3 0.0 65535.0000 /end AXIS_DESCR /end CHARACTERISTIC
/begin MEASUREMENT testvariable "Test" UWORD FORMULA_0010 0 0 0.0 65535.0000 ECU_ADDRESS 0x3FD23A /end MEASUREMENT
/begin MEASUREMENT test_kl_ip "Test" UWORD FORMULA_0010 0 0 0.0 65535.0000 ECU_ADDRESS 0x3FD23C /end MEASUREMENT
/begin MEASUREMENT test_kf_ip "Test" UWORD FORMULA_0010 0 0 0.0 65535.0000 ECU_ADDRESS 0x3FD23E /end MEASUREMENT
/* ------------------ Abschnitt erzeugt aus vanos.dat ------------------ */
/begin CHARACTERISTIC K_VAN_ANSCHL_DELTA "Abstand Soll-Anschlag  | EN: Abstand Soll-Anschlag | [Code V452 INJ 0x64154] Distance target-to-stop: I part frozen near the stops; target = stop - delta during the stop-learning/pressure routine." VALUE 0x7822E TKW_VV_VV_SW 100.0 FORMULA_0111 -80.0000 80.0000 FORMAT "%4.1" /end CHARACTERISTIC
/begin CHARACTERISTIC K_VAN_ANSCHL_HYS "Hysterese Anschlag anfahren | EN: Hysterese Anschlag anfahren" VALUE 0x78230 TKW_VV_VV_SW 100.0 FORMULA_0111 -80.0000 80.0000 FORMAT "%4.1" /end CHARACTERISTIC
/begin CHARACTERISTIC K_VAN_ANSCHL_I_E1 "Ventilstrom am Anschlag max. Spr. | EN: Ventilstrom am Anschlag max. Spr." VALUE 0x78232 TKW_VV_VV_SW 100.0 FORMULA_1198 -1000.0000 3000.0000 /end CHARACTERISTIC
/begin CHARACTERISTIC K_VAN_ANSCHL_I_A1 "Ventilstrom am Anschlag max. Spr. | EN: Ventilstrom am Anschlag max. Spr." VALUE 0x78234 TKW_VV_VV_SW 100.0 FORMULA_1198 -1000.0000 3000.0000 /end CHARACTERISTIC
/begin CHARACTERISTIC K_VAN_ANSCHL_I_E2 "Ventilstrom am Anschlag max. Spr. | EN: Ventilstrom am Anschlag max. Spr." VALUE 0x78236 TKW_VV_VV_SW 100.0 FORMULA_1198 -1000.0000 3000.0000 /end CHARACTERISTIC
/begin CHARACTERISTIC K_VAN_ANSCHL_I_A2 "Ventilstrom am Anschlag max. Spr. | EN: Ventilstrom am Anschlag max. Spr." VALUE 0x78238 TKW_VV_VV_SW 100.0 FORMULA_1198 -1000.0000 3000.0000 /end CHARACTERISTIC
/begin CHARACTERISTIC K_VAN_ANSCHL_I_RAMPE "Strom-Rampe zum Anschlag anfahren | EN: Strom-Rampe zum A nschlag anfahren" VALUE 0x7823A TKW_VV_VV_SW 100.0 FORMULA_1211 -1000.0000 3000.0000 /end CHARACTERISTIC
/begin CHARACTERISTIC K_VAN_ANSCHL_I_START_MAX "Max. Strom Beginn Anschlag anfahren | EN: Max. Strom Beginn A nschlag anfahren" VALUE 0x7823C TKW_VV_VV_SW 100.0 FORMULA_1198 -1000.0000 3000.0000 /end CHARACTERISTIC
/begin CHARACTERISTIC K_VAN_ANSCHL_T "Dauer Anschlag lernen | EN: Dauer Anschlag lernen" VALUE 0x7823E TKW_VV_VV_UB 100.0 FORMULA_0317 0.0 2.5500 /end CHARACTERISTIC
/begin CHARACTERISTIC K_VAN_BEGR_AB_FAKT_E "Abregelzeit Min-Begrenzung | [Code V452 INJ 0x64D64] Fade-out step of the cold-start target minimum." VALUE 0x7823F TKW_VV_VV_UB 100.0 FORMULA_1212 164.0000 0.6431 /end CHARACTERISTIC
/begin CHARACTERISTIC K_VAN_CFG_E1 "Konfig Vanos Steller/Geberrad | EN: 0x0 Flueg 0x1 Hochdr 0x2 MCS ELSE undef. Konfig Vanos Steller/Geberrad" VALUE 0x78240 TKW_VV_VV_UB 100.0 FORMULA_1213 0.0 255.0 /end CHARACTERISTIC
/begin CHARACTERISTIC K_VAN_CFG_A1 "Konfig Vanos Steller/Geberrad | EN: 0x0 Flueg 0x1 Hochdr 0x2 MCS ELSE undef. Konfig Vanos Steller/Geberrad" VALUE 0x78241 TKW_VV_VV_UB 100.0 FORMULA_1213 0.0 255.0 /end CHARACTERISTIC
/begin CHARACTERISTIC K_VAN_CFG_E2 "Konfig Vanos Steller/Geberrad | EN: 0x0 Flueg 0x1 Hochdr 0x2 MCS ELSE undef. Konfig Vanos Steller/Geberrad" VALUE 0x78242 TKW_VV_VV_UB 100.0 FORMULA_1213 0.0 255.0 /end CHARACTERISTIC
/begin CHARACTERISTIC K_VAN_CFG_A2 "Konfig Vanos Steller/Geberrad | EN: 0x0 Flueg 0x1 Hochdr 0x2 MCS ELSE undef. Konfig Vanos Steller/Geberrad" VALUE 0x78243 TKW_VV_VV_UB 100.0 FORMULA_1213 0.0 255.0 /end CHARACTERISTIC
/begin CHARACTERISTIC K_VAN_ERR_CFG "Ersatz-Sollwert bei Fehler | EN: 0x0 lls+wdk+ti 0x1 lls+ti 0x2 wdk+ti 0x3 ti 0x4 lls+wdk 0x5 lls 0x6 wdk Ersatz-Sollwert bei Fehler 0 | [Code V452 INJ 0x64154] Bit mask selecting which fault conditions switch to K_VAN_SOLL_ERSATZ (bits: throttle safety modes, cylinder cut-off, VANOS safety status). 6 here." VALUE 0x78244 TKW_VV_VV_UB 100.0 FORMULA_1214 0.0 255.0 /end CHARACTERISTIC
/begin CHARACTERISTIC K_VAN_DRUCK_VERSTELL_E "min. Fr�hverstellung Druckerkennung" VALUE 0x78246 TKW_VV_VV_SW 100.0 FORMULA_0111 -80.0000 80.0000 FORMAT "%4.1" /end CHARACTERISTIC
/begin CHARACTERISTIC K_VAN_DRUCK_SOLL_OFFSET_E "Soll-Offset auf van_druck_start_e" VALUE 0x78248 TKW_VV_VV_SW 100.0 FORMULA_0111 -80.0000 80.0000 FORMAT "%4.1" /end CHARACTERISTIC
/begin CHARACTERISTIC K_VAN_DRUCK_CNT "Anzahl Fr�hverstellungen Druckerk." VALUE 0x7824A TKW_VV_VV_UB 100.0 FORMULA_0003 0.0 10.0000 /end CHARACTERISTIC
/begin CHARACTERISTIC K_VAN_D_XD_TAU_Einlass "Gradient Regelabweichung Filterzeit" VALUE 0x7824B TKW_VV_VV_UB 100.0 FORMULA_0664 0.0101 2.5600 /end CHARACTERISTIC
/begin CHARACTERISTIC K_VAN_D_XD_TAU_Auslass "Gradient Regelabweichung Filterzeit" VALUE 0x7824C TKW_VV_VV_UB 100.0 FORMULA_0664 0.0101 2.5600 /end CHARACTERISTIC
/begin CHARACTERISTIC K_VAN_EXD_I_MAX_Einlass "Pr�flauf Ventilstrom max. Spr." VALUE 0x7824E TKW_VV_VV_SW 100.0 FORMULA_1198 -1000.0000 3000.0000 /end CHARACTERISTIC
/begin CHARACTERISTIC K_VAN_EXD_I_MAX_Auslass "Pr�flauf Ventilstrom max. Spr." VALUE 0x78250 TKW_VV_VV_SW 100.0 FORMULA_1198 -1000.0000 3000.0000 /end CHARACTERISTIC
/begin CHARACTERISTIC K_VAN_EXD_I_MIN_Einlass "Pr�flauf Ventilstrom min. Spr." VALUE 0x78252 TKW_VV_VV_SW 100.0 FORMULA_1198 -1000.0000 3000.0000 /end CHARACTERISTIC
/begin CHARACTERISTIC K_VAN_EXD_I_MIN_Auslass "Pr�flauf Ventilstrom min. Spr." VALUE 0x78254 TKW_VV_VV_SW 100.0 FORMULA_1198 -1000.0000 3000.0000 /end CHARACTERISTIC
/begin CHARACTERISTIC K_VAN_EXD_N_SOLL "Van Prueflauf LLR-Sollwert | EN: Van Prueflauf LLR-Sollwert" VALUE 0x78256 TKW_VV_VV_SW 100.0 FORMULA_0006 0.0 10000.0000 /end CHARACTERISTIC
/begin CHARACTERISTIC K_VAN_EXD_SPR_MAX_MIN_Einlass "kleinste gelernte MaxSpr f�r min-Pr�fen" VALUE 0x78258 TKW_VV_VV_SW 100.0 FORMULA_0111 50.0000 160.0000 FORMAT "%4.1" /end CHARACTERISTIC
/begin CHARACTERISTIC K_VAN_EXD_SPR_MAX_MIN_Auslass "kleinste gelernte MaxSpr f�r min-Pr�fen" VALUE 0x7825A TKW_VV_VV_SW 100.0 FORMULA_0111 50.0000 160.0000 FORMAT "%4.1" /end CHARACTERISTIC
/begin CHARACTERISTIC K_VAN_EXD_T_ANSCHL "Dauer Anschlag pr�fen | EN: Dauer Anschlag prüfen" VALUE 0x7825C TKW_VV_VV_UB 100.0 FORMULA_0317 0.0 2.5500 /end CHARACTERISTIC
/begin CHARACTERISTIC K_VAN_EXD_T_GUETE "Dauer Ventil-Guete messen" VALUE 0x7825E TKW_VV_VV_UW 100.0 FORMULA_0021 0.0 655.0000 FORMAT "%5.2" /end CHARACTERISTIC
/begin CHARACTERISTIC K_VAN_EXD_TMOT_MIN "Min. Temp.f�r Pr�flauf | EN: Min. Temp.für Prüflauf" VALUE 0x78260 TKW_VV_VV_SW 100.0 FORMULA_0023 -50.0000 170.0000 FORMAT "%4.1" /end CHARACTERISTIC
/begin CHARACTERISTIC K_VAN_EXD_GUETE_TAU "Ventilguete Aenderung pro Messung" VALUE 0x78262 TKW_VV_VV_UB 100.0 FORMULA_1215 0.0 0.9960 /end CHARACTERISTIC
/begin CHARACTERISTIC K_VAN_EXD_VERST_SOLL_MAX_Einlass "grosse Spr bei Verstellzeitmessung" VALUE 0x78264 TKW_VV_VV_SW 100.0 FORMULA_0111 50.0000 160.0000 FORMAT "%4.1" /end CHARACTERISTIC
/begin CHARACTERISTIC K_VAN_EXD_VERST_SOLL_MAX_Auslass "grosse Spr bei Verstellzeitmessung" VALUE 0x78266 TKW_VV_VV_SW 100.0 FORMULA_0111 50.0000 160.0000 FORMAT "%4.1" /end CHARACTERISTIC
/begin CHARACTERISTIC K_VAN_EXD_VERST_SOLL_MIN_Einlass "kleine Spr bei Verstellzeitmessung" VALUE 0x78268 TKW_VV_VV_SW 100.0 FORMULA_0111 50.0000 160.0000 FORMAT "%4.1" /end CHARACTERISTIC
/begin CHARACTERISTIC K_VAN_EXD_VERST_SOLL_MIN_Auslass "kleine Spr bei Verstellzeitmessung" VALUE 0x7826A TKW_VV_VV_SW 100.0 FORMULA_0111 50.0000 160.0000 FORMAT "%4.1" /end CHARACTERISTIC
/begin CHARACTERISTIC K_VAN_EXD_VERST_TMAX "Timeout Verstellzeitmessung | EN: Timeout Verstellzeitmessung" VALUE 0x7826C TKW_VV_VV_UB 100.0 FORMULA_0317 0.0 2.5500 /end CHARACTERISTIC
/begin CHARACTERISTIC K_VAN_EXD_VERST_TOL "Abweichung Verstellmessung Ende | EN: Abweichung Verstellme ssung Ende" VALUE 0x7826E TKW_VV_VV_SW 100.0 FORMULA_0111 -80.0000 80.0000 FORMAT "%4.1" /end CHARACTERISTIC
/begin CHARACTERISTIC K_VAN_EXD_VERST_TOL_START "Abweichung Verstellmessung Start | EN: Abweichung Verstellme ssung Start" VALUE 0x78270 TKW_VV_VV_SW 100.0 FORMULA_0111 -80.0000 80.0000 FORMAT "%4.1" /end CHARACTERISTIC
/begin CHARACTERISTIC K_VAN_FILTR_AMPL "Amplitude Sollwertwackeln gegen Filtration" VALUE 0x78272 TKW_VV_VV_SW 100.0 FORMULA_0111 -80.0000 80.0000 FORMAT "%4.1" /end CHARACTERISTIC
/begin CHARACTERISTIC K_VAN_FILTR_DAUER "max. Dauer ohne Sollaenderung" VALUE 0x78274 TKW_VV_VV_UW 100.0 FORMULA_0073 0.0 6553.5000 FORMAT "%4.1" /end CHARACTERISTIC
/begin CHARACTERISTIC K_VAN_FILTR_PERIOD "Periodendauer eines Wackelzyklus" VALUE 0x78276 TKW_VV_VV_UB 100.0 FORMULA_0458 0.0 25.5000 /end CHARACTERISTIC
/begin CHARACTERISTIC K_VAN_FILTR_SOLL_DELTA "Max. Sollwert-�nderung ohne Filtration" VALUE 0x78278 TKW_VV_VV_SW 100.0 FORMULA_0111 -80.0000 80.0000 FORMAT "%4.1" /end CHARACTERISTIC
/begin CHARACTERISTIC K_VAN_FILTR_T_ML_MIN "Min. Motorlaufzeit f�r Filtrationsoffset" VALUE 0x7827A TKW_VV_VV_UW 100.0 FORMULA_0021 0.0 655.0000 FORMAT "%5.2" /end CHARACTERISTIC
/begin CHARACTERISTIC K_VAN_FILTR_TV_PRUEF "Pruefzeitpunkt Filtrationserkennung" VALUE 0x7827C TKW_VV_VV_UB 100.0 FORMULA_1216 0.0 99.6093 /end CHARACTERISTIC
/begin CHARACTERISTIC K_VAN_GUETE_CFG "Auswahl Ventilgueteberechnung" VALUE 0x7827D TKW_VV_VV_UB 100.0 FORMULA_1217 0.0 255.0 /end CHARACTERISTIC
/begin CHARACTERISTIC K_VAN_GUETE_DAUER "Dauer Ventilgueteadaption" VALUE 0x7827E TKW_VV_VV_UW 100.0 FORMULA_0073 0.0 6553.5000 FORMAT "%4.1" /end CHARACTERISTIC
/begin CHARACTERISTIC K_VAN_GUETE_INIT "Ruecksetz-Wert der Ventilguete" VALUE 0x78280 TKW_VV_VV_UW 100.0 FORMULA_0024 0.0 1.9999 FORMAT "%7.4" /end CHARACTERISTIC
/begin CHARACTERISTIC K_VAN_GUETE_PAUSE "Pause zwischen Ventilgueteadaption" VALUE 0x78282 TKW_VV_VV_UW 100.0 FORMULA_1197 0.0 109.0000 FORMAT "%4.1" /end CHARACTERISTIC
/begin CHARACTERISTIC K_VAN_GUETE_RESET "Pumpen-Pauli's INCA-RESET Knopf" VALUE 0x78284 TKW_VV_VV_UB 100.0 FORMULA_1218 0.0 255.0 /end CHARACTERISTIC
/begin CHARACTERISTIC K_VAN_GUETE_RESET_MIN "Min. zulaessige Guete ohne Reset" VALUE 0x78286 TKW_VV_VV_UW 100.0 FORMULA_0024 0.0 1.9999 FORMAT "%7.4" /end CHARACTERISTIC
/begin CHARACTERISTIC K_VAN_GUETE_RESET_ZEIT "Dauer schlechter Ventilguete bis Reset" VALUE 0x78288 TKW_VV_VV_UW 100.0 FORMULA_0073 0.0 6553.5000 FORMAT "%4.1" /end CHARACTERISTIC
/begin CHARACTERISTIC K_VAN_FREQU_SPUEL_MIN "min. PWM-Frequenz Ventile spuelen | EN: Min. PWM -Frequenz Ventile spülen" VALUE 0x7828A TKW_VV_VV_UW 100.0 FORMULA_1192 16.0000 400.0000 FORMAT "%4.1" /end CHARACTERISTIC
/begin CHARACTERISTIC K_VAN_FREQU_STAND "PWM-Frequenz Ventile Motor steht | EN: PWM-Frequenz Ventile Motor steht" VALUE 0x7828C TKW_VV_VV_UW 100.0 FORMULA_1192 16.0000 400.0000 FORMAT "%4.1" /end CHARACTERISTIC
/begin CHARACTERISTIC K_VAN_FREQU_ANSCHL "PWM-Frequenz Ventile am Anschlag | EN: PWM-Frequenz Ventile am Anschlag" VALUE 0x7828E TKW_VV_VV_UW 100.0 FORMULA_1192 16.0000 400.0000 FORMAT "%4.1" /end CHARACTERISTIC
/begin CHARACTERISTIC K_VAN_FREQU_WICHT "Wichtung Ventilguete PWM-Frequenz" VALUE 0x78290 TKW_VV_VV_UB 100.0 FORMULA_0643 0.0 1.9921 /end CHARACTERISTIC
/begin CHARACTERISTIC K_VAN_GUETE_TAU "Ventilguete Aenderung pro Messung" VALUE 0x78291 TKW_VV_VV_UB 100.0 FORMULA_1215 0.0 0.9960 /end CHARACTERISTIC
/begin CHARACTERISTIC K_VAN_GUETE_TMOT "Minimaltemp fuer Gueteberechnung" VALUE 0x78292 TKW_VV_VV_SW 100.0 FORMULA_0023 -50.0000 170.0000 FORMAT "%4.1" /end CHARACTERISTIC
/begin CHARACTERISTIC K_VAN_GUETE_TOEL "Minimaltemp fuer Gueteberechnung" VALUE 0x78294 TKW_VV_VV_SW 100.0 FORMULA_0023 -50.0000 170.0000 FORMAT "%4.1" /end CHARACTERISTIC
/begin CHARACTERISTIC K_VAN_I_I_MAX "Regler I Anteil Maxwert | EN: Controller integral share, maximum [mA] | [Code V452 INJ 0x64154] Upper limit of the controller I part." VALUE 0x78296 TKW_VV_VV_SW 100.0 FORMULA_1198 -1000.0000 3000.0000 /end CHARACTERISTIC
/begin CHARACTERISTIC K_VAN_I_I_MIN "Regler I Anteil Minwert | EN: Controller integral share, minimum [mA] | [Code V452 INJ 0x64154] Lower limit of the controller I part." VALUE 0x78298 TKW_VV_VV_SW 100.0 FORMULA_1198 -1000.0000 3000.0000 /end CHARACTERISTIC
/begin CHARACTERISTIC K_VAN_I_MAX "Ventilstrom Maxwert | EN: Valve current, maximum [mA]" VALUE 0x7829A TKW_VV_VV_SW 100.0 FORMULA_1198 -1000.0000 3000.0000 /end CHARACTERISTIC
/begin CHARACTERISTIC K_VAN_START_I_MAX_AUSLASS "Ventilstrom im Start  | EN: Valve current during start [mA]" VALUE 0x7829C TKW_VV_VV_SW 100.0 FORMULA_1198 -1000.0000 3000.0000 /end CHARACTERISTIC
/begin CHARACTERISTIC K_VAN_INVERT_E1 "Norm: Stromlos => max.Spr | EN: Normalisation: de-energised = maximum spread" VALUE 0x7829E TKW_VV_VV_UB 100.0 FORMULA_1219 0.0 255.0 /end CHARACTERISTIC
/begin CHARACTERISTIC K_VAN_INVERT_A1 "Norm: Stromlos => max.Spr | EN: Normalisation: de-energised = maximum spread" VALUE 0x7829F TKW_VV_VV_UB 100.0 FORMULA_1219 0.0 255.0 /end CHARACTERISTIC
/begin CHARACTERISTIC K_VAN_INVERT_E2 "Norm: Stromlos => max.Spr | EN: Normalisation: de-energised = maximum spread" VALUE 0x782A0 TKW_VV_VV_UB 100.0 FORMULA_1219 0.0 255.0 /end CHARACTERISTIC
/begin CHARACTERISTIC K_VAN_INVERT_A2 "Norm: Stromlos => max.Spr | EN: Normalisation: de-energised = maximum spread" VALUE 0x782A1 TKW_VV_VV_UB 100.0 FORMULA_1219 0.0 255.0 /end CHARACTERISTIC
/begin CHARACTERISTIC K_VAN_KW_SPR_MAX_E1 "KW-Zahn bei max Spreizung | EN: KW-Zahn bei max Spreizung" VALUE 0x782A2 TKW_VV_VV_SB 100.0 FORMULA_1220 -60.0000 60.0000 /end CHARACTERISTIC
/begin CHARACTERISTIC K_VAN_KW_SPR_MAX_A1 "KW-Zahn bei max Spreizung | EN: KW-Zahn bei max Spreizung" VALUE 0x782A3 TKW_VV_VV_SB 100.0 FORMULA_1220 -60.0000 60.0000 /end CHARACTERISTIC
/begin CHARACTERISTIC K_VAN_KW_SPR_MAX_E2 "KW-Zahn bei max Spreizung | EN: KW-Zahn bei max Spreizung" VALUE 0x782A4 TKW_VV_VV_SB 100.0 FORMULA_1220 -60.0000 60.0000 /end CHARACTERISTIC
/begin CHARACTERISTIC K_VAN_KW_SPR_MAX_A2 "KW-Zahn bei max Spreizung | EN: KW-Zahn bei max Spreizung" VALUE 0x782A5 TKW_VV_VV_SB 100.0 FORMULA_1220 -60.0000 60.0000 /end CHARACTERISTIC
/begin CHARACTERISTIC K_VAN_KP_XD_KORR_Einlass "Korrektur van_i_p bei xd<0" VALUE 0x782A6 TKW_VV_VV_UB 100.0 FORMULA_0643 0.0 1.9921 /end CHARACTERISTIC
/begin CHARACTERISTIC K_VAN_KP_XD_KORR_Auslass "Korrektur van_i_p bei xd<0" VALUE 0x782A7 TKW_VV_VV_UB 100.0 FORMULA_0643 0.0 1.9921 /end CHARACTERISTIC
/begin CHARACTERISTIC K_VAN_N_OFFSET_MAX_A "AVanos n korr tabg max | [Code V452 INJ 0x64154] Max positive change of the exhaust X input by the charge-exchange factor (n x tabg_lw_verh_wurzel). 0 = correction off." VALUE 0x782A8 TKW_VV_VV_SW 100.0 FORMULA_0006 0.0 10000.0000 /end CHARACTERISTIC
/begin CHARACTERISTIC K_VAN_N_OFFSET_MIN_A "AVanos n korr tabg min | [Code V452 INJ 0x64154] Max negative change of the exhaust X input. 0 = correction off." VALUE 0x782AA TKW_VV_VV_SW 100.0 FORMULA_0006 0.0 10000.0000 /end CHARACTERISTIC
/begin CHARACTERISTIC K_VAN_N_OFF "VanosRegler Abschaltdrehzahl | EN: VanosRegler Abschaltdrehzahl" VALUE 0x782AC TKW_VV_VV_SW 100.0 FORMULA_0006 0.0 10000.0000 /end CHARACTERISTIC
/begin CHARACTERISTIC K_VAN_N_ON "VanosRegler Einschaltdrehzahl | EN: VanosRegler Einschaltdrehzahl" VALUE 0x782AE TKW_VV_VV_SW 100.0 FORMULA_0006 0.0 10000.0000 /end CHARACTERISTIC
/begin CHARACTERISTIC K_VAN_RAD_CFG "Auslass-Geberrad Geometrie" VALUE 0x782B0 TKW_VV_VV_UB 100.0 FORMULA_1221 0.0 255.0 /end CHARACTERISTIC
/begin CHARACTERISTIC K_VAN_RAD_MIN "min. Anzahl NW-Zaehne | EN: min. Anzahl NW-Zaehne" VALUE 0x782B1 TKW_VV_VV_UB 100.0 FORMULA_1222 0.0 255.0000 /end CHARACTERISTIC
/begin CHARACTERISTIC K_VAN_RAD_MAX "max. Anzahl NW-Zaehne | EN: max. Anzahl NW-Zaehne" VALUE 0x782B2 TKW_VV_VV_UB 100.0 FORMULA_1222 0.0 255.0000 /end CHARACTERISTIC
/begin CHARACTERISTIC K_VAN_R20 "Spulenwiderstand bei 20Grad | EN: Coil resistance at 20 deg C [Ohm]" VALUE 0x782B4 TKW_VV_VV_SW 100.0 FORMULA_1203 -32.7680 32.7670 FORMAT "%6.3" /end CHARACTERISTIC
/begin CHARACTERISTIC K_VAN_R_TK "Temperaturkoeffizient Spulenwiderstand | EN: Temperature coefficient of coil resistance [10exp-3]" VALUE 0x782B6 TKW_VV_VV_SW 100.0 FORMULA_1223 0.0 327.6700 FORMAT "%5.2" /end CHARACTERISTIC
/begin CHARACTERISTIC K_VAN_SMG_MD_MIN "Min. Wunschmoment SMG-Schaltung | EN: Minimum desired torque, SMG shift [%] | [Code V452 INJ 0x64154] Min torque demand for the SMG-shift pre-positioning. During an SMG shift both cams are read from KF_VAN_SOLL at the target-gear speed." VALUE 0x782B8 TKW_VV_VV_SW 100.0 FORMULA_0001 0.0 100.0000 FORMAT "%4.1" /end CHARACTERISTIC
/begin CHARACTERISTIC K_VAN_SMG_MD_ABBR "Abbruch-Wunschmoment SMG-Schaltung | EN: Abort desired torque, SMG shift [%] | [Code V452 INJ 0x64154] Abort below this torque demand. During an SMG shift both cams are read from KF_VAN_SOLL at the target-gear speed." VALUE 0x782BA TKW_VV_VV_SW 100.0 FORMULA_0001 0.0 100.0000 FORMAT "%4.1" /end CHARACTERISTIC
/begin CHARACTERISTIC K_VAN_SMG_N_MIN "min. Zieldrehzahl SMG-Schaltung | EN: Minimum target speed, SMG shift [Upm] | [Code V452 INJ 0x64154] Min SMG target speed for pre-positioning. During an SMG shift both cams are read from KF_VAN_SOLL at the target-gear speed." VALUE 0x782BC TKW_VV_VV_SW 100.0 FORMULA_0006 0.0 10000.0000 /end CHARACTERISTIC
/begin CHARACTERISTIC K_VAN_SMG_N_ABBR "Abbruch Zieldrehzahl SMG-Schaltung | EN: Abort target speed, SMG shift [Upm] | [Code V452 INJ 0x64154] Abort below this target speed. During an SMG shift both cams are read from KF_VAN_SOLL at the target-gear speed." VALUE 0x782BE TKW_VV_VV_SW 100.0 FORMULA_0006 0.0 10000.0000 /end CHARACTERISTIC
/begin CHARACTERISTIC K_VAN_SMG_DR_REL "vorgest. dr_rel bei SMG-Schaltung | [Code V452 INJ 0x64154] Y value used during SMG pre-positioning (100 % = WOT row). During an SMG shift both cams are read from KF_VAN_SOLL at the target-gear speed." VALUE 0x782C0 TKW_VV_VV_SW 100.0 FORMULA_0115 0.0 199.9938 FORMAT "%5.2" /end CHARACTERISTIC
/begin CHARACTERISTIC K_VAN_SMG_DAUER_MAX "max. SMG-Schaltungsdauer | EN: max. SMG-Schaltungsdauer | [Code V452 INJ 0x64154] Max duration of the SMG pre-positioning. During an SMG shift both cams are read from KF_VAN_SOLL at the target-gear speed." VALUE 0x782C2 TKW_VV_VV_UB 100.0 FORMULA_0317 0.0 2.5500 /end CHARACTERISTIC
/begin CHARACTERISTIC K_VAN_SMG_T_AUFREG "max. Aufregelzeit der Kupplung | EN: max. Aufregelzeit der Kupplung | [Code V452 INJ 0x64154] Pre-positioning only while the clutch ramp-up time is below this. During an SMG shift both cams are read from KF_VAN_SOLL at the target-gear speed." VALUE 0x782C3 TKW_VV_VV_UB 100.0 FORMULA_0317 0.0 2.5500 /end CHARACTERISTIC
/begin CHARACTERISTIC K_VAN_SOLL_CFG "Sollwert Eingangsgroesse | [Code V452 INJ 0x64154] Y input of the target maps: 1 = md_rf_soll_pt (torque-based fill demand), otherwise dr_rel of the bank (0 here)." VALUE 0x782C4 TKW_VV_VV_UB 100.0 FORMULA_1224 0.0 255.0 /end CHARACTERISTIC
/begin CHARACTERISTIC K_VAN_SOLL_ABSTELL_Einlass "Sollpos nach KL15 aus | [Code V452 INJ 0x64154] Intake target with ignition/engine off (CAN terminal status)." VALUE 0x782C6 TKW_VV_VV_SW 100.0 FORMULA_0111 50.0000 160.0000 FORMAT "%4.1" /end CHARACTERISTIC
/begin CHARACTERISTIC K_VAN_SOLL_ABSTELL_Auslass "Sollpos nach KL15 aus | [Code V452 INJ 0x64154] Exhaust target with ignition/engine off (CAN terminal status)." VALUE 0x782C8 TKW_VV_VV_SW 100.0 FORMULA_0111 50.0000 160.0000 FORMAT "%4.1" /end CHARACTERISTIC
/begin CHARACTERISTIC K_VAN_SOLL_ERSATZ_Einlass "Soll-Ersatzwert | [Code V452 INJ 0x64154] Intake substitute target on faults selected by K_VAN_ERR_CFG (throttle safety mode, cylinder cut, VANOS safety status)." VALUE 0x782CA TKW_VV_VV_SW 100.0 FORMULA_0111 50.0000 160.0000 FORMAT "%4.1" /end CHARACTERISTIC
/begin CHARACTERISTIC K_VAN_SOLL_ERSATZ_Auslass "Soll-Ersatzwert | [Code V452 INJ 0x64154] Exhaust substitute target on faults selected by K_VAN_ERR_CFG (throttle safety mode, cylinder cut, VANOS safety status)." VALUE 0x782CC TKW_VV_VV_SW 100.0 FORMULA_0111 50.0000 160.0000 FORMAT "%4.1" /end CHARACTERISTIC
/begin CHARACTERISTIC K_VAN_SOLL_MAX_Einlass "max. Sollwert | [Code V452 INJ 0x64154] Upper limit of the intake target (applied after offset, change limit and fault substitute)." VALUE 0x782CE TKW_VV_VV_SW 100.0 FORMULA_0111 50.0000 160.0000 FORMAT "%4.1" /end CHARACTERISTIC
/begin CHARACTERISTIC K_VAN_SOLL_MAX_Auslass "max. Sollwert | [Code V452 INJ 0x64154] Upper limit of the exhaust target (applied after offset, change limit and fault substitute)." VALUE 0x782D0 TKW_VV_VV_SW 100.0 FORMULA_0111 50.0000 160.0000 FORMAT "%4.1" /end CHARACTERISTIC
/begin CHARACTERISTIC K_VAN_SOLL_MIN_Einlass "min. Sollwert | [Code V452 INJ 0x64154] Lower limit of the intake target. During cold start raised towards the cold-start limit by van_begr_faktor." VALUE 0x782D2 TKW_VV_VV_SW 100.0 FORMULA_0111 50.0000 160.0000 FORMAT "%4.1" /end CHARACTERISTIC
/begin CHARACTERISTIC K_VAN_SOLL_MIN_Auslass "min. Sollwert | [Code V452 INJ 0x64154] Lower limit of the exhaust target. During cold start raised towards the cold-start limit by van_begr_faktor." VALUE 0x782D4 TKW_VV_VV_SW 100.0 FORMULA_0111 50.0000 160.0000 FORMAT "%4.1" /end CHARACTERISTIC
/begin CHARACTERISTIC K_VAN_SOLL_OFFSET_Einlass "Sollpositionsoffset | [Code V452 INJ 0x64154] Offset added to the intake target after the map/cat-heating blend, before the change limit (0 here)." VALUE 0x782D6 TKW_VV_VV_SW 100.0 FORMULA_0111 -80.0000 80.0000 FORMAT "%4.1" /end CHARACTERISTIC
/begin CHARACTERISTIC K_VAN_SOLL_OFFSET_Auslass "Sollpositionsoffset | [Code V452 INJ 0x64154] Offset added to the exhaust target after the map/cat-heating blend, before the change limit (0 here)." VALUE 0x782D8 TKW_VV_VV_SW 100.0 FORMULA_0111 -80.0000 80.0000 FORMAT "%4.1" /end CHARACTERISTIC
/begin CHARACTERISTIC K_VAN_SPR_MAX_Einlass "Maximale Spreizung am Anschlag | [Code V452 INJ 0x64154/0x63A6C] Learned-stop reference (max Spreizung at the end stop) for the intake cam; with K_VAN_ANSCHL_DELTA it also freezes the controller I part when the target is beyond the stop." VALUE 0x782DA TKW_VV_VV_SW 100.0 FORMULA_0111 50.0000 160.0000 FORMAT "%4.1" /end CHARACTERISTIC
/begin CHARACTERISTIC K_VAN_SPR_MAX_Auslass "Maximale Spreizung am Anschlag | [Code V452 INJ 0x64154/0x63A6C] Learned-stop reference (max Spreizung at the end stop) for the exhaust cam; with K_VAN_ANSCHL_DELTA it also freezes the controller I part when the target is beyond the stop." VALUE 0x782DC TKW_VV_VV_SW 100.0 FORMULA_0111 50.0000 160.0000 FORMAT "%4.1" /end CHARACTERISTIC
/begin CHARACTERISTIC K_VAN_SPR_MAX_TOL_Einlass "Max. Abweichung Spreizung Anschlag" VALUE 0x782DE TKW_VV_VV_SW 100.0 FORMULA_0111 -80.0000 80.0000 FORMAT "%4.1" /end CHARACTERISTIC
/begin CHARACTERISTIC K_VAN_SPR_MAX_TOL_Auslass "Max. Abweichung Spreizung Anschlag" VALUE 0x782E0 TKW_VV_VV_SW 100.0 FORMULA_0111 -80.0000 80.0000 FORMAT "%4.1" /end CHARACTERISTIC
/begin CHARACTERISTIC K_VAN_SPR_MIN_Einlass "Minimale Spreizung am Anschlag | [Code V452 INJ 0x64154] Min Spreizung at the end stop for the intake cam; I part frozen when target and actual are below it + K_VAN_ANSCHL_DELTA." VALUE 0x782E2 TKW_VV_VV_SW 100.0 FORMULA_0111 50.0000 160.0000 FORMAT "%4.1" /end CHARACTERISTIC
/begin CHARACTERISTIC K_VAN_SPR_MIN_Auslass "Minimale Spreizung am Anschlag | [Code V452 INJ 0x64154] Min Spreizung at the end stop for the exhaust cam; I part frozen when target and actual are below it + K_VAN_ANSCHL_DELTA." VALUE 0x782E4 TKW_VV_VV_SW 100.0 FORMULA_0111 50.0000 160.0000 FORMAT "%4.1" /end CHARACTERISTIC
/begin CHARACTERISTIC K_VAN_SPR_OFFSET_E1 "KW-Zahnflanke zu max Spreizung | EN: KW-Zahnflanke zu max Spre i-zung" VALUE 0x782E6 TKW_VV_VV_SW 100.0 FORMULA_0111 -80.0000 80.0000 FORMAT "%4.1" /end CHARACTERISTIC
/begin CHARACTERISTIC K_VAN_SPR_OFFSET_A1 "KW-Zahnflanke zu max Spreizung | EN: KW-Zahnflanke zu max Spre i-zung" VALUE 0x782E8 TKW_VV_VV_SW 100.0 FORMULA_0111 -80.0000 80.0000 FORMAT "%4.1" /end CHARACTERISTIC
/begin CHARACTERISTIC K_VAN_SPR_OFFSET_E2 "KW-Zahnflanke zu max Spreizung | EN: KW-Zahnflanke zu max Spre i-zung" VALUE 0x782EA TKW_VV_VV_SW 100.0 FORMULA_0111 -80.0000 80.0000 FORMAT "%4.1" /end CHARACTERISTIC
/begin CHARACTERISTIC K_VAN_SPR_OFFSET_A2 "KW-Zahnflanke zu max Spreizung | EN: KW-Zahnflanke zu max Spre i-zung" VALUE 0x782EC TKW_VV_VV_SW 100.0 FORMULA_0111 -80.0000 80.0000 FORMAT "%4.1" /end CHARACTERISTIC
/begin CHARACTERISTIC K_VAN_SZ_Einlass "Steuerzeit Nockenwelle" VALUE 0x782EE TKW_VV_VV_SW 100.0 FORMULA_0111 -80.0000 350.0000 FORMAT "%4.1" /end CHARACTERISTIC
/begin CHARACTERISTIC K_VAN_SZ_Auslass "Steuerzeit Nockenwelle" VALUE 0x782F0 TKW_VV_VV_SW 100.0 FORMULA_0111 -80.0000 350.0000 FORMAT "%4.1" /end CHARACTERISTIC
/begin CHARACTERISTIC K_VAN_TMOT_BEGR_E "Temp.-Schwelle Fr�hbegrenzung | [Code V452 INJ 0x64D64] Coolant temperature below which the cold-start target minimum is active." VALUE 0x782F2 TKW_VV_VV_SW 100.0 FORMULA_0023 -50.0000 170.0000 FORMAT "%4.1" /end CHARACTERISTIC
/begin CHARACTERISTIC K_VAN_TV_MCS_E1 "max. Ventil Tastverhaeltnis | EN: max. Ventil Tastverhaeltnis" VALUE 0x782F4 TKW_VV_VV_SW 100.0 FORMULA_1194 0.0 100.0000 FORMAT "%4.1" /end CHARACTERISTIC
/begin CHARACTERISTIC K_VAN_TV_MCS_A1 "max. Ventil Tastverhaeltnis | EN: max. Ventil Tastverhaeltnis" VALUE 0x782F6 TKW_VV_VV_SW 100.0 FORMULA_1194 0.0 100.0000 FORMAT "%4.1" /end CHARACTERISTIC
/begin CHARACTERISTIC K_VAN_TV_MCS_E2 "max. Ventil Tastverhaeltnis | EN: max. Ventil Tastverhaeltnis" VALUE 0x782F8 TKW_VV_VV_SW 100.0 FORMULA_1194 0.0 100.0000 FORMAT "%4.1" /end CHARACTERISTIC
/begin CHARACTERISTIC K_VAN_TV_MCS_A2 "max. Ventil Tastverhaeltnis | EN: max. Ventil Tastverhaeltnis" VALUE 0x782FA TKW_VV_VV_SW 100.0 FORMULA_1194 0.0 100.0000 FORMAT "%4.1" /end CHARACTERISTIC
/begin CHARACTERISTIC K_VAN_UB_ERS "Ersatzwert bei Fehler | EN: Ersatzwert bei Fehler" VALUE 0x782FC TKW_VV_VV_SW 100.0 FORMULA_0008 0.0 28.0000 FORMAT "%4.1" /end CHARACTERISTIC
/begin CHARACTERISTIC K_VAN_UNL_N_MIN_Einlass "min n bei von selbst entriegelt" VALUE 0x782FE TKW_VV_VV_SW 100.0 FORMULA_0006 0.0 10000.0000 /end CHARACTERISTIC
/begin CHARACTERISTIC K_VAN_UNL_N_MIN_Auslass "min n bei von selbst entriegelt" VALUE 0x78300 TKW_VV_VV_SW 100.0 FORMULA_0006 0.0 10000.0000 /end CHARACTERISTIC
/begin CHARACTERISTIC K_VAN_UNLOCK_SPR_Einlass "Pos ab der entriegelt sein muss" VALUE 0x78302 TKW_VV_VV_SW 100.0 FORMULA_0111 50.0000 160.0000 FORMAT "%4.1" /end CHARACTERISTIC
/begin CHARACTERISTIC K_VAN_UNLOCK_SPR_Auslass "Pos ab der entriegelt sein muss" VALUE 0x78304 TKW_VV_VV_SW 100.0 FORMULA_0111 50.0000 160.0000 FORMAT "%4.1" /end CHARACTERISTIC
/begin CHARACTERISTIC K_VAN_UNL_D_I_Einlass "Startwert Delta zum I-Anteil" VALUE 0x78306 TKW_VV_VV_SW 100.0 FORMULA_1198 -1000.0000 3000.0000 /end CHARACTERISTIC
/begin CHARACTERISTIC K_VAN_UNL_D_I_Auslass "Startwert Delta zum I-Anteil" VALUE 0x78308 TKW_VV_VV_SW 100.0 FORMULA_1198 -1000.0000 3000.0000 /end CHARACTERISTIC
/begin CHARACTERISTIC K_VAN_UNL_I_DYN_Einlass "max. Dynamik TV zum Entriegeln" VALUE 0x7830A TKW_VV_VV_SW 100.0 FORMULA_1225 -1000.0000 3000.0000 /end CHARACTERISTIC
/begin CHARACTERISTIC K_VAN_UNL_I_DYN_Auslass "max. Dynamik TV zum Entriegeln" VALUE 0x7830C TKW_VV_VV_SW 100.0 FORMULA_1225 -1000.0000 3000.0000 /end CHARACTERISTIC
/begin CHARACTERISTIC K_VAN_XD_FILT_ED_Einlass "Max. gef. Regelabweichung" VALUE 0x7830E TKW_VV_VV_SW 100.0 FORMULA_0111 -80.0000 80.0000 FORMAT "%4.1" /end CHARACTERISTIC
/begin CHARACTERISTIC K_VAN_XD_FILT_ED_Auslass "Max. gef. Regelabweichung" VALUE 0x78310 TKW_VV_VV_SW 100.0 FORMULA_0111 -80.0000 80.0000 FORMAT "%4.1" /end CHARACTERISTIC
/begin CHARACTERISTIC K_VAN_XD_EINGEREGELT "Max. Regelabweichung bei B_VAN_EINGEREGELT | EN: Maximum control error for B_VAN_EINGEREGELT (settled) [°KW]" VALUE 0x78312 TKW_VV_VV_SW 100.0 FORMULA_0111 -80.0000 80.0000 FORMAT "%4.1" /end CHARACTERISTIC
/begin CHARACTERISTIC K_VAN_XD_SK "Abweichung kleine Spreizung Notprogramm | EN: Deviation, small spread, limp-home program [°KW]" VALUE 0x78314 TKW_VV_VV_SW 100.0 FORMULA_0111 -80.0000 80.0000 FORMAT "%4.1" /end CHARACTERISTIC
/begin CHARACTERISTIC K_VAN_XD_REG_MIN "Min. Regelabweichung f�r ungefilterte Regelung | EN: Minimum control error for unfiltered control [°KW]" VALUE 0x78316 TKW_VV_VV_SW 100.0 FORMULA_0111 -80.0000 80.0000 FORMAT "%4.1" /end CHARACTERISTIC
/begin CHARACTERISTIC KL_VAN_FREQU_ML "PWM-Frequenz Ventile Motor l�uft | EN: Valve PWM frequency, engine running | [Code V452 INJ 0x6553C] Valve PWM frequency over tmot with engine running." CURVE 0x78318 TKL_SW_VV_UW 100.0 FORMULA_1192 16.0000 400.0000
 /begin AXIS_DESCR STD_AXIS tmot FORMULA_0023 4 -50.0000 170.0000 FORMAT "%4.1" /end AXIS_DESCR
 FORMAT "%4.1" /end CHARACTERISTIC
/begin CHARACTERISTIC KL_VAN_FILTR_XD_WICHT "Gewicht Regl-Abw. Vent.Guete" CURVE 0x7832A TKL_SW_VV_UB 100.0 FORMULA_0643 0.0 1.9921
 /begin AXIS_DESCR STD_AXIS tumg FORMULA_0023 4 -50.0000 170.0000 FORMAT "%4.1" /end AXIS_DESCR
/end CHARACTERISTIC
/begin CHARACTERISTIC KL_VAN_REG_FAKT_TMOT "Regler Korrekturfaktor | [Code V452 INJ 0x6553C] Controller correction factor over coolant temperature." CURVE 0x78338 TKL_SW_VV_UB 100.0 FORMULA_0643 0.0 1.9921
 /begin AXIS_DESCR STD_AXIS tmot FORMULA_0023 4 -50.0000 170.0000 FORMAT "%4.1" /end AXIS_DESCR
/end CHARACTERISTIC
/begin CHARACTERISTIC KL_VAN_KD_A "Regler D Faktor | [Code V452 INJ 0x64154] D gain over n (exhaust)." CURVE 0x78346 TKL_SW_VV_SW 100.0 FORMULA_1200 -32.0000 31.9990 /begin AXIS_DESCR STD_AXIS n FORMULA_0006 5 0.0 10000.0000 /end AXIS_DESCR FORMAT "%7.4" /end CHARACTERISTIC
/begin CHARACTERISTIC KL_VAN_KD_E "Regler D Faktor | [Code V452 INJ 0x64154] D gain over n (intake)." CURVE 0x7835C TKL_SW_VV_SW 100.0 FORMULA_1200 -32.0000 31.9990 /begin AXIS_DESCR STD_AXIS n FORMULA_0006 5 0.0 10000.0000 /end AXIS_DESCR FORMAT "%7.4" /end CHARACTERISTIC
/begin CHARACTERISTIC KL_VAN_KI_A "Regler I Faktor | EN: Controller I factor | [Code V452 INJ 0x64154] I gain over control error (exhaust), as KL_VAN_KI_E." CURVE 0x78372 TKL_SW_VV_SW 100.0 FORMULA_1201 -500.0000 499.9847
 /begin AXIS_DESCR STD_AXIS van_xd FORMULA_0111 5 -80.0000 80.0000 FORMAT "%4.1" /end AXIS_DESCR
 FORMAT "%5.2" /end CHARACTERISTIC
/begin CHARACTERISTIC KL_VAN_KI_E "Regler I Faktor | EN: Controller I factor | [Code V452 INJ 0x64154] I gain over control error van_xd (intake). Integrator limited to K_VAN_I_I_MIN..K_VAN_I_I_MAX; I step = 0 when target/actual are at the end stops (K_VAN_SPR_MAX/MIN +- K_VAN_ANSCHL_DELTA) or the unit is not unlocked (K_VAN_CFG)." CURVE 0x78388 TKL_SW_VV_SW 100.0 FORMULA_1201 -500.0000 499.9847
 /begin AXIS_DESCR STD_AXIS van_xd FORMULA_0111 5 -80.0000 80.0000 FORMAT "%4.1" /end AXIS_DESCR
 FORMAT "%5.2" /end CHARACTERISTIC
/begin CHARACTERISTIC KL_VAN_KP_A "Regler P Faktor | EN: Controller P factor | [Code V452 INJ 0x64154] P gain over n (exhaust)." CURVE 0x7839E TKL_SW_VV_SW 100.0 FORMULA_1202 -1280.0000 1279.9609 /begin AXIS_DESCR STD_AXIS n FORMULA_0006 5 0.0 10000.0000 /end AXIS_DESCR FORMAT "%5.2" /end CHARACTERISTIC
/begin CHARACTERISTIC KL_VAN_KP_E "Regler P Faktor | EN: Controller P factor | [Code V452 INJ 0x64154] P gain over n (intake), van_kp." CURVE 0x783B4 TKL_SW_VV_SW 100.0 FORMULA_1202 -1280.0000 1279.9609 /begin AXIS_DESCR STD_AXIS n FORMULA_0006 5 0.0 10000.0000 /end AXIS_DESCR FORMAT "%5.2" /end CHARACTERISTIC
/begin CHARACTERISTIC KL_VAN_SOLL_BEGR_E "Min-Begrenzung Kaltstart Einlass | [Code V452 INJ 0x64154] Cold-start minimum intake target over n; blended in by van_begr_faktor (0x64D64: active below K_VAN_TMOT_BEGR_E for KL_VAN_T_SOLL_BEGR_E(tan), faded by K_VAN_BEGR_AB_FAKT_E)." CURVE 0x783CA TKL_SW_VV_SW 100.0 FORMULA_0111 50.0000 160.0000 /begin AXIS_DESCR STD_AXIS n FORMULA_0006 5 0.0 10000.0000 /end AXIS_DESCR FORMAT "%4.1" /end CHARACTERISTIC
/begin CHARACTERISTIC KL_VAN_T_SOLL_BEGR_E "Min-Begrenzungsdauer Kaltstart | [Code V452 INJ 0x64D64] Duration of the cold-start target minimum over intake air temperature." CURVE 0x783E0 TKL_SW_VV_SW 100.0 FORMULA_0932 -327.6800 327.6700
 /begin AXIS_DESCR STD_AXIS tan_start FORMULA_0023 6 -50.0000 170.0000 FORMAT "%4.1" /end AXIS_DESCR
/end CHARACTERISTIC
/begin CHARACTERISTIC KL_VAN_T_DRUCK_E "Druckerkennungszeit ohne Fehlereintrag | EN: Pressure detection time without fault entry" CURVE 0x783FA TKL_SW_VV_UW 100.0 FORMULA_0073 0.0 6553.5000
 /begin AXIS_DESCR STD_AXIS tmot_start FORMULA_0023 4 -50.0000 170.0000 FORMAT "%4.1" /end AXIS_DESCR
 FORMAT "%4.1" /end CHARACTERISTIC
/begin CHARACTERISTIC KL_VAN_T_START_DLY "Reglerfreigabe nach Motor Start | EN: Controller enable after engine start | [Code V452 INJ 0x6553C] Controller release delay after engine start over start coolant temperature." CURVE 0x7840C TKL_SW_VV_UW 100.0 FORMULA_0021 0.0 655.0000
 /begin AXIS_DESCR STD_AXIS tmot_start FORMULA_0023 4 -50.0000 170.0000 FORMAT "%4.1" /end AXIS_DESCR
 FORMAT "%5.2" /end CHARACTERISTIC
/begin CHARACTERISTIC KF_VAN_I_VORST_E "Vorsteuerung Ventilstrom Einlass | [Code V452 INJ 0x6553C] Pre-control valve current (intake) over n x OIL temperature, added to the controller output (output stage 0x649D4, not fully traced)." MAP 0x7841E TKF_SW_SW_SW 100.0 FORMULA_1198 -1000.0000 3000.0000 /begin AXIS_DESCR STD_AXIS n FORMULA_0006 6 0.0 10000.0000 /end AXIS_DESCR
 /begin AXIS_DESCR STD_AXIS toel FORMULA_0023 6 -50.0000 170.0000 FORMAT "%4.1" /end AXIS_DESCR
/end CHARACTERISTIC
/begin CHARACTERISTIC KF_VAN_I_VORST_A "Vorsteuerung Ventilstrom Auslass | [Code V452 INJ 0x6553C] Pre-control valve current (exhaust) over n x oil temperature." MAP 0x78480 TKF_SW_SW_SW 100.0 FORMULA_1198 -1000.0000 3000.0000 /begin AXIS_DESCR STD_AXIS n FORMULA_0006 6 0.0 10000.0000 /end AXIS_DESCR
 /begin AXIS_DESCR STD_AXIS toel FORMULA_0023 6 -50.0000 170.0000 FORMAT "%4.1" /end AXIS_DESCR
/end CHARACTERISTIC
/begin CHARACTERISTIC KF_VAN_SOLL_A "Grundkennfeld Vanos Sollwert | EN: Base map, VANOS target | [Code V452 INJ 0x64154] Exhaust VANOS target (Spreizung) over n x dr_rel; same chain as KF_VAN_SOLL_E. X input for exhaust = n x tabg_lw_verh_wurzel limited to n + K_VAN_N_OFFSET_MAX_A / n - K_VAN_N_OFFSET_MIN_A (both 0 here, so plain n). Values limited to K_VAN_SOLL_MIN_Auslass..K_VAN_SOLL_MAX_Auslass." MAP 0x784E2 TKF_SW_SW_SW 100.0 FORMULA_0111 50.0000 160.0000 /begin AXIS_DESCR STD_AXIS n FORMULA_0006 16 0.0 10000.0000 /end AXIS_DESCR
 /begin AXIS_DESCR STD_AXIS dr_rel_1of2_ FORMULA_0115 12 0.0 199.9938 FORMAT "%5.2" /end AXIS_DESCR
 FORMAT "%4.1" /end CHARACTERISTIC
/begin CHARACTERISTIC KF_VAN_SOLL_E "Grundkennfeld Vanos Sollwert | EN: Base map, VANOS target | [Code V452 INJ 0x64154] Intake VANOS target (Spreizung, degKW) over n x dr_rel of the bank (top row 95 % = WOT). Chain per unit (E1/A1/E2/A2): engine off -> K_VAN_SOLL_ABSTELL; else map -> cat-heating blend to KF_VAN_KH_SOLL_E (factor kh_van_fakt_kf) -> + K_VAN_SOLL_OFFSET -> change limit KF_VAN_SOLL_DMAX -> fault substitute K_VAN_SOLL_ERSATZ (K_VAN_ERR_CFG) -> limit K_VAN_SOLL_MAX / K_VAN_SOLL_MIN (cold start: KL_VAN_SOLL_BEGR_E) -> van_soll. SMG upshift (>= K_VAN_SMG_MD_MIN torque, target speed >= K_VAN_SMG_N_MIN, max K_VAN_SMG_DAUER_MAX): read at the TARGET-gear speed and Y = K_VAN_SMG_DR_REL (bank 1 only)." MAP 0x7869C TKF_SW_SW_SW 100.0 FORMULA_0111 50.0000 160.0000 /begin AXIS_DESCR STD_AXIS n FORMULA_0006 16 0.0 10000.0000 /end AXIS_DESCR
 /begin AXIS_DESCR STD_AXIS dr_rel_1of2_ FORMULA_0115 12 0.0 199.9938 FORMAT "%5.2" /end AXIS_DESCR
 FORMAT "%4.1" /end CHARACTERISTIC
/begin CHARACTERISTIC KF_VAN_KH_SOLL_A "Katheizkennfeld Vanos Sollwert | EN: VANOS cat-heating target map, intake [degKW x/10] | [Code V452 INJ 0x64154] Cat-heating exhaust target, blended as KF_VAN_KH_SOLL_E." MAP 0x78856 TKF_SW_SW_SW 100.0 FORMULA_0111 50.0000 160.0000 /begin AXIS_DESCR STD_AXIS n FORMULA_0006 16 0.0 10000.0000 /end AXIS_DESCR
 /begin AXIS_DESCR STD_AXIS dr_rel_1of2_ FORMULA_0115 12 0.0 199.9938 FORMAT "%5.2" /end AXIS_DESCR
 FORMAT "%4.1" /end CHARACTERISTIC
/begin CHARACTERISTIC KF_VAN_KH_SOLL_E "Katheizkennfeld Vanos Sollwert | EN: Catalyst-heating map, VANOS target | [Code V452 INJ 0x64154] Cat-heating intake target; blended in: soll = KF_VAN_SOLL + kh_van_fakt_kf x (KF_VAN_KH_SOLL - KF_VAN_SOLL). Then KF_VAN_KH_SOLL_DMAX replaces KF_VAN_SOLL_DMAX." MAP 0x78A10 TKF_SW_SW_SW 100.0 FORMULA_0111 50.0000 160.0000 /begin AXIS_DESCR STD_AXIS n FORMULA_0006 16 0.0 10000.0000 /end AXIS_DESCR
 /begin AXIS_DESCR STD_AXIS dr_rel_1of2_ FORMULA_0115 12 0.0 199.9938 FORMAT "%5.2" /end AXIS_DESCR
 FORMAT "%4.1" /end CHARACTERISTIC
/begin CHARACTERISTIC KF_VAN_SOLL_BEGR_A "Min-Begrenzung Kaltstart Auslass | EN: VANOS min. limit cold start, intake [degKW x/10] | [Code V452 INJ 0x64154] Cold-start minimum exhaust target over n x pumg, blended as KL_VAN_SOLL_BEGR_E." MAP 0x78BCA TKF_SW_SW_SW 100.0 FORMULA_0111 50.0000 160.0000 /begin AXIS_DESCR STD_AXIS n FORMULA_0006 5 0.0 10000.0000 /end AXIS_DESCR
 /begin AXIS_DESCR STD_AXIS pumg FORMULA_0077 3 400.0000 1200.0000 FORMAT "%4.1" /end AXIS_DESCR
 FORMAT "%4.1" /end CHARACTERISTIC
/begin CHARACTERISTIC KF_VAN_SOLL_DMAX_A "Aenderungsbegrenzung Sollwert | EN: Rate limit of target value | [Code V452 INJ 0x64154] Max change of the exhaust target per 10 ms (all 60 = no limit here)." MAP 0x78BFA TKF_SW_SW_SW 100.0 FORMULA_1205 -80.0000 80.0000 /begin AXIS_DESCR STD_AXIS n FORMULA_0006 6 0.0 10000.0000 /end AXIS_DESCR
 /begin AXIS_DESCR STD_AXIS dr_rel_1of2_ FORMULA_0115 6 0.0 199.9938 FORMAT "%5.2" /end AXIS_DESCR
 FORMAT "%4.1" /end CHARACTERISTIC
/begin CHARACTERISTIC KF_VAN_SOLL_DMAX_E "Aenderungsbegrenzung Sollwert | EN: Rate limit of target value | [Code V452 INJ 0x64154] Max change of the intake target per 10 ms (n x dr_rel). Here 0.5-2 degKW/10 ms at 1900-3700 and 5600 rpm for dr_rel 40-93 % - slows intake moves in mid load; 60 (no limit) at dr_rel >= 95 %." MAP 0x78C5C TKF_SW_SW_SW 100.0 FORMULA_1205 -80.0000 80.0000 /begin AXIS_DESCR STD_AXIS n FORMULA_0006 6 0.0 10000.0000 /end AXIS_DESCR
 /begin AXIS_DESCR STD_AXIS dr_rel_1of2_ FORMULA_0115 6 0.0 199.9938 FORMAT "%5.2" /end AXIS_DESCR
 FORMAT "%4.1" /end CHARACTERISTIC
/begin CHARACTERISTIC KF_VAN_KH_SOLL_DMAX_A "Aenderungsbegrenzung Sollwert Katheizen | EN: VANOS cat-heating rate limit, intake [degKW/10ms] | [Code V452 INJ 0x64154] Change limit used during cat heating instead of KF_VAN_SOLL_DMAX_A." MAP 0x78CBE TKF_SW_SW_SW 100.0 FORMULA_1205 -80.0000 80.0000 /begin AXIS_DESCR STD_AXIS n FORMULA_0006 6 0.0 10000.0000 /end AXIS_DESCR
 /begin AXIS_DESCR STD_AXIS dr_rel_1of2_ FORMULA_0115 6 0.0 199.9938 FORMAT "%5.2" /end AXIS_DESCR
 FORMAT "%4.1" /end CHARACTERISTIC
/begin CHARACTERISTIC KF_VAN_KH_SOLL_DMAX_E "Aenderungsbegrenzung Sollwert Katheizen | EN: VANOS cat-heating rate limit, exhaust [degKW/10ms] | [Code V452 INJ 0x64154] Change limit used during cat heating instead of KF_VAN_SOLL_DMAX_E." MAP 0x78D20 TKF_SW_SW_SW 100.0 FORMULA_1205 -80.0000 80.0000 /begin AXIS_DESCR STD_AXIS n FORMULA_0006 6 0.0 10000.0000 /end AXIS_DESCR
 /begin AXIS_DESCR STD_AXIS dr_rel_1of2_ FORMULA_0115 6 0.0 199.9938 FORMAT "%5.2" /end AXIS_DESCR
 FORMAT "%4.1" /end CHARACTERISTIC
/begin CHARACTERISTIC KF_VAN_XD_TAU "Filterzeitkonstante Regelabweichung | EN: Filter time constant, control error | [Code V452 INJ 0x6553C] Filter time constant of the control error over n x tmot." MAP 0x78D82 TKF_SW_SW_SW 100.0 FORMULA_1059 0.2001 6553.5000 /begin AXIS_DESCR STD_AXIS n FORMULA_0006 3 0.0 10000.0000 /end AXIS_DESCR
 /begin AXIS_DESCR STD_AXIS tmot FORMULA_0023 4 -50.0000 170.0000 FORMAT "%4.1" /end AXIS_DESCR
 FORMAT "%5.2" /end CHARACTERISTIC
/begin MEASUREMENT van_anschl_t_E1 "Dauer Anschlag lernen" UBYTE FORMULA_0317 0 0 0.0 2.5500 ECU_ADDRESS 0x3FD4A8 /end MEASUREMENT
/begin MEASUREMENT van_anschl_t_A1 "Dauer Anschlag lernen" UBYTE FORMULA_0317 0 0 0.0 2.5500 ECU_ADDRESS 0x3FD4A9 /end MEASUREMENT
/begin MEASUREMENT van_anschl_t_E2 "Dauer Anschlag lernen" UBYTE FORMULA_0317 0 0 0.0 2.5500 ECU_ADDRESS 0x3FD4AA /end MEASUREMENT
/begin MEASUREMENT van_anschl_t_A2 "Dauer Anschlag lernen" UBYTE FORMULA_0317 0 0 0.0 2.5500 ECU_ADDRESS 0x3FD4AB /end MEASUREMENT
/begin MEASUREMENT van_begr_faktor "Gewichtungsfaktor Min-Begr." SWORD FORMULA_0025 0 0 0.0 1.9999 ECU_ADDRESS 0x3FD4AC /end MEASUREMENT
/begin MEASUREMENT van_druck_cnt_b1 "Anzahl erkannter Fr�hverstellungen" UBYTE FORMULA_0003 0 0 0.0 10.0000 ECU_ADDRESS 0x3FD4AE /end MEASUREMENT
/begin MEASUREMENT van_druck_cnt_b2 "Anzahl erkannter Fr�hverstellungen" UBYTE FORMULA_0003 0 0 0.0 10.0000 ECU_ADDRESS 0x3FD4AF /end MEASUREMENT
/begin MEASUREMENT van_druck_time "Motorlaufzeit ohne Druck" UWORD FORMULA_0073 0 0 0.0 6553.5000 ECU_ADDRESS 0x3FD4B0 /end MEASUREMENT
/begin MEASUREMENT van_druck_timeout "max. Druckerkennungszeit ohne Fehler" UWORD FORMULA_0073 0 0 0.0 6553.5000 ECU_ADDRESS 0x3FD4B2 /end MEASUREMENT
/begin MEASUREMENT van_druck_start_e_b1 "Istpos bei Ablauf van_t_start_dly" SWORD FORMULA_0111 0 0 50.0000 160.0000 ECU_ADDRESS 0x3FD4B4 /end MEASUREMENT
/begin MEASUREMENT van_druck_start_e_b2 "Istpos bei Ablauf van_t_start_dly" SWORD FORMULA_0111 0 0 50.0000 160.0000 ECU_ADDRESS 0x3FD4B6 /end MEASUREMENT
/begin MEASUREMENT van_d_xd_E1 "Gradient Regelabweichung" SWORD FORMULA_1191 0 0 -32768.0000 32767.0000 ECU_ADDRESS 0x3FD4B8 /end MEASUREMENT
/begin MEASUREMENT van_d_xd_A1 "Gradient Regelabweichung" SWORD FORMULA_1191 0 0 -32768.0000 32767.0000 ECU_ADDRESS 0x3FD4BA /end MEASUREMENT
/begin MEASUREMENT van_d_xd_E2 "Gradient Regelabweichung" SWORD FORMULA_1191 0 0 -32768.0000 32767.0000 ECU_ADDRESS 0x3FD4BC /end MEASUREMENT
/begin MEASUREMENT van_d_xd_A2 "Gradient Regelabweichung" SWORD FORMULA_1191 0 0 -32768.0000 32767.0000 ECU_ADDRESS 0x3FD4BE /end MEASUREMENT
/begin MEASUREMENT van_d_xd_filt_E1 "gefilterter Gradient Regelabweichung" SWORD FORMULA_1191 0 0 -32768.0000 32767.0000 ECU_ADDRESS 0x3FD4C0 /end MEASUREMENT
/begin MEASUREMENT van_d_xd_filt_A1 "gefilterter Gradient Regelabweichung" SWORD FORMULA_1191 0 0 -32768.0000 32767.0000 ECU_ADDRESS 0x3FD4C2 /end MEASUREMENT
/begin MEASUREMENT van_d_xd_filt_E2 "gefilterter Gradient Regelabweichung" SWORD FORMULA_1191 0 0 -32768.0000 32767.0000 ECU_ADDRESS 0x3FD4C4 /end MEASUREMENT
/begin MEASUREMENT van_d_xd_filt_A2 "gefilterter Gradient Regelabweichung" SWORD FORMULA_1191 0 0 -32768.0000 32767.0000 ECU_ADDRESS 0x3FD4C6 /end MEASUREMENT
/begin MEASUREMENT van_exd_anschl_max_E1 "Pr�flauf Max-Anschlag" SWORD FORMULA_0111 0 0 50.0000 160.0000 ECU_ADDRESS 0x3FD4C8 /end MEASUREMENT
/begin MEASUREMENT van_exd_anschl_max_A1 "Pr�flauf Max-Anschlag" SWORD FORMULA_0111 0 0 50.0000 160.0000 ECU_ADDRESS 0x3FD4CA /end MEASUREMENT
/begin MEASUREMENT van_exd_anschl_max_E2 "Pr�flauf Max-Anschlag" SWORD FORMULA_0111 0 0 50.0000 160.0000 ECU_ADDRESS 0x3FD4CC /end MEASUREMENT
/begin MEASUREMENT van_exd_anschl_max_A2 "Pr�flauf Max-Anschlag" SWORD FORMULA_0111 0 0 50.0000 160.0000 ECU_ADDRESS 0x3FD4CE /end MEASUREMENT
/begin MEASUREMENT van_exd_anschl_min_E1 "Pr�flauf Min-Anschlag" SWORD FORMULA_0111 0 0 50.0000 160.0000 ECU_ADDRESS 0x3FD4D0 /end MEASUREMENT
/begin MEASUREMENT van_exd_anschl_min_A1 "Pr�flauf Min-Anschlag" SWORD FORMULA_0111 0 0 50.0000 160.0000 ECU_ADDRESS 0x3FD4D2 /end MEASUREMENT
/begin MEASUREMENT van_exd_anschl_min_E2 "Pr�flauf Min-Anschlag" SWORD FORMULA_0111 0 0 50.0000 160.0000 ECU_ADDRESS 0x3FD4D4 /end MEASUREMENT
/begin MEASUREMENT van_exd_anschl_min_A2 "Pr�flauf Min-Anschlag" SWORD FORMULA_0111 0 0 50.0000 160.0000 ECU_ADDRESS 0x3FD4D6 /end MEASUREMENT
/begin MEASUREMENT van_exd_frequ_E1 "PWM-Frequenz vom Tester" UWORD FORMULA_1192 0 0 16.0000 400.0000 ECU_ADDRESS 0x3FD4D8 /end MEASUREMENT
/begin MEASUREMENT van_exd_frequ_A1 "PWM-Frequenz vom Tester" UWORD FORMULA_1192 0 0 16.0000 400.0000 ECU_ADDRESS 0x3FD4DA /end MEASUREMENT
/begin MEASUREMENT van_exd_frequ_E2 "PWM-Frequenz vom Tester" UWORD FORMULA_1192 0 0 16.0000 400.0000 ECU_ADDRESS 0x3FD4DC /end MEASUREMENT
/begin MEASUREMENT van_exd_frequ_A2 "PWM-Frequenz vom Tester" UWORD FORMULA_1192 0 0 16.0000 400.0000 ECU_ADDRESS 0x3FD4DE /end MEASUREMENT
/begin MEASUREMENT van_exd_soll_E1 "Sollwert vom Tester" SWORD FORMULA_0111 0 0 50.0000 160.0000 ECU_ADDRESS 0x3FD4E0 /end MEASUREMENT
/begin MEASUREMENT van_exd_soll_A1 "Sollwert vom Tester" SWORD FORMULA_0111 0 0 50.0000 160.0000 ECU_ADDRESS 0x3FD4E2 /end MEASUREMENT
/begin MEASUREMENT van_exd_soll_E2 "Sollwert vom Tester" SWORD FORMULA_0111 0 0 50.0000 160.0000 ECU_ADDRESS 0x3FD4E4 /end MEASUREMENT
/begin MEASUREMENT van_exd_soll_A2 "Sollwert vom Tester" SWORD FORMULA_0111 0 0 50.0000 160.0000 ECU_ADDRESS 0x3FD4E6 /end MEASUREMENT
/begin MEASUREMENT van_exd_pruef "Pr�flauf Status" UBYTE FORMULA_1193 0 0 0.0 255.0 ECU_ADDRESS 0x3FD4E8 /end MEASUREMENT
/begin MEASUREMENT van_exd_t_verst_klein_E1 "Verstellzeit zu kleiner Spreizung" UBYTE FORMULA_0317 0 0 0.0 2.5500 ECU_ADDRESS 0x3FD4E9 /end MEASUREMENT
/begin MEASUREMENT van_exd_t_verst_klein_A1 "Verstellzeit zu kleiner Spreizung" UBYTE FORMULA_0317 0 0 0.0 2.5500 ECU_ADDRESS 0x3FD4EA /end MEASUREMENT
/begin MEASUREMENT van_exd_t_verst_klein_E2 "Verstellzeit zu kleiner Spreizung" UBYTE FORMULA_0317 0 0 0.0 2.5500 ECU_ADDRESS 0x3FD4EB /end MEASUREMENT
/begin MEASUREMENT van_exd_t_verst_klein_A2 "Verstellzeit zu kleiner Spreizung" UBYTE FORMULA_0317 0 0 0.0 2.5500 ECU_ADDRESS 0x3FD4EC /end MEASUREMENT
/begin MEASUREMENT van_exd_t_verst_gross_E1 "Verstellzeit zu grosser Spreizung" UBYTE FORMULA_0317 0 0 0.0 2.5500 ECU_ADDRESS 0x3FD4ED /end MEASUREMENT
/begin MEASUREMENT van_exd_t_verst_gross_A1 "Verstellzeit zu grosser Spreizung" UBYTE FORMULA_0317 0 0 0.0 2.5500 ECU_ADDRESS 0x3FD4EE /end MEASUREMENT
/begin MEASUREMENT van_exd_t_verst_gross_E2 "Verstellzeit zu grosser Spreizung" UBYTE FORMULA_0317 0 0 0.0 2.5500 ECU_ADDRESS 0x3FD4EF /end MEASUREMENT
/begin MEASUREMENT van_exd_t_verst_gross_A2 "Verstellzeit zu grosser Spreizung" UBYTE FORMULA_0317 0 0 0.0 2.5500 ECU_ADDRESS 0x3FD4F0 /end MEASUREMENT
/begin MEASUREMENT van_exd_t "Timer Prueflauf" UWORD FORMULA_0021 0 0 0.0 655.0000 ECU_ADDRESS 0x3FD4F2 /end MEASUREMENT
/begin MEASUREMENT van_exd_tv_E1 "Ventil Tastverhaeltnis vom Tester" SWORD FORMULA_1194 0 0 0.0 100.0000 ECU_ADDRESS 0x3FD4F4 /end MEASUREMENT
/begin MEASUREMENT van_exd_tv_A1 "Ventil Tastverhaeltnis vom Tester" SWORD FORMULA_1194 0 0 0.0 100.0000 ECU_ADDRESS 0x3FD4F6 /end MEASUREMENT
/begin MEASUREMENT van_exd_tv_E2 "Ventil Tastverhaeltnis vom Tester" SWORD FORMULA_1194 0 0 0.0 100.0000 ECU_ADDRESS 0x3FD4F8 /end MEASUREMENT
/begin MEASUREMENT van_exd_tv_A2 "Ventil Tastverhaeltnis vom Tester" SWORD FORMULA_1194 0 0 0.0 100.0000 ECU_ADDRESS 0x3FD4FA /end MEASUREMENT
/begin MEASUREMENT van_exd_tv_timeout_E1 "Tastverhaeltnis vom Tester" UBYTE FORMULA_0458 0 0 0.0 25.5000 ECU_ADDRESS 0x3FD4FC /end MEASUREMENT
/begin MEASUREMENT van_exd_tv_timeout_A1 "Tastverhaeltnis vom Tester" UBYTE FORMULA_0458 0 0 0.0 25.5000 ECU_ADDRESS 0x3FD4FD /end MEASUREMENT
/begin MEASUREMENT van_exd_tv_timeout_E2 "Tastverhaeltnis vom Tester" UBYTE FORMULA_0458 0 0 0.0 25.5000 ECU_ADDRESS 0x3FD4FE /end MEASUREMENT
/begin MEASUREMENT van_exd_tv_timeout_A2 "Tastverhaeltnis vom Tester" UBYTE FORMULA_0458 0 0 0.0 25.5000 ECU_ADDRESS 0x3FD4FF /end MEASUREMENT
/begin MEASUREMENT van_exd_soll_timeout_E1 "Sollwert vom Tester Timeout" UBYTE FORMULA_0458 0 0 0.0 25.5000 ECU_ADDRESS 0x3FD500 /end MEASUREMENT
/begin MEASUREMENT van_exd_soll_timeout_A1 "Sollwert vom Tester Timeout" UBYTE FORMULA_0458 0 0 0.0 25.5000 ECU_ADDRESS 0x3FD501 /end MEASUREMENT
/begin MEASUREMENT van_exd_soll_timeout_E2 "Sollwert vom Tester Timeout" UBYTE FORMULA_0458 0 0 0.0 25.5000 ECU_ADDRESS 0x3FD502 /end MEASUREMENT
/begin MEASUREMENT van_exd_soll_timeout_A2 "Sollwert vom Tester Timeout" UBYTE FORMULA_0458 0 0 0.0 25.5000 ECU_ADDRESS 0x3FD503 /end MEASUREMENT
/begin MEASUREMENT B_VAN_DRUCK "Druck erkannt" UBYTE FORMULA_1195 0 0 0.0 255.0 ECU_ADDRESS 0x3FD504 BIT_MASK 0x1 /end MEASUREMENT
/begin MEASUREMENT B_VAN_GUETE "Guetemessung aktiv" UBYTE FORMULA_1196 0 0 0.0 255.0 ECU_ADDRESS 0x3FD504 BIT_MASK 0x2 /end MEASUREMENT
/begin MEASUREMENT van_flags "Steuerflags" UBYTE FORMULA_0033 0 0 0.0 255.0000 ECU_ADDRESS 0x3FD504 /end MEASUREMENT
/begin MEASUREMENT van_filtr_dauer_E1 "Dauer ohne Sollwertaenderung" UWORD FORMULA_0073 0 0 0.0 6553.5000 ECU_ADDRESS 0x3FD506 /end MEASUREMENT
/begin MEASUREMENT van_filtr_dauer_A1 "Dauer ohne Sollwertaenderung" UWORD FORMULA_0073 0 0 0.0 6553.5000 ECU_ADDRESS 0x3FD508 /end MEASUREMENT
/begin MEASUREMENT van_filtr_dauer_E2 "Dauer ohne Sollwertaenderung" UWORD FORMULA_0073 0 0 0.0 6553.5000 ECU_ADDRESS 0x3FD50A /end MEASUREMENT
/begin MEASUREMENT van_filtr_dauer_A2 "Dauer ohne Sollwertaenderung" UWORD FORMULA_0073 0 0 0.0 6553.5000 ECU_ADDRESS 0x3FD50C /end MEASUREMENT
/begin MEASUREMENT van_filtr_fgen "Timer fuer Soll-Offset-Generator" UBYTE FORMULA_0458 0 0 0.0 25.5000 ECU_ADDRESS 0x3FD50E /end MEASUREMENT
/begin MEASUREMENT van_fitr_xd_wicht "Gewicht Regl-Abw. Vent.Guete" UBYTE FORMULA_0643 0 0 0.0 1.9921 ECU_ADDRESS 0x3FD50F /end MEASUREMENT
/begin MEASUREMENT van_frequ_E1 "Ausgegebene PWM-Frequenz" UWORD FORMULA_1192 0 0 16.0000 400.0000 ECU_ADDRESS 0x3FD510 /end MEASUREMENT
/begin MEASUREMENT van_frequ_A1 "Ausgegebene PWM-Frequenz" UWORD FORMULA_1192 0 0 16.0000 400.0000 ECU_ADDRESS 0x3FD512 /end MEASUREMENT
/begin MEASUREMENT van_frequ_E2 "Ausgegebene PWM-Frequenz" UWORD FORMULA_1192 0 0 16.0000 400.0000 ECU_ADDRESS 0x3FD514 /end MEASUREMENT
/begin MEASUREMENT van_frequ_A2 "Ausgegebene PWM-Frequenz" UWORD FORMULA_1192 0 0 16.0000 400.0000 ECU_ADDRESS 0x3FD516 /end MEASUREMENT
/begin MEASUREMENT van_frequ_stat "max. Frequenz bei guete=1" UWORD FORMULA_1192 0 0 16.0000 400.0000 ECU_ADDRESS 0x3FD518 /end MEASUREMENT
/begin MEASUREMENT van_frequ_dyn_E1 "Frequenz bei aktiver Regelung" UWORD FORMULA_1192 0 0 16.0000 400.0000 ECU_ADDRESS 0x3FD51A /end MEASUREMENT
/begin MEASUREMENT van_frequ_dyn_A1 "Frequenz bei aktiver Regelung" UWORD FORMULA_1192 0 0 16.0000 400.0000 ECU_ADDRESS 0x3FD51C /end MEASUREMENT
/begin MEASUREMENT van_frequ_dyn_E2 "Frequenz bei aktiver Regelung" UWORD FORMULA_1192 0 0 16.0000 400.0000 ECU_ADDRESS 0x3FD51E /end MEASUREMENT
/begin MEASUREMENT van_frequ_dyn_A2 "Frequenz bei aktiver Regelung" UWORD FORMULA_1192 0 0 16.0000 400.0000 ECU_ADDRESS 0x3FD520 /end MEASUREMENT
/begin MEASUREMENT van_frequ_fakt_E1 "GueteFaktor auf frequ_stat" UBYTE FORMULA_0643 0 0 0.0 1.9921 ECU_ADDRESS 0x3FD522 /end MEASUREMENT
/begin MEASUREMENT van_frequ_fakt_A1 "GueteFaktor auf frequ_stat" UBYTE FORMULA_0643 0 0 0.0 1.9921 ECU_ADDRESS 0x3FD523 /end MEASUREMENT
/begin MEASUREMENT van_frequ_fakt_E2 "GueteFaktor auf frequ_stat" UBYTE FORMULA_0643 0 0 0.0 1.9921 ECU_ADDRESS 0x3FD524 /end MEASUREMENT
/begin MEASUREMENT van_frequ_fakt_A2 "GueteFaktor auf frequ_stat" UBYTE FORMULA_0643 0 0 0.0 1.9921 ECU_ADDRESS 0x3FD525 /end MEASUREMENT
/begin MEASUREMENT van_fpos_E1 "Feinposition" SWORD FORMULA_0111 0 0 -80.0000 80.0000 ECU_ADDRESS 0x3FD526 /end MEASUREMENT
/begin MEASUREMENT van_fpos_A1 "Feinposition" SWORD FORMULA_0111 0 0 -80.0000 80.0000 ECU_ADDRESS 0x3FD528 /end MEASUREMENT
/begin MEASUREMENT van_fpos_E2 "Feinposition" SWORD FORMULA_0111 0 0 -80.0000 80.0000 ECU_ADDRESS 0x3FD52A /end MEASUREMENT
/begin MEASUREMENT van_fpos_A2 "Feinposition" SWORD FORMULA_0111 0 0 -80.0000 80.0000 ECU_ADDRESS 0x3FD52C /end MEASUREMENT
/begin MEASUREMENT van_reg_fakt_tmot "Reglerkorrekturfaktor ueber tmot" UBYTE FORMULA_0643 0 0 0.0 1.9921 ECU_ADDRESS 0x3FD52E /end MEASUREMENT
/begin MEASUREMENT van_gpos_E1 "Grobposition" SWORD FORMULA_0111 0 0 -80.0000 80.0000 ECU_ADDRESS 0x3FD530 /end MEASUREMENT
/begin MEASUREMENT van_gpos_A1 "Grobposition" SWORD FORMULA_0111 0 0 -80.0000 80.0000 ECU_ADDRESS 0x3FD532 /end MEASUREMENT
/begin MEASUREMENT van_gpos_E2 "Grobposition" SWORD FORMULA_0111 0 0 -80.0000 80.0000 ECU_ADDRESS 0x3FD534 /end MEASUREMENT
/begin MEASUREMENT van_gpos_A2 "Grobposition" SWORD FORMULA_0111 0 0 -80.0000 80.0000 ECU_ADDRESS 0x3FD536 /end MEASUREMENT
/begin MEASUREMENT van_guete_dauer "Dauer Ventilgueteadaption" UWORD FORMULA_0073 0 0 0.0 6553.5000 ECU_ADDRESS 0x3FD538 /end MEASUREMENT
/begin MEASUREMENT van_guete_pause "Pause zwischen Ventilgueteadaption" UWORD FORMULA_1197 0 0 0.0 109.0000 ECU_ADDRESS 0x3FD53A /end MEASUREMENT
/begin MEASUREMENT van_guete_reset_zeit "Dauer mit schlechter Ventilguete" UWORD FORMULA_0073 0 0 0.0 6553.5000 ECU_ADDRESS 0x3FD53C /end MEASUREMENT
/begin MEASUREMENT van_guete_roh_E1 "Ventil-Guete ungefilt" UWORD FORMULA_0024 0 0 0.0 1.9999 ECU_ADDRESS 0x3FD53E /end MEASUREMENT
/begin MEASUREMENT van_guete_roh_A1 "Ventil-Guete ungefilt" UWORD FORMULA_0024 0 0 0.0 1.9999 ECU_ADDRESS 0x3FD540 /end MEASUREMENT
/begin MEASUREMENT van_guete_roh_E2 "Ventil-Guete ungefilt" UWORD FORMULA_0024 0 0 0.0 1.9999 ECU_ADDRESS 0x3FD542 /end MEASUREMENT
/begin MEASUREMENT van_guete_roh_A2 "Ventil-Guete ungefilt" UWORD FORMULA_0024 0 0 0.0 1.9999 ECU_ADDRESS 0x3FD544 /end MEASUREMENT
/begin MEASUREMENT van_i_E1 "Ventil Sollstrom" SWORD FORMULA_1198 0 0 -1000.0000 3000.0000 ECU_ADDRESS 0x3FD546 /end MEASUREMENT
/begin MEASUREMENT van_i_A1 "Ventil Sollstrom" SWORD FORMULA_1198 0 0 -1000.0000 3000.0000 ECU_ADDRESS 0x3FD548 /end MEASUREMENT
/begin MEASUREMENT van_i_E2 "Ventil Sollstrom" SWORD FORMULA_1198 0 0 -1000.0000 3000.0000 ECU_ADDRESS 0x3FD54A /end MEASUREMENT
/begin MEASUREMENT van_i_A2 "Ventil Sollstrom" SWORD FORMULA_1198 0 0 -1000.0000 3000.0000 ECU_ADDRESS 0x3FD54C /end MEASUREMENT
/begin MEASUREMENT van_i_d_E1 "D-Anteil Regler Ventilstrom" SWORD FORMULA_1198 0 0 -1000.0000 3000.0000 ECU_ADDRESS 0x3FD54E /end MEASUREMENT
/begin MEASUREMENT van_i_d_A1 "D-Anteil Regler Ventilstrom" SWORD FORMULA_1198 0 0 -1000.0000 3000.0000 ECU_ADDRESS 0x3FD550 /end MEASUREMENT
/begin MEASUREMENT van_i_d_E2 "D-Anteil Regler Ventilstrom" SWORD FORMULA_1198 0 0 -1000.0000 3000.0000 ECU_ADDRESS 0x3FD552 /end MEASUREMENT
/begin MEASUREMENT van_i_d_A2 "D-Anteil Regler Ventilstrom" SWORD FORMULA_1198 0 0 -1000.0000 3000.0000 ECU_ADDRESS 0x3FD554 /end MEASUREMENT
/begin MEASUREMENT van_i_i_E1 "I-Anteil Regler Ventilstrom" SLONG FORMULA_1199 0 0 -1000.0000 3000.0000 ECU_ADDRESS 0x3FD558 /end MEASUREMENT
/begin MEASUREMENT van_i_i_A1 "I-Anteil Regler Ventilstrom" SLONG FORMULA_1199 0 0 -1000.0000 3000.0000 ECU_ADDRESS 0x3FD55C /end MEASUREMENT
/begin MEASUREMENT van_i_i_E2 "I-Anteil Regler Ventilstrom" SLONG FORMULA_1199 0 0 -1000.0000 3000.0000 ECU_ADDRESS 0x3FD560 /end MEASUREMENT
/begin MEASUREMENT van_i_i_A2 "I-Anteil Regler Ventilstrom" SLONG FORMULA_1199 0 0 -1000.0000 3000.0000 ECU_ADDRESS 0x3FD564 /end MEASUREMENT
/begin MEASUREMENT van_i_p_E1 "P-Anteil Regler Ventilstrom" SWORD FORMULA_1198 0 0 -1000.0000 3000.0000 ECU_ADDRESS 0x3FD568 /end MEASUREMENT
/begin MEASUREMENT van_i_p_A1 "P-Anteil Regler Ventilstrom" SWORD FORMULA_1198 0 0 -1000.0000 3000.0000 ECU_ADDRESS 0x3FD56A /end MEASUREMENT
/begin MEASUREMENT van_i_p_E2 "P-Anteil Regler Ventilstrom" SWORD FORMULA_1198 0 0 -1000.0000 3000.0000 ECU_ADDRESS 0x3FD56C /end MEASUREMENT
/begin MEASUREMENT van_i_p_A2 "P-Anteil Regler Ventilstrom" SWORD FORMULA_1198 0 0 -1000.0000 3000.0000 ECU_ADDRESS 0x3FD56E /end MEASUREMENT
/begin MEASUREMENT van_i_vorst_Einlass "Vorsteuerung Ventilstrom" SWORD FORMULA_1198 0 0 -1000.0000 3000.0000 ECU_ADDRESS 0x3FD570 /end MEASUREMENT
/begin MEASUREMENT van_i_vorst_Auslass "Vorsteuerung Ventilstrom" SWORD FORMULA_1198 0 0 -1000.0000 3000.0000 ECU_ADDRESS 0x3FD572 /end MEASUREMENT
/begin MEASUREMENT van_imp_cnt_E1 "Impulszahler fuer Abriss-Erkennung" SBYTE FORMULA_0003 0 0 0.0 7.0000 ECU_ADDRESS 0x3FD574 /end MEASUREMENT
/begin MEASUREMENT van_imp_cnt_A1 "Impulszahler fuer Abriss-Erkennung" SBYTE FORMULA_0003 0 0 0.0 7.0000 ECU_ADDRESS 0x3FD575 /end MEASUREMENT
/begin MEASUREMENT van_imp_cnt_E2 "Impulszahler fuer Abriss-Erkennung" SBYTE FORMULA_0003 0 0 0.0 7.0000 ECU_ADDRESS 0x3FD576 /end MEASUREMENT
/begin MEASUREMENT van_imp_cnt_A2 "Impulszahler fuer Abriss-Erkennung" SBYTE FORMULA_0003 0 0 0.0 7.0000 ECU_ADDRESS 0x3FD577 /end MEASUREMENT
/begin MEASUREMENT van_ist_filt_E1 "gefilterte Istposition" SWORD FORMULA_0111 0 0 50.0000 160.0000 ECU_ADDRESS 0x3FD578 /end MEASUREMENT
/begin MEASUREMENT van_ist_filt_A1 "gefilterte Istposition" SWORD FORMULA_0111 0 0 50.0000 160.0000 ECU_ADDRESS 0x3FD57A /end MEASUREMENT
/begin MEASUREMENT van_ist_filt_E2 "gefilterte Istposition" SWORD FORMULA_0111 0 0 50.0000 160.0000 ECU_ADDRESS 0x3FD57C /end MEASUREMENT
/begin MEASUREMENT van_ist_filt_A2 "gefilterte Istposition" SWORD FORMULA_0111 0 0 50.0000 160.0000 ECU_ADDRESS 0x3FD57E /end MEASUREMENT
/begin MEASUREMENT van_ist_kh_start_E1 "Istposition zu Beginn KH" SWORD FORMULA_0111 0 0 50.0000 160.0000 ECU_ADDRESS 0x3FD580 /end MEASUREMENT
/begin MEASUREMENT van_ist_kh_start_A1 "Istposition zu Beginn KH" SWORD FORMULA_0111 0 0 50.0000 160.0000 ECU_ADDRESS 0x3FD582 /end MEASUREMENT
/begin MEASUREMENT van_ist_kh_start_E2 "Istposition zu Beginn KH" SWORD FORMULA_0111 0 0 50.0000 160.0000 ECU_ADDRESS 0x3FD584 /end MEASUREMENT
/begin MEASUREMENT van_ist_kh_start_A2 "Istposition zu Beginn KH" SWORD FORMULA_0111 0 0 50.0000 160.0000 ECU_ADDRESS 0x3FD586 /end MEASUREMENT
/begin MEASUREMENT van_ist_oeff_E1 "Ventil Oeffnen vor ZOT" SWORD FORMULA_0111 0 0 -80.0000 80.0000 ECU_ADDRESS 0x3FD588 /end MEASUREMENT
/begin MEASUREMENT van_ist_oeff_A1 "Ventil Oeffnen vor ZOT" SWORD FORMULA_0111 0 0 -80.0000 80.0000 ECU_ADDRESS 0x3FD58A /end MEASUREMENT
/begin MEASUREMENT van_ist_oeff_E2 "Ventil Oeffnen vor ZOT" SWORD FORMULA_0111 0 0 -80.0000 80.0000 ECU_ADDRESS 0x3FD58C /end MEASUREMENT
/begin MEASUREMENT van_ist_oeff_A2 "Ventil Oeffnen vor ZOT" SWORD FORMULA_0111 0 0 -80.0000 80.0000 ECU_ADDRESS 0x3FD58E /end MEASUREMENT
/begin MEASUREMENT van_ist_schl_E1 "Ventil Schliessen vor ZOT" SWORD FORMULA_0111 0 0 -80.0000 550.0000 ECU_ADDRESS 0x3FD5C8 /end MEASUREMENT
/begin MEASUREMENT van_ist_schl_A1 "Ventil Schliessen vor ZOT" SWORD FORMULA_0111 0 0 -80.0000 550.0000 ECU_ADDRESS 0x3FD5CA /end MEASUREMENT
/begin MEASUREMENT van_ist_schl_E2 "Ventil Schliessen vor ZOT" SWORD FORMULA_0111 0 0 -80.0000 550.0000 ECU_ADDRESS 0x3FD5CC /end MEASUREMENT
/begin MEASUREMENT van_ist_schl_A2 "Ventil Schliessen vor ZOT" SWORD FORMULA_0111 0 0 -80.0000 550.0000 ECU_ADDRESS 0x3FD5CE /end MEASUREMENT
/begin MEASUREMENT van_kh_soll_E1 "Kennfeld Katheiz Soll" SWORD FORMULA_0111 0 0 50.0000 160.0000 ECU_ADDRESS 0x3FD5D0 /end MEASUREMENT
/begin MEASUREMENT van_kh_soll_A1 "Kennfeld Katheiz Soll" SWORD FORMULA_0111 0 0 50.0000 160.0000 ECU_ADDRESS 0x3FD5D2 /end MEASUREMENT
/begin MEASUREMENT van_kh_soll_E2 "Kennfeld Katheiz Soll" SWORD FORMULA_0111 0 0 50.0000 160.0000 ECU_ADDRESS 0x3FD5D4 /end MEASUREMENT
/begin MEASUREMENT van_kh_soll_A2 "Kennfeld Katheiz Soll" SWORD FORMULA_0111 0 0 50.0000 160.0000 ECU_ADDRESS 0x3FD5D6 /end MEASUREMENT
/begin MEASUREMENT van_kd_Einlass "Vanos-Regler d-Faktor" SWORD FORMULA_1200 0 0 -32.0000 31.9990 ECU_ADDRESS 0x3FD5D8 /end MEASUREMENT
/begin MEASUREMENT van_kd_Auslass "Vanos-Regler d-Faktor" SWORD FORMULA_1200 0 0 -32.0000 31.9990 ECU_ADDRESS 0x3FD5DA /end MEASUREMENT
/begin MEASUREMENT van_ki_E1 "Vanos-Regler I-Faktor" SWORD FORMULA_1201 0 0 -500.0000 499.9847 ECU_ADDRESS 0x3FD5DC /end MEASUREMENT
/begin MEASUREMENT van_ki_A1 "Vanos-Regler I-Faktor" SWORD FORMULA_1201 0 0 -500.0000 499.9847 ECU_ADDRESS 0x3FD5DE /end MEASUREMENT
/begin MEASUREMENT van_ki_E2 "Vanos-Regler I-Faktor" SWORD FORMULA_1201 0 0 -500.0000 499.9847 ECU_ADDRESS 0x3FD5E0 /end MEASUREMENT
/begin MEASUREMENT van_ki_A2 "Vanos-Regler I-Faktor" SWORD FORMULA_1201 0 0 -500.0000 499.9847 ECU_ADDRESS 0x3FD5E2 /end MEASUREMENT
/begin MEASUREMENT van_kp_Einlass "Vanos-Regler P-Faktor" SWORD FORMULA_1202 0 0 -1280.0000 1279.9609 ECU_ADDRESS 0x3FD5E4 /end MEASUREMENT
/begin MEASUREMENT van_kp_Auslass "Vanos-Regler P-Faktor" SWORD FORMULA_1202 0 0 -1280.0000 1279.9609 ECU_ADDRESS 0x3FD5E6 /end MEASUREMENT
/begin MEASUREMENT van_n_korr_a_b1 "n * tabg_lw_verh_wurzel" SWORD FORMULA_0006 0 0 0.0 10000.0000 ECU_ADDRESS 0x3FD5E8 /end MEASUREMENT
/begin MEASUREMENT van_n_korr_a_b2 "n * tabg_lw_verh_wurzel" SWORD FORMULA_0006 0 0 0.0 10000.0000 ECU_ADDRESS 0x3FD5EA /end MEASUREMENT
/begin MEASUREMENT van_r "Spulenwiderstand Ventil" SWORD FORMULA_1203 0 0 -32.7680 32.7670 ECU_ADDRESS 0x3FD5EC /end MEASUREMENT
/begin MEASUREMENT van_smg_st "Sollwert SMG-Schaltung" UBYTE FORMULA_1204 0 0 0.0 255.0 ECU_ADDRESS 0x3FD5EE /end MEASUREMENT
/begin MEASUREMENT van_smg_dauer "SMG Eingriffsdauer" UBYTE FORMULA_0317 0 0 0.0 2.5500 ECU_ADDRESS 0x3FD5EF /end MEASUREMENT
/begin MEASUREMENT van_soll_filtr_offs "Sollwert-Offset gegen Filtration" SWORD FORMULA_0111 0 0 -80.0000 80.0000 ECU_ADDRESS 0x3FD5F0 /end MEASUREMENT
/begin MEASUREMENT van_soll_old_E1 "Alter Sollwert Aenderungserkennung" SWORD FORMULA_0111 0 0 50.0000 160.0000 ECU_ADDRESS 0x3FD5F2 /end MEASUREMENT
/begin MEASUREMENT van_soll_old_A1 "Alter Sollwert Aenderungserkennung" SWORD FORMULA_0111 0 0 50.0000 160.0000 ECU_ADDRESS 0x3FD5F4 /end MEASUREMENT
/begin MEASUREMENT van_soll_old_E2 "Alter Sollwert Aenderungserkennung" SWORD FORMULA_0111 0 0 50.0000 160.0000 ECU_ADDRESS 0x3FD5F6 /end MEASUREMENT
/begin MEASUREMENT van_soll_old_A2 "Alter Sollwert Aenderungserkennung" SWORD FORMULA_0111 0 0 50.0000 160.0000 ECU_ADDRESS 0x3FD5F8 /end MEASUREMENT
/begin MEASUREMENT van_soll_stat_E1 "Sollwert ohne Filtrationsmodulation" SWORD FORMULA_0111 0 0 50.0000 160.0000 ECU_ADDRESS 0x3FD5FA /end MEASUREMENT
/begin MEASUREMENT van_soll_stat_A1 "Sollwert ohne Filtrationsmodulation" SWORD FORMULA_0111 0 0 50.0000 160.0000 ECU_ADDRESS 0x3FD5FC /end MEASUREMENT
/begin MEASUREMENT van_soll_stat_E2 "Sollwert ohne Filtrationsmodulation" SWORD FORMULA_0111 0 0 50.0000 160.0000 ECU_ADDRESS 0x3FD5FE /end MEASUREMENT
/begin MEASUREMENT van_soll_stat_A2 "Sollwert ohne Filtrationsmodulation" SWORD FORMULA_0111 0 0 50.0000 160.0000 ECU_ADDRESS 0x3FD600 /end MEASUREMENT
/begin MEASUREMENT van_soll_dmax_E1 "max. Sollwertaenderung" SWORD FORMULA_1205 0 0 0.0 80.0000 ECU_ADDRESS 0x3FD602 /end MEASUREMENT
/begin MEASUREMENT van_soll_dmax_A1 "max. Sollwertaenderung" SWORD FORMULA_1205 0 0 0.0 80.0000 ECU_ADDRESS 0x3FD604 /end MEASUREMENT
/begin MEASUREMENT van_soll_dmax_E2 "max. Sollwertaenderung" SWORD FORMULA_1205 0 0 0.0 80.0000 ECU_ADDRESS 0x3FD606 /end MEASUREMENT
/begin MEASUREMENT van_soll_dmax_A2 "max. Sollwertaenderung" SWORD FORMULA_1205 0 0 0.0 80.0000 ECU_ADDRESS 0x3FD608 /end MEASUREMENT
/begin MEASUREMENT B_VAN_FILTR_E1 "Filtration erkannt" UBYTE FORMULA_0216 0 0 0.0 255.0 ECU_ADDRESS 0x3FD60A BIT_MASK 0x1 /end MEASUREMENT
/begin MEASUREMENT B_VAN_FILTR_A1 "Filtration erkannt" UBYTE FORMULA_0216 0 0 0.0 255.0 ECU_ADDRESS 0x3FD60B BIT_MASK 0x1 /end MEASUREMENT
/begin MEASUREMENT B_VAN_FILTR_E2 "Filtration erkannt" UBYTE FORMULA_0216 0 0 0.0 255.0 ECU_ADDRESS 0x3FD60C BIT_MASK 0x1 /end MEASUREMENT
/begin MEASUREMENT B_VAN_FILTR_A2 "Filtration erkannt" UBYTE FORMULA_0216 0 0 0.0 255.0 ECU_ADDRESS 0x3FD60D BIT_MASK 0x1 /end MEASUREMENT
/begin MEASUREMENT B_VAN_KS_AUS_E1 "Ventil Kurzschlussabschaltung" UBYTE FORMULA_0217 0 0 0.0 255.0 ECU_ADDRESS 0x3FD60A BIT_MASK 0x2 /end MEASUREMENT
/begin MEASUREMENT B_VAN_KS_AUS_A1 "Ventil Kurzschlussabschaltung" UBYTE FORMULA_0217 0 0 0.0 255.0 ECU_ADDRESS 0x3FD60B BIT_MASK 0x2 /end MEASUREMENT
/begin MEASUREMENT B_VAN_KS_AUS_E2 "Ventil Kurzschlussabschaltung" UBYTE FORMULA_0217 0 0 0.0 255.0 ECU_ADDRESS 0x3FD60C BIT_MASK 0x2 /end MEASUREMENT
/begin MEASUREMENT B_VAN_KS_AUS_A2 "Ventil Kurzschlussabschaltung" UBYTE FORMULA_0217 0 0 0.0 255.0 ECU_ADDRESS 0x3FD60D BIT_MASK 0x2 /end MEASUREMENT
/begin MEASUREMENT B_VAN_REG_FREI_E1 "Lageregler Freigabe" UBYTE FORMULA_0218 0 0 0.0 255.0 ECU_ADDRESS 0x3FD60A BIT_MASK 0x4 /end MEASUREMENT
/begin MEASUREMENT B_VAN_REG_FREI_A1 "Lageregler Freigabe" UBYTE FORMULA_0218 0 0 0.0 255.0 ECU_ADDRESS 0x3FD60B BIT_MASK 0x4 /end MEASUREMENT
/begin MEASUREMENT B_VAN_REG_FREI_E2 "Lageregler Freigabe" UBYTE FORMULA_0218 0 0 0.0 255.0 ECU_ADDRESS 0x3FD60C BIT_MASK 0x4 /end MEASUREMENT
/begin MEASUREMENT B_VAN_REG_FREI_A2 "Lageregler Freigabe" UBYTE FORMULA_0218 0 0 0.0 255.0 ECU_ADDRESS 0x3FD60D BIT_MASK 0x4 /end MEASUREMENT
/begin MEASUREMENT B_VAN_EXD_PRUEF_I_E1 "Stromvorgabe ueber Diagnose" UBYTE FORMULA_0219 0 0 0.0 255.0 ECU_ADDRESS 0x3FD60A BIT_MASK 0x8 /end MEASUREMENT
/begin MEASUREMENT B_VAN_EXD_PRUEF_I_A1 "Stromvorgabe ueber Diagnose" UBYTE FORMULA_0219 0 0 0.0 255.0 ECU_ADDRESS 0x3FD60B BIT_MASK 0x8 /end MEASUREMENT
/begin MEASUREMENT B_VAN_EXD_PRUEF_I_E2 "Stromvorgabe ueber Diagnose" UBYTE FORMULA_0219 0 0 0.0 255.0 ECU_ADDRESS 0x3FD60C BIT_MASK 0x8 /end MEASUREMENT
/begin MEASUREMENT B_VAN_EXD_PRUEF_I_A2 "Stromvorgabe ueber Diagnose" UBYTE FORMULA_0219 0 0 0.0 255.0 ECU_ADDRESS 0x3FD60D BIT_MASK 0x8 /end MEASUREMENT
/begin MEASUREMENT B_VAN_ANSCHL_ANF_E1 "Anschlag anfahren" UBYTE FORMULA_0220 0 0 0.0 255.0 ECU_ADDRESS 0x3FD60A BIT_MASK 0x10 /end MEASUREMENT
/begin MEASUREMENT B_VAN_ANSCHL_ANF_A1 "Anschlag anfahren" UBYTE FORMULA_0220 0 0 0.0 255.0 ECU_ADDRESS 0x3FD60B BIT_MASK 0x10 /end MEASUREMENT
/begin MEASUREMENT B_VAN_ANSCHL_ANF_E2 "Anschlag anfahren" UBYTE FORMULA_0220 0 0 0.0 255.0 ECU_ADDRESS 0x3FD60C BIT_MASK 0x10 /end MEASUREMENT
/begin MEASUREMENT B_VAN_ANSCHL_ANF_A2 "Anschlag anfahren" UBYTE FORMULA_0220 0 0 0.0 255.0 ECU_ADDRESS 0x3FD60D BIT_MASK 0x10 /end MEASUREMENT
/begin MEASUREMENT B_VAN_ANSCHL_DC_E1 "Anschlag im DrivingCycle gelernt" UBYTE FORMULA_0221 0 0 0.0 255.0 ECU_ADDRESS 0x3FD60A BIT_MASK 0x20 /end MEASUREMENT
/begin MEASUREMENT B_VAN_ANSCHL_DC_A1 "Anschlag im DrivingCycle gelernt" UBYTE FORMULA_0221 0 0 0.0 255.0 ECU_ADDRESS 0x3FD60B BIT_MASK 0x20 /end MEASUREMENT
/begin MEASUREMENT B_VAN_ANSCHL_DC_E2 "Anschlag im DrivingCycle gelernt" UBYTE FORMULA_0221 0 0 0.0 255.0 ECU_ADDRESS 0x3FD60C BIT_MASK 0x20 /end MEASUREMENT
/begin MEASUREMENT B_VAN_ANSCHL_DC_A2 "Anschlag im DrivingCycle gelernt" UBYTE FORMULA_0221 0 0 0.0 255.0 ECU_ADDRESS 0x3FD60D BIT_MASK 0x20 /end MEASUREMENT
/begin MEASUREMENT B_VAN_DRUCK_SPAET_E1 "Druckerkennung Sollwert spaet" UBYTE FORMULA_0222 0 0 0.0 255.0 ECU_ADDRESS 0x3FD60A BIT_MASK 0x40 /end MEASUREMENT
/begin MEASUREMENT B_VAN_DRUCK_SPAET_A1 "Druckerkennung Sollwert spaet" UBYTE FORMULA_0222 0 0 0.0 255.0 ECU_ADDRESS 0x3FD60B BIT_MASK 0x40 /end MEASUREMENT
/begin MEASUREMENT B_VAN_DRUCK_SPAET_E2 "Druckerkennung Sollwert spaet" UBYTE FORMULA_0222 0 0 0.0 255.0 ECU_ADDRESS 0x3FD60C BIT_MASK 0x40 /end MEASUREMENT
/begin MEASUREMENT B_VAN_DRUCK_SPAET_A2 "Druckerkennung Sollwert spaet" UBYTE FORMULA_0222 0 0 0.0 255.0 ECU_ADDRESS 0x3FD60D BIT_MASK 0x40 /end MEASUREMENT
/begin MEASUREMENT van_st_E1 "Status Vanos" UBYTE FORMULA_0003 0 0 0.0 255.0000 ECU_ADDRESS 0x3FD60A /end MEASUREMENT
/begin MEASUREMENT van_st_A1 "Status Vanos" UBYTE FORMULA_0003 0 0 0.0 255.0000 ECU_ADDRESS 0x3FD60B /end MEASUREMENT
/begin MEASUREMENT van_st_E2 "Status Vanos" UBYTE FORMULA_0003 0 0 0.0 255.0000 ECU_ADDRESS 0x3FD60C /end MEASUREMENT
/begin MEASUREMENT van_st_A2 "Status Vanos" UBYTE FORMULA_0003 0 0 0.0 255.0000 ECU_ADDRESS 0x3FD60D /end MEASUREMENT
/begin MEASUREMENT B_VAN_EINGER_E1 "Vanos eingeregelt" UBYTE FORMULA_0216 0 0 0.0 255.0 ECU_ADDRESS 0x3FD60E BIT_MASK 0x1 /end MEASUREMENT
/begin MEASUREMENT B_VAN_EINGER_A1 "Vanos eingeregelt" UBYTE FORMULA_0217 0 0 0.0 255.0 ECU_ADDRESS 0x3FD60E BIT_MASK 0x2 /end MEASUREMENT
/begin MEASUREMENT B_VAN_EINGER_E2 "Vanos eingeregelt" UBYTE FORMULA_0218 0 0 0.0 255.0 ECU_ADDRESS 0x3FD60E BIT_MASK 0x4 /end MEASUREMENT
/begin MEASUREMENT B_VAN_EINGER_A2 "Vanos eingeregelt" UBYTE FORMULA_0219 0 0 0.0 255.0 ECU_ADDRESS 0x3FD60E BIT_MASK 0x8 /end MEASUREMENT
/begin MEASUREMENT B_VAN_EINGER_BANK1 "Vanos eingeregelt" UBYTE FORMULA_1206 0 0 0.0 255.0 ECU_ADDRESS 0x3FD60E BIT_MASK 0x3 /end MEASUREMENT
/begin MEASUREMENT B_VAN_EINGER_BANK2 "Vanos eingeregelt" UBYTE FORMULA_1207 0 0 0.0 255.0 ECU_ADDRESS 0x3FD60E BIT_MASK 0xC /end MEASUREMENT
/begin MEASUREMENT van_st_eingeregelt "Vanos eingeregelt" UBYTE FORMULA_0003 0 0 0.0 255.0000 ECU_ADDRESS 0x3FD60E /end MEASUREMENT
/begin MEASUREMENT B_VAN_BEGR_E1 "Vanos Sollwert begrenzt" UBYTE FORMULA_0216 0 0 0.0 255.0 ECU_ADDRESS 0x3FD60F BIT_MASK 0x1 /end MEASUREMENT
/begin MEASUREMENT B_VAN_BEGR_A1 "Vanos Sollwert begrenzt" UBYTE FORMULA_0217 0 0 0.0 255.0 ECU_ADDRESS 0x3FD60F BIT_MASK 0x2 /end MEASUREMENT
/begin MEASUREMENT B_VAN_BEGR_E2 "Vanos Sollwert begrenzt" UBYTE FORMULA_0218 0 0 0.0 255.0 ECU_ADDRESS 0x3FD60F BIT_MASK 0x4 /end MEASUREMENT
/begin MEASUREMENT B_VAN_BEGR_A2 "Vanos Sollwert begrenzt" UBYTE FORMULA_0219 0 0 0.0 255.0 ECU_ADDRESS 0x3FD60F BIT_MASK 0x8 /end MEASUREMENT
/begin MEASUREMENT B_VAN_BEGR "Vanos Sollwert begrenzt" UBYTE FORMULA_1208 0 0 0.0 255.0 ECU_ADDRESS 0x3FD60F BIT_MASK 0xF /end MEASUREMENT
/begin MEASUREMENT van_st_begr "Vanos Sollwert begrenzt" UBYTE FORMULA_0003 0 0 0.0 255.0000 ECU_ADDRESS 0x3FD60F /end MEASUREMENT
/begin MEASUREMENT van_st_geber_E1 "Geberstatus" UBYTE FORMULA_1209 0 0 0.0 255.0 ECU_ADDRESS 0x3FD610 /end MEASUREMENT
/begin MEASUREMENT van_st_geber_A1 "Geberstatus" UBYTE FORMULA_1209 0 0 0.0 255.0 ECU_ADDRESS 0x3FD611 /end MEASUREMENT
/begin MEASUREMENT van_st_geber_E2 "Geberstatus" UBYTE FORMULA_1209 0 0 0.0 255.0 ECU_ADDRESS 0x3FD612 /end MEASUREMENT
/begin MEASUREMENT van_st_geber_A2 "Geberstatus" UBYTE FORMULA_1209 0 0 0.0 255.0 ECU_ADDRESS 0x3FD613 /end MEASUREMENT
/begin MEASUREMENT van_st_unlock_E1 "Entriegelungs-Status" UBYTE FORMULA_1210 0 0 0.0 255.0 ECU_ADDRESS 0x3FD614 /end MEASUREMENT
/begin MEASUREMENT van_st_unlock_A1 "Entriegelungs-Status" UBYTE FORMULA_1210 0 0 0.0 255.0 ECU_ADDRESS 0x3FD615 /end MEASUREMENT
/begin MEASUREMENT van_st_unlock_E2 "Entriegelungs-Status" UBYTE FORMULA_1210 0 0 0.0 255.0 ECU_ADDRESS 0x3FD616 /end MEASUREMENT
/begin MEASUREMENT van_st_unlock_A2 "Entriegelungs-Status" UBYTE FORMULA_1210 0 0 0.0 255.0 ECU_ADDRESS 0x3FD617 /end MEASUREMENT
/begin MEASUREMENT van_t_soll_begr "Dauer Sollwert Min-Begrenzung" UWORD FORMULA_0650 0 0 0.0 655.3500 ECU_ADDRESS 0x3FD618 /end MEASUREMENT
/begin MEASUREMENT van_t_start_dly "Reglerfreigabe nach Motor Start" UWORD FORMULA_0021 0 0 0.0 655.0000 ECU_ADDRESS 0x3FD61A /end MEASUREMENT
/begin MEASUREMENT van_tb_imp_E1 "Timerstand bei ZahnInterrupt" ULONG FORMULA_0074 0 0 0.0 4294967295.0000 ECU_ADDRESS 0x3FD61C /end MEASUREMENT
/begin MEASUREMENT van_tb_imp_A1 "Timerstand bei ZahnInterrupt" ULONG FORMULA_0074 0 0 0.0 4294967295.0000 ECU_ADDRESS 0x3FD620 /end MEASUREMENT
/begin MEASUREMENT van_tb_imp_E2 "Timerstand bei ZahnInterrupt" ULONG FORMULA_0074 0 0 0.0 4294967295.0000 ECU_ADDRESS 0x3FD624 /end MEASUREMENT
/begin MEASUREMENT van_tb_imp_A2 "Timerstand bei ZahnInterrupt" ULONG FORMULA_0074 0 0 0.0 4294967295.0000 ECU_ADDRESS 0x3FD628 /end MEASUREMENT
/begin MEASUREMENT van_tv_E1 "Ventil Tastverhaeltnis" SWORD FORMULA_1194 0 0 0.0 100.0000 ECU_ADDRESS 0x3FD62C /end MEASUREMENT
/begin MEASUREMENT van_tv_A1 "Ventil Tastverhaeltnis" SWORD FORMULA_1194 0 0 0.0 100.0000 ECU_ADDRESS 0x3FD62E /end MEASUREMENT
/begin MEASUREMENT van_tv_E2 "Ventil Tastverhaeltnis" SWORD FORMULA_1194 0 0 0.0 100.0000 ECU_ADDRESS 0x3FD630 /end MEASUREMENT
/begin MEASUREMENT van_tv_A2 "Ventil Tastverhaeltnis" SWORD FORMULA_1194 0 0 0.0 100.0000 ECU_ADDRESS 0x3FD632 /end MEASUREMENT
/begin MEASUREMENT van_vo_filt_b1 "Ventil_Ueberschneidung" SWORD FORMULA_0111 0 0 -80.0000 80.0000 ECU_ADDRESS 0x3FD634 /end MEASUREMENT
/begin MEASUREMENT van_vo_filt_b2 "Ventil_Ueberschneidung" SWORD FORMULA_0111 0 0 -80.0000 80.0000 ECU_ADDRESS 0x3FD636 /end MEASUREMENT
/begin MEASUREMENT van_xd_E1 "Regeldifferenz" SWORD FORMULA_0111 0 0 -80.0000 80.0000 ECU_ADDRESS 0x3FD638 /end MEASUREMENT
/begin MEASUREMENT van_xd_A1 "Regeldifferenz" SWORD FORMULA_0111 0 0 -80.0000 80.0000 ECU_ADDRESS 0x3FD63A /end MEASUREMENT
/begin MEASUREMENT van_xd_E2 "Regeldifferenz" SWORD FORMULA_0111 0 0 -80.0000 80.0000 ECU_ADDRESS 0x3FD63C /end MEASUREMENT
/begin MEASUREMENT van_xd_A2 "Regeldifferenz" SWORD FORMULA_0111 0 0 -80.0000 80.0000 ECU_ADDRESS 0x3FD63E /end MEASUREMENT
/begin MEASUREMENT van_xd_filt_E1 "Gefilterte Regeldifferenz" SWORD FORMULA_0111 0 0 -80.0000 80.0000 ECU_ADDRESS 0x3FD640 /end MEASUREMENT
/begin MEASUREMENT van_xd_filt_A1 "Gefilterte Regeldifferenz" SWORD FORMULA_0111 0 0 -80.0000 80.0000 ECU_ADDRESS 0x3FD642 /end MEASUREMENT
/begin MEASUREMENT van_xd_filt_E2 "Gefilterte Regeldifferenz" SWORD FORMULA_0111 0 0 -80.0000 80.0000 ECU_ADDRESS 0x3FD644 /end MEASUREMENT
/begin MEASUREMENT van_xd_filt_A2 "Gefilterte Regeldifferenz" SWORD FORMULA_0111 0 0 -80.0000 80.0000 ECU_ADDRESS 0x3FD646 /end MEASUREMENT
/begin MEASUREMENT van_xd_tau "Filterzeitkonstante Regeldifferenz" UWORD FORMULA_1059 0 0 0.1000 6553.5000 ECU_ADDRESS 0x3FD650 /end MEASUREMENT
/begin MEASUREMENT van_zahn_cnt_b1 "Zahnzaehler fuer n-Messung" SBYTE FORMULA_0003 0 0 0.0 6.0000 ECU_ADDRESS 0x3FD652 /end MEASUREMENT
/begin MEASUREMENT van_zahn_cnt_b2 "Zahnzaehler fuer n-Messung" SBYTE FORMULA_0003 0 0 0.0 6.0000 ECU_ADDRESS 0x3FD653 /end MEASUREMENT
/begin MEASUREMENT van_zahn_ctr5ms_b1 "5ms-Ctr fuer n-Messung" SWORD FORMULA_0010 0 0 0.0 6.0000 ECU_ADDRESS 0x3FD654 /end MEASUREMENT
/begin MEASUREMENT van_zahn_ctr5ms_b2 "5ms-Ctr fuer n-Messung" SWORD FORMULA_0010 0 0 0.0 6.0000 ECU_ADDRESS 0x3FD656 /end MEASUREMENT
/begin MEASUREMENT n_van_b1 "Einlass Nockenwellen-Drehzahl" SWORD FORMULA_0006 0 0 0.0 10000.0000 ECU_ADDRESS 0x3FD658 /end MEASUREMENT
/begin MEASUREMENT n_van_b2 "Einlass Nockenwellen-Drehzahl" SWORD FORMULA_0006 0 0 0.0 10000.0000 ECU_ADDRESS 0x3FD65A /end MEASUREMENT
/* ------------------ Abschnitt erzeugt aus van_dsv.dat ------------------ */
/begin CHARACTERISTIC K_VAN_DSV_ABFALL_DLY "Abfalldauer Druckspeicherventil | EN: Drop-out time, pressure-accumulator valve [s]" VALUE 0x7820A TKW_VV_VV_UB 100.0 FORMULA_0458 0.0 25.5000 /end CHARACTERISTIC
/begin CHARACTERISTIC K_VAN_DSV_CFG "Konfig Vanos Druckspeicherventil" VALUE 0x7820B TKW_VV_VV_UB 100.0 FORMULA_1228 0.0 255.0 /end CHARACTERISTIC
/begin CHARACTERISTIC K_VAN_DSV_N_AUS "Ausschaltschwelle DSV im Start | EN: Switch-off threshold, pressure-accumulator valve during start [Upm]" VALUE 0x7820C TKW_VV_VV_SW 100.0 FORMULA_0006 0.0 10000.0000 /end CHARACTERISTIC
/begin CHARACTERISTIC K_VAN_DSV_N_EIN "Einschaltschwelle DSV im Start | EN: Switch-on threshold, pressure-accumulator valve during start [Upm]" VALUE 0x7820E TKW_VV_VV_SW 100.0 FORMULA_0006 0.0 10000.0000 /end CHARACTERISTIC
/begin CHARACTERISTIC K_VAN_DSV_PEAK_TIME "Anzugszeit DSV | EN: Pull-in time, pressure-accumulator valve" VALUE 0x78210 TKW_VV_VV_UB 100.0 FORMULA_0458 0.0 25.5000 /end CHARACTERISTIC
/begin CHARACTERISTIC KL_VAN_DSV_HOLD_TV "Halte-Tastverhaeltnis DSV | EN: Hold duty cycle, pressure-accumulator valve" CURVE 0x78212 TKL_SW_VV_SW 100.0 FORMULA_1227 0.0 100.0000 /begin AXIS_DESCR STD_AXIS ub FORMULA_0008 3 0.0 28.0000 FORMAT "%4.1" /end AXIS_DESCR FORMAT "%4.1" /end CHARACTERISTIC
/begin CHARACTERISTIC KL_VAN_DSV_PEAK_TV "Peak-Tastverhaeltnis DSV | EN: Peak duty cycle, pressure-accumulator valve" CURVE 0x78220 TKL_SW_VV_SW 100.0 FORMULA_1227 0.0 100.0000 /begin AXIS_DESCR STD_AXIS ub FORMULA_0008 3 0.0 28.0000 FORMAT "%4.1" /end AXIS_DESCR FORMAT "%4.1" /end CHARACTERISTIC
/begin MEASUREMENT van_dsv_exd_st "Status externe Ansteuerung" UBYTE FORMULA_0635 0 0 0.0 255.0 ECU_ADDRESS 0x3FD4A0 /end MEASUREMENT
/begin MEASUREMENT van_dsv_exd_timeout "Timeout externe Ansteuerung" UBYTE FORMULA_0458 0 0 0.0 25.5000 ECU_ADDRESS 0x3FD4A1 /end MEASUREMENT
/begin MEASUREMENT van_dsv_peak_time "Zeit der Peak-Phase DSV" UBYTE FORMULA_0458 0 0 0.0 25.5000 ECU_ADDRESS 0x3FD4A2 /end MEASUREMENT
/begin MEASUREMENT van_dsv_st "Status Vanos Druckspeicherventil" UBYTE FORMULA_1226 0 0 0.0 255.0 ECU_ADDRESS 0x3FD4A3 /end MEASUREMENT
/begin MEASUREMENT van_dsv_timer "Zeitzaehler DSV" UBYTE FORMULA_0458 0 0 0.0 25.5000 ECU_ADDRESS 0x3FD4A4 /end MEASUREMENT
/begin MEASUREMENT van_dsv_tv "Druckspeicherventil Tastverhaeltnis" SWORD FORMULA_1227 0 0 0.0 100.0000 ECU_ADDRESS 0x3FD4A6 /end MEASUREMENT
/* ------------------ Abschnitt erzeugt aus wf.dat ------------------ */
/begin CHARACTERISTIC K_WF_MKS_TI_CFG "Einrechnung WF-MKS | EN: Inclusion of wall-film fuel mass" VALUE 0x78E72 TKW_VV_VV_UB 100.0 FORMULA_0003 0.0 1.0000 /end CHARACTERISTIC
/begin CHARACTERISTIC K_WF_SOLL_START_PSAU_CFG "Schaler f. realen o. appl. PSAU | EN: Switch for real or calibrated intake pressure" VALUE 0x78E73 TKW_VV_VV_UB 100.0 FORMULA_0003 0.0 1.0000 /end CHARACTERISTIC
/begin CHARACTERISTIC K_WF_SOLL_START_PSAU "appl. PSAU-Wert im Start | EN: Calibrated intake-pressure value during start [mbar]" VALUE 0x78E74 TKW_VV_VV_SW 100.0 FORMULA_0077 0.0 2000.0000 FORMAT "%4.1" /end CHARACTERISTIC
/begin CHARACTERISTIC K_WF_MKS_AUS_HYS "Hysterese-Faktor f. WF-Deaktivierung | EN: Hysteresis factor for wall-film deactivation" VALUE 0x78E76 TKW_VV_VV_UW 100.0 FORMULA_0075 0.0 4.0000 FORMAT "%6.3" /end CHARACTERISTIC
/begin CHARACTERISTIC K_WF_ASP_START "Anzahl ASP im START | EN: Number of intake strokes in START" VALUE 0x78E78 TKW_VV_VV_UW 100.0 FORMULA_1232 0.0 1279.0000 /end CHARACTERISTIC
/begin CHARACTERISTIC K_WF_IST_PLAU_MAX "max. plausibler WF-Wert | EN: max. plausibler WF-Wert" VALUE 0x78E7A TKW_VV_VV_UW 100.0 FORMULA_0530 0.0 2000.0000 FORMAT "%5.2" /end CHARACTERISTIC
/begin CHARACTERISTIC K_WF_SOLL_CFG "Auswahl - Ermittlung wf_soll_grund" VALUE 0x78E7C TKW_VV_VV_UB 100.0 FORMULA_1234 0.0 2.0 /end CHARACTERISTIC
/begin CHARACTERISTIC K_WF_MKS_F_CFG "Einrechnung WF-MKS-Verstaerkungsfaktor" VALUE 0x78E7D TKW_VV_VV_UB 100.0 FORMULA_1235 0.0 1.0 /end CHARACTERISTIC
/begin CHARACTERISTIC K_WF_MKS_F "Faktor/max. Schwelle Verstaerkungsfaktor" VALUE 0x78E7E TKW_VV_VV_UW 100.0 FORMULA_0075 0.0 4.0000 FORMAT "%6.3" /end CHARACTERISTIC
/begin CHARACTERISTIC K_WF_IST_CFG "Auswahl - Kraftstoffeintrags ins Oel" VALUE 0x78E80 TKW_VV_VV_UB 100.0 FORMULA_1236 0.0 2.0 /end CHARACTERISTIC
/begin CHARACTERISTIC KL_WF_DMKS_T1_MS "Abdampfzeitkonstante bei stehenden Motor | EN: Evaporation time constant with engine stopped" CURVE 0x78E82 TKL_SW_VV_UW 100.0 FORMULA_0062 0.0 65535.0000
 /begin AXIS_DESCR STD_AXIS tsgrw FORMULA_0023 5 -50.0000 170.0000 FORMAT "%4.1" /end AXIS_DESCR
/end CHARACTERISTIC
/begin CHARACTERISTIC KL_WF_SOLL_F_TI_PHI_ENDE "WF-Korrekturfaktor Einspritzende | EN: Wall-film correction factor, end of injection" CURVE 0x78E98 TKL_SW_VV_UW 100.0 FORMULA_0075 0.0 4.0000
 /begin AXIS_DESCR STD_AXIS ti_phi_ende FORMULA_0111 5 -72.0000 1440.0000 FORMAT "%4.1" /end AXIS_DESCR
 FORMAT "%6.3" /end CHARACTERISTIC
/begin CHARACTERISTIC KL_WF_SOLL_F_LAM "WF-Korrekturfaktor Lambda | EN: Wall-film correction factor, lambda" CURVE 0x78EAE TKL_UW_VV_UW 100.0 FORMULA_0075 0.0 4.0000 /begin AXIS_DESCR STD_AXIS lam_soll FORMULA_0025 5 0.0 3.9990 FORMAT "%6.3" /end AXIS_DESCR FORMAT "%6.3" /end CHARACTERISTIC
/begin CHARACTERISTIC KL_WF_ASP_POS_START "Anzahl ASP f. WF-Aufbau (seq.START) | EN: Number of working cycles for wall-film build-up (sequential start)" CURVE 0x78EC4 TKL_SW_VV_UW 100.0 FORMULA_1232 0.0 1279.0000
 /begin AXIS_DESCR STD_AXIS tsgrw FORMULA_0023 6 -50.0000 170.0000 FORMAT "%4.1" /end AXIS_DESCR
/end CHARACTERISTIC
/begin CHARACTERISTIC KL_WF_ASP_NEG_START "Anzahl ASP f. WF-Abbau (seq.START) | EN: Number of working cycles for wall-film decay (sequential start)" CURVE 0x78EDE TKL_SW_VV_UW 100.0 FORMULA_1232 0.0 1279.0000
 /begin AXIS_DESCR STD_AXIS tsgrw FORMULA_0023 6 -50.0000 170.0000 FORMAT "%4.1" /end AXIS_DESCR
/end CHARACTERISTIC
/begin CHARACTERISTIC KL_WF_MD_RF_TAU "Filterkonstanten - WF-PSAU Ermittlung" CURVE 0x78EF8 TKL_SW_VV_UB 100.0 FORMULA_1237 0.0040 0.9960 /begin AXIS_DESCR STD_AXIS n FORMULA_0006 5 0.0 10000.0000 /end AXIS_DESCR /end CHARACTERISTIC
/begin CHARACTERISTIC KL_WF_MKS_BEGR_NEG_WICHT "Wichtungsfaktor f. neg. WF-MKS-Begrenzung | EN: Weighting factor for negative wall-film fuel-mass limit" CURVE 0x78F0A TKL_SW_VV_UW 100.0 FORMULA_0075 0.0 4.0000
 /begin AXIS_DESCR STD_AXIS tsgrw FORMULA_0023 7 -50.0000 170.0000 FORMAT "%4.1" /end AXIS_DESCR
 FORMAT "%6.3" /end CHARACTERISTIC
/begin CHARACTERISTIC KL_WF_MKS_F_TSGRW "Temp.Saugrohrwand-Schwelle f. WF-Verstaerkungsfaktor" CURVE 0x78F28 TKL_SW_VV_UW 100.0 FORMULA_0075 0.0 4.0000
 /begin AXIS_DESCR STD_AXIS tsgrw FORMULA_0023 7 -50.0000 170.0000 FORMAT "%4.1" /end AXIS_DESCR
 FORMAT "%6.3" /end CHARACTERISTIC
/begin CHARACTERISTIC KF_WF_OELV_ETA "Kraftstoffeintrag ins Oel u. Nachstartverhalten" MAP 0x78F46 TKF_SW_SW_UW 100.0 FORMULA_0295 0.0 1.0000
 /begin AXIS_DESCR STD_AXIS tsgrw FORMULA_0023 7 -50.0000 170.0000 FORMAT "%4.1" /end AXIS_DESCR
 /begin AXIS_DESCR STD_AXIS time_ml FORMULA_0021 6 0.0 327.0000 FORMAT "%5.2" /end AXIS_DESCR
 FORMAT "%7.4" /end CHARACTERISTIC
/begin CHARACTERISTIC KF_WF_ASP_POS "Anzahl ASP f. WF-Aufbau | EN: Number of working cycles for wall-film build-up" MAP 0x78FB6 TKF_SW_SW_UW 100.0 FORMULA_1232 0.0 1279.0000
 /begin AXIS_DESCR STD_AXIS tsgrw FORMULA_0023 6 -50.0000 170.0000 FORMAT "%4.1" /end AXIS_DESCR
 /begin AXIS_DESCR STD_AXIS n FORMULA_0006 5 0.0 10000.0000 /end AXIS_DESCR
/end CHARACTERISTIC
/begin CHARACTERISTIC KF_WF_ASP_NEG "Anzahl ASP f. WF-Abbau | EN: Number of working cycles for wall-film decay" MAP 0x7900A TKF_SW_SW_UW 100.0 FORMULA_1232 0.0 1279.0000
 /begin AXIS_DESCR STD_AXIS tsgrw FORMULA_0023 6 -50.0000 170.0000 FORMAT "%4.1" /end AXIS_DESCR
 /begin AXIS_DESCR STD_AXIS n FORMULA_0006 5 0.0 10000.0000 /end AXIS_DESCR
/end CHARACTERISTIC
/begin CHARACTERISTIC KF_WF_MKS_AKTIV_POS "Aktivschwelle f. pos. WF | EN: Activation threshold for positive wall film" MAP 0x7905E TKF_SW_SW_UW 100.0 FORMULA_0530 0.0 512.0000
 /begin AXIS_DESCR STD_AXIS tsgrw FORMULA_0023 6 -50.0000 170.0000 FORMAT "%4.1" /end AXIS_DESCR
 /begin AXIS_DESCR STD_AXIS n FORMULA_0006 5 0.0 10000.0000 /end AXIS_DESCR
 FORMAT "%5.2" /end CHARACTERISTIC
/begin CHARACTERISTIC KF_WF_MKS_AKTIV_NEG "Aktivschwelle f. neg. WF | EN: Activation threshold for negative wall film" MAP 0x790B2 TKF_SW_SW_UW 100.0 FORMULA_0530 0.0 512.0000
 /begin AXIS_DESCR STD_AXIS tsgrw FORMULA_0023 6 -50.0000 170.0000 FORMAT "%4.1" /end AXIS_DESCR
 /begin AXIS_DESCR STD_AXIS n FORMULA_0006 5 0.0 10000.0000 /end AXIS_DESCR
 FORMAT "%5.2" /end CHARACTERISTIC
/begin CHARACTERISTIC KF_WF_SOLL_F_PUMG "WF-Korrekturfaktor Hoehe/Umgebungsdruck" MAP 0x79106 TKF_SW_SW_UW 100.0 FORMULA_0075 0.0 4.0000
 /begin AXIS_DESCR STD_AXIS tsgrw_m FORMULA_0023 5 -50.0000 170.0000 FORMAT "%4.1" /end AXIS_DESCR
 /begin AXIS_DESCR STD_AXIS pumg FORMULA_0077 5 400.0000 1200.0000 FORMAT "%4.1" /end AXIS_DESCR
 FORMAT "%6.3" /end CHARACTERISTIC
/begin CHARACTERISTIC KF_WF_SOLL_F_VAN "WF-Korrekturfaktor Ventilueberschneidung | EN: Wall-film correction factor, valve overlap" MAP 0x7914E TKF_SW_SW_UW 100.0 FORMULA_0075 0.0 4.0000
 /begin AXIS_DESCR STD_AXIS van_vo_filt FORMULA_0111 8 -80.0000 80.0000 FORMAT "%4.1" /end AXIS_DESCR
 /begin AXIS_DESCR STD_AXIS tsgrw_m FORMULA_0023 8 -50.0000 170.0000 FORMAT "%4.1" /end AXIS_DESCR
 FORMAT "%6.3" /end CHARACTERISTIC
/begin CHARACTERISTIC KF_WF_MKS_START_MAX "max. benoetigte MKS im START | EN: Max. required wall-film fuel mass during start" MAP 0x791F0 TKF_SW_SW_UW 100.0 FORMULA_0530 0.0 2000.0000 /begin AXIS_DESCR STD_AXIS time_ms FORMULA_0600 3 0.0 546.1166 FORMAT "%5.2" /end AXIS_DESCR
 /begin AXIS_DESCR STD_AXIS tsgrw FORMULA_0023 7 -50.0000 170.0000 FORMAT "%4.1" /end AXIS_DESCR
 FORMAT "%5.2" /end CHARACTERISTIC
/begin CHARACTERISTIC KF_WF_PSAU_WICHT "wf_psau-Wichtungskennfeld" MAP 0x79230 TKF_SW_SW_UW 100.0 FORMULA_0075 0.0 4.0000
 /begin AXIS_DESCR STD_AXIS tsgrw FORMULA_0023 7 -50.0000 170.0000 FORMAT "%4.1" /end AXIS_DESCR
 /begin AXIS_DESCR STD_AXIS rf FORMULA_0007 4 0.0 2.0000 FORMAT "%6.3" /end AXIS_DESCR
 FORMAT "%6.3" /end CHARACTERISTIC
/begin CHARACTERISTIC KF_WF_SOLL_GRUND "SOLL-Grundwandfilmmasse | EN: Target base wall-film mass" MAP 0x79280 TKF_SW_SW_UW 100.0 FORMULA_0530 0.0 2000.0000 /begin AXIS_DESCR STD_AXIS psau FORMULA_0077 10 0.0 2000.0000 FORMAT "%4.1" /end AXIS_DESCR
 /begin AXIS_DESCR STD_AXIS tsgrw FORMULA_0023 10 -50.0000 170.0000 FORMAT "%4.1" /end AXIS_DESCR
 FORMAT "%5.2" /end CHARACTERISTIC
/begin CHARACTERISTIC KF_WF_SOLL_GRUND_DR_REL "SOLL-Grundwandfilmmasse - DR_REL" MAP 0x79372 TKF_SW_SW_UW 100.0 FORMULA_0530 0.0 2000.0000 /begin AXIS_DESCR STD_AXIS dr_rel FORMULA_0115 10 0.0 199.9938 FORMAT "%5.2" /end AXIS_DESCR
 /begin AXIS_DESCR STD_AXIS tsgrw FORMULA_0023 10 -50.0000 170.0000 FORMAT "%4.1" /end AXIS_DESCR
 FORMAT "%5.2" /end CHARACTERISTIC
/begin CHARACTERISTIC KF_WF_MKS_F_N_DR_REL "N/RF-Schwelle f. WF-Verstaerkungsfaktor" MAP 0x79464 TKF_SW_SW_UW 100.0 FORMULA_0075 0.0 4.0000 /begin AXIS_DESCR STD_AXIS n FORMULA_0006 6 0.0 10000.0000 /end AXIS_DESCR /begin AXIS_DESCR STD_AXIS dr_rel FORMULA_0115 5 0.0 199.9938 FORMAT "%5.2" /end AXIS_DESCR FORMAT "%6.3" /end CHARACTERISTIC
/begin CHARACTERISTIC KF_WF_MKS_BEGR_POS "max. WF-MKS | EN: Maximum wall-film fuel mass" MAP 0x794B8 TKF_SW_SW_UW 100.0 FORMULA_0075 0.0 4.0000
 /begin AXIS_DESCR STD_AXIS tsgrw FORMULA_0023 7 -50.0000 170.0000 FORMAT "%4.1" /end AXIS_DESCR
 /begin AXIS_DESCR STD_AXIS ti_nw_asp_cnt FORMULA_0010 4 0.0 32767.0000 /end AXIS_DESCR
 FORMAT "%6.3" /end CHARACTERISTIC
/begin CHARACTERISTIC KF_WF_MKS_BEGR_NEG "min. WF-MKS | EN: Minimum wall-film fuel mass" MAP 0x79508 TKF_SW_SW_UW 100.0 FORMULA_0075 0.0 4.0000
 /begin AXIS_DESCR STD_AXIS tsgrw FORMULA_0023 7 -50.0000 170.0000 FORMAT "%4.1" /end AXIS_DESCR
 /begin AXIS_DESCR STD_AXIS ti_nw_asp_cnt FORMULA_0010 4 0.0 32767.0000 /end AXIS_DESCR
 FORMAT "%6.3" /end CHARACTERISTIC
/begin MEASUREMENT wf_bank "BANK" UWORD FORMULA_0010 0 0 0.0 65535.0000 ECU_ADDRESS 0x3FD6A0 /end MEASUREMENT
/begin MEASUREMENT wf_b1.soll_grund "Grundwandfilmmasse" UWORD FORMULA_0530 0 0 0.0 2000.0000 ECU_ADDRESS 0x3FD6A2 /end MEASUREMENT
/begin MEASUREMENT wf_b2.soll_grund "Grundwandfilmmasse" UWORD FORMULA_0530 0 0 0.0 2000.0000 ECU_ADDRESS 0x3FD6AE /end MEASUREMENT
/begin MEASUREMENT wf_b1.soll "SOLL-Wandfilmmasse" UWORD FORMULA_0530 0 0 0.0 2000.0000 ECU_ADDRESS 0x3FD6A4 /end MEASUREMENT
/begin MEASUREMENT wf_b2.soll "SOLL-Wandfilmmasse" UWORD FORMULA_0530 0 0 0.0 2000.0000 ECU_ADDRESS 0x3FD6B0 /end MEASUREMENT
/begin MEASUREMENT wf_b1.soll_f_ti "WF-Korrekturfaktor TI-Ende" UWORD FORMULA_0075 0 0 0.0 4.0000 ECU_ADDRESS 0x3FD6A6 /end MEASUREMENT
/begin MEASUREMENT wf_b2.soll_f_ti "WF-Korrekturfaktor TI-Ende" UWORD FORMULA_0075 0 0 0.0 4.0000 ECU_ADDRESS 0x3FD6B2 /end MEASUREMENT
/begin MEASUREMENT wf_b1.soll_f_van "WF-Korrekturfaktor Ventilueberschneidung" UWORD FORMULA_0075 0 0 0.0 4.0000 ECU_ADDRESS 0x3FD6A8 /end MEASUREMENT
/begin MEASUREMENT wf_b2.soll_f_van "WF-Korrekturfaktor Ventilueberschneidung" UWORD FORMULA_0075 0 0 0.0 4.0000 ECU_ADDRESS 0x3FD6B4 /end MEASUREMENT
/begin MEASUREMENT wf_b1.soll_f_lam "WF-Korrekturfaktor Lambda" UWORD FORMULA_0075 0 0 0.0 4.0000 ECU_ADDRESS 0x3FD6AA /end MEASUREMENT
/begin MEASUREMENT wf_b2.soll_f_lam "WF-Korrekturfaktor Lambda" UWORD FORMULA_0075 0 0 0.0 4.0000 ECU_ADDRESS 0x3FD6B6 /end MEASUREMENT
/begin MEASUREMENT wf_start_st "Status-simultan/sequentieller WF-START" UWORD FORMULA_0083 0 0 0.0 65535.0000 ECU_ADDRESS 0x3FD6BA /end MEASUREMENT
/begin MEASUREMENT wf_mks_st "WF-Aktiv-Status" UWORD FORMULA_0083 0 0 0.0 65535.0000 ECU_ADDRESS 0x3FD6BC /end MEASUREMENT
/begin MEASUREMENT wf_dmks_t1 "wf_dmks_t1_ms/dt" UWORD FORMULA_0755 0 0 0.0 255.9960 ECU_ADDRESS 0x3FD6BE /end MEASUREMENT
/begin MEASUREMENT wf_mks_tau "Filterkonstante" UWORD FORMULA_0763 0 0 0.0 7.9998 ECU_ADDRESS 0x3FD6C0 /end MEASUREMENT
/begin MEASUREMENT wf_ist_start_zyl1 "Wandfilmrueckstand vor START" UWORD FORMULA_0530 0 0 0.0 2000.0000 ECU_ADDRESS 0x3FD6C2 /end MEASUREMENT
/begin MEASUREMENT wf_ist_start_zyl2 "Wandfilmrueckstand vor START" UWORD FORMULA_0530 0 0 0.0 2000.0000 ECU_ADDRESS 0x3FD6C4 /end MEASUREMENT
/begin MEASUREMENT wf_ist_start_zyl3 "Wandfilmrueckstand vor START" UWORD FORMULA_0530 0 0 0.0 2000.0000 ECU_ADDRESS 0x3FD6C6 /end MEASUREMENT
/begin MEASUREMENT wf_ist_start_zyl4 "Wandfilmrueckstand vor START" UWORD FORMULA_0530 0 0 0.0 2000.0000 ECU_ADDRESS 0x3FD6C8 /end MEASUREMENT
/begin MEASUREMENT wf_ist_start_zyl5 "Wandfilmrueckstand vor START" UWORD FORMULA_0530 0 0 0.0 2000.0000 ECU_ADDRESS 0x3FD6CA /end MEASUREMENT
/begin MEASUREMENT wf_ist_start_zyl6 "Wandfilmrueckstand vor START" UWORD FORMULA_0530 0 0 0.0 2000.0000 ECU_ADDRESS 0x3FD6CC /end MEASUREMENT
/begin MEASUREMENT wf_ist_start_zyl7 "Wandfilmrueckstand vor START" UWORD FORMULA_0530 0 0 0.0 2000.0000 ECU_ADDRESS 0x3FD6CE /end MEASUREMENT
/begin MEASUREMENT wf_ist_start_zyl8 "Wandfilmrueckstand vor START" UWORD FORMULA_0530 0 0 0.0 2000.0000 ECU_ADDRESS 0x3FD6D0 /end MEASUREMENT
/begin MEASUREMENT wf_ist_start_zyl9 "Wandfilmrueckstand vor START" UWORD FORMULA_0530 0 0 0.0 2000.0000 ECU_ADDRESS 0x3FD6D2 /end MEASUREMENT
/begin MEASUREMENT wf_ist_start_zyl10 "Wandfilmrueckstand vor START" UWORD FORMULA_0530 0 0 0.0 2000.0000 ECU_ADDRESS 0x3FD6D4 /end MEASUREMENT
/begin MEASUREMENT wf_ist_start_eta_zyl1 "eta-korr. Wandfilmrueckstand vor START" UWORD FORMULA_0530 0 0 0.0 2000.0000 ECU_ADDRESS 0x3FD6D6 /end MEASUREMENT
/begin MEASUREMENT wf_ist_start_eta_zyl2 "eta-korr. Wandfilmrueckstand vor START" UWORD FORMULA_0530 0 0 0.0 2000.0000 ECU_ADDRESS 0x3FD6D8 /end MEASUREMENT
/begin MEASUREMENT wf_ist_start_eta_zyl3 "eta-korr. Wandfilmrueckstand vor START" UWORD FORMULA_0530 0 0 0.0 2000.0000 ECU_ADDRESS 0x3FD6DA /end MEASUREMENT
/begin MEASUREMENT wf_ist_start_eta_zyl4 "eta-korr. Wandfilmrueckstand vor START" UWORD FORMULA_0530 0 0 0.0 2000.0000 ECU_ADDRESS 0x3FD6DC /end MEASUREMENT
/begin MEASUREMENT wf_ist_start_eta_zyl5 "eta-korr. Wandfilmrueckstand vor START" UWORD FORMULA_0530 0 0 0.0 2000.0000 ECU_ADDRESS 0x3FD6DE /end MEASUREMENT
/begin MEASUREMENT wf_ist_start_eta_zyl6 "eta-korr. Wandfilmrueckstand vor START" UWORD FORMULA_0530 0 0 0.0 2000.0000 ECU_ADDRESS 0x3FD6E0 /end MEASUREMENT
/begin MEASUREMENT wf_ist_start_eta_zyl7 "eta-korr. Wandfilmrueckstand vor START" UWORD FORMULA_0530 0 0 0.0 2000.0000 ECU_ADDRESS 0x3FD6E2 /end MEASUREMENT
/begin MEASUREMENT wf_ist_start_eta_zyl8 "eta-korr. Wandfilmrueckstand vor START" UWORD FORMULA_0530 0 0 0.0 2000.0000 ECU_ADDRESS 0x3FD6E4 /end MEASUREMENT
/begin MEASUREMENT wf_ist_start_eta_zyl9 "eta-korr. Wandfilmrueckstand vor START" UWORD FORMULA_0530 0 0 0.0 2000.0000 ECU_ADDRESS 0x3FD6E6 /end MEASUREMENT
/begin MEASUREMENT wf_ist_start_eta_zyl10 "eta-korr. Wandfilmrueckstand vor START" UWORD FORMULA_0530 0 0 0.0 2000.0000 ECU_ADDRESS 0x3FD6E8 /end MEASUREMENT
/begin MEASUREMENT wf_mks_start_zyl1 "Kraftstoffmasse im START" UWORD FORMULA_0530 0 0 0.0 2000.0000 ECU_ADDRESS 0x3FD6EA /end MEASUREMENT
/begin MEASUREMENT wf_mks_start_zyl2 "Kraftstoffmasse im START" UWORD FORMULA_0530 0 0 0.0 2000.0000 ECU_ADDRESS 0x3FD6EC /end MEASUREMENT
/begin MEASUREMENT wf_mks_start_zyl3 "Kraftstoffmasse im START" UWORD FORMULA_0530 0 0 0.0 2000.0000 ECU_ADDRESS 0x3FD6EE /end MEASUREMENT
/begin MEASUREMENT wf_mks_start_zyl4 "Kraftstoffmasse im START" UWORD FORMULA_0530 0 0 0.0 2000.0000 ECU_ADDRESS 0x3FD6F0 /end MEASUREMENT
/begin MEASUREMENT wf_mks_start_zyl5 "Kraftstoffmasse im START" UWORD FORMULA_0530 0 0 0.0 2000.0000 ECU_ADDRESS 0x3FD6F2 /end MEASUREMENT
/begin MEASUREMENT wf_mks_start_zyl6 "Kraftstoffmasse im START" UWORD FORMULA_0530 0 0 0.0 2000.0000 ECU_ADDRESS 0x3FD6F4 /end MEASUREMENT
/begin MEASUREMENT wf_mks_start_zyl7 "Kraftstoffmasse im START" UWORD FORMULA_0530 0 0 0.0 2000.0000 ECU_ADDRESS 0x3FD6F6 /end MEASUREMENT
/begin MEASUREMENT wf_mks_start_zyl8 "Kraftstoffmasse im START" UWORD FORMULA_0530 0 0 0.0 2000.0000 ECU_ADDRESS 0x3FD6F8 /end MEASUREMENT
/begin MEASUREMENT wf_mks_start_zyl9 "Kraftstoffmasse im START" UWORD FORMULA_0530 0 0 0.0 2000.0000 ECU_ADDRESS 0x3FD6FA /end MEASUREMENT
/begin MEASUREMENT wf_mks_start_zyl10 "Kraftstoffmasse im START" UWORD FORMULA_0530 0 0 0.0 2000.0000 ECU_ADDRESS 0x3FD6FC /end MEASUREMENT
/begin MEASUREMENT wf_mks_dif_zyl1 "Dif. aus SOLL-IST-WF" SWORD FORMULA_0530 0 0 -1024.0000 1023.0000 ECU_ADDRESS 0x3FD6FE /end MEASUREMENT
/begin MEASUREMENT wf_mks_dif_zyl2 "Dif. aus SOLL-IST-WF" SWORD FORMULA_0530 0 0 -1024.0000 1023.0000 ECU_ADDRESS 0x3FD700 /end MEASUREMENT
/begin MEASUREMENT wf_mks_dif_zyl3 "Dif. aus SOLL-IST-WF" SWORD FORMULA_0530 0 0 -1024.0000 1023.0000 ECU_ADDRESS 0x3FD702 /end MEASUREMENT
/begin MEASUREMENT wf_mks_dif_zyl4 "Dif. aus SOLL-IST-WF" SWORD FORMULA_0530 0 0 -1024.0000 1023.0000 ECU_ADDRESS 0x3FD704 /end MEASUREMENT
/begin MEASUREMENT wf_mks_dif_zyl5 "Dif. aus SOLL-IST-WF" SWORD FORMULA_0530 0 0 -1024.0000 1023.0000 ECU_ADDRESS 0x3FD706 /end MEASUREMENT
/begin MEASUREMENT wf_mks_dif_zyl6 "Dif. aus SOLL-IST-WF" SWORD FORMULA_0530 0 0 -1024.0000 1023.0000 ECU_ADDRESS 0x3FD708 /end MEASUREMENT
/begin MEASUREMENT wf_mks_dif_zyl7 "Dif. aus SOLL-IST-WF" SWORD FORMULA_0530 0 0 -1024.0000 1023.0000 ECU_ADDRESS 0x3FD70A /end MEASUREMENT
/begin MEASUREMENT wf_mks_dif_zyl8 "Dif. aus SOLL-IST-WF" SWORD FORMULA_0530 0 0 -1024.0000 1023.0000 ECU_ADDRESS 0x3FD70C /end MEASUREMENT
/begin MEASUREMENT wf_mks_dif_zyl9 "Dif. aus SOLL-IST-WF" SWORD FORMULA_0530 0 0 -1024.0000 1023.0000 ECU_ADDRESS 0x3FD70E /end MEASUREMENT
/begin MEASUREMENT wf_mks_dif_zyl10 "Dif. aus SOLL-IST-WF" SWORD FORMULA_0530 0 0 -1024.0000 1023.0000 ECU_ADDRESS 0x3FD710 /end MEASUREMENT
/begin MEASUREMENT wf_mks_roh_zyl1 "benoetigte MKS aus WF" SWORD FORMULA_0530 0 0 -1024.0000 1023.0000 ECU_ADDRESS 0x3FD712 /end MEASUREMENT
/begin MEASUREMENT wf_mks_roh_zyl2 "benoetigte MKS aus WF" SWORD FORMULA_0530 0 0 -1024.0000 1023.0000 ECU_ADDRESS 0x3FD714 /end MEASUREMENT
/begin MEASUREMENT wf_mks_roh_zyl3 "benoetigte MKS aus WF" SWORD FORMULA_0530 0 0 -1024.0000 1023.0000 ECU_ADDRESS 0x3FD716 /end MEASUREMENT
/begin MEASUREMENT wf_mks_roh_zyl4 "benoetigte MKS aus WF" SWORD FORMULA_0530 0 0 -1024.0000 1023.0000 ECU_ADDRESS 0x3FD718 /end MEASUREMENT
/begin MEASUREMENT wf_mks_roh_zyl5 "benoetigte MKS aus WF" SWORD FORMULA_0530 0 0 -1024.0000 1023.0000 ECU_ADDRESS 0x3FD71A /end MEASUREMENT
/begin MEASUREMENT wf_mks_roh_zyl6 "benoetigte MKS aus WF" SWORD FORMULA_0530 0 0 -1024.0000 1023.0000 ECU_ADDRESS 0x3FD71C /end MEASUREMENT
/begin MEASUREMENT wf_mks_roh_zyl7 "benoetigte MKS aus WF" SWORD FORMULA_0530 0 0 -1024.0000 1023.0000 ECU_ADDRESS 0x3FD71E /end MEASUREMENT
/begin MEASUREMENT wf_mks_roh_zyl8 "benoetigte MKS aus WF" SWORD FORMULA_0530 0 0 -1024.0000 1023.0000 ECU_ADDRESS 0x3FD720 /end MEASUREMENT
/begin MEASUREMENT wf_mks_roh_zyl9 "benoetigte MKS aus WF" SWORD FORMULA_0530 0 0 -1024.0000 1023.0000 ECU_ADDRESS 0x3FD722 /end MEASUREMENT
/begin MEASUREMENT wf_mks_roh_zyl10 "benoetigte MKS aus WF" SWORD FORMULA_0530 0 0 -1024.0000 1023.0000 ECU_ADDRESS 0x3FD724 /end MEASUREMENT
/begin MEASUREMENT wf_mks_zyl_offs "OFFSET auf wf_mks_begr" UWORD FORMULA_0530 0 0 0.0 2000.0000 ECU_ADDRESS 0x3FD726 /end MEASUREMENT
/begin MEASUREMENT wf_mks_begr_zyl1 "begr. wf_mks_roh" SWORD FORMULA_0530 0 0 -1024.0000 1023.0000 ECU_ADDRESS 0x3FD728 /end MEASUREMENT
/begin MEASUREMENT wf_mks_begr_zyl2 "begr. wf_mks_roh" SWORD FORMULA_0530 0 0 -1024.0000 1023.0000 ECU_ADDRESS 0x3FD72A /end MEASUREMENT
/begin MEASUREMENT wf_mks_begr_zyl3 "begr. wf_mks_roh" SWORD FORMULA_0530 0 0 -1024.0000 1023.0000 ECU_ADDRESS 0x3FD72C /end MEASUREMENT
/begin MEASUREMENT wf_mks_begr_zyl4 "begr. wf_mks_roh" SWORD FORMULA_0530 0 0 -1024.0000 1023.0000 ECU_ADDRESS 0x3FD72E /end MEASUREMENT
/begin MEASUREMENT wf_mks_begr_zyl5 "begr. wf_mks_roh" SWORD FORMULA_0530 0 0 -1024.0000 1023.0000 ECU_ADDRESS 0x3FD730 /end MEASUREMENT
/begin MEASUREMENT wf_mks_begr_zyl6 "begr. wf_mks_roh" SWORD FORMULA_0530 0 0 -1024.0000 1023.0000 ECU_ADDRESS 0x3FD732 /end MEASUREMENT
/begin MEASUREMENT wf_mks_begr_zyl7 "begr. wf_mks_roh" SWORD FORMULA_0530 0 0 -1024.0000 1023.0000 ECU_ADDRESS 0x3FD734 /end MEASUREMENT
/begin MEASUREMENT wf_mks_begr_zyl8 "begr. wf_mks_roh" SWORD FORMULA_0530 0 0 -1024.0000 1023.0000 ECU_ADDRESS 0x3FD736 /end MEASUREMENT
/begin MEASUREMENT wf_mks_begr_zyl9 "begr. wf_mks_roh" SWORD FORMULA_0530 0 0 -1024.0000 1023.0000 ECU_ADDRESS 0x3FD738 /end MEASUREMENT
/begin MEASUREMENT wf_mks_begr_zyl10 "begr. wf_mks_roh" SWORD FORMULA_0530 0 0 -1024.0000 1023.0000 ECU_ADDRESS 0x3FD73A /end MEASUREMENT
/begin MEASUREMENT wf_mks_zyl1 "MKS aus Wandfilmmodell" SWORD FORMULA_0752 0 0 -512.0000 511.0000 ECU_ADDRESS 0x3FD73C /end MEASUREMENT
/begin MEASUREMENT wf_mks_zyl2 "MKS aus Wandfilmmodell" SWORD FORMULA_0752 0 0 -512.0000 511.0000 ECU_ADDRESS 0x3FD73E /end MEASUREMENT
/begin MEASUREMENT wf_mks_zyl3 "MKS aus Wandfilmmodell" SWORD FORMULA_0752 0 0 -512.0000 511.0000 ECU_ADDRESS 0x3FD740 /end MEASUREMENT
/begin MEASUREMENT wf_mks_zyl4 "MKS aus Wandfilmmodell" SWORD FORMULA_0752 0 0 -512.0000 511.0000 ECU_ADDRESS 0x3FD742 /end MEASUREMENT
/begin MEASUREMENT wf_mks_zyl5 "MKS aus Wandfilmmodell" SWORD FORMULA_0752 0 0 -512.0000 511.0000 ECU_ADDRESS 0x3FD744 /end MEASUREMENT
/begin MEASUREMENT wf_mks_zyl6 "MKS aus Wandfilmmodell" SWORD FORMULA_0752 0 0 -512.0000 511.0000 ECU_ADDRESS 0x3FD746 /end MEASUREMENT
/begin MEASUREMENT wf_mks_zyl7 "MKS aus Wandfilmmodell" SWORD FORMULA_0752 0 0 -512.0000 511.0000 ECU_ADDRESS 0x3FD748 /end MEASUREMENT
/begin MEASUREMENT wf_mks_zyl8 "MKS aus Wandfilmmodell" SWORD FORMULA_0752 0 0 -512.0000 511.0000 ECU_ADDRESS 0x3FD74A /end MEASUREMENT
/begin MEASUREMENT wf_mks_zyl9 "MKS aus Wandfilmmodell" SWORD FORMULA_0752 0 0 -512.0000 511.0000 ECU_ADDRESS 0x3FD74C /end MEASUREMENT
/begin MEASUREMENT wf_mks_zyl10 "MKS aus Wandfilmmodell" SWORD FORMULA_0752 0 0 -512.0000 511.0000 ECU_ADDRESS 0x3FD74E /end MEASUREMENT
/begin MEASUREMENT wf_start_seq_cnt "Segmentcounter f. sequentiellen WF-START" UWORD FORMULA_1231 0 0 0.0 12.0000 ECU_ADDRESS 0x3FD750 /end MEASUREMENT
/begin MEASUREMENT wf_asp_cnt "ASP-Counter f. WF-Auf-/Abbau" UWORD FORMULA_1232 0 0 0.0 1279.0000 ECU_ADDRESS 0x3FD752 /end MEASUREMENT
/begin MEASUREMENT wf_ist_eta_zyl1 "eta-korr. Wandfilmistmenge" UWORD FORMULA_0530 0 0 0.0 2000.0000 ECU_ADDRESS 0x3FD754 /end MEASUREMENT
/begin MEASUREMENT wf_ist_eta_zyl2 "eta-korr. Wandfilmistmenge" UWORD FORMULA_0530 0 0 0.0 2000.0000 ECU_ADDRESS 0x3FD756 /end MEASUREMENT
/begin MEASUREMENT wf_ist_eta_zyl3 "eta-korr. Wandfilmistmenge" UWORD FORMULA_0530 0 0 0.0 2000.0000 ECU_ADDRESS 0x3FD758 /end MEASUREMENT
/begin MEASUREMENT wf_ist_eta_zyl4 "eta-korr. Wandfilmistmenge" UWORD FORMULA_0530 0 0 0.0 2000.0000 ECU_ADDRESS 0x3FD75A /end MEASUREMENT
/begin MEASUREMENT wf_ist_eta_zyl5 "eta-korr. Wandfilmistmenge" UWORD FORMULA_0530 0 0 0.0 2000.0000 ECU_ADDRESS 0x3FD75C /end MEASUREMENT
/begin MEASUREMENT wf_ist_eta_zyl6 "eta-korr. Wandfilmistmenge" UWORD FORMULA_0530 0 0 0.0 2000.0000 ECU_ADDRESS 0x3FD75E /end MEASUREMENT
/begin MEASUREMENT wf_ist_eta_zyl7 "eta-korr. Wandfilmistmenge" UWORD FORMULA_0530 0 0 0.0 2000.0000 ECU_ADDRESS 0x3FD760 /end MEASUREMENT
/begin MEASUREMENT wf_ist_eta_zyl8 "eta-korr. Wandfilmistmenge" UWORD FORMULA_0530 0 0 0.0 2000.0000 ECU_ADDRESS 0x3FD762 /end MEASUREMENT
/begin MEASUREMENT wf_ist_eta_zyl9 "eta-korr. Wandfilmistmenge" UWORD FORMULA_0530 0 0 0.0 2000.0000 ECU_ADDRESS 0x3FD764 /end MEASUREMENT
/begin MEASUREMENT wf_ist_eta_zyl10 "eta-korr. Wandfilmistmenge" UWORD FORMULA_0530 0 0 0.0 2000.0000 ECU_ADDRESS 0x3FD766 /end MEASUREMENT
/begin MEASUREMENT wf_oelv_eta_f "Kraftstoffeintrag ins Oel" UWORD FORMULA_0295 0 0 0.0 1.0000 ECU_ADDRESS 0x3FD768 /end MEASUREMENT
/begin MEASUREMENT wf_oelv_zyl1 "Kraftstoffeintrag ins Oel" UWORD FORMULA_0530 0 0 0.0 2000.0000 ECU_ADDRESS 0x3FD76A /end MEASUREMENT
/begin MEASUREMENT wf_oelv_zyl2 "Kraftstoffeintrag ins Oel" UWORD FORMULA_0530 0 0 0.0 2000.0000 ECU_ADDRESS 0x3FD76C /end MEASUREMENT
/begin MEASUREMENT wf_oelv_zyl3 "Kraftstoffeintrag ins Oel" UWORD FORMULA_0530 0 0 0.0 2000.0000 ECU_ADDRESS 0x3FD76E /end MEASUREMENT
/begin MEASUREMENT wf_oelv_zyl4 "Kraftstoffeintrag ins Oel" UWORD FORMULA_0530 0 0 0.0 2000.0000 ECU_ADDRESS 0x3FD770 /end MEASUREMENT
/begin MEASUREMENT wf_oelv_zyl5 "Kraftstoffeintrag ins Oel" UWORD FORMULA_0530 0 0 0.0 2000.0000 ECU_ADDRESS 0x3FD772 /end MEASUREMENT
/begin MEASUREMENT wf_oelv_zyl6 "Kraftstoffeintrag ins Oel" UWORD FORMULA_0530 0 0 0.0 2000.0000 ECU_ADDRESS 0x3FD774 /end MEASUREMENT
/begin MEASUREMENT wf_oelv_zyl7 "Kraftstoffeintrag ins Oel" UWORD FORMULA_0530 0 0 0.0 2000.0000 ECU_ADDRESS 0x3FD776 /end MEASUREMENT
/begin MEASUREMENT wf_oelv_zyl8 "Kraftstoffeintrag ins Oel" UWORD FORMULA_0530 0 0 0.0 2000.0000 ECU_ADDRESS 0x3FD778 /end MEASUREMENT
/begin MEASUREMENT wf_oelv_zyl9 "Kraftstoffeintrag ins Oel" UWORD FORMULA_0530 0 0 0.0 2000.0000 ECU_ADDRESS 0x3FD77A /end MEASUREMENT
/begin MEASUREMENT wf_oelv_zyl10 "Kraftstoffeintrag ins Oel" UWORD FORMULA_0530 0 0 0.0 2000.0000 ECU_ADDRESS 0x3FD77C /end MEASUREMENT
/begin MEASUREMENT wf_lam_soll_offs_b1 "OFFSET-lam_soll abhaengig vom wf" SWORD FORMULA_0025 0 0 -2.0000 1.9999 ECU_ADDRESS 0x3FD77E /end MEASUREMENT
/begin MEASUREMENT wf_lam_soll_offs_b2 "OFFSET-lam_soll abhaengig vom wf" SWORD FORMULA_0025 0 0 -2.0000 1.9999 ECU_ADDRESS 0x3FD780 /end MEASUREMENT
/begin MEASUREMENT wf_psau_b1 "Saugrohrdruck fuer WF" SWORD FORMULA_0077 0 0 0.0 2000.0000 ECU_ADDRESS 0x3FD782 /end MEASUREMENT
/begin MEASUREMENT wf_psau_b2 "Saugrohrdruck fuer WF" SWORD FORMULA_0077 0 0 0.0 2000.0000 ECU_ADDRESS 0x3FD784 /end MEASUREMENT
/begin MEASUREMENT wf_md_rf_soll "gefilterte rf_md_soll fuer WF" SWORD FORMULA_0007 0 0 0.0 2.0000 ECU_ADDRESS 0x3FD786 /end MEASUREMENT
/begin MEASUREMENT wf_md_rf_tau "Filtertaukonstante" UBYTE FORMULA_1233 0 0 0.0040 0.9960 ECU_ADDRESS 0x3FD788 /end MEASUREMENT
/begin MEASUREMENT wf_mks_f_trig "wf_mks-Triggerfaktor" SWORD FORMULA_0075 0 0 -32.0000 31.9990 ECU_ADDRESS 0x3FD78A /end MEASUREMENT
/begin MEASUREMENT wf_mks_begr_pos_b1 "max. Schwelle fuer Wandfilmbegrenzung" SWORD FORMULA_0530 0 0 -1024.0000 1023.0000 ECU_ADDRESS 0x3FD78C /end MEASUREMENT
/begin MEASUREMENT wf_mks_begr_pos_b2 "max. Schwelle fuer Wandfilmbegrenzung" SWORD FORMULA_0530 0 0 -1024.0000 1023.0000 ECU_ADDRESS 0x3FD78E /end MEASUREMENT
/begin MEASUREMENT wf_mks_begr_neg_b1 "min. Schwelle fuer Wandfilmbegrenzung" SWORD FORMULA_0530 0 0 -1024.0000 1023.0000 ECU_ADDRESS 0x3FD790 /end MEASUREMENT
/begin MEASUREMENT wf_mks_begr_neg_b2 "min. Schwelle fuer Wandfilmbegrenzung" SWORD FORMULA_0530 0 0 -1024.0000 1023.0000 ECU_ADDRESS 0x3FD792 /end MEASUREMENT
/begin MEASUREMENT wf_mks_f_roh_b1 "Verstaerkungsfaktor ueber wf_mks_f_trig" UWORD FORMULA_0075 0 0 0.0 4.0000 ECU_ADDRESS 0x3FD794 /end MEASUREMENT
/begin MEASUREMENT wf_mks_f_roh_b2 "Verstaerkungsfaktor ueber wf_mks_f_trig" UWORD FORMULA_0075 0 0 0.0 4.0000 ECU_ADDRESS 0x3FD796 /end MEASUREMENT
/begin MEASUREMENT wf_mks_f_b1 "WF-MKS-Verstaerkungsfaktor" UWORD FORMULA_0075 0 0 0.0 4.0000 ECU_ADDRESS 0x3FD798 /end MEASUREMENT
/begin MEASUREMENT wf_mks_f_b2 "WF-MKS-Verstaerkungsfaktor" UWORD FORMULA_0075 0 0 0.0 4.0000 ECU_ADDRESS 0x3FD79A /end MEASUREMENT
/begin MEASUREMENT wf_zyl_aktiv_st "WF-Ausgabe-Status" UWORD FORMULA_0010 0 0 0.0 65535.0000 ECU_ADDRESS 0x3FD79C /end MEASUREMENT
/begin MEASUREMENT wf_mks_start_max "max. benoetigte MKS im START" UWORD FORMULA_0530 0 0 0.0 2000.0000 ECU_ADDRESS 0x3FD79E /end MEASUREMENT
/begin MEASUREMENT wf_soll_f_pumg "WF-Korrekturfaktor Hoehe/Umgebungsdruck" UWORD FORMULA_0075 0 0 0.0 4.0000 ECU_ADDRESS 0x3FD7A0 /end MEASUREMENT
/* ------------------ Abschnitt erzeugt aus zust_inj.dat ------------------ */
/begin CHARACTERISTIC K_ZUST_POWER "Konfiguration Powertaster | EN: 0x0 Inaktiv 0x1 Aktiv 0x2 Ist-Md Konfiguration Powertaster" VALUE 0x79558 TKW_VV_VV_UB 100.0 FORMULA_1239 0.0 255.0 /end CHARACTERISTIC
/begin CHARACTERISTIC K_ZUST_N_PS_LL "Drehzahlschwelle f. Uebergang PRESYNC --> LL | EN: Drehzahlschwelle f. Ueber gang PRESYNC --> LL" VALUE 0x7955A TKW_VV_VV_SW 100.0 FORMULA_0006 0.0 3000.0000 /end CHARACTERISTIC
/begin CHARACTERISTIC K_ZUST_MD_LL_TL "Momentenschwelle f. Uebergang LL --> TL | EN: Momentenschwelle f. Uebergang LL --> TL" VALUE 0x7955C TKW_VV_VV_SW 100.0 FORMULA_0001 0.0 100.0000 FORMAT "%4.1" /end CHARACTERISTIC
/begin CHARACTERISTIC K_ZUST_MD_HYST_LL_TL "MD Hysterese f. Uebergang TL --> LL | EN: MD Hysterese f. Uebergang TL --> LL" VALUE 0x7955E TKW_VV_VV_SW 100.0 FORMULA_0001 0.0 100.0000 FORMAT "%4.1" /end CHARACTERISTIC
/begin CHARACTERISTIC K_ZUST_MD_HYST_TL_VL "MD Hysterese f. Uebergang TL --> VL | EN: MD Hysterese f. Uebergang TL --> VL | [Code V452] Hysteresis for the part-load/full-load state switch (2 %)." VALUE 0x79560 TKW_VV_VV_SW 100.0 FORMULA_0001 0.0 100.0000 FORMAT "%4.1" /end CHARACTERISTIC
/begin CHARACTERISTIC K_ZUST_T_NL "Nachlaufzeit | EN: Nachlaufzeit" VALUE 0x79562 TKW_VV_VV_UW 100.0 FORMULA_0021 0.0 655.3500 FORMAT "%5.2" /end CHARACTERISTIC
/begin CHARACTERISTIC K_ZUST_NL_TIMOUT_INJ "Timeoutueberwachung fuer INJ | EN: Timeoutueberwachung fuer INJ" VALUE 0x79564 TKW_VV_VV_UW 100.0 FORMULA_1240 0.0 40000.0000 FORMAT "%5.2" /end CHARACTERISTIC
/begin CHARACTERISTIC KL_ZUST_N_ST_LL "Drehzahlschwelle fuer Start Exit" CURVE 0x79566 TKL_SW_VV_SW 100.0 FORMULA_0006 0.0 10000.0000
 /begin AXIS_DESCR STD_AXIS tmot FORMULA_0023 3 -50.0000 170.0000 FORMAT "%4.1" /end AXIS_DESCR
/end CHARACTERISTIC
/begin CHARACTERISTIC KL_ZUST_MD_TL_VL "md_rel fuer Uebergang TL -> VL | EN: Relative torque for transition part load to full load | [Code V452] Torque-demand threshold for the part-load -> full-load state (zust_md_rel_tl_vl, also sent to IGN). Ignition blends from KF_TZ_GRUND to KF_TZ_VL between this value (90 %) and 100 % md_wunsch_rel (IGN 0x66284)." CURVE 0x79574 TKL_SW_VV_SW 100.0 FORMULA_0001 0.0 100.0000 /begin AXIS_DESCR STD_AXIS n FORMULA_0006 6 0.0 10000.0000 /end AXIS_DESCR FORMAT "%4.1" /end CHARACTERISTIC
/begin MEASUREMENT zust_exd_st "Zustandsstatus fuer externe Ansteuerung Diagnose" UBYTE FORMULA_1238 0 0 0.0 255.0 ECU_ADDRESS 0x3FD7A4 /end MEASUREMENT
/begin FUNCTION Tankleckdiagnose ""
 /begin DEF_CHARACTERISTIC KL_DMTL_FST_ERS_LI KL_DMTL_FST_ERS_RE KL_DMTL_FST_MAX_STAND KL_DMTL_HOEHE_KORR KL_DMTL_I_REF_KORR KL_DMTL_KORR_FAKT KL_DMTL_T_FEIN_MIN KL_DMTL_T_GROB KL_DMTL_T_STABIL K_DMTL_2_STABIL K_DMTL_ABBR_FEIN K_DMTL_ABBR_FEUCHT K_DMTL_ANZ_DECKEL K_DMTL_ANZ_DECKEL_LECK K_DMTL_ANZ_FAHRTEN K_DMTL_AY_MAX K_DMTL_CFG K_DMTL_DI_BETANK K_DMTL_DI_DECKEL K_DMTL_DI_STABIL K_DMTL_DI_TEV_OFFEN K_DMTL_DU_MAX K_DMTL_FAKT_T_DECKEL K_DMTL_FST_DECKEL_MAX K_DMTL_FST_ERSATZ K_DMTL_FST_MAX K_DMTL_FST_MIN K_DMTL_GROB_OHNE_FEIN K_DMTL_I_FAKT_CCDECKEL K_DMTL_I_FAKT_GROB K_DMTL_I_FAKT_P K_DMTL_I_KURZSCHL K_DMTL_I_REF_1_2_DIFF K_DMTL_I_REF_DIFF K_DMTL_I_REF_MAX K_DMTL_I_REF_MIN K_DMTL_P_MIN K_DMTL_START K_DMTL_TEMP_DECKEL_MAX K_DMTL_TEMP_DECKEL_MIN K_DMTL_TEMP_MAX K_DMTL_TEMP_MIN K_DMTL_TEMP_START_MIN K_DMTL_TEMP_VENT_MIN K_DMTL_TP_I K_DMTL_TP_I_BEG K_DMTL_TP_I_ROH K_DMTL_TP_I_TANK K_DMTL_TP_UB K_DMTL_T_ABSTELL K_DMTL_T_AY_DLY K_DMTL_T_CC_DAUER K_DMTL_T_DECKEL_ML_MIN K_DMTL_T_FEUCHT_DLY K_DMTL_T_KURZSCHL K_DMTL_T_MESS_GES K_DMTL_T_ML_MIN K_DMTL_T_REF K_DMTL_T_START_DLY K_DMTL_T_VENT_CHK K_DMTL_T_VENT_UM K_DMTL_UB_MAX K_DMTL_UB_MIN K_DMTL_V_MIN /end DEF_CHARACTERISTIC
 /begin REF_CHARACTERISTIC /end REF_CHARACTERISTIC
 /begin IN_MEASUREMENT /end IN_MEASUREMENT
 /begin OUT_MEASUREMENT B_DMTL_2_STABIL B_DMTL_CLOSE_TEV B_DMTL_EXD_START B_DMTL_H_EIN B_DMTL_KURZSCHLUSS B_DMTL_MOTORLAUFZEIT B_DMTL_RUN B_DMTL_START_DECKEL B_DMTL_START_DECKEL_GROB B_DMTL_START_FEIN B_DMTL_START_GROB B_DMTL_VENTIL_FEHLER dmtl_anz_deckel dmtl_asc_ay dmtl_exd_h_st dmtl_exd_h_timeout dmtl_exd_p_st dmtl_exd_p_timeout dmtl_exd_v_st dmtl_exd_v_timeout dmtl_flags dmtl_flags_start dmtl_fst dmtl_fst_max dmtl_i dmtl_i_deckel dmtl_i_fakt_fein dmtl_i_filt_tank dmtl_i_filt_tank.rest dmtl_i_grob dmtl_i_max dmtl_i_ref2 dmtl_i_ref_korr dmtl_i_roh dmtl_i_stabil dmtl_korr_fakt dmtl_st dmtl_t_cc_dauer dmtl_t_deckel dmtl_t_fein_min dmtl_t_feucht_dly dmtl_t_grob dmtl_t_i_filt_beg dmtl_t_ks dmtl_t_ref dmtl_t_stabil dmtl_t_stabil_max dmtl_t_start_dly dmtl_ub_filt dmtl_ub_ref /end OUT_MEASUREMENT
/end FUNCTION
/begin FUNCTION Testfunktion ""
 /begin DEF_CHARACTERISTIC KF_TEST_XY KL_TEST_X K_TEST K_TEST_LA_BANK1 K_TEST_LA_BANK2 K_TEST_MD_ZYL1 K_TEST_MD_ZYL10 K_TEST_MD_ZYL11 K_TEST_MD_ZYL12 K_TEST_MD_ZYL2 K_TEST_MD_ZYL3 K_TEST_MD_ZYL4 K_TEST_MD_ZYL5 K_TEST_MD_ZYL6 K_TEST_MD_ZYL7 K_TEST_MD_ZYL8 K_TEST_MD_ZYL9 K_TEST_X K_TEST_Y /end DEF_CHARACTERISTIC
 /begin REF_CHARACTERISTIC /end REF_CHARACTERISTIC
 /begin IN_MEASUREMENT /end IN_MEASUREMENT
 /begin OUT_MEASUREMENT test_kf_ip test_kl_ip testvariable /end OUT_MEASUREMENT
/end FUNCTION
/begin FUNCTION Umgebungsdruck ""
 /begin DEF_CHARACTERISTIC KF_PUMG_OBD_P_STAU_KOMP KF_PUMG_OBD_RF_MAX_P400 KF_PUMG_OBD_RF_MAX_P500 K_PUMG_AEBEGR K_PUMG_DIAG_MAX K_PUMG_DIAG_MIN K_PUMG_ERSATZ K_PUMG_MAX_E2 K_PUMG_MAX_NEG_GRAD_E2 K_PUMG_MAX_POS_GRAD_E2 K_PUMG_MIN_E2 K_PUMG_OBD_ABW K_PUMG_OBD_CFG K_PUMG_OBD_FPLAU_ABW_MAX K_PUMG_OBD_FPLAU_ABW_MAX_T K_PUMG_OBD_MIN_MESS K_PUMG_OBD_ML_MS K_PUMG_OBD_MODEL_DELTA_MAX K_PUMG_OBD_N_MAX K_PUMG_OBD_N_MIN K_PUMG_OBD_PUMG_TAU K_PUMG_OBD_PWG_MIN K_PUMG_OBD_TAN_MAX K_PUMG_OBD_TAN_MIN K_PUMG_OBD_TIME_ML_MIN K_PUMG_OBD_TUMG_MIN K_PUMG_OBD_V_MAX K_PUMG_OBD_ZV_DELTA_MAX K_PUMG_RBM_HEILUNG_CFG K_PUMG_SENSOR_OFFSET K_PUMG_SENSOR_STEIGUNG K_PUMG_TAU /end DEF_CHARACTERISTIC
 /begin REF_CHARACTERISTIC /end REF_CHARACTERISTIC
 /begin IN_MEASUREMENT /end IN_MEASUREMENT
 /begin OUT_MEASUREMENT pumg_ad pumg_e2 pumg_obd_filter pumg_obd_fplau_abw_max_t pumg_obd_modell pumg_obd_modell_freigabe pumg_obd_modell_integral pumg_obd_modell_integral_cnt pumg_obd_modell_mw pumg_obd_rf pumg_roh /end OUT_MEASUREMENT
/end FUNCTION
/begin FUNCTION Vanos ""
 /begin DEF_CHARACTERISTIC KF_VAN_I_VORST_A KF_VAN_I_VORST_E KF_VAN_KH_SOLL_A KF_VAN_KH_SOLL_DMAX_A KF_VAN_KH_SOLL_DMAX_E KF_VAN_KH_SOLL_E KF_VAN_SOLL_A KF_VAN_SOLL_BEGR_A KF_VAN_SOLL_DMAX_A KF_VAN_SOLL_DMAX_E KF_VAN_SOLL_E KF_VAN_XD_TAU KL_VAN_DSV_HOLD_TV KL_VAN_DSV_PEAK_TV KL_VAN_FILTR_XD_WICHT KL_VAN_FREQU_ML KL_VAN_KD_A KL_VAN_KD_E KL_VAN_KI_A KL_VAN_KI_E KL_VAN_KP_A KL_VAN_KP_E KL_VAN_REG_FAKT_TMOT KL_VAN_SOLL_BEGR_E KL_VAN_T_DRUCK_E KL_VAN_T_SOLL_BEGR_E KL_VAN_T_START_DLY K_VAN_ANSCHL_DELTA K_VAN_ANSCHL_HYS K_VAN_ANSCHL_I_A1 K_VAN_ANSCHL_I_A2 K_VAN_ANSCHL_I_E1 K_VAN_ANSCHL_I_E2 K_VAN_ANSCHL_I_RAMPE K_VAN_ANSCHL_I_START_MAX K_VAN_ANSCHL_T K_VAN_BEGR_AB_FAKT_E K_VAN_CFG_A1 K_VAN_CFG_A2 K_VAN_CFG_E1 K_VAN_CFG_E2 K_VAN_DRUCK_CNT K_VAN_DRUCK_SOLL_OFFSET_E K_VAN_DRUCK_VERSTELL_E K_VAN_DSV_ABFALL_DLY K_VAN_DSV_CFG K_VAN_DSV_N_AUS K_VAN_DSV_N_EIN K_VAN_DSV_PEAK_TIME K_VAN_D_XD_TAU_Auslass K_VAN_D_XD_TAU_Einlass K_VAN_ERR_CFG K_VAN_EXD_GUETE_TAU K_VAN_EXD_I_MAX_Auslass K_VAN_EXD_I_MAX_Einlass K_VAN_EXD_I_MIN_Auslass K_VAN_EXD_I_MIN_Einlass K_VAN_EXD_N_SOLL K_VAN_EXD_SPR_MAX_MIN_Auslass K_VAN_EXD_SPR_MAX_MIN_Einlass K_VAN_EXD_TMOT_MIN K_VAN_EXD_T_ANSCHL K_VAN_EXD_T_GUETE K_VAN_EXD_VERST_SOLL_MAX_Auslass K_VAN_EXD_VERST_SOLL_MAX_Einlass K_VAN_EXD_VERST_SOLL_MIN_Auslass K_VAN_EXD_VERST_SOLL_MIN_Einlass K_VAN_EXD_VERST_TMAX K_VAN_EXD_VERST_TOL K_VAN_EXD_VERST_TOL_START K_VAN_FILTR_AMPL K_VAN_FILTR_DAUER K_VAN_FILTR_PERIOD K_VAN_FILTR_SOLL_DELTA K_VAN_FILTR_TV_PRUEF K_VAN_FILTR_T_ML_MIN K_VAN_FREQU_ANSCHL K_VAN_FREQU_SPUEL_MIN K_VAN_FREQU_STAND K_VAN_FREQU_WICHT K_VAN_GUETE_CFG K_VAN_GUETE_DAUER K_VAN_GUETE_INIT K_VAN_GUETE_PAUSE K_VAN_GUETE_RESET K_VAN_GUETE_RESET_MIN K_VAN_GUETE_RESET_ZEIT K_VAN_GUETE_TAU K_VAN_GUETE_TMOT K_VAN_GUETE_TOEL K_VAN_INVERT_A1 K_VAN_INVERT_A2 K_VAN_INVERT_E1 K_VAN_INVERT_E2 K_VAN_I_I_MAX K_VAN_I_I_MIN K_VAN_I_MAX K_VAN_KP_XD_KORR_Auslass K_VAN_KP_XD_KORR_Einlass K_VAN_KW_SPR_MAX_A1 K_VAN_KW_SPR_MAX_A2 K_VAN_KW_SPR_MAX_E1 K_VAN_KW_SPR_MAX_E2 K_VAN_N_OFF K_VAN_N_OFFSET_MAX_A K_VAN_N_OFFSET_MIN_A K_VAN_N_ON K_VAN_R20 K_VAN_RAD_CFG K_VAN_RAD_MAX K_VAN_RAD_MIN K_VAN_R_TK K_VAN_SMG_DAUER_MAX K_VAN_SMG_DR_REL K_VAN_SMG_MD_ABBR K_VAN_SMG_MD_MIN K_VAN_SMG_N_ABBR K_VAN_SMG_N_MIN K_VAN_SMG_T_AUFREG K_VAN_SOLL_ABSTELL_Auslass K_VAN_SOLL_ABSTELL_Einlass K_VAN_SOLL_CFG K_VAN_SOLL_ERSATZ_Auslass K_VAN_SOLL_ERSATZ_Einlass K_VAN_SOLL_MAX_Auslass K_VAN_SOLL_MAX_Einlass K_VAN_SOLL_MIN_Auslass K_VAN_SOLL_MIN_Einlass K_VAN_SOLL_OFFSET_Auslass K_VAN_SOLL_OFFSET_Einlass K_VAN_SPR_MAX_Auslass K_VAN_SPR_MAX_Einlass K_VAN_SPR_MAX_TOL_Auslass K_VAN_SPR_MAX_TOL_Einlass K_VAN_SPR_MIN_Auslass K_VAN_SPR_MIN_Einlass K_VAN_SPR_OFFSET_A1 K_VAN_SPR_OFFSET_A2 K_VAN_SPR_OFFSET_E1 K_VAN_SPR_OFFSET_E2 K_VAN_START_I_MAX_AUSLASS K_VAN_SZ_Auslass K_VAN_SZ_Einlass K_VAN_TMOT_BEGR_E K_VAN_TV_MCS_A1 K_VAN_TV_MCS_A2 K_VAN_TV_MCS_E1 K_VAN_TV_MCS_E2 K_VAN_UB_ERS K_VAN_UNLOCK_SPR_Auslass K_VAN_UNLOCK_SPR_Einlass K_VAN_UNL_D_I_Auslass K_VAN_UNL_D_I_Einlass K_VAN_UNL_I_DYN_Auslass K_VAN_UNL_I_DYN_Einlass K_VAN_UNL_N_MIN_Auslass K_VAN_UNL_N_MIN_Einlass K_VAN_XD_EINGEREGELT K_VAN_XD_FILT_ED_Auslass K_VAN_XD_FILT_ED_Einlass K_VAN_XD_REG_MIN K_VAN_XD_SK /end DEF_CHARACTERISTIC
 /begin REF_CHARACTERISTIC /end REF_CHARACTERISTIC
 /begin IN_MEASUREMENT /end IN_MEASUREMENT
 /begin OUT_MEASUREMENT B_VAN_ANSCHL_ANF_A1 B_VAN_ANSCHL_ANF_A2 B_VAN_ANSCHL_ANF_E1 B_VAN_ANSCHL_ANF_E2 B_VAN_ANSCHL_DC_A1 B_VAN_ANSCHL_DC_A2 B_VAN_ANSCHL_DC_E1 B_VAN_ANSCHL_DC_E2 B_VAN_BEGR B_VAN_BEGR_A1 B_VAN_BEGR_A2 B_VAN_BEGR_E1 B_VAN_BEGR_E2 B_VAN_DRUCK B_VAN_DRUCK_SPAET_A1 B_VAN_DRUCK_SPAET_A2 B_VAN_DRUCK_SPAET_E1 B_VAN_DRUCK_SPAET_E2 B_VAN_EINGER_A1 B_VAN_EINGER_A2 B_VAN_EINGER_BANK1 B_VAN_EINGER_BANK2 B_VAN_EINGER_E1 B_VAN_EINGER_E2 B_VAN_EXD_PRUEF_I_A1 B_VAN_EXD_PRUEF_I_A2 B_VAN_EXD_PRUEF_I_E1 B_VAN_EXD_PRUEF_I_E2 B_VAN_FILTR_A1 B_VAN_FILTR_A2 B_VAN_FILTR_E1 B_VAN_FILTR_E2 B_VAN_GUETE B_VAN_KS_AUS_A1 B_VAN_KS_AUS_A2 B_VAN_KS_AUS_E1 B_VAN_KS_AUS_E2 B_VAN_REG_FREI_A1 B_VAN_REG_FREI_A2 B_VAN_REG_FREI_E1 B_VAN_REG_FREI_E2 n_van_b1 n_van_b2 van_anschl_t_A1 van_anschl_t_A2 van_anschl_t_E1 van_anschl_t_E2 van_begr_faktor van_d_xd_A1 van_d_xd_A2 van_d_xd_E1 van_d_xd_E2 van_d_xd_filt_A1 van_d_xd_filt_A2 van_d_xd_filt_E1 van_d_xd_filt_E2 van_druck_cnt_b1 van_druck_cnt_b2 van_druck_start_e_b1 van_druck_start_e_b2 van_druck_time van_druck_timeout van_dsv_exd_st van_dsv_exd_timeout van_dsv_peak_time van_dsv_st van_dsv_timer van_dsv_tv van_exd_anschl_max_A1 van_exd_anschl_max_A2 van_exd_anschl_max_E1 van_exd_anschl_max_E2 van_exd_anschl_min_A1 van_exd_anschl_min_A2 van_exd_anschl_min_E1 van_exd_anschl_min_E2 van_exd_frequ_A1 van_exd_frequ_A2 van_exd_frequ_E1 van_exd_frequ_E2 van_exd_pruef van_exd_soll_A1 van_exd_soll_A2 van_exd_soll_E1 van_exd_soll_E2 van_exd_soll_timeout_A1 van_exd_soll_timeout_A2 van_exd_soll_timeout_E1 van_exd_soll_timeout_E2 van_exd_t van_exd_t_verst_gross_A1 van_exd_t_verst_gross_A2 van_exd_t_verst_gross_E1 van_exd_t_verst_gross_E2 van_exd_t_verst_klein_A1 van_exd_t_verst_klein_A2 van_exd_t_verst_klein_E1 van_exd_t_verst_klein_E2 van_exd_tv_A1 van_exd_tv_A2 van_exd_tv_E1 van_exd_tv_E2 van_exd_tv_timeout_A1 van_exd_tv_timeout_A2 van_exd_tv_timeout_E1 van_exd_tv_timeout_E2 van_filtr_dauer_A1 van_filtr_dauer_A2 van_filtr_dauer_E1 van_filtr_dauer_E2 van_filtr_fgen van_fitr_xd_wicht van_flags van_fpos_A1 van_fpos_A2 van_fpos_E1 van_fpos_E2 van_frequ_A1 van_frequ_A2 van_frequ_E1 van_frequ_E2 van_frequ_dyn_A1 van_frequ_dyn_A2 van_frequ_dyn_E1 van_frequ_dyn_E2 van_frequ_fakt_A1 van_frequ_fakt_A2 van_frequ_fakt_E1 van_frequ_fakt_E2 van_frequ_stat van_gpos_A1 van_gpos_A2 van_gpos_E1 van_gpos_E2 van_guete_dauer van_guete_pause van_guete_reset_zeit van_guete_roh_A1 van_guete_roh_A2 van_guete_roh_E1 van_guete_roh_E2 van_i_A1 van_i_A2 van_i_E1 van_i_E2 van_i_d_A1 van_i_d_A2 van_i_d_E1 van_i_d_E2 van_i_i_A1 van_i_i_A2 van_i_i_E1 van_i_i_E2 van_i_p_A1 van_i_p_A2 van_i_p_E1 van_i_p_E2 van_i_vorst_Auslass van_i_vorst_Einlass van_imp_cnt_A1 van_imp_cnt_A2 van_imp_cnt_E1 van_imp_cnt_E2 van_ist_filt_A1 van_ist_filt_A2 van_ist_filt_E1 van_ist_filt_E2 van_ist_kh_start_A1 van_ist_kh_start_A2 van_ist_kh_start_E1 van_ist_kh_start_E2 van_ist_oeff_A1 van_ist_oeff_A2 van_ist_oeff_E1 van_ist_oeff_E2 van_ist_schl_A1 van_ist_schl_A2 van_ist_schl_E1 van_ist_schl_E2 van_kd_Auslass van_kd_Einlass van_kh_soll_A1 van_kh_soll_A2 van_kh_soll_E1 van_kh_soll_E2 van_ki_A1 van_ki_A2 van_ki_E1 van_ki_E2 van_kp_Auslass van_kp_Einlass van_n_korr_a_b1 van_n_korr_a_b2 van_r van_reg_fakt_tmot van_smg_dauer van_smg_st van_soll_dmax_A1 van_soll_dmax_A2 van_soll_dmax_E1 van_soll_dmax_E2 van_soll_filtr_offs van_soll_old_A1 van_soll_old_A2 van_soll_old_E1 van_soll_old_E2 van_soll_stat_A1 van_soll_stat_A2 van_soll_stat_E1 van_soll_stat_E2 van_st_A1 van_st_A2 van_st_E1 van_st_E2 van_st_begr van_st_eingeregelt van_st_geber_A1 van_st_geber_A2 van_st_geber_E1 van_st_geber_E2 van_st_unlock_A1 van_st_unlock_A2 van_st_unlock_E1 van_st_unlock_E2 van_t_soll_begr van_t_start_dly van_tb_imp_A1 van_tb_imp_A2 van_tb_imp_E1 van_tb_imp_E2 van_tv_A1 van_tv_A2 van_tv_E1 van_tv_E2 van_vo_filt_b1 van_vo_filt_b2 van_xd_A1 van_xd_A2 van_xd_E1 van_xd_E2 van_xd_filt_A1 van_xd_filt_A2 van_xd_filt_E1 van_xd_filt_E2 van_xd_tau van_zahn_cnt_b1 van_zahn_cnt_b2 van_zahn_ctr5ms_b1 van_zahn_ctr5ms_b2 /end OUT_MEASUREMENT
/end FUNCTION
/begin FUNCTION Version ""
 /begin DEF_CHARACTERISTIC K_DATENKENNUNG_1_1of5_ K_DATENKENNUNG_1_2of5_ K_DATENKENNUNG_1_3of5_ K_DATENKENNUNG_1_4of5_ K_DATENKENNUNG_1_5of5_ K_DATENKENNUNG_2_1of5_ K_DATENKENNUNG_2_2of5_ K_DATENKENNUNG_2_3of5_ K_DATENKENNUNG_2_4of5_ K_DATENKENNUNG_2_5of5_ K_DATENKENNUNG_3_1of5_ K_DATENKENNUNG_3_2of5_ K_DATENKENNUNG_3_3of5_ K_DATENKENNUNG_3_4of5_ K_DATENKENNUNG_3_5of5_ K_VERS_DATEN K_VERS_NAME K_VERS_PROG K_VERS_PROZ /end DEF_CHARACTERISTIC
 /begin REF_CHARACTERISTIC /end REF_CHARACTERISTIC
 /begin IN_MEASUREMENT /end IN_MEASUREMENT
 /begin OUT_MEASUREMENT vers_index vers_name vers_prog vers_sg /end OUT_MEASUREMENT
/end FUNCTION
/begin FUNCTION Wandfilm ""
 /begin DEF_CHARACTERISTIC KF_WF_ASP_NEG KF_WF_ASP_POS KF_WF_MKS_AKTIV_NEG KF_WF_MKS_AKTIV_POS KF_WF_MKS_BEGR_NEG KF_WF_MKS_BEGR_POS KF_WF_MKS_F_N_DR_REL KF_WF_MKS_START_MAX KF_WF_OELV_ETA KF_WF_PSAU_WICHT KF_WF_SOLL_F_PUMG KF_WF_SOLL_F_VAN KF_WF_SOLL_GRUND KF_WF_SOLL_GRUND_DR_REL KL_WF_ASP_NEG_START KL_WF_ASP_POS_START KL_WF_DMKS_T1_MS KL_WF_MD_RF_TAU KL_WF_MKS_BEGR_NEG_WICHT KL_WF_MKS_F_TSGRW KL_WF_SOLL_F_LAM KL_WF_SOLL_F_TI_PHI_ENDE K_WF_ASP_START K_WF_IST_CFG K_WF_IST_PLAU_MAX K_WF_MKS_AUS_HYS K_WF_MKS_F K_WF_MKS_F_CFG K_WF_MKS_TI_CFG K_WF_SOLL_CFG K_WF_SOLL_START_PSAU K_WF_SOLL_START_PSAU_CFG /end DEF_CHARACTERISTIC
 /begin REF_CHARACTERISTIC /end REF_CHARACTERISTIC
 /begin IN_MEASUREMENT /end IN_MEASUREMENT
 /begin OUT_MEASUREMENT wf_asp_cnt wf_b1.soll wf_b1.soll_f_lam wf_b1.soll_f_ti wf_b1.soll_f_van wf_b1.soll_grund wf_b2.soll wf_b2.soll_f_lam wf_b2.soll_f_ti wf_b2.soll_f_van wf_b2.soll_grund wf_bank wf_dmks_t1 wf_ist_eta_zyl1 wf_ist_eta_zyl10 wf_ist_eta_zyl2 wf_ist_eta_zyl3 wf_ist_eta_zyl4 wf_ist_eta_zyl5 wf_ist_eta_zyl6 wf_ist_eta_zyl7 wf_ist_eta_zyl8 wf_ist_eta_zyl9 wf_ist_start_eta_zyl1 wf_ist_start_eta_zyl10 wf_ist_start_eta_zyl2 wf_ist_start_eta_zyl3 wf_ist_start_eta_zyl4 wf_ist_start_eta_zyl5 wf_ist_start_eta_zyl6 wf_ist_start_eta_zyl7 wf_ist_start_eta_zyl8 wf_ist_start_eta_zyl9 wf_ist_start_zyl1 wf_ist_start_zyl10 wf_ist_start_zyl2 wf_ist_start_zyl3 wf_ist_start_zyl4 wf_ist_start_zyl5 wf_ist_start_zyl6 wf_ist_start_zyl7 wf_ist_start_zyl8 wf_ist_start_zyl9 wf_lam_soll_offs_b1 wf_lam_soll_offs_b2 wf_md_rf_soll wf_md_rf_tau wf_mks_begr_neg_b1 wf_mks_begr_neg_b2 wf_mks_begr_pos_b1 wf_mks_begr_pos_b2 wf_mks_begr_zyl1 wf_mks_begr_zyl10 wf_mks_begr_zyl2 wf_mks_begr_zyl3 wf_mks_begr_zyl4 wf_mks_begr_zyl5 wf_mks_begr_zyl6 wf_mks_begr_zyl7 wf_mks_begr_zyl8 wf_mks_begr_zyl9 wf_mks_dif_zyl1 wf_mks_dif_zyl10 wf_mks_dif_zyl2 wf_mks_dif_zyl3 wf_mks_dif_zyl4 wf_mks_dif_zyl5 wf_mks_dif_zyl6 wf_mks_dif_zyl7 wf_mks_dif_zyl8 wf_mks_dif_zyl9 wf_mks_f_b1 wf_mks_f_b2 wf_mks_f_roh_b1 wf_mks_f_roh_b2 wf_mks_f_trig wf_mks_roh_zyl1 wf_mks_roh_zyl10 wf_mks_roh_zyl2 wf_mks_roh_zyl3 wf_mks_roh_zyl4 wf_mks_roh_zyl5 wf_mks_roh_zyl6 wf_mks_roh_zyl7 wf_mks_roh_zyl8 wf_mks_roh_zyl9 wf_mks_st wf_mks_start_max wf_mks_start_zyl1 wf_mks_start_zyl10 wf_mks_start_zyl2 wf_mks_start_zyl3 wf_mks_start_zyl4 wf_mks_start_zyl5 wf_mks_start_zyl6 wf_mks_start_zyl7 wf_mks_start_zyl8 wf_mks_start_zyl9 wf_mks_tau wf_mks_zyl1 wf_mks_zyl10 wf_mks_zyl2 wf_mks_zyl3 wf_mks_zyl4 wf_mks_zyl5 wf_mks_zyl6 wf_mks_zyl7 wf_mks_zyl8 wf_mks_zyl9 wf_mks_zyl_offs wf_oelv_eta_f wf_oelv_zyl1 wf_oelv_zyl10 wf_oelv_zyl2 wf_oelv_zyl3 wf_oelv_zyl4 wf_oelv_zyl5 wf_oelv_zyl6 wf_oelv_zyl7 wf_oelv_zyl8 wf_oelv_zyl9 wf_psau_b1 wf_psau_b2 wf_soll_f_pumg wf_start_seq_cnt wf_start_st wf_zyl_aktiv_st /end OUT_MEASUREMENT
/end FUNCTION
/begin FUNCTION Zustand ""
 /begin DEF_CHARACTERISTIC KL_ZUST_MD_TL_VL KL_ZUST_N_ST_LL K_ZUST_MD_HYST_LL_TL K_ZUST_MD_HYST_TL_VL K_ZUST_MD_LL_TL K_ZUST_NL_TIMOUT_INJ K_ZUST_N_PS_LL K_ZUST_POWER K_ZUST_T_NL /end DEF_CHARACTERISTIC
 /begin REF_CHARACTERISTIC /end REF_CHARACTERISTIC
 /begin IN_MEASUREMENT /end IN_MEASUREMENT
 /begin OUT_MEASUREMENT zust_exd_st /end OUT_MEASUREMENT
/end FUNCTION
/begin RECORD_LAYOUT TKW_VV_VV_UB FNC_VALUES 1 UBYTE COLUMN_DIR DIRECT /end RECORD_LAYOUT
/begin RECORD_LAYOUT TKW_VV_VV_SB FNC_VALUES 1 SBYTE COLUMN_DIR DIRECT /end RECORD_LAYOUT
/begin RECORD_LAYOUT TKW_VV_VV_UW FNC_VALUES 1 UWORD COLUMN_DIR DIRECT /end RECORD_LAYOUT
/begin RECORD_LAYOUT TKW_VV_VV_SW FNC_VALUES 1 SWORD COLUMN_DIR DIRECT /end RECORD_LAYOUT
/begin RECORD_LAYOUT TKW_VV_VV_UL FNC_VALUES 1 ULONG COLUMN_DIR DIRECT /end RECORD_LAYOUT
/begin RECORD_LAYOUT TKL_UB_VV_UB NO_AXIS_PTS_X 1 UBYTE RESERVED 2 BYTE AXIS_PTS_X 3 UBYTE INDEX_INCR DIRECT FNC_VALUES 4 UBYTE COLUMN_DIR DIRECT /end RECORD_LAYOUT
/begin RECORD_LAYOUT TKL_UW_VV_UW NO_AXIS_PTS_X 1 UBYTE RESERVED 2 BYTE AXIS_PTS_X 3 UWORD INDEX_INCR DIRECT FNC_VALUES 4 UWORD COLUMN_DIR DIRECT /end RECORD_LAYOUT
/begin RECORD_LAYOUT TKL_SW_VV_UB NO_AXIS_PTS_X 1 UBYTE RESERVED 2 BYTE AXIS_PTS_X 3 SWORD INDEX_INCR DIRECT FNC_VALUES 4 UBYTE COLUMN_DIR DIRECT /end RECORD_LAYOUT
/begin RECORD_LAYOUT TKL_SW_VV_UW NO_AXIS_PTS_X 1 UBYTE RESERVED 2 BYTE AXIS_PTS_X 3 SWORD INDEX_INCR DIRECT FNC_VALUES 4 UWORD COLUMN_DIR DIRECT /end RECORD_LAYOUT
/begin RECORD_LAYOUT TKL_SW_VV_SW NO_AXIS_PTS_X 1 UBYTE RESERVED 2 BYTE AXIS_PTS_X 3 SWORD INDEX_INCR DIRECT FNC_VALUES 4 SWORD COLUMN_DIR DIRECT /end RECORD_LAYOUT
/begin RECORD_LAYOUT TKF_UW_UW_UW NO_AXIS_PTS_X 1 UBYTE NO_AXIS_PTS_Y 2 UBYTE AXIS_PTS_X 3 UWORD INDEX_INCR DIRECT AXIS_PTS_Y 4 UWORD INDEX_INCR DIRECT FNC_VALUES 5 UWORD COLUMN_DIR DIRECT /end RECORD_LAYOUT
/begin RECORD_LAYOUT TKF_SW_SW_UW NO_AXIS_PTS_X 1 UBYTE NO_AXIS_PTS_Y 2 UBYTE AXIS_PTS_X 3 SWORD INDEX_INCR DIRECT AXIS_PTS_Y 4 SWORD INDEX_INCR DIRECT FNC_VALUES 5 UWORD COLUMN_DIR DIRECT /end RECORD_LAYOUT
/begin RECORD_LAYOUT TKF_SW_SW_SW NO_AXIS_PTS_X 1 UBYTE NO_AXIS_PTS_Y 2 UBYTE AXIS_PTS_X 3 SWORD INDEX_INCR DIRECT AXIS_PTS_Y 4 SWORD INDEX_INCR DIRECT FNC_VALUES 5 SWORD COLUMN_DIR DIRECT /end RECORD_LAYOUT
/end MODULE
/end PROJECT
