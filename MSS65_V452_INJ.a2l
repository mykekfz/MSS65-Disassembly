/begin PROJECT MSS65-inj-V452 "MSS65 INJ - V452.01-B204.00, data set 0569Q60Z160E"
/begin HEADER "" VERSION "V452.01-B204.00" /end HEADER
/begin MODULE _MSS65-inj "MSS65 INJ - V452.01-B204.00, calibration xxxxxxxx"
/begin MOD_COMMON "" BYTE_ORDER MSB_FIRST /* Default byteorder (Motorola) */ /end MOD_COMMON
/* Formel fuer 1:1-Wiedergabe ohne Einheit */
/begin COMPU_METHOD FORMULA_USER1 "FORMULA_USER1" RAT_FUNC "%7.0" "-" COEFFS 0 1 0 0 0 1 /end COMPU_METHOD
/begin MEASUREMENT sys_sypcr "Watchdog-Register" ULONG FORMULA_USER1 0 0 0.0000 4294967295.0000 ECU_ADDRESS 0x2FC004 /begin FUNCTION_LIST Systemvariablen /end FUNCTION_LIST /end MEASUREMENT
/* ------------------ Abschnitt erzeugt aus adapt_common.dat ------------------ */
/begin COMPU_METHOD FORMULA_0000 "FORMULA_0000" RAT_FUNC "%7.0" "-" COEFFS 0 1 0 0 0 1 /end COMPU_METHOD
/begin COMPU_METHOD FORMULA_0001 "FORMULA_0001" RAT_FUNC "%6.1" "%" COEFFS 0 10 0 0 0 1 /end COMPU_METHOD
/begin COMPU_METHOD FORMULA_0003 "FORMULA_0003" RAT_FUNC "%3.0" "-" COEFFS 0 1 0 0 0 1 /end COMPU_METHOD
/begin COMPU_METHOD FORMULA_0006 "FORMULA_0006" RAT_FUNC "%5.0" "Upm" COEFFS 0 1 0 0 0 1 /end COMPU_METHOD
/begin COMPU_METHOD FORMULA_0007 "FORMULA_0007" RAT_FUNC "%8.3" "-" COEFFS 0 10000 0 0 0 1 /end COMPU_METHOD
/begin COMPU_METHOD FORMULA_0008 "FORMULA_0008" RAT_FUNC "%6.1" "V" COEFFS 0 10 0 0 0 1 /end COMPU_METHOD
/begin COMPU_METHOD FORMULA_0009 "FORMULA_0009" RAT_FUNC "%6.1" "Nm" COEFFS 0 10 0 0 0 1 /end COMPU_METHOD
/begin COMPU_METHOD FORMULA_0010 "FORMULA_0010" RAT_FUNC "%5.0" "-" COEFFS 0 1 0 0 0 1 /end COMPU_METHOD
/begin COMPU_METHOD FORMULA_0011 "FORMULA_0011" TAB_VERB "%5.0" "-" COMPU_TAB_REF FORMULA_0011_VTAB /end COMPU_METHOD
/begin COMPU_VTAB FORMULA_0011_VTAB "FORMULA_0011_VTAB" TAB_VERB 15 0 "kein Fehler" 1 "Egasueberwachung" 2 "Momentenueberwachung" 4 "Einspritzueberwachung" 8 "SMG-Ueberwachung" 16 "Systemfehler" 32 "Stackueberwachung" 64 "Resetanzahl" 128 "Gemischfehler" 256 "Klopfregelung" 512 "CRC-Check" 1024 "Taskueberwachung" 2048 "Prozessueberwachung" 4096 "Pedalwertgeber" 8192 "Mastervac" DEFAULT_VALUE "undef" /end COMPU_VTAB
/begin COMPU_METHOD FORMULA_0015 "FORMULA_0015" TAB_VERB "%5.0" "-" COMPU_TAB_REF FORMULA_0015_VTAB /end COMPU_METHOD
/begin COMPU_VTAB FORMULA_0015_VTAB "FORMULA_0015_VTAB" TAB_VERB 6 512 "MCI" 768 "DataAcc" 1024 "IntrAcc" 1536 "Align" 1792 "PrgExc" 8192 "NMI" /end COMPU_VTAB
/begin COMPU_METHOD FORMULA_0021 "FORMULA_0021" RAT_FUNC "%7.2" "s" COEFFS 0 100 0 0 0 1 /end COMPU_METHOD
/* ------------------ Abschnitt erzeugt aus adapt_glob.dat ------------------ */
/begin COMPU_METHOD FORMULA_0023 "FORMULA_0023" RAT_FUNC "%6.1" "�C" COEFFS 0 10 2732 0 0 1 /end COMPU_METHOD
/begin COMPU_METHOD FORMULA_0025 "FORMULA_0025" RAT_FUNC "%8.3" "-" COEFFS 0 16384 0 0 0 1 /end COMPU_METHOD
/begin COMPU_METHOD FORMULA_0027 "FORMULA_0027" RAT_FUNC "%7.0" "km" COEFFS 0 1 0 0 0 1 /end COMPU_METHOD
/begin COMPU_METHOD FORMULA_0032 "FORMULA_0032" RAT_FUNC "%3.0" "%" COEFFS 0 1 0 0 0 1 /end COMPU_METHOD
/begin COMPU_METHOD FORMULA_0033 "FORMULA_0033" RAT_FUNC "%5.2" "-" COEFFS 0 1 0 0 0 1 /end COMPU_METHOD
/begin COMPU_METHOD FORMULA_0062 "FORMULA_0062" RAT_FUNC "%5.0" "s" COEFFS 0 1 0 0 0 1 /end COMPU_METHOD
/begin COMPU_METHOD FORMULA_0073 "FORMULA_0073" RAT_FUNC "%6.1" "s" COEFFS 0 10 0 0 0 1 /end COMPU_METHOD
/begin COMPU_METHOD FORMULA_0075 "FORMULA_0075" RAT_FUNC "%8.3" "-" COEFFS 0 1024 0 0 0 1 /end COMPU_METHOD
/begin COMPU_METHOD FORMULA_0077 "FORMULA_0077" RAT_FUNC "%6.1" "mbar" COEFFS 0 16 0 0 0 1 /end COMPU_METHOD
/begin COMPU_METHOD FORMULA_0078 "FORMULA_0078" RAT_FUNC "%6.1" "km/h" COEFFS 0 16 0 0 0 1 /end COMPU_METHOD
/* ------------------ Abschnitt erzeugt aus glob.dat ------------------ */
/begin COMPU_METHOD FORMULA_0083 "FORMULA_0083" RAT_FUNC "%7.2" "-" COEFFS 0 1 0 0 0 1 /end COMPU_METHOD
/begin COMPU_METHOD FORMULA_0109 "FORMULA_0109" RAT_FUNC "%7.2" "-" COEFFS 0 10000 0 0 0 1 /end COMPU_METHOD
/begin COMPU_METHOD FORMULA_0111 "FORMULA_0111" RAT_FUNC "%6.1" "�KW" COEFFS 0 10 0 0 0 1 /end COMPU_METHOD
/begin COMPU_METHOD FORMULA_0112 "FORMULA_0112" RAT_FUNC "%6.1" "kg/h" COEFFS 0 10 0 0 0 1 /end COMPU_METHOD
/begin COMPU_METHOD FORMULA_0113 "FORMULA_0113" RAT_FUNC "%6.1" "mg/asp" COEFFS 0 10 0 0 0 1 /end COMPU_METHOD
/begin COMPU_METHOD FORMULA_0115 "FORMULA_0115" RAT_FUNC "%7.2" "%" COEFFS 0 16384 0 0 0 100 /end COMPU_METHOD
/begin COMPU_METHOD FORMULA_0123 "FORMULA_0123" RAT_FUNC "%5.0" "digit" COEFFS 0 1 0 0 0 1 /end COMPU_METHOD
/begin COMPU_METHOD FORMULA_0146 "FORMULA_0146" RAT_FUNC "%6.1" "%" COEFFS 0 1667 0 0 0 100 /end COMPU_METHOD
/begin COMPU_METHOD FORMULA_0147 "FORMULA_0147" RAT_FUNC "%6.1" "qmm" COEFFS 0 10 0 0 0 1 /end COMPU_METHOD
/begin COMPU_METHOD FORMULA_0152 "FORMULA_0152" RAT_FUNC "%9.2" "s" COEFFS 0 100 0 0 0 1 /end COMPU_METHOD
/begin COMPU_METHOD FORMULA_0172 "FORMULA_0172" TAB_VERB "%3.0" "-" COMPU_TAB_REF FORMULA_0172_VTAB /end COMPU_METHOD
/begin COMPU_VTAB FORMULA_0172_VTAB "FORMULA_0172_VTAB" TAB_VERB 1 0 "kein Fehler" /end COMPU_VTAB
/begin COMPU_METHOD FORMULA_0184 "FORMULA_0184" TAB_VERB "%5.0" "-" COMPU_TAB_REF FORMULA_0184_VTAB /end COMPU_METHOD
/begin COMPU_VTAB FORMULA_0184_VTAB "FORMULA_0184_VTAB" TAB_VERB 1 0 "alle ein" /end COMPU_VTAB
/begin COMPU_METHOD FORMULA_0295 "FORMULA_0295" RAT_FUNC "%9.4" "-" COEFFS 0 16384 0 0 0 1 /end COMPU_METHOD
/begin COMPU_METHOD FORMULA_0317 "FORMULA_0317" RAT_FUNC "%5.2" "s" COEFFS 0 100 0 0 0 1 /end COMPU_METHOD
/begin COMPU_METHOD FORMULA_0318 "FORMULA_0318" RAT_FUNC "%3.0" ".Gang" COEFFS 0 1 0 0 0 1 /end COMPU_METHOD
/* ------------------ Abschnitt erzeugt aus pctrl.dat ------------------ */
/begin COMPU_METHOD FORMULA_0352 "FORMULA_0352" RAT_FUNC "%5.2" "s" COEFFS 0 200 0 0 0 1 /end COMPU_METHOD
/* ------------------ Abschnitt erzeugt aus ram_chk.dat ------------------ */
/begin COMPU_METHOD FORMULA_0355 "FORMULA_0355" RAT_FUNC "%7.2" "kHz" COEFFS 0 100 0 0 0 1 /end COMPU_METHOD
/begin COMPU_METHOD FORMULA_0356 "FORMULA_0356" RAT_FUNC "%3.0" "us" COEFFS 0 1 0 0 0 1 /end COMPU_METHOD
/begin COMPU_METHOD FORMULA_0357 "FORMULA_0357" TAB_VERB "%5.2" "-" COMPU_TAB_REF FORMULA_0357_VTAB /end COMPU_METHOD
/begin COMPU_VTAB FORMULA_0357_VTAB "FORMULA_0357_VTAB" TAB_VERB 2 0 "Aus" 1 "Ein" /end COMPU_VTAB
/* ------------------ Abschnitt erzeugt aus sk.dat ------------------ */
/begin COMPU_METHOD FORMULA_0362 "FORMULA_0362" TAB_VERB "%3.0" "-" COMPU_TAB_REF FORMULA_0362_VTAB /end COMPU_METHOD
/begin COMPU_VTAB FORMULA_0362_VTAB "FORMULA_0362_VTAB" TAB_VERB 1 0 "Inaktiv" DEFAULT_VALUE "Aktiv" /end COMPU_VTAB
/begin COMPU_METHOD FORMULA_0363 "FORMULA_0363" TAB_VERB "%5.2" "-" COMPU_TAB_REF FORMULA_0363_VTAB /end COMPU_METHOD
/begin COMPU_VTAB FORMULA_0363_VTAB "FORMULA_0363_VTAB" TAB_VERB 2 0 "SK aus" 1 "SK aktiv" /end COMPU_VTAB
/begin COMPU_METHOD FORMULA_0364 "FORMULA_0364" TAB_VERB "%3.0" "-" COMPU_TAB_REF FORMULA_0364_VTAB /end COMPU_METHOD
/begin COMPU_VTAB FORMULA_0364_VTAB "FORMULA_0364_VTAB" TAB_VERB 5 0 "Aus" 1 "MVAC" 2 "ELUP" 3 "MVAC+ELUP" 6 "System" /end COMPU_VTAB
/begin COMPU_METHOD FORMULA_0365 "FORMULA_0365" TAB_VERB "%3.0" "-" COMPU_TAB_REF FORMULA_0365_VTAB /end COMPU_METHOD
/begin COMPU_VTAB FORMULA_0365_VTAB "FORMULA_0365_VTAB" TAB_VERB 8 0 "Inaktiv" 1 "D-CRC" 2 "P-CRC" 3 "PD-CRC" 4 "B-CRC" 5 "BD-CRC" 6 "BP-CRC" 7 "BPD-CRC" /end COMPU_VTAB
/begin COMPU_METHOD FORMULA_0366 "FORMULA_0366" TAB_VERB "%3.0" "-" COMPU_TAB_REF FORMULA_0366_VTAB /end COMPU_METHOD
/begin COMPU_VTAB FORMULA_0366_VTAB "FORMULA_0366_VTAB" TAB_VERB 8 0 "alle an" 3 "LA" 12 "LAA" 15 "LA+LAA" 48 "Mager" 51 "LA+Mager" 60 "LAA+Mager" 63 "LA+LAA+Mager" /end COMPU_VTAB
/begin COMPU_METHOD FORMULA_0367 "FORMULA_0367" TAB_VERB "%3.0" "-" COMPU_TAB_REF FORMULA_0367_VTAB /end COMPU_METHOD
/begin COMPU_VTAB FORMULA_0367_VTAB "FORMULA_0367_VTAB" TAB_VERB 8 0 "alle an" 1 "LA" 2 "LAA" 3 "LA+LAA" 4 "Mager" 5 "LA+Mager" 6 "LAA+Mager" 7 "LA+LAA+Mager" /end COMPU_VTAB
/begin COMPU_METHOD FORMULA_0368 "FORMULA_0368" TAB_VERB "%3.0" "-" COMPU_TAB_REF FORMULA_0368_VTAB /end COMPU_METHOD
/begin COMPU_VTAB FORMULA_0368_VTAB "FORMULA_0368_VTAB" TAB_VERB 2 0 "aktiv" 1 "gesperrt" /end COMPU_VTAB
/* ------------------ Abschnitt erzeugt aus sk_e2_glob.dat ------------------ */
/begin COMPU_METHOD FORMULA_0369 "FORMULA_0369" TAB_VERB "%5.0" "-" COMPU_TAB_REF FORMULA_0369_VTAB /end COMPU_METHOD
/begin COMPU_VTAB FORMULA_0369_VTAB "FORMULA_0369_VTAB" TAB_VERB 23 0 "kein Fehler" 5 "Motortemperatur" 6 "Oeltemperatur" 10 "SMG-Schaltablauf" 11 "SMG-Eingriff" 12 "SMG-Sollmoment" 13 "SMG-nGetr" 14 "SMG-Gang" 20 "LLR-Plausi" 21 "Minimalmoment" 22 "Maximalmoment" 23 "Istmoment" 24 "Schleppmoment" 25 "Soll-Istvergleich" 26 "rel. Fahrerwunsch" 30 "Luftmasse" 40 "Drehzahl" 50 "Pedalwert" 60 "Bremslichtschalter" 80 "Komplementvergleich" 85 "Fehler Testrechnung" 86 "Timeout Testrechnung" 90 "Maxdrehzahl" /end COMPU_VTAB
/* ------------------ Abschnitt erzeugt aus sw_confg.dat ------------------ */
/begin COMPU_METHOD FORMULA_0371 "FORMULA_0371" TAB_VERB "%7.2" "-" COMPU_TAB_REF FORMULA_0371_VTAB /end COMPU_METHOD
/begin COMPU_VTAB FORMULA_0371_VTAB "FORMULA_0371_VTAB" TAB_VERB 5 8192 "S65" 8448 "S65FLACH" 8704 "S65V" 256 "S15" 16384 "S85" DEFAULT_VALUE "undefiniert" /end COMPU_VTAB
/begin COMPU_METHOD FORMULA_0372 "FORMULA_0372" TAB_VERB "%5.2" "-" COMPU_TAB_REF FORMULA_0372_VTAB /end COMPU_METHOD
/begin COMPU_VTAB FORMULA_0372_VTAB "FORMULA_0372_VTAB" TAB_VERB 7 16 "E60" 17 "E63" 18 "E64" 32 "E65" 64 "E85" 128 "E90" 129 "E91" DEFAULT_VALUE "undefiniert" /end COMPU_VTAB
/begin COMPU_METHOD FORMULA_0373 "FORMULA_0373" TAB_VERB "%5.2" "-" COMPU_TAB_REF FORMULA_0373_VTAB /end COMPU_METHOD
/begin COMPU_VTAB FORMULA_0373_VTAB "FORMULA_0373_VTAB" TAB_VERB 3 16 "HS" 64 "SMG" 128 "DKG" DEFAULT_VALUE "undefiniert" /end COMPU_VTAB
/begin COMPU_METHOD FORMULA_0374 "FORMULA_0374" TAB_VERB "%5.2" "-" COMPU_TAB_REF FORMULA_0374_VTAB /end COMPU_METHOD
/begin COMPU_VTAB FORMULA_0374_VTAB "FORMULA_0374_VTAB" TAB_VERB 5 1 "ECE" 2 "US" 4 "Golfstaaten" 8 "ZA" 16 "JAPAN" DEFAULT_VALUE "undefiniert" /end COMPU_VTAB
/begin COMPU_METHOD FORMULA_0375 "FORMULA_0375" TAB_VERB "%5.2" "-" COMPU_TAB_REF FORMULA_0375_VTAB /end COMPU_METHOD
/begin COMPU_VTAB FORMULA_0375_VTAB "FORMULA_0375_VTAB" TAB_VERB 6 16 "EU3" 17 "EU4" 1 "D4" 32 "LEV" 33 "LEV2" 34 "ULEV" DEFAULT_VALUE "undefiniert" /end COMPU_VTAB
/begin COMPU_METHOD FORMULA_0376 "FORMULA_0376" TAB_VERB "%5.2" "-" COMPU_TAB_REF FORMULA_0376_VTAB /end COMPU_METHOD
/begin COMPU_VTAB FORMULA_0376_VTAB "FORMULA_0376_VTAB" TAB_VERB 3 1 "MIL_OFF" 2 "MIL_FSP" 4 "MIL_ON" DEFAULT_VALUE "undefiniert" /end COMPU_VTAB
/begin COMPU_METHOD FORMULA_0377 "FORMULA_0377" TAB_VERB "%5.2" "-" COMPU_TAB_REF FORMULA_0377_VTAB /end COMPU_METHOD
/begin COMPU_VTAB FORMULA_0377_VTAB "FORMULA_0377_VTAB" TAB_VERB 2 128 "Serienstand" 1 "Entwicklung" DEFAULT_VALUE "undefiniert" /end COMPU_VTAB
/begin COMPU_METHOD FORMULA_0378 "FORMULA_0378" TAB_VERB "%5.2" "-" COMPU_TAB_REF FORMULA_0378_VTAB /end COMPU_METHOD
/begin COMPU_VTAB FORMULA_0378_VTAB "FORMULA_0378_VTAB" TAB_VERB 2 1 "CAN 11H" 2 "CAN 12H" DEFAULT_VALUE "undefiniert" /end COMPU_VTAB
/begin COMPU_METHOD FORMULA_0379 "FORMULA_0379" TAB_VERB "%5.2" "-" COMPU_TAB_REF FORMULA_0379_VTAB /end COMPU_METHOD
/begin COMPU_VTAB FORMULA_0379_VTAB "FORMULA_0379_VTAB" TAB_VERB 3 0 "Fz-Betrieb" 1 "Pruefstand" 2 "Rolle" /end COMPU_VTAB
/begin COMPU_METHOD FORMULA_0380 "FORMULA_0380" TAB_VERB "%5.2" "-" COMPU_TAB_REF FORMULA_0380_VTAB /end COMPU_METHOD
/begin COMPU_VTAB FORMULA_0380_VTAB "FORMULA_0380_VTAB" TAB_VERB 4 0 "auto Erkennung" 1 "ApplDFlash, rest auto" 2 "ETH aus, rest auto" 3 "ApplDFlash, ETH aus" DEFAULT_VALUE "ungueltig" /end COMPU_VTAB
/begin COMPU_METHOD FORMULA_0381 "FORMULA_0381" TAB_VERB "%5.2" "-" COMPU_TAB_REF FORMULA_0381_VTAB /end COMPU_METHOD
/begin COMPU_VTAB FORMULA_0381_VTAB "FORMULA_0381_VTAB" TAB_VERB 2 0 "Teves" 1 "Bosch" /end COMPU_VTAB
/begin COMPU_METHOD FORMULA_0382 "FORMULA_0382" TAB_VERB "%5.2" "-" COMPU_TAB_REF FORMULA_0382_VTAB /end COMPU_METHOD
/begin COMPU_VTAB FORMULA_0382_VTAB "FORMULA_0382_VTAB" TAB_VERB 3 0 "Aus" 1 "dSPACE" 2 "noLoop" /end COMPU_VTAB
/* ------------------ Abschnitt erzeugt aus sys_zust.dat ------------------ */
/begin COMPU_METHOD FORMULA_0383 "FORMULA_0383" TAB_VERB "%7.2" "-" COMPU_TAB_REF FORMULA_0383_VTAB /end COMPU_METHOD
/begin COMPU_VTAB FORMULA_0383_VTAB "FORMULA_0383_VTAB" TAB_VERB 3 0 "Treiberdiagnose" 1 "Dauerbestromung TPU" 2 "Dauerbestromung Treiber" DEFAULT_VALUE "undef" /end COMPU_VTAB
/begin COMPU_METHOD FORMULA_0384 "FORMULA_0384" TAB_VERB "%7.2" "-" COMPU_TAB_REF FORMULA_0384_VTAB /end COMPU_METHOD
/begin COMPU_VTAB FORMULA_0384_VTAB "FORMULA_0384_VTAB" TAB_VERB 5 1 "Boot" 2 "FpFlash/iD" 4 "FpRAM/iD" 10 "FpFlash/eD" 12 "FpRAM/eD" DEFAULT_VALUE "undefiniert" /end COMPU_VTAB
/begin COMPU_METHOD FORMULA_0385 "FORMULA_0385" TAB_VERB "%3.0" "-" COMPU_TAB_REF FORMULA_0385_VTAB /end COMPU_METHOD
/begin COMPU_VTAB FORMULA_0385_VTAB "FORMULA_0385_VTAB" TAB_VERB 3 0 "Prozessor" 1 "Selbst" 2 "Kollege" DEFAULT_VALUE "undef" /end COMPU_VTAB
/begin COMPU_METHOD FORMULA_0386 "FORMULA_0386" TAB_VERB "%7.2" "-" COMPU_TAB_REF FORMULA_0386_VTAB /end COMPU_METHOD
/begin COMPU_VTAB FORMULA_0386_VTAB "FORMULA_0386_VTAB" TAB_VERB 1 0 "no" DEFAULT_VALUE "ja" /end COMPU_VTAB
/begin COMPU_METHOD FORMULA_0387 "FORMULA_0387" TAB_VERB "%7.2" "-" COMPU_TAB_REF FORMULA_0387_VTAB /end COMPU_METHOD
/begin COMPU_VTAB FORMULA_0387_VTAB "FORMULA_0387_VTAB" TAB_VERB 1 0 "no" DEFAULT_VALUE "ja" /end COMPU_VTAB
/begin COMPU_METHOD FORMULA_0388 "FORMULA_0388" TAB_VERB "%7.2" "-" COMPU_TAB_REF FORMULA_0388_VTAB /end COMPU_METHOD
/begin COMPU_VTAB FORMULA_0388_VTAB "FORMULA_0388_VTAB" TAB_VERB 1 0 "no" DEFAULT_VALUE "ja" /end COMPU_VTAB
/begin COMPU_METHOD FORMULA_0389 "FORMULA_0389" TAB_VERB "%7.2" "-" COMPU_TAB_REF FORMULA_0389_VTAB /end COMPU_METHOD
/begin COMPU_VTAB FORMULA_0389_VTAB "FORMULA_0389_VTAB" TAB_VERB 1 0 "no" DEFAULT_VALUE "ja" /end COMPU_VTAB
/begin COMPU_METHOD FORMULA_0390 "FORMULA_0390" TAB_VERB "%7.2" "-" COMPU_TAB_REF FORMULA_0390_VTAB /end COMPU_METHOD
/begin COMPU_VTAB FORMULA_0390_VTAB "FORMULA_0390_VTAB" TAB_VERB 1 0 "no" DEFAULT_VALUE "ja" /end COMPU_VTAB
/begin COMPU_METHOD FORMULA_0391 "FORMULA_0391" TAB_VERB "%7.2" "-" COMPU_TAB_REF FORMULA_0391_VTAB /end COMPU_METHOD
/begin COMPU_VTAB FORMULA_0391_VTAB "FORMULA_0391_VTAB" TAB_VERB 1 0 "no" DEFAULT_VALUE "ja" /end COMPU_VTAB
/begin COMPU_METHOD FORMULA_0392 "FORMULA_0392" TAB_VERB "%7.2" "-" COMPU_TAB_REF FORMULA_0392_VTAB /end COMPU_METHOD
/begin COMPU_VTAB FORMULA_0392_VTAB "FORMULA_0392_VTAB" TAB_VERB 1 0 "no" DEFAULT_VALUE "ja" /end COMPU_VTAB
/begin COMPU_METHOD FORMULA_0393 "FORMULA_0393" TAB_VERB "%7.2" "-" COMPU_TAB_REF FORMULA_0393_VTAB /end COMPU_METHOD
/begin COMPU_VTAB FORMULA_0393_VTAB "FORMULA_0393_VTAB" TAB_VERB 1 0 "no" DEFAULT_VALUE "ja" /end COMPU_VTAB
/begin COMPU_METHOD FORMULA_0394 "FORMULA_0394" TAB_VERB "%7.2" "-" COMPU_TAB_REF FORMULA_0394_VTAB /end COMPU_METHOD
/begin COMPU_VTAB FORMULA_0394_VTAB "FORMULA_0394_VTAB" TAB_VERB 1 0 "no" DEFAULT_VALUE "ja" /end COMPU_VTAB
/begin COMPU_METHOD FORMULA_0395 "FORMULA_0395" TAB_VERB "%7.2" "-" COMPU_TAB_REF FORMULA_0395_VTAB /end COMPU_METHOD
/begin COMPU_VTAB FORMULA_0395_VTAB "FORMULA_0395_VTAB" TAB_VERB 1 0 "no" DEFAULT_VALUE "ja" /end COMPU_VTAB
/begin COMPU_METHOD FORMULA_0396 "FORMULA_0396" TAB_VERB "%7.2" "-" COMPU_TAB_REF FORMULA_0396_VTAB /end COMPU_METHOD
/begin COMPU_VTAB FORMULA_0396_VTAB "FORMULA_0396_VTAB" TAB_VERB 1 0 "no" DEFAULT_VALUE "ja" /end COMPU_VTAB
/begin COMPU_METHOD FORMULA_0397 "FORMULA_0397" TAB_VERB "%7.2" "-" COMPU_TAB_REF FORMULA_0397_VTAB /end COMPU_METHOD
/begin COMPU_VTAB FORMULA_0397_VTAB "FORMULA_0397_VTAB" TAB_VERB 1 0 "no" DEFAULT_VALUE "ja" /end COMPU_VTAB
/begin COMPU_METHOD FORMULA_0398 "FORMULA_0398" TAB_VERB "%7.2" "-" COMPU_TAB_REF FORMULA_0398_VTAB /end COMPU_METHOD
/begin COMPU_VTAB FORMULA_0398_VTAB "FORMULA_0398_VTAB" TAB_VERB 1 0 "no" DEFAULT_VALUE "ja" /end COMPU_VTAB
/begin COMPU_METHOD FORMULA_0399 "FORMULA_0399" RAT_FUNC "%8.3" "ms" COEFFS 0 1000 0 0 0 1 /end COMPU_METHOD
/begin COMPU_METHOD FORMULA_0400 "FORMULA_0400" TAB_VERB "%3.0" "-" COMPU_TAB_REF FORMULA_0400_VTAB /end COMPU_METHOD
/begin COMPU_VTAB FORMULA_0400_VTAB "FORMULA_0400_VTAB" TAB_VERB 59 0 "kein Fehler" 1 "Adaptionsdaten CRC32" 2 "Programm CRC32" 3 "Daten CRC32" 4 "undef" 5 "undef" 6 "Watchdog-Reset" 7 "Reset" 8 "CRC Boot" 9 "Reset-MCI" 10 "Reset-Data" 11 "Reset-Instr" 13 "Reset-Align" 14 "Reset-Prog" 15 "Reset-NoFp" 19 "Reset-System" 20 "Reset-Trace" 21 "Reset-FpAss" 22 "Reset-Perform" 23 "Reset-SwEmu" 26 "Reset-InstrProt" 27 "Reset-DataProt" 35 "Reset-DataBrk" 36 "Reset-InstrBrk" 37 "Reset-MaskBrk" 38 "Reset-NMIBrk" 39 "Reset-NMI" 40 "Reset-Reserve" 41 "HW_INDEX zu klein" 42 "ADAPT Loeschen" 43 "ADAPT Schreiben" 44 "ADAPT Hochlauf" 50 "SK-Resetausloesung" 51 "ADC" 52 "TZ-TPU Pin" 53 "TZ-TREIBER Pin" 54 "DSP-Bus" 55 "DSP-Stack" 56 "DSP-Watchdog" 57 "DSP-Programm" 58 "DSP-Daten" 59 "DSP-CRC" 60 "ZUST_NL IGN Timeout" 61 "DSP-Zylinder" 62 "FPGA Init Pin NHigh1" 63 "FPGA Init Pin NHigh2" 64 "FPGA Done Pin NHigh" 65 "FPGA Kennung-CRC32" 66 "RAM" 67 "Register" 68 "TPU RAM" 69 "QADC0 CCW" 70 "QADC1 CCW" 71 "SPI-ATIC39 Chain" 72 "SPI-ATIC35 Chain" 73 "SPI-ATIC29 Chain" 74 "Interne Spannung" 75 "OS-Tasksystem" 76 "OS-Stack" DEFAULT_VALUE "undef" /end COMPU_VTAB
/begin COMPU_METHOD FORMULA_0401 "FORMULA_0401" RAT_FUNC "%6.1" "ms" COEFFS 0 1 0 0 0 0.255 /end COMPU_METHOD
/* ------------------ Abschnitt erzeugt aus dgen.dat ------------------ */
/begin COMPU_METHOD FORMULA_0458 "FORMULA_0458" RAT_FUNC "%4.1" "s" COEFFS 0 10 0 0 0 1 /end COMPU_METHOD
/begin COMPU_METHOD FORMULA_0539 "FORMULA_0539" RAT_FUNC "%5.0" "ms" COEFFS 0 1 0 0 0 100 /end COMPU_METHOD
/begin COMPU_METHOD FORMULA_0556 "FORMULA_0556" RAT_FUNC "%9.4" "-" COEFFS 0 10000 0 0 0 1 /end COMPU_METHOD
/begin COMPU_METHOD FORMULA_0561 "FORMULA_0561" RAT_FUNC "%8.3" "kg/h" COEFFS 0 1000 0 0 0 1 /end COMPU_METHOD
/begin COMPU_METHOD FORMULA_0573 "FORMULA_0573" RAT_FUNC "%7.2" "-*s" COEFFS 0 16384 0 0 0 1 /end COMPU_METHOD
/begin COMPU_METHOD FORMULA_0650 "FORMULA_0650" RAT_FUNC "%6.1" "s" COEFFS 0 100 0 0 0 1 /end COMPU_METHOD
/begin COMPU_METHOD FORMULA_0651 "FORMULA_0651" RAT_FUNC "%6.3" "s" COEFFS 0 0 1.28 0 1 0 /end COMPU_METHOD
/begin COMPU_METHOD FORMULA_0664 "FORMULA_0664" RAT_FUNC "%5.2" "s" COEFFS 0 0 2.56 0 1 0 /end COMPU_METHOD
/begin COMPU_METHOD FORMULA_0683 "FORMULA_0683" RAT_FUNC "%5.2" "s" COEFFS 0 0 25.6 0 1 0 /end COMPU_METHOD
/begin COMPU_METHOD FORMULA_0997 "FORMULA_0997" RAT_FUNC "%8.3" "qcm" COEFFS 0 1000 0 0 0 1 /end COMPU_METHOD
/begin COMPU_METHOD FORMULA_0998 "FORMULA_0998" RAT_FUNC "%7.2" "ms" COEFFS 0 100 0 0 0 1 /end COMPU_METHOD
/* ------------------ Abschnitt erzeugt aus rf.dat ------------------ */
/begin COMPU_METHOD FORMULA_1065 "FORMULA_1065" RAT_FUNC "%5.2" "Segmente" COEFFS 0 2 0 0 0 1 /end COMPU_METHOD
/begin COMPU_METHOD FORMULA_1066 "FORMULA_1066" TAB_VERB "%5.2" "-" COMPU_TAB_REF FORMULA_1066_VTAB /end COMPU_METHOD
/begin COMPU_VTAB FORMULA_1066_VTAB "FORMULA_1066_VTAB" TAB_VERB 1 0 "RF_DYN aus" DEFAULT_VALUE "RF_DYN ein" /end COMPU_VTAB
/begin COMPU_METHOD FORMULA_1067 "FORMULA_1067" TAB_VERB "%5.2" "-" COMPU_TAB_REF FORMULA_1067_VTAB /end COMPU_METHOD
/begin COMPU_VTAB FORMULA_1067_VTAB "FORMULA_1067_VTAB" TAB_VERB 1 0 "RF_DYN aus" DEFAULT_VALUE "RF_DYN ein" /end COMPU_VTAB
/begin COMPU_METHOD FORMULA_1068 "FORMULA_1068" TAB_VERB "%5.2" "-" COMPU_TAB_REF FORMULA_1068_VTAB /end COMPU_METHOD
/begin COMPU_VTAB FORMULA_1068_VTAB "FORMULA_1068_VTAB" TAB_VERB 1 0 "RF_DYN aus" DEFAULT_VALUE "RF_DYN ein" /end COMPU_VTAB
/begin COMPU_METHOD FORMULA_1069 "FORMULA_1069" TAB_VERB "%5.2" "-" COMPU_TAB_REF FORMULA_1069_VTAB /end COMPU_METHOD
/begin COMPU_VTAB FORMULA_1069_VTAB "FORMULA_1069_VTAB" TAB_VERB 1 0 "RF_DYN aus" DEFAULT_VALUE "RF_DYN ein" /end COMPU_VTAB
/begin COMPU_METHOD FORMULA_1070 "FORMULA_1070" TAB_VERB "%5.2" "-" COMPU_TAB_REF FORMULA_1070_VTAB /end COMPU_METHOD
/begin COMPU_VTAB FORMULA_1070_VTAB "FORMULA_1070_VTAB" TAB_VERB 1 0 "RF_DYN aus" DEFAULT_VALUE "RF_DYN ein" /end COMPU_VTAB
/begin COMPU_METHOD FORMULA_1071 "FORMULA_1071" RAT_FUNC "%8.3" "dm**3" COEFFS 0 1000 0 0 0 1 /end COMPU_METHOD
/begin COMPU_METHOD FORMULA_1072 "FORMULA_1072" RAT_FUNC "%8.3" "Kg/m**3" COEFFS 0 1000 0 0 0 1 /end COMPU_METHOD
/begin COMPU_METHOD FORMULA_1073 "FORMULA_1073" RAT_FUNC "%3.0" "Segmente" COEFFS 0 2 0 0 0 1 /end COMPU_METHOD
/* ------------------ Abschnitt erzeugt aus rg.dat ------------------ */
/begin COMPU_METHOD FORMULA_1075 "FORMULA_1075" RAT_FUNC "%9.4" "mg/ccm" COEFFS 0 4096 0 0 0 1 /end COMPU_METHOD
/begin COMPU_METHOD FORMULA_1076 "FORMULA_1076" RAT_FUNC "%3.0" "seg" COEFFS 0 1 0 0 0 1 /end COMPU_METHOD
/begin COMPU_METHOD FORMULA_1077 "FORMULA_1077" RAT_FUNC "%6.1" "ccm" COEFFS 0 10 0 0 0 1 /end COMPU_METHOD
/begin COMPU_METHOD FORMULA_1078 "FORMULA_1078" RAT_FUNC "%7.2" "-" COEFFS 0 1000 0 0 0 1 /end COMPU_METHOD
/* ------------------ Abschnitt erzeugt aus schalter_inj.dat ------------------ */
/begin COMPU_METHOD FORMULA_1084 "FORMULA_1084" TAB_VERB "%7.2" "-" COMPU_TAB_REF FORMULA_1084_VTAB /end COMPU_METHOD
/begin COMPU_VTAB FORMULA_1084_VTAB "FORMULA_1084_VTAB" TAB_VERB 1 0 "offen" DEFAULT_VALUE "geschlossen" /end COMPU_VTAB
/begin COMPU_METHOD FORMULA_1085 "FORMULA_1085" TAB_VERB "%5.2" "-" COMPU_TAB_REF FORMULA_1085_VTAB /end COMPU_METHOD
/begin COMPU_VTAB FORMULA_1085_VTAB "FORMULA_1085_VTAB" TAB_VERB 2 0 "nein" 1 "ja" /end COMPU_VTAB
/begin COMPU_METHOD FORMULA_1086 "FORMULA_1086" TAB_VERB "%7.2" "-" COMPU_TAB_REF FORMULA_1086_VTAB /end COMPU_METHOD
/begin COMPU_VTAB FORMULA_1086_VTAB "FORMULA_1086_VTAB" TAB_VERB 1 0 "offen" DEFAULT_VALUE "Kraftschluss" /end COMPU_VTAB
/begin COMPU_METHOD FORMULA_1087 "FORMULA_1087" RAT_FUNC "%4.1" "%" COEFFS 0 128 0 0 0 100 /end COMPU_METHOD
/begin COMPU_METHOD FORMULA_1088 "FORMULA_1088" RAT_FUNC "%7.2" "Nm/Upm" COEFFS 0 5120 0 0 0 1 /end COMPU_METHOD
/* ------------------ Abschnitt erzeugt aus sk_inj.dat ------------------ */
/begin COMPU_METHOD FORMULA_1089 "FORMULA_1089" TAB_VERB "%3.0" "-" COMPU_TAB_REF FORMULA_1089_VTAB /end COMPU_METHOD
/begin COMPU_VTAB FORMULA_1089_VTAB "FORMULA_1089_VTAB" TAB_VERB 2 0 "Ok" 1 "AD-Err" /end COMPU_VTAB
/begin COMPU_METHOD FORMULA_1090 "FORMULA_1090" TAB_VERB "%3.0" "-" COMPU_TAB_REF FORMULA_1090_VTAB /end COMPU_METHOD
/begin COMPU_VTAB FORMULA_1090_VTAB "FORMULA_1090_VTAB" TAB_VERB 5 0 "Init" 1 "Wait" 2 "Error_1" 3 "Error_2" 4 "New" /end COMPU_VTAB
/begin COMPU_METHOD FORMULA_1091 "FORMULA_1091" RAT_FUNC "%3.0" "digit" COEFFS 0 1 0 0 0 1 /end COMPU_METHOD
/* ------------------ Abschnitt erzeugt aus sl.dat ------------------ */
/begin COMPU_METHOD FORMULA_1092 "FORMULA_1092" TAB_VERB "%5.2" "-" COMPU_TAB_REF FORMULA_1092_VTAB /end COMPU_METHOD
/begin COMPU_VTAB FORMULA_1092_VTAB "FORMULA_1092_VTAB" TAB_VERB 2 0 "HFM" 1 "LAM" /end COMPU_VTAB
/begin COMPU_METHOD FORMULA_1093 "FORMULA_1093" TAB_VERB "%5.2" "-" COMPU_TAB_REF FORMULA_1093_VTAB /end COMPU_METHOD
/begin COMPU_VTAB FORMULA_1093_VTAB "FORMULA_1093_VTAB" TAB_VERB 2 0 "ohne" 1 "mit" DEFAULT_VALUE "schmarn" /end COMPU_VTAB
/begin COMPU_METHOD FORMULA_1094 "FORMULA_1094" RAT_FUNC "%8.3" "-/100ms" COEFFS 0 32768 0 0 0 1 /end COMPU_METHOD
/begin COMPU_METHOD FORMULA_1095 "FORMULA_1095" RAT_FUNC "%8.3" "delta_lam" COEFFS 0 16384 0 0 0 1 /end COMPU_METHOD
/* ------------------ Abschnitt erzeugt aus sls_obd.dat ------------------ */
/begin COMPU_METHOD FORMULA_1096 "FORMULA_1096" RAT_FUNC "%8.1" "kg*s/h" COEFFS 0 1000 0 0 0 1 /end COMPU_METHOD
/begin COMPU_METHOD FORMULA_1097 "FORMULA_1097" RAT_FUNC "%6.1" "kg/h" COEFFS 0 125 0 0 0 1 /end COMPU_METHOD
/begin COMPU_METHOD FORMULA_1098 "FORMULA_1098" TAB_VERB "%8.1" "-" COMPU_TAB_REF FORMULA_1098_VTAB /end COMPU_METHOD
/begin COMPU_VTAB FORMULA_1098_VTAB "FORMULA_1098_VTAB" TAB_VERB 14 0 "nicht angelaufen" 1 "Mini-HFM IO" 2 "Mini-HFM NIO" 5 "ML-Plausi IO" 9 "SLP inaktiv" 17 "SLV kl.geschl.,Haupt-Ltg verstopft" 37 "MDF IO" 69 "SLS grobe Undichtigkeit" 133 "SLS blockiert" 293 "ZWD IO" 549 "ZWD klemmt" 1317 "SLV IO" 2341 "EUV haengt offen" 4389 "ASV re. haengt offen" /end COMPU_VTAB
/begin COMPU_METHOD FORMULA_1099 "FORMULA_1099" TAB_VERB "%6.1" "-" COMPU_TAB_REF FORMULA_1099_VTAB /end COMPU_METHOD
/begin COMPU_VTAB FORMULA_1099_VTAB "FORMULA_1099_VTAB" TAB_VERB 7 0 "nicht angelaufen" 1 "MDF DIAG IO" 2 "Max Intg zu gross" 4 "Min Intg zu gross" 16 "LAM B1 gr B2" 32 "LAM B1 kl B2" 64 "LAM B1 gl B2" DEFAULT_VALUE "undef" /end COMPU_VTAB
/begin COMPU_METHOD FORMULA_1100 "FORMULA_1100" TAB_VERB "%7.2" "-" COMPU_TAB_REF FORMULA_1100_VTAB /end COMPU_METHOD
/begin COMPU_VTAB FORMULA_1100_VTAB "FORMULA_1100_VTAB" TAB_VERB 1 0 "IO" DEFAULT_VALUE "abbruch" /end COMPU_VTAB
/begin COMPU_METHOD FORMULA_1101 "FORMULA_1101" TAB_VERB "%7.2" "-" COMPU_TAB_REF FORMULA_1101_VTAB /end COMPU_METHOD
/begin COMPU_VTAB FORMULA_1101_VTAB "FORMULA_1101_VTAB" TAB_VERB 2 0 "IO" 1 "abbruch" /end COMPU_VTAB
/begin COMPU_METHOD FORMULA_1102 "FORMULA_1102" TAB_VERB "%7.2" "-" COMPU_TAB_REF FORMULA_1102_VTAB /end COMPU_METHOD
/begin COMPU_VTAB FORMULA_1102_VTAB "FORMULA_1102_VTAB" TAB_VERB 2 0 "IO" 1 "abbruch" /end COMPU_VTAB
/begin COMPU_METHOD FORMULA_1103 "FORMULA_1103" TAB_VERB "%7.2" "-" COMPU_TAB_REF FORMULA_1103_VTAB /end COMPU_METHOD
/begin COMPU_VTAB FORMULA_1103_VTAB "FORMULA_1103_VTAB" TAB_VERB 2 0 "IO" 1 "abbruch" /end COMPU_VTAB
/begin COMPU_METHOD FORMULA_1104 "FORMULA_1104" TAB_VERB "%7.2" "-" COMPU_TAB_REF FORMULA_1104_VTAB /end COMPU_METHOD
/begin COMPU_VTAB FORMULA_1104_VTAB "FORMULA_1104_VTAB" TAB_VERB 2 0 "IO" 1 "abbruch" /end COMPU_VTAB
/begin COMPU_METHOD FORMULA_1105 "FORMULA_1105" TAB_VERB "%7.2" "-" COMPU_TAB_REF FORMULA_1105_VTAB /end COMPU_METHOD
/begin COMPU_VTAB FORMULA_1105_VTAB "FORMULA_1105_VTAB" TAB_VERB 2 0 "IO" 1 "abbruch" /end COMPU_VTAB
/begin COMPU_METHOD FORMULA_1106 "FORMULA_1106" TAB_VERB "%7.2" "-" COMPU_TAB_REF FORMULA_1106_VTAB /end COMPU_METHOD
/begin COMPU_VTAB FORMULA_1106_VTAB "FORMULA_1106_VTAB" TAB_VERB 2 0 "IO" 1 "abbruch" /end COMPU_VTAB
/begin COMPU_METHOD FORMULA_1107 "FORMULA_1107" TAB_VERB "%7.2" "-" COMPU_TAB_REF FORMULA_1107_VTAB /end COMPU_METHOD
/begin COMPU_VTAB FORMULA_1107_VTAB "FORMULA_1107_VTAB" TAB_VERB 2 0 "IO" 1 "abbruch" /end COMPU_VTAB
/begin COMPU_METHOD FORMULA_1108 "FORMULA_1108" TAB_VERB "%7.2" "-" COMPU_TAB_REF FORMULA_1108_VTAB /end COMPU_METHOD
/begin COMPU_VTAB FORMULA_1108_VTAB "FORMULA_1108_VTAB" TAB_VERB 2 0 "IO" 1 "abbruch" /end COMPU_VTAB
/begin COMPU_METHOD FORMULA_1109 "FORMULA_1109" TAB_VERB "%7.2" "-" COMPU_TAB_REF FORMULA_1109_VTAB /end COMPU_METHOD
/begin COMPU_VTAB FORMULA_1109_VTAB "FORMULA_1109_VTAB" TAB_VERB 2 0 "IO" 1 "abbruch" /end COMPU_VTAB
/begin COMPU_METHOD FORMULA_1110 "FORMULA_1110" TAB_VERB "%7.2" "-" COMPU_TAB_REF FORMULA_1110_VTAB /end COMPU_METHOD
/begin COMPU_VTAB FORMULA_1110_VTAB "FORMULA_1110_VTAB" TAB_VERB 2 0 "IO" 1 "abbruch" /end COMPU_VTAB
/begin COMPU_METHOD FORMULA_1111 "FORMULA_1111" TAB_VERB "%7.2" "-" COMPU_TAB_REF FORMULA_1111_VTAB /end COMPU_METHOD
/begin COMPU_VTAB FORMULA_1111_VTAB "FORMULA_1111_VTAB" TAB_VERB 2 0 "IO" 1 "abbruch" /end COMPU_VTAB
/begin COMPU_METHOD FORMULA_1112 "FORMULA_1112" TAB_VERB "%7.2" "-" COMPU_TAB_REF FORMULA_1112_VTAB /end COMPU_METHOD
/begin COMPU_VTAB FORMULA_1112_VTAB "FORMULA_1112_VTAB" TAB_VERB 2 0 "IO" 1 "abbruch" /end COMPU_VTAB
/begin COMPU_METHOD FORMULA_1113 "FORMULA_1113" TAB_VERB "%7.2" "-" COMPU_TAB_REF FORMULA_1113_VTAB /end COMPU_METHOD
/begin COMPU_VTAB FORMULA_1113_VTAB "FORMULA_1113_VTAB" TAB_VERB 2 0 "IO" 1 "abbruch" /end COMPU_VTAB
/begin COMPU_METHOD FORMULA_1114 "FORMULA_1114" TAB_VERB "%7.2" "-" COMPU_TAB_REF FORMULA_1114_VTAB /end COMPU_METHOD
/begin COMPU_VTAB FORMULA_1114_VTAB "FORMULA_1114_VTAB" TAB_VERB 2 0 "IO" 1 "abbruch" /end COMPU_VTAB
/begin COMPU_METHOD FORMULA_1115 "FORMULA_1115" TAB_VERB "%7.2" "-" COMPU_TAB_REF FORMULA_1115_VTAB /end COMPU_METHOD
/begin COMPU_VTAB FORMULA_1115_VTAB "FORMULA_1115_VTAB" TAB_VERB 2 0 "IO" 1 "abbruch" /end COMPU_VTAB
/begin COMPU_METHOD FORMULA_1116 "FORMULA_1116" TAB_VERB "%7.2" "-" COMPU_TAB_REF FORMULA_1116_VTAB /end COMPU_METHOD
/begin COMPU_VTAB FORMULA_1116_VTAB "FORMULA_1116_VTAB" TAB_VERB 2 0 "IO" 1 "abbruch" /end COMPU_VTAB
/begin COMPU_METHOD FORMULA_1117 "FORMULA_1117" RAT_FUNC "%10.3" "-*s" COEFFS 0 16384 0 0 0 1 /end COMPU_METHOD
/begin COMPU_METHOD FORMULA_1118 "FORMULA_1118" RAT_FUNC "%6.1" "kg/h/0.01s" COEFFS 0 10 0 0 0 1 /end COMPU_METHOD
/begin COMPU_METHOD FORMULA_1119 "FORMULA_1119" TAB_VERB "%5.2" "-" COMPU_TAB_REF FORMULA_1119_VTAB /end COMPU_METHOD
/begin COMPU_VTAB FORMULA_1119_VTAB "FORMULA_1119_VTAB" TAB_VERB 2 0 "AUS" 1 "AN" DEFAULT_VALUE "undefiniert" /end COMPU_VTAB
/begin COMPU_METHOD FORMULA_1120 "FORMULA_1120" RAT_FUNC "%8.3" "kg*s/h" COEFFS 0 1000 0 0 0 1 /end COMPU_METHOD
/begin COMPU_METHOD FORMULA_1121 "FORMULA_1121" TAB_VERB "%5.2" "-" COMPU_TAB_REF FORMULA_1121_VTAB /end COMPU_METHOD
/begin COMPU_VTAB FORMULA_1121_VTAB "FORMULA_1121_VTAB" TAB_VERB 5 0 "AUS" 2 "AN-HFM" 4 "AN-LAM" 8 "Prueflauf" 10 "AN-HFM-PL" DEFAULT_VALUE "undefiniert" /end COMPU_VTAB
/begin COMPU_METHOD FORMULA_1122 "FORMULA_1122" TAB_VERB "%5.2" "-" COMPU_TAB_REF FORMULA_1122_VTAB /end COMPU_METHOD
/begin COMPU_VTAB FORMULA_1122_VTAB "FORMULA_1122_VTAB" TAB_VERB 2 0 "SL_ML_SOLL" 2 "Modell" DEFAULT_VALUE "undefiniert" /end COMPU_VTAB
/begin COMPU_METHOD FORMULA_1123 "FORMULA_1123" RAT_FUNC "%9.4" "J/(kg*K*m^4)" COEFFS 0 65535 0 0 0 1 /end COMPU_METHOD
/begin COMPU_METHOD FORMULA_1124 "FORMULA_1124" RAT_FUNC "%8.3" "kg/h" COEFFS 0 125 0 0 0 1 /end COMPU_METHOD
/* ------------------ Abschnitt erzeugt aus ssp.dat ------------------ */
/begin COMPU_METHOD FORMULA_1127 "FORMULA_1127" RAT_FUNC "%8.1" "qmm" COEFFS 0 10 0 0 0 1 /end COMPU_METHOD
/begin COMPU_METHOD FORMULA_1128 "FORMULA_1128" TAB_VERB "%3.0" "-" COMPU_TAB_REF FORMULA_1128_VTAB /end COMPU_METHOD
/begin COMPU_VTAB FORMULA_1128_VTAB "FORMULA_1128_VTAB" TAB_VERB 3 0 "SSP-Funktion" 1 "Treiber an [SSP aus]" 2 "Treiber aus [SSP an]" /end COMPU_VTAB
/* ------------------ Abschnitt erzeugt aus ram_chk.dat ------------------ */
/begin CHARACTERISTIC K_RAM_CHK_T "Zeit fuer den Ramcheck pro Aufruf" VALUE 0x7639C TKW_VV_VV_UB 100.0 FORMULA_0356 1.0000 255.0000 /end CHARACTERISTIC
/begin CHARACTERISTIC K_RAM_CHK_CFG "Ramcheck Config | EN: Ramcheck Config" VALUE 0x7639D TKW_VV_VV_UB 100.0 FORMULA_0357 0.0 255.0 /end CHARACTERISTIC
/begin MEASUREMENT ram_chk_rptr "aktueller RAM_CHK Zeiger" ULONG FORMULA_0000 0 0 0.0 4294967295.0000 ECU_ADDRESS 0x3FCE6C /end MEASUREMENT
/begin MEASUREMENT ram_chk_freq "Ueberprufeungsfreuquenz RAM" UWORD FORMULA_0355 0 0 0.0 655.3500 ECU_ADDRESS 0x3FCE70 /end MEASUREMENT
/* ------------------ Abschnitt erzeugt aus sk.dat ------------------ */
/begin CHARACTERISTIC K_SK_CFG "SK-Cfg" VALUE 0x76778 TKW_VV_VV_UB 100.0 FORMULA_0363 0.0 255.0 /end CHARACTERISTIC
/begin CHARACTERISTIC K_SK_MAX_RESETS "max. Anzahl von Resets pro SG-Lauf | EN: Maximum number of resets per ECU run" VALUE 0x76779 TKW_VV_VV_UB 100.0 FORMULA_0003 0.0 255.0000 /end CHARACTERISTIC
/begin CHARACTERISTIC K_SK_FM_GEMISCH_TEST "SK Gemischtestmaske | EN: Safety-concept mixture test mask" VALUE 0x7677A TKW_VV_VV_UB 100.0 FORMULA_0003 0.0 255.0000 /end CHARACTERISTIC
/begin CHARACTERISTIC K_SK_FM_KR_TEST "SK KR-Testmaske" VALUE 0x7677B TKW_VV_VV_UB 100.0 FORMULA_0003 0.0 255.0000 /end CHARACTERISTIC
/begin CHARACTERISTIC K_SK_FM_EGAS_TEST "SK Egastestmaske | EN: Safety-concept E-gas test mask" VALUE 0x7677C TKW_VV_VV_UB 100.0 FORMULA_0003 0.0 255.0000 /end CHARACTERISTIC
/begin CHARACTERISTIC K_SK_ZYL_OFF_MAX "Anzahl der abg. Zyl. pro Bank | EN: Number of cylinders cut per bank" VALUE 0x7677D TKW_VV_VV_UB 100.0 FORMULA_0003 0.0 255.0000 /end CHARACTERISTIC
/begin CHARACTERISTIC K_SK_FM_FAIL_ZYL_TEST "SK TI-Testmaske (1=Aus) | EN: Safety-concept injection test mask (1=off)" VALUE 0x7677E TKW_VV_VV_UW 100.0 FORMULA_0010 0.0 65535.0000 /end CHARACTERISTIC
/begin CHARACTERISTIC K_SK_FM_SMG_TEST "SK SMG-Testmaske | EN: Safety-concept SMG test mask" VALUE 0x76780 TKW_VV_VV_UB 100.0 FORMULA_0003 0.0 255.0000 /end CHARACTERISTIC
/begin CHARACTERISTIC K_SK_FM_MD_TEST "SK Md-Testmaske | EN: Safety-concept torque test mask" VALUE 0x76781 TKW_VV_VV_UB 100.0 FORMULA_0003 0.0 255.0000 /end CHARACTERISTIC
/begin CHARACTERISTIC K_SK_FM_LAM_TEST "SK LAM-Testmaske | EN: Safety-concept lambda test mask" VALUE 0x76782 TKW_VV_VV_UB 100.0 FORMULA_0003 0.0 255.0000 /end CHARACTERISTIC
/begin CHARACTERISTIC K_SK_FM_MVAC_TEST "SK MVAC-Testmaske" VALUE 0x76783 TKW_VV_VV_UB 100.0 FORMULA_0364 0.0 255.0 /end CHARACTERISTIC
/begin CHARACTERISTIC K_SK_MAX_OS_ERR "erlaubte OS-Fehler bis zum Reset | EN: Permitted operating-system faults before reset" VALUE 0x76784 TKW_VV_VV_UB 100.0 FORMULA_0003 0.0 255.0000 /end CHARACTERISTIC
/begin CHARACTERISTIC K_SK_TASK_ERR "Maske Taskueberwachung | EN: Task monitoring mask" VALUE 0x76785 TKW_VV_VV_UB 100.0 FORMULA_0003 0.0 255.0000 /end CHARACTERISTIC
/begin CHARACTERISTIC K_SK_CRC32 "CRC32-Aktivierung" VALUE 0x76786 TKW_VV_VV_UB 100.0 FORMULA_0365 0.0 255.0 /end CHARACTERISTIC
/begin CHARACTERISTIC K_SK_PKS_NOTLAUF "PKS-Aktivierung | EN: Fuel-pressure-control activation" VALUE 0x76787 TKW_VV_VV_UB 100.0 FORMULA_0003 0.0 255.0000 /end CHARACTERISTIC
/begin CHARACTERISTIC K_SK_LLRA_SPERRE "LLRA-Sperre | EN: Idle-controller adaptation lock" VALUE 0x76788 TKW_VV_VV_UB 100.0 FORMULA_0003 0.0 255.0000 /end CHARACTERISTIC
/begin CHARACTERISTIC K_SK_FRA_SPERRE "FRA-Sperre | EN: Charge-adaptation lock" VALUE 0x76789 TKW_VV_VV_UB 100.0 FORMULA_0003 0.0 255.0000 /end CHARACTERISTIC
/begin CHARACTERISTIC K_SK_KH_SPERRE "KH-Sperre | EN: Catalyst-heating lock" VALUE 0x7678A TKW_VV_VV_UB 100.0 FORMULA_0003 0.0 255.0000 /end CHARACTERISTIC
/begin CHARACTERISTIC K_SK_FGR_SPERRE "FGR-Sperre | EN: Cruise control lock" VALUE 0x7678B TKW_VV_VV_UB 100.0 FORMULA_0003 0.0 255.0000 /end CHARACTERISTIC
/begin CHARACTERISTIC K_SK_MD_TI_EINGR "Freigabe Teilfeuern | EN: Enable partial firing (cylinder cut-out)" VALUE 0x7678C TKW_VV_VV_UB 100.0 FORMULA_0003 0.0 255.0000 /end CHARACTERISTIC
/begin CHARACTERISTIC K_SK_MD_VL_SPERRE "VL-Sperre | EN: Full-load lock" VALUE 0x7678D TKW_VV_VV_UB 100.0 FORMULA_0003 0.0 255.0000 /end CHARACTERISTIC
/begin CHARACTERISTIC K_SK_MD_BEGR_DK_OFFEN "Begrenzung bei offenen Klappen | EN: Limitation with open flaps" VALUE 0x7678E TKW_VV_VV_UB 100.0 FORMULA_0003 0.0 255.0000 /end CHARACTERISTIC
/begin CHARACTERISTIC K_SK_LAM_EINGR_TI "LA-Eingriff bei Teilfeuerung" VALUE 0x7678F TKW_VV_VV_UB 100.0 FORMULA_0366 0.0 255.0 /end CHARACTERISTIC
/begin CHARACTERISTIC K_SK_T_RESET_DELAY_OS "Resetdelay fuer Betriebssystem Fehler | EN: Reset delay for operating-system fault [s]" VALUE 0x76790 TKW_VV_VV_UB 100.0 FORMULA_0317 0.0 2.0000 /end CHARACTERISTIC
/begin CHARACTERISTIC K_SK_EGAS_OFF_TIME "Zeit bis Egasabschaltung | EN: Time until throttle (E-gas) shut-off [s]" VALUE 0x76792 TKW_VV_VV_UW 100.0 FORMULA_0021 0.0 5.0000 FORMAT "%5.2" /end CHARACTERISTIC
/begin CHARACTERISTIC K_SK_PROZ_ERR "Maske Prozessueberwachung | EN: Process monitoring mask" VALUE 0x76794 TKW_VV_VV_UW 100.0 FORMULA_0010 0.0 65535.0000 /end CHARACTERISTIC
/begin CHARACTERISTIC K_SK_MD_BEGR_MVAC_SYS "Begrenzung bei MVAC-Systemfehler | EN: Limitation with brake-booster vacuum system fault" VALUE 0x76796 TKW_VV_VV_UB 100.0 FORMULA_0003 0.0 255.0000 /end CHARACTERISTIC
/begin CHARACTERISTIC K_SK_MD_BEGR_RESET "Begrenzung ab dem 1.Reset | EN: Limitation from the 1st reset" VALUE 0x76797 TKW_VV_VV_UB 100.0 FORMULA_0003 0.0 255.0000 /end CHARACTERISTIC
/begin CHARACTERISTIC K_SK_EGAS_OFF_1of16_ "DK2 DK1 LLS2 LLS1 | EN: DK2 DK1 LLS2 LLS1" VALUE 0x76798 TKW_VV_VV_UB 100.0 FORMULA_0003 0.0 255.0000 /end CHARACTERISTIC
/begin CHARACTERISTIC K_SK_EGAS_OFF_2of16_ "DK2 DK1 LLS2 LLS1 | EN: DK2 DK1 LLS2 LLS1" VALUE 0x76799 TKW_VV_VV_UB 100.0 FORMULA_0003 0.0 255.0000 /end CHARACTERISTIC
/begin CHARACTERISTIC K_SK_EGAS_OFF_3of16_ "DK2 DK1 LLS2 LLS1 | EN: DK2 DK1 LLS2 LLS1" VALUE 0x7679A TKW_VV_VV_UB 100.0 FORMULA_0003 0.0 255.0000 /end CHARACTERISTIC
/begin CHARACTERISTIC K_SK_EGAS_OFF_4of16_ "DK2 DK1 LLS2 LLS1 | EN: DK2 DK1 LLS2 LLS1" VALUE 0x7679B TKW_VV_VV_UB 100.0 FORMULA_0003 0.0 255.0000 /end CHARACTERISTIC
/begin CHARACTERISTIC K_SK_EGAS_OFF_5of16_ "DK2 DK1 LLS2 LLS1 | EN: DK2 DK1 LLS2 LLS1" VALUE 0x7679C TKW_VV_VV_UB 100.0 FORMULA_0003 0.0 255.0000 /end CHARACTERISTIC
/begin CHARACTERISTIC K_SK_EGAS_OFF_6of16_ "DK2 DK1 LLS2 LLS1" VALUE 0x7679D TKW_VV_VV_UB 100.0 FORMULA_0003 0.0 255.0000 /end CHARACTERISTIC
/begin CHARACTERISTIC K_SK_EGAS_OFF_7of16_ "DK2 DK1 LLS2 LLS1 | EN: DK2 DK1 LLS2 LLS1" VALUE 0x7679E TKW_VV_VV_UB 100.0 FORMULA_0003 0.0 255.0000 /end CHARACTERISTIC
/begin CHARACTERISTIC K_SK_EGAS_OFF_8of16_ "DK2 DK1 LLS2 LLS1" VALUE 0x7679F TKW_VV_VV_UB 100.0 FORMULA_0003 0.0 255.0000 /end CHARACTERISTIC
/begin CHARACTERISTIC K_SK_EGAS_OFF_9of16_ "DK2 DK1 LLS2 LLS1" VALUE 0x767A0 TKW_VV_VV_UB 100.0 FORMULA_0003 0.0 255.0000 /end CHARACTERISTIC
/begin CHARACTERISTIC K_SK_EGAS_OFF_10of16_ "DK2 DK1 LLS2 LLS1" VALUE 0x767A1 TKW_VV_VV_UB 100.0 FORMULA_0003 0.0 255.0000 /end CHARACTERISTIC
/begin CHARACTERISTIC K_SK_EGAS_OFF_11of16_ "DK2 DK1 LLS2 LLS1" VALUE 0x767A2 TKW_VV_VV_UB 100.0 FORMULA_0003 0.0 255.0000 /end CHARACTERISTIC
/begin CHARACTERISTIC K_SK_EGAS_OFF_12of16_ "DK2 DK1 LLS2 LLS1" VALUE 0x767A3 TKW_VV_VV_UB 100.0 FORMULA_0003 0.0 255.0000 /end CHARACTERISTIC
/begin CHARACTERISTIC K_SK_EGAS_OFF_13of16_ "DK2 DK1 LLS2 LLS1" VALUE 0x767A4 TKW_VV_VV_UB 100.0 FORMULA_0003 0.0 255.0000 /end CHARACTERISTIC
/begin CHARACTERISTIC K_SK_EGAS_OFF_14of16_ "DK2 DK1 LLS2 LLS1 | EN: DK2 DK1 LLS2 LLS1" VALUE 0x767A5 TKW_VV_VV_UB 100.0 FORMULA_0003 0.0 255.0000 /end CHARACTERISTIC
/begin CHARACTERISTIC K_SK_EGAS_OFF_15of16_ "DK2 DK1 LLS2 LLS1 | EN: DK2 DK1 LLS2 LLS1" VALUE 0x767A6 TKW_VV_VV_UB 100.0 FORMULA_0003 0.0 255.0000 /end CHARACTERISTIC
/begin CHARACTERISTIC K_SK_EGAS_OFF_16of16_ "DK2 DK1 LLS2 LLS1 | EN: DK2 DK1 LLS2 LLS1" VALUE 0x767A7 TKW_VV_VV_UB 100.0 FORMULA_0003 0.0 255.0000 /end CHARACTERISTIC
/begin CHARACTERISTIC K_SK_MD_BEGR_EGAS_1of64_ "WDK2 WDK1 DK2 DK1 LLS2 LLS1 | EN: WDK2 WDK1 DK2 DK1 LLS2 LLS1" VALUE 0x767A8 TKW_VV_VV_UB 100.0 FORMULA_0003 0.0 255.0000 /end CHARACTERISTIC
/begin CHARACTERISTIC K_SK_MD_BEGR_EGAS_2of64_ "WDK2 WDK1 DK2 DK1 LLS2 LLS1 | EN: WDK2 WDK1 DK2 DK1 LLS2 LLS1" VALUE 0x767A9 TKW_VV_VV_UB 100.0 FORMULA_0003 0.0 255.0000 /end CHARACTERISTIC
/begin CHARACTERISTIC K_SK_MD_BEGR_EGAS_3of64_ "WDK2 WDK1 DK2 DK1 LLS2 LLS1 | EN: WDK2 WDK1 DK2 DK1 LLS2 LLS1" VALUE 0x767AA TKW_VV_VV_UB 100.0 FORMULA_0003 0.0 255.0000 /end CHARACTERISTIC
/begin CHARACTERISTIC K_SK_MD_BEGR_EGAS_4of64_ "WDK2 WDK1 DK2 DK1 LLS2 LLS1 | EN: WDK2 WDK1 DK2 DK1 LLS2 LLS1" VALUE 0x767AB TKW_VV_VV_UB 100.0 FORMULA_0003 0.0 255.0000 /end CHARACTERISTIC
/begin CHARACTERISTIC K_SK_MD_BEGR_EGAS_5of64_ "WDK2 WDK1 DK2 DK1 LLS2 LLS1 | EN: WDK2 WDK1 DK2 DK1 LLS2 LLS1" VALUE 0x767AC TKW_VV_VV_UB 100.0 FORMULA_0003 0.0 255.0000 /end CHARACTERISTIC
/begin CHARACTERISTIC K_SK_MD_BEGR_EGAS_6of64_ "WDK2 WDK1 DK2 DK1 LLS2 LLS1 | EN: WDK2 WDK1 DK2 DK1 LLS2 LLS1" VALUE 0x767AD TKW_VV_VV_UB 100.0 FORMULA_0003 0.0 255.0000 /end CHARACTERISTIC
/begin CHARACTERISTIC K_SK_MD_BEGR_EGAS_7of64_ "WDK2 WDK1 DK2 DK1 LLS2 LLS1 | EN: WDK2 WDK1 DK2 DK1 LLS2 LLS1" VALUE 0x767AE TKW_VV_VV_UB 100.0 FORMULA_0003 0.0 255.0000 /end CHARACTERISTIC
/begin CHARACTERISTIC K_SK_MD_BEGR_EGAS_8of64_ "WDK2 WDK1 DK2 DK1 LLS2 LLS1 | EN: WDK2 WDK1 DK2 DK1 LLS2 LLS1" VALUE 0x767AF TKW_VV_VV_UB 100.0 FORMULA_0003 0.0 255.0000 /end CHARACTERISTIC
/begin CHARACTERISTIC K_SK_MD_BEGR_EGAS_9of64_ "WDK2 WDK1 DK2 DK1 LLS2 LLS1 | EN: WDK2 WDK1 DK2 DK1 LLS2 LLS1" VALUE 0x767B0 TKW_VV_VV_UB 100.0 FORMULA_0003 0.0 255.0000 /end CHARACTERISTIC
/begin CHARACTERISTIC K_SK_MD_BEGR_EGAS_10of64_ "WDK2 WDK1 DK2 DK1 LLS2 LLS1 | EN: WDK2 WDK1 DK2 DK1 LLS2 LLS1" VALUE 0x767B1 TKW_VV_VV_UB 100.0 FORMULA_0003 0.0 255.0000 /end CHARACTERISTIC
/begin CHARACTERISTIC K_SK_MD_BEGR_EGAS_11of64_ "WDK2 WDK1 DK2 DK1 LLS2 LLS1 | EN: WDK2 WDK1 DK2 DK1 LLS2 LLS1" VALUE 0x767B2 TKW_VV_VV_UB 100.0 FORMULA_0003 0.0 255.0000 /end CHARACTERISTIC
/begin CHARACTERISTIC K_SK_MD_BEGR_EGAS_12of64_ "WDK2 WDK1 DK2 DK1 LLS2 LLS1 | EN: WDK2 WDK1 DK2 DK1 LLS2 LLS1" VALUE 0x767B3 TKW_VV_VV_UB 100.0 FORMULA_0003 0.0 255.0000 /end CHARACTERISTIC
/begin CHARACTERISTIC K_SK_MD_BEGR_EGAS_13of64_ "WDK2 WDK1 DK2 DK1 LLS2 LLS1 | EN: WDK2 WDK1 DK2 DK1 LLS2 LLS1" VALUE 0x767B4 TKW_VV_VV_UB 100.0 FORMULA_0003 0.0 255.0000 /end CHARACTERISTIC
/begin CHARACTERISTIC K_SK_MD_BEGR_EGAS_14of64_ "WDK2 WDK1 DK2 DK1 LLS2 LLS1 | EN: WDK2 WDK1 DK2 DK1 LLS2 LLS1" VALUE 0x767B5 TKW_VV_VV_UB 100.0 FORMULA_0003 0.0 255.0000 /end CHARACTERISTIC
/begin CHARACTERISTIC K_SK_MD_BEGR_EGAS_15of64_ "WDK2 WDK1 DK2 DK1 LLS2 LLS1 | EN: WDK2 WDK1 DK2 DK1 LLS2 LLS1" VALUE 0x767B6 TKW_VV_VV_UB 100.0 FORMULA_0003 0.0 255.0000 /end CHARACTERISTIC
/begin CHARACTERISTIC K_SK_MD_BEGR_EGAS_16of64_ "WDK2 WDK1 DK2 DK1 LLS2 LLS1 | EN: WDK2 WDK1 DK2 DK1 LLS2 LLS1" VALUE 0x767B7 TKW_VV_VV_UB 100.0 FORMULA_0003 0.0 255.0000 /end CHARACTERISTIC
/begin CHARACTERISTIC K_SK_MD_BEGR_EGAS_17of64_ "WDK2 WDK1 DK2 DK1 LLS2 LLS1" VALUE 0x767B8 TKW_VV_VV_UB 100.0 FORMULA_0003 0.0 255.0000 /end CHARACTERISTIC
/begin CHARACTERISTIC K_SK_MD_BEGR_EGAS_18of64_ "WDK2 WDK1 DK2 DK1 LLS2 LLS1" VALUE 0x767B9 TKW_VV_VV_UB 100.0 FORMULA_0003 0.0 255.0000 /end CHARACTERISTIC
/begin CHARACTERISTIC K_SK_MD_BEGR_EGAS_19of64_ "WDK2 WDK1 DK2 DK1 LLS2 LLS1" VALUE 0x767BA TKW_VV_VV_UB 100.0 FORMULA_0003 0.0 255.0000 /end CHARACTERISTIC
/begin CHARACTERISTIC K_SK_MD_BEGR_EGAS_20of64_ "WDK2 WDK1 DK2 DK1 LLS2 LLS1" VALUE 0x767BB TKW_VV_VV_UB 100.0 FORMULA_0003 0.0 255.0000 /end CHARACTERISTIC
/begin CHARACTERISTIC K_SK_MD_BEGR_EGAS_21of64_ "WDK2 WDK1 DK2 DK1 LLS2 LLS1" VALUE 0x767BC TKW_VV_VV_UB 100.0 FORMULA_0003 0.0 255.0000 /end CHARACTERISTIC
/begin CHARACTERISTIC K_SK_MD_BEGR_EGAS_22of64_ "WDK2 WDK1 DK2 DK1 LLS2 LLS1" VALUE 0x767BD TKW_VV_VV_UB 100.0 FORMULA_0003 0.0 255.0000 /end CHARACTERISTIC
/begin CHARACTERISTIC K_SK_MD_BEGR_EGAS_23of64_ "WDK2 WDK1 DK2 DK1 LLS2 LLS1" VALUE 0x767BE TKW_VV_VV_UB 100.0 FORMULA_0003 0.0 255.0000 /end CHARACTERISTIC
/begin CHARACTERISTIC K_SK_MD_BEGR_EGAS_24of64_ "WDK2 WDK1 DK2 DK1 LLS2 LLS1" VALUE 0x767BF TKW_VV_VV_UB 100.0 FORMULA_0003 0.0 255.0000 /end CHARACTERISTIC
/begin CHARACTERISTIC K_SK_MD_BEGR_EGAS_25of64_ "WDK2 WDK1 DK2 DK1 LLS2 LLS1 | EN: WDK2 WDK1 DK2 DK1 LLS2 LLS1" VALUE 0x767C0 TKW_VV_VV_UB 100.0 FORMULA_0003 0.0 255.0000 /end CHARACTERISTIC
/begin CHARACTERISTIC K_SK_MD_BEGR_EGAS_26of64_ "WDK2 WDK1 DK2 DK1 LLS2 LLS1 | EN: WDK2 WDK1 DK2 DK1 LLS2 LLS1" VALUE 0x767C1 TKW_VV_VV_UB 100.0 FORMULA_0003 0.0 255.0000 /end CHARACTERISTIC
/begin CHARACTERISTIC K_SK_MD_BEGR_EGAS_27of64_ "WDK2 WDK1 DK2 DK1 LLS2 LLS1 | EN: WDK2 WDK1 DK2 DK1 LLS2 LLS1" VALUE 0x767C2 TKW_VV_VV_UB 100.0 FORMULA_0003 0.0 255.0000 /end CHARACTERISTIC
/begin CHARACTERISTIC K_SK_MD_BEGR_EGAS_28of64_ "WDK2 WDK1 DK2 DK1 LLS2 LLS1 | EN: WDK2 WDK1 DK2 DK1 LLS2 LLS1" VALUE 0x767C3 TKW_VV_VV_UB 100.0 FORMULA_0003 0.0 255.0000 /end CHARACTERISTIC
/begin CHARACTERISTIC K_SK_MD_BEGR_EGAS_29of64_ "WDK2 WDK1 DK2 DK1 LLS2 LLS1" VALUE 0x767C4 TKW_VV_VV_UB 100.0 FORMULA_0003 0.0 255.0000 /end CHARACTERISTIC
/begin CHARACTERISTIC K_SK_MD_BEGR_EGAS_30of64_ "WDK2 WDK1 DK2 DK1 LLS2 LLS1" VALUE 0x767C5 TKW_VV_VV_UB 100.0 FORMULA_0003 0.0 255.0000 /end CHARACTERISTIC
/begin CHARACTERISTIC K_SK_MD_BEGR_EGAS_31of64_ "WDK2 WDK1 DK2 DK1 LLS2 LLS1" VALUE 0x767C6 TKW_VV_VV_UB 100.0 FORMULA_0003 0.0 255.0000 /end CHARACTERISTIC
/begin CHARACTERISTIC K_SK_MD_BEGR_EGAS_32of64_ "WDK2 WDK1 DK2 DK1 LLS2 LLS1" VALUE 0x767C7 TKW_VV_VV_UB 100.0 FORMULA_0003 0.0 255.0000 /end CHARACTERISTIC
/begin CHARACTERISTIC K_SK_MD_BEGR_EGAS_33of64_ "WDK2 WDK1 DK2 DK1 LLS2 LLS1" VALUE 0x767C8 TKW_VV_VV_UB 100.0 FORMULA_0003 0.0 255.0000 /end CHARACTERISTIC
/begin CHARACTERISTIC K_SK_MD_BEGR_EGAS_34of64_ "WDK2 WDK1 DK2 DK1 LLS2 LLS1" VALUE 0x767C9 TKW_VV_VV_UB 100.0 FORMULA_0003 0.0 255.0000 /end CHARACTERISTIC
/begin CHARACTERISTIC K_SK_MD_BEGR_EGAS_35of64_ "WDK2 WDK1 DK2 DK1 LLS2 LLS1" VALUE 0x767CA TKW_VV_VV_UB 100.0 FORMULA_0003 0.0 255.0000 /end CHARACTERISTIC
/begin CHARACTERISTIC K_SK_MD_BEGR_EGAS_36of64_ "WDK2 WDK1 DK2 DK1 LLS2 LLS1" VALUE 0x767CB TKW_VV_VV_UB 100.0 FORMULA_0003 0.0 255.0000 /end CHARACTERISTIC
/begin CHARACTERISTIC K_SK_MD_BEGR_EGAS_37of64_ "WDK2 WDK1 DK2 DK1 LLS2 LLS1" VALUE 0x767CC TKW_VV_VV_UB 100.0 FORMULA_0003 0.0 255.0000 /end CHARACTERISTIC
/begin CHARACTERISTIC K_SK_MD_BEGR_EGAS_38of64_ "WDK2 WDK1 DK2 DK1 LLS2 LLS1" VALUE 0x767CD TKW_VV_VV_UB 100.0 FORMULA_0003 0.0 255.0000 /end CHARACTERISTIC
/begin CHARACTERISTIC K_SK_MD_BEGR_EGAS_39of64_ "WDK2 WDK1 DK2 DK1 LLS2 LLS1" VALUE 0x767CE TKW_VV_VV_UB 100.0 FORMULA_0003 0.0 255.0000 /end CHARACTERISTIC
/begin CHARACTERISTIC K_SK_MD_BEGR_EGAS_40of64_ "WDK2 WDK1 DK2 DK1 LLS2 LLS1" VALUE 0x767CF TKW_VV_VV_UB 100.0 FORMULA_0003 0.0 255.0000 /end CHARACTERISTIC
/begin CHARACTERISTIC K_SK_MD_BEGR_EGAS_41of64_ "WDK2 WDK1 DK2 DK1 LLS2 LLS1 | EN: WDK2 WDK1 DK2 DK1 LLS2 LLS1" VALUE 0x767D0 TKW_VV_VV_UB 100.0 FORMULA_0003 0.0 255.0000 /end CHARACTERISTIC
/begin CHARACTERISTIC K_SK_MD_BEGR_EGAS_42of64_ "WDK2 WDK1 DK2 DK1 LLS2 LLS1 | EN: WDK2 WDK1 DK2 DK1 LLS2 LLS1" VALUE 0x767D1 TKW_VV_VV_UB 100.0 FORMULA_0003 0.0 255.0000 /end CHARACTERISTIC
/begin CHARACTERISTIC K_SK_MD_BEGR_EGAS_43of64_ "WDK2 WDK1 DK2 DK1 LLS2 LLS1 | EN: WDK2 WDK1 DK2 DK1 LLS2 LLS1" VALUE 0x767D2 TKW_VV_VV_UB 100.0 FORMULA_0003 0.0 255.0000 /end CHARACTERISTIC
/begin CHARACTERISTIC K_SK_MD_BEGR_EGAS_44of64_ "WDK2 WDK1 DK2 DK1 LLS2 LLS1 | EN: WDK2 WDK1 DK2 DK1 LLS2 LLS1" VALUE 0x767D3 TKW_VV_VV_UB 100.0 FORMULA_0003 0.0 255.0000 /end CHARACTERISTIC
/begin CHARACTERISTIC K_SK_MD_BEGR_EGAS_45of64_ "WDK2 WDK1 DK2 DK1 LLS2 LLS1" VALUE 0x767D4 TKW_VV_VV_UB 100.0 FORMULA_0003 0.0 255.0000 /end CHARACTERISTIC
/begin CHARACTERISTIC K_SK_MD_BEGR_EGAS_46of64_ "WDK2 WDK1 DK2 DK1 LLS2 LLS1" VALUE 0x767D5 TKW_VV_VV_UB 100.0 FORMULA_0003 0.0 255.0000 /end CHARACTERISTIC
/begin CHARACTERISTIC K_SK_MD_BEGR_EGAS_47of64_ "WDK2 WDK1 DK2 DK1 LLS2 LLS1" VALUE 0x767D6 TKW_VV_VV_UB 100.0 FORMULA_0003 0.0 255.0000 /end CHARACTERISTIC
/begin CHARACTERISTIC K_SK_MD_BEGR_EGAS_48of64_ "WDK2 WDK1 DK2 DK1 LLS2 LLS1" VALUE 0x767D7 TKW_VV_VV_UB 100.0 FORMULA_0003 0.0 255.0000 /end CHARACTERISTIC
/begin CHARACTERISTIC K_SK_MD_BEGR_EGAS_49of64_ "WDK2 WDK1 DK2 DK1 LLS2 LLS1" VALUE 0x767D8 TKW_VV_VV_UB 100.0 FORMULA_0003 0.0 255.0000 /end CHARACTERISTIC
/begin CHARACTERISTIC K_SK_MD_BEGR_EGAS_50of64_ "WDK2 WDK1 DK2 DK1 LLS2 LLS1" VALUE 0x767D9 TKW_VV_VV_UB 100.0 FORMULA_0003 0.0 255.0000 /end CHARACTERISTIC
/begin CHARACTERISTIC K_SK_MD_BEGR_EGAS_51of64_ "WDK2 WDK1 DK2 DK1 LLS2 LLS1" VALUE 0x767DA TKW_VV_VV_UB 100.0 FORMULA_0003 0.0 255.0000 /end CHARACTERISTIC
/begin CHARACTERISTIC K_SK_MD_BEGR_EGAS_52of64_ "WDK2 WDK1 DK2 DK1 LLS2 LLS1" VALUE 0x767DB TKW_VV_VV_UB 100.0 FORMULA_0003 0.0 255.0000 /end CHARACTERISTIC
/begin CHARACTERISTIC K_SK_MD_BEGR_EGAS_53of64_ "WDK2 WDK1 DK2 DK1 LLS2 LLS1" VALUE 0x767DC TKW_VV_VV_UB 100.0 FORMULA_0003 0.0 255.0000 /end CHARACTERISTIC
/begin CHARACTERISTIC K_SK_MD_BEGR_EGAS_54of64_ "WDK2 WDK1 DK2 DK1 LLS2 LLS1" VALUE 0x767DD TKW_VV_VV_UB 100.0 FORMULA_0003 0.0 255.0000 /end CHARACTERISTIC
/begin CHARACTERISTIC K_SK_MD_BEGR_EGAS_55of64_ "WDK2 WDK1 DK2 DK1 LLS2 LLS1" VALUE 0x767DE TKW_VV_VV_UB 100.0 FORMULA_0003 0.0 255.0000 /end CHARACTERISTIC
/begin CHARACTERISTIC K_SK_MD_BEGR_EGAS_56of64_ "WDK2 WDK1 DK2 DK1 LLS2 LLS1" VALUE 0x767DF TKW_VV_VV_UB 100.0 FORMULA_0003 0.0 255.0000 /end CHARACTERISTIC
/begin CHARACTERISTIC K_SK_MD_BEGR_EGAS_57of64_ "WDK2 WDK1 DK2 DK1 LLS2 LLS1" VALUE 0x767E0 TKW_VV_VV_UB 100.0 FORMULA_0003 0.0 255.0000 /end CHARACTERISTIC
/begin CHARACTERISTIC K_SK_MD_BEGR_EGAS_58of64_ "WDK2 WDK1 DK2 DK1 LLS2 LLS1" VALUE 0x767E1 TKW_VV_VV_UB 100.0 FORMULA_0003 0.0 255.0000 /end CHARACTERISTIC
/begin CHARACTERISTIC K_SK_MD_BEGR_EGAS_59of64_ "WDK2 WDK1 DK2 DK1 LLS2 LLS1" VALUE 0x767E2 TKW_VV_VV_UB 100.0 FORMULA_0003 0.0 255.0000 /end CHARACTERISTIC
/begin CHARACTERISTIC K_SK_MD_BEGR_EGAS_60of64_ "WDK2 WDK1 DK2 DK1 LLS2 LLS1" VALUE 0x767E3 TKW_VV_VV_UB 100.0 FORMULA_0003 0.0 255.0000 /end CHARACTERISTIC
/begin CHARACTERISTIC K_SK_MD_BEGR_EGAS_61of64_ "WDK2 WDK1 DK2 DK1 LLS2 LLS1" VALUE 0x767E4 TKW_VV_VV_UB 100.0 FORMULA_0003 0.0 255.0000 /end CHARACTERISTIC
/begin CHARACTERISTIC K_SK_MD_BEGR_EGAS_62of64_ "WDK2 WDK1 DK2 DK1 LLS2 LLS1" VALUE 0x767E5 TKW_VV_VV_UB 100.0 FORMULA_0003 0.0 255.0000 /end CHARACTERISTIC
/begin CHARACTERISTIC K_SK_MD_BEGR_EGAS_63of64_ "WDK2 WDK1 DK2 DK1 LLS2 LLS1" VALUE 0x767E6 TKW_VV_VV_UB 100.0 FORMULA_0003 0.0 255.0000 /end CHARACTERISTIC
/begin CHARACTERISTIC K_SK_MD_BEGR_EGAS_64of64_ "WDK2 WDK1 DK2 DK1 LLS2 LLS1 | EN: WDK2 WDK1 DK2 DK1 LLS2 LLS1" VALUE 0x767E7 TKW_VV_VV_UB 100.0 FORMULA_0003 0.0 255.0000 /end CHARACTERISTIC
/begin CHARACTERISTIC K_SK_MD_BEGR_TI_1of16_ "B2 B1 Z2 Z1" VALUE 0x767E8 TKW_VV_VV_UB 100.0 FORMULA_0003 0.0 255.0000 /end CHARACTERISTIC
/begin CHARACTERISTIC K_SK_MD_BEGR_TI_2of16_ "B2 B1 Z2 Z1 | EN: B2 B1 Z2 Z1" VALUE 0x767E9 TKW_VV_VV_UB 100.0 FORMULA_0003 0.0 255.0000 /end CHARACTERISTIC
/begin CHARACTERISTIC K_SK_MD_BEGR_TI_3of16_ "B2 B1 Z2 Z1 | EN: B2 B1 Z2 Z1" VALUE 0x767EA TKW_VV_VV_UB 100.0 FORMULA_0003 0.0 255.0000 /end CHARACTERISTIC
/begin CHARACTERISTIC K_SK_MD_BEGR_TI_4of16_ "B2 B1 Z2 Z1 | EN: B2 B1 Z2 Z1" VALUE 0x767EB TKW_VV_VV_UB 100.0 FORMULA_0003 0.0 255.0000 /end CHARACTERISTIC
/begin CHARACTERISTIC K_SK_MD_BEGR_TI_5of16_ "B2 B1 Z2 Z1 | EN: B2 B1 Z2 Z1" VALUE 0x767EC TKW_VV_VV_UB 100.0 FORMULA_0003 0.0 255.0000 /end CHARACTERISTIC
/begin CHARACTERISTIC K_SK_MD_BEGR_TI_6of16_ "B2 B1 Z2 Z1 | EN: B2 B1 Z2 Z1" VALUE 0x767ED TKW_VV_VV_UB 100.0 FORMULA_0003 0.0 255.0000 /end CHARACTERISTIC
/begin CHARACTERISTIC K_SK_MD_BEGR_TI_7of16_ "B2 B1 Z2 Z1 | EN: B2 B1 Z2 Z1" VALUE 0x767EE TKW_VV_VV_UB 100.0 FORMULA_0003 0.0 255.0000 /end CHARACTERISTIC
/begin CHARACTERISTIC K_SK_MD_BEGR_TI_8of16_ "B2 B1 Z2 Z1 | EN: B2 B1 Z2 Z1" VALUE 0x767EF TKW_VV_VV_UB 100.0 FORMULA_0003 0.0 255.0000 /end CHARACTERISTIC
/begin CHARACTERISTIC K_SK_MD_BEGR_TI_9of16_ "B2 B1 Z2 Z1 | EN: B2 B1 Z2 Z1" VALUE 0x767F0 TKW_VV_VV_UB 100.0 FORMULA_0003 0.0 255.0000 /end CHARACTERISTIC
/begin CHARACTERISTIC K_SK_MD_BEGR_TI_10of16_ "B2 B1 Z2 Z1 | EN: B2 B1 Z2 Z1" VALUE 0x767F1 TKW_VV_VV_UB 100.0 FORMULA_0003 0.0 255.0000 /end CHARACTERISTIC
/begin CHARACTERISTIC K_SK_MD_BEGR_TI_11of16_ "B2 B1 Z2 Z1 | EN: B2 B1 Z2 Z1" VALUE 0x767F2 TKW_VV_VV_UB 100.0 FORMULA_0003 0.0 255.0000 /end CHARACTERISTIC
/begin CHARACTERISTIC K_SK_MD_BEGR_TI_12of16_ "B2 B1 Z2 Z1 | EN: B2 B1 Z2 Z1" VALUE 0x767F3 TKW_VV_VV_UB 100.0 FORMULA_0003 0.0 255.0000 /end CHARACTERISTIC
/begin CHARACTERISTIC K_SK_MD_BEGR_TI_13of16_ "B2 B1 Z2 Z1 | EN: B2 B1 Z2 Z1" VALUE 0x767F4 TKW_VV_VV_UB 100.0 FORMULA_0003 0.0 255.0000 /end CHARACTERISTIC
/begin CHARACTERISTIC K_SK_MD_BEGR_TI_14of16_ "B2 B1 Z2 Z1 | EN: B2 B1 Z2 Z1" VALUE 0x767F5 TKW_VV_VV_UB 100.0 FORMULA_0003 0.0 255.0000 /end CHARACTERISTIC
/begin CHARACTERISTIC K_SK_MD_BEGR_TI_15of16_ "B2 B1 Z2 Z1 | EN: B2 B1 Z2 Z1" VALUE 0x767F6 TKW_VV_VV_UB 100.0 FORMULA_0003 0.0 255.0000 /end CHARACTERISTIC
/begin CHARACTERISTIC K_SK_MD_BEGR_TI_16of16_ "B2 B1 Z2 Z1 | EN: B2 B1 Z2 Z1" VALUE 0x767F7 TKW_VV_VV_UB 100.0 FORMULA_0003 0.0 255.0000 /end CHARACTERISTIC
/begin CHARACTERISTIC K_SK_TI_OFF_EGAS_1of64_ "TI2 TI1 DK2 DK1 LLS2 LLS1 | EN: TI2 TI1 DK2 DK1 LLS2 LLS1" VALUE 0x767F8 TKW_VV_VV_UB 100.0 FORMULA_0003 0.0 255.0000 /end CHARACTERISTIC
/begin CHARACTERISTIC K_SK_TI_OFF_EGAS_2of64_ "TI2 TI1 DK2 DK1 LLS2 LLS1 | EN: TI2 TI1 DK2 DK1 LLS2 LLS1" VALUE 0x767F9 TKW_VV_VV_UB 100.0 FORMULA_0003 0.0 255.0000 /end CHARACTERISTIC
/begin CHARACTERISTIC K_SK_TI_OFF_EGAS_3of64_ "TI2 TI1 DK2 DK1 LLS2 LLS1 | EN: TI2 TI1 DK2 DK1 LLS2 LLS1" VALUE 0x767FA TKW_VV_VV_UB 100.0 FORMULA_0003 0.0 255.0000 /end CHARACTERISTIC
/begin CHARACTERISTIC K_SK_TI_OFF_EGAS_4of64_ "TI2 TI1 DK2 DK1 LLS2 LLS1 | EN: TI2 TI1 DK2 DK1 LLS2 LLS1" VALUE 0x767FB TKW_VV_VV_UB 100.0 FORMULA_0003 0.0 255.0000 /end CHARACTERISTIC
/begin CHARACTERISTIC K_SK_TI_OFF_EGAS_5of64_ "TI2 TI1 DK2 DK1 LLS2 LLS1 | EN: TI2 TI1 DK2 DK1 LLS2 LLS1" VALUE 0x767FC TKW_VV_VV_UB 100.0 FORMULA_0003 0.0 255.0000 /end CHARACTERISTIC
/begin CHARACTERISTIC K_SK_TI_OFF_EGAS_6of64_ "TI2 TI1 DK2 DK1 LLS2 LLS1 | EN: TI2 TI1 DK2 DK1 LLS2 LLS1" VALUE 0x767FD TKW_VV_VV_UB 100.0 FORMULA_0003 0.0 255.0000 /end CHARACTERISTIC
/begin CHARACTERISTIC K_SK_TI_OFF_EGAS_7of64_ "TI2 TI1 DK2 DK1 LLS2 LLS1 | EN: TI2 TI1 DK2 DK1 LLS2 LLS1" VALUE 0x767FE TKW_VV_VV_UB 100.0 FORMULA_0003 0.0 255.0000 /end CHARACTERISTIC
/begin CHARACTERISTIC K_SK_TI_OFF_EGAS_8of64_ "TI2 TI1 DK2 DK1 LLS2 LLS1 | EN: TI2 TI1 DK2 DK1 LLS2 LLS1" VALUE 0x767FF TKW_VV_VV_UB 100.0 FORMULA_0003 0.0 255.0000 /end CHARACTERISTIC
/begin CHARACTERISTIC K_SK_TI_OFF_EGAS_9of64_ "TI2 TI1 DK2 DK1 LLS2 LLS1 | EN: TI2 TI1 DK2 DK1 LLS2 LLS1" VALUE 0x76800 TKW_VV_VV_UB 100.0 FORMULA_0003 0.0 255.0000 /end CHARACTERISTIC
/begin CHARACTERISTIC K_SK_TI_OFF_EGAS_10of64_ "TI2 TI1 DK2 DK1 LLS2 LLS1 | EN: TI2 TI1 DK2 DK1 LLS2 LLS1" VALUE 0x76801 TKW_VV_VV_UB 100.0 FORMULA_0003 0.0 255.0000 /end CHARACTERISTIC
/begin CHARACTERISTIC K_SK_TI_OFF_EGAS_11of64_ "TI2 TI1 DK2 DK1 LLS2 LLS1 | EN: TI2 TI1 DK2 DK1 LLS2 LLS1" VALUE 0x76802 TKW_VV_VV_UB 100.0 FORMULA_0003 0.0 255.0000 /end CHARACTERISTIC
/begin CHARACTERISTIC K_SK_TI_OFF_EGAS_12of64_ "TI2 TI1 DK2 DK1 LLS2 LLS1 | EN: TI2 TI1 DK2 DK1 LLS2 LLS1" VALUE 0x76803 TKW_VV_VV_UB 100.0 FORMULA_0003 0.0 255.0000 /end CHARACTERISTIC
/begin CHARACTERISTIC K_SK_TI_OFF_EGAS_13of64_ "TI2 TI1 DK2 DK1 LLS2 LLS1 | EN: TI2 TI1 DK2 DK1 LLS2 LLS1" VALUE 0x76804 TKW_VV_VV_UB 100.0 FORMULA_0003 0.0 255.0000 /end CHARACTERISTIC
/begin CHARACTERISTIC K_SK_TI_OFF_EGAS_14of64_ "TI2 TI1 DK2 DK1 LLS2 LLS1 | EN: TI2 TI1 DK2 DK1 LLS2 LLS1" VALUE 0x76805 TKW_VV_VV_UB 100.0 FORMULA_0003 0.0 255.0000 /end CHARACTERISTIC
/begin CHARACTERISTIC K_SK_TI_OFF_EGAS_15of64_ "TI2 TI1 DK2 DK1 LLS2 LLS1 | EN: TI2 TI1 DK2 DK1 LLS2 LLS1" VALUE 0x76806 TKW_VV_VV_UB 100.0 FORMULA_0003 0.0 255.0000 /end CHARACTERISTIC
/begin CHARACTERISTIC K_SK_TI_OFF_EGAS_16of64_ "TI2 TI1 DK2 DK1 LLS2 LLS1 | EN: TI2 TI1 DK2 DK1 LLS2 LLS1" VALUE 0x76807 TKW_VV_VV_UB 100.0 FORMULA_0003 0.0 255.0000 /end CHARACTERISTIC
/begin CHARACTERISTIC K_SK_TI_OFF_EGAS_17of64_ "TI2 TI1 DK2 DK1 LLS2 LLS1 | EN: TI2 TI1 DK2 DK1 LLS2 LLS1" VALUE 0x76808 TKW_VV_VV_UB 100.0 FORMULA_0003 0.0 255.0000 /end CHARACTERISTIC
/begin CHARACTERISTIC K_SK_TI_OFF_EGAS_18of64_ "TI2 TI1 DK2 DK1 LLS2 LLS1 | EN: TI2 TI1 DK2 DK1 LLS2 LLS1" VALUE 0x76809 TKW_VV_VV_UB 100.0 FORMULA_0003 0.0 255.0000 /end CHARACTERISTIC
/begin CHARACTERISTIC K_SK_TI_OFF_EGAS_19of64_ "TI2 TI1 DK2 DK1 LLS2 LLS1 | EN: TI2 TI1 DK2 DK1 LLS2 LLS1" VALUE 0x7680A TKW_VV_VV_UB 100.0 FORMULA_0003 0.0 255.0000 /end CHARACTERISTIC
/begin CHARACTERISTIC K_SK_TI_OFF_EGAS_20of64_ "TI2 TI1 DK2 DK1 LLS2 LLS1 | EN: TI2 TI1 DK2 DK1 LLS2 LLS1" VALUE 0x7680B TKW_VV_VV_UB 100.0 FORMULA_0003 0.0 255.0000 /end CHARACTERISTIC
/begin CHARACTERISTIC K_SK_TI_OFF_EGAS_21of64_ "TI2 TI1 DK2 DK1 LLS2 LLS1 | EN: TI2 TI1 DK2 DK1 LLS2 LLS1" VALUE 0x7680C TKW_VV_VV_UB 100.0 FORMULA_0003 0.0 255.0000 /end CHARACTERISTIC
/begin CHARACTERISTIC K_SK_TI_OFF_EGAS_22of64_ "TI2 TI1 DK2 DK1 LLS2 LLS1 | EN: TI2 TI1 DK2 DK1 LLS2 LLS1" VALUE 0x7680D TKW_VV_VV_UB 100.0 FORMULA_0003 0.0 255.0000 /end CHARACTERISTIC
/begin CHARACTERISTIC K_SK_TI_OFF_EGAS_23of64_ "TI2 TI1 DK2 DK1 LLS2 LLS1 | EN: TI2 TI1 DK2 DK1 LLS2 LLS1" VALUE 0x7680E TKW_VV_VV_UB 100.0 FORMULA_0003 0.0 255.0000 /end CHARACTERISTIC
/begin CHARACTERISTIC K_SK_TI_OFF_EGAS_24of64_ "TI2 TI1 DK2 DK1 LLS2 LLS1 | EN: TI2 TI1 DK2 DK1 LLS2 LLS1" VALUE 0x7680F TKW_VV_VV_UB 100.0 FORMULA_0003 0.0 255.0000 /end CHARACTERISTIC
/begin CHARACTERISTIC K_SK_TI_OFF_EGAS_25of64_ "TI2 TI1 DK2 DK1 LLS2 LLS1 | EN: TI2 TI1 DK2 DK1 LLS2 LLS1" VALUE 0x76810 TKW_VV_VV_UB 100.0 FORMULA_0003 0.0 255.0000 /end CHARACTERISTIC
/begin CHARACTERISTIC K_SK_TI_OFF_EGAS_26of64_ "TI2 TI1 DK2 DK1 LLS2 LLS1 | EN: TI2 TI1 DK2 DK1 LLS2 LLS1" VALUE 0x76811 TKW_VV_VV_UB 100.0 FORMULA_0003 0.0 255.0000 /end CHARACTERISTIC
/begin CHARACTERISTIC K_SK_TI_OFF_EGAS_27of64_ "TI2 TI1 DK2 DK1 LLS2 LLS1 | EN: TI2 TI1 DK2 DK1 LLS2 LLS1" VALUE 0x76812 TKW_VV_VV_UB 100.0 FORMULA_0003 0.0 255.0000 /end CHARACTERISTIC
/begin CHARACTERISTIC K_SK_TI_OFF_EGAS_28of64_ "TI2 TI1 DK2 DK1 LLS2 LLS1 | EN: TI2 TI1 DK2 DK1 LLS2 LLS1" VALUE 0x76813 TKW_VV_VV_UB 100.0 FORMULA_0003 0.0 255.0000 /end CHARACTERISTIC
/begin CHARACTERISTIC K_SK_TI_OFF_EGAS_29of64_ "TI2 TI1 DK2 DK1 LLS2 LLS1 | EN: TI2 TI1 DK2 DK1 LLS2 LLS1" VALUE 0x76814 TKW_VV_VV_UB 100.0 FORMULA_0003 0.0 255.0000 /end CHARACTERISTIC
/begin CHARACTERISTIC K_SK_TI_OFF_EGAS_30of64_ "TI2 TI1 DK2 DK1 LLS2 LLS1 | EN: TI2 TI1 DK2 DK1 LLS2 LLS1" VALUE 0x76815 TKW_VV_VV_UB 100.0 FORMULA_0003 0.0 255.0000 /end CHARACTERISTIC
/begin CHARACTERISTIC K_SK_TI_OFF_EGAS_31of64_ "TI2 TI1 DK2 DK1 LLS2 LLS1 | EN: TI2 TI1 DK2 DK1 LLS2 LLS1" VALUE 0x76816 TKW_VV_VV_UB 100.0 FORMULA_0003 0.0 255.0000 /end CHARACTERISTIC
/begin CHARACTERISTIC K_SK_TI_OFF_EGAS_32of64_ "TI2 TI1 DK2 DK1 LLS2 LLS1 | EN: TI2 TI1 DK2 DK1 LLS2 LLS1" VALUE 0x76817 TKW_VV_VV_UB 100.0 FORMULA_0003 0.0 255.0000 /end CHARACTERISTIC
/begin CHARACTERISTIC K_SK_TI_OFF_EGAS_33of64_ "TI2 TI1 DK2 DK1 LLS2 LLS1 | EN: TI2 TI1 DK2 DK1 LLS2 LLS1" VALUE 0x76818 TKW_VV_VV_UB 100.0 FORMULA_0003 0.0 255.0000 /end CHARACTERISTIC
/begin CHARACTERISTIC K_SK_TI_OFF_EGAS_34of64_ "TI2 TI1 DK2 DK1 LLS2 LLS1 | EN: TI2 TI1 DK2 DK1 LLS2 LLS1" VALUE 0x76819 TKW_VV_VV_UB 100.0 FORMULA_0003 0.0 255.0000 /end CHARACTERISTIC
/begin CHARACTERISTIC K_SK_TI_OFF_EGAS_35of64_ "TI2 TI1 DK2 DK1 LLS2 LLS1 | EN: TI2 TI1 DK2 DK1 LLS2 LLS1" VALUE 0x7681A TKW_VV_VV_UB 100.0 FORMULA_0003 0.0 255.0000 /end CHARACTERISTIC
/begin CHARACTERISTIC K_SK_TI_OFF_EGAS_36of64_ "TI2 TI1 DK2 DK1 LLS2 LLS1 | EN: TI2 TI1 DK2 DK1 LLS2 LLS1" VALUE 0x7681B TKW_VV_VV_UB 100.0 FORMULA_0003 0.0 255.0000 /end CHARACTERISTIC
/begin CHARACTERISTIC K_SK_TI_OFF_EGAS_37of64_ "TI2 TI1 DK2 DK1 LLS2 LLS1 | EN: TI2 TI1 DK2 DK1 LLS2 LLS1" VALUE 0x7681C TKW_VV_VV_UB 100.0 FORMULA_0003 0.0 255.0000 /end CHARACTERISTIC
/begin CHARACTERISTIC K_SK_TI_OFF_EGAS_38of64_ "TI2 TI1 DK2 DK1 LLS2 LLS1 | EN: TI2 TI1 DK2 DK1 LLS2 LLS1" VALUE 0x7681D TKW_VV_VV_UB 100.0 FORMULA_0003 0.0 255.0000 /end CHARACTERISTIC
/begin CHARACTERISTIC K_SK_TI_OFF_EGAS_39of64_ "TI2 TI1 DK2 DK1 LLS2 LLS1 | EN: TI2 TI1 DK2 DK1 LLS2 LLS1" VALUE 0x7681E TKW_VV_VV_UB 100.0 FORMULA_0003 0.0 255.0000 /end CHARACTERISTIC
/begin CHARACTERISTIC K_SK_TI_OFF_EGAS_40of64_ "TI2 TI1 DK2 DK1 LLS2 LLS1 | EN: TI2 TI1 DK2 DK1 LLS2 LLS1" VALUE 0x7681F TKW_VV_VV_UB 100.0 FORMULA_0003 0.0 255.0000 /end CHARACTERISTIC
/begin CHARACTERISTIC K_SK_TI_OFF_EGAS_41of64_ "TI2 TI1 DK2 DK1 LLS2 LLS1 | EN: TI2 TI1 DK2 DK1 LLS2 LLS1" VALUE 0x76820 TKW_VV_VV_UB 100.0 FORMULA_0003 0.0 255.0000 /end CHARACTERISTIC
/begin CHARACTERISTIC K_SK_TI_OFF_EGAS_42of64_ "TI2 TI1 DK2 DK1 LLS2 LLS1 | EN: TI2 TI1 DK2 DK1 LLS2 LLS1" VALUE 0x76821 TKW_VV_VV_UB 100.0 FORMULA_0003 0.0 255.0000 /end CHARACTERISTIC
/begin CHARACTERISTIC K_SK_TI_OFF_EGAS_43of64_ "TI2 TI1 DK2 DK1 LLS2 LLS1 | EN: TI2 TI1 DK2 DK1 LLS2 LLS1" VALUE 0x76822 TKW_VV_VV_UB 100.0 FORMULA_0003 0.0 255.0000 /end CHARACTERISTIC
/begin CHARACTERISTIC K_SK_TI_OFF_EGAS_44of64_ "TI2 TI1 DK2 DK1 LLS2 LLS1 | EN: TI2 TI1 DK2 DK1 LLS2 LLS1" VALUE 0x76823 TKW_VV_VV_UB 100.0 FORMULA_0003 0.0 255.0000 /end CHARACTERISTIC
/begin CHARACTERISTIC K_SK_TI_OFF_EGAS_45of64_ "TI2 TI1 DK2 DK1 LLS2 LLS1 | EN: TI2 TI1 DK2 DK1 LLS2 LLS1" VALUE 0x76824 TKW_VV_VV_UB 100.0 FORMULA_0003 0.0 255.0000 /end CHARACTERISTIC
/begin CHARACTERISTIC K_SK_TI_OFF_EGAS_46of64_ "TI2 TI1 DK2 DK1 LLS2 LLS1 | EN: TI2 TI1 DK2 DK1 LLS2 LLS1" VALUE 0x76825 TKW_VV_VV_UB 100.0 FORMULA_0003 0.0 255.0000 /end CHARACTERISTIC
/begin CHARACTERISTIC K_SK_TI_OFF_EGAS_47of64_ "TI2 TI1 DK2 DK1 LLS2 LLS1 | EN: TI2 TI1 DK2 DK1 LLS2 LLS1" VALUE 0x76826 TKW_VV_VV_UB 100.0 FORMULA_0003 0.0 255.0000 /end CHARACTERISTIC
/begin CHARACTERISTIC K_SK_TI_OFF_EGAS_48of64_ "TI2 TI1 DK2 DK1 LLS2 LLS1 | EN: TI2 TI1 DK2 DK1 LLS2 LLS1" VALUE 0x76827 TKW_VV_VV_UB 100.0 FORMULA_0003 0.0 255.0000 /end CHARACTERISTIC
/begin CHARACTERISTIC K_SK_TI_OFF_EGAS_49of64_ "TI2 TI1 DK2 DK1 LLS2 LLS1 | EN: TI2 TI1 DK2 DK1 LLS2 LLS1" VALUE 0x76828 TKW_VV_VV_UB 100.0 FORMULA_0003 0.0 255.0000 /end CHARACTERISTIC
/begin CHARACTERISTIC K_SK_TI_OFF_EGAS_50of64_ "TI2 TI1 DK2 DK1 LLS2 LLS1 | EN: TI2 TI1 DK2 DK1 LLS2 LLS1" VALUE 0x76829 TKW_VV_VV_UB 100.0 FORMULA_0003 0.0 255.0000 /end CHARACTERISTIC
/begin CHARACTERISTIC K_SK_TI_OFF_EGAS_51of64_ "TI2 TI1 DK2 DK1 LLS2 LLS1 | EN: TI2 TI1 DK2 DK1 LLS2 LLS1" VALUE 0x7682A TKW_VV_VV_UB 100.0 FORMULA_0003 0.0 255.0000 /end CHARACTERISTIC
/begin CHARACTERISTIC K_SK_TI_OFF_EGAS_52of64_ "TI2 TI1 DK2 DK1 LLS2 LLS1 | EN: TI2 TI1 DK2 DK1 LLS2 LLS1" VALUE 0x7682B TKW_VV_VV_UB 100.0 FORMULA_0003 0.0 255.0000 /end CHARACTERISTIC
/begin CHARACTERISTIC K_SK_TI_OFF_EGAS_53of64_ "TI2 TI1 DK2 DK1 LLS2 LLS1 | EN: TI2 TI1 DK2 DK1 LLS2 LLS1" VALUE 0x7682C TKW_VV_VV_UB 100.0 FORMULA_0003 0.0 255.0000 /end CHARACTERISTIC
/begin CHARACTERISTIC K_SK_TI_OFF_EGAS_54of64_ "TI2 TI1 DK2 DK1 LLS2 LLS1 | EN: TI2 TI1 DK2 DK1 LLS2 LLS1" VALUE 0x7682D TKW_VV_VV_UB 100.0 FORMULA_0003 0.0 255.0000 /end CHARACTERISTIC
/begin CHARACTERISTIC K_SK_TI_OFF_EGAS_55of64_ "TI2 TI1 DK2 DK1 LLS2 LLS1 | EN: TI2 TI1 DK2 DK1 LLS2 LLS1" VALUE 0x7682E TKW_VV_VV_UB 100.0 FORMULA_0003 0.0 255.0000 /end CHARACTERISTIC
/begin CHARACTERISTIC K_SK_TI_OFF_EGAS_56of64_ "TI2 TI1 DK2 DK1 LLS2 LLS1 | EN: TI2 TI1 DK2 DK1 LLS2 LLS1" VALUE 0x7682F TKW_VV_VV_UB 100.0 FORMULA_0003 0.0 255.0000 /end CHARACTERISTIC
/begin CHARACTERISTIC K_SK_TI_OFF_EGAS_57of64_ "TI2 TI1 DK2 DK1 LLS2 LLS1 | EN: TI2 TI1 DK2 DK1 LLS2 LLS1" VALUE 0x76830 TKW_VV_VV_UB 100.0 FORMULA_0003 0.0 255.0000 /end CHARACTERISTIC
/begin CHARACTERISTIC K_SK_TI_OFF_EGAS_58of64_ "TI2 TI1 DK2 DK1 LLS2 LLS1 | EN: TI2 TI1 DK2 DK1 LLS2 LLS1" VALUE 0x76831 TKW_VV_VV_UB 100.0 FORMULA_0003 0.0 255.0000 /end CHARACTERISTIC
/begin CHARACTERISTIC K_SK_TI_OFF_EGAS_59of64_ "TI2 TI1 DK2 DK1 LLS2 LLS1 | EN: TI2 TI1 DK2 DK1 LLS2 LLS1" VALUE 0x76832 TKW_VV_VV_UB 100.0 FORMULA_0003 0.0 255.0000 /end CHARACTERISTIC
/begin CHARACTERISTIC K_SK_TI_OFF_EGAS_60of64_ "TI2 TI1 DK2 DK1 LLS2 LLS1 | EN: TI2 TI1 DK2 DK1 LLS2 LLS1" VALUE 0x76833 TKW_VV_VV_UB 100.0 FORMULA_0003 0.0 255.0000 /end CHARACTERISTIC
/begin CHARACTERISTIC K_SK_TI_OFF_EGAS_61of64_ "TI2 TI1 DK2 DK1 LLS2 LLS1 | EN: TI2 TI1 DK2 DK1 LLS2 LLS1" VALUE 0x76834 TKW_VV_VV_UB 100.0 FORMULA_0003 0.0 255.0000 /end CHARACTERISTIC
/begin CHARACTERISTIC K_SK_TI_OFF_EGAS_62of64_ "TI2 TI1 DK2 DK1 LLS2 LLS1 | EN: TI2 TI1 DK2 DK1 LLS2 LLS1" VALUE 0x76835 TKW_VV_VV_UB 100.0 FORMULA_0003 0.0 255.0000 /end CHARACTERISTIC
/begin CHARACTERISTIC K_SK_TI_OFF_EGAS_63of64_ "TI2 TI1 DK2 DK1 LLS2 LLS1 | EN: TI2 TI1 DK2 DK1 LLS2 LLS1" VALUE 0x76836 TKW_VV_VV_UB 100.0 FORMULA_0003 0.0 255.0000 /end CHARACTERISTIC
/begin CHARACTERISTIC K_SK_TI_OFF_EGAS_64of64_ "TI2 TI1 DK2 DK1 LLS2 LLS1 | EN: TI2 TI1 DK2 DK1 LLS2 LLS1" VALUE 0x76837 TKW_VV_VV_UB 100.0 FORMULA_0003 0.0 255.0000 /end CHARACTERISTIC
/begin CHARACTERISTIC K_SK_MD_BEGR_SMG_1of16_ "CANErr CANSk STAT SABR | EN: CANErr CANSk STAT SABR" VALUE 0x76838 TKW_VV_VV_UB 100.0 FORMULA_0003 0.0 255.0000 /end CHARACTERISTIC
/begin CHARACTERISTIC K_SK_MD_BEGR_SMG_2of16_ "CANErr CANSk STAT SABR | EN: CANErr CANSk STAT SABR" VALUE 0x76839 TKW_VV_VV_UB 100.0 FORMULA_0003 0.0 255.0000 /end CHARACTERISTIC
/begin CHARACTERISTIC K_SK_MD_BEGR_SMG_3of16_ "CANErr CANSk STAT SABR | EN: CANErr CANSk STAT SABR" VALUE 0x7683A TKW_VV_VV_UB 100.0 FORMULA_0003 0.0 255.0000 /end CHARACTERISTIC
/begin CHARACTERISTIC K_SK_MD_BEGR_SMG_4of16_ "CANErr CANSk STAT SABR | EN: CANErr CANSk STAT SABR" VALUE 0x7683B TKW_VV_VV_UB 100.0 FORMULA_0003 0.0 255.0000 /end CHARACTERISTIC
/begin CHARACTERISTIC K_SK_MD_BEGR_SMG_5of16_ "CANErr CANSk STAT SABR | EN: CANErr CANSk STAT SABR" VALUE 0x7683C TKW_VV_VV_UB 100.0 FORMULA_0003 0.0 255.0000 /end CHARACTERISTIC
/begin CHARACTERISTIC K_SK_MD_BEGR_SMG_6of16_ "CANErr CANSk STAT SABR | EN: CANErr CANSk STAT SABR" VALUE 0x7683D TKW_VV_VV_UB 100.0 FORMULA_0003 0.0 255.0000 /end CHARACTERISTIC
/begin CHARACTERISTIC K_SK_MD_BEGR_SMG_7of16_ "CANErr CANSk STAT SABR | EN: CANErr CANSk STAT SABR" VALUE 0x7683E TKW_VV_VV_UB 100.0 FORMULA_0003 0.0 255.0000 /end CHARACTERISTIC
/begin CHARACTERISTIC K_SK_MD_BEGR_SMG_8of16_ "CANErr CANSk STAT SABR | EN: CANErr CANSk STAT SABR" VALUE 0x7683F TKW_VV_VV_UB 100.0 FORMULA_0003 0.0 255.0000 /end CHARACTERISTIC
/begin CHARACTERISTIC K_SK_MD_BEGR_SMG_9of16_ "CANErr CANSk STAT SABR | EN: CANErr CANSk STAT SABR" VALUE 0x76840 TKW_VV_VV_UB 100.0 FORMULA_0003 0.0 255.0000 /end CHARACTERISTIC
/begin CHARACTERISTIC K_SK_MD_BEGR_SMG_10of16_ "CANErr CANSk STAT SABR | EN: CANErr CANSk STAT SABR" VALUE 0x76841 TKW_VV_VV_UB 100.0 FORMULA_0003 0.0 255.0000 /end CHARACTERISTIC
/begin CHARACTERISTIC K_SK_MD_BEGR_SMG_11of16_ "CANErr CANSk STAT SABR | EN: CANErr CANSk STAT SABR" VALUE 0x76842 TKW_VV_VV_UB 100.0 FORMULA_0003 0.0 255.0000 /end CHARACTERISTIC
/begin CHARACTERISTIC K_SK_MD_BEGR_SMG_12of16_ "CANErr CANSk STAT SABR | EN: CANErr CANSk STAT SABR" VALUE 0x76843 TKW_VV_VV_UB 100.0 FORMULA_0003 0.0 255.0000 /end CHARACTERISTIC
/begin CHARACTERISTIC K_SK_MD_BEGR_SMG_13of16_ "CANErr CANSk STAT SABR | EN: CANErr CANSk STAT SABR" VALUE 0x76844 TKW_VV_VV_UB 100.0 FORMULA_0003 0.0 255.0000 /end CHARACTERISTIC
/begin CHARACTERISTIC K_SK_MD_BEGR_SMG_14of16_ "CANErr CANSk STAT SABR | EN: CANErr CANSk STAT SABR" VALUE 0x76845 TKW_VV_VV_UB 100.0 FORMULA_0003 0.0 255.0000 /end CHARACTERISTIC
/begin CHARACTERISTIC K_SK_MD_BEGR_SMG_15of16_ "CANErr CANSk STAT SABR | EN: CANErr CANSk STAT SABR" VALUE 0x76846 TKW_VV_VV_UB 100.0 FORMULA_0003 0.0 255.0000 /end CHARACTERISTIC
/begin CHARACTERISTIC K_SK_MD_BEGR_SMG_16of16_ "CANErr CANSk STAT SABR | EN: CANErr CANSk STAT SABR" VALUE 0x76847 TKW_VV_VV_UB 100.0 FORMULA_0003 0.0 255.0000 /end CHARACTERISTIC
/begin CHARACTERISTIC K_SK_MD_BEGR_MD_1of16_ "SollIst Mdmin EtaRf LLR | EN: SollIst Mdmin EtaRf LLR" VALUE 0x76848 TKW_VV_VV_UB 100.0 FORMULA_0003 0.0 255.0000 /end CHARACTERISTIC
/begin CHARACTERISTIC K_SK_MD_BEGR_MD_2of16_ "SollIst Mdmin EtaRf LLR" VALUE 0x76849 TKW_VV_VV_UB 100.0 FORMULA_0003 0.0 255.0000 /end CHARACTERISTIC
/begin CHARACTERISTIC K_SK_MD_BEGR_MD_3of16_ "SollIst Mdmin EtaRf LLR" VALUE 0x7684A TKW_VV_VV_UB 100.0 FORMULA_0003 0.0 255.0000 /end CHARACTERISTIC
/begin CHARACTERISTIC K_SK_MD_BEGR_MD_4of16_ "SollIst Mdmin EtaRf LLR | EN: SollIst Mdmin EtaRf LLR" VALUE 0x7684B TKW_VV_VV_UB 100.0 FORMULA_0003 0.0 255.0000 /end CHARACTERISTIC
/begin CHARACTERISTIC K_SK_MD_BEGR_MD_5of16_ "SollIst Mdmin EtaRf LLR | EN: SollIst Mdmin EtaRf LLR" VALUE 0x7684C TKW_VV_VV_UB 100.0 FORMULA_0003 0.0 255.0000 /end CHARACTERISTIC
/begin CHARACTERISTIC K_SK_MD_BEGR_MD_6of16_ "SollIst Mdmin EtaRf LLR | EN: SollIst Mdmin EtaRf LLR" VALUE 0x7684D TKW_VV_VV_UB 100.0 FORMULA_0003 0.0 255.0000 /end CHARACTERISTIC
/begin CHARACTERISTIC K_SK_MD_BEGR_MD_7of16_ "SollIst Mdmin EtaRf LLR | EN: SollIst Mdmin EtaRf LLR" VALUE 0x7684E TKW_VV_VV_UB 100.0 FORMULA_0003 0.0 255.0000 /end CHARACTERISTIC
/begin CHARACTERISTIC K_SK_MD_BEGR_MD_8of16_ "SollIst Mdmin EtaRf LLR | EN: SollIst Mdmin EtaRf LLR" VALUE 0x7684F TKW_VV_VV_UB 100.0 FORMULA_0003 0.0 255.0000 /end CHARACTERISTIC
/begin CHARACTERISTIC K_SK_MD_BEGR_MD_9of16_ "SollIst Mdmin EtaRf LLR | EN: SollIst Mdmin EtaRf LLR" VALUE 0x76850 TKW_VV_VV_UB 100.0 FORMULA_0003 0.0 255.0000 /end CHARACTERISTIC
/begin CHARACTERISTIC K_SK_MD_BEGR_MD_10of16_ "SollIst Mdmin EtaRf LLR | EN: SollIst Mdmin EtaRf LLR" VALUE 0x76851 TKW_VV_VV_UB 100.0 FORMULA_0003 0.0 255.0000 /end CHARACTERISTIC
/begin CHARACTERISTIC K_SK_MD_BEGR_MD_11of16_ "SollIst Mdmin EtaRf LLR | EN: SollIst Mdmin EtaRf LLR" VALUE 0x76852 TKW_VV_VV_UB 100.0 FORMULA_0003 0.0 255.0000 /end CHARACTERISTIC
/begin CHARACTERISTIC K_SK_MD_BEGR_MD_12of16_ "SollIst Mdmin EtaRf LLR | EN: SollIst Mdmin EtaRf LLR" VALUE 0x76853 TKW_VV_VV_UB 100.0 FORMULA_0003 0.0 255.0000 /end CHARACTERISTIC
/begin CHARACTERISTIC K_SK_MD_BEGR_MD_13of16_ "SollIst Mdmin EtaRf LLR | EN: SollIst Mdmin EtaRf LLR" VALUE 0x76854 TKW_VV_VV_UB 100.0 FORMULA_0003 0.0 255.0000 /end CHARACTERISTIC
/begin CHARACTERISTIC K_SK_MD_BEGR_MD_14of16_ "SollIst Mdmin EtaRf LLR | EN: SollIst Mdmin EtaRf LLR" VALUE 0x76855 TKW_VV_VV_UB 100.0 FORMULA_0003 0.0 255.0000 /end CHARACTERISTIC
/begin CHARACTERISTIC K_SK_MD_BEGR_MD_15of16_ "SollIst Mdmin EtaRf LLR | EN: SollIst Mdmin EtaRf LLR" VALUE 0x76856 TKW_VV_VV_UB 100.0 FORMULA_0003 0.0 255.0000 /end CHARACTERISTIC
/begin CHARACTERISTIC K_SK_MD_BEGR_MD_16of16_ "SollIst Mdmin EtaRf LLR | EN: SollIst Mdmin EtaRf LLR" VALUE 0x76857 TKW_VV_VV_UB 100.0 FORMULA_0003 0.0 255.0000 /end CHARACTERISTIC
/begin CHARACTERISTIC K_SK_MD_BEGR_GEMISCH_1of32_ "VAN KATS FPLAU LAVK PKS | EN: VAN KATS FPLAU LAVK PKS" VALUE 0x76858 TKW_VV_VV_UB 100.0 FORMULA_0003 0.0 255.0000 /end CHARACTERISTIC
/begin CHARACTERISTIC K_SK_MD_BEGR_GEMISCH_2of32_ "VAN KATS FPLAU LAVK PKS | EN: VAN KATS FPLAU LAVK PKS" VALUE 0x76859 TKW_VV_VV_UB 100.0 FORMULA_0003 0.0 255.0000 /end CHARACTERISTIC
/begin CHARACTERISTIC K_SK_MD_BEGR_GEMISCH_3of32_ "VAN KATS FPLAU LAVK PKS | EN: VAN KATS FPLAU LAVK PKS" VALUE 0x7685A TKW_VV_VV_UB 100.0 FORMULA_0003 0.0 255.0000 /end CHARACTERISTIC
/begin CHARACTERISTIC K_SK_MD_BEGR_GEMISCH_4of32_ "VAN KATS FPLAU LAVK PKS | EN: VAN KATS FPLAU LAVK PKS" VALUE 0x7685B TKW_VV_VV_UB 100.0 FORMULA_0003 0.0 255.0000 /end CHARACTERISTIC
/begin CHARACTERISTIC K_SK_MD_BEGR_GEMISCH_5of32_ "VAN KATS FPLAU LAVK PKS" VALUE 0x7685C TKW_VV_VV_UB 100.0 FORMULA_0003 0.0 255.0000 /end CHARACTERISTIC
/begin CHARACTERISTIC K_SK_MD_BEGR_GEMISCH_6of32_ "VAN KATS FPLAU LAVK PKS" VALUE 0x7685D TKW_VV_VV_UB 100.0 FORMULA_0003 0.0 255.0000 /end CHARACTERISTIC
/begin CHARACTERISTIC K_SK_MD_BEGR_GEMISCH_7of32_ "VAN KATS FPLAU LAVK PKS" VALUE 0x7685E TKW_VV_VV_UB 100.0 FORMULA_0003 0.0 255.0000 /end CHARACTERISTIC
/begin CHARACTERISTIC K_SK_MD_BEGR_GEMISCH_8of32_ "VAN KATS FPLAU LAVK PKS" VALUE 0x7685F TKW_VV_VV_UB 100.0 FORMULA_0003 0.0 255.0000 /end CHARACTERISTIC
/begin CHARACTERISTIC K_SK_MD_BEGR_GEMISCH_9of32_ "VAN KATS FPLAU LAVK PKS" VALUE 0x76860 TKW_VV_VV_UB 100.0 FORMULA_0003 0.0 255.0000 /end CHARACTERISTIC
/begin CHARACTERISTIC K_SK_MD_BEGR_GEMISCH_10of32_ "VAN KATS FPLAU LAVK PKS" VALUE 0x76861 TKW_VV_VV_UB 100.0 FORMULA_0003 0.0 255.0000 /end CHARACTERISTIC
/begin CHARACTERISTIC K_SK_MD_BEGR_GEMISCH_11of32_ "VAN KATS FPLAU LAVK PKS" VALUE 0x76862 TKW_VV_VV_UB 100.0 FORMULA_0003 0.0 255.0000 /end CHARACTERISTIC
/begin CHARACTERISTIC K_SK_MD_BEGR_GEMISCH_12of32_ "VAN KATS FPLAU LAVK PKS" VALUE 0x76863 TKW_VV_VV_UB 100.0 FORMULA_0003 0.0 255.0000 /end CHARACTERISTIC
/begin CHARACTERISTIC K_SK_MD_BEGR_GEMISCH_13of32_ "VAN KATS FPLAU LAVK PKS" VALUE 0x76864 TKW_VV_VV_UB 100.0 FORMULA_0003 0.0 255.0000 /end CHARACTERISTIC
/begin CHARACTERISTIC K_SK_MD_BEGR_GEMISCH_14of32_ "VAN KATS FPLAU LAVK PKS" VALUE 0x76865 TKW_VV_VV_UB 100.0 FORMULA_0003 0.0 255.0000 /end CHARACTERISTIC
/begin CHARACTERISTIC K_SK_MD_BEGR_GEMISCH_15of32_ "VAN KATS FPLAU LAVK PKS" VALUE 0x76866 TKW_VV_VV_UB 100.0 FORMULA_0003 0.0 255.0000 /end CHARACTERISTIC
/begin CHARACTERISTIC K_SK_MD_BEGR_GEMISCH_16of32_ "VAN KATS FPLAU LAVK PKS" VALUE 0x76867 TKW_VV_VV_UB 100.0 FORMULA_0003 0.0 255.0000 /end CHARACTERISTIC
/begin CHARACTERISTIC K_SK_MD_BEGR_GEMISCH_17of32_ "VAN KATS FPLAU LAVK PKS | EN: VAN KATS FPLAU LAVK PKS" VALUE 0x76868 TKW_VV_VV_UB 100.0 FORMULA_0003 0.0 255.0000 /end CHARACTERISTIC
/begin CHARACTERISTIC K_SK_MD_BEGR_GEMISCH_18of32_ "VAN KATS FPLAU LAVK PKS | EN: VAN KATS FPLAU LAVK PKS" VALUE 0x76869 TKW_VV_VV_UB 100.0 FORMULA_0003 0.0 255.0000 /end CHARACTERISTIC
/begin CHARACTERISTIC K_SK_MD_BEGR_GEMISCH_19of32_ "VAN KATS FPLAU LAVK PKS | EN: VAN KATS FPLAU LAVK PKS" VALUE 0x7686A TKW_VV_VV_UB 100.0 FORMULA_0003 0.0 255.0000 /end CHARACTERISTIC
/begin CHARACTERISTIC K_SK_MD_BEGR_GEMISCH_20of32_ "VAN KATS FPLAU LAVK PKS | EN: VAN KATS FPLAU LAVK PKS" VALUE 0x7686B TKW_VV_VV_UB 100.0 FORMULA_0003 0.0 255.0000 /end CHARACTERISTIC
/begin CHARACTERISTIC K_SK_MD_BEGR_GEMISCH_21of32_ "VAN KATS FPLAU LAVK PKS | EN: VAN KATS FPLAU LAVK PKS" VALUE 0x7686C TKW_VV_VV_UB 100.0 FORMULA_0003 0.0 255.0000 /end CHARACTERISTIC
/begin CHARACTERISTIC K_SK_MD_BEGR_GEMISCH_22of32_ "VAN KATS FPLAU LAVK PKS | EN: VAN KATS FPLAU LAVK PKS" VALUE 0x7686D TKW_VV_VV_UB 100.0 FORMULA_0003 0.0 255.0000 /end CHARACTERISTIC
/begin CHARACTERISTIC K_SK_MD_BEGR_GEMISCH_23of32_ "VAN KATS FPLAU LAVK PKS | EN: VAN KATS FPLAU LAVK PKS" VALUE 0x7686E TKW_VV_VV_UB 100.0 FORMULA_0003 0.0 255.0000 /end CHARACTERISTIC
/begin CHARACTERISTIC K_SK_MD_BEGR_GEMISCH_24of32_ "VAN KATS FPLAU LAVK PKS | EN: VAN KATS FPLAU LAVK PKS" VALUE 0x7686F TKW_VV_VV_UB 100.0 FORMULA_0003 0.0 255.0000 /end CHARACTERISTIC
/begin CHARACTERISTIC K_SK_MD_BEGR_GEMISCH_25of32_ "VAN KATS FPLAU LAVK PKS | EN: VAN KATS FPLAU LAVK PKS" VALUE 0x76870 TKW_VV_VV_UB 100.0 FORMULA_0003 0.0 255.0000 /end CHARACTERISTIC
/begin CHARACTERISTIC K_SK_MD_BEGR_GEMISCH_26of32_ "VAN KATS FPLAU LAVK PKS | EN: VAN KATS FPLAU LAVK PKS" VALUE 0x76871 TKW_VV_VV_UB 100.0 FORMULA_0003 0.0 255.0000 /end CHARACTERISTIC
/begin CHARACTERISTIC K_SK_MD_BEGR_GEMISCH_27of32_ "VAN KATS FPLAU LAVK PKS | EN: VAN KATS FPLAU LAVK PKS" VALUE 0x76872 TKW_VV_VV_UB 100.0 FORMULA_0003 0.0 255.0000 /end CHARACTERISTIC
/begin CHARACTERISTIC K_SK_MD_BEGR_GEMISCH_28of32_ "VAN KATS FPLAU LAVK PKS | EN: VAN KATS FPLAU LAVK PKS" VALUE 0x76873 TKW_VV_VV_UB 100.0 FORMULA_0003 0.0 255.0000 /end CHARACTERISTIC
/begin CHARACTERISTIC K_SK_MD_BEGR_GEMISCH_29of32_ "VAN KATS FPLAU LAVK PKS | EN: VAN KATS FPLAU LAVK PKS" VALUE 0x76874 TKW_VV_VV_UB 100.0 FORMULA_0003 0.0 255.0000 /end CHARACTERISTIC
/begin CHARACTERISTIC K_SK_MD_BEGR_GEMISCH_30of32_ "VAN KATS FPLAU LAVK PKS | EN: VAN KATS FPLAU LAVK PKS" VALUE 0x76875 TKW_VV_VV_UB 100.0 FORMULA_0003 0.0 255.0000 /end CHARACTERISTIC
/begin CHARACTERISTIC K_SK_MD_BEGR_GEMISCH_31of32_ "VAN KATS FPLAU LAVK PKS | EN: VAN KATS FPLAU LAVK PKS" VALUE 0x76876 TKW_VV_VV_UB 100.0 FORMULA_0003 0.0 255.0000 /end CHARACTERISTIC
/begin CHARACTERISTIC K_SK_MD_BEGR_GEMISCH_32of32_ "VAN KATS FPLAU LAVK PKS | EN: VAN KATS FPLAU LAVK PKS" VALUE 0x76877 TKW_VV_VV_UB 100.0 FORMULA_0003 0.0 255.0000 /end CHARACTERISTIC
/begin CHARACTERISTIC K_SK_MD_BEGR_KR_1of8_ "nc nc SpVe" VALUE 0x76878 TKW_VV_VV_UB 100.0 FORMULA_0003 0.0 255.0000 /end CHARACTERISTIC
/begin CHARACTERISTIC K_SK_MD_BEGR_KR_2of8_ "nc nc SpVe" VALUE 0x76879 TKW_VV_VV_UB 100.0 FORMULA_0003 0.0 255.0000 /end CHARACTERISTIC
/begin CHARACTERISTIC K_SK_MD_BEGR_KR_3of8_ "nc nc SpVe" VALUE 0x7687A TKW_VV_VV_UB 100.0 FORMULA_0003 0.0 255.0000 /end CHARACTERISTIC
/begin CHARACTERISTIC K_SK_MD_BEGR_KR_4of8_ "nc nc SpVe" VALUE 0x7687B TKW_VV_VV_UB 100.0 FORMULA_0003 0.0 255.0000 /end CHARACTERISTIC
/begin CHARACTERISTIC K_SK_MD_BEGR_KR_5of8_ "nc nc SpVe" VALUE 0x7687C TKW_VV_VV_UB 100.0 FORMULA_0003 0.0 255.0000 /end CHARACTERISTIC
/begin CHARACTERISTIC K_SK_MD_BEGR_KR_6of8_ "nc nc SpVe" VALUE 0x7687D TKW_VV_VV_UB 100.0 FORMULA_0003 0.0 255.0000 /end CHARACTERISTIC
/begin CHARACTERISTIC K_SK_MD_BEGR_KR_7of8_ "nc nc SpVe" VALUE 0x7687E TKW_VV_VV_UB 100.0 FORMULA_0003 0.0 255.0000 /end CHARACTERISTIC
/begin CHARACTERISTIC K_SK_MD_BEGR_KR_8of8_ "nc nc SpVe" VALUE 0x7687F TKW_VV_VV_UB 100.0 FORMULA_0003 0.0 255.0000 /end CHARACTERISTIC
/begin CHARACTERISTIC K_SK_LAM_EINGR_1of32_ "Gemisch Boff Zoff DK LLS | EN: Gemisch Boff Zoff DK LLS" VALUE 0x76880 TKW_VV_VV_UB 100.0 FORMULA_0367 0.0 255.0 /end CHARACTERISTIC
/begin CHARACTERISTIC K_SK_LAM_EINGR_2of32_ "Gemisch Boff Zoff DK LLS | EN: Gemisch Boff Zoff DK LLS" VALUE 0x76881 TKW_VV_VV_UB 100.0 FORMULA_0367 0.0 255.0 /end CHARACTERISTIC
/begin CHARACTERISTIC K_SK_LAM_EINGR_3of32_ "Gemisch Boff Zoff DK LLS | EN: Gemisch Boff Zoff DK LLS" VALUE 0x76882 TKW_VV_VV_UB 100.0 FORMULA_0367 0.0 255.0 /end CHARACTERISTIC
/begin CHARACTERISTIC K_SK_LAM_EINGR_4of32_ "Gemisch Boff Zoff DK LLS | EN: Gemisch Boff Zoff DK LLS" VALUE 0x76883 TKW_VV_VV_UB 100.0 FORMULA_0367 0.0 255.0 /end CHARACTERISTIC
/begin CHARACTERISTIC K_SK_LAM_EINGR_5of32_ "Gemisch Boff Zoff DK LLS | EN: Gemisch Boff Zoff DK LLS" VALUE 0x76884 TKW_VV_VV_UB 100.0 FORMULA_0367 0.0 255.0 /end CHARACTERISTIC
/begin CHARACTERISTIC K_SK_LAM_EINGR_6of32_ "Gemisch Boff Zoff DK LLS | EN: Gemisch Boff Zoff DK LLS" VALUE 0x76885 TKW_VV_VV_UB 100.0 FORMULA_0367 0.0 255.0 /end CHARACTERISTIC
/begin CHARACTERISTIC K_SK_LAM_EINGR_7of32_ "Gemisch Boff Zoff DK LLS | EN: Gemisch Boff Zoff DK LLS" VALUE 0x76886 TKW_VV_VV_UB 100.0 FORMULA_0367 0.0 255.0 /end CHARACTERISTIC
/begin CHARACTERISTIC K_SK_LAM_EINGR_8of32_ "Gemisch Boff Zoff DK LLS | EN: Gemisch Boff Zoff DK LLS" VALUE 0x76887 TKW_VV_VV_UB 100.0 FORMULA_0367 0.0 255.0 /end CHARACTERISTIC
/begin CHARACTERISTIC K_SK_LAM_EINGR_9of32_ "Gemisch Boff Zoff DK LLS | EN: Gemisch Boff Zoff DK LLS" VALUE 0x76888 TKW_VV_VV_UB 100.0 FORMULA_0367 0.0 255.0 /end CHARACTERISTIC
/begin CHARACTERISTIC K_SK_LAM_EINGR_10of32_ "Gemisch Boff Zoff DK LLS | EN: Gemisch Boff Zoff DK LLS" VALUE 0x76889 TKW_VV_VV_UB 100.0 FORMULA_0367 0.0 255.0 /end CHARACTERISTIC
/begin CHARACTERISTIC K_SK_LAM_EINGR_11of32_ "Gemisch Boff Zoff DK LLS | EN: Gemisch Boff Zoff DK LLS" VALUE 0x7688A TKW_VV_VV_UB 100.0 FORMULA_0367 0.0 255.0 /end CHARACTERISTIC
/begin CHARACTERISTIC K_SK_LAM_EINGR_12of32_ "Gemisch Boff Zoff DK LLS | EN: Gemisch Boff Zoff DK LLS" VALUE 0x7688B TKW_VV_VV_UB 100.0 FORMULA_0367 0.0 255.0 /end CHARACTERISTIC
/begin CHARACTERISTIC K_SK_LAM_EINGR_13of32_ "Gemisch Boff Zoff DK LLS | EN: Gemisch Boff Zoff DK LLS" VALUE 0x7688C TKW_VV_VV_UB 100.0 FORMULA_0367 0.0 255.0 /end CHARACTERISTIC
/begin CHARACTERISTIC K_SK_LAM_EINGR_14of32_ "Gemisch Boff Zoff DK LLS | EN: Gemisch Boff Zoff DK LLS" VALUE 0x7688D TKW_VV_VV_UB 100.0 FORMULA_0367 0.0 255.0 /end CHARACTERISTIC
/begin CHARACTERISTIC K_SK_LAM_EINGR_15of32_ "Gemisch Boff Zoff DK LLS | EN: Gemisch Boff Zoff DK LLS" VALUE 0x7688E TKW_VV_VV_UB 100.0 FORMULA_0367 0.0 255.0 /end CHARACTERISTIC
/begin CHARACTERISTIC K_SK_LAM_EINGR_16of32_ "Gemisch Boff Zoff DK LLS | EN: Gemisch Boff Zoff DK LLS" VALUE 0x7688F TKW_VV_VV_UB 100.0 FORMULA_0367 0.0 255.0 /end CHARACTERISTIC
/begin CHARACTERISTIC K_SK_LAM_EINGR_17of32_ "Gemisch Boff Zoff DK LLS | EN: Gemisch Boff Zoff DK LLS" VALUE 0x76890 TKW_VV_VV_UB 100.0 FORMULA_0367 0.0 255.0 /end CHARACTERISTIC
/begin CHARACTERISTIC K_SK_LAM_EINGR_18of32_ "Gemisch Boff Zoff DK LLS | EN: Gemisch Boff Zoff DK LLS" VALUE 0x76891 TKW_VV_VV_UB 100.0 FORMULA_0367 0.0 255.0 /end CHARACTERISTIC
/begin CHARACTERISTIC K_SK_LAM_EINGR_19of32_ "Gemisch Boff Zoff DK LLS | EN: Gemisch Boff Zoff DK LLS" VALUE 0x76892 TKW_VV_VV_UB 100.0 FORMULA_0367 0.0 255.0 /end CHARACTERISTIC
/begin CHARACTERISTIC K_SK_LAM_EINGR_20of32_ "Gemisch Boff Zoff DK LLS | EN: Gemisch Boff Zoff DK LLS" VALUE 0x76893 TKW_VV_VV_UB 100.0 FORMULA_0367 0.0 255.0 /end CHARACTERISTIC
/begin CHARACTERISTIC K_SK_LAM_EINGR_21of32_ "Gemisch Boff Zoff DK LLS | EN: Gemisch Boff Zoff DK LLS" VALUE 0x76894 TKW_VV_VV_UB 100.0 FORMULA_0367 0.0 255.0 /end CHARACTERISTIC
/begin CHARACTERISTIC K_SK_LAM_EINGR_22of32_ "Gemisch Boff Zoff DK LLS | EN: Gemisch Boff Zoff DK LLS" VALUE 0x76895 TKW_VV_VV_UB 100.0 FORMULA_0367 0.0 255.0 /end CHARACTERISTIC
/begin CHARACTERISTIC K_SK_LAM_EINGR_23of32_ "Gemisch Boff Zoff DK LLS | EN: Gemisch Boff Zoff DK LLS" VALUE 0x76896 TKW_VV_VV_UB 100.0 FORMULA_0367 0.0 255.0 /end CHARACTERISTIC
/begin CHARACTERISTIC K_SK_LAM_EINGR_24of32_ "Gemisch Boff Zoff DK LLS | EN: Gemisch Boff Zoff DK LLS" VALUE 0x76897 TKW_VV_VV_UB 100.0 FORMULA_0367 0.0 255.0 /end CHARACTERISTIC
/begin CHARACTERISTIC K_SK_LAM_EINGR_25of32_ "Gemisch Boff Zoff DK LLS | EN: Gemisch Boff Zoff DK LLS" VALUE 0x76898 TKW_VV_VV_UB 100.0 FORMULA_0367 0.0 255.0 /end CHARACTERISTIC
/begin CHARACTERISTIC K_SK_LAM_EINGR_26of32_ "Gemisch Boff Zoff DK LLS | EN: Gemisch Boff Zoff DK LLS" VALUE 0x76899 TKW_VV_VV_UB 100.0 FORMULA_0367 0.0 255.0 /end CHARACTERISTIC
/begin CHARACTERISTIC K_SK_LAM_EINGR_27of32_ "Gemisch Boff Zoff DK LLS | EN: Gemisch Boff Zoff DK LLS" VALUE 0x7689A TKW_VV_VV_UB 100.0 FORMULA_0367 0.0 255.0 /end CHARACTERISTIC
/begin CHARACTERISTIC K_SK_LAM_EINGR_28of32_ "Gemisch Boff Zoff DK LLS | EN: Gemisch Boff Zoff DK LLS" VALUE 0x7689B TKW_VV_VV_UB 100.0 FORMULA_0367 0.0 255.0 /end CHARACTERISTIC
/begin CHARACTERISTIC K_SK_LAM_EINGR_29of32_ "Gemisch Boff Zoff DK LLS | EN: Gemisch Boff Zoff DK LLS" VALUE 0x7689C TKW_VV_VV_UB 100.0 FORMULA_0367 0.0 255.0 /end CHARACTERISTIC
/begin CHARACTERISTIC K_SK_LAM_EINGR_30of32_ "Gemisch Boff Zoff DK LLS | EN: Gemisch Boff Zoff DK LLS" VALUE 0x7689D TKW_VV_VV_UB 100.0 FORMULA_0367 0.0 255.0 /end CHARACTERISTIC
/begin CHARACTERISTIC K_SK_LAM_EINGR_31of32_ "Gemisch Boff Zoff DK LLS | EN: Gemisch Boff Zoff DK LLS" VALUE 0x7689E TKW_VV_VV_UB 100.0 FORMULA_0367 0.0 255.0 /end CHARACTERISTIC
/begin CHARACTERISTIC K_SK_LAM_EINGR_32of32_ "Gemisch Boff Zoff DK LLS | EN: Gemisch Boff Zoff DK LLS" VALUE 0x7689F TKW_VV_VV_UB 100.0 FORMULA_0367 0.0 255.0 /end CHARACTERISTIC
/begin CHARACTERISTIC K_SK_MD_BEGR_PWG_1of6_ "pwg_mode | EN: pwg_mode" VALUE 0x768A0 TKW_VV_VV_UB 100.0 FORMULA_0003 0.0 255.0000 /end CHARACTERISTIC
/begin CHARACTERISTIC K_SK_MD_BEGR_PWG_2of6_ "pwg_mode | EN: pwg_mode" VALUE 0x768A1 TKW_VV_VV_UB 100.0 FORMULA_0003 0.0 255.0000 /end CHARACTERISTIC
/begin CHARACTERISTIC K_SK_MD_BEGR_PWG_3of6_ "pwg_mode | EN: pwg_mode" VALUE 0x768A2 TKW_VV_VV_UB 100.0 FORMULA_0003 0.0 255.0000 /end CHARACTERISTIC
/begin CHARACTERISTIC K_SK_MD_BEGR_PWG_4of6_ "pwg_mode | EN: pwg_mode" VALUE 0x768A3 TKW_VV_VV_UB 100.0 FORMULA_0003 0.0 255.0000 /end CHARACTERISTIC
/begin CHARACTERISTIC K_SK_MD_BEGR_PWG_5of6_ "pwg_mode | EN: pwg_mode" VALUE 0x768A4 TKW_VV_VV_UB 100.0 FORMULA_0003 0.0 255.0000 /end CHARACTERISTIC
/begin CHARACTERISTIC K_SK_MD_BEGR_PWG_6of6_ "pwg_mode | EN: pwg_mode" VALUE 0x768A5 TKW_VV_VV_UB 100.0 FORMULA_0003 0.0 255.0000 /end CHARACTERISTIC
/begin CHARACTERISTIC K_SK_MD_BEGR_MVAC_1of4_ "ELUP MVAC | EN: ELUP MVAC" VALUE 0x768A6 TKW_VV_VV_UB 100.0 FORMULA_0003 0.0 255.0000 /end CHARACTERISTIC
/begin CHARACTERISTIC K_SK_MD_BEGR_MVAC_2of4_ "ELUP MVAC | EN: ELUP MVAC" VALUE 0x768A7 TKW_VV_VV_UB 100.0 FORMULA_0003 0.0 255.0000 /end CHARACTERISTIC
/begin CHARACTERISTIC K_SK_MD_BEGR_MVAC_3of4_ "ELUP MVAC | EN: ELUP MVAC" VALUE 0x768A8 TKW_VV_VV_UB 100.0 FORMULA_0003 0.0 255.0000 /end CHARACTERISTIC
/begin CHARACTERISTIC K_SK_MD_BEGR_MVAC_4of4_ "ELUP MVAC | EN: ELUP MVAC" VALUE 0x768A9 TKW_VV_VV_UB 100.0 FORMULA_0003 0.0 255.0000 /end CHARACTERISTIC
/begin CHARACTERISTIC K_SK_MVAC_KH_1of4_ "ELUP MVAC | EN: ELUP MVAC" VALUE 0x768AA TKW_VV_VV_UB 100.0 FORMULA_0368 0.0 255.0 /end CHARACTERISTIC
/begin CHARACTERISTIC K_SK_MVAC_KH_2of4_ "ELUP MVAC | EN: ELUP MVAC" VALUE 0x768AB TKW_VV_VV_UB 100.0 FORMULA_0368 0.0 255.0 /end CHARACTERISTIC
/begin CHARACTERISTIC K_SK_MVAC_KH_3of4_ "ELUP MVAC | EN: ELUP MVAC" VALUE 0x768AC TKW_VV_VV_UB 100.0 FORMULA_0368 0.0 255.0 /end CHARACTERISTIC
/begin CHARACTERISTIC K_SK_MVAC_KH_4of4_ "ELUP MVAC | EN: ELUP MVAC" VALUE 0x768AD TKW_VV_VV_UB 100.0 FORMULA_0368 0.0 255.0 /end CHARACTERISTIC
/begin MEASUREMENT sk_fail_st_zyl "Zusammenfassung Ausblender" UWORD FORMULA_0184 0 0 0.0 65535.0 ECU_ADDRESS 0x3FCFEE /end MEASUREMENT
/begin MEASUREMENT sk_fm_gemisch "Eingang Gemisch-Matrix" UBYTE FORMULA_0172 0 0 0.0 255.0 ECU_ADDRESS 0x3FCFF0 /end MEASUREMENT
/begin MEASUREMENT sk_fm_kr "Eingang KR-Matrix" UBYTE FORMULA_0172 0 0 0.0 255.0 ECU_ADDRESS 0x3FCFF1 /end MEASUREMENT
/begin MEASUREMENT sk_fm_ti "Eingang TI-Matrix" UBYTE FORMULA_0172 0 0 0.0 255.0 ECU_ADDRESS 0x3FCFF2 /end MEASUREMENT
/begin MEASUREMENT sk_fm_egas_exd "Abschaltung ueber Exd" UBYTE FORMULA_0362 0 0 0.0 255.0 ECU_ADDRESS 0x3FCFF3 /end MEASUREMENT
/begin MEASUREMENT sk_tr_error_cnt "Fehlerzaehler Testrechnung" UBYTE FORMULA_0003 0 0 0.0 255.0000 ECU_ADDRESS 0x3FCFF6 /end MEASUREMENT
/begin MEASUREMENT sk_fm_lam_1of2_ "Eingang LAM-Matrix" UBYTE FORMULA_0172 0 0 0.0 255.0 ECU_ADDRESS 0x3FCFF7 /end MEASUREMENT
/begin MEASUREMENT sk_fm_lam_2of2_ "Eingang LAM-Matrix" UBYTE FORMULA_0172 0 0 0.0 255.0 ECU_ADDRESS 0x3FCFF8 /end MEASUREMENT
/begin MEASUREMENT sk_md_begr_st "Ausloeser MD-Begrenzung" UWORD FORMULA_0011 0 0 0.0 65535.0 ECU_ADDRESS 0x3FCFFA /end MEASUREMENT
/begin MEASUREMENT sk_ti_off_st "Ausloeser TI-Abschaltung" UWORD FORMULA_0011 0 0 0.0 65535.0 ECU_ADDRESS 0x3FCFFC /end MEASUREMENT
/begin MEASUREMENT sk_egas_off_time_b1 "Zeit bis Egasabschaltung" UWORD FORMULA_0021 0 0 0.0 5.0000 ECU_ADDRESS 0x3FCFFE /end MEASUREMENT
/begin MEASUREMENT sk_egas_off_time_b2 "Zeit bis Egasabschaltung" UWORD FORMULA_0021 0 0 0.0 5.0000 ECU_ADDRESS 0x3FD000 /end MEASUREMENT
/begin MEASUREMENT sk_ti_zyl_off_cnt "Anzahl der Ausblender" UBYTE FORMULA_0003 0 0 0.0 12.0000 ECU_ADDRESS 0x3FD002 /end MEASUREMENT
/begin MEASUREMENT sk_t_reset_delay_os "Timer fuer Verzoegerung sk_reset bei OS Fehlern" UWORD FORMULA_0021 0 0 0.0 655.0000 ECU_ADDRESS 0x3FD004 /end MEASUREMENT
/begin MEASUREMENT sk_ursache "Urache fuer SK-Eingriff" UWORD FORMULA_0011 0 0 0.0 65535.0 ECU_ADDRESS 0x3FE75C /end MEASUREMENT
/begin MEASUREMENT sk_reset_cnt "Resetzaehler seit Kl15 ein" UBYTE FORMULA_0003 0 0 0.0 10.0000 ECU_ADDRESS 0x3FE75E /end MEASUREMENT
/begin MEASUREMENT sk_md_begr_ni "SK-Begrenzungsstufe - no Init" UBYTE FORMULA_0172 0 0 0.0 255.0 ECU_ADDRESS 0x3FE75F /end MEASUREMENT
/begin MEASUREMENT sk_egas_off_ni "SK-Egasstufe - no Init" UBYTE FORMULA_0172 0 0 0.0 255.0 ECU_ADDRESS 0x3FE760 /end MEASUREMENT
/* ------------------ Abschnitt erzeugt aus sk_e2_glob.dat ------------------ */
/begin CHARACTERISTIC K_SK_E2_KOMP_ERR_MAX "max. Fehler fuer Komplementvergleich | EN: Maximum faults for complement comparison" VALUE 0x768AE TKW_VV_VV_UB 100.0 FORMULA_0003 0.0 255.0000 /end CHARACTERISTIC
/begin CHARACTERISTIC K_SK_MAX_RESETS_E2 "max. Anzahl von Resets pro SG-Lauf Ebene 2 | EN: Maximum number of resets per ECU run, level 2" VALUE 0x768AF TKW_VV_VV_UB 100.0 FORMULA_0003 0.0 255.0000 /end CHARACTERISTIC
/begin MEASUREMENT sk_e2_byte "Counter Byte-Komplement" UBYTE FORMULA_0003 0 0 0.0 255.0000 ECU_ADDRESS 0x3FD808 /end MEASUREMENT
/begin MEASUREMENT sk_e2_word "Counter Word-Komplement" UBYTE FORMULA_0003 0 0 0.0 255.0000 ECU_ADDRESS 0x3FD809 /end MEASUREMENT
/begin MEASUREMENT sk_e2_long "Counter Long-Komplement" UBYTE FORMULA_0003 0 0 0.0 255.0000 ECU_ADDRESS 0x3FD80A /end MEASUREMENT
/begin MEASUREMENT sk_e2_byte_err "Fehler Byte-Komplement" UBYTE FORMULA_0003 0 0 0.0 255.0000 ECU_ADDRESS 0x3FD80B /end MEASUREMENT
/begin MEASUREMENT sk_e2_word_err "Fehler Word-Komplement" UBYTE FORMULA_0003 0 0 0.0 255.0000 ECU_ADDRESS 0x3FD80C /end MEASUREMENT
/begin MEASUREMENT sk_e2_long_err "Fehler Long-Komplement" UBYTE FORMULA_0003 0 0 0.0 255.0000 ECU_ADDRESS 0x3FD80D /end MEASUREMENT
/begin MEASUREMENT sk_e2_komp_err "Anzahl der Komplement-Fehler" UBYTE FORMULA_0003 0 0 0.0 255.0000 ECU_ADDRESS 0x3FD80E /end MEASUREMENT
/begin MEASUREMENT sk_e2_fehler "aktueller Ebene2-Fehler" UWORD FORMULA_0369 0 0 0.0 65535.0 ECU_ADDRESS 0x3FE762 /end MEASUREMENT
/begin MEASUREMENT sk_reset_cnt_e2 "Resetzaehler Ebene 2" UBYTE FORMULA_0003 0 0 0.0 10.0000 ECU_ADDRESS 0x3FE764 /end MEASUREMENT
/* ------------------ Abschnitt erzeugt aus sw_confg.dat ------------------ */
/begin CHARACTERISTIC cfg.motortyp "Konfigurationsparameter: Motortyp | EN: Konfigurationsparameter: Motortyp" VALUE 0x76DBA TKW_VV_VV_UW 100.0 FORMULA_0371 0.0 65535.0 FORMAT "%5.2" /end CHARACTERISTIC
/begin CHARACTERISTIC cfg.baureihe "Konfigurationsparameter: Fz Baureihe" VALUE 0x76DBC TKW_VV_VV_UB 100.0 FORMULA_0372 0.0 255.0 /end CHARACTERISTIC
/begin CHARACTERISTIC cfg.getriebetyp "Konfigurationsparameter: Getriebetyp | EN: Konfigurationsparameter: Getriebetyp" VALUE 0x76DBD TKW_VV_VV_UB 100.0 FORMULA_0373 0.0 255.0 /end CHARACTERISTIC
/begin CHARACTERISTIC cfg.la_variante "Konfigurationsparameter: LA-Variante | EN: Konfigurationsparameter: LA-Variante" VALUE 0x76DBE TKW_VV_VV_UB 100.0 FORMULA_0374 0.0 255.0 /end CHARACTERISTIC
/begin CHARACTERISTIC cfg.abgas "Konfigurationsparameter: ABGAS-Variante" VALUE 0x76DBF TKW_VV_VV_UB 100.0 FORMULA_0375 0.0 255.0 /end CHARACTERISTIC
/begin CHARACTERISTIC cfg.diagnose "Konfigurationsparameter: Diagnose | EN: Konfigurationsparameter: Diagnose" VALUE 0x76DC0 TKW_VV_VV_UB 100.0 FORMULA_0376 0.0 255.0 /end CHARACTERISTIC
/begin CHARACTERISTIC cfg.status "Konfigurationsparameter: SG Status | EN: Konfigurationsparameter: SG Status" VALUE 0x76DC1 TKW_VV_VV_UB 100.0 FORMULA_0377 0.0 255.0 /end CHARACTERISTIC
/begin CHARACTERISTIC cfg.canstand "Konfigurationsparameter: CAN Stand | EN: Konfigurationsparameter: CAN Stand" VALUE 0x76DC2 TKW_VV_VV_UB 100.0 FORMULA_0378 0.0 255.0 /end CHARACTERISTIC
/begin CHARACTERISTIC cfg.betriebsmode "Konfigurationsparameter: SG Typ | EN: Konfigurationsparameter: SG Typ" VALUE 0x76DC3 TKW_VV_VV_UB 100.0 FORMULA_0379 0.0 255.0 /end CHARACTERISTIC
/begin CHARACTERISTIC cfg.sg_mode "Steuergeraete Mode | EN: Steuergeraete Mode" VALUE 0x76DC4 TKW_VV_VV_UB 100.0 FORMULA_0380 0.0 255.0 BIT_MASK 0xF /end CHARACTERISTIC
/begin CHARACTERISTIC cfg.peripherie "Konfigurationsparameter: Motorperipherie" VALUE 0x76DC5 TKW_VV_VV_UB 100.0 FORMULA_0033 0.0 255.0000 /end CHARACTERISTIC
/begin CHARACTERISTIC cfg.dsc_typ "Konfigurationsparameter: DSC" VALUE 0x76DC6 TKW_VV_VV_UB 100.0 FORMULA_0381 0.0 255.0 /end CHARACTERISTIC
/begin CHARACTERISTIC cfg.canmess "Konfigurationsparameter: CAN-Messtechnik | EN: Konfigurationsparameter: CAN-Messtechnik" VALUE 0x76DC7 TKW_VV_VV_UB 100.0 FORMULA_0357 0.0 255.0 /end CHARACTERISTIC
/begin CHARACTERISTIC cfg.hil "Konfigurationsparameter: HIL-Betrieb | EN: Konfigurationsparameter: HIL-Betrieb" VALUE 0x76DC8 TKW_VV_VV_UB 100.0 FORMULA_0382 0.0 255.0 /end CHARACTERISTIC
/begin CHARACTERISTIC cfg.ipm "Konfigurationsparameter: IPM | EN: Konfigurationsparameter: IPM" VALUE 0x76DC9 TKW_VV_VV_UB 100.0 FORMULA_0357 0.0 255.0 /end CHARACTERISTIC
/begin MEASUREMENT cfg_boot_st "Bootstaus" ULONG FORMULA_0000 0 0 0.0 4294967295.0000 ECU_ADDRESS 0x3F8010 /end MEASUREMENT
/begin MEASUREMENT vers_boot "Booterversion" UWORD FORMULA_0010 0 0 0.0 65535.0000 ECU_ADDRESS 0x3F8014 /end MEASUREMENT
/begin MEASUREMENT vers_boot_index "Booterversionsindex" UWORD FORMULA_0010 0 0 0.0 65535.0000 ECU_ADDRESS 0x3F8016 /end MEASUREMENT
/begin MEASUREMENT sys_exc_lr "Linkregister nach Exception" ULONG FORMULA_0000 0 0 0.0 4294967295.0000 ECU_ADDRESS 0x3F8018 /end MEASUREMENT
/* ------------------ Abschnitt erzeugt aus sys_zust.dat ------------------ */
/begin MEASUREMENT sys_ed_st "ED Status" UWORD FORMULA_0383 0 0 0.0 65535.0 ECU_ADDRESS 0x3FD0C8 /end MEASUREMENT
/begin MEASUREMENT sys_zust "Betriebszustand des Systems" UWORD FORMULA_0384 0 0 0.0 65535.0 ECU_ADDRESS 0x3FD0CA /end MEASUREMENT
/begin MEASUREMENT sys_last_reset_st "Letzter Resetstatus" UBYTE FORMULA_0385 0 0 0.0 255.0 ECU_ADDRESS 0x3FD0D0 /end MEASUREMENT
/begin MEASUREMENT sys_rsr "Reset Status Register" UWORD FORMULA_0010 0 0 0.0 65535.0000 ECU_ADDRESS 0x3FE768 /end MEASUREMENT
/begin MEASUREMENT sys_rsr_ehrs "External Hreset" UWORD FORMULA_0386 0 0 0.0 65535.0 ECU_ADDRESS 0x3FE768 BIT_MASK 0x8000 /end MEASUREMENT
/begin MEASUREMENT sys_rsr_ersr "External Soft reset" UWORD FORMULA_0387 0 0 0.0 65535.0 ECU_ADDRESS 0x3FE768 BIT_MASK 0x4000 /end MEASUREMENT
/begin MEASUREMENT sys_rsr_llrs "Los of lock reset" UWORD FORMULA_0388 0 0 0.0 65535.0 ECU_ADDRESS 0x3FE768 BIT_MASK 0x2000 /end MEASUREMENT
/begin MEASUREMENT sys_rsr_swrs "Software watchdog reset" UWORD FORMULA_0389 0 0 0.0 65535.0 ECU_ADDRESS 0x3FE768 BIT_MASK 0x1000 /end MEASUREMENT
/begin MEASUREMENT sys_rsr_csrs "Checkstop reset" UWORD FORMULA_0390 0 0 0.0 65535.0 ECU_ADDRESS 0x3FE768 BIT_MASK 0x800 /end MEASUREMENT
/begin MEASUREMENT sys_rsr_dbhrs "Debug port hard reset" UWORD FORMULA_0391 0 0 0.0 65535.0 ECU_ADDRESS 0x3FE768 BIT_MASK 0x400 /end MEASUREMENT
/begin MEASUREMENT sys_rsr_dbsrs "Debug port soft reset" UWORD FORMULA_0392 0 0 0.0 65535.0 ECU_ADDRESS 0x3FE768 BIT_MASK 0x200 /end MEASUREMENT
/begin MEASUREMENT sys_rsr_jtrs "Jtag reset" UWORD FORMULA_0393 0 0 0.0 65535.0 ECU_ADDRESS 0x3FE768 BIT_MASK 0x100 /end MEASUREMENT
/begin MEASUREMENT sys_rsr_occs "On chip clock reset" UWORD FORMULA_0394 0 0 0.0 65535.0 ECU_ADDRESS 0x3FE768 BIT_MASK 0x80 /end MEASUREMENT
/begin MEASUREMENT sys_rsr_ilbc "Illegal bit change reset" UWORD FORMULA_0395 0 0 0.0 65535.0 ECU_ADDRESS 0x3FE768 BIT_MASK 0x40 /end MEASUREMENT
/begin MEASUREMENT sys_rsr_gpor "Glitch detected on  powern on reset" UWORD FORMULA_0396 0 0 0.0 65535.0 ECU_ADDRESS 0x3FE768 BIT_MASK 0x20 /end MEASUREMENT
/begin MEASUREMENT sys_rsr_ghrst "Glitch detected on  HRESET PIN" UWORD FORMULA_0397 0 0 0.0 65535.0 ECU_ADDRESS 0x3FE768 BIT_MASK 0x10 /end MEASUREMENT
/begin MEASUREMENT sys_rsr_gsrst "Glitch detected on  SRESET PIN" UWORD FORMULA_0398 0 0 0.0 65535.0 ECU_ADDRESS 0x3FE768 BIT_MASK 0x8 /end MEASUREMENT
/begin MEASUREMENT sys_rsr_cnt_sum "Reset-Summenzaehler" UWORD FORMULA_0010 0 0 0.0 65535.0000 ECU_ADDRESS 0x3FE76A /end MEASUREMENT
/begin MEASUREMENT sys_zust_cpu_last "CPU Last" UWORD FORMULA_0001 0 0 0.0 100.0000 ECU_ADDRESS 0x3FE76C /end MEASUREMENT
/begin MEASUREMENT sys_zust_bgnd_cnt "Aufruf Bgnd Task pro 100ms" UWORD FORMULA_0010 0 0 0.0 1000.0000 ECU_ADDRESS 0x3FE76E /end MEASUREMENT
/begin MEASUREMENT sys_zust_bgnd_net_min "Background Netto time min" UWORD FORMULA_0399 0 0 0.0 2.0000 ECU_ADDRESS 0x3FE770 /end MEASUREMENT
/begin MEASUREMENT sys_exc_vec "Exception-Vector" UWORD FORMULA_0015 0 0 0.0 65535.0 ECU_ADDRESS 0x3FE772 /end MEASUREMENT
/begin MEASUREMENT sys_exc_addr "Exception-Adresse" ULONG FORMULA_0000 0 0 0.0 4294967295.0000 ECU_ADDRESS 0x3FE774 /end MEASUREMENT
/begin MEASUREMENT sys_sg_fehler "SG internere Fehlernummer" UBYTE FORMULA_0400 0 0 0.0 255.0 ECU_ADDRESS 0x3FE778 /end MEASUREMENT
/begin MEASUREMENT sys_reset_st "Resetursache" UBYTE FORMULA_0385 0 0 0.0 255.0 ECU_ADDRESS 0x3FE779 /end MEASUREMENT
/begin MEASUREMENT sys_exc_km_ni "Kilometerstand bei Exception" ULONG FORMULA_0027 0 0 0.0 16777214.0000 ECU_ADDRESS 0x3FE77C /end MEASUREMENT
/begin MEASUREMENT sys_exc_n_ni "Drehzahl bei Exception" SWORD FORMULA_0006 0 0 0.0 10000.0000 ECU_ADDRESS 0x3FE780 /end MEASUREMENT
/begin MEASUREMENT sys_sync_init_t_1of5_ "Hochlauf Zeitmarken" UWORD FORMULA_0401 0 0 0.0 16711.4250 ECU_ADDRESS 0x3FE782 /end MEASUREMENT
/begin MEASUREMENT sys_sync_init_t_2of5_ "Hochlauf Zeitmarken" UWORD FORMULA_0401 0 0 0.0 16711.4250 ECU_ADDRESS 0x3FE784 /end MEASUREMENT
/begin MEASUREMENT sys_sync_init_t_3of5_ "Hochlauf Zeitmarken" UWORD FORMULA_0401 0 0 0.0 16711.4250 ECU_ADDRESS 0x3FE786 /end MEASUREMENT
/begin MEASUREMENT sys_sync_init_t_4of5_ "Hochlauf Zeitmarken" UWORD FORMULA_0401 0 0 0.0 16711.4250 ECU_ADDRESS 0x3FE788 /end MEASUREMENT
/begin MEASUREMENT sys_sync_init_t_5of5_ "Hochlauf Zeitmarken" UWORD FORMULA_0401 0 0 0.0 16711.4250 ECU_ADDRESS 0x3FE78A /end MEASUREMENT
/* ------------------ Abschnitt erzeugt aus rf.dat ------------------ */
/begin CHARACTERISTIC K_RF_HUBVOLUMEN "Hubvolumen  | EN: Hubvolumen" VALUE 0x7639E TKW_VV_VV_UW 100.0 FORMULA_1071 1.0000 9.0000 FORMAT "%6.3" /end CHARACTERISTIC
/begin CHARACTERISTIC K_RF_LUFTDICHTE "Luftdichte | EN: Luftdichte" VALUE 0x763A0 TKW_VV_VV_UW 100.0 FORMULA_1072 0.1000 1.8000 FORMAT "%6.3" /end CHARACTERISTIC
/begin CHARACTERISTIC K_RF_ST_LL_RAMP "Dauer der RF Rampe von START nach LL | EN: Dauer der RF Rampe von START nach LL" VALUE 0x763A2 TKW_VV_VV_UB 100.0 FORMULA_1073 0.0 100.0000 /end CHARACTERISTIC
/begin CHARACTERISTIC K_RF_DYN_TAU "Filterkonstante fuer rf_dyn | EN: Filterkonstante fuer rf_dyn" VALUE 0x763A3 TKW_VV_VV_UB 100.0 FORMULA_0664 0.0101 2.5600 /end CHARACTERISTIC
/begin CHARACTERISTIC KL_RF_START "Start rf" CURVE 0x763A4 TKL_SW_VV_SW 100.0 FORMULA_0007 0.0 2.0000 /begin AXIS_DESCR STD_AXIS n FORMULA_0006 4 0.0 10000.0000 /end AXIS_DESCR FORMAT "%6.3" /end CHARACTERISTIC
/begin MEASUREMENT rf_st_ll_ramp "Segmentzaehler fuer die rf Rampe von Start auf LL" UBYTE FORMULA_1065 0 0 0.0 127.5000 ECU_ADDRESS 0x3FCE82 /end MEASUREMENT
/begin MEASUREMENT rf_dyn_la_cnt "Zaehler fuer die LA Dynamik Erkennung" UWORD FORMULA_0083 0 0 0.0 65535.0000 ECU_ADDRESS 0x3FCE84 /end MEASUREMENT
/begin MEASUREMENT rf_dyn_o2_cnt "Zaehler fuer die O2 Dynamik Erkennung" UWORD FORMULA_0083 0 0 0.0 65535.0000 ECU_ADDRESS 0x3FCE86 /end MEASUREMENT
/begin MEASUREMENT rf_dyn_st "Statusbyte fuer rf Dynamik" UBYTE FORMULA_0033 0 0 0.0 255.0000 ECU_ADDRESS 0x3FCE88 /end MEASUREMENT
/begin MEASUREMENT rf_dyn_st_te "Statusbyte fuer rf Dynamik" UBYTE FORMULA_1066 0 0 0.0 255.0 ECU_ADDRESS 0x3FCE88 BIT_MASK 0x1 /end MEASUREMENT
/begin MEASUREMENT rf_dyn_st_fplau "Statusbyte fuer rf Dynamik" UBYTE FORMULA_1067 0 0 0.0 255.0 ECU_ADDRESS 0x3FCE88 BIT_MASK 0x2 /end MEASUREMENT
/begin MEASUREMENT rf_dyn_st_la_trim "Statusbyte fuer rf Dynamik" UBYTE FORMULA_1068 0 0 0.0 255.0 ECU_ADDRESS 0x3FCE88 BIT_MASK 0x4 /end MEASUREMENT
/begin MEASUREMENT rf_dyn_st_o2 "Statusbyte fuer rf Dynamik" UBYTE FORMULA_1069 0 0 0.0 255.0 ECU_ADDRESS 0x3FCE88 BIT_MASK 0x8 /end MEASUREMENT
/begin MEASUREMENT rf_dyn_st_la "Statusbyte fuer rf Dynamik" UBYTE FORMULA_1070 0 0 0.0 255.0 ECU_ADDRESS 0x3FCE88 BIT_MASK 0x10 /end MEASUREMENT
/* ------------------ Abschnitt erzeugt aus rg.dat ------------------ */
/begin CHARACTERISTIC K_RG_M_MIN "MIN-Begrenzung RG-Masse" VALUE 0x763B6 TKW_VV_VV_SW 100.0 FORMULA_0113 -500.0000 1500.0000 FORMAT "%4.1" /end CHARACTERISTIC
/begin CHARACTERISTIC K_RG_M_MAX "MAX-Begrenzung RG-Masse" VALUE 0x763B8 TKW_VV_VV_SW 100.0 FORMULA_0113 -500.0000 1500.0000 FORMAT "%4.1" /end CHARACTERISTIC
/begin CHARACTERISTIC K_RG_X_START "RG-Gehalt Zustand Start" VALUE 0x763BA TKW_VV_VV_SW 100.0 FORMULA_0109 -0.5000 0.5000 FORMAT "%5.2" /end CHARACTERISTIC
/begin CHARACTERISTIC K_RG_TABG_FAKTOR "Verhaelt tzyl zu tabg LW" VALUE 0x763BC TKW_VV_VV_UW 100.0 FORMULA_0075 0.0 4.0000 FORMAT "%6.3" /end CHARACTERISTIC
/begin CHARACTERISTIC K_RG_V_TOTVOLUMEN "Masse RG im Totvolumen" VALUE 0x763BE TKW_VV_VV_SW 100.0 FORMULA_1077 0.0 3000.0000 FORMAT "%4.1" /end CHARACTERISTIC
/begin CHARACTERISTIC K_RG_T_UES_AV_MAX "Max. Ueberschneidungszeit" VALUE 0x763C0 TKW_VV_VV_UW 100.0 FORMULA_0998 0.0 40.0000 FORMAT "%5.2" /end CHARACTERISTIC
/begin CHARACTERISTIC K_RG_WE_ANZ_SEGM "Anzahl der Segm. fuer Auf bzw. Abregeln" VALUE 0x763C2 TKW_VV_VV_UB 100.0 FORMULA_1076 0.0 100.0000 /end CHARACTERISTIC
/begin CHARACTERISTIC KL_RG_UES_A_MEAN "AVquerschnitt nach LOT | EN: Valve cross-section after LOT" CURVE 0x763C4 TKL_SW_VV_UW 100.0 FORMULA_0997 0.0 15.0000 /begin AXIS_DESCR STD_AXIS van_xd FORMULA_0111 12 0.0 160.0000 FORMAT "%4.1" /end AXIS_DESCR FORMAT "%6.3" /end CHARACTERISTIC
/begin CHARACTERISTIC KL_RG_UES_E_MEAN "EV-Querschnitt vor LOT" CURVE 0x763F6 TKL_SW_VV_UW 100.0 FORMULA_0997 0.0 15.0000 /begin AXIS_DESCR STD_AXIS van_xd FORMULA_0111 12 0.0 160.0000 FORMAT "%4.1" /end AXIS_DESCR FORMAT "%6.3" /end CHARACTERISTIC
/begin CHARACTERISTIC KL_RG_PHI_MEAN "Durchflussbeiwert RG" CURVE 0x76428 TKL_SW_VV_SW 100.0 FORMULA_0556 -1.0000 1.0000
 /begin AXIS_DESCR STD_AXIS pzyl_pabg_Verhaeltniss FORMULA_1078 10 0.0 2.0000 FORMAT "%5.2" /end AXIS_DESCR
 FORMAT "%7.4" /end CHARACTERISTIC
/begin CHARACTERISTIC KL_RG_PRGVO_ASP_OFFSET "Druckoffset aus Ventilueberschneidung" CURVE 0x76452 TKL_SW_VV_SW 100.0 FORMULA_0077 -2000.0000 2000.0000
 /begin AXIS_DESCR STD_AXIS van_vo_filt FORMULA_0111 9 -80.0000 80.0000 FORMAT "%4.1" /end AXIS_DESCR
 FORMAT "%4.1" /end CHARACTERISTIC
/begin CHARACTERISTIC KF_RG_STAT "RG-Gehalt stationaer" MAP 0x76478 TKF_SW_SW_SW 100.0 FORMULA_0109 -0.5000 0.5000 /begin AXIS_DESCR STD_AXIS n FORMULA_0006 16 0.0 10000.0000 /end AXIS_DESCR /begin AXIS_DESCR STD_AXIS dr_rel FORMULA_0115 12 0.0 199.9938 FORMAT "%5.2" /end AXIS_DESCR FORMAT "%5.2" /end CHARACTERISTIC
/begin MEASUREMENT rg_b1.m_mod "Restgasmasse Moduliert" SWORD FORMULA_0113 0 0 -500.0000 1500.0000 ECU_ADDRESS 0x3FCE90 /end MEASUREMENT
/begin MEASUREMENT rg_b2.m_mod "Restgasmasse Moduliert" SWORD FORMULA_0113 0 0 -500.0000 1500.0000 ECU_ADDRESS 0x3FCEBE /end MEASUREMENT
/begin MEASUREMENT rg_b1.m_tot "Restgasmasse im Totvolumen" SWORD FORMULA_0113 0 0 -500.0000 1500.0000 ECU_ADDRESS 0x3FCE92 /end MEASUREMENT
/begin MEASUREMENT rg_b2.m_tot "Restgasmasse im Totvolumen" SWORD FORMULA_0113 0 0 -500.0000 1500.0000 ECU_ADDRESS 0x3FCEC0 /end MEASUREMENT
/begin MEASUREMENT rg_b1.m_av "RG-Masse ueber AV nach LOT" SWORD FORMULA_0113 0 0 -500.0000 1500.0000 ECU_ADDRESS 0x3FCE94 /end MEASUREMENT
/begin MEASUREMENT rg_b2.m_av "RG-Masse ueber AV nach LOT" SWORD FORMULA_0113 0 0 -500.0000 1500.0000 ECU_ADDRESS 0x3FCEC2 /end MEASUREMENT
/begin MEASUREMENT rg_b1.m_ev "RG-Masse ueber EV vor LOT" SWORD FORMULA_0113 0 0 -500.0000 1500.0000 ECU_ADDRESS 0x3FCE96 /end MEASUREMENT
/begin MEASUREMENT rg_b2.m_ev "RG-Masse ueber EV vor LOT" SWORD FORMULA_0113 0 0 -500.0000 1500.0000 ECU_ADDRESS 0x3FCEC4 /end MEASUREMENT
/begin MEASUREMENT rg_b1.t_ues_av "Ueberschneidungszeit vom AV" UWORD FORMULA_0998 0 0 0.0 40.0000 ECU_ADDRESS 0x3FCE98 /end MEASUREMENT
/begin MEASUREMENT rg_b2.t_ues_av "Ueberschneidungszeit vom AV" UWORD FORMULA_0998 0 0 0.0 40.0000 ECU_ADDRESS 0x3FCEC6 /end MEASUREMENT
/begin MEASUREMENT rg_b1.t_ues_ev "Ueberschneidungszeit vom EV" UWORD FORMULA_0998 0 0 0.0 40.0000 ECU_ADDRESS 0x3FCE9A /end MEASUREMENT
/begin MEASUREMENT rg_b2.t_ues_ev "Ueberschneidungszeit vom EV" UWORD FORMULA_0998 0 0 0.0 40.0000 ECU_ADDRESS 0x3FCEC8 /end MEASUREMENT
/begin MEASUREMENT rg_b1.w_ues_av "Ueberschneidungswinkel vom AV" SWORD FORMULA_0111 0 0 50.0000 160.0000 ECU_ADDRESS 0x3FCE9C /end MEASUREMENT
/begin MEASUREMENT rg_b2.w_ues_av "Ueberschneidungswinkel vom AV" SWORD FORMULA_0111 0 0 50.0000 160.0000 ECU_ADDRESS 0x3FCECA /end MEASUREMENT
/begin MEASUREMENT rg_b1.w_ues_ev "Ueberschneidungswinkel vom EV" SWORD FORMULA_0111 0 0 50.0000 160.0000 ECU_ADDRESS 0x3FCE9E /end MEASUREMENT
/begin MEASUREMENT rg_b2.w_ues_ev "Ueberschneidungswinkel vom EV" SWORD FORMULA_0111 0 0 50.0000 160.0000 ECU_ADDRESS 0x3FCECC /end MEASUREMENT
/begin MEASUREMENT rg_b1.a_mean_ues "Mittl. AV-querschnitt nach LOT" UWORD FORMULA_0997 0 0 0.0 15.0000 ECU_ADDRESS 0x3FCEA0 /end MEASUREMENT
/begin MEASUREMENT rg_b2.a_mean_ues "Mittl. AV-querschnitt nach LOT" UWORD FORMULA_0997 0 0 0.0 15.0000 ECU_ADDRESS 0x3FCECE /end MEASUREMENT
/begin MEASUREMENT rg_b1.e_mean_ues "Mittl. EV-querschnitt nach LOT" UWORD FORMULA_0997 0 0 0.0 15.0000 ECU_ADDRESS 0x3FCEA2 /end MEASUREMENT
/begin MEASUREMENT rg_b2.e_mean_ues "Mittl. EV-querschnitt nach LOT" UWORD FORMULA_0997 0 0 0.0 15.0000 ECU_ADDRESS 0x3FCED0 /end MEASUREMENT
/begin MEASUREMENT rg_b1.phi_av_mean "Durchflussbeiwert fuer AV" SWORD FORMULA_0556 0 0 -0.0001 1.0000 ECU_ADDRESS 0x3FCEA4 /end MEASUREMENT
/begin MEASUREMENT rg_b2.phi_av_mean "Durchflussbeiwert fuer AV" SWORD FORMULA_0556 0 0 -0.0001 1.0000 ECU_ADDRESS 0x3FCED2 /end MEASUREMENT
/begin MEASUREMENT rg_b1.phi_ev_mean "Durchflussbeiwert fuer EV" SWORD FORMULA_0556 0 0 -0.0001 1.0000 ECU_ADDRESS 0x3FCEA6 /end MEASUREMENT
/begin MEASUREMENT rg_b2.phi_ev_mean "Durchflussbeiwert fuer EV" SWORD FORMULA_0556 0 0 -0.0001 1.0000 ECU_ADDRESS 0x3FCED4 /end MEASUREMENT
/begin MEASUREMENT rg_b1.gas_zustand "Faktor fuer Gaszustand RG" UWORD FORMULA_0010 0 0 0.0 65535.0000 ECU_ADDRESS 0x3FCEA8 /end MEASUREMENT
/begin MEASUREMENT rg_b2.gas_zustand "Faktor fuer Gaszustand RG" UWORD FORMULA_0010 0 0 0.0 65535.0000 ECU_ADDRESS 0x3FCED6 /end MEASUREMENT
/begin MEASUREMENT rg_b1.rho "Dichte vom RG" SWORD FORMULA_1075 0 0 -8.0000 7.9997 ECU_ADDRESS 0x3FCEAA /end MEASUREMENT
/begin MEASUREMENT rg_b2.rho "Dichte vom RG" SWORD FORMULA_1075 0 0 -8.0000 7.9997 ECU_ADDRESS 0x3FCED8 /end MEASUREMENT
/begin MEASUREMENT rg_b1.mdt_av "Restgasmassenstrom durch AV" SWORD FORMULA_0112 0 0 -100.0000 1400.0000 ECU_ADDRESS 0x3FCEAC /end MEASUREMENT
/begin MEASUREMENT rg_b2.mdt_av "Restgasmassenstrom durch AV" SWORD FORMULA_0112 0 0 -100.0000 1400.0000 ECU_ADDRESS 0x3FCEDA /end MEASUREMENT
/begin MEASUREMENT rg_b1.mdt_ev "Restgasmassenstrom durch EV" SWORD FORMULA_0112 0 0 -100.0000 1400.0000 ECU_ADDRESS 0x3FCEAE /end MEASUREMENT
/begin MEASUREMENT rg_b2.mdt_ev "Restgasmassenstrom durch EV" SWORD FORMULA_0112 0 0 -100.0000 1400.0000 ECU_ADDRESS 0x3FCEDC /end MEASUREMENT
/begin MEASUREMENT rg_b1.x_stat "RG-Gehalt stationaer aus KF" SWORD FORMULA_0109 0 0 -0.5000 0.5000 ECU_ADDRESS 0x3FCEB0 /end MEASUREMENT
/begin MEASUREMENT rg_b2.x_stat "RG-Gehalt stationaer aus KF" SWORD FORMULA_0109 0 0 -0.5000 0.5000 ECU_ADDRESS 0x3FCEDE /end MEASUREMENT
/begin MEASUREMENT rg_b1.m_stat "RG-Masse stationaer aus KF" SWORD FORMULA_0113 0 0 -500.0000 1500.0000 ECU_ADDRESS 0x3FCEB2 /end MEASUREMENT
/begin MEASUREMENT rg_b2.m_stat "RG-Masse stationaer aus KF" SWORD FORMULA_0113 0 0 -500.0000 1500.0000 ECU_ADDRESS 0x3FCEE0 /end MEASUREMENT
/begin MEASUREMENT rg_b1.prgvo "Druck-Offset aus der Ventilueberschneidung" SWORD FORMULA_0077 0 0 0.0 2000.0000 ECU_ADDRESS 0x3FCEB4 /end MEASUREMENT
/begin MEASUREMENT rg_b2.prgvo "Druck-Offset aus der Ventilueberschneidung" SWORD FORMULA_0077 0 0 0.0 2000.0000 ECU_ADDRESS 0x3FCEE2 /end MEASUREMENT
/begin MEASUREMENT rg_b1.psau "Saugrohrduck aus Druck ASP und Offset" SWORD FORMULA_0077 0 0 0.0 2000.0000 ECU_ADDRESS 0x3FCEB6 /end MEASUREMENT
/begin MEASUREMENT rg_b2.psau "Saugrohrduck aus Druck ASP und Offset" SWORD FORMULA_0077 0 0 0.0 2000.0000 ECU_ADDRESS 0x3FCEE4 /end MEASUREMENT
/begin MEASUREMENT rg_b1.pabg "Abgasgegendruck fuer das Restgasmodell" SWORD FORMULA_0077 0 0 0.0 2000.0000 ECU_ADDRESS 0x3FCEB8 /end MEASUREMENT
/begin MEASUREMENT rg_b2.pabg "Abgasgegendruck fuer das Restgasmodell" SWORD FORMULA_0077 0 0 0.0 2000.0000 ECU_ADDRESS 0x3FCEE6 /end MEASUREMENT
/begin MEASUREMENT rg_b1.pzyl "pabg fuer das Restgasmodell" SWORD FORMULA_0077 0 0 0.0 2000.0000 ECU_ADDRESS 0x3FCEBA /end MEASUREMENT
/begin MEASUREMENT rg_b2.pzyl "pabg fuer das Restgasmodell" SWORD FORMULA_0077 0 0 0.0 2000.0000 ECU_ADDRESS 0x3FCEE8 /end MEASUREMENT
/begin MEASUREMENT rg_b1.sa_ctr "Counter fuer die SA Ab/-Aufregelung" UBYTE FORMULA_1076 0 0 0.0 255.0000 ECU_ADDRESS 0x3FCEBC /end MEASUREMENT
/begin MEASUREMENT rg_b2.sa_ctr "Counter fuer die SA Ab/-Aufregelung" UBYTE FORMULA_1076 0 0 0.0 255.0000 ECU_ADDRESS 0x3FCEEA /end MEASUREMENT
/* ------------------ Abschnitt erzeugt aus schalter_inj.dat ------------------ */
/begin CHARACTERISTIC K_SCHALTER_POEL_START_ENDE "Oeldruck-Aufbauzeit | EN: Oil pressure build-up time [s]" VALUE 0x76704 TKW_VV_VV_UW 100.0 FORMULA_0021 0.0 655.0000 FORMAT "%5.2" /end CHARACTERISTIC
/begin CHARACTERISTIC K_SCHALTER_POEL_N_DIAG "Oeldruck Drehzahlschwelle | EN: Oil pressure engine-speed threshold [Upm]" VALUE 0x76706 TKW_VV_VV_SW 100.0 FORMULA_0006 0.0 10000.0000 /end CHARACTERISTIC
/begin CHARACTERISTIC K_SCHALTER_POEL_T_DIAG "Oeldruck-Sperre | EN: Oil pressure lock [s]" VALUE 0x76708 TKW_VV_VV_UW 100.0 FORMULA_0021 0.0 655.0000 FORMAT "%5.2" /end CHARACTERISTIC
/begin CHARACTERISTIC K_SCHALTER_POEL_TOEL "Schwelle Oeltemperatur im Nachlauf | EN: Schwelle Oeltemperatur im Nachlauf" VALUE 0x7670A TKW_VV_VV_SW 100.0 FORMULA_0023 -50.0000 170.0000 FORMAT "%4.1" /end CHARACTERISTIC
/begin CHARACTERISTIC K_SCHALTER_POEL_N_DELAY "Delay fuer n == 0 bei S_POEL-Diagnose | EN: Delay fuer n == 0 bei S_POEL-Diagnose" VALUE 0x7670C TKW_VV_VV_UW 100.0 FORMULA_0539 0.0 6553500.0000 /end CHARACTERISTIC
/begin CHARACTERISTIC K_SCHALTER_GETR_A0 "Nullpunktadaption Schalter Getriebeleergasse | EN: Nullpunktadaption Schalter Getriebeleergasse" VALUE 0x7670E TKW_VV_VV_SW 100.0 FORMULA_0123 0.0 1023.0000 /end CHARACTERISTIC
/begin CHARACTERISTIC K_SCHALTER_GETR_FIL_TAU "Filterkonstante fuer AD_Wert Getriebeleergasse | EN: Filterkonstante fuer AD_Wert Getriebeleergasse" VALUE 0x76710 TKW_VV_VV_UB 100.0 FORMULA_0664 0.0101 2.5600 /end CHARACTERISTIC
/begin CHARACTERISTIC K_SCHALTER_GETR_LEERGASSE_MIN "minimaler AD-Wert f�r Getriebeleergasse | EN: minimaler AD -Wert für G e-triebeleergasse" VALUE 0x76712 TKW_VV_VV_SW 100.0 FORMULA_0123 -1023.0000 1023.0000 /end CHARACTERISTIC
/begin CHARACTERISTIC K_SCHALTER_GETR_LEERGASSE_MAX "maximaler AD-Wert f�r Getriebeleergasse | EN: maximaler AD -Wert für G e-triebeleergasse" VALUE 0x76714 TKW_VV_VV_SW 100.0 FORMULA_0123 -1023.0000 1023.0000 /end CHARACTERISTIC
/begin CHARACTERISTIC K_SCHALTER_GETR_HYSTERESE_BREITE "Hysterese zwischen Erkennung Leergasse und Gang (in AD Schritten) | EN: Hysterese zwischen Erken- nung Leergasse und Gang (in AD Schritten)" VALUE 0x76716 TKW_VV_VV_SW 100.0 FORMULA_0123 0.0 1023.0000 /end CHARACTERISTIC
/begin CHARACTERISTIC K_SCHALTER_GETR_DIAG_MIN "Short-to-GND Schwelle | EN: Short-to-GND Schwelle" VALUE 0x76718 TKW_VV_VV_SW 100.0 FORMULA_0123 0.0 1023.0000 /end CHARACTERISTIC
/begin CHARACTERISTIC K_SCHALTER_GETR_DIAG_MAX "Short-to-UB Schwelle | EN: Short-to-UB Schwelle" VALUE 0x7671A TKW_VV_VV_SW 100.0 FORMULA_0123 0.0 1023.0000 /end CHARACTERISTIC
/begin CHARACTERISTIC K_SCHALTER_GETR_DIAG_N_VERH_TAU "Filterkonstante fuer gang_n_verh | EN: Filterkonstante fuer gang_n_verh" VALUE 0x7671C TKW_VV_VV_UB 100.0 FORMULA_0683 0.1004 25.6000 /end CHARACTERISTIC
/begin CHARACTERISTIC K_SCHALTER_GETR_DIAG_N_GETR_EIN_MIN "Mindestdrehzahl Getriebeeingang fuer Diagnose | EN: Minimum gearbox input speed for diagnosis [Upm]" VALUE 0x7671E TKW_VV_VV_SW 100.0 FORMULA_0006 0.0 12000.0000 /end CHARACTERISTIC
/begin CHARACTERISTIC K_SCHALTER_GETR_DIAG_V_MIN "Mindestgeschwindigkeit fuer Diagnose | EN: Minimum vehicle speed for diagnosis [km/h]" VALUE 0x76720 TKW_VV_VV_SW 100.0 FORMULA_0078 -80.0000 360.0000 FORMAT "%4.1" /end CHARACTERISTIC
/begin CHARACTERISTIC K_SCHALTER_GETR_DIAG_STABIL "rel. Stabilit�tsgrenze Getriebeuebersetzung fuer Diagnose | EN: Relative stability limit of gearbox ratio for diagnosis [%]" VALUE 0x76722 TKW_VV_VV_UB 100.0 FORMULA_1087 0.0 199.2187 /end CHARACTERISTIC
/begin CHARACTERISTIC K_SCHALTER_GETR_DIAG_T "Timergrenze, um Diagnose zu beenden | EN: Timer limit to end diagnosis [s]" VALUE 0x76724 TKW_VV_VV_UW 100.0 FORMULA_0073 0.0 6553.5000 FORMAT "%4.1" /end CHARACTERISTIC
/begin CHARACTERISTIC K_SCHALTER_KUPP_GESCHL "Schaltschwelle Kupplung geschlossen | EN: Switching threshold, clutch closed [digit]" VALUE 0x76726 TKW_VV_VV_SW 100.0 FORMULA_0123 0.0 1023.0000 /end CHARACTERISTIC
/begin CHARACTERISTIC K_SCHALTER_KUPP_OFFEN "Schaltschwelle Kupplung offen | EN: Switching threshold, clutch open [digit]" VALUE 0x76728 TKW_VV_VV_SW 100.0 FORMULA_0123 0.0 1023.0000 /end CHARACTERISTIC
/begin CHARACTERISTIC K_SCHALTER_KUPP_DIAG_V_MIN "Geschwindigkeit, um Diagnose scharf zu schalten | EN: Vehicle speed to arm diagnosis [km/h]" VALUE 0x7672A TKW_VV_VV_SW 100.0 FORMULA_0078 -80.0000 360.0000 FORMAT "%4.1" /end CHARACTERISTIC
/begin CHARACTERISTIC K_SCHALTER_KUPP_DIAG_V_MAX "Geschwindigkeit, um Diagnosetimer zu starten | EN: Vehicle speed to start diagnosis timer [km/h]" VALUE 0x7672C TKW_VV_VV_SW 100.0 FORMULA_0078 -80.0000 360.0000 FORMAT "%4.1" /end CHARACTERISTIC
/begin CHARACTERISTIC K_SCHALTER_KUPP_DIAG_RF "relative Fuellung, um Diagnosetimer zu starten | EN: Relative charge to start diagnosis timer" VALUE 0x7672E TKW_VV_VV_SW 100.0 FORMULA_0007 0.0 2.0000 FORMAT "%6.3" /end CHARACTERISTIC
/begin CHARACTERISTIC K_SCHALTER_KUPP_DIAG_N "Motordrehzahl, um Diagnosetimer zu starten | EN: Engine speed to start diagnosis timer [Upm]" VALUE 0x76730 TKW_VV_VV_SW 100.0 FORMULA_0006 0.0 10000.0000 /end CHARACTERISTIC
/begin CHARACTERISTIC K_SCHALTER_KUPP_DIAG_T "Timergrenze, um Diagnose zu beenden | EN: Timer limit to end diagnosis [s]" VALUE 0x76732 TKW_VV_VV_UW 100.0 FORMULA_0073 0.0 6553.5000 FORMAT "%4.1" /end CHARACTERISTIC
/begin CHARACTERISTIC K_SCHALTER_KS_N_DIFF_REF "Schaltschwelle Abstand zur Referenzdrehzahl | EN: Switching threshold, distance to reference speed [Upm]" VALUE 0x76734 TKW_VV_VV_SW 100.0 FORMULA_0006 0.0 10000.0000 /end CHARACTERISTIC
/begin CHARACTERISTIC K_SCHALTER_KS_N_DIFF "Drehzahldifferenz Motor - Getriebeeingang | EN: Speed difference engine - gearbox input [Upm]" VALUE 0x76736 TKW_VV_VV_SW 100.0 FORMULA_0006 0.0 10000.0000 /end CHARACTERISTIC
/begin CHARACTERISTIC K_SCHALTER_KS_N_T "Timer Drehzahldifferenz Motor - Getriebeeingang | EN: Timer, speed difference engine - gearbox input [s]" VALUE 0x76738 TKW_VV_VV_UW 100.0 FORMULA_0021 0.0 655.0000 FORMAT "%5.2" /end CHARACTERISTIC
/begin CHARACTERISTIC K_SCHALTER_KS_N_T_AUF "Timer Drehzahldifferenz Motor - Getr Kupplung auf" VALUE 0x7673A TKW_VV_VV_UW 100.0 FORMULA_0021 0.0 655.0000 FORMAT "%5.2" /end CHARACTERISTIC
/begin CHARACTERISTIC K_SCHALTER_KS_SCHALT_T "Timer Schaltung | EN: Timer, gearshift [s]" VALUE 0x7673C TKW_VV_VV_UW 100.0 FORMULA_0021 0.0 655.0000 FORMAT "%5.2" /end CHARACTERISTIC
/begin CHARACTERISTIC KL_SCHALTER_KS_REG "Kennlinie P-Anteil Regler Kraftschluss | EN: Curve: P share of drivetrain-engagement controller" CURVE 0x7673E TKL_SB_VV_UW 100.0 FORMULA_1088 0.0 8.0000 /begin AXIS_DESCR STD_AXIS Gang_KS FORMULA_0318 8 -1.0000 10.0000 /end AXIS_DESCR FORMAT "%5.2" /end CHARACTERISTIC
/begin CHARACTERISTIC KF_SCHALTER_KS_N_DIFF_AUF "Drehzahldifferenz Kupplung auf | EN: Speed difference, clutch open" MAP 0x76758 TKF_SW_SW_SW 100.0 FORMULA_0006 0.0 10000.0000 /begin AXIS_DESCR STD_AXIS n FORMULA_0006 3 0.0 10000.0000 /end AXIS_DESCR
 /begin AXIS_DESCR STD_AXIS md_kupp_wunsch_tz FORMULA_0009 3 -100.0000 1000.0000 FORMAT "%4.1" /end AXIS_DESCR
/end CHARACTERISTIC
/begin MEASUREMENT schalter_st_inj_old_1of2_ "schalter_st_inj_old" UWORD FORMULA_0083 0 0 0.0 65535.0000 ECU_ADDRESS 0x3FCFB4 /end MEASUREMENT
/begin MEASUREMENT schalter_st_inj_old_2of2_ "schalter_st_inj_old" UWORD FORMULA_0083 0 0 0.0 65535.0000 ECU_ADDRESS 0x3FCFB6 /end MEASUREMENT
/begin MEASUREMENT schalter_wakeup_ad_inj "Eingelesener Spannungswert Wakeup" SWORD FORMULA_0123 0 0 0.0 1023.0000 ECU_ADDRESS 0x3FCFB8 /end MEASUREMENT
/begin MEASUREMENT schalter_bls_ad_inj "Eingelesener Spannungswert Bremslichtschalter" SWORD FORMULA_0123 0 0 0.0 1023.0000 ECU_ADDRESS 0x3FCFBA /end MEASUREMENT
/begin MEASUREMENT schalter_sport_ad "Eingelesener Spannungswert vom Sporttaster" SWORD FORMULA_0123 0 0 0.0 1023.0000 ECU_ADDRESS 0x3FCFBC /end MEASUREMENT
/begin MEASUREMENT schalter_poel_ad "Eingelesener Spannungswert vom Oeldruckschalter" SWORD FORMULA_0123 0 0 0.0 1023.0000 ECU_ADDRESS 0x3FCFBE /end MEASUREMENT
/begin MEASUREMENT schalter_poel_time "Diagnosezeit" UWORD FORMULA_0021 0 0 0.0 655.0000 ECU_ADDRESS 0x3FCFC0 /end MEASUREMENT
/begin MEASUREMENT schalter_diag_poel_n_delay "Delay fuer n == 0 bei S_POEL-Diagnose" UWORD FORMULA_0539 0 0 0.0 6553500.0000 ECU_ADDRESS 0x3FCFC2 /end MEASUREMENT
/begin MEASUREMENT schalter_getr_ad "Eingelesener Spannungswert vom Getriebeschalter" SWORD FORMULA_0123 0 0 0.0 1023.0000 ECU_ADDRESS 0x3FCFC4 /end MEASUREMENT
/begin MEASUREMENT schalter_getr_fil "gefilterter Spannungswert vom Getriebeschalter" SWORD FORMULA_0123 0 0 0.0 1023.0000 ECU_ADDRESS 0x3FCFC6 /end MEASUREMENT
/begin MEASUREMENT schalter_getr_a0 "Nullpunktadaptionswert vom Getriebeschalter" SWORD FORMULA_0123 0 0 0.0 1023.0000 ECU_ADDRESS 0x3FCFC8 /end MEASUREMENT
/begin MEASUREMENT schalter_getr "nullpunktadaptierter Spannungswert vom Getriebeschalter" SWORD FORMULA_0123 0 0 0.0 1023.0000 ECU_ADDRESS 0x3FCFCA /end MEASUREMENT
/begin MEASUREMENT schalter_getr_n_verh_fil "Getriebe Eingangsdrehzahl / Abtriebsdrehzahl gefiltert" SWORD FORMULA_0075 0 0 -32.0000 31.9990 ECU_ADDRESS 0x3FCFCC /end MEASUREMENT
/begin MEASUREMENT schalter_getr_diag_timer "Diagnosetimer Getriebeleergassenschalter" UWORD FORMULA_0073 0 0 0.0 6553.5000 ECU_ADDRESS 0x3FCFCE /end MEASUREMENT
/begin MEASUREMENT schalter_getr_diag_st_inj_verz "Schalterstatus, verzoegert" UWORD FORMULA_0083 0 0 0.0 65535.0000 ECU_ADDRESS 0x3FCFD0 /end MEASUREMENT
/begin MEASUREMENT schalter_kupp_ad "Eingelesener Spannungswert vom Kupplungsschalter" SWORD FORMULA_0123 0 0 0.0 1023.0000 ECU_ADDRESS 0x3FCFD2 /end MEASUREMENT
/begin MEASUREMENT schalter_kupp_diag "Status Kupplungsschalter" UWORD FORMULA_1084 0 0 0.0 65535.0 ECU_ADDRESS 0x3FCFD4 BIT_MASK 0x2 /end MEASUREMENT
/begin MEASUREMENT schalter_kupp_diag_verz "Status Kupplungsschalter verzoegert" UWORD FORMULA_1084 0 0 0.0 65535.0 ECU_ADDRESS 0x3FCFD6 BIT_MASK 0x2 /end MEASUREMENT
/begin MEASUREMENT schalter_kupp_diag_scharf "Diagnose Kupplungsschalter scharf" UBYTE FORMULA_1085 0 0 0.0 255.0 ECU_ADDRESS 0x3FCFD8 /end MEASUREMENT
/begin MEASUREMENT schalter_kupp_diag_timer "Diagnosetimer Kupplungsschalter" UWORD FORMULA_0073 0 0 0.0 6553.5000 ECU_ADDRESS 0x3FCFDA /end MEASUREMENT
/begin MEASUREMENT schalter_ks_alt "alter Schalterzustand Kraftschluss" UWORD FORMULA_1086 0 0 0.0 65535.0 ECU_ADDRESS 0x3FCFDC BIT_MASK 0x200 /end MEASUREMENT
/begin MEASUREMENT schalter_ks_md_eff "effektives Wunschmoment fuer Kraftschluss" SWORD FORMULA_0009 0 0 -100.0000 1000.0000 ECU_ADDRESS 0x3FCFDE /end MEASUREMENT
/begin MEASUREMENT schalter_ks_dn "Delta Motordrehzahl" SWORD FORMULA_0006 0 0 -10000.0000 10000.0000 ECU_ADDRESS 0x3FCFE0 /end MEASUREMENT
/begin MEASUREMENT schalter_ks_n_ref "Referenzdrehzahl" SWORD FORMULA_0006 0 0 0.0 10000.0000 ECU_ADDRESS 0x3FCFE2 /end MEASUREMENT
/begin MEASUREMENT schalter_ks_n_diff_ref "Abstand zur Referenzdrehzahl" SWORD FORMULA_0006 0 0 -10000.0000 10000.0000 ECU_ADDRESS 0x3FCFE4 /end MEASUREMENT
/begin MEASUREMENT schalter_ks_n_diff "Drehzahldifferenz Motor - Getriebeeingang" SWORD FORMULA_0006 0 0 0.0 10000.0000 ECU_ADDRESS 0x3FCFE6 /end MEASUREMENT
/begin MEASUREMENT schalter_ks_n_diff_timer "Timer Drehzahldifferenz Kraftschluss" UWORD FORMULA_0021 0 0 0.0 655.0000 ECU_ADDRESS 0x3FCFE8 /end MEASUREMENT
/begin MEASUREMENT schalter_ks_n_diff_auf_timer "Timer Drehzahldifferenz Motor - Getr Kupplung auf" UWORD FORMULA_0021 0 0 0.0 655.0000 ECU_ADDRESS 0x3FCFEA /end MEASUREMENT
/begin MEASUREMENT schalter_ks_schalt_timer "Timer Schaltung" UWORD FORMULA_0021 0 0 0.0 655.0000 ECU_ADDRESS 0x3FCFEC /end MEASUREMENT
/* ------------------ Abschnitt erzeugt aus sk_inj.dat ------------------ */
/begin CHARACTERISTIC K_SK_HW_AD_DELTA_MAX "Maximal zulaessige Differenz Master-Slave | EN: Maximum permitted master-slave difference [digit]" VALUE 0x7692A TKW_VV_VV_UB 100.0 FORMULA_1091 0.0 255.0000 /end CHARACTERISTIC
/begin CHARACTERISTIC K_SK_HW_AD_STAT "Maximaler Spannungshub fuer Stationaerbetrieb PWG1 | EN: Maximum voltage swing for steady state, pedal sensor 1 [digit]" VALUE 0x7692B TKW_VV_VV_UB 100.0 FORMULA_1091 0.0 255.0000 /end CHARACTERISTIC
/begin CHARACTERISTIC K_SK_HW_AD_STAT_ZAEHLER "Zaehler fuer Stationaerbetrieb PWG1 | EN: Counter for steady state, pedal sensor 1 [s]" VALUE 0x7692C TKW_VV_VV_UB 100.0 FORMULA_0352 0.0 1.2750 /end CHARACTERISTIC
/begin CHARACTERISTIC K_SK_HW_AD_ED_ZAEHLER "Filterzaehler bei fehlerhaftem AD-Wert | EN: Filter counter for faulty A/D value [s]" VALUE 0x7692D TKW_VV_VV_UB 100.0 FORMULA_0352 0.0 1.2750 /end CHARACTERISTIC
/begin MEASUREMENT sk_hw_pwg1m_ad_alt "AD-Wandlerwert PWG1 des Masterprozessors vor 10ms" SWORD FORMULA_0123 0 0 0.0 1023.0000 ECU_ADDRESS 0x3FD006 /end MEASUREMENT
/begin MEASUREMENT sk_hw_pwg1s_ad_alt "AD-Wandlerwert PWG1 des Slaveprozessors vor 10ms" SWORD FORMULA_0123 0 0 0.0 1023.0000 ECU_ADDRESS 0x3FD008 /end MEASUREMENT
/begin MEASUREMENT sk_hw_pwg1m_ad_zaehler "Zaehlervariable fuer Stationaerbetrieb PWG1-Master" UBYTE FORMULA_0352 0 0 0.0 1.2750 ECU_ADDRESS 0x3FD00A /end MEASUREMENT
/begin MEASUREMENT sk_hw_pwg1s_ad_zaehler "Zaehlervariable fuer Stationaerbetrieb PWG1-Slave" UBYTE FORMULA_0352 0 0 0.0 1.2750 ECU_ADDRESS 0x3FD00B /end MEASUREMENT
/begin MEASUREMENT sk_hw_pwg1_ad_ed_zaehler "Zaehlervariable bei fehlerhaftem AD-Wert" UBYTE FORMULA_0352 0 0 0.0 1.2750 ECU_ADDRESS 0x3FD00C /end MEASUREMENT
/begin MEASUREMENT sk_hw_pwg1_ad_mode "Zustand der AD-Wandler PWG1-Erfassung" UBYTE FORMULA_1089 0 0 0.0 255.0 ECU_ADDRESS 0x3FD00D /end MEASUREMENT
/begin MEASUREMENT sk_tr_wait "Wartezeit Testrechnung" UBYTE FORMULA_0458 0 0 0.0 25.5000 ECU_ADDRESS 0x3FD00E /end MEASUREMENT
/begin MEASUREMENT sk_tr_state "Zustand Testrechnung" UBYTE FORMULA_1090 0 0 0.0 255.0 ECU_ADDRESS 0x3FD00F /end MEASUREMENT
/begin MEASUREMENT sk_tr_error_nr "Fehler Testrechnung" UBYTE FORMULA_0003 0 0 0.0 255.0000 ECU_ADDRESS 0x3FD010 /end MEASUREMENT
/begin MEASUREMENT sk_tr_timeout "Timeout - keine Antwort auf TR" UBYTE FORMULA_0458 0 0 0.0 25.5000 ECU_ADDRESS 0x3FD011 /end MEASUREMENT
/* ------------------ Abschnitt erzeugt aus sl.dat ------------------ */
/begin CHARACTERISTIC K_SL_HFM_TAU "Filterkonstante Rohwert | EN: Filterkonstante Rohwert" VALUE 0x7692E TKW_VV_VV_UB 100.0 FORMULA_0651 0.0051 1.2800 /end CHARACTERISTIC
/begin CHARACTERISTIC K_SL_LAM_ABG_TAU "Filterkonstante Rohwert Abgaslambda B1" VALUE 0x7692F TKW_VV_VV_UB 100.0 FORMULA_0651 0.0051 1.2800 /end CHARACTERISTIC
/begin CHARACTERISTIC K_SL_HFM_CFG "Umschaltung Istwert SL-Reg." VALUE 0x76930 TKW_VV_VV_UB 100.0 FORMULA_1092 0.0 255.0 /end CHARACTERISTIC
/begin CHARACTERISTIC K_SL_TKAT_ANSPR "Anspringtemp. Kat fuer NOx-Konv." VALUE 0x76932 TKW_VV_VV_SW 100.0 FORMULA_0023 -1000.0000 1000.0000 FORMAT "%4.1" /end CHARACTERISTIC
/begin CHARACTERISTIC K_SL_I_MAX "I-Anteil Max SL Mengenregelung | EN: I-Anteil Max SL Mengenregelung" VALUE 0x76934 TKW_VV_VV_SW 100.0 FORMULA_0295 -2.0000 1.9999 FORMAT "%7.4" /end CHARACTERISTIC
/begin CHARACTERISTIC K_SL_I_MIN "I-Anteil Min SL Mengenregelung | EN: I-Anteil Min SL Mengenregelung" VALUE 0x76936 TKW_VV_VV_SW 100.0 FORMULA_0295 -2.0000 1.9999 FORMAT "%7.4" /end CHARACTERISTIC
/begin CHARACTERISTIC K_SL_ML_HFM_DIAG_MAX "Diagnoseschelle Max | EN: Diagnoseschelle Max" VALUE 0x76938 TKW_VV_VV_SW 100.0 FORMULA_0112 -100.0000 1400.0000 FORMAT "%4.1" /end CHARACTERISTIC
/begin CHARACTERISTIC K_SL_ML_HFM_DIAG_MIN "Diagnoseschelle Min | EN: Diagnoseschelle Min" VALUE 0x7693A TKW_VV_VV_SW 100.0 FORMULA_0112 -100.0000 1400.0000 FORMAT "%4.1" /end CHARACTERISTIC
/begin CHARACTERISTIC K_SL_ML_HFM_ERSATZ "Ersatzwert im Fehlerfall" VALUE 0x7693C TKW_VV_VV_SW 100.0 FORMULA_0112 -100.0000 1400.0000 FORMAT "%4.1" /end CHARACTERISTIC
/begin CHARACTERISTIC K_SL_LAM_MIN_FAK "Motorlambda B2 Korr-Fak. MIN-Wert" VALUE 0x7693E TKW_VV_VV_SW 100.0 FORMULA_0075 0.5000 1.0000 FORMAT "%6.3" /end CHARACTERISTIC
/begin CHARACTERISTIC K_SL_LAM_MAX_FAK "Motorlambda B2 Korr-Fak. MAX-Wert | EN: Motorlambda B2 Korr-Fak. MAX-Wert" VALUE 0x76940 TKW_VV_VV_SW 100.0 FORMULA_0075 0.0 1.5000 FORMAT "%6.3" /end CHARACTERISTIC
/begin CHARACTERISTIC K_SL_LLS_CFG "Konfig fuer LLS(ZWD)" VALUE 0x76942 TKW_VV_VV_UB 100.0 FORMULA_1093 0.0 255.0 /end CHARACTERISTIC
/begin CHARACTERISTIC KL_SL_P_ANTEIL "P-Anteil SL-Mengenregelung" CURVE 0x76944 TKL_SW_VV_SW 100.0 FORMULA_0295 -2.0000 1.9999
 /begin AXIS_DESCR STD_AXIS ml FORMULA_0112 7 -100.0000 1400.0000 FORMAT "%4.1" /end AXIS_DESCR
 FORMAT "%7.4" /end CHARACTERISTIC
/begin CHARACTERISTIC KL_SL_I_ANTEIL "I-Anteil SL-Mengenregelung" CURVE 0x76962 TKL_SW_VV_SW 100.0 FORMULA_0295 -2.0000 1.9999
 /begin AXIS_DESCR STD_AXIS ml FORMULA_0112 7 -100.0000 1400.0000 FORMAT "%4.1" /end AXIS_DESCR
 FORMAT "%7.4" /end CHARACTERISTIC
/begin CHARACTERISTIC KL_SL_LAM_MOT_DELAY "Zeitverzoegerung fuer Motorlambda, offset | EN: Time delay for engine lambda offset" CURVE 0x76980 TKL_SW_VV_UW 100.0 FORMULA_0021 0.0 655.0000
 /begin AXIS_DESCR STD_AXIS zust_tmot_start FORMULA_0023 6 -50.0000 200.0000 FORMAT "%4.1" /end AXIS_DESCR
 FORMAT "%5.2" /end CHARACTERISTIC
/begin CHARACTERISTIC KL_SL_LAM_I_ANTEIL "I-Anteil Bankabgleich" CURVE 0x7699A TKL_SW_VV_SW 100.0 FORMULA_1094 -0.5000 0.5000
 /begin AXIS_DESCR STD_AXIS Regelabweichung FORMULA_1095 5 -0.5000 0.5000 FORMAT "%6.3" /end AXIS_DESCR
 FORMAT "%6.3" /end CHARACTERISTIC
/begin CHARACTERISTIC KL_SL_LAMSOL_KALT "Soll Abgaslambda fuer kalten Kat" CURVE 0x769B0 TKL_UW_VV_UW 100.0 FORMULA_0025 0.0 3.9990 /begin AXIS_DESCR STD_AXIS t FORMULA_0021 6 0.0 655.0000 FORMAT "%5.2" /end AXIS_DESCR FORMAT "%6.3" /end CHARACTERISTIC
/begin CHARACTERISTIC KL_SL_LAMSOL_WARM "Soll Abgaslambda fuer warmen Kat" CURVE 0x769CA TKL_UW_VV_UW 100.0 FORMULA_0025 0.0 3.9990 /begin AXIS_DESCR STD_AXIS t FORMULA_0021 6 0.0 655.0000 FORMAT "%5.2" /end AXIS_DESCR FORMAT "%6.3" /end CHARACTERISTIC
/begin CHARACTERISTIC KL_SL_HFM_AD "Kennlinie Mini HFM | EN: Curve: mini air-mass meter (secondary air)" CURVE 0x769E4 TKL_SW_VV_SW 100.0 FORMULA_0112 -100.0000 1400.0000 /begin AXIS_DESCR STD_AXIS sl_ml_hfm_ad FORMULA_0123 10 0.0 1023.0000 /end AXIS_DESCR FORMAT "%4.1" /end CHARACTERISTIC
/begin CHARACTERISTIC KL_SL_ML_MAX_UB_FAKT "UB Korrektur | EN: Battery-voltage correction" CURVE 0x76A0E TKL_SW_VV_UW 100.0 FORMULA_0075 0.0 4.0000 /begin AXIS_DESCR STD_AXIS ub FORMULA_0008 4 0.0 28.0000 FORMAT "%4.1" /end AXIS_DESCR FORMAT "%6.3" /end CHARACTERISTIC
/begin CHARACTERISTIC KL_SL_ML_MAX_PABG "SL Max Durchfluss abh. von pabg | EN: Secondary air maximum flow vs exhaust back-pressure" CURVE 0x76A20 TKL_SW_VV_SW 100.0 FORMULA_0112 -100.0000 1400.0000
 /begin AXIS_DESCR STD_AXIS pabg_diff FORMULA_0077 6 0.0 1000.0000 FORMAT "%4.1" /end AXIS_DESCR
 FORMAT "%4.1" /end CHARACTERISTIC
/begin CHARACTERISTIC KL_SL_LAM_MOT_OFFS_TIME_F "Spreitzung time_ml abh. von Katalterung | EN: Spread of time_ml vs cat aging" CURVE 0x76A3A TKL_UW_VV_UW 100.0 FORMULA_0075 0.0 4.0000
 /begin AXIS_DESCR STD_AXIS kat_obd_wert_gesamt_nv FORMULA_0025 4 0.0 3.9990 FORMAT "%6.3" /end AXIS_DESCR
 FORMAT "%6.3" /end CHARACTERISTIC
/begin CHARACTERISTIC KL_SL_LAM_MOT_OFFS_KAT_F "Katalterungsfaktor fuer KF_SL_LAM_MOT_OFFS" CURVE 0x76A4C TKL_UW_VV_SW 100.0 FORMULA_0075 -4.0000 4.0000
 /begin AXIS_DESCR STD_AXIS kat_obd_wert_gesamt_nv FORMULA_0025 4 0.0 3.9990 FORMAT "%6.3" /end AXIS_DESCR
 FORMAT "%6.3" /end CHARACTERISTIC
/begin CHARACTERISTIC KF_SL_VORST_TV "Vorsteuerung SL Tastverhaeltnis" MAP 0x76A5E TKF_SW_SW_SW 100.0 FORMULA_0146 0.0 100.0000
 /begin AXIS_DESCR STD_AXIS pabg_diff FORMULA_0077 6 0.0 500.0000 FORMAT "%4.1" /end AXIS_DESCR
 /begin AXIS_DESCR STD_AXIS sl_ml_rel FORMULA_0001 6 0.0 100.0000 FORMAT "%4.1" /end AXIS_DESCR
 FORMAT "%4.1" /end CHARACTERISTIC
/begin CHARACTERISTIC KF_SL_LAM_MOT_OFFS "Motorlambdaoffset bei SL" MAP 0x76AC0 TKF_SW_SW_SW 100.0 FORMULA_0295 -0.6000 0.6000 /begin AXIS_DESCR STD_AXIS time_ml FORMULA_0021 6 0.0 327.0000 FORMAT "%5.2" /end AXIS_DESCR
 /begin AXIS_DESCR STD_AXIS zust_tmot_start FORMULA_0023 6 -50.0000 170.0000 FORMAT "%4.1" /end AXIS_DESCR
 FORMAT "%7.4" /end CHARACTERISTIC
/begin MEASUREMENT sl_lam_abg_soll "Soll Abgaslambda" UWORD FORMULA_0025 0 0 0.0 3.9990 ECU_ADDRESS 0x3FD012 /end MEASUREMENT
/begin MEASUREMENT sl_lam_abg_ist_roh "Mittelwert Abgaslambda Bank1" UWORD FORMULA_0025 0 0 0.0 3.9990 ECU_ADDRESS 0x3FD014 /end MEASUREMENT
/begin MEASUREMENT sl_lam_abg_ist "gefilterter Mittelwert Abgaslambda Bank1" UWORD FORMULA_0025 0 0 0.0 3.9990 ECU_ADDRESS 0x3FD016 /end MEASUREMENT
/begin MEASUREMENT sl_ml_hfm_ad "AD-Wert Mini HFM" SWORD FORMULA_0123 0 0 0.0 1023.0000 ECU_ADDRESS 0x3FD018 /end MEASUREMENT
/begin MEASUREMENT sl_reg_p "Faktor P-Anteil SL-Mengenregler" SWORD FORMULA_0295 0 0 -2.0000 1.9999 ECU_ADDRESS 0x3FD01C /end MEASUREMENT
/begin MEASUREMENT sl_reg_i "Faktor I-Anteil SL-Mengenregler" SWORD FORMULA_0295 0 0 -2.0000 1.9999 ECU_ADDRESS 0x3FD01E /end MEASUREMENT
/begin MEASUREMENT sl_ml_ist_lam "SLP-Luftmassenstrom gerechnet aus Abgaslambda" SWORD FORMULA_0112 0 0 -100.0000 1400.0000 ECU_ADDRESS 0x3FD020 /end MEASUREMENT
/begin MEASUREMENT sl_ml_soll "Soll-SLP-Luftmassenstrom gerechnet aus Abgaslambda" SWORD FORMULA_0112 0 0 -100.0000 1400.0000 ECU_ADDRESS 0x3FD022 /end MEASUREMENT
/begin MEASUREMENT sl_ml_hfm_roh "Rohwert SLP-Luftmassenstrom" SWORD FORMULA_0112 0 0 -100.0000 1400.0000 ECU_ADDRESS 0x3FD024 /end MEASUREMENT
/begin MEASUREMENT sl_ml_ist "SLP-Luftmasseniststrom Bank1 und 2" SWORD FORMULA_0112 0 0 -100.0000 1400.0000 ECU_ADDRESS 0x3FD026 /end MEASUREMENT
/begin MEASUREMENT sl_regler_f "Regelfaktor fuer Vorsteuerung" UWORD FORMULA_0295 0 0 0.0 2.0000 ECU_ADDRESS 0x3FD028 /end MEASUREMENT
/begin MEASUREMENT sl_zwd_vorst_tv "Vorsteuerungstastverh. LLS fuer SL" SWORD FORMULA_0146 0 0 0.0 100.0000 ECU_ADDRESS 0x3FD02A /end MEASUREMENT
/begin MEASUREMENT sl_lam_mot_soll_roh_1of2_ "Lambda Sollwert roh" UWORD FORMULA_0025 0 0 0.0 3.9990 ECU_ADDRESS 0x3FD02C /end MEASUREMENT
/begin MEASUREMENT sl_lam_mot_soll_roh_2of2_ "Lambda Sollwert roh" UWORD FORMULA_0025 0 0 0.0 3.9990 ECU_ADDRESS 0x3FD02E /end MEASUREMENT
/begin MEASUREMENT sl_lam_mot_soll_1of2_ "Lambda Sollwert" UWORD FORMULA_0025 0 0 0.0 3.9990 ECU_ADDRESS 0x3FD030 /end MEASUREMENT
/begin MEASUREMENT sl_lam_mot_soll_2of2_ "Lambda Sollwert" UWORD FORMULA_0025 0 0 0.0 3.9990 ECU_ADDRESS 0x3FD032 /end MEASUREMENT
/begin MEASUREMENT sl_lam_b2_korr "Korrekturwert Bank2 Lambda" SWORD FORMULA_0075 0 0 -4.0000 4.0000 ECU_ADDRESS 0x3FD034 /end MEASUREMENT
/begin MEASUREMENT sl_ml_max "Max. sekundaerer Lufmassenstrom nach rf_pt_korr" SWORD FORMULA_0112 0 0 -100.0000 1400.0000 ECU_ADDRESS 0x3FD036 /end MEASUREMENT
/begin MEASUREMENT sl_ml_max_roh "Max. sekundaerer Lufmassenstrom" SWORD FORMULA_0112 0 0 -100.0000 1400.0000 ECU_ADDRESS 0x3FD038 /end MEASUREMENT
/begin MEASUREMENT sl_ml_rel "relativer Sekundaerluftmassenstrom" SWORD FORMULA_0001 0 0 0.0 100.0000 ECU_ADDRESS 0x3FD03A /end MEASUREMENT
/begin MEASUREMENT ml_slp_b1 "Sekund. Pumpe" SWORD FORMULA_0112 0 0 -100.0000 1400.0000 ECU_ADDRESS 0x3FD03C /end MEASUREMENT
/begin MEASUREMENT ml_slp_b2 "Sekund. Pumpe" SWORD FORMULA_0112 0 0 -100.0000 1400.0000 ECU_ADDRESS 0x3FD03E /end MEASUREMENT
/* ------------------ Abschnitt erzeugt aus slp.dat ------------------ */
/begin CHARACTERISTIC K_SLP_TIME_AUS "Auszeit SLP nach Abschalten | EN: Auszeit SLP nach Abschalten" VALUE 0x76B22 TKW_VV_VV_UW 100.0 FORMULA_0062 0.0 65535.0000 /end CHARACTERISTIC
/begin CHARACTERISTIC K_SLP_PABG_SCHWELLE "Abbruchschwelle durch Abgasgegendruck | EN: Abbruchschwelle durch Abgasgege n-druck" VALUE 0x76B24 TKW_VV_VV_SW 100.0 FORMULA_0077 0.0 1000.0000 FORMAT "%4.1" /end CHARACTERISTIC
/begin CHARACTERISTIC K_SLP_PABG_TAU "Filterkonstante fuer den Abgasdruck | EN: Filterkonstante fuer den Abgasdruck" VALUE 0x76B26 TKW_VV_VV_UB 100.0 FORMULA_0683 0.1004 25.6000 /end CHARACTERISTIC
/begin CHARACTERISTIC K_SLP_TIME_MAX "Maxlaufzeit der SLP | EN: Maxlaufzeit der SLP" VALUE 0x76B28 TKW_VV_VV_UW 100.0 FORMULA_0073 0.0 6553.5000 FORMAT "%4.1" /end CHARACTERISTIC
/begin CHARACTERISTIC KL_SLP_DELAY_TMOT_START "SLP-Delay abhaengig von tmot_start" CURVE 0x76B2A TKL_SW_VV_UW 100.0 FORMULA_0021 0.0 655.0000
 /begin AXIS_DESCR STD_AXIS zust_tmot_start FORMULA_0023 6 -50.0000 170.0000 FORMAT "%4.1" /end AXIS_DESCR
 FORMAT "%5.2" /end CHARACTERISTIC
/begin CHARACTERISTIC KF_SLP_DAUER_TMOT_START "SLP Laufzeit" MAP 0x76B44 TKF_SW_SW_SW 100.0 FORMULA_0073 0.0 3276.7000
 /begin AXIS_DESCR STD_AXIS zust_tmot_start FORMULA_0023 8 -50.0000 170.0000 FORMAT "%4.1" /end AXIS_DESCR
 /begin AXIS_DESCR STD_AXIS kat_obd_wert_nv_b1 FORMULA_0025 4 0.0 1.9990 FORMAT "%6.3" /end AXIS_DESCR
 FORMAT "%4.1" /end CHARACTERISTIC
/begin MEASUREMENT slp_pabg_dif_max "Abgasgegendruck gefiltert" SWORD FORMULA_0077 0 0 0.0 1000.0000 ECU_ADDRESS 0x3FD040 /end MEASUREMENT
/begin MEASUREMENT slp_dauer "Laufzeit der SLP, abh. von tmot_start und kat_obd_wert_nv" UWORD FORMULA_0073 0 0 0.0 6553.5000 ECU_ADDRESS 0x3FD042 /end MEASUREMENT
/* ------------------ Abschnitt erzeugt aus sls_obd.dat ------------------ */
/begin CHARACTERISTIC K_SLS_OBDH_T_AUFHEIZ "Aufheizverzoegerung fuer Mini-HFM | EN: Aufheizverzoegerung fuer Mini-HFM" VALUE 0x76B9E TKW_VV_VV_UB 100.0 FORMULA_0317 0.0 2.5000 /end CHARACTERISTIC
/begin CHARACTERISTIC K_SLS_OBDH_T_HFM_DIA "Diagnosezeit fuer Mini-HFM | EN: Diagnosezeit fuer Mini-HFM" VALUE 0x76BA0 TKW_VV_VV_UW 100.0 FORMULA_0021 0.0 100.0000 FORMAT "%5.2" /end CHARACTERISTIC
/begin CHARACTERISTIC K_SLS_OBDH_T_ML_PLAUSI "Max. Diagnosezeit fuer Luftmassenplausi | EN: Max. Diagnosezeit fuer Luftmassenplausi" VALUE 0x76BA2 TKW_VV_VV_UW 100.0 FORMULA_0021 0.0 100.0000 FORMAT "%5.2" /end CHARACTERISTIC
/begin CHARACTERISTIC K_SLS_OBDH_START_MIN "Mindestluftmassenintegral fuer plausibles SLS" VALUE 0x76BA4 TKW_VV_VV_SW 100.0 FORMULA_0561 -32.7670 32.7670 FORMAT "%6.3" /end CHARACTERISTIC
/begin CHARACTERISTIC K_SLS_OBDH_SLP_DEF "Luftmassenintegralgrenze fuer Erkennung SLP defekt" VALUE 0x76BA6 TKW_VV_VV_SW 100.0 FORMULA_1120 -32.7670 32.7670 FORMAT "%6.3" /end CHARACTERISTIC
/begin CHARACTERISTIC K_SLS_OBDH_EUV_MIN_DEF "Ml-Integralgrenze fuer Erkennung SLV klemmt geschl. Leitung undicht" VALUE 0x76BA8 TKW_VV_VV_SW 100.0 FORMULA_1120 -32.7670 32.7670 FORMAT "%6.3" /end CHARACTERISTIC
/begin CHARACTERISTIC K_SLS_OBDH_MDF_MAX_DEF "Max. Abw.Integralgrenze LTG-undicht" VALUE 0x76BAA TKW_VV_VV_SW 100.0 FORMULA_1120 -32.7670 32.7670 FORMAT "%6.3" /end CHARACTERISTIC
/begin CHARACTERISTIC K_SLS_OBDH_MDF_MIN_DEF "Max. Abw.Integralgrenze MDF zu gering" VALUE 0x76BAC TKW_VV_VV_SW 100.0 FORMULA_1120 -32.7670 32.7670 FORMAT "%6.3" /end CHARACTERISTIC
/begin CHARACTERISTIC K_SLS_OBDH_ZWD_100_MIN "Min. ML-Grenze fuer ZWD 100 Proz. offen" VALUE 0x76BAE TKW_VV_VV_SW 100.0 FORMULA_0112 0.0 40.0000 FORMAT "%4.1" /end CHARACTERISTIC
/begin CHARACTERISTIC K_SLS_OBDH_ZWD_0_MAX "Max. ML-Grenze fuer ZWD 0 Proz. offen" VALUE 0x76BB0 TKW_VV_VV_SW 100.0 FORMULA_0112 0.0 40.0000 FORMAT "%4.1" /end CHARACTERISTIC
/begin CHARACTERISTIC K_SLS_OBDH_ZWD_OFF_MAX "Max. ML-Grenze fuer ZWD stromlos" VALUE 0x76BB2 TKW_VV_VV_SW 100.0 FORMULA_0112 0.0 40.0000 FORMAT "%4.1" /end CHARACTERISTIC
/begin CHARACTERISTIC K_SLS_OBDH_ZWD_OFF_MIN "Min. ML-Grenze fuer ZWD stromlos" VALUE 0x76BB4 TKW_VV_VV_SW 100.0 FORMULA_0112 0.0 40.0000 FORMAT "%4.1" /end CHARACTERISTIC
/begin CHARACTERISTIC K_SLS_OBDH_SLV_MAX "Max. ML-Integralgrenze fuer SLV NIO" VALUE 0x76BB6 TKW_VV_VV_SW 100.0 FORMULA_1120 -32.7670 32.7670 FORMAT "%6.3" /end CHARACTERISTIC
/begin CHARACTERISTIC K_SLS_OBD_CFG "SLS-OBD Konfigbyte | EN: 0x0 AUS 0x2 AN-HFM 0x4 AN-LAM 0x8 Prueflauf 0xA AN -HFM- PL ELSE undef i- niert SLS-OBD Konfigbyte" VALUE 0x76BB8 TKW_VV_VV_UB 100.0 FORMULA_1121 0.0 255.0 /end CHARACTERISTIC
/begin CHARACTERISTIC K_SLS_OBDH_MDF_CFG "SLS-OBD MDF Konfigbyte" VALUE 0x76BB9 TKW_VV_VV_UB 100.0 FORMULA_1122 0.0 255.0 /end CHARACTERISTIC
/begin CHARACTERISTIC K_SLS_OBDH_MDF_1_MAG "Max. Abweichungsintg.-grenze MDF-Diag B1 magerer als B2" VALUE 0x76BBA TKW_VV_VV_SW 100.0 FORMULA_0573 -1.9000 1.9000 FORMAT "%5.2" /end CHARACTERISTIC
/begin CHARACTERISTIC K_SLS_OBDH_MDF_2_MAG "Max. Abweichungsintg.-grenze MDF-Diag B1 magerer als B2" VALUE 0x76BBC TKW_VV_VV_SW 100.0 FORMULA_0573 -1.9000 1.9000 FORMAT "%5.2" /end CHARACTERISTIC
/begin CHARACTERISTIC K_SLS_OBDH_MDL_K_EINBAUTEN "Max. Abweichungsintg.-grenze MDF-Diag B1 magerer als B2" VALUE 0x76BBE TKW_VV_VV_UW 100.0 FORMULA_1123 0.0 1.0000 FORMAT "%7.4" /end CHARACTERISTIC
/begin CHARACTERISTIC K_SLS_OBDH_DYN_DELTA_RF "Dynamikschwelle RF | EN: Dynamikschwelle RF" VALUE 0x76BC0 TKW_VV_VV_SW 100.0 FORMULA_0007 0.0 2.0000 FORMAT "%6.3" /end CHARACTERISTIC
/begin CHARACTERISTIC K_SLS_OBDH_DYN_RF_T "Zeit nach Dyn.abbr. durch rf, bevor die Diag weiterlaeuft | EN: Zeit nach Dyn.abbr. durch rf, bevor die Diag weiterlaeuft" VALUE 0x76BC2 TKW_VV_VV_UW 100.0 FORMULA_0021 0.0 655.0000 FORMAT "%5.2" /end CHARACTERISTIC
/begin CHARACTERISTIC K_SLS_OBD_DYN_TAU "Filterkonstante fuer sls_obd_ml_dyn" VALUE 0x76BC4 TKW_VV_VV_UB 100.0 FORMULA_0664 0.0101 2.5600 /end CHARACTERISTIC
/begin CHARACTERISTIC K_SLS_OBD_ML_MDL_DIFF_MAX "Saturation Gradient Luftmasse Motor | EN: Saturation Gradient Luftmasse Motor" VALUE 0x76BC6 TKW_VV_VV_SW 100.0 FORMULA_1118 -100.0000 100.0000 FORMAT "%4.1" /end CHARACTERISTIC
/begin CHARACTERISTIC K_SLS_OBD_ML_MDL_WICHT "Wichtungsfaktor fuer Dynamik | EN: Wichtungsfaktor fuer Dynamik" VALUE 0x76BC8 TKW_VV_VV_UW 100.0 FORMULA_0075 0.0 4.0000 FORMAT "%6.3" /end CHARACTERISTIC
/begin CHARACTERISTIC K_SLS_OBDH_ASV_RE_OPE "Max. Abweichungsintg.-grenze ASV-Diag rechts haengt offen | EN: Max. Abweichungsintg. -grenze ASV-Diag rechts haengt offen" VALUE 0x76BCA TKW_VV_VV_SW 100.0 FORMULA_0573 -1.9000 1.9000 FORMAT "%5.2" /end CHARACTERISTIC
/begin CHARACTERISTIC K_SLS_OBDH_ASV_PL_RE_OPE "Max. Abweichungsintg.-grenze ASV-Diag rechts haengt offen im PL | EN: Max. Abweichungsintg.-grenze ASV-Diag rechts haengt offen im PL" VALUE 0x76BCC TKW_VV_VV_SW 100.0 FORMULA_0573 -1.9000 1.9000 FORMAT "%5.2" /end CHARACTERISTIC
/begin CHARACTERISTIC K_SLS_OBDH_UB_MIN "UB min. Schwelle fuer die SLS-Diagnose | EN: UB min. Schwelle fuer di e SLS -Diagnose" VALUE 0x76BCE TKW_VV_VV_SW 100.0 FORMULA_0008 0.0 28.0000 FORMAT "%4.1" /end CHARACTERISTIC
/begin CHARACTERISTIC K_SLS_OBDH_ASV_LI_OPE "Max. Abweichungsintg.-grenze ASV-Diag links haengt offen | EN: Max. Abweichungsintg. -grenze ASV-Diag links haengt offen" VALUE 0x76BD0 TKW_VV_VV_SW 100.0 FORMULA_0573 -1.9000 1.9000 FORMAT "%5.2" /end CHARACTERISTIC
/begin CHARACTERISTIC K_SLS_OBDH_ASV_PL_LI_OPE "Max. Abweichungsintg.-grenze ASV-Diag links haengt offen im PL" VALUE 0x76BD2 TKW_VV_VV_SW 100.0 FORMULA_0573 -1.9000 1.9000 FORMAT "%5.2" /end CHARACTERISTIC
/begin CHARACTERISTIC K_SLS_OBDH_T_SLV_INT_START "Delay fuer start Diagnose SLV | EN: Delay fuer start Diagnose SLV" VALUE 0x76BD4 TKW_VV_VV_UW 100.0 FORMULA_0021 0.0 10.0000 FORMAT "%5.2" /end CHARACTERISTIC
/begin CHARACTERISTIC K_SLS_PL_T_MDF_STOP "MDF Diagnoseende fuer Prueflauf | EN: MDF Diagnoseende fuer Prueflauf" VALUE 0x76BD6 TKW_VV_VV_UW 100.0 FORMULA_0021 0.0 100.0000 FORMAT "%5.2" /end CHARACTERISTIC
/begin CHARACTERISTIC K_SLS_OBD_TMOT_MIN "Min. Temp. fuer die Diagnose | EN: Min. Temp. fuer die Diagnose" VALUE 0x76BD8 TKW_VV_VV_SW 100.0 FORMULA_0023 -50.0000 170.0000 FORMAT "%4.1" /end CHARACTERISTIC
/begin CHARACTERISTIC K_SLS_OBDH_N_MIN "Abbruchdrezahl n kleiner Schwelle | EN: Abbruchdrezahl n kleiner Schwelle" VALUE 0x76BDA TKW_VV_VV_SW 100.0 FORMULA_0006 0.0 10000.0000 /end CHARACTERISTIC
/begin CHARACTERISTIC K_SLS_OBDH_N_MAX "Abbruchdrezahl n groesser Schwelle | EN: Abbruchdrezahl n groesser Schwelle" VALUE 0x76BDC TKW_VV_VV_SW 100.0 FORMULA_0006 0.0 10000.0000 /end CHARACTERISTIC
/begin CHARACTERISTIC K_SLS_OBDH_RF_MIN "Abbruchlastschwelle bei rf unter Schelle | EN: Abbruchlastschwelle bei rf unter Schelle" VALUE 0x76BDE TKW_VV_VV_SW 100.0 FORMULA_0007 0.0 2.0000 FORMAT "%6.3" /end CHARACTERISTIC
/begin CHARACTERISTIC K_SLS_OBDH_RF_MAX "Abbruchlastschwelle bei rf ueber Schelle" VALUE 0x76BE0 TKW_VV_VV_SW 100.0 FORMULA_0007 0.0 2.0000 FORMAT "%6.3" /end CHARACTERISTIC
/begin CHARACTERISTIC K_SLS_OBDH_ML_MIN "Abbruchlastschwelle bei ml_ges unter Schelle | EN: Abbruchlastschwelle bei ml_ges unter Schelle" VALUE 0x76BE2 TKW_VV_VV_SW 100.0 FORMULA_0112 -100.0000 1400.0000 FORMAT "%4.1" /end CHARACTERISTIC
/begin CHARACTERISTIC K_SLS_OBDH_ML_MAX "Abbruchlastschwelle bei ml_ges ueber Schelle | EN: Abbruchlastschwelle bei ml_ges ueber Schelle" VALUE 0x76BE4 TKW_VV_VV_SW 100.0 FORMULA_0112 -100.0000 1400.0000 FORMAT "%4.1" /end CHARACTERISTIC
/begin CHARACTERISTIC K_SLS_OBDH_MLVERH_MIN "Abbruchlastschwelle bei ml_verh unter Schelle | EN: Abbruchlastschwelle bei ml_verh unter Schelle" VALUE 0x76BE6 TKW_VV_VV_UB 100.0 FORMULA_0032 0.0 200.0000 /end CHARACTERISTIC
/begin CHARACTERISTIC K_SLS_OBDH_PUMG_MIN "Abbruchlastschwelle bei ml_verh unter Schelle | EN: Abbruchlastschwelle bei ml_verh unter Schelle" VALUE 0x76BE8 TKW_VV_VV_SW 100.0 FORMULA_0077 400.0000 1200.0000 FORMAT "%4.1" /end CHARACTERISTIC
/begin CHARACTERISTIC K_SLS_OBDH_T_SA "Diagnoseabbruch nach time_sa | EN: Diagnoseabbruch nach time_sa" VALUE 0x76BEA TKW_VV_VV_UW 100.0 FORMULA_0021 0.0 655.0000 FORMAT "%5.2" /end CHARACTERISTIC
/begin CHARACTERISTIC K_SLS_OBDH_ASV_TAU "Filterkonstante fuer lam_ist und ml_ges der ASV Diag. | EN: Filterkonstante fuer lam_ist  und ml_ges der ASV Diag." VALUE 0x76BEC TKW_VV_VV_UB 100.0 FORMULA_0683 0.1004 25.6000 /end CHARACTERISTIC
/begin CHARACTERISTIC K_SLS_OBDH_ML_TAU "Filterkonstante fuer lam_ist und ml_ges der ML Diag." VALUE 0x76BED TKW_VV_VV_UB 100.0 FORMULA_0683 0.1004 25.6000 /end CHARACTERISTIC
/begin CHARACTERISTIC K_SLS_OBDH_HFM_TAU "Tau fuer sl_ml_hfm_fil" VALUE 0x76BEE TKW_VV_VV_UB 100.0 FORMULA_0664 0.0101 2.5600 /end CHARACTERISTIC
/begin CHARACTERISTIC K_SLS_OBDH_ML_TMOT "Schwelle ML-Plausi fuer ASV kleben zu | EN: Schwelle ML-Plausi fuer ASV kleben zu" VALUE 0x76BF0 TKW_VV_VV_SW 100.0 FORMULA_0023 -50.0000 170.0000 FORMAT "%4.1" /end CHARACTERISTIC
/begin CHARACTERISTIC K_SLS_OBDH_HYD_ABBRUCH_ML_MAX "ML-Schwelle fuer Feuchtigkeitserkennung Mini-HFM | EN: ML-Schwelle fuer Feuchtigkeitserkennung Mini-HFM" VALUE 0x76BF2 TKW_VV_VV_SW 100.0 FORMULA_1124 -260.0000 260.0000 FORMAT "%6.3" /end CHARACTERISTIC
/begin CHARACTERISTIC K_SLS_OBDH_HYD_ABBRUCH_AD_MAX "max-AD-Wert fuer Feuchtigkeitsabbruch | EN: max-AD-Wert fuer Feuchtigkeitsabbruch" VALUE 0x76BF4 TKW_VV_VV_SW 100.0 FORMULA_0123 0.0 1023.0000 /end CHARACTERISTIC
/begin CHARACTERISTIC K_SLS_OBDH_HFM_MAX "max. Luftmassenintegral fuer plausibles SLS | EN: max. Luftmassenintegral fuer plausibles SLS" VALUE 0x76BF6 TKW_VV_VV_SW 100.0 FORMULA_1097 -260.0000 260.0000 FORMAT "%4.1" /end CHARACTERISTIC
/begin CHARACTERISTIC KL_SLS_OBDH_ML_MDF_DIAG "Einschaltverzoegerung Mindestdurchflussdiagnose | EN: Switch-on delay of minimum-flow diagnosis" CURVE 0x76BF8 TKL_SW_VV_UW 100.0 FORMULA_0021 0.0 655.0000
 /begin AXIS_DESCR STD_AXIS tabg_vkat_1of2 FORMULA_0023 6 -50.0000 1000.0000 FORMAT "%4.1" /end AXIS_DESCR
 FORMAT "%5.2" /end CHARACTERISTIC
/begin CHARACTERISTIC KL_SLS_OBDH_ZWD_T_DIAG_OFF "Diag-Dauer ZWD stromlos" CURVE 0x76C12 TKL_SW_VV_UW 100.0 FORMULA_0021 0.0 655.0000
 /begin AXIS_DESCR STD_AXIS tabg_vkat_1of2 FORMULA_0023 6 -50.0000 170.0000 FORMAT "%4.1" /end AXIS_DESCR
 FORMAT "%5.2" /end CHARACTERISTIC
/begin CHARACTERISTIC KL_SLS_OBDH_ZWD_T_DIAG_0 "Diag-Dauer ZWD  ZWD 0 Proz geoffnet" CURVE 0x76C2C TKL_SW_VV_UW 100.0 FORMULA_0021 0.0 655.0000
 /begin AXIS_DESCR STD_AXIS tabg_vkat_1of2 FORMULA_0023 6 -50.0000 170.0000 FORMAT "%4.1" /end AXIS_DESCR
 FORMAT "%5.2" /end CHARACTERISTIC
/begin CHARACTERISTIC KL_SLS_OBDH_ZWD_T_DIAG_100 "Diag-Dauer ZWD 100 Proz geoffnet" CURVE 0x76C46 TKL_SW_VV_UW 100.0 FORMULA_0021 0.0 655.0000
 /begin AXIS_DESCR STD_AXIS tabg_vkat_1of2 FORMULA_0023 6 -50.0000 170.0000 FORMAT "%4.1" /end AXIS_DESCR
 FORMAT "%5.2" /end CHARACTERISTIC
/begin CHARACTERISTIC KL_SLS_OBDH_SLV_T_DIAG_OFF "Diag-Dauer SLV" CURVE 0x76C60 TKL_SW_VV_UW 100.0 FORMULA_0021 0.0 655.0000
 /begin AXIS_DESCR STD_AXIS tabg_vkat_1of2 FORMULA_0023 6 -50.0000 170.0000 FORMAT "%4.1" /end AXIS_DESCR
 FORMAT "%5.2" /end CHARACTERISTIC
/begin CHARACTERISTIC KL_SLS_OBDH_ASV_DIA_T "Diag-Dauer ASV | EN: Diagnosis duration, secondary-air valve" CURVE 0x76C7A TKL_SW_VV_UW 100.0 FORMULA_0021 0.0 655.0000
 /begin AXIS_DESCR STD_AXIS tabg_vkat_1of2 FORMULA_0023 6 -50.0000 170.0000 FORMAT "%4.1" /end AXIS_DESCR
 FORMAT "%5.2" /end CHARACTERISTIC
/begin CHARACTERISTIC KL_SLS_OBDH_ASV_LAM_LEAK_MAX "Schwelle fuer Erkennung auf Leckage | EN: Schwelle fuer Erkennung auf Leckage" CURVE 0x76C94 TKL_SW_VV_SW 100.0 FORMULA_0025 -0.5000 0.5000
 /begin AXIS_DESCR STD_AXIS ml_ges FORMULA_0112 4 -100.0000 1400.0000 FORMAT "%4.1" /end AXIS_DESCR
 FORMAT "%6.3" /end CHARACTERISTIC
/begin CHARACTERISTIC KL_SLS_OBDH_ML_LAM_DIF_MAX "Schwelle fuer Erkennung Durchfluss ML-Plausi" CURVE 0x76CA6 TKL_SW_VV_SW 100.0 FORMULA_0025 -0.5000 0.5000
 /begin AXIS_DESCR STD_AXIS ml_ges FORMULA_0112 4 -100.0000 1400.0000 FORMAT "%4.1" /end AXIS_DESCR
 FORMAT "%6.3" /end CHARACTERISTIC
/begin CHARACTERISTIC KL_SLS_OBDH_PU_SAU_MIN "Schwelle fuer Diagnoseabbruch psau Underdruck" CURVE 0x76CB8 TKL_SW_VV_SW 100.0 FORMULA_0077 0.0 2000.0000
 /begin AXIS_DESCR STD_AXIS tmot FORMULA_0023 4 -50.0000 170.0000 FORMAT "%4.1" /end AXIS_DESCR
 FORMAT "%4.1" /end CHARACTERISTIC
/begin CHARACTERISTIC KL_SLS_OBDH_HFM_DIAG_MIN "Min Luftmassendelta zur Erkennung HFM i.O. | EN: Minimum air-mass delta for detecting air-mass meter OK" CURVE 0x76CCA TKL_UW_VV_SW 100.0 FORMULA_0123 0.0 2000.0000
 /begin AXIS_DESCR STD_AXIS rf_pt_korr FORMULA_0075 4 0.0 4.0000 FORMAT "%6.3" /end AXIS_DESCR
/end CHARACTERISTIC
/begin CHARACTERISTIC KL_SLS_OBDH_ML_VOLA_INTG_MAX "Max. Wert fuer Erkennung SLP defekt" CURVE 0x76CDC TKL_UW_VV_UW 100.0 FORMULA_0112 0.0 6550.0000
 /begin AXIS_DESCR STD_AXIS rf_pt_korr FORMULA_0075 4 0.0 4.0000 FORMAT "%6.3" /end AXIS_DESCR
 FORMAT "%4.1" /end CHARACTERISTIC
/begin MEASUREMENT sls_obd_max "min-Wert Speicher fuer die versch. Diagnosestates" SWORD FORMULA_0123 0 0 0.0 1023.0000 ECU_ADDRESS 0x3FD044 /end MEASUREMENT
/begin MEASUREMENT sls_obd_min "min-Wert Speicher fuer die versch. Diagnosestates" SWORD FORMULA_0123 0 0 0.0 1023.0000 ECU_ADDRESS 0x3FD046 /end MEASUREMENT
/begin MEASUREMENT sls_obdh_mdf_max_intg "MAX-Integral der Soll/-Istabweichung" SLONG FORMULA_1096 0 0 268435.4550 2147483.6470 ECU_ADDRESS 0x3FD048 /end MEASUREMENT
/begin MEASUREMENT sls_obdh_mdf_min_intg "MIN-Integral der Soll/-Istabweichung" SLONG FORMULA_1096 0 0 268435.4550 2147483.6470 ECU_ADDRESS 0x3FD04C /end MEASUREMENT
/begin MEASUREMENT sls_obdh_mdf_max_intg_s16 "normiertes Max-Integral der Soll/-Istabweichung" SWORD FORMULA_1097 0 0 -260.0000 260.0000 ECU_ADDRESS 0x3FD050 /end MEASUREMENT
/begin MEASUREMENT sls_obdh_mdf_max_intg_norm "Normiertes Max-Integral der Soll/-Istabweichung" SWORD FORMULA_0561 0 0 -32.7670 32.7670 ECU_ADDRESS 0x3FD052 /end MEASUREMENT
/begin MEASUREMENT sls_obdh_lam_asv_intg_norm "Normiertes Lam-Integral der Soll/-Istabweichung ASV" SWORD FORMULA_0573 0 0 -1.9000 1.9000 ECU_ADDRESS 0x3FD054 /end MEASUREMENT
/begin MEASUREMENT sls_obdh_diag_st "Diagnosestatus des SL-Systems" ULONG FORMULA_1098 0 0 0.0 4294967295.0 ECU_ADDRESS 0x3FD058 /end MEASUREMENT
/begin MEASUREMENT sls_obdh_mdf_st "MDF-Fehlermatrix" UWORD FORMULA_1099 0 0 0.0 65535.0 ECU_ADDRESS 0x3FD05C /end MEASUREMENT
/begin MEASUREMENT sls_obd_abbruch_st "SLS-OBD Abbruchstatus" UWORD FORMULA_1100 0 0 0.0 65535.0 ECU_ADDRESS 0x3FD05E /end MEASUREMENT
/begin MEASUREMENT sls_obd_abbruch_st_n_max "N ueberschritten" UWORD FORMULA_1101 0 0 0.0 65535.0 ECU_ADDRESS 0x3FD05E BIT_MASK 0x1 /end MEASUREMENT
/begin MEASUREMENT sls_obd_abbruch_st_ml_max "Luftmasser ueberschritten" UWORD FORMULA_1102 0 0 0.0 65535.0 ECU_ADDRESS 0x3FD05E BIT_MASK 0x2 /end MEASUREMENT
/begin MEASUREMENT sls_obd_abbruch_st_tmot "Tmot zu niedrig" UWORD FORMULA_1103 0 0 0.0 65535.0 ECU_ADDRESS 0x3FD05E BIT_MASK 0x4 /end MEASUREMENT
/begin MEASUREMENT sls_obd_abbruch_st_ub "ub zu gering" UWORD FORMULA_1104 0 0 0.0 65535.0 ECU_ADDRESS 0x3FD05E BIT_MASK 0x8 /end MEASUREMENT
/begin MEASUREMENT sls_obd_abbruch_st_slp "SLP noch nicht angelaufen fur SLS-OBD" UWORD FORMULA_1105 0 0 0.0 65535.0 ECU_ADDRESS 0x3FD05E BIT_MASK 0x10 /end MEASUREMENT
/begin MEASUREMENT sls_obd_abbruch_st_restl "Wiederholstart" UWORD FORMULA_1106 0 0 0.0 65535.0 ECU_ADDRESS 0x3FD05E BIT_MASK 0x20 /end MEASUREMENT
/begin MEASUREMENT sls_obd_abbruch_st_ext_fehler "Fehler aus einem externen Modul" UWORD FORMULA_1107 0 0 0.0 65535.0 ECU_ADDRESS 0x3FD05E BIT_MASK 0x40 /end MEASUREMENT
/begin MEASUREMENT sls_obd_abbruch_st_n_min "n unterschritten" UWORD FORMULA_1108 0 0 0.0 65535.0 ECU_ADDRESS 0x3FD05E BIT_MASK 0x80 /end MEASUREMENT
/begin MEASUREMENT sls_obd_abbruch_st_rf_min "rf unterschritten" UWORD FORMULA_1109 0 0 0.0 65535.0 ECU_ADDRESS 0x3FD05E BIT_MASK 0x100 /end MEASUREMENT
/begin MEASUREMENT sls_obd_abbruch_st_ml_min "Luftmasse unterschritten" UWORD FORMULA_1110 0 0 0.0 65535.0 ECU_ADDRESS 0x3FD05E BIT_MASK 0x200 /end MEASUREMENT
/begin MEASUREMENT sls_obd_abbruch_st_ml_verh "Luftmasserverhaeltniss zu gering" UWORD FORMULA_1111 0 0 0.0 65535.0 ECU_ADDRESS 0x3FD05E BIT_MASK 0x400 /end MEASUREMENT
/begin MEASUREMENT sls_obd_abbruch_st_pumg "pumg ueberschritten" UWORD FORMULA_1112 0 0 0.0 65535.0 ECU_ADDRESS 0x3FD05E BIT_MASK 0x800 /end MEASUREMENT
/begin MEASUREMENT sls_obd_abbruch_st_rf_max "rf ueberschritten" UWORD FORMULA_1113 0 0 0.0 65535.0 ECU_ADDRESS 0x3FD05E BIT_MASK 0x1000 /end MEASUREMENT
/begin MEASUREMENT sls_obd_abbruch_st_t_sa "SA Zeit ueberschritten" UWORD FORMULA_1114 0 0 0.0 65535.0 ECU_ADDRESS 0x3FD05E BIT_MASK 0x2000 /end MEASUREMENT
/begin MEASUREMENT sls_obd_abbruch_st_pu_sau_min "Saugrohrunterdruck zu gering um ASV zu oeffnen" UWORD FORMULA_1115 0 0 0.0 65535.0 ECU_ADDRESS 0x3FD05E BIT_MASK 0x4000 /end MEASUREMENT
/begin MEASUREMENT sls_obd_abbruch_st_ende "Diagnose abgelaufen" UWORD FORMULA_1116 0 0 0.0 65535.0 ECU_ADDRESS 0x3FD05E BIT_MASK 0x8000 /end MEASUREMENT
/begin MEASUREMENT sls_obdh_mdf_ml_soll "Sek.Luftmasse zur MDF" SWORD FORMULA_0112 0 0 -100.0000 1400.0000 ECU_ADDRESS 0x3FD060 /end MEASUREMENT
/begin MEASUREMENT sls_obd_timer "Timer der sls-OBD" UWORD FORMULA_0650 0 0 0.0 655.0000 ECU_ADDRESS 0x3FD062 /end MEASUREMENT
/begin MEASUREMENT sls_obdh_diag_time_on "Time der sls-OBD Diagnoese" UWORD FORMULA_0650 0 0 0.0 655.0000 ECU_ADDRESS 0x3FD064 /end MEASUREMENT
/begin MEASUREMENT sls_obdh_t_mdf "Timer der MDF-Diagnose" UWORD FORMULA_0650 0 0 0.0 655.0000 ECU_ADDRESS 0x3FD066 /end MEASUREMENT
/begin MEASUREMENT sls_obdh_t_mdf_lam "Timer der MDF-Lambda-Diagnose" UWORD FORMULA_0650 0 0 0.0 655.0000 ECU_ADDRESS 0x3FD068 /end MEASUREMENT
/begin MEASUREMENT sls_obdh_lam_intg "Integral Lambdadelta zwischen B1 und B2" SLONG FORMULA_1117 0 0 -0.5000 0.5000 ECU_ADDRESS 0x3FD06C /end MEASUREMENT
/begin MEASUREMENT sls_obdh_mdl_ml_korr "Verlustanteil aufgrund Leitungsverluste" SWORD FORMULA_0112 0 0 -100.0000 1400.0000 ECU_ADDRESS 0x3FD070 /end MEASUREMENT
/begin MEASUREMENT sls_obdh_ml_mdl "Modellierter SL-Luftmassenstrom" SWORD FORMULA_0112 0 0 -100.0000 1400.0000 ECU_ADDRESS 0x3FD072 /end MEASUREMENT
/begin MEASUREMENT sls_obd_ml_dyn "Dynamik Grad fuer ml" SWORD FORMULA_0112 0 0 -100.0000 1400.0000 ECU_ADDRESS 0x3FD074 /end MEASUREMENT
/begin MEASUREMENT sls_obd_dyn_grad "Dynamik Grad fuer ml" SWORD FORMULA_1118 0 0 -3276.8000 3276.7000 ECU_ADDRESS 0x3FD076 /end MEASUREMENT
/begin MEASUREMENT sls_obd_mdl_diff_dyn "Dynamik Grad fuer ml" SWORD FORMULA_0112 0 0 -100.0000 1400.0000 ECU_ADDRESS 0x3FD078 /end MEASUREMENT
/begin MEASUREMENT sls_exd_st_pl "Externer Ansteuerungsstatus Prueflauf" UBYTE FORMULA_1119 0 0 0.0 255.0 ECU_ADDRESS 0x3FD07A /end MEASUREMENT
/begin MEASUREMENT sls_obdh_pu_sau_max "Max. aufgetr. Saugr.-unterdruck bis nach SLS-HFM-Diagnose" SWORD FORMULA_0077 0 0 0.0 2000.0000 ECU_ADDRESS 0x3FD07C /end MEASUREMENT
/begin MEASUREMENT sls_obdh_lam_ist_fil "gefiltertes Lambda ist aus Maxauswahl B1 und B2" UWORD FORMULA_0025 0 0 0.0 3.9990 ECU_ADDRESS 0x3FD07E /end MEASUREMENT
/begin MEASUREMENT sls_obdh_ml_ges_fil "gefiltertes ml_ges " SWORD FORMULA_0112 0 0 -100.0000 1400.0000 ECU_ADDRESS 0x3FD080 /end MEASUREMENT
/begin MEASUREMENT sls_obdh_sl_ml_vola_intg "Integral ueber den Absolutbegrag der Abweichung" UWORD FORMULA_0112 0 0 0.0 1400.0000 ECU_ADDRESS 0x3FD082 /end MEASUREMENT
/begin MEASUREMENT sls_obdh_ml_hfm_fil "gefilterter SLP-Luftmassenstrom" SWORD FORMULA_0112 0 0 -100.0000 1400.0000 ECU_ADDRESS 0x3FD084 /end MEASUREMENT
/* ------------------ Abschnitt erzeugt aus slv.dat ------------------ */
/begin MEASUREMENT slv_exd_timeout "KWP-Ansteuerzeit" UBYTE FORMULA_0458 0 0 0.0 25.5000 ECU_ADDRESS 0x3FD086 /end MEASUREMENT
/* ------------------ Abschnitt erzeugt aus ssp.dat ------------------ */
/begin CHARACTERISTIC K_SSP_CFG "Schalter Funktion - Ausgang" VALUE 0x76CF8 TKW_VV_VV_UB 100.0 FORMULA_1128 0.0 255.0 /end CHARACTERISTIC
/begin CHARACTERISTIC K_SSP_N "Treiber Ausschaltschwelle" VALUE 0x76CFA TKW_VV_VV_SW 100.0 FORMULA_0006 0.0 10000.0000 /end CHARACTERISTIC
/begin CHARACTERISTIC K_SSP_N_HYS "Hysterese Ausschaltschwelle" VALUE 0x76CFC TKW_VV_VV_SW 100.0 FORMULA_0006 0.0 10000.0000 /end CHARACTERISTIC
/begin CHARACTERISTIC K_SSP_DIAG_ML_MAX "maximal zulaessiger Luftmassenstrom aus HFM fuer SSP-Funktionscheck" VALUE 0x76CFE TKW_VV_VV_SW 100.0 FORMULA_0112 -100.0000 1400.0000 FORMAT "%4.1" /end CHARACTERISTIC
/begin CHARACTERISTIC K_SSP_DIAG_TMOT "minimal zulaessige tmot fuer SSP-Funktionscheck" VALUE 0x76D00 TKW_VV_VV_SW 100.0 FORMULA_0023 -50.0000 170.0000 FORMAT "%4.1" /end CHARACTERISTIC
/begin CHARACTERISTIC K_SSP_DIAG_T_START "minimal geforderte Motorlaufzeit time_ml fuer SSP-Funktionscheck" VALUE 0x76D02 TKW_VV_VV_UW 100.0 FORMULA_0021 0.0 655.0000 FORMAT "%5.2" /end CHARACTERISTIC
/begin CHARACTERISTIC K_SSP_DIAG_LLS_DIFF "zulaessige Abweichung lls[1] Ist- zu Mittelwert fuer SSP-Funktionscheck" VALUE 0x76D04 TKW_VV_VV_SW 100.0 FORMULA_0001 -10.0000 120.0000 FORMAT "%4.1" /end CHARACTERISTIC
/begin CHARACTERISTIC K_SSP_DIAG_TIME_WAIT "Wartezeit ohne SSP fuer SSP-Funktionscheck" VALUE 0x76D06 TKW_VV_VV_UW 100.0 FORMULA_0021 0.0 655.0000 FORMAT "%5.2" /end CHARACTERISTIC
/begin CHARACTERISTIC K_SSP_DIAG_TIME "Messzeit ohne SSP fuer SSP-Funktionscheck" VALUE 0x76D08 TKW_VV_VV_UW 100.0 FORMULA_0021 0.0 655.0000 FORMAT "%5.2" /end CHARACTERISTIC
/begin CHARACTERISTIC K_SSP_DIAG_TIME_WAIT_AN "Wartezeit mit SSP fuer SSP-Funktionscheck" VALUE 0x76D0A TKW_VV_VV_UW 100.0 FORMULA_0021 0.0 655.0000 FORMAT "%5.2" /end CHARACTERISTIC
/begin CHARACTERISTIC K_SSP_DIAG_TIME_AN "Messzeit mit SSP fuer SSP-Funktionscheck" VALUE 0x76D0C TKW_VV_VV_UW 100.0 FORMULA_0021 0.0 655.0000 FORMAT "%5.2" /end CHARACTERISTIC
/begin CHARACTERISTIC K_SSP_DIAG_SCHWELLE "zu ueberschreitende Schwelle von ml-Differenz" VALUE 0x76D0E TKW_VV_VV_SW 100.0 FORMULA_0112 -100.0000 1400.0000 FORMAT "%4.1" /end CHARACTERISTIC
/begin CHARACTERISTIC K_SSP_ED_OPENLOAD_CNT "Counter zur Entprellung der Treiberdiagnose bei OPENLOAD" VALUE 0x76D10 TKW_VV_VV_UB 100.0 FORMULA_0003 0.0 255.0000 /end CHARACTERISTIC
/begin CHARACTERISTIC K_SSP_DIAG_AQ_SOLL_SCHWELLE "zulaessige AQ-Soll-Abweichung fuer SSP-Diagnose" VALUE 0x76D12 TKW_VV_VV_UW 100.0 FORMULA_0147 0.0 6500.0000 FORMAT "%4.1" /end CHARACTERISTIC
/begin MEASUREMENT ssp_exd_timeout "KWP-Ansteuerzeit" UBYTE FORMULA_0458 0 0 0.0 25.5000 ECU_ADDRESS 0x3FD094 /end MEASUREMENT
/begin MEASUREMENT ssp_diag_egas_mw_lls_1of2_ "DK-Mittelwert gebildet aus egas_ist_lls fuer SSP-Funktionscheck" SWORD FORMULA_0001 0 0 -10.0000 120.0000 ECU_ADDRESS 0x3FD096 /end MEASUREMENT
/begin MEASUREMENT ssp_diag_egas_mw_lls_2of2_ "DK-Mittelwert gebildet aus egas_ist_lls fuer SSP-Funktionscheck" SWORD FORMULA_0001 0 0 -10.0000 120.0000 ECU_ADDRESS 0x3FD098 /end MEASUREMENT
/begin MEASUREMENT ssp_diag_time_wait_old "Wartezeitbasis ohne SSP fuer kommenden SSP-Diag-Zyklus" ULONG FORMULA_0152 0 0 0.0 655.0000 ECU_ADDRESS 0x3FD09C /end MEASUREMENT
/begin MEASUREMENT ssp_diag_time_old "Messzeitbasis ohne SSP fuer kommenden SSP-Diag-Zyklus" ULONG FORMULA_0152 0 0 0.0 655.0000 ECU_ADDRESS 0x3FD0A0 /end MEASUREMENT
/begin MEASUREMENT ssp_diag_time_wait_an_old "Wartezeitbasis mit SSP fuer kommenden SSP-Diag-Zyklus" ULONG FORMULA_0152 0 0 0.0 655.0000 ECU_ADDRESS 0x3FD0A4 /end MEASUREMENT
/begin MEASUREMENT ssp_diag_time_an_old "Messzeitbasis mit SSP fuer kommenden SSP-Diag-Zyklus" ULONG FORMULA_0152 0 0 0.0 655.0000 ECU_ADDRESS 0x3FD0A8 /end MEASUREMENT
/begin MEASUREMENT ssp_diag_ml_abweichung "Luftmassenstromdifferenz aus Messung mit und ohne SSP" SWORD FORMULA_0112 0 0 -100.0000 1400.0000 ECU_ADDRESS 0x3FD0AC /end MEASUREMENT
/begin MEASUREMENT ssp_diag_ml_ohne_ssp "ml-Durchschnitt ohne SSP ueber Messzeit" SWORD FORMULA_0112 0 0 -100.0000 1400.0000 ECU_ADDRESS 0x3FD0AE /end MEASUREMENT
/begin MEASUREMENT ssp_diag_ml_mit_ssp "ml-Durchschnitt mit SSP ueber Messzeit" SWORD FORMULA_0112 0 0 -100.0000 1400.0000 ECU_ADDRESS 0x3FD0B0 /end MEASUREMENT
/begin MEASUREMENT ssp_diag_egas_aq_soll_ohne_ssp "AQ-Soll-Mittelwert bei SSP aus" ULONG FORMULA_1127 0 0 0.0 429496729.5000 ECU_ADDRESS 0x3FD0B8 /end MEASUREMENT
/begin MEASUREMENT ssp_diag_egas_aq_soll_mit_ssp "AQ-Soll-Mittelwert bei SSP an" ULONG FORMULA_1127 0 0 0.0 429496729.5000 ECU_ADDRESS 0x3FD0BC /end MEASUREMENT
/begin MEASUREMENT ssp_diag_egas_aq_soll_abweichung "AQ-Soll-Abweichung mit Fuellungsadaption waehrend SSP-Diagnose" UWORD FORMULA_0147 0 0 0.0 6500.0000 ECU_ADDRESS 0x3FD0C0 /end MEASUREMENT
/begin FUNCTION RF ""
 /begin DEF_CHARACTERISTIC KL_RF_START K_RF_DYN_TAU K_RF_HUBVOLUMEN K_RF_LUFTDICHTE K_RF_ST_LL_RAMP /end DEF_CHARACTERISTIC
 /begin REF_CHARACTERISTIC /end REF_CHARACTERISTIC
 /begin IN_MEASUREMENT /end IN_MEASUREMENT
 /begin OUT_MEASUREMENT rf_dyn_la_cnt rf_dyn_o2_cnt rf_dyn_st rf_dyn_st_fplau rf_dyn_st_la rf_dyn_st_la_trim rf_dyn_st_o2 rf_dyn_st_te rf_st_ll_ramp /end OUT_MEASUREMENT
/end FUNCTION
/begin FUNCTION RTA "" /begin DEF_CHARACTERISTIC /end DEF_CHARACTERISTIC /begin REF_CHARACTERISTIC /end REF_CHARACTERISTIC /begin IN_MEASUREMENT /end IN_MEASUREMENT /begin OUT_MEASUREMENT /end OUT_MEASUREMENT /end FUNCTION
/begin FUNCTION RamCheck "" /begin DEF_CHARACTERISTIC K_RAM_CHK_CFG K_RAM_CHK_T /end DEF_CHARACTERISTIC /begin REF_CHARACTERISTIC /end REF_CHARACTERISTIC /begin IN_MEASUREMENT /end IN_MEASUREMENT /begin OUT_MEASUREMENT ram_chk_freq ram_chk_rptr /end OUT_MEASUREMENT /end FUNCTION
/begin FUNCTION Restgas ""
 /begin DEF_CHARACTERISTIC KF_RG_STAT KL_RG_PHI_MEAN KL_RG_PRGVO_ASP_OFFSET KL_RG_UES_A_MEAN KL_RG_UES_E_MEAN K_RG_M_MAX K_RG_M_MIN K_RG_TABG_FAKTOR K_RG_T_UES_AV_MAX K_RG_V_TOTVOLUMEN K_RG_WE_ANZ_SEGM K_RG_X_START /end DEF_CHARACTERISTIC
 /begin REF_CHARACTERISTIC /end REF_CHARACTERISTIC
 /begin IN_MEASUREMENT /end IN_MEASUREMENT
 /begin OUT_MEASUREMENT rg_b1.a_mean_ues rg_b1.e_mean_ues rg_b1.gas_zustand rg_b1.m_av rg_b1.m_ev rg_b1.m_mod rg_b1.m_stat rg_b1.m_tot rg_b1.mdt_av rg_b1.mdt_ev rg_b1.pabg rg_b1.phi_av_mean rg_b1.phi_ev_mean rg_b1.prgvo rg_b1.psau rg_b1.pzyl rg_b1.rho rg_b1.sa_ctr rg_b1.t_ues_av rg_b1.t_ues_ev rg_b1.w_ues_av rg_b1.w_ues_ev rg_b1.x_stat rg_b2.a_mean_ues rg_b2.e_mean_ues rg_b2.gas_zustand rg_b2.m_av rg_b2.m_ev rg_b2.m_mod rg_b2.m_stat rg_b2.m_tot rg_b2.mdt_av rg_b2.mdt_ev rg_b2.pabg rg_b2.phi_av_mean rg_b2.phi_ev_mean rg_b2.prgvo rg_b2.psau rg_b2.pzyl rg_b2.rho rg_b2.sa_ctr rg_b2.t_ues_av rg_b2.t_ues_ev rg_b2.w_ues_av rg_b2.w_ues_ev rg_b2.x_stat /end OUT_MEASUREMENT
/end FUNCTION
/begin FUNCTION SG-Konfiguration ""
 /begin DEF_CHARACTERISTIC cfg.abgas cfg.baureihe cfg.betriebsmode cfg.canmess cfg.canstand cfg.diagnose cfg.dsc_typ cfg.getriebetyp cfg.hil cfg.ipm cfg.la_variante cfg.motortyp cfg.peripherie cfg.sg_mode cfg.status /end DEF_CHARACTERISTIC
 /begin REF_CHARACTERISTIC /end REF_CHARACTERISTIC
 /begin IN_MEASUREMENT /end IN_MEASUREMENT
 /begin OUT_MEASUREMENT cfg_boot_st sys_exc_lr vers_boot vers_boot_index /end OUT_MEASUREMENT
/end FUNCTION
/begin FUNCTION SK-Ebene_2 "" /begin DEF_CHARACTERISTIC K_SK_E2_KOMP_ERR_MAX K_SK_MAX_RESETS_E2 /end DEF_CHARACTERISTIC /begin REF_CHARACTERISTIC /end REF_CHARACTERISTIC /begin IN_MEASUREMENT /end IN_MEASUREMENT
 /begin OUT_MEASUREMENT sk_e2_byte sk_e2_byte_err sk_e2_fehler sk_e2_komp_err sk_e2_long sk_e2_long_err sk_e2_word sk_e2_word_err sk_reset_cnt_e2 /end OUT_MEASUREMENT
/end FUNCTION
/begin FUNCTION SK-Manager ""
 /begin DEF_CHARACTERISTIC K_SK_CFG K_SK_CRC32 K_SK_EGAS_OFF_10of16_ K_SK_EGAS_OFF_11of16_ K_SK_EGAS_OFF_12of16_ K_SK_EGAS_OFF_13of16_ K_SK_EGAS_OFF_14of16_ K_SK_EGAS_OFF_15of16_ K_SK_EGAS_OFF_16of16_ K_SK_EGAS_OFF_1of16_ K_SK_EGAS_OFF_2of16_ K_SK_EGAS_OFF_3of16_ K_SK_EGAS_OFF_4of16_ K_SK_EGAS_OFF_5of16_ K_SK_EGAS_OFF_6of16_ K_SK_EGAS_OFF_7of16_ K_SK_EGAS_OFF_8of16_ K_SK_EGAS_OFF_9of16_ K_SK_EGAS_OFF_TIME K_SK_FGR_SPERRE K_SK_FM_EGAS_TEST K_SK_FM_FAIL_ZYL_TEST K_SK_FM_GEMISCH_TEST K_SK_FM_KR_TEST K_SK_FM_LAM_TEST K_SK_FM_MD_TEST K_SK_FM_MVAC_TEST K_SK_FM_SMG_TEST K_SK_FRA_SPERRE K_SK_HW_AD_DELTA_MAX K_SK_HW_AD_ED_ZAEHLER K_SK_HW_AD_STAT K_SK_HW_AD_STAT_ZAEHLER K_SK_KH_SPERRE K_SK_LAM_EINGR_10of32_ K_SK_LAM_EINGR_11of32_ K_SK_LAM_EINGR_12of32_ K_SK_LAM_EINGR_13of32_ K_SK_LAM_EINGR_14of32_ K_SK_LAM_EINGR_15of32_ K_SK_LAM_EINGR_16of32_ K_SK_LAM_EINGR_17of32_ K_SK_LAM_EINGR_18of32_ K_SK_LAM_EINGR_19of32_ K_SK_LAM_EINGR_1of32_ K_SK_LAM_EINGR_20of32_ K_SK_LAM_EINGR_21of32_ K_SK_LAM_EINGR_22of32_ K_SK_LAM_EINGR_23of32_ K_SK_LAM_EINGR_24of32_ K_SK_LAM_EINGR_25of32_ K_SK_LAM_EINGR_26of32_ K_SK_LAM_EINGR_27of32_ K_SK_LAM_EINGR_28of32_ K_SK_LAM_EINGR_29of32_ K_SK_LAM_EINGR_2of32_ K_SK_LAM_EINGR_30of32_ K_SK_LAM_EINGR_31of32_ K_SK_LAM_EINGR_32of32_ K_SK_LAM_EINGR_3of32_ K_SK_LAM_EINGR_4of32_ K_SK_LAM_EINGR_5of32_ K_SK_LAM_EINGR_6of32_ K_SK_LAM_EINGR_7of32_ K_SK_LAM_EINGR_8of32_ K_SK_LAM_EINGR_9of32_ K_SK_LAM_EINGR_TI K_SK_LLRA_SPERRE K_SK_MAX_OS_ERR K_SK_MAX_RESETS K_SK_MD_BEGR_DK_OFFEN K_SK_MD_BEGR_EGAS_10of64_ K_SK_MD_BEGR_EGAS_11of64_ K_SK_MD_BEGR_EGAS_12of64_ K_SK_MD_BEGR_EGAS_13of64_ K_SK_MD_BEGR_EGAS_14of64_ K_SK_MD_BEGR_EGAS_15of64_ K_SK_MD_BEGR_EGAS_16of64_ K_SK_MD_BEGR_EGAS_17of64_ K_SK_MD_BEGR_EGAS_18of64_ K_SK_MD_BEGR_EGAS_19of64_ K_SK_MD_BEGR_EGAS_1of64_ K_SK_MD_BEGR_EGAS_20of64_ K_SK_MD_BEGR_EGAS_21of64_ K_SK_MD_BEGR_EGAS_22of64_ K_SK_MD_BEGR_EGAS_23of64_ K_SK_MD_BEGR_EGAS_24of64_ K_SK_MD_BEGR_EGAS_25of64_ K_SK_MD_BEGR_EGAS_26of64_ K_SK_MD_BEGR_EGAS_27of64_ K_SK_MD_BEGR_EGAS_28of64_ K_SK_MD_BEGR_EGAS_29of64_ K_SK_MD_BEGR_EGAS_2of64_ K_SK_MD_BEGR_EGAS_30of64_ K_SK_MD_BEGR_EGAS_31of64_ K_SK_MD_BEGR_EGAS_32of64_ K_SK_MD_BEGR_EGAS_33of64_ K_SK_MD_BEGR_EGAS_34of64_ K_SK_MD_BEGR_EGAS_35of64_ K_SK_MD_BEGR_EGAS_36of64_ K_SK_MD_BEGR_EGAS_37of64_ K_SK_MD_BEGR_EGAS_38of64_ K_SK_MD_BEGR_EGAS_39of64_ K_SK_MD_BEGR_EGAS_3of64_ K_SK_MD_BEGR_EGAS_40of64_ K_SK_MD_BEGR_EGAS_41of64_ K_SK_MD_BEGR_EGAS_42of64_ K_SK_MD_BEGR_EGAS_43of64_ K_SK_MD_BEGR_EGAS_44of64_ K_SK_MD_BEGR_EGAS_45of64_ K_SK_MD_BEGR_EGAS_46of64_ K_SK_MD_BEGR_EGAS_47of64_ K_SK_MD_BEGR_EGAS_48of64_ K_SK_MD_BEGR_EGAS_49of64_ K_SK_MD_BEGR_EGAS_4of64_ K_SK_MD_BEGR_EGAS_50of64_ K_SK_MD_BEGR_EGAS_51of64_ K_SK_MD_BEGR_EGAS_52of64_ K_SK_MD_BEGR_EGAS_53of64_ K_SK_MD_BEGR_EGAS_54of64_ K_SK_MD_BEGR_EGAS_55of64_ K_SK_MD_BEGR_EGAS_56of64_ K_SK_MD_BEGR_EGAS_57of64_ K_SK_MD_BEGR_EGAS_58of64_ K_SK_MD_BEGR_EGAS_59of64_ K_SK_MD_BEGR_EGAS_5of64_ K_SK_MD_BEGR_EGAS_60of64_ K_SK_MD_BEGR_EGAS_61of64_ K_SK_MD_BEGR_EGAS_62of64_ K_SK_MD_BEGR_EGAS_63of64_ K_SK_MD_BEGR_EGAS_64of64_ K_SK_MD_BEGR_EGAS_6of64_ K_SK_MD_BEGR_EGAS_7of64_ K_SK_MD_BEGR_EGAS_8of64_ K_SK_MD_BEGR_EGAS_9of64_ K_SK_MD_BEGR_GEMISCH_10of32_ K_SK_MD_BEGR_GEMISCH_11of32_ K_SK_MD_BEGR_GEMISCH_12of32_ K_SK_MD_BEGR_GEMISCH_13of32_ K_SK_MD_BEGR_GEMISCH_14of32_ K_SK_MD_BEGR_GEMISCH_15of32_ K_SK_MD_BEGR_GEMISCH_16of32_ K_SK_MD_BEGR_GEMISCH_17of32_ K_SK_MD_BEGR_GEMISCH_18of32_ K_SK_MD_BEGR_GEMISCH_19of32_ K_SK_MD_BEGR_GEMISCH_1of32_ K_SK_MD_BEGR_GEMISCH_20of32_ K_SK_MD_BEGR_GEMISCH_21of32_ K_SK_MD_BEGR_GEMISCH_22of32_ K_SK_MD_BEGR_GEMISCH_23of32_ K_SK_MD_BEGR_GEMISCH_24of32_ K_SK_MD_BEGR_GEMISCH_25of32_ K_SK_MD_BEGR_GEMISCH_26of32_ K_SK_MD_BEGR_GEMISCH_27of32_ K_SK_MD_BEGR_GEMISCH_28of32_ K_SK_MD_BEGR_GEMISCH_29of32_ K_SK_MD_BEGR_GEMISCH_2of32_ K_SK_MD_BEGR_GEMISCH_30of32_ K_SK_MD_BEGR_GEMISCH_31of32_ K_SK_MD_BEGR_GEMISCH_32of32_ K_SK_MD_BEGR_GEMISCH_3of32_ K_SK_MD_BEGR_GEMISCH_4of32_ K_SK_MD_BEGR_GEMISCH_5of32_ K_SK_MD_BEGR_GEMISCH_6of32_ K_SK_MD_BEGR_GEMISCH_7of32_ K_SK_MD_BEGR_GEMISCH_8of32_ K_SK_MD_BEGR_GEMISCH_9of32_ K_SK_MD_BEGR_KR_1of8_ K_SK_MD_BEGR_KR_2of8_ K_SK_MD_BEGR_KR_3of8_ K_SK_MD_BEGR_KR_4of8_ K_SK_MD_BEGR_KR_5of8_ K_SK_MD_BEGR_KR_6of8_ K_SK_MD_BEGR_KR_7of8_ K_SK_MD_BEGR_KR_8of8_ K_SK_MD_BEGR_MD_10of16_ K_SK_MD_BEGR_MD_11of16_ K_SK_MD_BEGR_MD_12of16_ K_SK_MD_BEGR_MD_13of16_ K_SK_MD_BEGR_MD_14of16_ K_SK_MD_BEGR_MD_15of16_ K_SK_MD_BEGR_MD_16of16_ K_SK_MD_BEGR_MD_1of16_ K_SK_MD_BEGR_MD_2of16_ K_SK_MD_BEGR_MD_3of16_ K_SK_MD_BEGR_MD_4of16_ K_SK_MD_BEGR_MD_5of16_ K_SK_MD_BEGR_MD_6of16_ K_SK_MD_BEGR_MD_7of16_ K_SK_MD_BEGR_MD_8of16_ K_SK_MD_BEGR_MD_9of16_ K_SK_MD_BEGR_MVAC_1of4_ K_SK_MD_BEGR_MVAC_2of4_ K_SK_MD_BEGR_MVAC_3of4_ K_SK_MD_BEGR_MVAC_4of4_ K_SK_MD_BEGR_MVAC_SYS K_SK_MD_BEGR_PWG_1of6_ K_SK_MD_BEGR_PWG_2of6_ K_SK_MD_BEGR_PWG_3of6_ K_SK_MD_BEGR_PWG_4of6_ K_SK_MD_BEGR_PWG_5of6_ K_SK_MD_BEGR_PWG_6of6_ K_SK_MD_BEGR_RESET K_SK_MD_BEGR_SMG_10of16_ K_SK_MD_BEGR_SMG_11of16_ K_SK_MD_BEGR_SMG_12of16_ K_SK_MD_BEGR_SMG_13of16_ K_SK_MD_BEGR_SMG_14of16_ K_SK_MD_BEGR_SMG_15of16_ K_SK_MD_BEGR_SMG_16of16_ K_SK_MD_BEGR_SMG_1of16_ K_SK_MD_BEGR_SMG_2of16_ K_SK_MD_BEGR_SMG_3of16_ K_SK_MD_BEGR_SMG_4of16_ K_SK_MD_BEGR_SMG_5of16_ K_SK_MD_BEGR_SMG_6of16_ K_SK_MD_BEGR_SMG_7of16_ K_SK_MD_BEGR_SMG_8of16_ K_SK_MD_BEGR_SMG_9of16_ K_SK_MD_BEGR_TI_10of16_ K_SK_MD_BEGR_TI_11of16_ K_SK_MD_BEGR_TI_12of16_ K_SK_MD_BEGR_TI_13of16_ K_SK_MD_BEGR_TI_14of16_ K_SK_MD_BEGR_TI_15of16_ K_SK_MD_BEGR_TI_16of16_ K_SK_MD_BEGR_TI_1of16_ K_SK_MD_BEGR_TI_2of16_ K_SK_MD_BEGR_TI_3of16_ K_SK_MD_BEGR_TI_4of16_ K_SK_MD_BEGR_TI_5of16_ K_SK_MD_BEGR_TI_6of16_ K_SK_MD_BEGR_TI_7of16_ K_SK_MD_BEGR_TI_8of16_ K_SK_MD_BEGR_TI_9of16_ K_SK_MD_TI_EINGR K_SK_MD_VL_SPERRE K_SK_MVAC_KH_1of4_ K_SK_MVAC_KH_2of4_ K_SK_MVAC_KH_3of4_ K_SK_MVAC_KH_4of4_ K_SK_PKS_NOTLAUF K_SK_PROZ_ERR K_SK_TASK_ERR K_SK_TI_OFF_EGAS_10of64_ K_SK_TI_OFF_EGAS_11of64_ K_SK_TI_OFF_EGAS_12of64_ K_SK_TI_OFF_EGAS_13of64_ K_SK_TI_OFF_EGAS_14of64_ K_SK_TI_OFF_EGAS_15of64_ K_SK_TI_OFF_EGAS_16of64_ K_SK_TI_OFF_EGAS_17of64_ K_SK_TI_OFF_EGAS_18of64_ K_SK_TI_OFF_EGAS_19of64_ K_SK_TI_OFF_EGAS_1of64_ K_SK_TI_OFF_EGAS_20of64_ K_SK_TI_OFF_EGAS_21of64_ K_SK_TI_OFF_EGAS_22of64_ K_SK_TI_OFF_EGAS_23of64_ K_SK_TI_OFF_EGAS_24of64_ K_SK_TI_OFF_EGAS_25of64_ K_SK_TI_OFF_EGAS_26of64_ K_SK_TI_OFF_EGAS_27of64_ K_SK_TI_OFF_EGAS_28of64_ K_SK_TI_OFF_EGAS_29of64_ K_SK_TI_OFF_EGAS_2of64_ K_SK_TI_OFF_EGAS_30of64_ K_SK_TI_OFF_EGAS_31of64_ K_SK_TI_OFF_EGAS_32of64_ K_SK_TI_OFF_EGAS_33of64_ K_SK_TI_OFF_EGAS_34of64_ K_SK_TI_OFF_EGAS_35of64_ K_SK_TI_OFF_EGAS_36of64_ K_SK_TI_OFF_EGAS_37of64_ K_SK_TI_OFF_EGAS_38of64_ K_SK_TI_OFF_EGAS_39of64_ K_SK_TI_OFF_EGAS_3of64_ K_SK_TI_OFF_EGAS_40of64_ K_SK_TI_OFF_EGAS_41of64_ K_SK_TI_OFF_EGAS_42of64_ K_SK_TI_OFF_EGAS_43of64_ K_SK_TI_OFF_EGAS_44of64_ K_SK_TI_OFF_EGAS_45of64_ K_SK_TI_OFF_EGAS_46of64_ K_SK_TI_OFF_EGAS_47of64_ K_SK_TI_OFF_EGAS_48of64_ K_SK_TI_OFF_EGAS_49of64_ K_SK_TI_OFF_EGAS_4of64_ K_SK_TI_OFF_EGAS_50of64_ K_SK_TI_OFF_EGAS_51of64_ K_SK_TI_OFF_EGAS_52of64_ K_SK_TI_OFF_EGAS_53of64_ K_SK_TI_OFF_EGAS_54of64_ K_SK_TI_OFF_EGAS_55of64_ K_SK_TI_OFF_EGAS_56of64_ K_SK_TI_OFF_EGAS_57of64_ K_SK_TI_OFF_EGAS_58of64_ K_SK_TI_OFF_EGAS_59of64_ K_SK_TI_OFF_EGAS_5of64_ K_SK_TI_OFF_EGAS_60of64_ K_SK_TI_OFF_EGAS_61of64_ K_SK_TI_OFF_EGAS_62of64_ K_SK_TI_OFF_EGAS_63of64_ K_SK_TI_OFF_EGAS_64of64_ K_SK_TI_OFF_EGAS_6of64_ K_SK_TI_OFF_EGAS_7of64_ K_SK_TI_OFF_EGAS_8of64_ K_SK_TI_OFF_EGAS_9of64_ K_SK_T_RESET_DELAY_OS K_SK_ZYL_OFF_MAX /end DEF_CHARACTERISTIC
 /begin REF_CHARACTERISTIC /end REF_CHARACTERISTIC
 /begin IN_MEASUREMENT /end IN_MEASUREMENT
 /begin OUT_MEASUREMENT sk_egas_off_ni sk_egas_off_time_b1 sk_egas_off_time_b2 sk_fail_st_zyl sk_fm_egas_exd sk_fm_gemisch sk_fm_kr sk_fm_lam_1of2_ sk_fm_lam_2of2_ sk_fm_ti sk_hw_pwg1_ad_ed_zaehler sk_hw_pwg1_ad_mode sk_hw_pwg1m_ad_alt sk_hw_pwg1m_ad_zaehler sk_hw_pwg1s_ad_alt sk_hw_pwg1s_ad_zaehler sk_md_begr_ni sk_md_begr_st sk_reset_cnt sk_t_reset_delay_os sk_ti_off_st sk_ti_zyl_off_cnt sk_tr_error_cnt sk_tr_error_nr sk_tr_state sk_tr_timeout sk_tr_wait sk_ursache /end OUT_MEASUREMENT
/end FUNCTION
/begin FUNCTION SLP ""
 /begin DEF_CHARACTERISTIC KF_SLP_DAUER_TMOT_START KL_SLP_DELAY_TMOT_START K_SLP_PABG_SCHWELLE K_SLP_PABG_TAU K_SLP_TIME_AUS K_SLP_TIME_MAX /end DEF_CHARACTERISTIC
 /begin REF_CHARACTERISTIC /end REF_CHARACTERISTIC
 /begin IN_MEASUREMENT /end IN_MEASUREMENT
 /begin OUT_MEASUREMENT slp_dauer slp_pabg_dif_max /end OUT_MEASUREMENT
/end FUNCTION
/begin FUNCTION SLS_OBD ""
 /begin DEF_CHARACTERISTIC KL_SLS_OBDH_ASV_DIA_T KL_SLS_OBDH_ASV_LAM_LEAK_MAX KL_SLS_OBDH_HFM_DIAG_MIN KL_SLS_OBDH_ML_LAM_DIF_MAX KL_SLS_OBDH_ML_MDF_DIAG KL_SLS_OBDH_ML_VOLA_INTG_MAX KL_SLS_OBDH_PU_SAU_MIN KL_SLS_OBDH_SLV_T_DIAG_OFF KL_SLS_OBDH_ZWD_T_DIAG_0 KL_SLS_OBDH_ZWD_T_DIAG_100 KL_SLS_OBDH_ZWD_T_DIAG_OFF K_SLS_OBDH_ASV_LI_OPE K_SLS_OBDH_ASV_PL_LI_OPE K_SLS_OBDH_ASV_PL_RE_OPE K_SLS_OBDH_ASV_RE_OPE K_SLS_OBDH_ASV_TAU K_SLS_OBDH_DYN_DELTA_RF K_SLS_OBDH_DYN_RF_T K_SLS_OBDH_EUV_MIN_DEF K_SLS_OBDH_HFM_MAX K_SLS_OBDH_HFM_TAU K_SLS_OBDH_HYD_ABBRUCH_AD_MAX K_SLS_OBDH_HYD_ABBRUCH_ML_MAX K_SLS_OBDH_MDF_1_MAG K_SLS_OBDH_MDF_2_MAG K_SLS_OBDH_MDF_CFG K_SLS_OBDH_MDF_MAX_DEF K_SLS_OBDH_MDF_MIN_DEF K_SLS_OBDH_MDL_K_EINBAUTEN K_SLS_OBDH_MLVERH_MIN K_SLS_OBDH_ML_MAX K_SLS_OBDH_ML_MIN K_SLS_OBDH_ML_TAU K_SLS_OBDH_ML_TMOT K_SLS_OBDH_N_MAX K_SLS_OBDH_N_MIN K_SLS_OBDH_PUMG_MIN K_SLS_OBDH_RF_MAX K_SLS_OBDH_RF_MIN K_SLS_OBDH_SLP_DEF K_SLS_OBDH_SLV_MAX K_SLS_OBDH_START_MIN K_SLS_OBDH_T_AUFHEIZ K_SLS_OBDH_T_HFM_DIA K_SLS_OBDH_T_ML_PLAUSI K_SLS_OBDH_T_SA K_SLS_OBDH_T_SLV_INT_START K_SLS_OBDH_UB_MIN K_SLS_OBDH_ZWD_0_MAX K_SLS_OBDH_ZWD_100_MIN K_SLS_OBDH_ZWD_OFF_MAX K_SLS_OBDH_ZWD_OFF_MIN K_SLS_OBD_CFG K_SLS_OBD_DYN_TAU K_SLS_OBD_ML_MDL_DIFF_MAX K_SLS_OBD_ML_MDL_WICHT K_SLS_OBD_TMOT_MIN K_SLS_PL_T_MDF_STOP /end DEF_CHARACTERISTIC
 /begin REF_CHARACTERISTIC /end REF_CHARACTERISTIC
 /begin IN_MEASUREMENT /end IN_MEASUREMENT
 /begin OUT_MEASUREMENT sls_exd_st_pl sls_obd_abbruch_st sls_obd_abbruch_st_ende sls_obd_abbruch_st_ext_fehler sls_obd_abbruch_st_ml_max sls_obd_abbruch_st_ml_min sls_obd_abbruch_st_ml_verh sls_obd_abbruch_st_n_max sls_obd_abbruch_st_n_min sls_obd_abbruch_st_pu_sau_min sls_obd_abbruch_st_pumg sls_obd_abbruch_st_restl sls_obd_abbruch_st_rf_max sls_obd_abbruch_st_rf_min sls_obd_abbruch_st_slp sls_obd_abbruch_st_t_sa sls_obd_abbruch_st_tmot sls_obd_abbruch_st_ub sls_obd_dyn_grad sls_obd_max sls_obd_mdl_diff_dyn sls_obd_min sls_obd_ml_dyn sls_obd_timer sls_obdh_diag_st sls_obdh_diag_time_on sls_obdh_lam_asv_intg_norm sls_obdh_lam_intg sls_obdh_lam_ist_fil sls_obdh_mdf_max_intg sls_obdh_mdf_max_intg_norm sls_obdh_mdf_max_intg_s16 sls_obdh_mdf_min_intg sls_obdh_mdf_ml_soll sls_obdh_mdf_st sls_obdh_mdl_ml_korr sls_obdh_ml_ges_fil sls_obdh_ml_hfm_fil sls_obdh_ml_mdl sls_obdh_pu_sau_max sls_obdh_sl_ml_vola_intg sls_obdh_t_mdf sls_obdh_t_mdf_lam /end OUT_MEASUREMENT
/end FUNCTION
/begin FUNCTION SLV "" /begin DEF_CHARACTERISTIC /end DEF_CHARACTERISTIC /begin REF_CHARACTERISTIC /end REF_CHARACTERISTIC /begin IN_MEASUREMENT /end IN_MEASUREMENT /begin OUT_MEASUREMENT slv_exd_timeout /end OUT_MEASUREMENT /end FUNCTION
/begin FUNCTION SPI_INJ "" /begin DEF_CHARACTERISTIC /end DEF_CHARACTERISTIC /begin REF_CHARACTERISTIC /end REF_CHARACTERISTIC /begin IN_MEASUREMENT /end IN_MEASUREMENT /begin OUT_MEASUREMENT /end OUT_MEASUREMENT /end FUNCTION
/begin FUNCTION SSP ""
 /begin DEF_CHARACTERISTIC K_SSP_CFG K_SSP_DIAG_AQ_SOLL_SCHWELLE K_SSP_DIAG_LLS_DIFF K_SSP_DIAG_ML_MAX K_SSP_DIAG_SCHWELLE K_SSP_DIAG_TIME K_SSP_DIAG_TIME_AN K_SSP_DIAG_TIME_WAIT K_SSP_DIAG_TIME_WAIT_AN K_SSP_DIAG_TMOT K_SSP_DIAG_T_START K_SSP_ED_OPENLOAD_CNT K_SSP_N K_SSP_N_HYS /end DEF_CHARACTERISTIC
 /begin REF_CHARACTERISTIC /end REF_CHARACTERISTIC
 /begin IN_MEASUREMENT /end IN_MEASUREMENT
 /begin OUT_MEASUREMENT ssp_diag_egas_aq_soll_abweichung ssp_diag_egas_aq_soll_mit_ssp ssp_diag_egas_aq_soll_ohne_ssp ssp_diag_egas_mw_lls_1of2_ ssp_diag_egas_mw_lls_2of2_ ssp_diag_ml_abweichung ssp_diag_ml_mit_ssp ssp_diag_ml_ohne_ssp ssp_diag_time_an_old ssp_diag_time_old ssp_diag_time_wait_an_old ssp_diag_time_wait_old ssp_exd_timeout /end OUT_MEASUREMENT
/end FUNCTION
/begin FUNCTION Schalter ""
 /begin DEF_CHARACTERISTIC KF_SCHALTER_KS_N_DIFF_AUF KL_SCHALTER_KS_REG K_SCHALTER_GETR_A0 K_SCHALTER_GETR_DIAG_MAX K_SCHALTER_GETR_DIAG_MIN K_SCHALTER_GETR_DIAG_N_GETR_EIN_MIN K_SCHALTER_GETR_DIAG_N_VERH_TAU K_SCHALTER_GETR_DIAG_STABIL K_SCHALTER_GETR_DIAG_T K_SCHALTER_GETR_DIAG_V_MIN K_SCHALTER_GETR_FIL_TAU K_SCHALTER_GETR_HYSTERESE_BREITE K_SCHALTER_GETR_LEERGASSE_MAX K_SCHALTER_GETR_LEERGASSE_MIN K_SCHALTER_KS_N_DIFF K_SCHALTER_KS_N_DIFF_REF K_SCHALTER_KS_N_T K_SCHALTER_KS_N_T_AUF K_SCHALTER_KS_SCHALT_T K_SCHALTER_KUPP_DIAG_N K_SCHALTER_KUPP_DIAG_RF K_SCHALTER_KUPP_DIAG_T K_SCHALTER_KUPP_DIAG_V_MAX K_SCHALTER_KUPP_DIAG_V_MIN K_SCHALTER_KUPP_GESCHL K_SCHALTER_KUPP_OFFEN K_SCHALTER_POEL_N_DELAY K_SCHALTER_POEL_N_DIAG K_SCHALTER_POEL_START_ENDE K_SCHALTER_POEL_TOEL K_SCHALTER_POEL_T_DIAG /end DEF_CHARACTERISTIC
 /begin REF_CHARACTERISTIC /end REF_CHARACTERISTIC
 /begin IN_MEASUREMENT /end IN_MEASUREMENT
 /begin OUT_MEASUREMENT schalter_bls_ad_inj schalter_diag_poel_n_delay schalter_getr schalter_getr_a0 schalter_getr_ad schalter_getr_diag_st_inj_verz schalter_getr_diag_timer schalter_getr_fil schalter_getr_n_verh_fil schalter_ks_alt schalter_ks_dn schalter_ks_md_eff schalter_ks_n_diff schalter_ks_n_diff_auf_timer schalter_ks_n_diff_ref schalter_ks_n_diff_timer schalter_ks_n_ref schalter_ks_schalt_timer schalter_kupp_ad schalter_kupp_diag schalter_kupp_diag_scharf schalter_kupp_diag_timer schalter_kupp_diag_verz schalter_poel_ad schalter_poel_time schalter_sport_ad schalter_st_inj_old_1of2_ schalter_st_inj_old_2of2_ schalter_wakeup_ad_inj /end OUT_MEASUREMENT
/end FUNCTION
/begin FUNCTION Sekundaerluftreg. ""
 /begin DEF_CHARACTERISTIC KF_SL_LAM_MOT_OFFS KF_SL_VORST_TV KL_SL_HFM_AD KL_SL_I_ANTEIL KL_SL_LAMSOL_KALT KL_SL_LAMSOL_WARM KL_SL_LAM_I_ANTEIL KL_SL_LAM_MOT_DELAY KL_SL_LAM_MOT_OFFS_KAT_F KL_SL_LAM_MOT_OFFS_TIME_F KL_SL_ML_MAX_PABG KL_SL_ML_MAX_UB_FAKT KL_SL_P_ANTEIL K_SL_HFM_CFG K_SL_HFM_TAU K_SL_I_MAX K_SL_I_MIN K_SL_LAM_ABG_TAU K_SL_LAM_MAX_FAK K_SL_LAM_MIN_FAK K_SL_LLS_CFG K_SL_ML_HFM_DIAG_MAX K_SL_ML_HFM_DIAG_MIN K_SL_ML_HFM_ERSATZ K_SL_TKAT_ANSPR /end DEF_CHARACTERISTIC
 /begin REF_CHARACTERISTIC /end REF_CHARACTERISTIC
 /begin IN_MEASUREMENT /end IN_MEASUREMENT
 /begin OUT_MEASUREMENT ml_slp_b1 ml_slp_b2 sl_lam_abg_ist sl_lam_abg_ist_roh sl_lam_abg_soll sl_lam_b2_korr sl_lam_mot_soll_1of2_ sl_lam_mot_soll_2of2_ sl_lam_mot_soll_roh_1of2_ sl_lam_mot_soll_roh_2of2_ sl_ml_hfm_ad sl_ml_hfm_roh sl_ml_ist sl_ml_ist_lam sl_ml_max sl_ml_max_roh sl_ml_rel sl_ml_soll sl_reg_i sl_reg_p sl_regler_f sl_zwd_vorst_tv /end OUT_MEASUREMENT
/end FUNCTION
/begin FUNCTION Systemvariablen "" /begin DEF_CHARACTERISTIC /end DEF_CHARACTERISTIC /begin REF_CHARACTERISTIC /end REF_CHARACTERISTIC /begin IN_MEASUREMENT /end IN_MEASUREMENT
 /begin OUT_MEASUREMENT sys_ed_st sys_exc_addr sys_exc_km_ni sys_exc_n_ni sys_exc_vec sys_last_reset_st sys_reset_st sys_rsr sys_rsr_cnt_sum sys_rsr_csrs sys_rsr_dbhrs sys_rsr_dbsrs sys_rsr_ehrs sys_rsr_ersr sys_rsr_ghrst sys_rsr_gpor sys_rsr_gsrst sys_rsr_ilbc sys_rsr_jtrs sys_rsr_llrs sys_rsr_occs sys_rsr_swrs sys_sg_fehler sys_sync_init_t_1of5_ sys_sync_init_t_2of5_ sys_sync_init_t_3of5_ sys_sync_init_t_4of5_ sys_sync_init_t_5of5_ sys_zust sys_zust_bgnd_cnt sys_zust_bgnd_net_min sys_zust_cpu_last /end OUT_MEASUREMENT
/end FUNCTION
/begin RECORD_LAYOUT TKW_VV_VV_UB FNC_VALUES 1 UBYTE COLUMN_DIR DIRECT /end RECORD_LAYOUT
/begin RECORD_LAYOUT TKW_VV_VV_UW FNC_VALUES 1 UWORD COLUMN_DIR DIRECT /end RECORD_LAYOUT
/begin RECORD_LAYOUT TKW_VV_VV_SW FNC_VALUES 1 SWORD COLUMN_DIR DIRECT /end RECORD_LAYOUT
/begin RECORD_LAYOUT TKL_SB_VV_UW NO_AXIS_PTS_X 1 UBYTE RESERVED 2 BYTE AXIS_PTS_X 3 SBYTE INDEX_INCR DIRECT FNC_VALUES 4 UWORD COLUMN_DIR DIRECT /end RECORD_LAYOUT
/begin RECORD_LAYOUT TKL_UW_VV_UW NO_AXIS_PTS_X 1 UBYTE RESERVED 2 BYTE AXIS_PTS_X 3 UWORD INDEX_INCR DIRECT FNC_VALUES 4 UWORD COLUMN_DIR DIRECT /end RECORD_LAYOUT
/begin RECORD_LAYOUT TKL_UW_VV_SW NO_AXIS_PTS_X 1 UBYTE RESERVED 2 BYTE AXIS_PTS_X 3 UWORD INDEX_INCR DIRECT FNC_VALUES 4 SWORD COLUMN_DIR DIRECT /end RECORD_LAYOUT
/begin RECORD_LAYOUT TKL_SW_VV_UW NO_AXIS_PTS_X 1 UBYTE RESERVED 2 BYTE AXIS_PTS_X 3 SWORD INDEX_INCR DIRECT FNC_VALUES 4 UWORD COLUMN_DIR DIRECT /end RECORD_LAYOUT
/begin RECORD_LAYOUT TKL_SW_VV_SW NO_AXIS_PTS_X 1 UBYTE RESERVED 2 BYTE AXIS_PTS_X 3 SWORD INDEX_INCR DIRECT FNC_VALUES 4 SWORD COLUMN_DIR DIRECT /end RECORD_LAYOUT
/begin RECORD_LAYOUT TKF_SW_SW_SW NO_AXIS_PTS_X 1 UBYTE NO_AXIS_PTS_Y 2 UBYTE AXIS_PTS_X 3 SWORD INDEX_INCR DIRECT AXIS_PTS_Y 4 SWORD INDEX_INCR DIRECT FNC_VALUES 5 SWORD COLUMN_DIR DIRECT /end RECORD_LAYOUT
/end MODULE
/end PROJECT
