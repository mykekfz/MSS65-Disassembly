/begin PROJECT MSS65-inj-V452 "MSS65 INJ - V452.01-B204.00, data set 0569Q60Z160E"
/begin HEADER "" VERSION "V452.01-B204.00" /end HEADER
/begin MODULE _MSS65-inj "MSS65 INJ - V452.01-B204.00, calibration xxxxxxxx"
/begin MOD_COMMON "" BYTE_ORDER MSB_FIRST /* Default byteorder (Motorola) */ /end MOD_COMMON
/begin COMPU_METHOD FORMULA_0003 "FORMULA_0003" RAT_FUNC "%3.0" "-" COEFFS 0 1 0 0 0 1 /end COMPU_METHOD
/begin COMPU_METHOD FORMULA_0006 "FORMULA_0006" RAT_FUNC "%5.0" "Upm" COEFFS 0 1 0 0 0 1 /end COMPU_METHOD
/begin COMPU_METHOD FORMULA_0008 "FORMULA_0008" RAT_FUNC "%6.1" "V" COEFFS 0 10 0 0 0 1 /end COMPU_METHOD
/begin COMPU_METHOD FORMULA_0010 "FORMULA_0010" RAT_FUNC "%5.0" "-" COEFFS 0 1 0 0 0 1 /end COMPU_METHOD
/begin COMPU_METHOD FORMULA_0021 "FORMULA_0021" RAT_FUNC "%7.2" "s" COEFFS 0 100 0 0 0 1 /end COMPU_METHOD
/* ------------------ Abschnitt erzeugt aus adapt_glob.dat ------------------ */
/begin COMPU_METHOD FORMULA_0023 "FORMULA_0023" RAT_FUNC "%6.1" "�C" COEFFS 0 10 2732 0 0 1 /end COMPU_METHOD
/begin COMPU_METHOD FORMULA_0073 "FORMULA_0073" RAT_FUNC "%6.1" "s" COEFFS 0 10 0 0 0 1 /end COMPU_METHOD
/begin COMPU_METHOD FORMULA_0075 "FORMULA_0075" RAT_FUNC "%8.3" "-" COEFFS 0 1024 0 0 0 1 /end COMPU_METHOD
/begin COMPU_METHOD FORMULA_0077 "FORMULA_0077" RAT_FUNC "%6.1" "mbar" COEFFS 0 16 0 0 0 1 /end COMPU_METHOD
/begin COMPU_METHOD FORMULA_0078 "FORMULA_0078" RAT_FUNC "%6.1" "km/h" COEFFS 0 16 0 0 0 1 /end COMPU_METHOD
/begin COMPU_METHOD FORMULA_0079 "FORMULA_0079" RAT_FUNC "%6.1" "l" COEFFS 0 2 0 0 0 1 /end COMPU_METHOD
/begin COMPU_METHOD FORMULA_0109 "FORMULA_0109" RAT_FUNC "%7.2" "-" COEFFS 0 10000 0 0 0 1 /end COMPU_METHOD
/begin COMPU_METHOD FORMULA_0115 "FORMULA_0115" RAT_FUNC "%7.2" "%" COEFFS 0 16384 0 0 0 100 /end COMPU_METHOD
/begin COMPU_METHOD FORMULA_0118 "FORMULA_0118" RAT_FUNC "%8.3" "bar" COEFFS 0 1000 0 0 0 1 /end COMPU_METHOD
/begin COMPU_METHOD FORMULA_0123 "FORMULA_0123" RAT_FUNC "%5.0" "digit" COEFFS 0 1 0 0 0 1 /end COMPU_METHOD
/begin COMPU_METHOD FORMULA_0126 "FORMULA_0126" TAB_VERB "%3.0" "-" COMPU_TAB_REF FORMULA_0126_VTAB /end COMPU_METHOD
/begin COMPU_VTAB FORMULA_0126_VTAB "FORMULA_0126_VTAB" TAB_VERB 8 0 "O.K." 1 "BusOff" 2 "DPR" 4 "Timeout" 5 "BusOff+Timeout" 8 "Overflow" 16 "Chksum" 32 "Alive" DEFAULT_VALUE "Mehrfachfehler" /end COMPU_VTAB
/begin COMPU_METHOD FORMULA_0132 "FORMULA_0132" RAT_FUNC "%7.2" "m/(s*s)" COEFFS 0 40 0 0 0 1 /end COMPU_METHOD
/begin COMPU_METHOD FORMULA_0232 "FORMULA_0232" RAT_FUNC "%3.0" "s" COEFFS 0 1 0 0 0 1 /end COMPU_METHOD
/begin COMPU_METHOD FORMULA_0353 "FORMULA_0353" RAT_FUNC "%3.0" "ms" COEFFS 0 1 0 0 0 10 /end COMPU_METHOD
/* ------------------ Abschnitt erzeugt aus dqlt.dat ------------------ */
/begin COMPU_METHOD FORMULA_0418 "FORMULA_0418" TAB_VERB "%5.2" "-" COMPU_TAB_REF FORMULA_0418_VTAB /end COMPU_METHOD
/begin COMPU_VTAB FORMULA_0418_VTAB "FORMULA_0418_VTAB" TAB_VERB 2 0 "FALSE" 1 "TRUE" DEFAULT_VALUE "TRUE" /end COMPU_VTAB
/begin COMPU_METHOD FORMULA_0419 "FORMULA_0419" TAB_VERB "%5.2" "-" COMPU_TAB_REF FORMULA_0419_VTAB /end COMPU_METHOD
/begin COMPU_VTAB FORMULA_0419_VTAB "FORMULA_0419_VTAB" TAB_VERB 2 0 "FALSE" 1 "TRUE" DEFAULT_VALUE "TRUE" /end COMPU_VTAB
/begin COMPU_METHOD FORMULA_0420 "FORMULA_0420" TAB_VERB "%5.2" "-" COMPU_TAB_REF FORMULA_0420_VTAB /end COMPU_METHOD
/begin COMPU_VTAB FORMULA_0420_VTAB "FORMULA_0420_VTAB" TAB_VERB 2 0 "FALSE" 1 "TRUE" DEFAULT_VALUE "TRUE" /end COMPU_VTAB
/begin COMPU_METHOD FORMULA_0421 "FORMULA_0421" TAB_VERB "%5.2" "-" COMPU_TAB_REF FORMULA_0421_VTAB /end COMPU_METHOD
/begin COMPU_VTAB FORMULA_0421_VTAB "FORMULA_0421_VTAB" TAB_VERB 2 0 "FALSE" 1 "TRUE" DEFAULT_VALUE "TRUE" /end COMPU_VTAB
/begin COMPU_METHOD FORMULA_0422 "FORMULA_0422" TAB_VERB "%5.2" "-" COMPU_TAB_REF FORMULA_0422_VTAB /end COMPU_METHOD
/begin COMPU_VTAB FORMULA_0422_VTAB "FORMULA_0422_VTAB" TAB_VERB 2 0 "FALSE" 1 "TRUE" DEFAULT_VALUE "TRUE" /end COMPU_VTAB
/begin COMPU_METHOD FORMULA_0423 "FORMULA_0423" TAB_VERB "%5.2" "-" COMPU_TAB_REF FORMULA_0423_VTAB /end COMPU_METHOD
/begin COMPU_VTAB FORMULA_0423_VTAB "FORMULA_0423_VTAB" TAB_VERB 2 0 "FALSE" 1 "TRUE" DEFAULT_VALUE "TRUE" /end COMPU_VTAB
/begin COMPU_METHOD FORMULA_0424 "FORMULA_0424" TAB_VERB "%5.2" "-" COMPU_TAB_REF FORMULA_0424_VTAB /end COMPU_METHOD
/begin COMPU_VTAB FORMULA_0424_VTAB "FORMULA_0424_VTAB" TAB_VERB 2 0 "FALSE" 1 "TRUE" DEFAULT_VALUE "TRUE" /end COMPU_VTAB
/begin COMPU_METHOD FORMULA_0425 "FORMULA_0425" TAB_VERB "%5.2" "-" COMPU_TAB_REF FORMULA_0425_VTAB /end COMPU_METHOD
/begin COMPU_VTAB FORMULA_0425_VTAB "FORMULA_0425_VTAB" TAB_VERB 2 0 "FALSE" 1 "TRUE" DEFAULT_VALUE "TRUE" /end COMPU_VTAB
/begin COMPU_METHOD FORMULA_0426 "FORMULA_0426" RAT_FUNC "%5.0" "�C" COEFFS 0 10 0 0 0 1 /end COMPU_METHOD
/begin COMPU_METHOD FORMULA_0427 "FORMULA_0427" RAT_FUNC "%6.1" "V" COEFFS 0 1 0 0 0 0.0942 /end COMPU_METHOD
/begin COMPU_METHOD FORMULA_0433 "FORMULA_0433" RAT_FUNC "%7.2" "%" COEFFS 0 65536 0 0 0 100 /end COMPU_METHOD
/begin COMPU_METHOD FORMULA_0434 "FORMULA_0434" RAT_FUNC "%5.2" "-" COEFFS 0 256 0 0 0 1 /end COMPU_METHOD
/begin COMPU_METHOD FORMULA_0444 "FORMULA_0444" RAT_FUNC "%9.4" "-" COEFFS 0 32768 0 0 0 32 /end COMPU_METHOD
/begin COMPU_METHOD FORMULA_0447 "FORMULA_0447" RAT_FUNC "%5.2" "-" COEFFS 0 256 0 0 0 8 /end COMPU_METHOD
/begin COMPU_METHOD FORMULA_0455 "FORMULA_0455" RAT_FUNC "%5.2" "-" COEFFS 0 256 0 0 0 32 /end COMPU_METHOD
/begin COMPU_METHOD FORMULA_0457 "FORMULA_0457" RAT_FUNC "%9.4" "-" COEFFS 0 65536 0 0 0 1 /end COMPU_METHOD
/* ------------------ Abschnitt erzeugt aus dgen.dat ------------------ */
/begin COMPU_METHOD FORMULA_0458 "FORMULA_0458" RAT_FUNC "%4.1" "s" COEFFS 0 10 0 0 0 1 /end COMPU_METHOD
/* ------------------ Abschnitt erzeugt aus imdgen_1pr.dat ------------------ */
/begin COMPU_METHOD FORMULA_0459 "FORMULA_0459" RAT_FUNC "%6.3" "" COEFFS 0 1 0 0 0 1 /end COMPU_METHOD
/begin COMPU_METHOD FORMULA_0461 "FORMULA_0461" RAT_FUNC "%5.2" "-" COEFFS 0 256 0 0 0 4 /end COMPU_METHOD
/begin COMPU_METHOD FORMULA_0465 "FORMULA_0465" RAT_FUNC "%8.3" "A" COEFFS 0 1 0 0 0 1 /end COMPU_METHOD
/begin COMPU_METHOD FORMULA_0470 "FORMULA_0470" RAT_FUNC "%5.0" "km/h" COEFFS 0 1 0 0 0 1 /end COMPU_METHOD
/begin COMPU_METHOD FORMULA_0471 "FORMULA_0471" RAT_FUNC "%5.2" "%" COEFFS 0 256 0 0 0 100 /end COMPU_METHOD
/begin COMPU_METHOD FORMULA_0472 "FORMULA_0472" RAT_FUNC "%5.2" "min" COEFFS 0 1 0 0 0 1 /end COMPU_METHOD
/begin COMPU_METHOD FORMULA_0473 "FORMULA_0473" RAT_FUNC "%5.2" "-" COEFFS 0 256 0 0 0 2 /end COMPU_METHOD
/begin COMPU_METHOD FORMULA_0474 "FORMULA_0474" RAT_FUNC "%4.1" "-" COEFFS 0 1 0 0 0 1 /end COMPU_METHOD
/* ------------------ Abschnitt erzeugt aus loadresp.dat ------------------ */
/begin COMPU_METHOD FORMULA_0475 "FORMULA_0475" RAT_FUNC "%7.2" "-" COEFFS 0 32768 0 0 0 100 /end COMPU_METHOD
/* ------------------ Abschnitt erzeugt aus pgentred.dat ------------------ */
/begin COMPU_METHOD FORMULA_0478 "FORMULA_0478" RAT_FUNC "%7.2" "%" COEFFS 0 65536 0 0 0 256 /end COMPU_METHOD
/* ------------------ Abschnitt erzeugt aus bgcreng.dat ------------------ */
/begin COMPU_METHOD FORMULA_0480 "FORMULA_0480" RAT_FUNC "%7.2" "%" COEFFS 0 65536 0 0 0 512 /end COMPU_METHOD
/begin COMPU_METHOD FORMULA_0481 "FORMULA_0481" RAT_FUNC "%8.3" "A" COEFFS 0 65536 0 0 0 4096 /end COMPU_METHOD
/begin COMPU_METHOD FORMULA_0482 "FORMULA_0482" RAT_FUNC "%8.3" "A" COEFFS 0 1000 0 0 0 1 /end COMPU_METHOD
/* ------------------ Abschnitt erzeugt aus dibs.dat ------------------ */
/begin COMPU_METHOD FORMULA_0483 "FORMULA_0483" RAT_FUNC "%4.1" "-" COEFFS 0 1 0 0 0 1 /end COMPU_METHOD
/* ------------------ Abschnitt erzeugt aus lbattcal.dat ------------------ */
/begin COMPU_METHOD FORMULA_0484 "FORMULA_0484" RAT_FUNC "%8.3" "V" COEFFS 0 256 0 0 0 1 /end COMPU_METHOD
/begin COMPU_METHOD FORMULA_0485 "FORMULA_0485" RAT_FUNC "%8.3" "kg" COEFFS 0 2250 0 0 0 1 /end COMPU_METHOD
/* ------------------ Abschnitt erzeugt aus pmbnstab.dat ------------------ */
/begin COMPU_METHOD FORMULA_0486 "FORMULA_0486" RAT_FUNC "%7.4" "V" COEFFS 0 1 0 0 0 0.0942 /end COMPU_METHOD
/* ------------------ Abschnitt erzeugt aus pmdiag.dat ------------------ */
/begin COMPU_METHOD FORMULA_0487 "FORMULA_0487" RAT_FUNC "%7.2" "" COEFFS 0 103 0 0 0 30 /end COMPU_METHOD
/begin COMPU_METHOD FORMULA_0488 "FORMULA_0488" RAT_FUNC "%7.2" "s" COEFFS 0 1 0 0 0 56 /end COMPU_METHOD
/begin COMPU_METHOD FORMULA_0489 "FORMULA_0489" RAT_FUNC "%7.2" "min" COEFFS 0 15 0 0 0 14 /end COMPU_METHOD
/begin COMPU_METHOD FORMULA_0490 "FORMULA_0490" RAT_FUNC "%7.2" "s" COEFFS 0 1 0 0 0 14 /end COMPU_METHOD
/begin COMPU_METHOD FORMULA_0491 "FORMULA_0491" RAT_FUNC "%5.2" "A" COEFFS 0 1 0 0 0 10 /end COMPU_METHOD
/begin COMPU_METHOD FORMULA_0492 "FORMULA_0492" RAT_FUNC "%6.3" "" COEFFS 0 800 0 0 0 1 /end COMPU_METHOD
/begin COMPU_METHOD FORMULA_0493 "FORMULA_0493" RAT_FUNC "%5.2" "min" COEFFS 0 15 0 0 0 224 /end COMPU_METHOD
/begin COMPU_METHOD FORMULA_0494 "FORMULA_0494" RAT_FUNC "%8.3" "Ah" COEFFS 0 989 0 0 0 18 /end COMPU_METHOD
/begin COMPU_METHOD FORMULA_0495 "FORMULA_0495" RAT_FUNC "%7.2" "-" COEFFS 0 32768 0 0 0 50 /end COMPU_METHOD
/begin COMPU_METHOD FORMULA_0496 "FORMULA_0496" RAT_FUNC "%8.3" "" COEFFS 0 4000 0 0 0 1 /end COMPU_METHOD
/begin COMPU_METHOD FORMULA_0497 "FORMULA_0497" RAT_FUNC "%8.3" "" COEFFS 0 -4000 24000 0 0 -1 /end COMPU_METHOD
/begin COMPU_METHOD FORMULA_0498 "FORMULA_0498" RAT_FUNC "%5.2" "" COEFFS 0 25 0 0 0 128 /end COMPU_METHOD
/begin COMPU_METHOD FORMULA_0499 "FORMULA_0499" RAT_FUNC "%7.4" "min" COEFFS 0 15 0 0 0 14 /end COMPU_METHOD
/* ------------------ Abschnitt erzeugt aus pmprsvcalc.dat ------------------ */
/begin COMPU_METHOD FORMULA_0500 "FORMULA_0500" RAT_FUNC "%9.2" "" COEFFS 0 65536 0 0 0 512 /end COMPU_METHOD
/begin COMPU_METHOD FORMULA_0501 "FORMULA_0501" RAT_FUNC "%7.2" "" COEFFS 0 4 0 0 0 1 /end COMPU_METHOD
/begin COMPU_METHOD FORMULA_0502 "FORMULA_0502" RAT_FUNC "%9.4" "-" COEFFS 0 64 0 0 0 0.0942 /end COMPU_METHOD
/begin COMPU_METHOD FORMULA_0503 "FORMULA_0503" RAT_FUNC "%8.3" "" COEFFS 0 4 0 0 0 1 /end COMPU_METHOD
/begin COMPU_METHOD FORMULA_0504 "FORMULA_0504" RAT_FUNC "%8.3" "" COEFFS 0 25 5000 0 0 2 /end COMPU_METHOD
/begin COMPU_METHOD FORMULA_0505 "FORMULA_0505" RAT_FUNC "%8.3" "V" COEFFS 0 200 0 0 0 3 /end COMPU_METHOD
/begin COMPU_METHOD FORMULA_0506 "FORMULA_0506" RAT_FUNC "%5.2" "%" COEFFS 0 2 0 0 0 1 /end COMPU_METHOD
/* ------------------ Abschnitt erzeugt aus pmsoccalc.dat ------------------ */
/begin COMPU_METHOD FORMULA_0507 "FORMULA_0507" RAT_FUNC "%8.3" "A" COEFFS 0 50 0 0 0 1 /end COMPU_METHOD
/begin COMPU_METHOD FORMULA_0508 "FORMULA_0508" RAT_FUNC "%11.4" "Ah" COEFFS 0 3600000 0 0 0 1 /end COMPU_METHOD
/* ------------------ Abschnitt erzeugt aus pmsocfit.dat ------------------ */
/begin COMPU_METHOD FORMULA_0509 "FORMULA_0509" RAT_FUNC "%6.3" "" COEFFS 0 1000 0 0 0 1 /end COMPU_METHOD
/* ------------------ Abschnitt erzeugt aus pmsockor.dat ------------------ */
/begin COMPU_METHOD FORMULA_0510 "FORMULA_0510" RAT_FUNC "%6.1" "s" COEFFS 0 1 0 0 0 1 /end COMPU_METHOD
/* ------------------ Abschnitt erzeugt aus pmsocstart.dat ------------------ */
/begin COMPU_METHOD FORMULA_0511 "FORMULA_0511" RAT_FUNC "%8.3" "A" COEFFS 0 1 0 0 0 0.02 /end COMPU_METHOD
/begin COMPU_METHOD FORMULA_0512 "FORMULA_0512" RAT_FUNC "%6.3" "A" COEFFS 0 256 0 0 0 1000 /end COMPU_METHOD
/begin COMPU_METHOD FORMULA_0541 "FORMULA_0541" RAT_FUNC "%5.0" "%" COEFFS 0 1 0 0 0 1 /end COMPU_METHOD
/begin COMPU_METHOD FORMULA_0557 "FORMULA_0557" RAT_FUNC "%4.1" "l" COEFFS 0 2 0 0 0 1 /end COMPU_METHOD
/* ------------------ Abschnitt erzeugt aus cantel.dat ------------------ */
/begin COMPU_METHOD FORMULA_0609 "FORMULA_0609" RAT_FUNC "%7.2" "s" COEFFS 0 1000 0 0 0 5 /end COMPU_METHOD
/begin COMPU_METHOD FORMULA_0610 "FORMULA_0610" TAB_VERB "%5.2" "-" COMPU_TAB_REF FORMULA_0610_VTAB /end COMPU_METHOD
/begin COMPU_VTAB FORMULA_0610_VTAB "FORMULA_0610_VTAB" TAB_VERB 4 0 "Kl15 aus" 1 "Req Kl15" 2 "Kl15 ein" 3 "Ungueltig" /end COMPU_VTAB
/begin COMPU_METHOD FORMULA_0611 "FORMULA_0611" RAT_FUNC "%3.0" "Sufe" COEFFS 0 1 0 0 0 1 /end COMPU_METHOD
/begin COMPU_METHOD FORMULA_0612 "FORMULA_0612" TAB_VERB "%3.0" "-" COMPU_TAB_REF FORMULA_0612_VTAB /end COMPU_METHOD
/begin COMPU_VTAB FORMULA_0612_VTAB "FORMULA_0612_VTAB" TAB_VERB 7 0 "keine" 1 "ACC aktz." 2 "EMF aktz." 3 "HBA aktz." 4 "Verzoegerung" 14 "abgelehnt" 15 "ungueltig" DEFAULT_VALUE "undef" /end COMPU_VTAB
/begin COMPU_METHOD FORMULA_0613 "FORMULA_0613" RAT_FUNC "%4.1" "s" COEFFS 0 1 0 0 0 1 /end COMPU_METHOD
/begin COMPU_METHOD FORMULA_0614 "FORMULA_0614" TAB_VERB "%5.2" "-" COMPU_TAB_REF FORMULA_0614_VTAB /end COMPU_METHOD
/begin COMPU_VTAB FORMULA_0614_VTAB "FORMULA_0614_VTAB" TAB_VERB 2 0 "Aus" 1 "An" /end COMPU_VTAB
/begin COMPU_METHOD FORMULA_0615 "FORMULA_0615" TAB_VERB "%5.2" "-" COMPU_TAB_REF FORMULA_0615_VTAB /end COMPU_METHOD
/begin COMPU_VTAB FORMULA_0615_VTAB "FORMULA_0615_VTAB" TAB_VERB 2 0 "unlocked" 1 "locked" DEFAULT_VALUE "undef" /end COMPU_VTAB
/begin COMPU_METHOD FORMULA_0616 "FORMULA_0616" RAT_FUNC "%5.0" "km" COEFFS 0 1 0 0 0 1 /end COMPU_METHOD
/begin COMPU_METHOD FORMULA_0617 "FORMULA_0617" TAB_VERB "%5.2" "-" COMPU_TAB_REF FORMULA_0617_VTAB /end COMPU_METHOD
/begin COMPU_VTAB FORMULA_0617_VTAB "FORMULA_0617_VTAB" TAB_VERB 3 5 "EKP an" 10 "EKP aus" 15 "ungueltig" DEFAULT_VALUE "undef" /end COMPU_VTAB
/begin COMPU_METHOD FORMULA_0618 "FORMULA_0618" RAT_FUNC "%3.0" ".Klasse" COEFFS 0 1 0 0 0 1 /end COMPU_METHOD
/begin COMPU_METHOD FORMULA_0619 "FORMULA_0619" RAT_FUNC "%3.0" "mA" COEFFS 0 1 0 0 0 1 /end COMPU_METHOD
/begin COMPU_METHOD FORMULA_0620 "FORMULA_0620" RAT_FUNC "%3.0" "A" COEFFS 0 1 0 0 0 10 /end COMPU_METHOD
/begin COMPU_METHOD FORMULA_0621 "FORMULA_0621" TAB_VERB "%3.0" "-" COMPU_TAB_REF FORMULA_0621_VTAB /end COMPU_METHOD
/begin COMPU_VTAB FORMULA_0621_VTAB "FORMULA_0621_VTAB" TAB_VERB 5 0 "keine Angabe" 1 "Komfort" 2 "Sport" 5 "Komfort erw." 6 "Sport erw." DEFAULT_VALUE "undef" /end COMPU_VTAB
/begin COMPU_METHOD FORMULA_0622 "FORMULA_0622" TAB_VERB "%3.0" "-" COMPU_TAB_REF FORMULA_0622_VTAB /end COMPU_METHOD
/begin COMPU_VTAB FORMULA_0622_VTAB "FORMULA_0622_VTAB" TAB_VERB 2 0 "Ausschalten" 1 "Einschalten" DEFAULT_VALUE "undef" /end COMPU_VTAB
/begin COMPU_METHOD FORMULA_0623 "FORMULA_0623" RAT_FUNC "%6.1" "-" COEFFS 0 10 0 0 0 1 /end COMPU_METHOD
/begin COMPU_METHOD FORMULA_0624 "FORMULA_0624" TAB_VERB "%3.0" "-" COMPU_TAB_REF FORMULA_0624_VTAB /end COMPU_METHOD
/begin COMPU_VTAB FORMULA_0624_VTAB "FORMULA_0624_VTAB" TAB_VERB 4 0 "beide zu" 1 "FAT offen" 2 "BFAT offen" 3 "beide offen" DEFAULT_VALUE "undef" /end COMPU_VTAB
/begin COMPU_METHOD FORMULA_0625 "FORMULA_0625" TAB_VERB "%3.0" "-" COMPU_TAB_REF FORMULA_0625_VTAB /end COMPU_METHOD
/begin COMPU_VTAB FORMULA_0625_VTAB "FORMULA_0625_VTAB" TAB_VERB 2 0 "Aus" 1 "PTH/Mdrv" DEFAULT_VALUE "undef" /end COMPU_VTAB
/begin COMPU_METHOD FORMULA_0626 "FORMULA_0626" RAT_FUNC "%4.1" "%" COEFFS 0 10 0 0 0 1 /end COMPU_METHOD
/begin COMPU_METHOD FORMULA_0627 "FORMULA_0627" TAB_VERB "%5.2" "-" COMPU_TAB_REF FORMULA_0627_VTAB /end COMPU_METHOD
/begin COMPU_VTAB FORMULA_0627_VTAB "FORMULA_0627_VTAB" TAB_VERB 6 0 "Normal" 1 "MDrv aus" 2 "BAT-Komp aus" 4 "Obd ein" 8 "OelAG ein" 12 "Obd+OelAG" /end COMPU_VTAB
/begin COMPU_METHOD FORMULA_0628 "FORMULA_0628" TAB_VERB "%5.2" "-" COMPU_TAB_REF FORMULA_0628_VTAB /end COMPU_METHOD
/begin COMPU_VTAB FORMULA_0628_VTAB "FORMULA_0628_VTAB" TAB_VERB 2 0 "Aus" 1 "Ein" /end COMPU_VTAB
/begin COMPU_METHOD FORMULA_0629 "FORMULA_0629" TAB_VERB "%5.2" "-" COMPU_TAB_REF FORMULA_0629_VTAB /end COMPU_METHOD
/begin COMPU_VTAB FORMULA_0629_VTAB "FORMULA_0629_VTAB" TAB_VERB 2 0 "1=li" 1 "1=re" /end COMPU_VTAB
/begin COMPU_METHOD FORMULA_0630 "FORMULA_0630" TAB_VERB "%3.0" "-" COMPU_TAB_REF FORMULA_0630_VTAB /end COMPU_METHOD
/begin COMPU_VTAB FORMULA_0630_VTAB "FORMULA_0630_VTAB" TAB_VERB 3 5 "EKP an" 10 "EKP aus" 15 "ungueltig" /end COMPU_VTAB
/begin COMPU_METHOD FORMULA_0631 "FORMULA_0631" RAT_FUNC "%4.1" "�C" COEFFS 0 2 80 0 0 1 /end COMPU_METHOD
/begin COMPU_METHOD FORMULA_0651 "FORMULA_0651" RAT_FUNC "%6.3" "s" COEFFS 0 0 1.28 0 1 0 /end COMPU_METHOD
/begin COMPU_METHOD FORMULA_0664 "FORMULA_0664" RAT_FUNC "%5.2" "s" COEFFS 0 0 2.56 0 1 0 /end COMPU_METHOD
/begin COMPU_METHOD FORMULA_0683 "FORMULA_0683" RAT_FUNC "%5.2" "s" COEFFS 0 0 25.6 0 1 0 /end COMPU_METHOD
/* ------------------ Abschnitt erzeugt aus kva.dat ------------------ */
/begin COMPU_METHOD FORMULA_0746 "FORMULA_0746" RAT_FUNC "%6.1" "l/h" COEFFS 0 8 0 0 0 1 /end COMPU_METHOD
/begin COMPU_METHOD FORMULA_0840 "FORMULA_0840" RAT_FUNC "%6.1" "%" COEFFS 0 1024 0 0 0 100 /end COMPU_METHOD
/* ------------------ Abschnitt erzeugt aus pks.dat ------------------ */
/begin COMPU_METHOD FORMULA_1033 "FORMULA_1033" RAT_FUNC "%7.2" "s" COEFFS 0 10 0 0 0 1 /end COMPU_METHOD
/begin COMPU_METHOD FORMULA_1034 "FORMULA_1034" RAT_FUNC "%8.3" "-" COEFFS 0 1000 0 0 0 1 /end COMPU_METHOD
/begin COMPU_METHOD FORMULA_1035 "FORMULA_1035" TAB_VERB "%5.2" "-" COMPU_TAB_REF FORMULA_1035_VTAB /end COMPU_METHOD
/begin COMPU_VTAB FORMULA_1035_VTAB "FORMULA_1035_VTAB" TAB_VERB 2 0 "IO" 1 "100%" DEFAULT_VALUE "ungueltig" /end COMPU_VTAB
/begin COMPU_METHOD FORMULA_1036 "FORMULA_1036" TAB_VERB "%5.2" "-" COMPU_TAB_REF FORMULA_1036_VTAB /end COMPU_METHOD
/begin COMPU_VTAB FORMULA_1036_VTAB "FORMULA_1036_VTAB" TAB_VERB 4 0 "noDIAG" 1 "LL-100Proz" 2 "TL" 4 "Q-Max" DEFAULT_VALUE "ungueltig" /end COMPU_VTAB
/begin COMPU_METHOD FORMULA_1037 "FORMULA_1037" TAB_VERB "%5.2" "-" COMPU_TAB_REF FORMULA_1037_VTAB /end COMPU_METHOD
/begin COMPU_VTAB FORMULA_1037_VTAB "FORMULA_1037_VTAB" TAB_VERB 2 0 "Disabled" 1 "Enabled" /end COMPU_VTAB
/begin COMPU_METHOD FORMULA_1038 "FORMULA_1038" RAT_FUNC "%8.3" "bar/V" COEFFS 0 5000 0 0 0 1 /end COMPU_METHOD
/begin COMPU_METHOD FORMULA_1039 "FORMULA_1039" RAT_FUNC "%8.3" "-/10ms" COEFFS 0 1000 0 0 0 1 /end COMPU_METHOD
/begin COMPU_METHOD FORMULA_1040 "FORMULA_1040" RAT_FUNC "%7.2" "s" COEFFS 0 0 655.35 0 1 0 /end COMPU_METHOD
/* ------------------ Abschnitt erzeugt aus psau.dat ------------------ */
/begin COMPU_METHOD FORMULA_1054 "FORMULA_1054" RAT_FUNC "%6.1" "mbar/V" COEFFS 0 80 0 0 0 1 /end COMPU_METHOD
/begin COMPU_METHOD FORMULA_1055 "FORMULA_1055" TAB_VERB "%5.2" "-" COMPU_TAB_REF FORMULA_1055_VTAB /end COMPU_METHOD
/begin COMPU_VTAB FORMULA_1055_VTAB "FORMULA_1055_VTAB" TAB_VERB 2 0 "absolut" 1 "differenz" DEFAULT_VALUE "ungueltig" /end COMPU_VTAB
/* ------------------ Abschnitt erzeugt aus bgcreng.dat ------------------ */
/begin CHARACTERISTIC K_IABGLMOT "Konstante Abgleichstrom Motor" VALUE 0x7041E TKW_VV_VV_SW 100.0 FORMULA_0482 -32.7680 32.7670 FORMAT "%6.3" /end CHARACTERISTIC
/begin CHARACTERISTIC K_IABGLNL "Konstante Abgleichstrom Kl. 15" VALUE 0x70420 TKW_VV_VV_SW 100.0 FORMULA_0482 -32.7680 32.7670 FORMAT "%6.3" /end CHARACTERISTIC
/begin CHARACTERISTIC K_IABGLST "Konstante Abgleichstrom Start" VALUE 0x70422 TKW_VV_VV_SW 100.0 FORMULA_0482 -32.7680 32.7670 FORMAT "%6.3" /end CHARACTERISTIC
/begin CHARACTERISTIC K_IKEINESA "Konstante Strom wenn keine SA" VALUE 0x70424 TKW_VV_VV_SW 100.0 FORMULA_0482 -32.7680 32.7670 FORMAT "%6.3" /end CHARACTERISTIC
/begin CHARACTERISTIC K_CRENGOF "" VALUE 0x70426 TKW_VV_VV_UW 100.0 FORMULA_0481 0.0 4095.9375 FORMAT "%6.3" /end CHARACTERISTIC
/begin CHARACTERISTIC K_CRVVTNOT "Wert vvt_iges bei vvt_es Fehlersignal" VALUE 0x70428 TKW_VV_VV_UW 100.0 FORMULA_0481 0.0 4095.9375 FORMAT "%6.3" /end CHARACTERISTIC
/begin CHARACTERISTIC K_CRVVTOF "" VALUE 0x7042A TKW_VV_VV_UW 100.0 FORMULA_0481 0.0 4095.9375 FORMAT "%6.3" /end CHARACTERISTIC
/begin CHARACTERISTIC KL_ELTEMP39 "Temperaturfaktor El�fter" CURVE 0x7042C TKL_SW_VV_UW 100.0 FORMULA_0480 0.0 511.9921 /begin AXIS_DESCR STD_AXIS Tans FORMULA_0426 6 -3276.8000 3276.7000 /end AXIS_DESCR FORMAT "%5.2" /end CHARACTERISTIC
/begin CHARACTERISTIC KL_ELUB60 "" CURVE 0x70446 TKL_UW_VV_UW 100.0 FORMULA_0480 0.0 511.9921 /begin AXIS_DESCR STD_AXIS Ub FORMULA_0427 5 0.0 6173.3970 FORMAT "%4.1" /end AXIS_DESCR FORMAT "%5.2" /end CHARACTERISTIC
/begin CHARACTERISTIC KL_IABGLST "Abgleichstrom Start" CURVE 0x7045C TKL_UW_VV_UB 100.0 FORMULA_0447 0.0 7.9687 /begin AXIS_DESCR STD_AXIS Ub FORMULA_0427 5 0.0 6173.3970 FORMAT "%4.1" /end AXIS_DESCR /end CHARACTERISTIC
/begin CHARACTERISTIC KL_IABGLMOT "Abgleichstrom Motor" CURVE 0x7046E TKL_UW_VV_UB 100.0 FORMULA_0447 0.0 7.9687 /begin AXIS_DESCR STD_AXIS Ub FORMULA_0427 5 0.0 6173.3970 FORMAT "%4.1" /end AXIS_DESCR /end CHARACTERISTIC
/begin CHARACTERISTIC KL_ELUB39 "" CURVE 0x70480 TKL_UW_VV_UW 100.0 FORMULA_0480 0.0 511.9921 /begin AXIS_DESCR STD_AXIS Ub FORMULA_0427 5 0.0 6173.3970 FORMAT "%4.1" /end AXIS_DESCR FORMAT "%5.2" /end CHARACTERISTIC
/begin CHARACTERISTIC KL_ELTEMP60 "Temperaturfaktor El�fter" CURVE 0x70496 TKL_SW_VV_UW 100.0 FORMULA_0480 0.0 511.9921 /begin AXIS_DESCR STD_AXIS Tans FORMULA_0426 6 -3276.8000 3276.7000 /end AXIS_DESCR FORMAT "%5.2" /end CHARACTERISTIC
/begin CHARACTERISTIC KL_ELSLS "Kennlinie E-L�fter Strom" CURVE 0x704B0 TKL_UW_VV_UW 100.0 FORMULA_0481 0.0 255.0000 /begin AXIS_DESCR STD_AXIS Ub FORMULA_0427 3 0.0 6173.3970 FORMAT "%4.1" /end AXIS_DESCR FORMAT "%6.3" /end CHARACTERISTIC
/begin CHARACTERISTIC KL_IABGLNL "Abgleichstrom Kl. 15" CURVE 0x704BE TKL_UW_VV_UB 100.0 FORMULA_0447 0.0 7.9687 /begin AXIS_DESCR STD_AXIS Ub FORMULA_0427 5 0.0 6173.3970 FORMAT "%4.1" /end AXIS_DESCR /end CHARACTERISTIC
/begin CHARACTERISTIC KF_ELUPWM60 "Strom E-L�fter �ber pwm und ub" MAP 0x704D0 TKF_UW_UB_UW 100.0 FORMULA_0481 0.0 64.0000 /begin AXIS_DESCR STD_AXIS L_pwmout FORMULA_0471 8 0.0 99.6093 /end AXIS_DESCR /begin AXIS_DESCR STD_AXIS V FORMULA_0470 8 0.0 360.0000 /end AXIS_DESCR FORMAT "%6.3" /end CHARACTERISTIC
/begin CHARACTERISTIC KF_ELUPWM39 "Strom E-L�fter �ber pwm und ub" MAP 0x7056A TKF_UW_UB_UW 100.0 FORMULA_0481 0.0 64.0000 /begin AXIS_DESCR STD_AXIS L_pwmout FORMULA_0471 8 0.0 99.6093 /end AXIS_DESCR /begin AXIS_DESCR STD_AXIS V FORMULA_0470 8 0.0 360.0000 /end AXIS_DESCR FORMAT "%6.3" /end CHARACTERISTIC
/begin MEASUREMENT I_craweng "Strombedarf Motor" SWORD FORMULA_0465 0 0 -10.0000 254.0000 ECU_ADDRESS 0x3FBDA4 /end MEASUREMENT
/begin MEASUREMENT Fak_ttansel "Ansaugluftfaktor E-L�fterstrom" UWORD FORMULA_0480 0 0 0.0 511.9921 ECU_ADDRESS 0x3FAA80 /end MEASUREMENT
/begin MEASUREMENT Fak_tubel "Faktor L�fterstrom aus Geschwindigkeit" UWORD FORMULA_0480 0 0 0.0 511.9921 ECU_ADDRESS 0x3FAA82 /end MEASUREMENT
/begin MEASUREMENT I_elu_vvt "Strom E-L�fter und VVT-System" UWORD FORMULA_0481 0 0 0.0 4095.9375 ECU_ADDRESS 0x3FAA84 /end MEASUREMENT
/begin MEASUREMENT I_eluefter "E-L�fter Stromaufnahme" UWORD FORMULA_0481 0 0 0.0 4095.9375 ECU_ADDRESS 0x3FAA86 /end MEASUREMENT
/begin MEASUREMENT I_elupwm "L�fterstrom ohne Temperatur- und Geschwindigkeitseinfluss" UWORD FORMULA_0481 0 0 0.0 64.0000 ECU_ADDRESS 0x3FAA88 /end MEASUREMENT
/begin MEASUREMENT I_eluvfzg "L�fterstrom ohne Geschwindigkeitseinfluss" UWORD FORMULA_0481 0 0 0.0 128.0000 ECU_ADDRESS 0x3FAA8A /end MEASUREMENT
/begin MEASUREMENT I_gle "Gl�hstrom" UWORD FORMULA_0481 0 0 0.0 4095.9375 ECU_ADDRESS 0x3FAA8C /end MEASUREMENT
/begin MEASUREMENT I_sls "berechnete Groesse Strombedarf Sekund�rluftpumpe" UWORD FORMULA_0481 0 0 0.0 255.0000 ECU_ADDRESS 0x3FAA8E /end MEASUREMENT
/begin MEASUREMENT Vvt_ib1_2 "Gesamtstrom VVT Bank1 bzw 4Zyl. und Bank2" UWORD FORMULA_0481 0 0 0.0 4095.9375 ECU_ADDRESS 0x3FAA90 /end MEASUREMENT
/begin MEASUREMENT Vvt_iges "Strombedarf des gesamten VVT-Systems" UWORD FORMULA_0481 0 0 0.0 192.0000 ECU_ADDRESS 0x3FAA92 /end MEASUREMENT
/* ------------------ Abschnitt erzeugt aus bgllgen_1pr.dat ------------------ */
/begin CHARACTERISTIC K_DFRUTYP "DF-R�ckschaltungstyp f�r LLR-Anhebung" VALUE 0x70604 TKW_VV_VV_UB 100.0 FORMULA_0003 0.0 255.0000 /end CHARACTERISTIC
/begin CHARACTERISTIC K_IGENLLRANH "Generatorstromabstand f�r LL-Anhebung" VALUE 0x70605 TKW_VV_VV_UB 100.0 FORMULA_0459 0.0 254.0000 /end CHARACTERISTIC
/begin CHARACTERISTIC K_LLRABS_DF "DF-Schwelle f�r LL-Absenkung" VALUE 0x70606 TKW_VV_VV_UB 100.0 FORMULA_0471 0.0 99.6093 /end CHARACTERISTIC
/begin CHARACTERISTIC K_LLRANH_DF "DF-Schwelle f�r LL-Anhebung" VALUE 0x70607 TKW_VV_VV_UB 100.0 FORMULA_0471 0.0 99.6093 /end CHARACTERISTIC
/begin CHARACTERISTIC K_NTWBGLLGEN "Notlaufwert Leerlaufanhebung bei Generatorfehler" VALUE 0x70608 TKW_VV_VV_UB 100.0 FORMULA_0003 0.0 1.0000 /end CHARACTERISTIC
/begin CHARACTERISTIC K_PRELLDFAH "Prellzeit f�r LLR-Anhebung" VALUE 0x70609 TKW_VV_VV_UB 100.0 FORMULA_0458 0.0 25.5000 /end CHARACTERISTIC
/begin CHARACTERISTIC K_PRELLDFRF "Prellzeit f�r LLR-Absenkung" VALUE 0x7060A TKW_VV_VV_UB 100.0 FORMULA_0458 0.0 25.5000 /end CHARACTERISTIC
/begin CHARACTERISTIC KF_DFIGEN2 "inv. Generator-DF-Ausgang" MAP 0x7060B TKF_UB_UB_UB 100.0 FORMULA_0471 0.0 99.6093 /begin AXIS_DESCR STD_AXIS NO_INPUT_QUANTITY FORMULA_0459 8 0.0 255.0000 /end AXIS_DESCR /begin AXIS_DESCR STD_AXIS I_genrllrah FORMULA_0459 8 0.0 255.0000 /end AXIS_DESCR /end CHARACTERISTIC
/begin CHARACTERISTIC KF_DFIGEN1 "inv. Generator-DF-Ausgang" MAP 0x7065D TKF_UB_UB_UB 100.0 FORMULA_0471 0.0 99.6093 /begin AXIS_DESCR STD_AXIS NO_INPUT_QUANTITY FORMULA_0459 8 0.0 255.0000 /end AXIS_DESCR /begin AXIS_DESCR STD_AXIS I_genrllrah FORMULA_0459 8 0.0 255.0000 /end AXIS_DESCR /end CHARACTERISTIC
/begin CHARACTERISTIC KF_DFIGEN4 "inv. Generator-DF-Ausgang" MAP 0x706AF TKF_UB_UB_UB 100.0 FORMULA_0471 0.0 99.6093 /begin AXIS_DESCR STD_AXIS NO_INPUT_QUANTITY FORMULA_0459 8 0.0 255.0000 /end AXIS_DESCR /begin AXIS_DESCR STD_AXIS I_genrllrah FORMULA_0459 8 0.0 255.0000 /end AXIS_DESCR /end CHARACTERISTIC
/begin CHARACTERISTIC KF_DFIGEN3 "inv. Generator-DF-Ausgang" MAP 0x70701 TKF_UB_UB_UB 100.0 FORMULA_0471 0.0 99.6093 /begin AXIS_DESCR STD_AXIS NO_INPUT_QUANTITY FORMULA_0459 8 0.0 255.0000 /end AXIS_DESCR /begin AXIS_DESCR STD_AXIS I_genrllrah FORMULA_0459 8 0.0 255.0000 /end AXIS_DESCR /end CHARACTERISTIC
/begin MEASUREMENT St_bgllgen0.B_hysllrah "" UBYTE FORMULA_0418 0 0 0.0 255.0 ECU_ADDRESS 0x3FBDA6 BIT_MASK 0x1 /end MEASUREMENT
/begin MEASUREMENT St_bgllgen0 "Statuswort" UBYTE FORMULA_0003 0 0 0.0 255.0000 ECU_ADDRESS 0x3FBDA6 /end MEASUREMENT
/begin MEASUREMENT N_idlgspec "Anforderung LL-Anhebung" UBYTE FORMULA_0003 0 0 0.0 255.0000 ECU_ADDRESS 0x3FBDA7 /end MEASUREMENT
/begin MEASUREMENT N_gsllm "" SWORD FORMULA_0006 0 0 0.0 32767.0000 ECU_ADDRESS 0x3FAA94 /end MEASUREMENT
/begin MEASUREMENT Gen_dfvorhs "DF-Signal Vorhersage" UBYTE FORMULA_0471 0 0 0.0 99.6093 ECU_ADDRESS 0x3FAA96 /end MEASUREMENT
/begin MEASUREMENT I_genrllrah "" UBYTE FORMULA_0459 0 0 0.0 255.0000 ECU_ADDRESS 0x3FAA97 /end MEASUREMENT
/* ------------------ Abschnitt erzeugt aus dibs.dat ------------------ */
/begin CHARACTERISTIC S_BSDKOORD "" VALUE 0x707A1 TKW_VV_VV_UB 100.0 FORMULA_0474 0.0 1.0000 /end CHARACTERISTIC
/begin CHARACTERISTIC K_MSKIBSDFP "Bitmaske Generator Fehler-> DFP" VALUE 0x707A2 TKW_VV_VV_UB 100.0 FORMULA_0003 0.0 255.0000 /end CHARACTERISTIC
/begin CHARACTERISTIC K_MSKIBSDFP2 "" VALUE 0x707A3 TKW_VV_VV_UB 100.0 FORMULA_0003 0.0 255.0000 /end CHARACTERISTIC
/begin CHARACTERISTIC K_MSKIBSDIAG "Test AK disable Diagnose | EN: Test AK disable Diagnose" VALUE 0x707A4 TKW_VV_VV_UB 100.0 FORMULA_0003 0.0 255.0000 /end CHARACTERISTIC
/begin CHARACTERISTIC K_MSKIBSERR "" VALUE 0x707A5 TKW_VV_VV_UB 100.0 FORMULA_0483 0.0 255.0000 /end CHARACTERISTIC
/begin CHARACTERISTIC K_MSKIBSERR2 "" VALUE 0x707A6 TKW_VV_VV_UB 100.0 FORMULA_0483 0.0 255.0000 /end CHARACTERISTIC
/begin MEASUREMENT St_dibs1.B_ifbsak "BSD Kommunikation zum IBS gestoert" UBYTE FORMULA_0420 0 0 0.0 255.0 ECU_ADDRESS 0x3FBEF4 BIT_MASK 0x4 /end MEASUREMENT
/begin MEASUREMENT St_dibs1.B_ifebsak "Fehler erweiterte BSD Kommunikation zum IBS" UBYTE FORMULA_0421 0 0 0.0 255.0 ECU_ADDRESS 0x3FBEF4 BIT_MASK 0x8 /end MEASUREMENT
/begin MEASUREMENT St_dibs1.B_ifuplak "Fehler IBS Version unplausibel" UBYTE FORMULA_0422 0 0 0.0 255.0 ECU_ADDRESS 0x3FBEF4 BIT_MASK 0x10 /end MEASUREMENT
/begin MEASUREMENT St_dibs1 "Statuswort" UBYTE FORMULA_0003 0 0 0.0 255.0000 ECU_ADDRESS 0x3FBEF4 /end MEASUREMENT
/begin MEASUREMENT St_dibs2.B_ifisak "IBS Stromfehler" UBYTE FORMULA_0418 0 0 0.0 255.0 ECU_ADDRESS 0x3FBEF5 BIT_MASK 0x1 /end MEASUREMENT
/begin MEASUREMENT St_dibs2.B_ifusak "IBS Spannungsfehler" UBYTE FORMULA_0419 0 0 0.0 255.0 ECU_ADDRESS 0x3FBEF5 BIT_MASK 0x2 /end MEASUREMENT
/begin MEASUREMENT St_dibs2.B_iftempak "IBS Temperaturfehler" UBYTE FORMULA_0420 0 0 0.0 255.0 ECU_ADDRESS 0x3FBEF5 BIT_MASK 0x4 /end MEASUREMENT
/begin MEASUREMENT St_dibs2.B_ifwugdak "IBS KL15 Masseschluss" UBYTE FORMULA_0421 0 0 0.0 255.0 ECU_ADDRESS 0x3FBEF5 BIT_MASK 0x8 /end MEASUREMENT
/begin MEASUREMENT St_dibs2.B_ifwuplak "" UBYTE FORMULA_0422 0 0 0.0 255.0 ECU_ADDRESS 0x3FBEF5 BIT_MASK 0x10 /end MEASUREMENT
/begin MEASUREMENT St_dibs2.B_ifsysak "" UBYTE FORMULA_0423 0 0 0.0 255.0 ECU_ADDRESS 0x3FBEF5 BIT_MASK 0x20 /end MEASUREMENT
/begin MEASUREMENT St_dibs2 "Statuswort" UBYTE FORMULA_0003 0 0 0.0 255.0000 ECU_ADDRESS 0x3FBEF5 /end MEASUREMENT
/begin MEASUREMENT St_dibs0.B_dibloc1 "Signal nv lave loc zur Flankenerkennung" UBYTE FORMULA_0418 0 0 0.0 255.0 ECU_ADDRESS 0x3F9858 BIT_MASK 0x1 /end MEASUREMENT
/begin MEASUREMENT St_dibs0.B_dibloc2 "Signal nv lave loc zur Flankenerkennung" UBYTE FORMULA_0419 0 0 0.0 255.0 ECU_ADDRESS 0x3F9858 BIT_MASK 0x2 /end MEASUREMENT
/begin MEASUREMENT St_dibs0 "Statuswort" UBYTE FORMULA_0003 0 0 0.0 255.0000 ECU_ADDRESS 0x3F9858 /end MEASUREMENT
/begin MEASUREMENT Ibs1_errstat "" UWORD FORMULA_0010 0 0 0.0 65535.0000 ECU_ADDRESS 0x3FBEF6 /end MEASUREMENT
/begin MEASUREMENT Ibs2_errstat "" UWORD FORMULA_0010 0 0 0.0 65535.0000 ECU_ADDRESS 0x3FBEF8 /end MEASUREMENT
/begin MEASUREMENT Ibs3_errstat "" UWORD FORMULA_0010 0 0 0.0 65535.0000 ECU_ADDRESS 0x3FBEFA /end MEASUREMENT
/begin MEASUREMENT T_count_dibs1 "" UBYTE FORMULA_0459 0 0 0.0 255.0000 ECU_ADDRESS 0x3FBEFC /end MEASUREMENT
/begin MEASUREMENT T_count_dibs2 "" UBYTE FORMULA_0459 0 0 0.0 255.0000 ECU_ADDRESS 0x3FBEFD /end MEASUREMENT
/begin MEASUREMENT T_count_dibs3 "" UBYTE FORMULA_0483 0 0 0.0 255.0000 ECU_ADDRESS 0x3FBEFE /end MEASUREMENT
/begin MEASUREMENT T_count_dibs4 "" UBYTE FORMULA_0483 0 0 0.0 255.0000 ECU_ADDRESS 0x3FBEFF /end MEASUREMENT
/begin MEASUREMENT Ibsderrs2 "Fehlerz�hler IBS EBSD Kommunikation" UWORD FORMULA_0010 0 0 0.0 65535.0000 ECU_ADDRESS 0x3F985A /end MEASUREMENT
/begin MEASUREMENT Ibsderrs1 "Fehlerz�hler IBS BSD Kommunikation" UBYTE FORMULA_0003 0 0 0.0 255.0000 ECU_ADDRESS 0x3F985C /end MEASUREMENT
/begin MEASUREMENT Ibspreco2 "Vorteiler /10 fuer Ibsderrs2" UBYTE FORMULA_0003 0 0 0.0 255.0000 ECU_ADDRESS 0x3F985D /end MEASUREMENT
/* ------------------ Abschnitt erzeugt aus lbattcal.dat ------------------ */
/begin CHARACTERISTIC K_LBATTMAXK "maximale Batterieladespannung Kofferraum" VALUE 0x7435E TKW_VV_VV_SW 100.0 FORMULA_0484 0.0 127.9960 FORMAT "%6.3" /end CHARACTERISTIC
/begin CHARACTERISTIC K_LBATTMAXM "maximale Batterieladespannung | EN: maximale Batterieladespannung" VALUE 0x74360 TKW_VV_VV_SW 100.0 FORMULA_0484 0.0 127.9960 FORMAT "%6.3" /end CHARACTERISTIC
/begin CHARACTERISTIC K_LBATTMIN "minmale Batterieladespannung Licht an" VALUE 0x74362 TKW_VV_VV_SW 100.0 FORMULA_0484 0.0 127.9960 FORMAT "%6.3" /end CHARACTERISTIC
/begin CHARACTERISTIC K_LBATTTUMG "" VALUE 0x74364 TKW_VV_VV_SW 100.0 FORMULA_0426 -3276.8000 3276.7000 /end CHARACTERISTIC
/begin CHARACTERISTIC K_LBATTTUMGBA "" VALUE 0x74366 TKW_VV_VV_SW 100.0 FORMULA_0426 -3276.8000 3276.7000 /end CHARACTERISTIC
/begin CHARACTERISTIC K_UKOMPK "Applikationswert Kompensationsspannung Kafferraum" VALUE 0x74368 TKW_VV_VV_SW 100.0 FORMULA_0484 0.0 127.9960 FORMAT "%6.3" /end CHARACTERISTIC
/begin CHARACTERISTIC K_UKOMPM "Applikationswert Kompensationsspannung Motorraum" VALUE 0x7436A TKW_VV_VV_SW 100.0 FORMULA_0484 0.0 127.9960 FORMAT "%6.3" /end CHARACTERISTIC
/begin CHARACTERISTIC K_RLEITUNGK "Widerstand Ladeleitung Batterie Kofferraum" VALUE 0x7436C TKW_VV_VV_UB 100.0 FORMULA_0455 0.0 31.8750 /end CHARACTERISTIC
/begin CHARACTERISTIC K_RLEITUNGM "Widerstand Ladeleitung Batterie Motorraum" VALUE 0x7436D TKW_VV_VV_UB 100.0 FORMULA_0455 0.0 31.8750 /end CHARACTERISTIC
/begin CHARACTERISTIC K_TIMERDLY "Verzoegerungszeit f�r Startwertberechnung" VALUE 0x7436E TKW_VV_VV_UB 100.0 FORMULA_0003 0.0 255.0000 /end CHARACTERISTIC
/begin CHARACTERISTIC S_LBATT1 "Applikationsschalter1 Auswahl Ersatztemperatur" VALUE 0x7436F TKW_VV_VV_UB 100.0 FORMULA_0474 0.0 1.0000 /end CHARACTERISTIC
/begin CHARACTERISTIC S_LBATT2 "Applikationsschalter2 Auswahl Ersatztemperatur" VALUE 0x74370 TKW_VV_VV_UB 100.0 FORMULA_0474 0.0 1.0000 /end CHARACTERISTIC
/begin CHARACTERISTIC K_DTANSKOR "Ansaugluftmodelloffset Aussentemperatur" VALUE 0x74372 TKW_VV_VV_SW 100.0 FORMULA_0426 -3276.8000 3276.7000 /end CHARACTERISTIC
/begin CHARACTERISTIC K_NMINUMG "Drehzahlschwelle Aussentemperaturmodell" VALUE 0x74374 TKW_VV_VV_SW 100.0 FORMULA_0006 0.0 32767.0000 /end CHARACTERISTIC
/begin CHARACTERISTIC K_OFTUMGCAN "Offset Umgebungstemperatur CAN" VALUE 0x74376 TKW_VV_VV_SW 100.0 FORMULA_0426 -3276.8000 3276.7000 /end CHARACTERISTIC
/begin CHARACTERISTIC K_OFULADE "Offset Ladekennlinie Batthinten" VALUE 0x74378 TKW_VV_VV_SW 100.0 FORMULA_0484 -128.0000 127.9960 FORMAT "%6.3" /end CHARACTERISTIC
/begin CHARACTERISTIC K_PLBATTUMG "Plausibilisierung-Schwelle Batterieumgebungstemperatur" VALUE 0x7437A TKW_VV_VV_SW 100.0 FORMULA_0426 0.0 3276.7000 /end CHARACTERISTIC
/begin CHARACTERISTIC K_TBATINIMAN "Applikation INITWERT Batterietemperatur" VALUE 0x7437C TKW_VV_VV_SW 100.0 FORMULA_0426 0.0 3276.7000 /end CHARACTERISTIC
/begin CHARACTERISTIC K_TUMGINI "Initialisierungswert Aussentemperaturmodell" VALUE 0x7437E TKW_VV_VV_SW 100.0 FORMULA_0426 -3276.8000 3276.7000 /end CHARACTERISTIC
/begin CHARACTERISTIC K_UBATTNORM "Batterienormspannung" VALUE 0x74380 TKW_VV_VV_SW 100.0 FORMULA_0484 -128.0000 127.9960 FORMAT "%6.3" /end CHARACTERISTIC
/begin CHARACTERISTIC K_BATTHTAUVG "Zeitkonstante Batterie hinten bei VFZG>" VALUE 0x74382 TKW_VV_VV_UW 100.0 FORMULA_0457 0.0 9.99984741210938e-1 FORMAT "%7.4" /end CHARACTERISTIC
/begin CHARACTERISTIC K_BATTHTAUVK "Zeitkonstante Batterie hinten bei VFZG<" VALUE 0x74384 TKW_VV_VV_UW 100.0 FORMULA_0457 0.0 9.99984741210938e-1 FORMAT "%7.4" /end CHARACTERISTIC
/begin CHARACTERISTIC K_BATTVTAUVG "Zeitkonstante Batterie vorne bei VFZG>" VALUE 0x74386 TKW_VV_VV_UW 100.0 FORMULA_0457 0.0 9.99984741210938e-1 FORMAT "%7.4" /end CHARACTERISTIC
/begin CHARACTERISTIC K_BATTVTAUVK "Zeitkonstante Batterie bei VFZG<Zeitkonstante Batterie bei VFZG>" VALUE 0x74388 TKW_VV_VV_UW 100.0 FORMULA_0457 0.0 9.99984741210938e-1 FORMAT "%7.4" /end CHARACTERISTIC
/begin CHARACTERISTIC K_BATT_ALFAH "Alphatau-Wert Batterie hinten" VALUE 0x7438A TKW_VV_VV_UW 100.0 FORMULA_0457 1.52587890625e-5 9.99984741210938e-1 FORMAT "%7.4" /end CHARACTERISTIC
/begin CHARACTERISTIC K_BATT_ALFAV "Alphatau-Wert Batterie vorne" VALUE 0x7438C TKW_VV_VV_UW 100.0 FORMULA_0457 1.52587890625e-5 9.99984741210938e-1 FORMAT "%7.4" /end CHARACTERISTIC
/begin CHARACTERISTIC K_BATT_BETAV "Beta-Wert Batterie vorne" VALUE 0x7438E TKW_VV_VV_UW 100.0 FORMULA_0457 1.52587890625e-5 9.99984741210938e-1 FORMAT "%7.4" /end CHARACTERISTIC
/begin CHARACTERISTIC K_BATVFZGTAU "VFZG-Umschaltschwelle TAU Batterie" VALUE 0x74390 TKW_VV_VV_UW 100.0 FORMULA_0470 0.0 65535.0000 /end CHARACTERISTIC
/begin CHARACTERISTIC K_ILMINUMG "integrierte Lufmassenschwelle Aussentemperaturmodell" VALUE 0x74392 TKW_VV_VV_UW 100.0 FORMULA_0485 0.0 29.1266 FORMAT "%6.3" /end CHARACTERISTIC
/begin CHARACTERISTIC K_TBATTFTAUV "Zeitkonstante 5*Tau Batterievorne" VALUE 0x74394 TKW_VV_VV_UW 100.0 FORMULA_0010 0.0 65535.0000 /end CHARACTERISTIC
/begin CHARACTERISTIC K_TBATTTAUFH "Zeitkonstante Batterie 5*Tau hinten" VALUE 0x74396 TKW_VV_VV_UW 100.0 FORMULA_0010 0.0 65535.0000 /end CHARACTERISTIC
/begin CHARACTERISTIC K_TUMGTAU "Zeitkonstante 5*Tau Aussentemperatur" VALUE 0x74398 TKW_VV_VV_UW 100.0 FORMULA_0010 0.0 65535.0000 /end CHARACTERISTIC
/begin CHARACTERISTIC K_ULADE_TAU "Batterieladespannungs Zeitkonstante" VALUE 0x7439A TKW_VV_VV_UW 100.0 FORMULA_0457 0.0 9.99984741210938e-1 FORMAT "%7.4" /end CHARACTERISTIC
/begin CHARACTERISTIC K_VMINUMG "Fahrzeuggeschwindigkeitsschwelle Aussentemperaturmodell" VALUE 0x7439C TKW_VV_VV_UW 100.0 FORMULA_0470 0.0 65535.0000 /end CHARACTERISTIC
/begin CHARACTERISTIC CW_BATTCOD "Enable Handcodierung" VALUE 0x7439E TKW_VV_VV_UB 100.0 FORMULA_0003 0.0 2.0000 /end CHARACTERISTIC
/begin CHARACTERISTIC K_APPTBATINI "Enable Applikation Initwert Batterietemperatur" VALUE 0x7439F TKW_VV_VV_UB 100.0 FORMULA_0003 0.0 255.0000 /end CHARACTERISTIC
/begin CHARACTERISTIC K_BATTORT0 "Batterieeinbauort No1" VALUE 0x743A0 TKW_VV_VV_UB 100.0 FORMULA_0003 0.0 2.0000 /end CHARACTERISTIC
/begin CHARACTERISTIC K_BATTORT2 "Batterieeinbauort No2" VALUE 0x743A1 TKW_VV_VV_UB 100.0 FORMULA_0003 0.0 2.0000 /end CHARACTERISTIC
/begin CHARACTERISTIC K_MCOBATTORT "Codierung Hand Batterieeinbauort" VALUE 0x743A2 TKW_VV_VV_UB 100.0 FORMULA_0003 0.0 2.0000 /end CHARACTERISTIC
/begin CHARACTERISTIC S_LBATTAPPL "" VALUE 0x743A3 TKW_VV_VV_UB 100.0 FORMULA_0474 0.0 1.0000 /end CHARACTERISTIC
/begin CHARACTERISTIC KL_LADEKENNL "Batterieladespannungskennlinie" CURVE 0x743A4 TKL_SW_VV_SW 100.0 FORMULA_0484 0.0 127.9960 /begin AXIS_DESCR STD_AXIS T_battabst FORMULA_0426 6 -3276.8000 3276.7000 /end AXIS_DESCR FORMAT "%6.3" /end CHARACTERISTIC
/begin CHARACTERISTIC KL_EXPBETAV "Funktion EXP (-BETA*tabst_w)" CURVE 0x743BE TKL_UW_VV_UW 100.0 FORMULA_0457 0.0 9.99984741210938e-1 /begin AXIS_DESCR STD_AXIS NO_INPUT_QUANTITY FORMULA_0010 11 0.0 65535.0000 /end AXIS_DESCR FORMAT "%7.4" /end CHARACTERISTIC
/begin CHARACTERISTIC KL_BATTLSTR "Geschwindigkeitsfaktor Batterieumgebungstemperatur" CURVE 0x743EC TKL_UW_VV_UW 100.0 FORMULA_0478 0.0 255.9960 /begin AXIS_DESCR STD_AXIS NO_INPUT_QUANTITY FORMULA_0470 6 0.0 360.0000 /end AXIS_DESCR FORMAT "%5.2" /end CHARACTERISTIC
/begin CHARACTERISTIC KL_EXPALV "Funktion EXP(-ALPHA*tabst_w) hinten" CURVE 0x74406 TKL_UW_VV_UW 100.0 FORMULA_0457 0.0 9.99984741210938e-1 /begin AXIS_DESCR STD_AXIS Tn_abstell FORMULA_0010 11 0.0 65535.0000 /end AXIS_DESCR FORMAT "%7.4" /end CHARACTERISTIC
/begin CHARACTERISTIC KL_EXPALH "Funktion EXP(-ALPHA*tabst_w) hinten" CURVE 0x74434 TKL_UW_VV_UW 100.0 FORMULA_0457 0.0 9.99984741210938e-1 /begin AXIS_DESCR STD_AXIS NO_INPUT_QUANTITY FORMULA_0010 11 0.0 65535.0000 /end AXIS_DESCR FORMAT "%7.4" /end CHARACTERISTIC
/begin MEASUREMENT St_lbattcal0.B_lbatteinih "Ende Initialisierungsphase Lbattcal Batterie hinten" UBYTE FORMULA_0418 0 0 0.0 255.0 ECU_ADDRESS 0x3FC7FE BIT_MASK 0x1 /end MEASUREMENT
/begin MEASUREMENT St_lbattcal0.B_lbatteiniv "Ende Initialisierungsphase Lbattcal Batterie vorne" UBYTE FORMULA_0419 0 0 0.0 255.0 ECU_ADDRESS 0x3FC7FE BIT_MASK 0x2 /end MEASUREMENT
/begin MEASUREMENT St_lbattcal0.B_lbattenh "Enable Batterie hinten" UBYTE FORMULA_0420 0 0 0.0 255.0 ECU_ADDRESS 0x3FC7FE BIT_MASK 0x4 /end MEASUREMENT
/begin MEASUREMENT St_lbattcal0.B_lbattenv "Enable Batterie vorne" UBYTE FORMULA_0421 0 0 0.0 255.0 ECU_ADDRESS 0x3FC7FE BIT_MASK 0x8 /end MEASUREMENT
/begin MEASUREMENT St_lbattcal0.B_lbattinit "Initialisierung LBATTCAL beendet" UBYTE FORMULA_0422 0 0 0.0 255.0 ECU_ADDRESS 0x3FC7FE BIT_MASK 0x10 /end MEASUREMENT
/begin MEASUREMENT St_lbattcal0.B_dly_tbi "Bedingung f�r Startwertberechnung" UBYTE FORMULA_0423 0 0 0.0 255.0 ECU_ADDRESS 0x3FC7FE BIT_MASK 0x20 /end MEASUREMENT
/begin MEASUREMENT St_lbattcal0 "Statuswort" UBYTE FORMULA_0003 0 0 0.0 255.0000 ECU_ADDRESS 0x3FC7FE /end MEASUREMENT
/begin MEASUREMENT U_kompk "Zwischengr��e" SWORD FORMULA_0484 0 0 0.0 127.9960 ECU_ADDRESS 0x3FC800 /end MEASUREMENT
/begin MEASUREMENT U_kompm "Zwischengr��e" SWORD FORMULA_0484 0 0 0.0 127.9960 ECU_ADDRESS 0x3FC802 /end MEASUREMENT
/begin MEASUREMENT U_lade "Zwischengr��e" SWORD FORMULA_0484 0 0 0.0 127.9960 ECU_ADDRESS 0x3FC804 /end MEASUREMENT
/begin MEASUREMENT T_batt_lb "Batterietemperatur" SWORD FORMULA_0426 0 0 -3276.8000 3276.7000 ECU_ADDRESS 0x3FC806 /end MEASUREMENT
/begin MEASUREMENT Tumg_ers "Aussentemperatur oder Ersatzwert" SWORD FORMULA_0426 0 0 -3276.8000 3276.7000 ECU_ADDRESS 0x3FC808 /end MEASUREMENT
/begin MEASUREMENT U_gensollm "Generatorsollspannung" SWORD FORMULA_0484 0 0 -128.0000 127.9960 ECU_ADDRESS 0x3FC80A /end MEASUREMENT
/begin MEASUREMENT T_battabst "Batterieabstelltemperatur" SWORD FORMULA_0426 0 0 -3276.8000 3276.7000 ECU_ADDRESS 0x3FA964 /end MEASUREMENT
/begin MEASUREMENT Tumg_abst "Abstell-Aussentemperatur" SWORD FORMULA_0426 0 0 -3276.8000 3276.7000 ECU_ADDRESS 0x3FA966 /end MEASUREMENT
/begin MEASUREMENT Tumg_battab "Abstell-Umgebungstemperatur Batterie" SWORD FORMULA_0426 0 0 -3276.8000 3276.7000 ECU_ADDRESS 0x3FA968 /end MEASUREMENT
/begin MEASUREMENT T_batstiniv "Starttemperatur Batterie vorne" SWORD FORMULA_0426 0 0 -3276.8000 3276.7000 ECU_ADDRESS 0x3FAFD4 /end MEASUREMENT
/begin MEASUREMENT T_batt_ini "Startwert Batterietemperatur" SWORD FORMULA_0426 0 0 -3276.8000 3276.7000 ECU_ADDRESS 0x3FAFD6 /end MEASUREMENT
/begin MEASUREMENT T_batt_zw "Tempor�re Batterietemperatur" SWORD FORMULA_0426 0 0 -3276.8000 3276.7000 ECU_ADDRESS 0x3FAFD8 /end MEASUREMENT
/begin MEASUREMENT T_batt_zw2 "Tempor�re Zwischengroesse" SWORD FORMULA_0426 0 0 -3276.8000 3276.7000 ECU_ADDRESS 0x3FAFDA /end MEASUREMENT
/begin MEASUREMENT T_batt_zw3 "" SWORD FORMULA_0426 0 0 -3276.8000 3276.7000 ECU_ADDRESS 0x3FAFDC /end MEASUREMENT
/begin MEASUREMENT Tumg_dt "Tempor�re zwischengroesse" SWORD FORMULA_0426 0 0 -3276.8000 3276.7000 ECU_ADDRESS 0x3FAFDE /end MEASUREMENT
/begin MEASUREMENT Tumg_tp "" SWORD FORMULA_0426 0 0 -3276.8000 3276.7000 ECU_ADDRESS 0x3FAFE0 /end MEASUREMENT
/begin MEASUREMENT Batt_tfil "Zeitkonstante Batterie" UWORD FORMULA_0457 0 0 0.0 9.99984741210938e-1 ECU_ADDRESS 0x3FAFE2 /end MEASUREMENT
/begin MEASUREMENT Batt_ort "Batterieeinbauort" UBYTE FORMULA_0003 0 0 0.0 255.0000 ECU_ADDRESS 0x3FAFE4 /end MEASUREMENT
/* ------------------ Abschnitt erzeugt aus llpmctrl.dat ------------------ */
/begin CHARACTERISTIC K_DSOCHYST "Hystereschwelle SOC | EN: Hystereschwelle SOC" VALUE 0x74480 TKW_VV_VV_SW 100.0 FORMULA_0475 -100.0000 99.9969 FORMAT "%5.2" /end CHARACTERISTIC
/begin CHARACTERISTIC K_DSOCLLANH "Abstand zur Stfgrz, bei der die LLDZanh aktiviert wird. | EN: Abstand zur Stfgrz, bei der die LLDZanh aktiviert wird." VALUE 0x74482 TKW_VV_VV_SW 100.0 FORMULA_0475 -100.0000 99.9969 FORMAT "%5.2" /end CHARACTERISTIC
/begin CHARACTERISTIC K_NLLMIN "Motordrehzahl unterhalb derer die LLDZanh. zurueckgenommen wird. | EN: Motordrehzahl unterhalb derer die LLDZanh. zurueckgenommen wird." VALUE 0x74484 TKW_VV_VV_SW 100.0 FORMULA_0006 -32768.0000 32767.0000 /end CHARACTERISTIC
/begin CHARACTERISTIC K_DFLLMIN "DF unterhalb derer die LLDZanh. zurueckgenommen wird." VALUE 0x74486 TKW_VV_VV_UB 100.0 FORMULA_0471 0.0 99.6093 /end CHARACTERISTIC
/begin CHARACTERISTIC K_DFMAX "Obere Schwelle DF Signal | EN: Obere Schwelle DF Signal" VALUE 0x74487 TKW_VV_VV_UB 100.0 FORMULA_0471 0.0 99.6093 /end CHARACTERISTIC
/begin CHARACTERISTIC K_LLANHAPP "LLDZanh.-level, falls Generator fehlerhaft ist." VALUE 0x74488 TKW_VV_VV_UB 100.0 FORMULA_0003 0.0 255.0000 /end CHARACTERISTIC
/begin CHARACTERISTIC K_LLPMAPP "Handapplikationswert f�r Leerlaufdrehzahlvorgabe" VALUE 0x74489 TKW_VV_VV_UB 100.0 FORMULA_0003 0.0 255.0000 /end CHARACTERISTIC
/begin CHARACTERISTIC S_N_IDLIBS "Schalter zum manuellen Setzen von LL aktiv" VALUE 0x7448A TKW_VV_VV_UB 100.0 FORMULA_0474 0.0 1.0000 /end CHARACTERISTIC
/begin MEASUREMENT N_idlibs "Leerlaufdrehzahlvorgabe von LC-Powermanagement" UBYTE FORMULA_0003 0 0 0.0 255.0000 ECU_ADDRESS 0x3FC812 /end MEASUREMENT
/* ------------------ Abschnitt erzeugt aus pmdiag.dat ------------------ */
/begin CHARACTERISTIC K_ABKORROVER "schlechter absch_korr Schwelle ueberschritten" VALUE 0x758DA TKW_VV_VV_SW 100.0 FORMULA_0495 -50.0000 49.9984 FORMAT "%5.2" /end CHARACTERISTIC
/begin CHARACTERISTIC K_DSOCHYSTCC "DSOC Hyst. fuer B_ccbtnach reset  | EN: DSOC Hyst. fuer B_ccbtnach reset" VALUE 0x758DC TKW_VV_VV_SW 100.0 FORMULA_0475 -100.0000 99.9969 FORMAT "%5.2" /end CHARACTERISTIC
/begin CHARACTERISTIC K_DSOCLOW "DSOC Grenze f. CCmeld Batt Nachladen | EN: DSOC Grenze f. CCmeld Batt Nachladen" VALUE 0x758DE TKW_VV_VV_SW 100.0 FORMULA_0475 -100.0000 99.9969 FORMAT "%5.2" /end CHARACTERISTIC
/begin CHARACTERISTIC K_OSPGHYST "Unterspannungshysterese | EN: Unterspannungshysterese" VALUE 0x758E0 TKW_VV_VV_SW 100.0 FORMULA_0496 -8.1920 8.1917 FORMAT "%6.3" /end CHARACTERISTIC
/begin CHARACTERISTIC K_USPGHYST "Unterspannungshysterese | EN: Unterspannungshysterese" VALUE 0x758E2 TKW_VV_VV_SW 100.0 FORMULA_0496 -8.1920 8.1917 FORMAT "%6.3" /end CHARACTERISTIC
/begin CHARACTERISTIC K_CCPWRSET "ctrpwrcos Schwelle ab dem CC Meldung aktiviert wird. " VALUE 0x758E4 TKW_VV_VV_UW 100.0 FORMULA_0010 0.0 65535.0000 /end CHARACTERISTIC
/begin CHARACTERISTIC K_OSPGAPP "Oberspannungsschwelle | EN: Oberspannungsschwelle" VALUE 0x758E6 TKW_VV_VV_UW 100.0 FORMULA_0497 6.0000 22.3837 FORMAT "%6.3" /end CHARACTERISTIC
/begin CHARACTERISTIC K_T2PMINFO "T2 Zykluszeit fuer PM Fehlerinfo | EN: T2 Zykluszeit fuer PM Fehlerinfo" VALUE 0x758E8 TKW_VV_VV_UW 100.0 FORMULA_0073 0.0 6553.5000 FORMAT "%4.1" /end CHARACTERISTIC
/begin CHARACTERISTIC K_T3PMINFO "T3 Zykluszeit fuer PM Fehlerinfo | EN: T3 Zykluszeit fuer PM Fehlerinfo" VALUE 0x758EA TKW_VV_VV_UW 100.0 FORMULA_0073 0.0 6553.5000 FORMAT "%4.1" /end CHARACTERISTIC
/begin CHARACTERISTIC K_TBATNACHL "B_ccbtnach wird nach dieser Zeit aktiviert | EN: B_ccbtnach wird nach dieser Zeit aktiviert" VALUE 0x758EC TKW_VV_VV_UW 100.0 FORMULA_0073 0.0 6553.5000 FORMAT "%4.1" /end CHARACTERISTIC
/begin CHARACTERISTIC K_T_CCRUHVER "Dauer fuer CC-Meld. erhoehter Ruhestrom | EN: Dauer fuer CC -Meld. e rhoehter Ruhestrom" VALUE 0x758EE TKW_VV_VV_UW 100.0 FORMULA_0073 0.0 6553.5000 FORMAT "%4.1" /end CHARACTERISTIC
/begin CHARACTERISTIC K_T_KMSHIFT "Delayzeit f�r Km_st Info-shift | EN: Delayzeit für Km_st Info-shift" VALUE 0x758F0 TKW_VV_VV_UW 100.0 FORMULA_0073 0.0 6553.5000 FORMAT "%4.1" /end CHARACTERISTIC
/begin CHARACTERISTIC K_USPGAPP "Unterspannungschwelle | EN: Unterspannungschwelle" VALUE 0x758F2 TKW_VV_VV_UW 100.0 FORMULA_0497 6.0000 22.3837 FORMAT "%6.3" /end CHARACTERISTIC
/begin CHARACTERISTIC CW_CCMASK "CC-Meldung Maske" VALUE 0x758F4 TKW_VV_VV_UB 100.0 FORMULA_0003 0.0 255.0000 /end CHARACTERISTIC
/begin CHARACTERISTIC CW_PMDEFMASK "Bitcodierte Maske zum Setzen von PM Defekt" VALUE 0x758F5 TKW_VV_VV_UB 100.0 FORMULA_0003 0.0 255.0000 /end CHARACTERISTIC
/begin CHARACTERISTIC K_BATTINDAPP "batt_index appl. | EN: batt_index appl." VALUE 0x758F6 TKW_VV_VV_UB 100.0 FORMULA_0003 0.0 255.0000 /end CHARACTERISTIC
/begin CHARACTERISTIC K_BATTREGAPP "Batterietauschregristrieren App | EN: Batterietauschregristrieren App" VALUE 0x758F7 TKW_VV_VV_UB 100.0 FORMULA_0003 0.0 255.0000 /end CHARACTERISTIC
/begin CHARACTERISTIC K_CBATTAPP "Cbattnenn appl. | EN: Cbattnenn appl." VALUE 0x758F8 TKW_VV_VV_UB 100.0 FORMULA_0483 0.0 255.0000 /end CHARACTERISTIC
/begin CHARACTERISTIC K_CCPRIOSET "Schwelle von E65Prios ab dem ccmeldung aktiv ist. | EN: Schwelle von E65Prios ab dem ccmeldung aktiv ist." VALUE 0x758F9 TKW_VV_VV_UB 100.0 FORMULA_0003 0.0 7.0000 /end CHARACTERISTIC
/begin CHARACTERISTIC K_CCPRIOTIME "Zeitverschiebung bis ccmeldung gesetzt wird." VALUE 0x758FA TKW_VV_VV_UB 100.0 FORMULA_0458 0.0 25.5000 /end CHARACTERISTIC
/begin CHARACTERISTIC K_HISTDMERST "Manueller Reset d. Histogramm in der DME | EN: Manueller Reset d. Histogramm in der DME" VALUE 0x758FB TKW_VV_VV_UB 100.0 FORMULA_0003 0.0 255.0000 /end CHARACTERISTIC
/begin CHARACTERISTIC K_HISTIBSRST "Manueller Histogramm Reset in IBS | EN: Manueller Histogramm Reset in IBS" VALUE 0x758FC TKW_VV_VV_UB 100.0 FORMULA_0003 0.0 255.0000 /end CHARACTERISTIC
/begin CHARACTERISTIC K_IWAKEAPP "Wakeupgrenze Appl. | EN: Wakeupgrenze Appl." VALUE 0x758FD TKW_VV_VV_UB 100.0 FORMULA_0492 0.0 0.2550 /end CHARACTERISTIC
/begin CHARACTERISTIC K_KSOGRZAPP "Ikurz_ogrz appl. | EN: Ikurz_ogrz appl." VALUE 0x758FE TKW_VV_VV_UB 100.0 FORMULA_0498 0.0 998.4000 /end CHARACTERISTIC
/begin CHARACTERISTIC K_KSUGRZAPP "Ikurz_ugrz Appl. | EN: Ikurz_ugrz Appl." VALUE 0x758FF TKW_VV_VV_UB 100.0 FORMULA_0498 0.0 1000.0000 /end CHARACTERISTIC
/begin CHARACTERISTIC K_OSPGPRELLZ "Anzahl der Entprellungen f�r Oberspannungsfehlereintrag | EN: Anzahl der Entprellungen fï¿½r Oberspannungsfehlereintrag" VALUE 0x75900 TKW_VV_VV_UB 100.0 FORMULA_0003 0.0 255.0000 /end CHARACTERISTIC
/begin CHARACTERISTIC K_OSPRELLDEC "Dekrement auf Entprellcounter Oberspannung" VALUE 0x75901 TKW_VV_VV_UB 100.0 FORMULA_0003 0.0 255.0000 /end CHARACTERISTIC
/begin CHARACTERISTIC K_OSPRELLINC "Inkrement auf Entprellcounter Oberspannung" VALUE 0x75902 TKW_VV_VV_UB 100.0 FORMULA_0003 0.0 255.0000 /end CHARACTERISTIC
/begin CHARACTERISTIC K_RUHVERMODE "Ruhestromverletzungserkennungsmode | EN: Ruhestromverletzungserkennungsmode" VALUE 0x75903 TKW_VV_VV_UB 100.0 FORMULA_0003 0.0 255.0000 /end CHARACTERISTIC
/begin CHARACTERISTIC K_T1PMINFO "T1 Zykluszeit fuer PM Fehlerinfo | EN: T1 Zykluszeit fuer PM Fehlerinfo" VALUE 0x75904 TKW_VV_VV_UB 100.0 FORMULA_0458 0.0 25.5000 /end CHARACTERISTIC
/begin CHARACTERISTIC K_TCODIERPM "T1 Zyklus fuer Fehlerinfo | EN: T1 Zyklus fuer Fehlerinfo" VALUE 0x75905 TKW_VV_VV_UB 100.0 FORMULA_0458 0.0 25.5000 /end CHARACTERISTIC
/begin CHARACTERISTIC K_TRINGSHIFT "Ruhezeit nachdem der Ruhestrom-Ringspeicher eingetragen wird. | EN: min 0.0p 4 14*x/15 Ruhezeit nachdem der Ruhestrom -Ringspeicher eingetragen wird." VALUE 0x75906 TKW_VV_VV_UB 100.0 FORMULA_0499 0.0 238.0000 /end CHARACTERISTIC
/begin CHARACTERISTIC K_T_OSPGRSET "Zeit f�r 1x Oberspannungsentprellungr�cknahme" VALUE 0x75907 TKW_VV_VV_UB 100.0 FORMULA_0458 0.0 25.5000 /end CHARACTERISTIC
/begin CHARACTERISTIC K_T_OSPGSET "Entrpellzeit FS_oberspannungserkennung | EN: Entrpellzeit FS_oberspannungserkennung" VALUE 0x75908 TKW_VV_VV_UB 100.0 FORMULA_0458 0.0 25.5000 /end CHARACTERISTIC
/begin CHARACTERISTIC K_T_RUHAUSW "Minimal verstrichene Zeit f�r Ruheverl. Auswertung | EN: min 0.0p 4 14*x/15 Minimal verstrichene Zeit für Ruheverl. Auswertung" VALUE 0x75909 TKW_VV_VV_UB 100.0 FORMULA_0499 0.0 238.0000 /end CHARACTERISTIC
/begin CHARACTERISTIC K_T_SQSHIFT "Delayzeit f�r Soc_quali Info-shift | EN: Delayzeit für Soc_quali Info-shift" VALUE 0x7590A TKW_VV_VV_UB 100.0 FORMULA_0458 0.0 25.5000 /end CHARACTERISTIC
/begin CHARACTERISTIC K_T_USPGRSET "Uterspannung Resetzeit | EN: Uterspannung Resetzeit" VALUE 0x7590B TKW_VV_VV_UB 100.0 FORMULA_0458 0.0 25.5000 /end CHARACTERISTIC
/begin CHARACTERISTIC K_T_USPGSET "Zeit f�r 1x Unterspannungsentprellung | EN: Zeit für 1x Unterspannungsentprellung" VALUE 0x7590C TKW_VV_VV_UB 100.0 FORMULA_0458 0.0 25.5000 /end CHARACTERISTIC
/begin CHARACTERISTIC K_USPGPRELLZ "Anzahl der FS_uspg Entprellungen f�r Fehlereintrag | EN: Anzahl der FS_uspg Entprellungen fï¿½r Fehlereintrag" VALUE 0x7590D TKW_VV_VV_UB 100.0 FORMULA_0003 0.0 255.0000 /end CHARACTERISTIC
/begin CHARACTERISTIC K_USPRELLDEC "Dekrement auf Entprellcounter Unterspannung" VALUE 0x7590E TKW_VV_VV_UB 100.0 FORMULA_0003 0.0 255.0000 /end CHARACTERISTIC
/begin CHARACTERISTIC K_USPRELLINC "Inkrement auf Entprellcounter Unterspannung" VALUE 0x7590F TKW_VV_VV_UB 100.0 FORMULA_0003 0.0 255.0000 /end CHARACTERISTIC
/begin CHARACTERISTIC S_PMSV_HEIZ "Standheizen wird f�r Nibble-historie ausgewertet" VALUE 0x75910 TKW_VV_VV_UB 100.0 FORMULA_0474 0.0 1.0000 /end CHARACTERISTIC
/begin CHARACTERISTIC S_PMSV_KLIMA "Standklimatisierung wird f�r Nibble-historie ausgewertet" VALUE 0x75911 TKW_VV_VV_UB 100.0 FORMULA_0474 0.0 1.0000 /end CHARACTERISTIC
/begin CHARACTERISTIC S_PMSV_LUFT "Standlueften wird f�r Nibble-historie ausgewertet | EN: Standlueften wird fï¿½r Nibble-historie ausgewertet" VALUE 0x75912 TKW_VV_VV_UB 100.0 FORMULA_0474 0.0 1.0000 /end CHARACTERISTIC
/begin CHARACTERISTIC KL_T4RELMXRG "Max Toleranzzeit von T4 Ringshift | EN: Maximum tolerance time of T4, ring shift" CURVE 0x75914 TKL_UW_VV_UW 100.0 FORMULA_0490 0.0 917490.0000
 /begin AXIS_DESCR STD_AXIS T_histsum FORMULA_0488 6 0.0 3669960.0000 FORMAT "%5.2" /end AXIS_DESCR
 FORMAT "%5.2" /end CHARACTERISTIC
/begin CHARACTERISTIC KL_CLASS2NENN "Batterieklasse -> Batteriegroesse" CURVE 0x7592E TKL_UB_VV_UB 100.0 FORMULA_0483 0.0 255.0000 /begin AXIS_DESCR STD_AXIS Batt_class FORMULA_0003 8 0.0 255.0000 /end AXIS_DESCR /end CHARACTERISTIC
/begin CHARACTERISTIC KL_T2RELMXRG "Max Toleranzzeit von T2 Ringshift | EN: Maximum tolerance time of T2, ring shift" CURVE 0x75940 TKL_UW_VV_UW 100.0 FORMULA_0490 0.0 917490.0000
 /begin AXIS_DESCR STD_AXIS T_histsum FORMULA_0488 6 0.0 3669960.0000 FORMAT "%5.2" /end AXIS_DESCR
 FORMAT "%5.2" /end CHARACTERISTIC
/begin CHARACTERISTIC KL_T2RELMAX "Max Toleranzzeit von T2 | EN: Maximum tolerance time of T2" CURVE 0x7595A TKL_UW_VV_UW 100.0 FORMULA_0490 0.0 917490.0000
 /begin AXIS_DESCR STD_AXIS T_histsum FORMULA_0488 6 0.0 3669960.0000 FORMAT "%5.2" /end AXIS_DESCR
 FORMAT "%5.2" /end CHARACTERISTIC
/begin CHARACTERISTIC KL_T3RELMAX "Max Toleranzzeit von T3 | EN: Maximum tolerance time of T3" CURVE 0x75974 TKL_UW_VV_UW 100.0 FORMULA_0490 0.0 917490.0000
 /begin AXIS_DESCR STD_AXIS T_histsum FORMULA_0488 6 0.0 3669960.0000 FORMAT "%5.2" /end AXIS_DESCR
 FORMAT "%5.2" /end CHARACTERISTIC
/begin CHARACTERISTIC KL_CLASS2IND "Batterieklasse -> Batterieindex" CURVE 0x7598E TKL_UB_VV_UB 100.0 FORMULA_0003 0.0 255.0000 /begin AXIS_DESCR STD_AXIS Batt_class FORMULA_0003 8 0.0 255.0000 /end AXIS_DESCR /end CHARACTERISTIC
/begin CHARACTERISTIC KL_T3RELMXRG "Max Toleranzzeit von T3 Ringshift | EN: Maximum tolerance time of T3, ring shift" CURVE 0x759A0 TKL_UW_VV_UW 100.0 FORMULA_0490 0.0 917490.0000
 /begin AXIS_DESCR STD_AXIS T_histsum FORMULA_0488 6 0.0 3669960.0000 FORMAT "%5.2" /end AXIS_DESCR
 FORMAT "%5.2" /end CHARACTERISTIC
/begin CHARACTERISTIC KL_T4RELMAX "Max Toleranzzeit von T4 | EN: Maximum tolerance time of T4" CURVE 0x759BA TKL_UW_VV_UW 100.0 FORMULA_0490 0.0 917490.0000
 /begin AXIS_DESCR STD_AXIS T_histsum FORMULA_0488 6 0.0 3669960.0000 FORMAT "%5.2" /end AXIS_DESCR
 FORMAT "%5.2" /end CHARACTERISTIC
/begin CHARACTERISTIC CW_PMMASKDFP "Powermanagement Fehlerpseicher Maske" VALUE 0x759D4 TKW_VV_VV_UB 100.0 FORMULA_0003 0.0 255.0000 /end CHARACTERISTIC
/begin MEASUREMENT St_pmdiag0.B_codierpm "Anfrage an CAS die Codierdaten erneut fuer PM zu senden. [V452 CHECK: PKSR RAM block reorganised in V452 (new ub correction of SSP flow); address not valid]" UBYTE FORMULA_0418 0 0 0.0 255.0 ECU_ADDRESS 0x3FCCF4 BIT_MASK 0x1 /end MEASUREMENT
/begin MEASUREMENT St_pmdiag0.B_ccprio "CC Meldung : Komfortverbraucher eingeschraenkt [V452 CHECK: PKSR RAM block reorganised in V452 (new ub correction of SSP flow); address not valid]" UBYTE FORMULA_0419 0 0 0.0 255.0 ECU_ADDRESS 0x3FCCF4 BIT_MASK 0x2 /end MEASUREMENT
/begin MEASUREMENT St_pmdiag0.B_ccbttdfk "CC Meldung : Batterie verschlissen [V452 CHECK: PKSR RAM block reorganised in V452 (new ub correction of SSP flow); address not valid]" UBYTE FORMULA_0420 0 0 0.0 255.0 ECU_ADDRESS 0x3FCCF4 BIT_MASK 0x4 /end MEASUREMENT
/begin MEASUREMENT St_pmdiag0.B_ccpmerr "CC Meldung : Powermgm ausser Betrieb [V452 CHECK: PKSR RAM block reorganised in V452 (new ub correction of SSP flow); address not valid]" UBYTE FORMULA_0421 0 0 0.0 255.0 ECU_ADDRESS 0x3FCCF4 BIT_MASK 0x8 /end MEASUREMENT
/begin MEASUREMENT St_pmdiag0.B_ccbttknt "CC Meldung : Batteriekontakt pruefen [V452 CHECK: PKSR RAM block reorganised in V452 (new ub correction of SSP flow); address not valid]" UBYTE FORMULA_0422 0 0 0.0 255.0 ECU_ADDRESS 0x3FCCF4 BIT_MASK 0x10 /end MEASUREMENT
/begin MEASUREMENT St_pmdiag0.B_pcoschg "Bed. SVstatus darf ge�ndert werden. [V452 CHECK: PKSR RAM block reorganised in V452 (new ub correction of SSP flow); address not valid]" UBYTE FORMULA_0423 0 0 0.0 255.0 ECU_ADDRESS 0x3FCCF4 BIT_MASK 0x20 /end MEASUREMENT
/begin MEASUREMENT St_pmdiag0.B_ccbtnach "CC Meldung : Batterie Nachladen [V452 CHECK: PKSR RAM block reorganised in V452 (new ub correction of SSP flow); address not valid]" UBYTE FORMULA_0424 0 0 0.0 255.0 ECU_ADDRESS 0x3FCCF4 BIT_MASK 0x40 /end MEASUREMENT
/begin MEASUREMENT St_pmdiag0.B_tiefrset "Tiefentladungsbit, B_tiefset, im IBS l�schen. [V452 CHECK: PKSR RAM block reorganised in V452 (new ub correction of SSP flow); address not valid]" UBYTE FORMULA_0425 0 0 0.0 255.0 ECU_ADDRESS 0x3FCCF4 BIT_MASK 0x80 /end MEASUREMENT
/begin MEASUREMENT St_pmdiag0 "Statuswort [V452 CHECK: PKSR RAM block reorganised in V452 (new ub correction of SSP flow); address not valid]" UBYTE FORMULA_0003 0 0 0.0 255.0000 ECU_ADDRESS 0x3FCCF4 /end MEASUREMENT
/begin MEASUREMENT St_pmdiag1.B_ccruhver "CC Meldung : erhoehter Ruhestrom [V452 CHECK: PKSR RAM block reorganised in V452 (new ub correction of SSP flow); address not valid]" UBYTE FORMULA_0418 0 0 0.0 255.0 ECU_ADDRESS 0x3FCCF5 BIT_MASK 0x1 /end MEASUREMENT
/begin MEASUREMENT St_pmdiag1.B_histrset "IBS Histrogramm darf gel�scht werden. [V452 CHECK: PKSR RAM block reorganised in V452 (new ub correction of SSP flow); address not valid]" UBYTE FORMULA_0419 0 0 0.0 255.0 ECU_ADDRESS 0x3FCCF5 BIT_MASK 0x2 /end MEASUREMENT
/begin MEASUREMENT St_pmdiag1.B_timer_rst "Dient zum Aufziehen des internen Delay Timers [V452 CHECK: PKSR RAM block reorganised in V452 (new ub correction of SSP flow); address not valid]" UBYTE FORMULA_0420 0 0 0.0 255.0 ECU_ADDRESS 0x3FCCF5 BIT_MASK 0x4 /end MEASUREMENT
/begin MEASUREMENT St_pmdiag1.B_sv_ihka "IHKA Standverbraucher aktiv [V452 CHECK: PKSR RAM block reorganised in V452 (new ub correction of SSP flow); address not valid]" UBYTE FORMULA_0421 0 0 0.0 255.0 ECU_ADDRESS 0x3FCCF5 BIT_MASK 0x8 /end MEASUREMENT
/begin MEASUREMENT St_pmdiag1.B_ruhverl7 "Ruhestromverletzung derzeit vorhanden. [V452 CHECK: PKSR RAM block reorganised in V452 (new ub correction of SSP flow); address not valid]" UBYTE FORMULA_0422 0 0 0.0 255.0 ECU_ADDRESS 0x3FCCF5 BIT_MASK 0x10 /end MEASUREMENT
/begin MEASUREMENT St_pmdiag1.B_qelad1step "Q_elad 1. Takt vorbei  [V452 CHECK: PKSR RAM block reorganised in V452 (new ub correction of SSP flow); address not valid]" UBYTE FORMULA_0423 0 0 0.0 255.0 ECU_ADDRESS 0x3FCCF5 BIT_MASK 0x20 /end MEASUREMENT
/begin MEASUREMENT St_pmdiag1 "Statuswort [V452 CHECK: PKSR RAM block reorganised in V452 (new ub correction of SSP flow); address not valid]" UBYTE FORMULA_0003 0 0 0.0 255.0000 ECU_ADDRESS 0x3FCCF5 /end MEASUREMENT
/begin MEASUREMENT St_pmdiagnv.B_ruhverl "ruhestromverletzung vorhanden" UBYTE FORMULA_0418 0 0 0.0 255.0 ECU_ADDRESS 0x3FA9D4 BIT_MASK 0x1 /end MEASUREMENT
/begin MEASUREMENT St_pmdiagnv "Statuswort" UBYTE FORMULA_0003 0 0 0.0 255.0000 ECU_ADDRESS 0x3FA9D4 /end MEASUREMENT
/begin MEASUREMENT Dqelad7 "diff = qelad-qeladold7 [V452 CHECK: PKSR RAM block reorganised in V452 (new ub correction of SSP flow); address not valid]" UWORD FORMULA_0487 0 0 0.0 19087.8640 ECU_ADDRESS 0x3FCCF6 /end MEASUREMENT
/begin MEASUREMENT Dqlad7 "diff = qlad-qladold7 [V452 CHECK: PKSR RAM block reorganised in V452 (new ub correction of SSP flow); address not valid]" UWORD FORMULA_0487 0 0 0.0 19087.8640 ECU_ADDRESS 0x3FCCF8 /end MEASUREMENT
/begin MEASUREMENT Qladzwsp7 "qlad uebertragspeicher [V452 CHECK: PKSR RAM block reorganised in V452 (new ub correction of SSP flow); address not valid]" UWORD FORMULA_0010 0 0 0.0 65535.0000 ECU_ADDRESS 0x3FCCFA /end MEASUREMENT
/begin MEASUREMENT Stat_sv_reg "Status Standverbraucher registriert [V452 CHECK: PKSR RAM block reorganised in V452 (new ub correction of SSP flow); address not valid]" UWORD FORMULA_0010 0 0 0.0 65535.0000 ECU_ADDRESS 0x3FCCFC /end MEASUREMENT
/begin MEASUREMENT T2pmcntr "T2PMINFO countdowncounter [V452 CHECK: PKSR RAM block reorganised in V452 (new ub correction of SSP flow); address not valid]" UWORD FORMULA_0073 0 0 0.0 6553.5000 ECU_ADDRESS 0x3FCCFE /end MEASUREMENT
/begin MEASUREMENT T3pmcntr "T3PMINFO countdowncounter [V452 CHECK: PKSR RAM block reorganised in V452 (new ub correction of SSP flow); address not valid]" UWORD FORMULA_0073 0 0 0.0 6553.5000 ECU_ADDRESS 0x3FCD00 /end MEASUREMENT
/begin MEASUREMENT T_histsum "Txhistiruh Summe [V452 CHECK: PKSR RAM block reorganised in V452 (new ub correction of SSP flow); address not valid]" UWORD FORMULA_0488 0 0 0.0 3669960.0000 ECU_ADDRESS 0x3FCD02 /end MEASUREMENT
/begin MEASUREMENT T_histsummin "Summe der Txhistiruh in Minuten [V452 CHECK: PKSR RAM block reorganised in V452 (new ub correction of SSP flow); address not valid]" UWORD FORMULA_0489 0 0 0.0 61166.0000 ECU_ADDRESS 0x3FCD04 /end MEASUREMENT
/begin MEASUREMENT T2hist "T2histitruh in sek. [V452 CHECK: PKSR RAM block reorganised in V452 (new ub correction of SSP flow); address not valid]" UWORD FORMULA_0490 0 0 0.0 917490.0000 ECU_ADDRESS 0x3FCD06 /end MEASUREMENT
/begin MEASUREMENT T3hist "T3histiruh in Sek [V452 CHECK: PKSR RAM block reorganised in V452 (new ub correction of SSP flow); address not valid]" UWORD FORMULA_0490 0 0 0.0 917490.0000 ECU_ADDRESS 0x3FCD08 /end MEASUREMENT
/begin MEASUREMENT T4hist "T4histiruh in Sek [V452 CHECK: PKSR RAM block reorganised in V452 (new ub correction of SSP flow); address not valid]" UWORD FORMULA_0490 0 0 0.0 917490.0000 ECU_ADDRESS 0x3FCD0A /end MEASUREMENT
/begin MEASUREMENT Batt_index "Batterie Index [V452 CHECK: PKSR RAM block reorganised in V452 (new ub correction of SSP flow); address not valid]" UBYTE FORMULA_0003 0 0 0.0 255.0000 ECU_ADDRESS 0x3FCD0C /end MEASUREMENT
/begin MEASUREMENT C_battnenn "Batteriekapazitaet [V452 CHECK: PKSR RAM block reorganised in V452 (new ub correction of SSP flow); address not valid]" UBYTE FORMULA_0483 0 0 0.0 255.0000 ECU_ADDRESS 0x3FCD0D /end MEASUREMENT
/begin MEASUREMENT Codiercnt "Internet Zaehler fuer Anfrage Codierung" UBYTE FORMULA_0458 0 0 0.0 25.5000 ECU_ADDRESS 0x3FCD0E /end MEASUREMENT
/begin MEASUREMENT Ibsbor_hb "highbyte ibsborctr" UBYTE FORMULA_0003 0 0 0.0 255.0000 ECU_ADDRESS 0x3FCD0F /end MEASUREMENT
/begin MEASUREMENT Ikurz_ogrz "Obere Grenze Kurzschlu�strom" UBYTE FORMULA_0491 0 0 0.0 2550.0000 ECU_ADDRESS 0x3FCD10 /end MEASUREMENT
/begin MEASUREMENT Ikurz_ugrz "Untere Grenze Kurzschlu�strom" UBYTE FORMULA_0491 0 0 0.0 2550.0000 ECU_ADDRESS 0x3FCD11 /end MEASUREMENT
/begin MEASUREMENT Iwakeupgrz "Ruhestromverletzungsgrenze, ab hier weckt u.U. das IBS." UBYTE FORMULA_0492 0 0 0.0 0.2550 ECU_ADDRESS 0x3FCD12 /end MEASUREMENT
/begin MEASUREMENT Ospgcnt "fs_Oberspannungscounter" UBYTE FORMULA_0458 0 0 0.0 25.5000 ECU_ADDRESS 0x3FCD13 /end MEASUREMENT
/begin MEASUREMENT Ospgprell "Anzahl der entprellten FS_Oberspannungserkennung" UBYTE FORMULA_0003 0 0 0.0 255.0000 ECU_ADDRESS 0x3FCD14 /end MEASUREMENT
/begin MEASUREMENT Ospgstat "Status Oberspannungserkennung" UBYTE FORMULA_0003 0 0 0.0 255.0000 ECU_ADDRESS 0x3FCD15 /end MEASUREMENT
/begin MEASUREMENT Pm_klemmstat "Umweltbed. Klemmenstatus" UBYTE FORMULA_0003 0 0 0.0 255.0000 ECU_ADDRESS 0x3FCD16 /end MEASUREMENT
/begin MEASUREMENT Stat_sv_reg1 "LoByte Stat_sv_reg f�r Umweltbedingungen" UBYTE FORMULA_0003 0 0 0.0 255.0000 ECU_ADDRESS 0x3FCD17 /end MEASUREMENT
/begin MEASUREMENT Stat_sv_reg2 "HiByte Stat_sv_reg f�r Umweltbedinung" UBYTE FORMULA_0003 0 0 0.0 255.0000 ECU_ADDRESS 0x3FCD18 /end MEASUREMENT
/begin MEASUREMENT Svaus "Status Standverbraucher sind aus " UBYTE FORMULA_0474 0 0 0.0 1.0000 ECU_ADDRESS 0x3FCD19 /end MEASUREMENT
/begin MEASUREMENT T1histshort "T1 Histogramm in 14.9333 MIn. Quantisiert" UBYTE FORMULA_0493 0 0 0.0 3808.0000 ECU_ADDRESS 0x3FCD1A /end MEASUREMENT
/begin MEASUREMENT T1pmcntr "T1PMINFO countdowncounter" UBYTE FORMULA_0458 0 0 0.0 25.5000 ECU_ADDRESS 0x3FCD1B /end MEASUREMENT
/begin MEASUREMENT T2histshort "T2 Histogramm als Umweltbed. bei Ruhestromverletzung" UBYTE FORMULA_0493 0 0 0.0 3808.0000 ECU_ADDRESS 0x3FCD1C /end MEASUREMENT
/begin MEASUREMENT T3histshort "T3 Histogramm als Umweltbed. bei Ruhestromverletzung" UBYTE FORMULA_0493 0 0 0.0 3808.0000 ECU_ADDRESS 0x3FCD1D /end MEASUREMENT
/begin MEASUREMENT T4histshort "T4 Histogramm als Umweltbed. bei Ruhestromverletzung" UBYTE FORMULA_0493 0 0 0.0 3808.0000 ECU_ADDRESS 0x3FCD1E /end MEASUREMENT
/begin MEASUREMENT T_saismem "T Saison zw. speicher" UBYTE FORMULA_0003 0 0 0.0 255.0000 ECU_ADDRESS 0x3FCD1F /end MEASUREMENT
/begin MEASUREMENT Uspgcnt "FS_Unterspannungscounter" UBYTE FORMULA_0458 0 0 0.0 25.5000 ECU_ADDRESS 0x3FCD20 /end MEASUREMENT
/begin MEASUREMENT Uspgprell "Anzahl der entprellten FS_Unterspannungserkennung." UBYTE FORMULA_0003 0 0 0.0 255.0000 ECU_ADDRESS 0x3FCD21 /end MEASUREMENT
/begin MEASUREMENT Uspgstat "FS_Unterspannungsstatus" UBYTE FORMULA_0003 0 0 0.0 255.0000 ECU_ADDRESS 0x3FCD22 /end MEASUREMENT
/begin MEASUREMENT Ztagedelta "verstrichene Tage" UBYTE FORMULA_0003 0 0 0.0 10.0000 ECU_ADDRESS 0x3FCD23 /end MEASUREMENT
/begin MEASUREMENT Ztagestate "Tageswechsel Statemachine Ctr" UBYTE FORMULA_0003 0 0 0.0 255.0000 ECU_ADDRESS 0x3FCD24 /end MEASUREMENT
/begin MEASUREMENT Pminfo1_1of37_ "Infospeicher 1 vom Powermanagement" UWORD FORMULA_0010 0 0 0.0 65535.0000 ECU_ADDRESS 0x3FA9D6 /end MEASUREMENT
/begin MEASUREMENT Pminfo1_2of37_ "Infospeicher 1 vom Powermanagement" UWORD FORMULA_0010 0 0 0.0 65535.0000 ECU_ADDRESS 0x3FA9D8 /end MEASUREMENT
/begin MEASUREMENT Pminfo1_3of37_ "Infospeicher 1 vom Powermanagement" UWORD FORMULA_0010 0 0 0.0 65535.0000 ECU_ADDRESS 0x3FA9DA /end MEASUREMENT
/begin MEASUREMENT Pminfo1_4of37_ "Infospeicher 1 vom Powermanagement" UWORD FORMULA_0010 0 0 0.0 65535.0000 ECU_ADDRESS 0x3FA9DC /end MEASUREMENT
/begin MEASUREMENT Pminfo1_5of37_ "Infospeicher 1 vom Powermanagement" UWORD FORMULA_0010 0 0 0.0 65535.0000 ECU_ADDRESS 0x3FA9DE /end MEASUREMENT
/begin MEASUREMENT Pminfo1_6of37_ "Infospeicher 1 vom Powermanagement" UWORD FORMULA_0010 0 0 0.0 65535.0000 ECU_ADDRESS 0x3FA9E0 /end MEASUREMENT
/begin MEASUREMENT Pminfo1_7of37_ "Infospeicher 1 vom Powermanagement" UWORD FORMULA_0010 0 0 0.0 65535.0000 ECU_ADDRESS 0x3FA9E2 /end MEASUREMENT
/begin MEASUREMENT Pminfo1_8of37_ "Infospeicher 1 vom Powermanagement" UWORD FORMULA_0010 0 0 0.0 65535.0000 ECU_ADDRESS 0x3FA9E4 /end MEASUREMENT
/begin MEASUREMENT Pminfo1_9of37_ "Infospeicher 1 vom Powermanagement" UWORD FORMULA_0010 0 0 0.0 65535.0000 ECU_ADDRESS 0x3FA9E6 /end MEASUREMENT
/begin MEASUREMENT Pminfo1_10of37_ "Infospeicher 1 vom Powermanagement" UWORD FORMULA_0010 0 0 0.0 65535.0000 ECU_ADDRESS 0x3FA9E8 /end MEASUREMENT
/begin MEASUREMENT Pminfo1_11of37_ "Infospeicher 1 vom Powermanagement" UWORD FORMULA_0010 0 0 0.0 65535.0000 ECU_ADDRESS 0x3FA9EA /end MEASUREMENT
/begin MEASUREMENT Pminfo1_12of37_ "Infospeicher 1 vom Powermanagement" UWORD FORMULA_0010 0 0 0.0 65535.0000 ECU_ADDRESS 0x3FA9EC /end MEASUREMENT
/begin MEASUREMENT Pminfo1_13of37_ "Infospeicher 1 vom Powermanagement" UWORD FORMULA_0010 0 0 0.0 65535.0000 ECU_ADDRESS 0x3FA9EE /end MEASUREMENT
/begin MEASUREMENT Pminfo1_14of37_ "Infospeicher 1 vom Powermanagement" UWORD FORMULA_0010 0 0 0.0 65535.0000 ECU_ADDRESS 0x3FA9F0 /end MEASUREMENT
/begin MEASUREMENT Pminfo1_15of37_ "Infospeicher 1 vom Powermanagement" UWORD FORMULA_0010 0 0 0.0 65535.0000 ECU_ADDRESS 0x3FA9F2 /end MEASUREMENT
/begin MEASUREMENT Pminfo1_16of37_ "Infospeicher 1 vom Powermanagement" UWORD FORMULA_0010 0 0 0.0 65535.0000 ECU_ADDRESS 0x3FA9F4 /end MEASUREMENT
/begin MEASUREMENT Pminfo1_17of37_ "Infospeicher 1 vom Powermanagement" UWORD FORMULA_0010 0 0 0.0 65535.0000 ECU_ADDRESS 0x3FA9F6 /end MEASUREMENT
/begin MEASUREMENT Pminfo1_18of37_ "Infospeicher 1 vom Powermanagement" UWORD FORMULA_0010 0 0 0.0 65535.0000 ECU_ADDRESS 0x3FA9F8 /end MEASUREMENT
/begin MEASUREMENT Pminfo1_19of37_ "Infospeicher 1 vom Powermanagement" UWORD FORMULA_0010 0 0 0.0 65535.0000 ECU_ADDRESS 0x3FA9FA /end MEASUREMENT
/begin MEASUREMENT Pminfo1_20of37_ "Infospeicher 1 vom Powermanagement" UWORD FORMULA_0010 0 0 0.0 65535.0000 ECU_ADDRESS 0x3FA9FC /end MEASUREMENT
/begin MEASUREMENT Pminfo1_21of37_ "Infospeicher 1 vom Powermanagement" UWORD FORMULA_0010 0 0 0.0 65535.0000 ECU_ADDRESS 0x3FA9FE /end MEASUREMENT
/begin MEASUREMENT Pminfo1_22of37_ "Infospeicher 1 vom Powermanagement" UWORD FORMULA_0010 0 0 0.0 65535.0000 ECU_ADDRESS 0x3FAA00 /end MEASUREMENT
/begin MEASUREMENT Pminfo1_23of37_ "Infospeicher 1 vom Powermanagement" UWORD FORMULA_0010 0 0 0.0 65535.0000 ECU_ADDRESS 0x3FAA02 /end MEASUREMENT
/begin MEASUREMENT Pminfo1_24of37_ "Infospeicher 1 vom Powermanagement" UWORD FORMULA_0010 0 0 0.0 65535.0000 ECU_ADDRESS 0x3FAA04 /end MEASUREMENT
/begin MEASUREMENT Pminfo1_25of37_ "Infospeicher 1 vom Powermanagement" UWORD FORMULA_0010 0 0 0.0 65535.0000 ECU_ADDRESS 0x3FAA06 /end MEASUREMENT
/begin MEASUREMENT Pminfo1_26of37_ "Infospeicher 1 vom Powermanagement" UWORD FORMULA_0010 0 0 0.0 65535.0000 ECU_ADDRESS 0x3FAA08 /end MEASUREMENT
/begin MEASUREMENT Pminfo1_27of37_ "Infospeicher 1 vom Powermanagement" UWORD FORMULA_0010 0 0 0.0 65535.0000 ECU_ADDRESS 0x3FAA0A /end MEASUREMENT
/begin MEASUREMENT Pminfo1_28of37_ "Infospeicher 1 vom Powermanagement" UWORD FORMULA_0010 0 0 0.0 65535.0000 ECU_ADDRESS 0x3FAA0C /end MEASUREMENT
/begin MEASUREMENT Pminfo1_29of37_ "Infospeicher 1 vom Powermanagement" UWORD FORMULA_0010 0 0 0.0 65535.0000 ECU_ADDRESS 0x3FAA0E /end MEASUREMENT
/begin MEASUREMENT Pminfo1_30of37_ "Infospeicher 1 vom Powermanagement" UWORD FORMULA_0010 0 0 0.0 65535.0000 ECU_ADDRESS 0x3FAA10 /end MEASUREMENT
/begin MEASUREMENT Pminfo1_31of37_ "Infospeicher 1 vom Powermanagement" UWORD FORMULA_0010 0 0 0.0 65535.0000 ECU_ADDRESS 0x3FAA12 /end MEASUREMENT
/begin MEASUREMENT Pminfo1_32of37_ "Infospeicher 1 vom Powermanagement" UWORD FORMULA_0010 0 0 0.0 65535.0000 ECU_ADDRESS 0x3FAA14 /end MEASUREMENT
/begin MEASUREMENT Pminfo1_33of37_ "Infospeicher 1 vom Powermanagement" UWORD FORMULA_0010 0 0 0.0 65535.0000 ECU_ADDRESS 0x3FAA16 /end MEASUREMENT
/begin MEASUREMENT Pminfo1_34of37_ "Infospeicher 1 vom Powermanagement" UWORD FORMULA_0010 0 0 0.0 65535.0000 ECU_ADDRESS 0x3FAA18 /end MEASUREMENT
/begin MEASUREMENT Pminfo1_35of37_ "Infospeicher 1 vom Powermanagement" UWORD FORMULA_0010 0 0 0.0 65535.0000 ECU_ADDRESS 0x3FAA1A /end MEASUREMENT
/begin MEASUREMENT Pminfo1_36of37_ "Infospeicher 1 vom Powermanagement" UWORD FORMULA_0010 0 0 0.0 65535.0000 ECU_ADDRESS 0x3FAA1C /end MEASUREMENT
/begin MEASUREMENT Pminfo1_37of37_ "Infospeicher 1 vom Powermanagement" UWORD FORMULA_0010 0 0 0.0 65535.0000 ECU_ADDRESS 0x3FAA1E /end MEASUREMENT
/begin MEASUREMENT Qeladold7 "zuletzt gesp. qelad" UWORD FORMULA_0494 0 0 0.0 1192.7502 ECU_ADDRESS 0x3FAA20 /end MEASUREMENT
/begin MEASUREMENT Qladold7 "zuletzt gesp. qlad" UWORD FORMULA_0494 0 0 0.0 1192.7502 ECU_ADDRESS 0x3FAA22 /end MEASUREMENT
/begin MEASUREMENT Ztageold "letzter Wert von ztageabs_w" UWORD FORMULA_0010 0 0 0.0 65535.0000 ECU_ADDRESS 0x3FAA24 /end MEASUREMENT
/begin MEASUREMENT Fs_pm "Fehlerspeicher Powermanagement, Bitcodiert" UBYTE FORMULA_0003 0 0 0.0 255.0000 ECU_ADDRESS 0x3FAA26 /end MEASUREMENT
/begin MEASUREMENT Pminfo2_1of29_ "Fehlerinfo2 vom Powermanagement" UBYTE FORMULA_0003 0 0 0.0 255.0000 ECU_ADDRESS 0x3FAA27 /end MEASUREMENT
/begin MEASUREMENT Pminfo2_2of29_ "Fehlerinfo2 vom Powermanagement" UBYTE FORMULA_0003 0 0 0.0 255.0000 ECU_ADDRESS 0x3FAA28 /end MEASUREMENT
/begin MEASUREMENT Pminfo2_3of29_ "Fehlerinfo2 vom Powermanagement" UBYTE FORMULA_0003 0 0 0.0 255.0000 ECU_ADDRESS 0x3FAA29 /end MEASUREMENT
/begin MEASUREMENT Pminfo2_4of29_ "Fehlerinfo2 vom Powermanagement" UBYTE FORMULA_0003 0 0 0.0 255.0000 ECU_ADDRESS 0x3FAA2A /end MEASUREMENT
/begin MEASUREMENT Pminfo2_5of29_ "Fehlerinfo2 vom Powermanagement" UBYTE FORMULA_0003 0 0 0.0 255.0000 ECU_ADDRESS 0x3FAA2B /end MEASUREMENT
/begin MEASUREMENT Pminfo2_6of29_ "Fehlerinfo2 vom Powermanagement" UBYTE FORMULA_0003 0 0 0.0 255.0000 ECU_ADDRESS 0x3FAA2C /end MEASUREMENT
/begin MEASUREMENT Pminfo2_7of29_ "Fehlerinfo2 vom Powermanagement" UBYTE FORMULA_0003 0 0 0.0 255.0000 ECU_ADDRESS 0x3FAA2D /end MEASUREMENT
/begin MEASUREMENT Pminfo2_8of29_ "Fehlerinfo2 vom Powermanagement" UBYTE FORMULA_0003 0 0 0.0 255.0000 ECU_ADDRESS 0x3FAA2E /end MEASUREMENT
/begin MEASUREMENT Pminfo2_9of29_ "Fehlerinfo2 vom Powermanagement" UBYTE FORMULA_0003 0 0 0.0 255.0000 ECU_ADDRESS 0x3FAA2F /end MEASUREMENT
/begin MEASUREMENT Pminfo2_10of29_ "Fehlerinfo2 vom Powermanagement" UBYTE FORMULA_0003 0 0 0.0 255.0000 ECU_ADDRESS 0x3FAA30 /end MEASUREMENT
/begin MEASUREMENT Pminfo2_11of29_ "Fehlerinfo2 vom Powermanagement" UBYTE FORMULA_0003 0 0 0.0 255.0000 ECU_ADDRESS 0x3FAA31 /end MEASUREMENT
/begin MEASUREMENT Pminfo2_12of29_ "Fehlerinfo2 vom Powermanagement" UBYTE FORMULA_0003 0 0 0.0 255.0000 ECU_ADDRESS 0x3FAA32 /end MEASUREMENT
/begin MEASUREMENT Pminfo2_13of29_ "Fehlerinfo2 vom Powermanagement" UBYTE FORMULA_0003 0 0 0.0 255.0000 ECU_ADDRESS 0x3FAA33 /end MEASUREMENT
/begin MEASUREMENT Pminfo2_14of29_ "Fehlerinfo2 vom Powermanagement" UBYTE FORMULA_0003 0 0 0.0 255.0000 ECU_ADDRESS 0x3FAA34 /end MEASUREMENT
/begin MEASUREMENT Pminfo2_15of29_ "Fehlerinfo2 vom Powermanagement" UBYTE FORMULA_0003 0 0 0.0 255.0000 ECU_ADDRESS 0x3FAA35 /end MEASUREMENT
/begin MEASUREMENT Pminfo2_16of29_ "Fehlerinfo2 vom Powermanagement" UBYTE FORMULA_0003 0 0 0.0 255.0000 ECU_ADDRESS 0x3FAA36 /end MEASUREMENT
/begin MEASUREMENT Pminfo2_17of29_ "Fehlerinfo2 vom Powermanagement" UBYTE FORMULA_0003 0 0 0.0 255.0000 ECU_ADDRESS 0x3FAA37 /end MEASUREMENT
/begin MEASUREMENT Pminfo2_18of29_ "Fehlerinfo2 vom Powermanagement" UBYTE FORMULA_0003 0 0 0.0 255.0000 ECU_ADDRESS 0x3FAA38 /end MEASUREMENT
/begin MEASUREMENT Pminfo2_19of29_ "Fehlerinfo2 vom Powermanagement" UBYTE FORMULA_0003 0 0 0.0 255.0000 ECU_ADDRESS 0x3FAA39 /end MEASUREMENT
/begin MEASUREMENT Pminfo2_20of29_ "Fehlerinfo2 vom Powermanagement" UBYTE FORMULA_0003 0 0 0.0 255.0000 ECU_ADDRESS 0x3FAA3A /end MEASUREMENT
/begin MEASUREMENT Pminfo2_21of29_ "Fehlerinfo2 vom Powermanagement" UBYTE FORMULA_0003 0 0 0.0 255.0000 ECU_ADDRESS 0x3FAA3B /end MEASUREMENT
/begin MEASUREMENT Pminfo2_22of29_ "Fehlerinfo2 vom Powermanagement" UBYTE FORMULA_0003 0 0 0.0 255.0000 ECU_ADDRESS 0x3FAA3C /end MEASUREMENT
/begin MEASUREMENT Pminfo2_23of29_ "Fehlerinfo2 vom Powermanagement" UBYTE FORMULA_0003 0 0 0.0 255.0000 ECU_ADDRESS 0x3FAA3D /end MEASUREMENT
/begin MEASUREMENT Pminfo2_24of29_ "Fehlerinfo2 vom Powermanagement" UBYTE FORMULA_0003 0 0 0.0 255.0000 ECU_ADDRESS 0x3FAA3E /end MEASUREMENT
/begin MEASUREMENT Pminfo2_25of29_ "Fehlerinfo2 vom Powermanagement" UBYTE FORMULA_0003 0 0 0.0 255.0000 ECU_ADDRESS 0x3FAA3F /end MEASUREMENT
/begin MEASUREMENT Pminfo2_26of29_ "Fehlerinfo2 vom Powermanagement" UBYTE FORMULA_0003 0 0 0.0 255.0000 ECU_ADDRESS 0x3FAA40 /end MEASUREMENT
/begin MEASUREMENT Pminfo2_27of29_ "Fehlerinfo2 vom Powermanagement" UBYTE FORMULA_0003 0 0 0.0 255.0000 ECU_ADDRESS 0x3FAA41 /end MEASUREMENT
/begin MEASUREMENT Pminfo2_28of29_ "Fehlerinfo2 vom Powermanagement" UBYTE FORMULA_0003 0 0 0.0 255.0000 ECU_ADDRESS 0x3FAA42 /end MEASUREMENT
/begin MEASUREMENT Pminfo2_29of29_ "Fehlerinfo2 vom Powermanagement" UBYTE FORMULA_0003 0 0 0.0 255.0000 ECU_ADDRESS 0x3FAA43 /end MEASUREMENT
/* ------------------ Abschnitt erzeugt aus pmprsvcalc.dat ------------------ */
/begin CHARACTERISTIC K_DSOCPCOS "dsoc, unterhalb derer die Standverbraucher deaktiviert werden." VALUE 0x759D6 TKW_VV_VV_SW 100.0 FORMULA_0475 -100.0000 99.9969 FORMAT "%5.2" /end CHARACTERISTIC
/begin CHARACTERISTIC K_NKW2HIPTC "Nkw i.O. PTC darf zugeschaltet werden. | EN: Nkw i.O. PTC darf zugeschaltet werden." VALUE 0x759D8 TKW_VV_VV_SW 100.0 FORMULA_0006 -32768.0000 32767.0000 /end CHARACTERISTIC
/begin CHARACTERISTIC K_NKW2LOWPTC "Nkw zu niedrig, PTC wird abgeschaltet | EN: Nkw zu niedrig, PTC wird abgeschaltet" VALUE 0x759DA TKW_VV_VV_SW 100.0 FORMULA_0006 -32768.0000 32767.0000 /end CHARACTERISTIC
/begin CHARACTERISTIC K_DUDTPTCAUS "K-Faktor f�r dudt-PTC Abschaltung" VALUE 0x759DC TKW_VV_VV_UW 100.0 FORMULA_0457 0.0 9.99984741210938e-1 FORMAT "%7.4" /end CHARACTERISTIC
/begin CHARACTERISTIC K_IPMPMDEC "Prio-dekrementfaktor aufgrund IPM | EN: Prio-dekrementfaktor aufgrund IPM" VALUE 0x759DE TKW_VV_VV_UW 100.0 FORMULA_0503 0.0 450.0000 FORMAT "%6.3" /end CHARACTERISTIC
/begin CHARACTERISTIC K_IPMPMINC "Prio-Inkrementfaktor aufgrund IPM | EN: Prio-Inkrementfaktor aufgrund IPM" VALUE 0x759E0 TKW_VV_VV_UW 100.0 FORMULA_0503 0.0 450.0000 FORMAT "%6.3" /end CHARACTERISTIC
/begin CHARACTERISTIC K_MN_PTCPI "Minimalwert des PI-Reglers PTC Ansteuerung | EN: Minimum value of PI controller, PTC control" VALUE 0x759E2 TKW_VV_VV_UW 100.0 FORMULA_0480 0.0 511.9921 FORMAT "%5.2" /end CHARACTERISTIC
/begin CHARACTERISTIC K_MN_PWRDFPI "Minimaler Wert PI-Regler df Prio | EN: Minimum value of PI controller, generator priority" VALUE 0x759E4 TKW_VV_VV_UW 100.0 FORMULA_0480 0.0 511.9921 FORMAT "%5.2" /end CHARACTERISTIC
/begin CHARACTERISTIC K_MX_PTCPI "Maximalwert des PI-Reglers PTC Ansteuerung | EN: Maximum value of PI controller, PTC control" VALUE 0x759E6 TKW_VV_VV_UW 100.0 FORMULA_0480 0.0 511.9921 FORMAT "%5.2" /end CHARACTERISTIC
/begin CHARACTERISTIC K_PWRCOS15 "PWRCOS bei Kl.15, Motor aus | EN: Consumer power control at terminal 15, engine off" VALUE 0x759E8 TKW_VV_VV_UW 100.0 FORMULA_0010 0.0 65535.0000 /end CHARACTERISTIC
/begin CHARACTERISTIC K_PWRCOSAPP "Steuerung Leistung Verbraucher bitcodiert Applikationsgroesse | EN: Consumer power control, bit-coded calibration value" VALUE 0x759EA TKW_VV_VV_UW 100.0 FORMULA_0010 0.0 65535.0000 /end CHARACTERISTIC
/begin CHARACTERISTIC K_PWRCOSHT "ctrpwrcos-Wert bei Generator Hochtemperatur | EN: Consumer power control value at high generator temperature" VALUE 0x759EC TKW_VV_VV_UW 100.0 FORMULA_0010 0.0 65535.0000 /end CHARACTERISTIC
/begin CHARACTERISTIC K_PWRCOSULEV "Bitcodierte ctrpwrcos Zuschaltung bei Sulev | EN: Bitcodierte ctrpwrcos Zuschaltung bei Sulev" VALUE 0x759EE TKW_VV_VV_UW 100.0 FORMULA_0010 0.0 65535.0000 /end CHARACTERISTIC
/begin CHARACTERISTIC K_PWRCOS_R "PowerCos Bitcodiert bei Kl.R" VALUE 0x759F0 TKW_VV_VV_UW 100.0 FORMULA_0010 0.0 65535.0000 /end CHARACTERISTIC
/begin CHARACTERISTIC K_PWRCSGNDEF "ctrpwrcos-Wert bei Gen. mechn. el. Fehler | EN: ctrpwrcos-Wert bei Gen. mechn. el. Fehler" VALUE 0x759F2 TKW_VV_VV_UW 100.0 FORMULA_0010 0.0 65535.0000 /end CHARACTERISTIC
/begin CHARACTERISTIC K_PWRCSKOMM "ctrpwrcos Wert bei Gen. Komm. Fehler" VALUE 0x759F4 TKW_VV_VV_UW 100.0 FORMULA_0010 0.0 65535.0000 /end CHARACTERISTIC
/begin CHARACTERISTIC K_TD_PWRDFPI "K-Faktor des PI Reglers zur Berechnung von ctrpwrdf | EN: K-Faktor des PI Reglers zur Berechnung von ctrpwrdf" VALUE 0x759F6 TKW_VV_VV_UW 100.0 FORMULA_0073 0.1000 6553.5000 FORMAT "%4.1" /end CHARACTERISTIC
/begin CHARACTERISTIC K_T_PTCPI "T-Faktor des PI-Reglers f�r PTC-Ansteuerung | EN: T-Faktor des PI-Reglers fï¿½r PTC-Ansteuerung" VALUE 0x759F8 TKW_VV_VV_UW 100.0 FORMULA_0073 0.1000 6553.5000 FORMAT "%4.1" /end CHARACTERISTIC
/begin CHARACTERISTIC K_T_SULEVON "Zeit f�r SULEV-ctrpwrcos-prios nach Motorstart | EN: Zeit fï¿½r SULEV-ctrpwrcos-prios nach Motorstart" VALUE 0x759FA TKW_VV_VV_UW 100.0 FORMULA_0073 0.0 6553.5000 FORMAT "%4.1" /end CHARACTERISTIC
/begin CHARACTERISTIC K_UBAT_LP "K-Faktor des ubatt-tiefpass Filters zur Berechnung von ctrpwrdf | EN: K-Faktor des ubatt-tiefpass Filters zur Berechnung von ctrpwrdf" VALUE 0x759FC TKW_VV_VV_UW 100.0 FORMULA_0457 0.0 9.99984741210938e-1 FORMAT "%7.4" /end CHARACTERISTIC
/begin CHARACTERISTIC K_UBPTC_LP "K-Faktor des ubatt-Tiefpass Filters zur Berechnung von PTC" VALUE 0x759FE TKW_VV_VV_UW 100.0 FORMULA_0457 0.0 9.99984741210938e-1 FORMAT "%7.4" /end CHARACTERISTIC
/begin CHARACTERISTIC K_UBTAPP "Batteriespannung Applikationsgroesse | EN: Batteriespannung Applikationsgroesse" VALUE 0x75A00 TKW_VV_VV_UW 100.0 FORMULA_0505 0.0 61.4250 FORMAT "%6.3" /end CHARACTERISTIC
/begin CHARACTERISTIC K_UBTLOWMAX "Obere Unterspannungsgrenze | EN: Obere Unterspannungsgrenze" VALUE 0x75A02 TKW_VV_VV_UW 100.0 FORMULA_0497 6.0000 16.0000 FORMAT "%6.3" /end CHARACTERISTIC
/begin CHARACTERISTIC K_UBTLOWMIN "Untere Unterspannungsgrenze | EN: Untere Unterspannungsgrenze" VALUE 0x75A04 TKW_VV_VV_UW 100.0 FORMULA_0497 6.0000 16.0000 FORMAT "%6.3" /end CHARACTERISTIC
/begin CHARACTERISTIC K_CTRCBRA "" VALUE 0x75A06 TKW_VV_VV_UB 100.0 FORMULA_0003 0.0 255.0000 /end CHARACTERISTIC
/begin CHARACTERISTIC K_CTRCBRAPP "Steuerung Stromzweige Applikationsgroesse" VALUE 0x75A07 TKW_VV_VV_UB 100.0 FORMULA_0003 0.0 255.0000 /end CHARACTERISTIC
/begin CHARACTERISTIC K_CTRCBRKBM "CTRCBR APP bei B_startfgk" VALUE 0x75A08 TKW_VV_VV_UB 100.0 FORMULA_0003 0.0 255.0000 /end CHARACTERISTIC
/begin CHARACTERISTIC K_CTRPCOSAPP "Steuerung Standverbraucher Applikationsgroesse" VALUE 0x75A09 TKW_VV_VV_UB 100.0 FORMULA_0003 0.0 3.0000 /end CHARACTERISTIC
/begin CHARACTERISTIC K_CTRPRIOAPP "Steuerung Spitzenreduzierung Prioritaet Applikationsgroesse | EN: Steuerung Spitzenreduzierung Prioritaet Applikationsgroesse" VALUE 0x75A0A TKW_VV_VV_UB 100.0 FORMULA_0003 0.0 7.0000 /end CHARACTERISTIC
/begin CHARACTERISTIC K_DFFILTAPP "Schalter, um dffgenfilt auf DFFILT_APP umzustellen | EN: Schalter, um dffgenfilt auf DFFILT_APP umzustellen" VALUE 0x75A0B TKW_VV_VV_UB 100.0 FORMULA_0471 0.0 99.6093 /end CHARACTERISTIC
/begin CHARACTERISTIC K_DFKOMMERR "Ersatzwert Dffgen bei Gen. Komm. Fehler | EN: Ersatzwert Dffgen bei Gen. Komm. Fehler" VALUE 0x75A0C TKW_VV_VV_UB 100.0 FORMULA_0471 0.0 99.6093 /end CHARACTERISTIC
/begin CHARACTERISTIC K_DFPTC_LP "K-Faktor des df-Tiefpass Filters zur Berechnung von PTC | EN: K-Faktor des df-Tiefpass Filters zur Berechnung von PTC" VALUE 0x75A0D TKW_VV_VV_UB 100.0 FORMULA_0434 0.0 0.9960 /end CHARACTERISTIC
/begin CHARACTERISTIC K_DF_LP "K-Faktor des df-Tiefpass Filters zur Berechnung von ctrpwrdf | EN: K-Faktor des df-Tiefpass Filters zur Berechnung von ctrpwrdf" VALUE 0x75A0E TKW_VV_VV_UB 100.0 FORMULA_0434 0.0 0.9960 /end CHARACTERISTIC
/begin CHARACTERISTIC K_IBSWAKEAPP "Bit, ob IBS Bus wecken darf oder nicht. Applikationsgroesse. | EN: Bit, ob IBS Bus wecken darf oder nicht. Applikationsgroesse." VALUE 0x75A0F TKW_VV_VV_UB 100.0 FORMULA_0003 0.0 255.0000 /end CHARACTERISTIC
/begin CHARACTERISTIC K_KBMCNT_APP "Zeit, indem KBM alle Straenge einschalten soll. | EN: Zeit, indem KBM alle Straenge einschalten soll." VALUE 0x75A10 TKW_VV_VV_UB 100.0 FORMULA_0458 0.0 25.5000 /end CHARACTERISTIC
/begin CHARACTERISTIC K_LLPMFILTK "Filterkonstante : Tiefpassfilter DF-Signal | EN: Filterkonstante : Tiefpassfilter DF-Signal" VALUE 0x75A11 TKW_VV_VV_UB 100.0 FORMULA_0434 0.0 0.9960 /end CHARACTERISTIC
/begin CHARACTERISTIC K_PM_IPMON "IPM Massnahmen bzgl. PM aktiviert" VALUE 0x75A12 TKW_VV_VV_UB 100.0 FORMULA_0003 0.0 3.0000 /end CHARACTERISTIC
/begin CHARACTERISTIC K_PRIO15 "Prios bei Kl.15, Motor aus | EN: Prios bei Kl.15, Motor aus" VALUE 0x75A13 TKW_VV_VV_UB 100.0 FORMULA_0003 0.0 7.0000 /end CHARACTERISTIC
/begin CHARACTERISTIC K_PRIOCF15 "PrioCF bei kl.15, Motor aus | EN: PrioCF bei kl.15, Motor aus" VALUE 0x75A14 TKW_VV_VV_UB 100.0 FORMULA_0003 0.0 7.0000 /end CHARACTERISTIC
/begin CHARACTERISTIC K_PRIOCFAPP "Steuerung Spitzenreduzierung Prioritaet Komfort App | EN: Steuerung Spitzenreduzierung Prioritaet Komfort App" VALUE 0x75A15 TKW_VV_VV_UB 100.0 FORMULA_0003 0.0 7.0000 /end CHARACTERISTIC
/begin CHARACTERISTIC K_PRIOCF_R "Prio Comfort Bei Kl.R | EN: Prio Comfort Bei Kl.R" VALUE 0x75A16 TKW_VV_VV_UB 100.0 FORMULA_0003 0.0 7.0000 /end CHARACTERISTIC
/begin CHARACTERISTIC K_PRIO_R "Prio Bei Kl.R | EN: Prio Bei Kl.R" VALUE 0x75A17 TKW_VV_VV_UB 100.0 FORMULA_0003 0.0 7.0000 /end CHARACTERISTIC
/begin CHARACTERISTIC K_PTCPWRAPP "Ansteuerung PWM-Ausgang f�r PTC-Zuheizer. Applikationsgroesse. | EN: Ansteuerung PWM-Ausgang fï¿½r PTC-Zuheizer. Applikationsgroesse." VALUE 0x75A18 TKW_VV_VV_UB 100.0 FORMULA_0506 0.0 127.5000 /end CHARACTERISTIC
/begin CHARACTERISTIC K_PTC_PI "K-Faktor des PI-Reglers PTC-Ansteuerung | EN: K-Faktor des PI-Reglers PTC-Ansteuerung" VALUE 0x75A19 TKW_VV_VV_UB 100.0 FORMULA_0434 0.0 0.9960 /end CHARACTERISTIC
/begin CHARACTERISTIC K_PWRDF_PI "K-Faktor des PI Reglers zur Berechnung von ctrpwrdf | EN: K-Faktor des PI Reglers zur Berechnung von ctrpwrdf" VALUE 0x75A1A TKW_VV_VV_UB 100.0 FORMULA_0434 0.0 0.9960 /end CHARACTERISTIC
/begin CHARACTERISTIC K_RESET_PI "PI-Reset-Zeit bei steigender Kl.15 | EN: PI-Reset-Zeit bei steigender Kl.15" VALUE 0x75A1B TKW_VV_VV_UB 100.0 FORMULA_0458 0.0 25.5000 /end CHARACTERISTIC
/begin CHARACTERISTIC K_RQPCOSA "Parameter f�r SV-Anmeldung | EN: Parameter fï¿½r SV-Anmeldung" VALUE 0x75A1C TKW_VV_VV_UB 100.0 FORMULA_0003 0.0 3.0000 /end CHARACTERISTIC
/begin CHARACTERISTIC K_RQPCOSAPP "Anforderung Standverbraucher Applikationsgroesse" VALUE 0x75A1D TKW_VV_VV_UB 100.0 FORMULA_0003 0.0 255.0000 /end CHARACTERISTIC
/begin CHARACTERISTIC K_RQULCP "RQPCOS Master umschalter" VALUE 0x75A1E TKW_VV_VV_UB 100.0 FORMULA_0003 0.0 4.0000 /end CHARACTERISTIC
/begin CHARACTERISTIC K_SELSPCOSA "Spezialverbraucher | EN: Spezialverbraucher" VALUE 0x75A1F TKW_VV_VV_UB 100.0 FORMULA_0003 0.0 15.0000 /end CHARACTERISTIC
/begin CHARACTERISTIC K_SELSPCSAPP "Auswahl Sonderverbraucher Applikationsgroesse | EN: Auswahl Sonderverbraucher Applikationsgroesse" VALUE 0x75A20 TKW_VV_VV_UB 100.0 FORMULA_0003 0.0 15.0000 /end CHARACTERISTIC
/begin CHARACTERISTIC K_STPCOSAPP "Status Standverbraucher Applikationsgroesse | EN: Status Standverbraucher Applikationsgroesse" VALUE 0x75A21 TKW_VV_VV_UB 100.0 FORMULA_0003 0.0 3.0000 /end CHARACTERISTIC
/begin CHARACTERISTIC K_T_IPMPRIO "max. Zeit, indem Prio aufgrund IPM gesteuert wird" VALUE 0x75A22 TKW_VV_VV_UB 100.0 FORMULA_0458 0.0 25.5000 /end CHARACTERISTIC
/begin CHARACTERISTIC K_T_NKPTCAUS "Zeit PTC aus aufgrund NKW zu niedrig. | EN: Zeit PTC aus aufgrund NKW zu niedrig." VALUE 0x75A23 TKW_VV_VV_UB 100.0 FORMULA_0458 0.0 25.5000 /end CHARACTERISTIC
/begin CHARACTERISTIC K_T_PMBS "Zeit bis zum n�chsten zyklischen senden" VALUE 0x75A24 TKW_VV_VV_UB 100.0 FORMULA_0472 0.0 255.0000 /end CHARACTERISTIC
/begin CHARACTERISTIC K_T_PMVS "Zeit zwischen zwei zyklischen Sendungen von 3b3  | EN: Zeit zwischen zwei zyklischen Sendungen von 3b3" VALUE 0x75A25 TKW_VV_VV_UB 100.0 FORMULA_0472 0.0 255.0000 /end CHARACTERISTIC
/begin CHARACTERISTIC K_T_PTCKWAN "PTC-Ein Wartezeit nach Motor an. | EN: PTC-Ein Wartezeit nach Motor an." VALUE 0x75A26 TKW_VV_VV_UB 100.0 FORMULA_0458 0.0 25.5000 /end CHARACTERISTIC
/begin CHARACTERISTIC K_ULEVA "Spannungslevel" VALUE 0x75A27 TKW_VV_VV_UB 100.0 FORMULA_0003 0.0 255.0000 /end CHARACTERISTIC
/begin CHARACTERISTIC K_ULEVAPP "Spannungsebene Applikationsgroesse" VALUE 0x75A28 TKW_VV_VV_UB 100.0 FORMULA_0003 0.0 15.0000 /end CHARACTERISTIC
/begin CHARACTERISTIC K_ULOWSETAPP "Entrpellzeit zentrale Unterspannung" VALUE 0x75A29 TKW_VV_VV_UB 100.0 FORMULA_0458 0.0 25.5000 /end CHARACTERISTIC
/begin CHARACTERISTIC S_DFKOMMERR "Ma�nahmen bei Gen. Komm. Fehler aktiv" VALUE 0x75A2A TKW_VV_VV_UB 100.0 FORMULA_0474 0.0 1.0000 /end CHARACTERISTIC
/begin CHARACTERISTIC S_IPMPTC "PTC Einschr�nkung aufgrund IPM | EN: PTC Einschrï¿½nkung aufgrund IPM" VALUE 0x75A2B TKW_VV_VV_UB 100.0 FORMULA_0474 0.0 1.0000 /end CHARACTERISTIC
/begin CHARACTERISTIC S_PMMESS "Schalter Messemode aktiv | EN: Schalter Messemode aktiv" VALUE 0x75A2C TKW_VV_VV_UB 100.0 FORMULA_0474 0.0 1.0000 /end CHARACTERISTIC
/begin CHARACTERISTIC S_PRIOCFENA "" VALUE 0x75A2D TKW_VV_VV_UB 100.0 FORMULA_0474 0.0 1.0000 /end CHARACTERISTIC
/begin CHARACTERISTIC S_PRIOMANUAL "Manueller Schalter fuer E60/E65-Can Botschaften | EN: Manueller Schalter fuer E60/E65-Can Botschaften" VALUE 0x75A2E TKW_VV_VV_UB 100.0 FORMULA_0003 0.0 255.0000 /end CHARACTERISTIC
/begin CHARACTERISTIC S_PTCKOOR "Schalter Aktivierung PTC Koordinator im PMPRSVCALC | EN: Schalter Aktivierung PTC Koordinator im PMPRSVCALC" VALUE 0x75A2F TKW_VV_VV_UB 100.0 FORMULA_0474 0.0 1.0000 /end CHARACTERISTIC
/begin CHARACTERISTIC S_PTCMANUAL "Schalter manueller PTC Wert aktivieren. | EN: Switch to activate manual PTC value" VALUE 0x75A30 TKW_VV_VV_UB 100.0 FORMULA_0474 0.0 1.0000 /end CHARACTERISTIC
/begin CHARACTERISTIC S_PWRCFENA "" VALUE 0x75A31 TKW_VV_VV_UB 100.0 FORMULA_0474 0.0 1.0000 /end CHARACTERISTIC
/begin CHARACTERISTIC K_CTRPWRCF_1of7_ "" VALUE 0x75A32 TKW_VV_VV_UW 100.0 FORMULA_0010 0.0 65535.0000 /end CHARACTERISTIC
/begin CHARACTERISTIC K_CTRPWRCF_2of7_ "" VALUE 0x75A34 TKW_VV_VV_UW 100.0 FORMULA_0010 0.0 65535.0000 /end CHARACTERISTIC
/begin CHARACTERISTIC K_CTRPWRCF_3of7_ "" VALUE 0x75A36 TKW_VV_VV_UW 100.0 FORMULA_0010 0.0 65535.0000 /end CHARACTERISTIC
/begin CHARACTERISTIC K_CTRPWRCF_4of7_ "" VALUE 0x75A38 TKW_VV_VV_UW 100.0 FORMULA_0010 0.0 65535.0000 /end CHARACTERISTIC
/begin CHARACTERISTIC K_CTRPWRCF_5of7_ "" VALUE 0x75A3A TKW_VV_VV_UW 100.0 FORMULA_0010 0.0 65535.0000 /end CHARACTERISTIC
/begin CHARACTERISTIC K_CTRPWRCF_6of7_ "" VALUE 0x75A3C TKW_VV_VV_UW 100.0 FORMULA_0010 0.0 65535.0000 /end CHARACTERISTIC
/begin CHARACTERISTIC K_CTRPWRCF_7of7_ "" VALUE 0x75A3E TKW_VV_VV_UW 100.0 FORMULA_0010 0.0 65535.0000 /end CHARACTERISTIC
/begin CHARACTERISTIC K_CTRPWRDF_1of14_ "" VALUE 0x75A40 TKW_VV_VV_UW 100.0 FORMULA_0010 0.0 65535.0000 /end CHARACTERISTIC
/begin CHARACTERISTIC K_CTRPWRDF_2of14_ "" VALUE 0x75A42 TKW_VV_VV_UW 100.0 FORMULA_0010 0.0 65535.0000 /end CHARACTERISTIC
/begin CHARACTERISTIC K_CTRPWRDF_3of14_ "" VALUE 0x75A44 TKW_VV_VV_UW 100.0 FORMULA_0010 0.0 65535.0000 /end CHARACTERISTIC
/begin CHARACTERISTIC K_CTRPWRDF_4of14_ "" VALUE 0x75A46 TKW_VV_VV_UW 100.0 FORMULA_0010 0.0 65535.0000 /end CHARACTERISTIC
/begin CHARACTERISTIC K_CTRPWRDF_5of14_ "" VALUE 0x75A48 TKW_VV_VV_UW 100.0 FORMULA_0010 0.0 65535.0000 /end CHARACTERISTIC
/begin CHARACTERISTIC K_CTRPWRDF_6of14_ "" VALUE 0x75A4A TKW_VV_VV_UW 100.0 FORMULA_0010 0.0 65535.0000 /end CHARACTERISTIC
/begin CHARACTERISTIC K_CTRPWRDF_7of14_ "" VALUE 0x75A4C TKW_VV_VV_UW 100.0 FORMULA_0010 0.0 65535.0000 /end CHARACTERISTIC
/begin CHARACTERISTIC K_CTRPWRDF_8of14_ "" VALUE 0x75A4E TKW_VV_VV_UW 100.0 FORMULA_0010 0.0 65535.0000 /end CHARACTERISTIC
/begin CHARACTERISTIC K_CTRPWRDF_9of14_ "" VALUE 0x75A50 TKW_VV_VV_UW 100.0 FORMULA_0010 0.0 65535.0000 /end CHARACTERISTIC
/begin CHARACTERISTIC K_CTRPWRDF_10of14_ "" VALUE 0x75A52 TKW_VV_VV_UW 100.0 FORMULA_0010 0.0 65535.0000 /end CHARACTERISTIC
/begin CHARACTERISTIC K_CTRPWRDF_11of14_ "" VALUE 0x75A54 TKW_VV_VV_UW 100.0 FORMULA_0010 0.0 65535.0000 /end CHARACTERISTIC
/begin CHARACTERISTIC K_CTRPWRDF_12of14_ "" VALUE 0x75A56 TKW_VV_VV_UW 100.0 FORMULA_0010 0.0 65535.0000 /end CHARACTERISTIC
/begin CHARACTERISTIC K_CTRPWRDF_13of14_ "" VALUE 0x75A58 TKW_VV_VV_UW 100.0 FORMULA_0010 0.0 65535.0000 /end CHARACTERISTIC
/begin CHARACTERISTIC K_CTRPWRDF_14of14_ "" VALUE 0x75A5A TKW_VV_VV_UW 100.0 FORMULA_0010 0.0 65535.0000 /end CHARACTERISTIC
/begin CHARACTERISTIC K_CTRPRIOCF_1of7_ "" VALUE 0x75A5C TKW_VV_VV_UB 100.0 FORMULA_0003 0.0 255.0000 /end CHARACTERISTIC
/begin CHARACTERISTIC K_CTRPRIOCF_2of7_ "" VALUE 0x75A5D TKW_VV_VV_UB 100.0 FORMULA_0003 0.0 255.0000 /end CHARACTERISTIC
/begin CHARACTERISTIC K_CTRPRIOCF_3of7_ "" VALUE 0x75A5E TKW_VV_VV_UB 100.0 FORMULA_0003 0.0 255.0000 /end CHARACTERISTIC
/begin CHARACTERISTIC K_CTRPRIOCF_4of7_ "" VALUE 0x75A5F TKW_VV_VV_UB 100.0 FORMULA_0003 0.0 255.0000 /end CHARACTERISTIC
/begin CHARACTERISTIC K_CTRPRIOCF_5of7_ "" VALUE 0x75A60 TKW_VV_VV_UB 100.0 FORMULA_0003 0.0 255.0000 /end CHARACTERISTIC
/begin CHARACTERISTIC K_CTRPRIOCF_6of7_ "" VALUE 0x75A61 TKW_VV_VV_UB 100.0 FORMULA_0003 0.0 255.0000 /end CHARACTERISTIC
/begin CHARACTERISTIC K_CTRPRIOCF_7of7_ "" VALUE 0x75A62 TKW_VV_VV_UB 100.0 FORMULA_0003 0.0 255.0000 /end CHARACTERISTIC
/begin CHARACTERISTIC K_PRIODF_1of7_ "" VALUE 0x75A63 TKW_VV_VV_UB 100.0 FORMULA_0003 0.0 255.0000 /end CHARACTERISTIC
/begin CHARACTERISTIC K_PRIODF_2of7_ "" VALUE 0x75A64 TKW_VV_VV_UB 100.0 FORMULA_0003 0.0 255.0000 /end CHARACTERISTIC
/begin CHARACTERISTIC K_PRIODF_3of7_ "" VALUE 0x75A65 TKW_VV_VV_UB 100.0 FORMULA_0003 0.0 255.0000 /end CHARACTERISTIC
/begin CHARACTERISTIC K_PRIODF_4of7_ "" VALUE 0x75A66 TKW_VV_VV_UB 100.0 FORMULA_0003 0.0 255.0000 /end CHARACTERISTIC
/begin CHARACTERISTIC K_PRIODF_5of7_ "" VALUE 0x75A67 TKW_VV_VV_UB 100.0 FORMULA_0003 0.0 255.0000 /end CHARACTERISTIC
/begin CHARACTERISTIC K_PRIODF_6of7_ "" VALUE 0x75A68 TKW_VV_VV_UB 100.0 FORMULA_0003 0.0 255.0000 /end CHARACTERISTIC
/begin CHARACTERISTIC K_PRIODF_7of7_ "" VALUE 0x75A69 TKW_VV_VV_UB 100.0 FORMULA_0003 0.0 255.0000 /end CHARACTERISTIC
/begin CHARACTERISTIC KL_UB_PTC "UBatt-Kennlinie f�r Ansteuerung PTC" CURVE 0x75A6A TKL_SW_VV_SW 100.0 FORMULA_0501 -100.0000 100.0000
 /begin AXIS_DESCR STD_AXIS Ubtpt1ptc FORMULA_0444 6 -32.0000 31.9990 FORMAT "%7.4" /end AXIS_DESCR
 FORMAT "%5.2" /end CHARACTERISTIC
/begin CHARACTERISTIC KL_PTC "PWM-�bersetzer f�r PTC-Ansteuerung | EN: PWM translator for PTC heater control" CURVE 0x75A84 TKL_UW_VV_UB 100.0 FORMULA_0506 0.0 127.5000
 /begin AXIS_DESCR STD_AXIS Allptcfilt FORMULA_0503 5 0.0 16383.7500 FORMAT "%6.3" /end AXIS_DESCR
/end CHARACTERISTIC
/begin CHARACTERISTIC KL_I2PTC "I-Delta �bersetzer zu PTC Ansteuerung" CURVE 0x75A96 TKL_UW_VV_SW 100.0 FORMULA_0501 -100.0000 100.0000
 /begin AXIS_DESCR STD_AXIS Isolldiff FORMULA_0504 6 -200.0000 5042.8000 FORMAT "%6.3" /end AXIS_DESCR
 FORMAT "%5.2" /end CHARACTERISTIC
/begin CHARACTERISTIC KL_PRIOCF "" CURVE 0x75AB0 TKL_SW_VV_UB 100.0 FORMULA_0003 0.0 6.0000
 /begin AXIS_DESCR STD_AXIS Dsoc2pi FORMULA_0501 7 -8192.0000 8191.7500 FORMAT "%5.2" /end AXIS_DESCR
/end CHARACTERISTIC
/begin CHARACTERISTIC KL_PWRCF "" CURVE 0x75AC8 TKL_SW_VV_UB 100.0 FORMULA_0003 0.0 6.0000
 /begin AXIS_DESCR STD_AXIS Dsoc2pi FORMULA_0501 7 -8192.0000 8191.7500 FORMAT "%5.2" /end AXIS_DESCR
/end CHARACTERISTIC
/begin CHARACTERISTIC KL_WUBPTC "KL Multiplikationsfaktor W_ub bei SpgEinbruch" CURVE 0x75AE0 TKL_UW_VV_UB 100.0 FORMULA_0461 0.0 3.9843 /begin AXIS_DESCR STD_AXIS Ub FORMULA_0427 5 0.0 6173.3970 FORMAT "%4.1" /end AXIS_DESCR /end CHARACTERISTIC
/begin CHARACTERISTIC KL_DFPTC "Gefiltertes dffgen -> Prio_Gewichtung -�bersetzer | EN: Filtered generator demand to priority weighting translator" CURVE 0x75AF2 TKL_UB_VV_SW 100.0 FORMULA_0501 -100.0000 100.0000 /begin AXIS_DESCR STD_AXIS Dfpt1ptc FORMULA_0471 6 0.0 99.6093 /end AXIS_DESCR FORMAT "%5.2" /end CHARACTERISTIC
/begin CHARACTERISTIC KL_PWRDF "" CURVE 0x75B06 TKL_UW_VV_UB 100.0 FORMULA_0003 0.0 13.0000
 /begin AXIS_DESCR STD_AXIS Dfprio FORMULA_0503 14 0.0 16383.7500 FORMAT "%6.3" /end AXIS_DESCR
/end CHARACTERISTIC
/begin CHARACTERISTIC KL_PRIO2PTC "Gewichtung der Prios auf Gewichtung fuer PTC Ansteuerung | EN: Priority weighting for PTC heater control" CURVE 0x75B32 TKL_UW_VV_SW 100.0 FORMULA_0501 -100.0000 100.0000
 /begin AXIS_DESCR STD_AXIS Dfprio FORMULA_0503 5 0.0 16383.7500 FORMAT "%6.3" /end AXIS_DESCR
 FORMAT "%5.2" /end CHARACTERISTIC
/begin CHARACTERISTIC KL_SOCPRIO "dsoc -> Prio �bersetzer | EN: State-of-charge delta to priority translator" CURVE 0x75B48 TKL_SW_VV_SW 100.0 FORMULA_0501 -150.0000 150.0000
 /begin AXIS_DESCR STD_AXIS D_soc FORMULA_0475 4 -100.0000 99.9969 FORMAT "%5.2" /end AXIS_DESCR
 FORMAT "%5.2" /end CHARACTERISTIC
/begin CHARACTERISTIC KL_DFPRIO "Dffgen Prio �bersetzer | EN: Generator priority translator" CURVE 0x75B5A TKL_UB_VV_SW 100.0 FORMULA_0501 -100.0000 100.0000 /begin AXIS_DESCR STD_AXIS Dfpt1filt FORMULA_0471 6 0.0 99.6093 /end AXIS_DESCR FORMAT "%5.2" /end CHARACTERISTIC
/begin CHARACTERISTIC KL_UBTPRIO "Delta-Spannung -> Prio �bersetzer" CURVE 0x75B6E TKL_SW_VV_SW 100.0 FORMULA_0501 -100.0000 100.0000
 /begin AXIS_DESCR STD_AXIS Ubdiffilt FORMULA_0444 6 -32.0000 31.9990 FORMAT "%7.4" /end AXIS_DESCR
 FORMAT "%5.2" /end CHARACTERISTIC
/begin CHARACTERISTIC KL_IREST "Noch verfuegbare Restleistung vom Generator." CURVE 0x75B88 TKL_UW_VV_SW 100.0 FORMULA_0501 -100.0000 100.0000
 /begin AXIS_DESCR STD_AXIS Pgenrest FORMULA_0503 10 0.0 16383.7500 FORMAT "%6.3" /end AXIS_DESCR
 FORMAT "%5.2" /end CHARACTERISTIC
/begin CHARACTERISTIC KL_DUDTPTC "�bersetzer dudtmul -> PTC Add. Gewichtung" CURVE 0x75BB2 TKL_SW_VV_UW 100.0 FORMULA_0503 0.0 550.0000
 /begin AXIS_DESCR STD_AXIS Dudtmul FORMULA_0502 5 -48.2304 48.2289 FORMAT "%7.4" /end AXIS_DESCR
 FORMAT "%6.3" /end CHARACTERISTIC
/begin CHARACTERISTIC KL_DSOCPTC "Kennlinie dsoc auf PTC-Ansteuerung �bersetzer" CURVE 0x75BC8 TKL_SW_VV_SW 100.0 FORMULA_0501 -150.0000 150.0000
 /begin AXIS_DESCR STD_AXIS D_soc FORMULA_0475 4 -100.0000 99.9969 FORMAT "%5.2" /end AXIS_DESCR
 FORMAT "%5.2" /end CHARACTERISTIC
/begin CHARACTERISTIC KL_ISOLLPR "Delta-I -> Prio �bersetzer" CURVE 0x75BDA TKL_UW_VV_SW 100.0 FORMULA_0501 -100.0000 100.0000
 /begin AXIS_DESCR STD_AXIS Ibtdiff FORMULA_0504 6 -200.0000 5042.8000 FORMAT "%6.3" /end AXIS_DESCR
 FORMAT "%5.2" /end CHARACTERISTIC
/begin CHARACTERISTIC KL_DSOCPRIO "" CURVE 0x75BF4 TKL_SW_VV_UW 100.0 FORMULA_0480 0.0 511.9921
 /begin AXIS_DESCR STD_AXIS D_soc FORMULA_0475 5 -100.0000 99.9969 FORMAT "%5.2" /end AXIS_DESCR
 FORMAT "%5.2" /end CHARACTERISTIC
/begin CHARACTERISTIC KL_PRIODF "" CURVE 0x75C0A TKL_UW_VV_UB 100.0 FORMULA_0003 0.0 6.0000
 /begin AXIS_DESCR STD_AXIS Dfprio FORMULA_0503 7 0.0 16383.7500 FORMAT "%6.3" /end AXIS_DESCR
/end CHARACTERISTIC
/begin CHARACTERISTIC KF_IBTSOLL "KFSollstrom aufgrund von Batterietemperatur und Ladezustand." MAP 0x75C22 TKF_SW_SW_UW 100.0 FORMULA_0504 -200.0000 5042.8000 /begin AXIS_DESCR STD_AXIS T_batt FORMULA_0426 5 -3276.8000 3276.7000 /end AXIS_DESCR
 /begin AXIS_DESCR STD_AXIS D_soc FORMULA_0475 6 -100.0000 99.9969 FORMAT "%5.2" /end AXIS_DESCR
 FORMAT "%6.3" /end CHARACTERISTIC
/begin MEASUREMENT St_pmprsvcalc.B_ubtlow "Bedingung Batterie in Unterspannungszustand" UBYTE FORMULA_0418 0 0 0.0 255.0 ECU_ADDRESS 0x3FCD28 BIT_MASK 0x1 /end MEASUREMENT
/begin MEASUREMENT St_pmprsvcalc.B_uloreset "Bedingung Batterie nicht mehr in Unterspannungszustand" UBYTE FORMULA_0419 0 0 0.0 255.0 ECU_ADDRESS 0x3FCD28 BIT_MASK 0x2 /end MEASUREMENT
/begin MEASUREMENT St_pmprsvcalc.B_ipmtimer "IPM Timer f�r Prios aktiv" UBYTE FORMULA_0420 0 0 0.0 255.0 ECU_ADDRESS 0x3FCD28 BIT_MASK 0x4 /end MEASUREMENT
/begin MEASUREMENT St_pmprsvcalc.B_ipmaktiv "IPM Massnahmen bzgl. Prios aktiviert" UBYTE FORMULA_0421 0 0 0.0 255.0 ECU_ADDRESS 0x3FCD28 BIT_MASK 0x8 /end MEASUREMENT
/begin MEASUREMENT St_pmprsvcalc.B_kwdr_old "Dient zur Erkennung einer steigender Flanke B_kl15" UBYTE FORMULA_0422 0 0 0.0 255.0 ECU_ADDRESS 0x3FCD28 BIT_MASK 0x10 /end MEASUREMENT
/begin MEASUREMENT St_pmprsvcalc.B_gendef "Bedingung Generator defekt w�hrend Motorbetrieb" UBYTE FORMULA_0423 0 0 0.0 255.0 ECU_ADDRESS 0x3FCD28 BIT_MASK 0x20 /end MEASUREMENT
/begin MEASUREMENT St_pmprsvcalc.B_nkwptcio "NKW status f�r PTC i.o." UBYTE FORMULA_0424 0 0 0.0 255.0 ECU_ADDRESS 0x3FCD28 BIT_MASK 0x40 /end MEASUREMENT
/begin MEASUREMENT St_pmprsvcalc.B_ptckoor "PTC Koordinator Ma�nahmen Aktiv" UBYTE FORMULA_0425 0 0 0.0 255.0 ECU_ADDRESS 0x3FCD28 BIT_MASK 0x80 /end MEASUREMENT
/begin MEASUREMENT St_pmprsvcalc "Statuswort" UBYTE FORMULA_0003 0 0 0.0 255.0000 ECU_ADDRESS 0x3FCD28 /end MEASUREMENT
/begin MEASUREMENT St_pmprsvcalc1.B_enwakeup "Bit, ob IBS Bus wecken darf oder nicht." UBYTE FORMULA_0418 0 0 0.0 255.0 ECU_ADDRESS 0x3FCD29 BIT_MASK 0x1 /end MEASUREMENT
/begin MEASUREMENT St_pmprsvcalc1.B_dubt "Bedg., ob dubt > 100mV" UBYTE FORMULA_0419 0 0 0.0 255.0 ECU_ADDRESS 0x3FCD29 BIT_MASK 0x2 /end MEASUREMENT
/begin MEASUREMENT St_pmprsvcalc1.B_pmvsdanf "Bedg., ob 3b3 versendet wird" UBYTE FORMULA_0420 0 0 0.0 255.0 ECU_ADDRESS 0x3FCD29 BIT_MASK 0x4 /end MEASUREMENT
/begin MEASUREMENT St_pmprsvcalc1.B_pmbsdanf "Bedg. ob 3b4 versendet wird" UBYTE FORMULA_0422 0 0 0.0 255.0 ECU_ADDRESS 0x3FCD29 BIT_MASK 0x10 /end MEASUREMENT
/begin MEASUREMENT St_pmprsvcalc1.B_limcalc "Bedg. begrenzte Berechnung" UBYTE FORMULA_0423 0 0 0.0 255.0 ECU_ADDRESS 0x3FCD29 BIT_MASK 0x20 /end MEASUREMENT
/begin MEASUREMENT St_pmprsvcalc1.B_notprsv "Bed.Notlauf aufg.Batt-Unterspg, Generatorstat und B_kl15 in PMPRSVCALC" UBYTE FORMULA_0424 0 0 0.0 255.0 ECU_ADDRESS 0x3FCD29 BIT_MASK 0x40 /end MEASUREMENT
/begin MEASUREMENT St_pmprsvcalc1.B_pireset "Bedingung f�r PI-Reset" UBYTE FORMULA_0425 0 0 0.0 255.0 ECU_ADDRESS 0x3FCD29 BIT_MASK 0x80 /end MEASUREMENT
/begin MEASUREMENT St_pmprsvcalc1 "Statuswort" UBYTE FORMULA_0003 0 0 0.0 255.0000 ECU_ADDRESS 0x3FCD29 /end MEASUREMENT
/begin MEASUREMENT St_pmprsvcalc2.B_kwdrise "Motorstart Rising" UBYTE FORMULA_0418 0 0 0.0 255.0 ECU_ADDRESS 0x3FCD2A BIT_MASK 0x1 /end MEASUREMENT
/begin MEASUREMENT St_pmprsvcalc2.B_pmsulevon "PM Sulev Ma�nahmen aktiv" UBYTE FORMULA_0419 0 0 0.0 255.0 ECU_ADDRESS 0x3FCD2A BIT_MASK 0x2 /end MEASUREMENT
/begin MEASUREMENT St_pmprsvcalc2 "Statuswort" UBYTE FORMULA_0003 0 0 0.0 255.0000 ECU_ADDRESS 0x3FCD2A /end MEASUREMENT
/begin MEASUREMENT St_pmprsv_nv.B_enwake7 "lokales B_enwake" UBYTE FORMULA_0418 0 0 0.0 255.0 ECU_ADDRESS 0x3FAA44 BIT_MASK 0x1 /end MEASUREMENT
/begin MEASUREMENT St_pmprsv_nv "Statuswort" UBYTE FORMULA_0003 0 0 0.0 255.0000 ECU_ADDRESS 0x3FAA44 /end MEASUREMENT
/begin MEASUREMENT Priopizw1 "Pi-Regler zw1" SLONG FORMULA_0500 0 0 -512.0000 512.0000 ECU_ADDRESS 0x3FCD2C /end MEASUREMENT
/begin MEASUREMENT Priopizw2 "Pi-Regler zw2" SLONG FORMULA_0500 0 0 -512.0000 512.0000 ECU_ADDRESS 0x3FCD30 /end MEASUREMENT
/begin MEASUREMENT Ptcpizw1 "PTC PI Regler zw1" SLONG FORMULA_0500 0 0 -512.0000 512.0000 ECU_ADDRESS 0x3FCD34 /end MEASUREMENT
/begin MEASUREMENT Ptcpizw2 "PTC PI zw2" SLONG FORMULA_0500 0 0 -512.0000 512.0000 ECU_ADDRESS 0x3FCD38 /end MEASUREMENT
/begin MEASUREMENT All2ptc "Gesamtgewichtung f�r PTC-Ansteuerung" SWORD FORMULA_0501 0 0 -500.0000 550.0000 ECU_ADDRESS 0x3FCD3C /end MEASUREMENT
/begin MEASUREMENT Df2pi "DF-Gewichtung auf Prios" SWORD FORMULA_0501 0 0 -100.0000 100.0000 ECU_ADDRESS 0x3FCD3E /end MEASUREMENT
/begin MEASUREMENT Dfall2pi "Gesamtgewichtung auf Prios" SWORD FORMULA_0501 0 0 -500.0000 500.0000 ECU_ADDRESS 0x3FCD40 /end MEASUREMENT
/begin MEASUREMENT Dfpi2ptc "Gewichtung der Prios -> Gewichtung f�r PTC Ansteuerung" SWORD FORMULA_0501 0 0 -100.0000 100.0000 ECU_ADDRESS 0x3FCD42 /end MEASUREMENT
/begin MEASUREMENT Dfpt1_2ptc "gefiltertes dffgen Gewichtung auf PTC-Ansteuerung" SWORD FORMULA_0501 0 0 -100.0000 100.0000 ECU_ADDRESS 0x3FCD44 /end MEASUREMENT
/begin MEASUREMENT Dsoc2pi "Batterieladezustand-Gewichtung auf Prios" SWORD FORMULA_0501 0 0 -150.0000 150.0000 ECU_ADDRESS 0x3FCD46 /end MEASUREMENT
/begin MEASUREMENT Dsoc2ptc "dsoc Gewichtung auf PTC-Ansteuerung" SWORD FORMULA_0501 0 0 -150.0000 150.0000 ECU_ADDRESS 0x3FCD48 /end MEASUREMENT
/begin MEASUREMENT Dudtmul "PTC dudt : gewichtetes Dudt" SWORD FORMULA_0502 0 0 -48.2304 48.2289 ECU_ADDRESS 0x3FCD4A /end MEASUREMENT
/begin MEASUREMENT Ibtdiff2pi "Batterie-soll-strom Gewichtung auf Prios" SWORD FORMULA_0501 0 0 -100.0000 100.0000 ECU_ADDRESS 0x3FCD4C /end MEASUREMENT
/begin MEASUREMENT Idiff2ptc "idiff Gewichtung auf die PTC-Ansteuerung" SWORD FORMULA_0501 0 0 -100.0000 100.0000 ECU_ADDRESS 0x3FCD4E /end MEASUREMENT
/begin MEASUREMENT Pgen2ptc "Gewichtung der Generatorrestleistung f�r PTC-Ansteuerung" SWORD FORMULA_0501 0 0 -100.0000 100.0000 ECU_ADDRESS 0x3FCD50 /end MEASUREMENT
/begin MEASUREMENT Ubdiff "ubattsoll - ubatt_w" SWORD FORMULA_0444 0 0 -32.0000 31.9990 ECU_ADDRESS 0x3FCD52 /end MEASUREMENT
/begin MEASUREMENT Ubdiff2pi "Ubatt-Differenz-Gewichtung auf Prios" SWORD FORMULA_0501 0 0 -100.0000 100.0000 ECU_ADDRESS 0x3FCD54 /end MEASUREMENT
/begin MEASUREMENT Ubdiffilt "Wert nach Ubdiff-Tiefpass Prio" SWORD FORMULA_0444 0 0 -32.0000 31.9990 ECU_ADDRESS 0x3FCD56 /end MEASUREMENT
/begin MEASUREMENT Ubdiffptc "Delta Usoll-Ubatt PTC" SWORD FORMULA_0444 0 0 -32.0000 31.9990 ECU_ADDRESS 0x3FCD58 /end MEASUREMENT
/begin MEASUREMENT Ubt7mem "resultierendes ubt" SWORD FORMULA_0484 0 0 -128.0000 127.9960 ECU_ADDRESS 0x3FCD5A /end MEASUREMENT
/begin MEASUREMENT Ubtpt12ptc "Ubatt Gewichtung f�r PTC Ansteuerung" SWORD FORMULA_0501 0 0 -100.0000 100.0000 ECU_ADDRESS 0x3FCD5C /end MEASUREMENT
/begin MEASUREMENT Ubtpt1ptc "Ubdiffptc gefiltert" SWORD FORMULA_0444 0 0 -32.0000 31.9990 ECU_ADDRESS 0x3FCD5E /end MEASUREMENT
/begin MEASUREMENT Udeltac "inkrementierte Differenz zwischen altem und neuem ubt" SWORD FORMULA_0484 0 0 -128.0000 127.9960 ECU_ADDRESS 0x3FCD60 /end MEASUREMENT
/begin MEASUREMENT Allptcfilt "pi-geregelte Gewichtung f�r PTC-Ansteuerung" UWORD FORMULA_0503 0 0 0.0 550.0000 ECU_ADDRESS 0x3FCD62 /end MEASUREMENT
/begin MEASUREMENT Ctrpwrcf "Komfort-Teil von ctrpwrcos" UWORD FORMULA_0010 0 0 0.0 65535.0000 ECU_ADDRESS 0x3FCD64 /end MEASUREMENT
/begin MEASUREMENT Ctrpwrcos "Steuerung_Leistung_Verbraucher" UWORD FORMULA_0010 0 0 0.0 65535.0000 ECU_ADDRESS 0x3FCD66 /end MEASUREMENT
/begin MEASUREMENT Ctrpwrcos7 "lokales ctrpwrcos" UWORD FORMULA_0010 0 0 0.0 65535.0000 ECU_ADDRESS 0x3FCD68 /end MEASUREMENT
/begin MEASUREMENT Ctrpwrdf "df-Teil von ctrpwrcos" UWORD FORMULA_0010 0 0 0.0 65535.0000 ECU_ADDRESS 0x3FCD6A /end MEASUREMENT
/begin MEASUREMENT Ctrpwrmem "altes ctrpwrcos" UWORD FORMULA_0010 0 0 0.0 65535.0000 ECU_ADDRESS 0x3FCD6C /end MEASUREMENT
/begin MEASUREMENT Dfallpi "PI-Geregelte Gesamtgewichtung auf Prios" UWORD FORMULA_0503 0 0 0.0 450.0000 ECU_ADDRESS 0x3FCD6E /end MEASUREMENT
/begin MEASUREMENT Dfprio "" UWORD FORMULA_0503 0 0 0.0 450.0000 ECU_ADDRESS 0x3FCD70 /end MEASUREMENT
/begin MEASUREMENT F_dudtptc "Inkrement auf Ptc_pwr aufgrund du/dt" UWORD FORMULA_0503 0 0 0.0 550.0000 ECU_ADDRESS 0x3FCD72 /end MEASUREMENT
/begin MEASUREMENT Ibtdiff "Delta Ibtsoll-Ibatt" UWORD FORMULA_0504 0 0 -200.0000 5042.8000 ECU_ADDRESS 0x3FCD74 /end MEASUREMENT
/begin MEASUREMENT Ibtsoll "Sollstrom aufgrund von tbatt und dsoc" UWORD FORMULA_0504 0 0 -200.0000 5042.8000 ECU_ADDRESS 0x3FCD76 /end MEASUREMENT
/begin MEASUREMENT Ipmdfprio "lokale Prioberechnungsvariable bei IPM aktiv" UWORD FORMULA_0503 0 0 0.0 450.0000 ECU_ADDRESS 0x3FCD78 /end MEASUREMENT
/begin MEASUREMENT Isolldiff "Differenz isoll - ibatt_w f�r PTC Ansteuerung" UWORD FORMULA_0504 0 0 -200.0000 5042.8000 ECU_ADDRESS 0x3FCD7A /end MEASUREMENT
/begin MEASUREMENT Memprio1 "memory 1 PI-Regler dfall2pi E60Prio" UWORD FORMULA_0480 0 0 0.0 511.9921 ECU_ADDRESS 0x3FCD7C /end MEASUREMENT
/begin MEASUREMENT Memprio2 "memory 2 PI-Regler dfall2pi E60Prio" UWORD FORMULA_0480 0 0 0.0 511.9921 ECU_ADDRESS 0x3FCD7E /end MEASUREMENT
/begin MEASUREMENT Memptc1 "memory 1 PI-Regler all2ptc PTC" UWORD FORMULA_0480 0 0 0.0 511.9921 ECU_ADDRESS 0x3FCD80 /end MEASUREMENT
/begin MEASUREMENT Memptc2 "memory 2 PI-Regler all2ptc PTC" UWORD FORMULA_0480 0 0 0.0 511.9921 ECU_ADDRESS 0x3FCD82 /end MEASUREMENT
/begin MEASUREMENT Pgenrest "Generatorrestleistung (igenrest*ubatt_w)" UWORD FORMULA_0503 0 0 0.0 6400.0000 ECU_ADDRESS 0x3FCD84 /end MEASUREMENT
/begin MEASUREMENT Ptcadd "Wg. Spgeinbruch zu addierender PTC Faktor" UWORD FORMULA_0503 0 0 0.0 550.0000 ECU_ADDRESS 0x3FCD86 /end MEASUREMENT
/begin MEASUREMENT Ubold7 "PTC dudt : alter Ub Wert zur Differenzbildung" UWORD FORMULA_0427 0 0 0.0 6173.3970 ECU_ADDRESS 0x3FCD88 /end MEASUREMENT
/begin MEASUREMENT Ubt "Batteriespannung" UWORD FORMULA_0505 0 0 0.0 983.0250 ECU_ADDRESS 0x3FCD8A /end MEASUREMENT
/begin MEASUREMENT Ubt7 "Lokale Batteriespannung" UWORD FORMULA_0505 0 0 0.0 61.4250 ECU_ADDRESS 0x3FCD8C /end MEASUREMENT
/begin MEASUREMENT Ubt7old "altes ubt" UWORD FORMULA_0505 0 0 0.0 61.4250 ECU_ADDRESS 0x3FCD8E /end MEASUREMENT
/begin MEASUREMENT Udeltaabsc "absoluter Wert von udelta" UWORD FORMULA_0505 0 0 0.0 61.4250 ECU_ADDRESS 0x3FCD90 /end MEASUREMENT
/begin MEASUREMENT D_udtptc "Spannungsdifferenz in 10ms" SBYTE FORMULA_0486 0 0 -12.0576 11.9634 ECU_ADDRESS 0x3FCD92 /end MEASUREMENT
/begin MEASUREMENT Ctrcbr "Steuerung_Stromzweige" UBYTE FORMULA_0003 0 0 0.0 255.0000 ECU_ADDRESS 0x3FCD93 /end MEASUREMENT
/begin MEASUREMENT Ctrcbr7 "lokales ctrcbr" UBYTE FORMULA_0003 0 0 0.0 255.0000 ECU_ADDRESS 0x3FCD94 /end MEASUREMENT
/begin MEASUREMENT Ctrcbrmem "altes ctrbr" UBYTE FORMULA_0003 0 0 0.0 255.0000 ECU_ADDRESS 0x3FCD95 /end MEASUREMENT
/begin MEASUREMENT Ctrpcos "Steuerung_Standverbraucher" UBYTE FORMULA_0003 0 0 0.0 3.0000 ECU_ADDRESS 0x3FCD96 /end MEASUREMENT
/begin MEASUREMENT Ctrpcosmem "altes ctrpcos" UBYTE FORMULA_0003 0 0 0.0 3.0000 ECU_ADDRESS 0x3FCD97 /end MEASUREMENT
/begin MEASUREMENT Ctrprio "Steuerung_Spitzenreduzierung_Priorit�t" UBYTE FORMULA_0003 0 0 0.0 7.0000 ECU_ADDRESS 0x3FCD98 /end MEASUREMENT
/begin MEASUREMENT Ctrprio7 "lokales ctrprio" UBYTE FORMULA_0003 0 0 0.0 7.0000 ECU_ADDRESS 0x3FCD99 /end MEASUREMENT
/begin MEASUREMENT Ctrpriocf "Steuerung_Spitzenreduzierung_Priorit�t_Komfort" UBYTE FORMULA_0003 0 0 0.0 7.0000 ECU_ADDRESS 0x3FCD9A /end MEASUREMENT
/begin MEASUREMENT Ctrpriocf7 "lokales ctrpriocf" UBYTE FORMULA_0003 0 0 0.0 7.0000 ECU_ADDRESS 0x3FCD9B /end MEASUREMENT
/begin MEASUREMENT Ctrpriocfm "altes ctrpriocf" UBYTE FORMULA_0003 0 0 0.0 7.0000 ECU_ADDRESS 0x3FCD9C /end MEASUREMENT
/begin MEASUREMENT Ctrpriomem "altes ctrprio" UBYTE FORMULA_0003 0 0 0.0 7.0000 ECU_ADDRESS 0x3FCD9D /end MEASUREMENT
/begin MEASUREMENT Ctrpwspcos "Steuerung_Leistung_Sonderverbraucher" UBYTE FORMULA_0506 0 0 0.0 127.5000 ECU_ADDRESS 0x3FCD9E /end MEASUREMENT
/begin MEASUREMENT Dff_filt7 "lokales dffgenflit" UBYTE FORMULA_0471 0 0 0.0 99.6093 ECU_ADDRESS 0x3FCD9F /end MEASUREMENT
/begin MEASUREMENT Dfgenfilt "�ber PT-1 gefiltertes dffgen-Signal" UBYTE FORMULA_0471 0 0 0.0 99.6093 ECU_ADDRESS 0x3FCDA0 /end MEASUREMENT
/begin MEASUREMENT Dfpt1filt "Wert nach DF-Tiefpass Prio" UBYTE FORMULA_0471 0 0 0.0 99.6093 ECU_ADDRESS 0x3FCDA1 /end MEASUREMENT
/begin MEASUREMENT Dfpt1ptc "Wert nach DFFGEN-Filter PTC" UBYTE FORMULA_0471 0 0 0.0 99.6093 ECU_ADDRESS 0x3FCDA2 /end MEASUREMENT
/begin MEASUREMENT Igenrest "Generatorreststrom modelliert" UBYTE FORMULA_0459 0 0 0.0 255.0000 ECU_ADDRESS 0x3FCDA3 /end MEASUREMENT
/begin MEASUREMENT Picntr "Counter fuer PI-Reset" UBYTE FORMULA_0458 0 0 0.0 25.5000 ECU_ADDRESS 0x3FCDA4 /end MEASUREMENT
/begin MEASUREMENT Pmbscount "zyklisches Senden entspricht 5 sek" UBYTE FORMULA_0003 0 0 0.0 255.0000 ECU_ADDRESS 0x3FCDA5 /end MEASUREMENT
/begin MEASUREMENT Pmvscount "Z�hler bis zum n�chsten zyklischen Senden von 3b3" UBYTE FORMULA_0003 0 0 0.0 255.0000 ECU_ADDRESS 0x3FCDA6 /end MEASUREMENT
/begin MEASUREMENT Ptc_pwr "Maximale Leistung, die der PTC einstellen darf." UBYTE FORMULA_0506 0 0 0.0 127.5000 ECU_ADDRESS 0x3FCDA7 /end MEASUREMENT
/begin MEASUREMENT Ptc_pwr7 "lokales ptc_pwr" UBYTE FORMULA_0506 0 0 0.0 127.5000 ECU_ADDRESS 0x3FCDA8 /end MEASUREMENT
/begin MEASUREMENT Pwrspmem "altes ctrpwspcos" UBYTE FORMULA_0506 0 0 0.0 127.5000 ECU_ADDRESS 0x3FCDA9 /end MEASUREMENT
/begin MEASUREMENT Rqpcos "Anforderung_Standverbraucher" UBYTE FORMULA_0003 0 0 0.0 3.0000 ECU_ADDRESS 0x3FCDAA /end MEASUREMENT
/begin MEASUREMENT Rqpcos7 "lokales rqpcos" UBYTE FORMULA_0003 0 0 0.0 3.0000 ECU_ADDRESS 0x3FCDAB /end MEASUREMENT
/begin MEASUREMENT Rqpcosmem "altes rqpcos" UBYTE FORMULA_0003 0 0 0.0 3.0000 ECU_ADDRESS 0x3FCDAC /end MEASUREMENT
/begin MEASUREMENT Selspcos "Auswahl_Sonderverbraucher" UBYTE FORMULA_0003 0 0 0.0 15.0000 ECU_ADDRESS 0x3FCDAD /end MEASUREMENT
/begin MEASUREMENT Selspcosme "altes selspcos" UBYTE FORMULA_0003 0 0 0.0 15.0000 ECU_ADDRESS 0x3FCDAE /end MEASUREMENT
/begin MEASUREMENT Stpcos "Status_Standverbraucher" UBYTE FORMULA_0003 0 0 0.0 3.0000 ECU_ADDRESS 0x3FCDAF /end MEASUREMENT
/begin MEASUREMENT Stpcosmem "altes stpcos" UBYTE FORMULA_0003 0 0 0.0 3.0000 ECU_ADDRESS 0x3FCDB0 /end MEASUREMENT
/begin MEASUREMENT Ulev "Spannungsebene" UBYTE FORMULA_0003 0 0 0.0 15.0000 ECU_ADDRESS 0x3FCDB1 /end MEASUREMENT
/begin MEASUREMENT Ulevmem "altes ulev" UBYTE FORMULA_0003 0 0 0.0 15.0000 ECU_ADDRESS 0x3FCDB2 /end MEASUREMENT
/begin MEASUREMENT Ulow "Unterspannungsstatus : 0=i.O, 1=in between, 2=unterspannung" UBYTE FORMULA_0003 0 0 0.0 255.0000 ECU_ADDRESS 0x3FCDB3 /end MEASUREMENT
/begin MEASUREMENT Ulowtimer "Zeit zur Unterspannungserkennung * Taskzeit (50*100ms = 5sec)" UBYTE FORMULA_0458 0 0 0.0 25.5000 ECU_ADDRESS 0x3FCDB4 /end MEASUREMENT
/begin MEASUREMENT kbmcount "Counter, gesetzt von KBMCNT_APP" UBYTE FORMULA_0458 0 0 0.0 25.5000 ECU_ADDRESS 0x3FCDB5 /end MEASUREMENT
/begin MEASUREMENT Ctrpcos7 "lokales ctrpcos" UBYTE FORMULA_0003 0 0 0.0 3.0000 ECU_ADDRESS 0x3FAA45 /end MEASUREMENT
/begin MEASUREMENT Stpcos7 "lokales stpcos" UBYTE FORMULA_0003 0 0 0.0 3.0000 ECU_ADDRESS 0x3FAA46 /end MEASUREMENT
/* ------------------ Abschnitt erzeugt aus pmsoccalc.dat ------------------ */
/begin CHARACTERISTIC K_Q_BILAPWF "Defaultwert f�r q_bila nach Powerfail | EN: Defaultwert für q_bila nach Powerfail" VALUE 0x75C76 TKW_VV_VV_UW 100.0 FORMULA_0494 0.0 1192.7502 FORMAT "%6.3" /end CHARACTERISTIC
/begin CHARACTERISTIC K_SOC_BILAWA "Applikationswert soc_bila | EN: Applikationswert soc_bila" VALUE 0x75C78 TKW_VV_VV_UW 100.0 FORMULA_0433 0.0 99.9984 FORMAT "%5.2" /end CHARACTERISTIC
/begin CHARACTERISTIC K_SOC_QPWF "Ladezustandsqualit�t nach Powerfail | EN: Ladezustandsqualität nach Powerfail" VALUE 0x75C7A TKW_VV_VV_UW 100.0 FORMULA_0494 0.0 1192.7502 FORMAT "%6.3" /end CHARACTERISTIC
/begin CHARACTERISTIC K_SOC_QUALIA "Applikationswert soc_quali | EN: Applikationswert soc_quali" VALUE 0x75C7C TKW_VV_VV_UW 100.0 FORMULA_0494 0.0 1192.7502 FORMAT "%6.3" /end CHARACTERISTIC
/begin CHARACTERISTIC CBATT_DEF "Ersatzwert Batteriekapazit�t | EN: Ersatzwert Batteriekapazitï¿½t" VALUE 0x75C7E TKW_VV_VV_UB 100.0 FORMULA_0483 1.0000 255.0000 /end CHARACTERISTIC
/begin CHARACTERISTIC K_IB_COMMVAL "Anzahl Taskaufrufe zwischen periodischer Abfrage qlad und qelad | EN: Anzahl Taskaufrufe zwischen periodischer A bfrage qlad und qelad" VALUE 0x75C7F TKW_VV_VV_UB 100.0 FORMULA_0003 0.0 255.0000 /end CHARACTERISTIC
/begin CHARACTERISTIC K_PMQ_UX "Ruhespannung Extrapolationsteiler | EN: trapolationsteiler 7.96875p S_BSOCCALC - 0p 0 x Enable Rücksetzten Ruhespannungen IBS" VALUE 0x75C80 TKW_VV_VV_UB 100.0 FORMULA_0447 0.0313 7.9687 /end CHARACTERISTIC
/begin CHARACTERISTIC S_BSOCCALC "Enable R�cksetzten Ruhespannungen IBS | EN: Enable Rï¿½cksetzten Ruhespannungen IBS" VALUE 0x75C81 TKW_VV_VV_UB 100.0 FORMULA_0003 0.0 255.0000 /end CHARACTERISTIC
/begin CHARACTERISTIC S_SOC_BILA "Schalter f�r Applik. soc_bila | EN: Schalter fï¿½r Applik. soc_bila" VALUE 0x75C82 TKW_VV_VV_UB 100.0 FORMULA_0003 0.0 255.0000 /end CHARACTERISTIC
/begin CHARACTERISTIC S_SOC_QUAL "Schalter f�r Applik. soc_quali | EN: Schalter fï¿½r Applik. soc_quali" VALUE 0x75C83 TKW_VV_VV_UB 100.0 FORMULA_0003 0.0 255.0000 /end CHARACTERISTIC
/begin CHARACTERISTIC KL_SOC0TEMP "Temperaturabh�ngige Stromkorrektur f�r Ruhespannungsmessung" CURVE 0x75C84 TKL_SW_VV_UB 100.0 FORMULA_0473 0.0 1.9921 /begin AXIS_DESCR STD_AXIS Tsocloc FORMULA_0426 5 -3276.8000 3276.7000 /end AXIS_DESCR /end CHARACTERISTIC
/begin CHARACTERISTIC KF_SOCLF "Ladefaktor in Abh�ngigkeit von Temperatur und Ladezustand | EN: Charge factor vs temperature and state of charge" MAP 0x75C96 TKF_UW_SW_UB 100.0 FORMULA_0461 0.0157 3.9843 /begin AXIS_DESCR STD_AXIS T_batt FORMULA_0426 3 -3276.8000 3276.7000 /end AXIS_DESCR
 /begin AXIS_DESCR STD_AXIS Soc_b_loc FORMULA_0494 3 0.0 1192.7502 FORMAT "%6.3" /end AXIS_DESCR
/end CHARACTERISTIC
/begin CHARACTERISTIC KF_SOC0UBIB "" MAP 0x75CAE TKF_SW_UW_UW 100.0 FORMULA_0494 0.0 1192.7502
 /begin AXIS_DESCR STD_AXIS Ubatt0 FORMULA_0497 3 6.0000 22.3837 FORMAT "%6.3" /end AXIS_DESCR
 /begin AXIS_DESCR STD_AXIS Isoc0loc FORMULA_0507 5 -655.3600 655.3400 FORMAT "%6.3" /end AXIS_DESCR
 FORMAT "%6.3" /end CHARACTERISTIC
/begin MEASUREMENT St_pmsoccalc.B_soc_pwf "Uo Kalibrierung durchgef�hrt" UBYTE FORMULA_0419 0 0 0.0 255.0 ECU_ADDRESS 0x3FCDB6 BIT_MASK 0x2 /end MEASUREMENT
/begin MEASUREMENT St_pmsoccalc.B_soccalc "Uo Kalibrierung durchgef�hrt" UBYTE FORMULA_0420 0 0 0.0 255.0 ECU_ADDRESS 0x3FCDB6 BIT_MASK 0x4 /end MEASUREMENT
/begin MEASUREMENT St_pmsoccalc "Statuswort" UBYTE FORMULA_0003 0 0 0.0 255.0000 ECU_ADDRESS 0x3FCDB6 /end MEASUREMENT
/begin MEASUREMENT St_pmsocalc1.B_ibspwf_e "Bedingung Powerfail IBS erkannt" UBYTE FORMULA_0418 0 0 0.0 255.0 ECU_ADDRESS 0x3FAA48 BIT_MASK 0x1 /end MEASUREMENT
/begin MEASUREMENT St_pmsocalc1 "Statuswort" UBYTE FORMULA_0003 0 0 0.0 255.0000 ECU_ADDRESS 0x3FAA48 /end MEASUREMENT
/begin MEASUREMENT Isoc0loc "Batteriestrom zum Zeitpunkt der Ruhespannungsmessung (lokal)" SWORD FORMULA_0507 0 0 -655.3600 655.3400 ECU_ADDRESS 0x3FCDB8 /end MEASUREMENT
/begin MEASUREMENT Tsocloc "Batterietemperatur zum Zeitpunkt der Ruhespannungsmessung (lokal)" SWORD FORMULA_0426 0 0 -3276.8000 3276.7000 ECU_ADDRESS 0x3FCDBA /end MEASUREMENT
/begin MEASUREMENT D_qelad "Delta Kapazit�t entladen" UWORD FORMULA_0494 0 0 0.0 1192.7502 ECU_ADDRESS 0x3FCDBC /end MEASUREMENT
/begin MEASUREMENT D_qlad "Delta Kapazit�t geladen" UWORD FORMULA_0494 0 0 0.0 1192.7502 ECU_ADDRESS 0x3FCDBE /end MEASUREMENT
/begin MEASUREMENT Soc_bila "Ladezustand durch Bilanzierung und Ruhespannungsmessung ermittelt" UWORD FORMULA_0433 0 0 0.0 99.9984 ECU_ADDRESS 0x3FCDC0 /end MEASUREMENT
/begin MEASUREMENT Soc_quali "Z�hler Genauigkeit Ladeztustandsbestimmung" UWORD FORMULA_0494 0 0 0.0 1192.7502 ECU_ADDRESS 0x3FCDC2 /end MEASUREMENT
/begin MEASUREMENT Ubatt0 "Aus Wertetripel ausgew�hlter Ruhespannungswert" UWORD FORMULA_0497 0 0 6.0000 22.3837 ECU_ADDRESS 0x3FCDC4 /end MEASUREMENT
/begin MEASUREMENT Cbatt_lo "Nennkapazit�t Batterie, lokal" UBYTE FORMULA_0483 0 0 1.0000 255.0000 ECU_ADDRESS 0x3FCDC6 /end MEASUREMENT
/begin MEASUREMENT Ib_commcnt "Z�hler Taskaufrufe zwischen periodischer Abfrage qlad und qelad" UBYTE FORMULA_0003 0 0 0.0 255.0000 ECU_ADDRESS 0x3FCDC7 /end MEASUREMENT
/begin MEASUREMENT Ib_commsta "Statemaschine zeiger zur Abfrage qlad und qelad" UBYTE FORMULA_0003 0 0 0.0 255.0000 ECU_ADDRESS 0x3FCDC8 /end MEASUREMENT
/begin MEASUREMENT Kalevcnt "Anzahl der Ruhespannungsmessungen" UBYTE FORMULA_0003 0 0 0.0 255.0000 ECU_ADDRESS 0x3FCDC9 /end MEASUREMENT
/begin MEASUREMENT Q_bila "Kapazit�t Batterie (long)" ULONG FORMULA_0508 0 0 0.0 1193.0464 ECU_ADDRESS 0x3FAA4C /end MEASUREMENT
/begin MEASUREMENT Qeladold "Kapazit�t Entladen vor Abstellen" UWORD FORMULA_0494 0 0 0.0 1192.7502 ECU_ADDRESS 0x3FAA50 /end MEASUREMENT
/begin MEASUREMENT Qladold "Kapazit�t Getladen vor Abstellen" UWORD FORMULA_0494 0 0 0.0 1192.7502 ECU_ADDRESS 0x3FAA52 /end MEASUREMENT
/begin MEASUREMENT Soc_b_loc "lokal soc_bila f. KFSOCLF" UWORD FORMULA_0433 0 0 0.0 99.9984 ECU_ADDRESS 0x3FAA54 /end MEASUREMENT
/begin MEASUREMENT Soc_q_loc "lokaler Z�hler Genauigkeit Ladeztustandsbestimmung" UWORD FORMULA_0494 0 0 0.0 1192.7502 ECU_ADDRESS 0x3FAA56 /end MEASUREMENT
/* ------------------ Abschnitt erzeugt aus pmsocfit.dat ------------------ */
/begin CHARACTERISTIC K_I_FITAUSW "Grenzwert Fitstrom | EN: Grenzwert Fitstrom" VALUE 0x75CDE TKW_VV_VV_UW 100.0 FORMULA_0504 -200.0000 5042.8000 FORMAT "%6.3" /end CHARACTERISTIC
/begin CHARACTERISTIC K_SOCFITAPP "Applikationwert Soc aus der Fitberechnung | EN: Schalter Initialisierung Fit -Filter mit SOCFIT" VALUE 0x75CE0 TKW_VV_VV_UW 100.0 FORMULA_0433 0.0 99.9984 FORMAT "%5.2" /end CHARACTERISTIC
/begin CHARACTERISTIC ZK_PMSOC "Zeitfaktor | EN: Zeitfaktor" VALUE 0x75CE2 TKW_VV_VV_UW 100.0 FORMULA_0457 0.0 9.99984741210938e-1 FORMAT "%7.4" /end CHARACTERISTIC
/begin CHARACTERISTIC S_PMSOCFIT "Schalter zur Applikation SoC aus der Fitberechnung | EN: Schalter zur Applikation SoC aus der Fitberechnung" VALUE 0x75CE4 TKW_VV_VV_UB 100.0 FORMULA_0003 0.0 255.0000 /end CHARACTERISTIC
/begin CHARACTERISTIC KL_PMSOCVU "SoC-Wert aus der Fitberechnung | EN: State-of-charge value from fit calculation" CURVE 0x75CE6 TKL_UW_VV_UW 100.0 FORMULA_0433 0.0 99.9984
 /begin AXIS_DESCR STD_AXIS Ubatts2 FORMULA_0497 3 6.0000 22.3837 FORMAT "%6.3" /end AXIS_DESCR
 FORMAT "%5.2" /end CHARACTERISTIC
/begin CHARACTERISTIC KF_PMRIBAT8 "Kennfeld Innenwiderstand Batterie8 | EN: Kennfeld Innenwiderstand Batterie8" MAP 0x75CF4 TKF_UW_SW_UB 100.0 FORMULA_0509 0.0 0.2550 /begin AXIS_DESCR STD_AXIS T_batt FORMULA_0426 4 -3276.8000 3276.7000 /end AXIS_DESCR
 /begin AXIS_DESCR STD_AXIS I_batt FORMULA_0504 6 -200.0000 5042.8000 FORMAT "%6.3" /end AXIS_DESCR
/end CHARACTERISTIC
/begin CHARACTERISTIC KF_PMRIBAT6 "Kennfeld Innenwiderstand Batterie6 | EN: Kennfeld Innenwiderstand Batterie6" MAP 0x75D22 TKF_UW_SW_UB 100.0 FORMULA_0509 0.0 0.2550 /begin AXIS_DESCR STD_AXIS T_batt FORMULA_0426 4 -3276.8000 3276.7000 /end AXIS_DESCR
 /begin AXIS_DESCR STD_AXIS I_batt FORMULA_0504 6 -200.0000 5042.8000 FORMAT "%6.3" /end AXIS_DESCR
/end CHARACTERISTIC
/begin CHARACTERISTIC KF_PMRIBAT5 "Kennfeld Innenwiderstand Batterie5 | EN: Kennfeld Innenwiderstand Batterie5" MAP 0x75D50 TKF_UW_SW_UB 100.0 FORMULA_0509 0.0 0.2550 /begin AXIS_DESCR STD_AXIS T_batt FORMULA_0426 4 -3276.8000 3276.7000 /end AXIS_DESCR
 /begin AXIS_DESCR STD_AXIS I_batt FORMULA_0504 6 -200.0000 5042.8000 FORMAT "%6.3" /end AXIS_DESCR
/end CHARACTERISTIC
/begin CHARACTERISTIC KF_PMRIBAT3 "Kennfeld Innenwiderstand Batterie3 | EN: Kennfeld Innenwiderstand Batterie3" MAP 0x75D7E TKF_UW_SW_UB 100.0 FORMULA_0509 0.0 0.2550 /begin AXIS_DESCR STD_AXIS T_batt FORMULA_0426 4 -3276.8000 3276.7000 /end AXIS_DESCR
 /begin AXIS_DESCR STD_AXIS I_batt FORMULA_0504 6 -200.0000 5042.8000 FORMAT "%6.3" /end AXIS_DESCR
/end CHARACTERISTIC
/begin CHARACTERISTIC KF_PMRIBAT4 "Kennfeld Innenwiderstand Batterie4 | EN: Kennfeld Innenwiderstand Batterie4" MAP 0x75DAC TKF_UW_SW_UB 100.0 FORMULA_0509 0.0 0.2550 /begin AXIS_DESCR STD_AXIS T_batt FORMULA_0426 4 -3276.8000 3276.7000 /end AXIS_DESCR
 /begin AXIS_DESCR STD_AXIS I_batt FORMULA_0504 6 -200.0000 5042.8000 FORMAT "%6.3" /end AXIS_DESCR
/end CHARACTERISTIC
/begin CHARACTERISTIC KF_PMRIBAT2 "Kennfeld Innenwiderstand Batterie2 | EN: Kennfeld Innenwiderstand Batterie2" MAP 0x75DDA TKF_UW_SW_UB 100.0 FORMULA_0509 0.0 0.2550 /begin AXIS_DESCR STD_AXIS T_batt FORMULA_0426 4 -3276.8000 3276.7000 /end AXIS_DESCR
 /begin AXIS_DESCR STD_AXIS I_batt FORMULA_0504 6 -200.0000 5042.8000 FORMAT "%6.3" /end AXIS_DESCR
/end CHARACTERISTIC
/begin CHARACTERISTIC KF_PMRIBAT1 "Kennfeld Innenwiderstand Batterie" MAP 0x75E08 TKF_UW_SW_UB 100.0 FORMULA_0509 0.0 0.2550 /begin AXIS_DESCR STD_AXIS T_batt FORMULA_0426 4 -3276.8000 3276.7000 /end AXIS_DESCR
 /begin AXIS_DESCR STD_AXIS I_batt FORMULA_0504 6 -200.0000 5042.8000 FORMAT "%6.3" /end AXIS_DESCR
/end CHARACTERISTIC
/begin CHARACTERISTIC KF_PMRIBAT7 "Kennfeld Innenwiderstand Batterie7 | EN: Kennfeld Innenwiderstand Batterie7" MAP 0x75E36 TKF_UW_SW_UB 100.0 FORMULA_0509 0.0 0.2550 /begin AXIS_DESCR STD_AXIS T_batt FORMULA_0426 4 -3276.8000 3276.7000 /end AXIS_DESCR
 /begin AXIS_DESCR STD_AXIS I_batt FORMULA_0504 6 -200.0000 5042.8000 FORMAT "%6.3" /end AXIS_DESCR
/end CHARACTERISTIC
/begin MEASUREMENT Soc_fit_temp "" UWORD FORMULA_0433 0 0 0.0 99.9984 ECU_ADDRESS 0x3FCDCA /end MEASUREMENT
/begin MEASUREMENT Ubatts2 "Hilfswert2 Spannung aus Fitberechnung" UWORD FORMULA_0497 0 0 6.0000 16.0000 ECU_ADDRESS 0x3FCDCC /end MEASUREMENT
/begin MEASUREMENT Soc_fit "SoC aus der Fitformel" UWORD FORMULA_0433 0 0 0.0 99.9984 ECU_ADDRESS 0x3FAA58 /end MEASUREMENT
/* ------------------ Abschnitt erzeugt aus pmsockor.dat ------------------ */
/begin CHARACTERISTIC K_ABSCHKORA "Applikationswert f�r Korrektur Abschaltung | EN: Calibration value for switch-off correction" VALUE 0x75E64 TKW_VV_VV_SW 100.0 FORMULA_0495 -50.0000 49.9984 FORMAT "%5.2" /end CHARACTERISTIC
/begin CHARACTERISTIC K_DAB_KORR1 "Korrekturkonstante 1 f�r Abschaltung | EN: Correction constant 1 for switch-off" VALUE 0x75E66 TKW_VV_VV_SW 100.0 FORMULA_0495 -50.0000 49.9984 FORMAT "%5.2" /end CHARACTERISTIC
/begin CHARACTERISTIC K_DAB_KORR2 "Korrekturkonstante 2 f�r Abschaltung | EN: Correction constant 2 for switch-off" VALUE 0x75E68 TKW_VV_VV_SW 100.0 FORMULA_0495 -50.0000 49.9984 FORMAT "%5.2" /end CHARACTERISTIC
/begin CHARACTERISTIC K_DAB_KORR3 "Korrekturkonstante 3 f�r Abschaltung | EN: Correction constant 3 for switch-off" VALUE 0x75E6A TKW_VV_VV_SW 100.0 FORMULA_0495 -50.0000 49.9984 FORMAT "%5.2" /end CHARACTERISTIC
/begin CHARACTERISTIC K_DSOCA "Applikationsgr�sse f�r d_soc | EN: Calibration value for d_soc" VALUE 0x75E6C TKW_VV_VV_SW 100.0 FORMULA_0475 -100.0000 99.9969 FORMAT "%5.2" /end CHARACTERISTIC
/begin CHARACTERISTIC K_DSOCABSCH "Applikationsgr�sse f�r d_soc | EN: Calibration value for d_soc" VALUE 0x75E6E TKW_VV_VV_SW 100.0 FORMULA_0475 -100.0000 99.9969 FORMAT "%5.2" /end CHARACTERISTIC
/begin CHARACTERISTIC K_TSAISPWF "Defaultwert Saison Temp bei DME Powerfail | EN: Default seasonal temperature on DME power fail [°C]" VALUE 0x75E70 TKW_VV_VV_SW 100.0 FORMULA_0426 -3276.8000 3276.7000 /end CHARACTERISTIC
/begin CHARACTERISTIC K_BILA_OGRZ "Grenzwert oberhalb dessen eine Apassung durch soc_kor nicht zul�ssig ist" VALUE 0x75E72 TKW_VV_VV_UW 100.0 FORMULA_0433 0.0 99.9984 FORMAT "%5.2" /end CHARACTERISTIC
/begin CHARACTERISTIC K_BILA_UGRZ "" VALUE 0x75E74 TKW_VV_VV_UW 100.0 FORMULA_0433 0.0 99.9984 FORMAT "%5.2" /end CHARACTERISTIC
/begin CHARACTERISTIC K_PMTIMERSQ1 "Startwert Timer f�r soc_quali | EN: Start value of timer for soc_quali" VALUE 0x75E76 TKW_VV_VV_UW 100.0 FORMULA_0010 0.0 65535.0000 /end CHARACTERISTIC
/begin CHARACTERISTIC K_PM_TABSMN "Applikationsgr�sse f�r Abstellzeit tabsmn_w | EN: Calibration value for engine-off time tabsmn_w [s]" VALUE 0x75E78 TKW_VV_VV_UW 100.0 FORMULA_0510 0.0 65535.0000 FORMAT "%4.1" /end CHARACTERISTIC
/begin CHARACTERISTIC K_QSOCCL1 "Grenze zur Ladezustandsqualit�tsklasse1 | EN: Limit for state-of-charge quality class 1 [Ah]" VALUE 0x75E7A TKW_VV_VV_UW 100.0 FORMULA_0494 0.0 1192.7502 FORMAT "%6.3" /end CHARACTERISTIC
/begin CHARACTERISTIC K_QSOCCL2 "Grenze zur Ladezustandsqualit�tsklasse2 | EN: Limit for state-of-charge quality class 2 [Ah]" VALUE 0x75E7C TKW_VV_VV_UW 100.0 FORMULA_0494 0.0 1192.7502 FORMAT "%6.3" /end CHARACTERISTIC
/begin CHARACTERISTIC K_QSOCCL3 "Grenze zur Ladezustandsqualit�tsklasse3 | EN: Limit for state-of-charge quality class 3 [Ah]" VALUE 0x75E7E TKW_VV_VV_UW 100.0 FORMULA_0494 0.0 1192.7502 FORMAT "%6.3" /end CHARACTERISTIC
/begin CHARACTERISTIC K_QSTARTFGA "Applikationswert f�r q_startfgk | EN: Calibration value for q_startfgk" VALUE 0x75E80 TKW_VV_VV_UW 100.0 FORMULA_0494 0.0 1192.7502 FORMAT "%6.3" /end CHARACTERISTIC
/begin CHARACTERISTIC K_SOCFITGRZ "Grenzwert f�r soc_fit | EN: Limit value for soc_fit" VALUE 0x75E82 TKW_VV_VV_UW 100.0 FORMULA_0433 0.0 99.9984 FORMAT "%5.2" /end CHARACTERISTIC
/begin CHARACTERISTIC K_SOCFITLIMH "Applikationskonstante zur Verbesserung SoC aus der Fitberechnung" VALUE 0x75E84 TKW_VV_VV_UW 100.0 FORMULA_0433 0.0 99.9984 FORMAT "%5.2" /end CHARACTERISTIC
/begin CHARACTERISTIC K_SOCFITLIML "Applikationskonstante zur Abwertung SoC aus der Fitberechnung | EN: Calibration constant for devaluing state of charge from fit calculation" VALUE 0x75E86 TKW_VV_VV_UW 100.0 FORMULA_0433 0.0 99.9984 FORMAT "%5.2" /end CHARACTERISTIC
/begin CHARACTERISTIC K_SOC_STAFGA "Applikationswert f�r SoC aus der Startf�higkeit | EN: Calibration value for state of charge from start capability" VALUE 0x75E88 TKW_VV_VV_UW 100.0 FORMULA_0433 0.0 99.9984 FORMAT "%5.2" /end CHARACTERISTIC
/begin CHARACTERISTIC K_TSAISONFIL "Filterkonstante f�r t_saison | EN: Filter constant for seasonal temperature" VALUE 0x75E8A TKW_VV_VV_UW 100.0 FORMULA_0010 1.0000 65535.0000 /end CHARACTERISTIC
/begin CHARACTERISTIC S_ABSCHK "Schalter f�r Applikationswert absch_korr | EN: Switch for calibration value absch_korr" VALUE 0x75E8C TKW_VV_VV_UB 100.0 FORMULA_0003 0.0 255.0000 /end CHARACTERISTIC
/begin CHARACTERISTIC S_DSOCS "Schalter f�r Applikationswert Delta SoC | EN: Switch for calibration value delta state of charge" VALUE 0x75E8D TKW_VV_VV_UB 100.0 FORMULA_0003 0.0 255.0000 /end CHARACTERISTIC
/begin CHARACTERISTIC S_PMTABSMN "Schalter f�r Applikation der Abstellzeit tabsmn_w | EN: Switch for calibrating engine-off time tabsmn_w" VALUE 0x75E8E TKW_VV_VV_UB 100.0 FORMULA_0003 0.0 255.0000 /end CHARACTERISTIC
/begin CHARACTERISTIC S_QSTARTFK "Schalter f�r Applikation q_startfgk | EN: Switch for calibrating q_startfgk" VALUE 0x75E8F TKW_VV_VV_UB 100.0 FORMULA_0003 0.0 255.0000 /end CHARACTERISTIC
/begin CHARACTERISTIC S_SOCSTAFK "Schalter f�r Applikation SoC aus der Startf�higkeit | EN: Switch for calibrating state of charge from start capability" VALUE 0x75E90 TKW_VV_VV_UB 100.0 FORMULA_0003 0.0 255.0000 /end CHARACTERISTIC
/begin CHARACTERISTIC KL_FITGRZ "Grenzwert f�r soc_fit | EN: Limit value for soc_fit" CURVE 0x75E92 TKL_SW_VV_UW 100.0 FORMULA_0433 0.0 99.9984 /begin AXIS_DESCR STD_AXIS T_saison FORMULA_0426 4 -3276.8000 3276.7000 /end AXIS_DESCR FORMAT "%5.2" /end CHARACTERISTIC
/begin CHARACTERISTIC KL_SSOC "soc_s in Abh. von tsaison | EN: soc_s depending on seasonal temperature" CURVE 0x75EA4 TKL_SW_VV_UW 100.0 FORMULA_0433 0.0 99.9984 /begin AXIS_DESCR STD_AXIS T_saison FORMULA_0426 4 -3276.8000 3276.7000 /end AXIS_DESCR FORMAT "%5.2" /end CHARACTERISTIC
/begin MEASUREMENT St_pmsockor0.B_soc_npl "Bedingung SoC-Wert nicht plausibel" UBYTE FORMULA_0418 0 0 0.0 255.0 ECU_ADDRESS 0x3FCDCE BIT_MASK 0x1 /end MEASUREMENT
/begin MEASUREMENT St_pmsockor0.B_pm_fit2 "Bedingung Hilfsvariable Fit 2" UBYTE FORMULA_0419 0 0 0.0 255.0 ECU_ADDRESS 0x3FCDCE BIT_MASK 0x2 /end MEASUREMENT
/begin MEASUREMENT St_pmsockor0.B_pm_fit3 "Bedingung Hilfsvariable Fit 3" UBYTE FORMULA_0420 0 0 0.0 255.0 ECU_ADDRESS 0x3FCDCE BIT_MASK 0x4 /end MEASUREMENT
/begin MEASUREMENT St_pmsockor0.B_pmsocini "wird beim INIT wahr um den Timer zur�ckzusetzen" UBYTE FORMULA_0421 0 0 0.0 255.0 ECU_ADDRESS 0x3FCDCE BIT_MASK 0x8 /end MEASUREMENT
/begin MEASUREMENT St_pmsockor0.B_q_start "Bedingung Startqualit�t vollst�ndig berechnet" UBYTE FORMULA_0422 0 0 0.0 255.0 ECU_ADDRESS 0x3FCDCE BIT_MASK 0x10 /end MEASUREMENT
/begin MEASUREMENT St_pmsockor0.B_abschfit "Bedingung Korrektur Startf�higkeitsgrenze durchgef�hrt" UBYTE FORMULA_0423 0 0 0.0 255.0 ECU_ADDRESS 0x3FCDCE BIT_MASK 0x20 /end MEASUREMENT
/begin MEASUREMENT St_pmsockor0 "Statuswort" UBYTE FORMULA_0003 0 0 0.0 255.0000 ECU_ADDRESS 0x3FCDCE /end MEASUREMENT
/begin MEASUREMENT D_socw "Delta SoC" SWORD FORMULA_0475 0 0 -100.0000 99.9969 ECU_ADDRESS 0x3FCDD0 /end MEASUREMENT
/begin MEASUREMENT T_saisonalt "letzter Wert Saisontemperatur" SWORD FORMULA_0426 0 0 -3276.8000 3276.7000 ECU_ADDRESS 0x3FCDD2 /end MEASUREMENT
/begin MEASUREMENT Soc_stfgkw "SoC Startf�higkeit" UWORD FORMULA_0433 0 0 0.0 99.9984 ECU_ADDRESS 0x3FCDD4 /end MEASUREMENT
/begin MEASUREMENT Absch_korr "Korrekturwert Abschaltung" SWORD FORMULA_0495 0 0 -40.0000 40.0000 ECU_ADDRESS 0x3FAA5A /end MEASUREMENT
/begin MEASUREMENT D_soc "Abstand zur Startf�higkeitsgrenze" SWORD FORMULA_0475 0 0 -100.0000 99.9969 ECU_ADDRESS 0x3FAA5C /end MEASUREMENT
/begin MEASUREMENT Soc_korr "Korrekturwert soc_bila" SWORD FORMULA_0475 0 0 -100.0000 99.9969 ECU_ADDRESS 0x3FAA5E /end MEASUREMENT
/begin MEASUREMENT T_saison "Saison -Temperatur" SWORD FORMULA_0426 0 0 -3276.8000 3276.7000 ECU_ADDRESS 0x3FAA60 /end MEASUREMENT
/begin MEASUREMENT Q_startfgk "Abstand zur Startf�higkeitsgrenze" UWORD FORMULA_0494 0 0 0.0 1192.7502 ECU_ADDRESS 0x3FAA62 /end MEASUREMENT
/begin MEASUREMENT Soc_q_kor "Korrekturwert Genauigkeit Ladezustandsbestimmung" UWORD FORMULA_0494 0 0 0.0 1192.7502 ECU_ADDRESS 0x3FAA64 /end MEASUREMENT
/begin MEASUREMENT Soc_rel "Relativz�hler f�r Ladezustand SoC" UWORD FORMULA_0433 0 0 0.0 99.9984 ECU_ADDRESS 0x3FAA66 /end MEASUREMENT
/begin MEASUREMENT Soc_stfgk "Startf�higkeitsgrenze" UWORD FORMULA_0433 0 0 0.0 99.9984 ECU_ADDRESS 0x3FAA68 /end MEASUREMENT
/begin MEASUREMENT Pm_tsrdy "Status Berechnung Tsaison" UBYTE FORMULA_0474 0 0 0.0 1.0000 ECU_ADDRESS 0x3FAA6A /end MEASUREMENT
/* ------------------ Abschnitt erzeugt aus pmsocstart.dat ------------------ */
/begin CHARACTERISTIC K_TIME_START "Zeittriggerschwelle nach Motorstart" VALUE 0x75EB6 TKW_VV_VV_UW 100.0 FORMULA_0021 0.0 655.3500 FORMAT "%5.2" /end CHARACTERISTIC
/begin CHARACTERISTIC K_UB_GRENZ "Grenzwert Gradient d. Bordnetzspannung" VALUE 0x75EB8 TKW_VV_VV_UW 100.0 FORMULA_0427 0.0 6173.3970 FORMAT "%4.1" /end CHARACTERISTIC
/begin CHARACTERISTIC K_USTARTGRZ "Spannungsgrenzwert f�r Startauswertung  | EN: Voltage limit for start evaluation" VALUE 0x75EBA TKW_VV_VV_UW 100.0 FORMULA_0497 6.0000 22.3837 FORMAT "%6.3" /end CHARACTERISTIC
/begin CHARACTERISTIC K_RIN_GRENZ1 "Grenzwert Innenwiderstand Batterie1 | EN: Battery internal resistance limit 1" VALUE 0x75EBC TKW_VV_VV_UB 100.0 FORMULA_0455 0.0 31.8750 /end CHARACTERISTIC
/begin CHARACTERISTIC K_RIN_GRENZ2 "Grenzwert Innenwiderstand Batterie2 | EN: Battery internal resistance limit 2" VALUE 0x75EBD TKW_VV_VV_UB 100.0 FORMULA_0455 0.0 31.8750 /end CHARACTERISTIC
/begin CHARACTERISTIC K_RIN_GRENZ3 "Grenzwert Innenwiderstand Batterie3 | EN: Battery internal resistance limit 3" VALUE 0x75EBE TKW_VV_VV_UB 100.0 FORMULA_0455 0.0 31.8750 /end CHARACTERISTIC
/begin CHARACTERISTIC K_RIN_GRENZ4 "Grenzwert Innenwiderstand Batterie4 | EN: Battery internal resistance limit 4" VALUE 0x75EBF TKW_VV_VV_UB 100.0 FORMULA_0455 0.0 31.8750 /end CHARACTERISTIC
/begin CHARACTERISTIC K_RIN_GRENZ5 "Grenzwert Innenwiderstand Batterie5 | EN: Battery internal resistance limit 5" VALUE 0x75EC0 TKW_VV_VV_UB 100.0 FORMULA_0455 0.0 31.8750 /end CHARACTERISTIC
/begin CHARACTERISTIC K_RIN_GRENZ6 "Grenzwert Innenwiderstand Batterie6 | EN: Battery internal resistance limit 6" VALUE 0x75EC1 TKW_VV_VV_UB 100.0 FORMULA_0455 0.0 31.8750 /end CHARACTERISTIC
/begin CHARACTERISTIC K_RIN_GRENZ7 "Grenzwert Innenwiderstand Batterie7 | EN: Battery internal resistance limit 7" VALUE 0x75EC2 TKW_VV_VV_UB 100.0 FORMULA_0455 0.0 31.8750 /end CHARACTERISTIC
/begin CHARACTERISTIC K_RIN_GRENZ8 "Grenzwert Innenwiderstand Batterie8 | EN: Battery internal resistance limit 8" VALUE 0x75EC3 TKW_VV_VV_UB 100.0 FORMULA_0455 0.0 31.8750 /end CHARACTERISTIC
/begin CHARACTERISTIC S_NKWITNSTRT "0 = Nkw-Auswertung, 1=Itnstart Auswertung | EN: 0 = engine-speed evaluation, 1 = start-current evaluation" VALUE 0x75EC4 TKW_VV_VV_UB 100.0 FORMULA_0474 0.0 1.0000 /end CHARACTERISTIC
/begin CHARACTERISTIC S_PMSTARTQ "Applikationsschalter f. B_pmstartq | EN: Calibration switch for B_pmstartq" VALUE 0x75EC5 TKW_VV_VV_UB 100.0 FORMULA_0003 0.0 255.0000 /end CHARACTERISTIC
/begin CHARACTERISTIC S_PM_TEST1 "Applikationsschalter um die Startberechnung zu erzwingen | EN: Calibration switch to force start calculation" VALUE 0x75EC6 TKW_VV_VV_UB 100.0 FORMULA_0003 0.0 255.0000 /end CHARACTERISTIC
/begin CHARACTERISTIC S_RIN "Schalter Applikation Innenwiderstandspr�fung | EN: Switch for internal-resistance check calibration" VALUE 0x75EC7 TKW_VV_VV_UB 100.0 FORMULA_0003 0.0 255.0000 /end CHARACTERISTIC
/begin CHARACTERISTIC S_STARTAW "Startauswertung fertig | EN: Start evaluation finished" VALUE 0x75EC8 TKW_VV_VV_UB 100.0 FORMULA_0003 0.0 255.0000 /end CHARACTERISTIC
/begin CHARACTERISTIC KL_UNSTART "Startspannung abh�ngig v.Motordrehzahl | EN: Start voltage depending on engine speed" CURVE 0x75ECA TKL_SW_VV_UW 100.0 FORMULA_0497 6.0000 22.3837 /begin AXIS_DESCR STD_AXIS Nnmstart FORMULA_0006 2 -32768.0000 32767.0000 /end AXIS_DESCR FORMAT "%6.3" /end CHARACTERISTIC
/begin CHARACTERISTIC KL_ITNSTART "Startspannung abh. vom Itnstart | EN: Start voltage depending on start current" CURVE 0x75ED4 TKL_UB_VV_UW 100.0 FORMULA_0497 6.0000 22.3837 /begin AXIS_DESCR STD_AXIS NO_INPUT_QUANTITY FORMULA_0512 4 0.0 996.0937 /end AXIS_DESCR FORMAT "%6.3" /end CHARACTERISTIC
/begin CHARACTERISTIC KL_UTSTART "Startspannung in Abh�ngigkeit von Temperatur Batterie" CURVE 0x75EE2 TKL_SW_VV_SW 100.0 FORMULA_0496 -8.1920 8.1917 /begin AXIS_DESCR STD_AXIS T_batt FORMULA_0426 3 -3276.8000 3276.7000 /end AXIS_DESCR FORMAT "%6.3" /end CHARACTERISTIC
/begin MEASUREMENT St_pmsocstart0.B_pmstart7 "Bed. Motorstart f�r Startauswertung PM" UBYTE FORMULA_0418 0 0 0.0 255.0 ECU_ADDRESS 0x3FCDD6 BIT_MASK 0x1 /end MEASUREMENT
/begin MEASUREMENT St_pmsocstart0.B_resetsta "Bedingung Reset Startauswertung" UBYTE FORMULA_0419 0 0 0.0 255.0 ECU_ADDRESS 0x3FCDD6 BIT_MASK 0x2 /end MEASUREMENT
/begin MEASUREMENT St_pmsocstart0.B_rstdatardy "Motor aus erkannt, Startwerte im IBS bereit zum l�schen." UBYTE FORMULA_0420 0 0 0.0 255.0 ECU_ADDRESS 0x3FCDD6 BIT_MASK 0x4 /end MEASUREMENT
/begin MEASUREMENT St_pmsocstart0 "Statuswort" UBYTE FORMULA_0003 0 0 0.0 255.0000 ECU_ADDRESS 0x3FCDD6 /end MEASUREMENT
/begin MEASUREMENT St_pmsocstart_nv0.B_pmstartq "Bedingung Startqualit�t" UBYTE FORMULA_0418 0 0 0.0 255.0 ECU_ADDRESS 0x3FAA6B BIT_MASK 0x1 /end MEASUREMENT
/begin MEASUREMENT St_pmsocstart_nv0.B_pmsqrdy "kt_ibs.dat" UBYTE FORMULA_0419 0 0 0.0 255.0 ECU_ADDRESS 0x3FAA6B BIT_MASK 0x2 /end MEASUREMENT
/begin MEASUREMENT St_pmsocstart_nv0 "Statuswort" UBYTE FORMULA_0003 0 0 0.0 255.0000 ECU_ADDRESS 0x3FAA6B /end MEASUREMENT
/begin MEASUREMENT Nnmstart "Motordrehzahl nach Motorstart" SWORD FORMULA_0006 0 0 -32768.0000 32767.0000 ECU_ADDRESS 0x3FCDD8 /end MEASUREMENT
/begin MEASUREMENT U_startausw "U_tnstart - ugrenz" SWORD FORMULA_0496 0 0 -8.1920 8.1917 ECU_ADDRESS 0x3FCDDA /end MEASUREMENT
/begin MEASUREMENT Ideltaabs "Differenz der Startstr�me" UWORD FORMULA_0511 0 0 0.0200 1310.7000 ECU_ADDRESS 0x3FCDDC /end MEASUREMENT
/begin MEASUREMENT U_grenz "Grenzwert Spannung" UWORD FORMULA_0497 0 0 6.0000 22.3837 ECU_ADDRESS 0x3FCDDE /end MEASUREMENT
/begin MEASUREMENT Ub_old "letzter Wert Batteriespannung" UWORD FORMULA_0427 0 0 0.0 6173.3970 ECU_ADDRESS 0x3FCDE0 /end MEASUREMENT
/begin MEASUREMENT Pmstartsta "Schalter f�r Ablaufsteuerung" UBYTE FORMULA_0003 0 0 0.0 255.0000 ECU_ADDRESS 0x3FCDE2 /end MEASUREMENT
/begin MEASUREMENT Rin_grenzh "Batt.Innenwiderstand Grenze" UBYTE FORMULA_0455 0 0 0.0 31.8750 ECU_ADDRESS 0x3FCDE3 /end MEASUREMENT
/begin MEASUREMENT Rin_start "Innenwiderstand Batterie beim Start" UBYTE FORMULA_0455 0 0 0.0 31.8750 ECU_ADDRESS 0x3FCDE4 /end MEASUREMENT
/* ------------------ Abschnitt erzeugt aus pmugencalc.dat ------------------ */
/begin CHARACTERISTIC K_IGRDETEC "U_gsoll - U_ibs Max f�r Freeze" VALUE 0x75EF0 TKW_VV_VV_SW 100.0 FORMULA_0484 -128.0000 127.9960 FORMAT "%6.3" /end CHARACTERISTIC
/begin CHARACTERISTIC K_PMUGEN_MAX "Max zugelassene Generatorspg" VALUE 0x75EF2 TKW_VV_VV_SW 100.0 FORMULA_0484 -128.0000 127.9960 FORMAT "%6.3" /end CHARACTERISTIC
/begin CHARACTERISTIC K_PMUGEN_MIN "Min zugelassene Generatorspg" VALUE 0x75EF4 TKW_VV_VV_SW 100.0 FORMULA_0484 -128.0000 127.9960 FORMAT "%6.3" /end CHARACTERISTIC
/begin CHARACTERISTIC K_UGENNORM "Generator Normspannung | EN: Generator Normspannung" VALUE 0x75EF6 TKW_VV_VV_SW 100.0 FORMULA_0484 -128.0000 127.9960 FORMAT "%6.3" /end CHARACTERISTIC
/begin CHARACTERISTIC K_UIBSAPP "Manueller Applikationswert von Uibs an UGENKOR" VALUE 0x75EF8 TKW_VV_VV_SW 100.0 FORMULA_0484 -128.0000 127.9960 FORMAT "%6.3" /end CHARACTERISTIC
/begin CHARACTERISTIC K_USTEPMIN "Min. Delta zw. Battsollspg und Battspg damit uibs veraendert wird." VALUE 0x75EFA TKW_VV_VV_SW 100.0 FORMULA_0484 -128.0000 127.9960 FORMAT "%6.3" /end CHARACTERISTIC
/begin CHARACTERISTIC K_PMUBAT_MAX "Max. zugelassene Batteriespg " VALUE 0x75EFC TKW_VV_VV_UW 100.0 FORMULA_0497 6.0000 22.3837 FORMAT "%6.3" /end CHARACTERISTIC
/begin CHARACTERISTIC K_PMUBAT_MIN "Min. zugelassene Batteriespg" VALUE 0x75EFE TKW_VV_VV_UW 100.0 FORMULA_0497 6.0000 22.3837 FORMAT "%6.3" /end CHARACTERISTIC
/begin CHARACTERISTIC K_DFOVERRIDE "Schwellwert wann Generator als ueberlastet erkannt wird | EN: Schwellwert wann Generator als ueberlastet erkannt wird" VALUE 0x75F00 TKW_VV_VV_UB 100.0 FORMULA_0471 0.0 99.6093 /end CHARACTERISTIC
/begin CHARACTERISTIC K_TD_BNMOT "Zeit nach Motorlauf, wo die stufenweise (USTEPMIN) Berechnung von uibs aktiviert wird." VALUE 0x75F01 TKW_VV_VV_UB 100.0 FORMULA_0472 0.0 255.0000 /end CHARACTERISTIC
/begin CHARACTERISTIC K_TD_PMUGEN "Taskzeit von PMUGENCALC, = Zeit wo die stufenweise Setzung von uibs berechnet wird." VALUE 0x75F02 TKW_VV_VV_UB 100.0 FORMULA_0472 0.0 255.0000 /end CHARACTERISTIC
/begin CHARACTERISTIC S_UIBS "Schalter f�r UIBS, wenn True dann uibs=UIBSAPP | EN: Schalter fï¿½r UIBS, wenn True dann uibs=UIBSAPP" VALUE 0x75F03 TKW_VV_VV_UB 100.0 FORMULA_0474 0.0 1.0000 /end CHARACTERISTIC
/begin CHARACTERISTIC KL_USOLL "Batteriesollspannung aufgrund von tbatt" CURVE 0x75F04 TKL_SW_VV_UW 100.0 FORMULA_0497 6.0000 22.3837 /begin AXIS_DESCR STD_AXIS T_batt FORMULA_0426 3 -3276.8000 3276.7000 /end AXIS_DESCR FORMAT "%6.3" /end CHARACTERISTIC
/begin CHARACTERISTIC KF_USOLL "Batteriesollspannung aufgrund der Temperatur und soc." MAP 0x75F12 TKF_UW_SW_UW 100.0 FORMULA_0497 6.0000 22.3837 /begin AXIS_DESCR STD_AXIS T_batt FORMULA_0426 3 -3276.8000 3276.7000 /end AXIS_DESCR /begin AXIS_DESCR STD_AXIS Soc_rel FORMULA_0433 3 0.0 99.9984 FORMAT "%5.2" /end AXIS_DESCR FORMAT "%6.3" /end CHARACTERISTIC
/begin MEASUREMENT St_pmugencalc.B_genclcon "Wird auf true gesetzt wenn Motor und Generator bereits T_B_NMOT-Sekunden laufen." UBYTE FORMULA_0418 0 0 0.0 255.0 ECU_ADDRESS 0x3FCDE6 BIT_MASK 0x1 /end MEASUREMENT
/begin MEASUREMENT St_pmugencalc "Statuswort" UBYTE FORMULA_0003 0 0 0.0 255.0000 ECU_ADDRESS 0x3FCDE6 /end MEASUREMENT
/begin MEASUREMENT U_ibs "Generatorspannungsvorgabe von IBS" SWORD FORMULA_0484 0 0 -128.0000 127.9960 ECU_ADDRESS 0x3FCDE8 /end MEASUREMENT
/begin MEASUREMENT U_igrdetec "U_gsoll - U_ibs f�r IGRLOW Detektierung" SWORD FORMULA_0484 0 0 -128.0000 127.9960 ECU_ADDRESS 0x3FCDEA /end MEASUREMENT
/begin MEASUREMENT Udelta "Delta zw. Battsollspg und Battspg" SWORD FORMULA_0496 0 0 -8.1920 8.1917 ECU_ADDRESS 0x3FCDEC /end MEASUREMENT
/begin MEASUREMENT Udeltaabs "Absolutwert von udelta" SWORD FORMULA_0496 0 0 0.0 8.1917 ECU_ADDRESS 0x3FCDEE /end MEASUREMENT
/begin MEASUREMENT Ubattsoll "Batteriesollspannung aufgrund Batterietemperatur und Batt.-ladezustand. Weitere Nutzung in PMPRSVCALC." UWORD FORMULA_0497 0 0 6.0000 22.3837 ECU_ADDRESS 0x3FCDF0 /end MEASUREMENT
/begin MEASUREMENT Ubattsoll7 "lokales ubattsoll" UWORD FORMULA_0497 0 0 6.0000 22.3837 ECU_ADDRESS 0x3FCDF2 /end MEASUREMENT
/begin MEASUREMENT T_bnmotakt "Zeit nachdem der Motor laeuft, hoert nach T_B_NMOT Sekunden auf." UBYTE FORMULA_0472 0 0 0.0 255.0000 ECU_ADDRESS 0x3FCDF4 /end MEASUREMENT
/begin MEASUREMENT T_delta "Zeit, die seit letzem Prozessaufruf verstrichen ist. Dient zur Taskkompatibilitaet." UBYTE FORMULA_0472 0 0 0.0 255.0000 ECU_ADDRESS 0x3FCDF5 /end MEASUREMENT
/begin MEASUREMENT Uibs7 "lokales uibs" SWORD FORMULA_0484 0 0 -128.0000 127.9960 ECU_ADDRESS 0x3FB11A /end MEASUREMENT
/* ------------------ Abschnitt erzeugt aus cantel.dat ------------------ */
/begin CHARACTERISTIC K_CAN_ED_UB_MIN "min. Ub fuer CAN-Diagnose | EN: min. Ub fuer CAN-Diagnose" VALUE 0x70776 TKW_VV_VV_SW 100.0 FORMULA_0008 0.0 28.0000 FORMAT "%4.1" /end CHARACTERISTIC
/begin CHARACTERISTIC K_CAN_ED_TSPERR "ED-Sperrzeit | EN: ED-Sperrzeit" VALUE 0x70778 TKW_VV_VV_UW 100.0 FORMULA_0609 0.0 327.6750 FORMAT "%5.2" /end CHARACTERISTIC
/begin CHARACTERISTIC K_CAN_CFG "CAN-Sonderfunktionen" VALUE 0x7077A TKW_VV_VV_UB 100.0 FORMULA_0627 0.0 255.0 /end CHARACTERISTIC
/begin CHARACTERISTIC K_CAN_CFG_ANZGRB "Anzeige Getriebedaten" VALUE 0x7077B TKW_VV_VV_UB 100.0 FORMULA_0628 0.0 255.0 /end CHARACTERISTIC
/begin CHARACTERISTIC K_CAN_CFG_OBDFST "Zuordnung Fuellstaende" VALUE 0x7077C TKW_VV_VV_UB 100.0 FORMULA_0629 0.0 255.0 /end CHARACTERISTIC
/begin CHARACTERISTIC K_CAN_ALIVE_ERR_MAX "Schwelle Aliveerror | EN: 0   Schwelle Aliveerror" VALUE 0x7077D TKW_VV_VV_UB 100.0 FORMULA_0003 0.0 255.0000 /end CHARACTERISTIC
/begin CHARACTERISTIC K_CAN_CHKSUM_ERR_MAX "Schwelle Chksum-Error | EN: 0   Schwelle Chksum-Error" VALUE 0x7077E TKW_VV_VV_UB 100.0 FORMULA_0003 0.0 255.0000 /end CHARACTERISTIC
/begin CHARACTERISTIC K_CAN_CRASH_CTR_TOUT "Crash-Kontrolle bei Timeout | EN: 5 EKP an 10 EKP aus 15 ungueltig Crash-Kontrolle bei Timeout" VALUE 0x7077F TKW_VV_VV_UB 100.0 FORMULA_0630 0.0 255.0 /end CHARACTERISTIC
/begin CHARACTERISTIC K_CAN_TUMG_MCS "Tumg per MCS | EN: Tumg per MCS" VALUE 0x70780 TKW_VV_VV_UB 100.0 FORMULA_0631 -40.0000 87.5000 /end CHARACTERISTIC
/begin CHARACTERISTIC K_CAN_CLAS_BAT_INIT "Batterieklasse" VALUE 0x70781 TKW_VV_VV_UB 100.0 FORMULA_0618 0.0 255.0000 /end CHARACTERISTIC
/begin CHARACTERISTIC K_CAN_QC_VEH_INIT "Ruhestrom Fahrzeug" VALUE 0x70782 TKW_VV_VV_UB 100.0 FORMULA_0619 0.0 255.0000 /end CHARACTERISTIC
/begin CHARACTERISTIC K_CAN_I_SC_MIN_INIT "min. Kurzschlu�strom | EN: min. Kurzschluï¿½strom" VALUE 0x70783 TKW_VV_VV_UB 100.0 FORMULA_0620 0.0 2550.0000 /end CHARACTERISTIC
/begin CHARACTERISTIC K_CAN_I_SC_MAX_INIT "max. Kurzschlu�strom" VALUE 0x70784 TKW_VV_VV_UB 100.0 FORMULA_0620 0.0 2550.0000 /end CHARACTERISTIC
/begin CHARACTERISTIC K_CAN_KEY_NO_MCS "Schluesselnummer per MCS | EN: Key number via MCS" VALUE 0x70785 TKW_VV_VV_UB 100.0 FORMULA_0003 0.0 255.0000 /end CHARACTERISTIC
/begin MEASUREMENT can_ed_tsperr "ED-Sperrzeit fuer BusOn" UWORD FORMULA_0609 0 0 0.0 327.6750 ECU_ADDRESS 0x3FBDF0 /end MEASUREMENT
/begin MEASUREMENT can_ed_tsperr_kl15 "ED-Sperrzeit fuer Kl15" UWORD FORMULA_0609 0 0 0.0 327.6750 ECU_ADDRESS 0x3FBDF2 /end MEASUREMENT
/begin MEASUREMENT can_st_lrw "Empfangsstatus LRW" UBYTE FORMULA_0126 0 0 0.0 255.0 ECU_ADDRESS 0x3FBDF4 /end MEASUREMENT
/begin MEASUREMENT can_st_crash "Empfangsstatus Crashabschaltung" UBYTE FORMULA_0126 0 0 0.0 255.0 ECU_ADDRESS 0x3FBDF5 /end MEASUREMENT
/begin MEASUREMENT can_st_kmst "Empfangsstatus Kilometerstand" UBYTE FORMULA_0126 0 0 0.0 255.0 ECU_ADDRESS 0x3FBDF6 /end MEASUREMENT
/begin MEASUREMENT can_st_bedat "Empfangsstatus Bed. Audio Tel" UBYTE FORMULA_0126 0 0 0.0 255.0 ECU_ADDRESS 0x3FBDF7 /end MEASUREMENT
/begin MEASUREMENT can_alive_klst_cnt "Fehler Alive" UBYTE FORMULA_0003 0 0 0.0 255.0000 ECU_ADDRESS 0x3FBDF8 /end MEASUREMENT
/begin MEASUREMENT can_chksum_klst_cnt "Fehler Checksumme" UBYTE FORMULA_0003 0 0 0.0 255.0000 ECU_ADDRESS 0x3FBDFA /end MEASUREMENT
/begin MEASUREMENT can_klst_s_roh "KLST-Rohinfo" UBYTE FORMULA_0003 0 0 0.0 255.0000 ECU_ADDRESS 0x3FBDFB /end MEASUREMENT
/begin MEASUREMENT can_klst_timeout "KLST-Timeout" UBYTE FORMULA_0458 0 0 0.0 25.5000 ECU_ADDRESS 0x3FBDFC /end MEASUREMENT
/begin MEASUREMENT can_klst_15off "Req Kl15-Abschaltung" UBYTE FORMULA_0610 0 0 0.0 255.0 ECU_ADDRESS 0x3FBDFD /end MEASUREMENT
/begin MEASUREMENT can_kkos_timeout "KKOS-Timeout" UBYTE FORMULA_0458 0 0 0.0 25.5000 ECU_ADDRESS 0x3FBDFE /end MEASUREMENT
/begin MEASUREMENT can_kkos_elu "Anfoderung ELU" UBYTE FORMULA_0611 0 0 0.0 255.0000 ECU_ADDRESS 0x3FBDFF /end MEASUREMENT
/begin MEASUREMENT can_alive_TorqReqDSC_cnt "Fehler Alive" UBYTE FORMULA_0003 0 0 0.0 255.0000 ECU_ADDRESS 0x3FBE00 /end MEASUREMENT
/begin MEASUREMENT can_chksum_TorqReqDSC_cnt "Fehler Checksumme" UBYTE FORMULA_0003 0 0 0.0 255.0000 ECU_ADDRESS 0x3FBE02 /end MEASUREMENT
/begin MEASUREMENT can_verz_st "Verzoegerungs-Status" UBYTE FORMULA_0612 0 0 0.0 255.0 ECU_ADDRESS 0x3FBE03 /end MEASUREMENT
/begin MEASUREMENT can_kmst_timeout "KMST-Timeout" UBYTE FORMULA_0613 0 0 0.0 255.0000 ECU_ADDRESS 0x3FBE04 /end MEASUREMENT
/begin MEASUREMENT can_fst_li "Fuellstand Tank-Links" UBYTE FORMULA_0557 0 0 0.0 127.5000 ECU_ADDRESS 0x3FBE05 /end MEASUREMENT
/begin MEASUREMENT can_fst_re "Fuellstand Tank-Rechts" UBYTE FORMULA_0557 0 0 0.0 127.5000 ECU_ADDRESS 0x3FBE06 /end MEASUREMENT
/begin MEASUREMENT can_fst_reserve "Reservelampe" UBYTE FORMULA_0614 0 0 0.0 255.0 ECU_ADDRESS 0x3FBE07 /end MEASUREMENT
/begin MEASUREMENT can_no_key_update "Schluesselnr.-Aktualisierungsverriegelung bei B_ZUST_ML" UBYTE FORMULA_0615 0 0 0.0 255.0 ECU_ADDRESS 0x3FBE08 /end MEASUREMENT
/begin MEASUREMENT can_reichweite "Reichweite" UWORD FORMULA_0616 0 0 0.0 65535.0000 ECU_ADDRESS 0x3FBE0A /end MEASUREMENT
/begin MEASUREMENT can_vehmod_timeout "VehMode-Timeout" UBYTE FORMULA_0613 0 0 0.0 255.0000 ECU_ADDRESS 0x3FBE0C /end MEASUREMENT
/begin MEASUREMENT can_alive_vehmod_cnt "Fehler Alive" UBYTE FORMULA_0003 0 0 0.0 255.0000 ECU_ADDRESS 0x3FBE0D /end MEASUREMENT
/begin MEASUREMENT can_chksum_vehmod_cnt "Fehler Checksumme" UBYTE FORMULA_0003 0 0 0.0 255.0000 ECU_ADDRESS 0x3FBE0F /end MEASUREMENT
/begin MEASUREMENT can_crash_timeout "KKOS-Timeout" UBYTE FORMULA_0458 0 0 0.0 25.5000 ECU_ADDRESS 0x3FBE10 /end MEASUREMENT
/begin MEASUREMENT can_crash_ctr "Crash-Kontrolle" UBYTE FORMULA_0617 0 0 0.0 255.0 ECU_ADDRESS 0x3FBE11 /end MEASUREMENT
/begin MEASUREMENT can_alive_vfzg_cnt "Fehler Alive" UBYTE FORMULA_0003 0 0 0.0 255.0000 ECU_ADDRESS 0x3FBE12 /end MEASUREMENT
/begin MEASUREMENT can_chksum_vfzg_cnt "Fehler Checksumme" UBYTE FORMULA_0003 0 0 0.0 255.0000 ECU_ADDRESS 0x3FBE14 /end MEASUREMENT
/begin MEASUREMENT can_v_vorne "vVorne - Rohwert" SWORD FORMULA_0078 0 0 -80.0000 360.0000 ECU_ADDRESS 0x3FBE16 /end MEASUREMENT
/begin MEASUREMENT can_v_rad_vl "Radgeschw. VL - Rohwert" SWORD FORMULA_0078 0 0 -80.0000 360.0000 ECU_ADDRESS 0x3FBE18 /end MEASUREMENT
/begin MEASUREMENT can_v_rad_vr "Radgeschw. VR - Rohwert" SWORD FORMULA_0078 0 0 -80.0000 360.0000 ECU_ADDRESS 0x3FBE1A /end MEASUREMENT
/begin MEASUREMENT can_v_rad_hl "Radgeschw. HL - Rohwert" SWORD FORMULA_0078 0 0 -80.0000 360.0000 ECU_ADDRESS 0x3FBE1C /end MEASUREMENT
/begin MEASUREMENT can_v_rad_hr "Radgeschw. HR - Rohwert" SWORD FORMULA_0078 0 0 -80.0000 360.0000 ECU_ADDRESS 0x3FBE1E /end MEASUREMENT
/begin MEASUREMENT can_bedfgr_timeout "BedFgr-Timeout" UBYTE FORMULA_0458 0 0 0.0 25.5000 ECU_ADDRESS 0x3FBE20 /end MEASUREMENT
/begin MEASUREMENT can_alive_BedFgr_cnt "Fehler Alive" UBYTE FORMULA_0003 0 0 0.0 255.0000 ECU_ADDRESS 0x3FBE21 /end MEASUREMENT
/begin MEASUREMENT can_chksum_BedFgr_cnt "Fehler Checksumme" UBYTE FORMULA_0003 0 0 0.0 255.0000 ECU_ADDRESS 0x3FBE23 /end MEASUREMENT
/begin MEASUREMENT can_clas_bat "Batterieklasse" UBYTE FORMULA_0618 0 0 0.0 255.0000 ECU_ADDRESS 0x3FBE24 /end MEASUREMENT
/begin MEASUREMENT can_i_qc_veh "Ruhestrom Fahrzeug" UBYTE FORMULA_0619 0 0 0.0 255.0000 ECU_ADDRESS 0x3FBE25 /end MEASUREMENT
/begin MEASUREMENT can_i_sc_min "min. Kurzschlu�strom" UBYTE FORMULA_0620 0 0 0.0 2550.0000 ECU_ADDRESS 0x3FBE26 /end MEASUREMENT
/begin MEASUREMENT can_i_sc_max "max. Kurzschlu�strom" UBYTE FORMULA_0620 0 0 0.0 2550.0000 ECU_ADDRESS 0x3FBE27 /end MEASUREMENT
/begin MEASUREMENT can_stat_veh_mod_1of3_ "Status Fahrzeugmodus" UBYTE FORMULA_0621 0 0 0.0 255.0 ECU_ADDRESS 0x3FBE28 /end MEASUREMENT
/begin MEASUREMENT can_stat_veh_mod_2of3_ "Status Fahrzeugmodus" UBYTE FORMULA_0621 0 0 0.0 255.0 ECU_ADDRESS 0x3FBE29 /end MEASUREMENT
/begin MEASUREMENT can_stat_veh_mod_3of3_ "Status Fahrzeugmodus" UBYTE FORMULA_0621 0 0 0.0 255.0 ECU_ADDRESS 0x3FBE2A /end MEASUREMENT
/begin MEASUREMENT can_ctr_ilicht "Steuerung Innenlicht" UBYTE FORMULA_0622 0 0 0.0 255.0 ECU_ADDRESS 0x3FBE2B /end MEASUREMENT
/begin MEASUREMENT can_fgr_idx "Index FGR-Geschwindigkeit" UBYTE FORMULA_0003 0 0 0.0 4.0000 ECU_ADDRESS 0x3FBE2C /end MEASUREMENT
/begin MEASUREMENT can_fgr_v_idx_1_1of5_ "FGR-Geschwindigkeit Index 1" UWORD FORMULA_0623 0 0 30.0000 250.0000 ECU_ADDRESS 0x3FBE2E /end MEASUREMENT
/begin MEASUREMENT can_fgr_v_idx_1_2of5_ "FGR-Geschwindigkeit Index 1" UWORD FORMULA_0623 0 0 30.0000 250.0000 ECU_ADDRESS 0x3FBE30 /end MEASUREMENT
/begin MEASUREMENT can_fgr_v_idx_1_3of5_ "FGR-Geschwindigkeit Index 1" UWORD FORMULA_0623 0 0 30.0000 250.0000 ECU_ADDRESS 0x3FBE32 /end MEASUREMENT
/begin MEASUREMENT can_fgr_v_idx_1_4of5_ "FGR-Geschwindigkeit Index 1" UWORD FORMULA_0623 0 0 30.0000 250.0000 ECU_ADDRESS 0x3FBE34 /end MEASUREMENT
/begin MEASUREMENT can_fgr_v_idx_1_5of5_ "FGR-Geschwindigkeit Index 1" UWORD FORMULA_0623 0 0 30.0000 250.0000 ECU_ADDRESS 0x3FBE36 /end MEASUREMENT
/begin MEASUREMENT can_fgr_v_idx_2_1of5_ "FGR-Geschwindigkeit Index 2" UWORD FORMULA_0623 0 0 30.0000 250.0000 ECU_ADDRESS 0x3FBE38 /end MEASUREMENT
/begin MEASUREMENT can_fgr_v_idx_2_2of5_ "FGR-Geschwindigkeit Index 2" UWORD FORMULA_0623 0 0 30.0000 250.0000 ECU_ADDRESS 0x3FBE3A /end MEASUREMENT
/begin MEASUREMENT can_fgr_v_idx_2_3of5_ "FGR-Geschwindigkeit Index 2" UWORD FORMULA_0623 0 0 30.0000 250.0000 ECU_ADDRESS 0x3FBE3C /end MEASUREMENT
/begin MEASUREMENT can_fgr_v_idx_2_4of5_ "FGR-Geschwindigkeit Index 2" UWORD FORMULA_0623 0 0 30.0000 250.0000 ECU_ADDRESS 0x3FBE3E /end MEASUREMENT
/begin MEASUREMENT can_fgr_v_idx_2_5of5_ "FGR-Geschwindigkeit Index 2" UWORD FORMULA_0623 0 0 30.0000 250.0000 ECU_ADDRESS 0x3FBE40 /end MEASUREMENT
/begin MEASUREMENT can_fgr_v_idx_3_1of5_ "FGR-Geschwindigkeit Index 3" UWORD FORMULA_0623 0 0 30.0000 250.0000 ECU_ADDRESS 0x3FBE42 /end MEASUREMENT
/begin MEASUREMENT can_fgr_v_idx_3_2of5_ "FGR-Geschwindigkeit Index 3" UWORD FORMULA_0623 0 0 30.0000 250.0000 ECU_ADDRESS 0x3FBE44 /end MEASUREMENT
/begin MEASUREMENT can_fgr_v_idx_3_3of5_ "FGR-Geschwindigkeit Index 3" UWORD FORMULA_0623 0 0 30.0000 250.0000 ECU_ADDRESS 0x3FBE46 /end MEASUREMENT
/begin MEASUREMENT can_fgr_v_idx_3_4of5_ "FGR-Geschwindigkeit Index 3" UWORD FORMULA_0623 0 0 30.0000 250.0000 ECU_ADDRESS 0x3FBE48 /end MEASUREMENT
/begin MEASUREMENT can_fgr_v_idx_3_5of5_ "FGR-Geschwindigkeit Index 3" UWORD FORMULA_0623 0 0 30.0000 250.0000 ECU_ADDRESS 0x3FBE4A /end MEASUREMENT
/begin MEASUREMENT can_tuer_st "Tuerstatus" UBYTE FORMULA_0624 0 0 0.0 255.0 ECU_ADDRESS 0x3FBE4C /end MEASUREMENT
/begin MEASUREMENT can_alive_stkombi_cnt "Fehler Alive" UBYTE FORMULA_0003 0 0 0.0 255.0000 ECU_ADDRESS 0x3FBE4D /end MEASUREMENT
/begin MEASUREMENT can_v_tacho "Tachogeschwindigkeit - Rohwert" SWORD FORMULA_0078 0 0 -80.0000 360.0000 ECU_ADDRESS 0x3FBE50 /end MEASUREMENT
/begin MEASUREMENT can_bedat_timeout "BedAT-Timeout" UBYTE FORMULA_0232 0 0 0.0 255.0000 ECU_ADDRESS 0x3FBE52 /end MEASUREMENT
/begin MEASUREMENT can_alive_bedat_cnt "Fehler Alive" UBYTE FORMULA_0003 0 0 0.0 255.0000 ECU_ADDRESS 0x3FBE53 /end MEASUREMENT
/begin MEASUREMENT can_chksum_bedat_cnt "Fehler Komplement" UBYTE FORMULA_0003 0 0 0.0 255.0000 ECU_ADDRESS 0x3FBE55 /end MEASUREMENT
/begin MEASUREMENT can_bedat_s "Schalter Bed. Audio Tel" UBYTE FORMULA_0625 0 0 0.0 255.0 ECU_ADDRESS 0x3FBE56 /end MEASUREMENT
/begin MEASUREMENT can_statanh_timeout "StatAnh-Timeout" UBYTE FORMULA_0232 0 0 0.0 255.0000 ECU_ADDRESS 0x3FBE57 /end MEASUREMENT
/begin MEASUREMENT can_st_statanh "Empfangsstatus StatAnh" UBYTE FORMULA_0126 0 0 0.0 255.0 ECU_ADDRESS 0x3FBE58 /end MEASUREMENT
/begin MEASUREMENT can_statr_timeout "StatR-Timeout" UBYTE FORMULA_0232 0 0 0.0 255.0000 ECU_ADDRESS 0x3FBE59 /end MEASUREMENT
/begin MEASUREMENT can_st_statr "Empfangsstatus StatR" UBYTE FORMULA_0126 0 0 0.0 255.0 ECU_ADDRESS 0x3FBE5A /end MEASUREMENT
/begin MEASUREMENT can_toma_timeout "RadToleranz-Timeout" UBYTE FORMULA_0232 0 0 0.0 255.0000 ECU_ADDRESS 0x3FBE5B /end MEASUREMENT
/begin MEASUREMENT can_st_toma "Empfangsstatus RadToleranz" UBYTE FORMULA_0126 0 0 0.0 255.0 ECU_ADDRESS 0x3FBE5C /end MEASUREMENT
/begin MEASUREMENT can_toma_vl "RadToleranz VL" SBYTE FORMULA_0626 0 0 -12.8000 12.7000 ECU_ADDRESS 0x3FBE5D /end MEASUREMENT
/begin MEASUREMENT can_toma_vr "RadToleranz VR" SBYTE FORMULA_0626 0 0 -12.8000 12.7000 ECU_ADDRESS 0x3FBE5E /end MEASUREMENT
/begin MEASUREMENT can_toma_hl "RadToleranz HL" SBYTE FORMULA_0626 0 0 -12.8000 12.7000 ECU_ADDRESS 0x3FBE5F /end MEASUREMENT
/begin MEASUREMENT can_toma_hr "RadToleranz HR" SBYTE FORMULA_0626 0 0 -12.8000 12.7000 ECU_ADDRESS 0x3FBE60 /end MEASUREMENT
/begin MEASUREMENT can_obd_ed_timeout "CanObdEd-Timeout" UBYTE FORMULA_0232 0 0 0.0 255.0000 ECU_ADDRESS 0x3FBE61 /end MEASUREMENT
/begin MEASUREMENT can_st_obd_ed "Empfangsstatus CanObdEd" UBYTE FORMULA_0126 0 0 0.0 255.0 ECU_ADDRESS 0x3FBE62 /end MEASUREMENT
/* ------------------ Abschnitt erzeugt aus can_ev.dat ------------------ */
/begin MEASUREMENT can_ev_repeat_1of5_ "Wiederholzaehler" UBYTE FORMULA_0003 0 0 0.0 255.0000 ECU_ADDRESS 0x3FBDDD /end MEASUREMENT
/begin MEASUREMENT can_ev_repeat_2of5_ "Wiederholzaehler" UBYTE FORMULA_0003 0 0 0.0 255.0000 ECU_ADDRESS 0x3FBDDE /end MEASUREMENT
/begin MEASUREMENT can_ev_repeat_3of5_ "Wiederholzaehler" UBYTE FORMULA_0003 0 0 0.0 255.0000 ECU_ADDRESS 0x3FBDDF /end MEASUREMENT
/begin MEASUREMENT can_ev_repeat_4of5_ "Wiederholzaehler" UBYTE FORMULA_0003 0 0 0.0 255.0000 ECU_ADDRESS 0x3FBDE0 /end MEASUREMENT
/begin MEASUREMENT can_ev_repeat_5of5_ "Wiederholzaehler" UBYTE FORMULA_0003 0 0 0.0 255.0000 ECU_ADDRESS 0x3FBDE1 /end MEASUREMENT
/begin MEASUREMENT can_ev_timer_1of5_ "Timer" UBYTE FORMULA_0353 0 0 0.0 2550.0000 ECU_ADDRESS 0x3FBDE2 /end MEASUREMENT
/begin MEASUREMENT can_ev_timer_2of5_ "Timer" UBYTE FORMULA_0353 0 0 0.0 2550.0000 ECU_ADDRESS 0x3FBDE3 /end MEASUREMENT
/begin MEASUREMENT can_ev_timer_3of5_ "Timer" UBYTE FORMULA_0353 0 0 0.0 2550.0000 ECU_ADDRESS 0x3FBDE4 /end MEASUREMENT
/begin MEASUREMENT can_ev_timer_4of5_ "Timer" UBYTE FORMULA_0353 0 0 0.0 2550.0000 ECU_ADDRESS 0x3FBDE5 /end MEASUREMENT
/begin MEASUREMENT can_ev_timer_5of5_ "Timer" UBYTE FORMULA_0353 0 0 0.0 2550.0000 ECU_ADDRESS 0x3FBDE6 /end MEASUREMENT
/* ------------------ Abschnitt erzeugt aus pks.dat ------------------ */
/begin CHARACTERISTIC K_PKS_OBD_CFG "OBD Kraftstoffsystem Diagnose" VALUE 0x75620 TKW_VV_VV_UB 100.0 FORMULA_1037 0.0 255.0 /end CHARACTERISTIC
/begin CHARACTERISTIC K_PKS_OBD_PUMG_MIN "Minimaler Umgebungsdruck fuer PKS-Diagnose | EN: Minimum ambient pressure for fuel-pressure diagnosis [mbar]" VALUE 0x75622 TKW_VV_VV_SW 100.0 FORMULA_0077 400.0000 1200.0000 FORMAT "%4.1" /end CHARACTERISTIC
/begin CHARACTERISTIC K_PKS_OBD_UB_MIN "Minimaler Spannungswert U_KL87 fuer PKS-Diagnose | EN: Minimum terminal-87 voltage for fuel-pressure diagnosis [V]" VALUE 0x75624 TKW_VV_VV_SW 100.0 FORMULA_0008 0.0 28.0000 FORMAT "%4.1" /end CHARACTERISTIC
/begin CHARACTERISTIC K_PKS_OBD_FST "Minimaler Fuellstand Tank | EN: Minimum tank fill level [l]" VALUE 0x75626 TKW_VV_VV_UW 100.0 FORMULA_0079 0.0 32767.5000 FORMAT "%4.1" /end CHARACTERISTIC
/begin CHARACTERISTIC K_PKS_OBD_AY "Maximale Querbeschleunigung fuer PKS-Diagnose | EN: Maximum lateral acceleration for fuel-pressure diagnosis [m/(s*s)]" VALUE 0x75628 TKW_VV_VV_SW 100.0 FORMULA_0132 -20.0000 20.0000 FORMAT "%5.2" /end CHARACTERISTIC
/begin CHARACTERISTIC K_PKS_OBD_PUMPE_VL "Vorlaufzeit Kraftstoffpumpe bis Diagnose | EN: Fuel-pump lead time before diagnosis [s]" VALUE 0x7562A TKW_VV_VV_UW 100.0 FORMULA_1033 0.0 6553.5000 FORMAT "%5.2" /end CHARACTERISTIC
/begin CHARACTERISTIC K_PKS_OBD_VERZ "Vorzoegerung Kraftstoffpumpen-Diagnose nach Dynamik | EN: Fuel-pump diagnosis delay after dynamics [s]" VALUE 0x7562C TKW_VV_VV_UW 100.0 FORMULA_1033 0.0 6553.5000 FORMAT "%5.2" /end CHARACTERISTIC
/begin CHARACTERISTIC K_PKS_OBD_VERZ_Q_MAX "Vorzoegerung Kraftstoffpumpen-Diagnose bei QMAX | EN: Fuel-pump diagnosis delay at maximum flow [s]" VALUE 0x7562E TKW_VV_VV_UW 100.0 FORMULA_1033 0.0 6553.5000 FORMAT "%5.2" /end CHARACTERISTIC
/begin CHARACTERISTIC K_PKS_OBD_SOLL_DYN_MAX "Maximale Dynamik Kraftstoffpumpen-Solldruck | EN: Maximum dynamics of fuel-pump target pressure [bar]" VALUE 0x75630 TKW_VV_VV_SW 100.0 FORMULA_0118 0.0 10.0000 FORMAT "%6.3" /end CHARACTERISTIC
/begin CHARACTERISTIC K_PKS_OBD_TMOT_MIN "Untergrenze Motortemperatur fuer Diagnose | EN: Lower engine-temperature limit for diagnosis [°C]" VALUE 0x75632 TKW_VV_VV_SW 100.0 FORMULA_0023 -50.0000 170.0000 FORMAT "%4.1" /end CHARACTERISTIC
/begin CHARACTERISTIC K_PKS_OBD_LL_MAX "Kraftstoffdruck Abweichung LL Maximum | EN: Fuel pressure deviation at idle, maximum [%]" VALUE 0x75634 TKW_VV_VV_SW 100.0 FORMULA_0541 -1000.0000 1000.0000 /end CHARACTERISTIC
/begin CHARACTERISTIC K_PKS_OBD_LL_MIN "Kraftstoffdruck Abweichung LL Minimum | EN: Fuel pressure deviation at idle, minimum [%]" VALUE 0x75636 TKW_VV_VV_SW 100.0 FORMULA_0541 -1000.0000 1000.0000 /end CHARACTERISTIC
/begin CHARACTERISTIC K_PKS_OBD_TL_MAX "Kraftstoffdruck Abweichung TL Maximum | EN: Fuel pressure deviation at part load, maximum [%]" VALUE 0x75638 TKW_VV_VV_SW 100.0 FORMULA_0541 -1000.0000 1000.0000 /end CHARACTERISTIC
/begin CHARACTERISTIC K_PKS_OBD_TL_MIN "Kraftstoffdruck Abweichung TL Minimum | EN: Fuel pressure deviation at part load, minimum [%]" VALUE 0x7563A TKW_VV_VV_SW 100.0 FORMULA_0541 -1000.0000 1000.0000 /end CHARACTERISTIC
/begin CHARACTERISTIC K_PKS_OBD_Q_MAX "Kraftstoffdruck Abweichung Q Maximum | EN: Fuel pressure deviation at flow Q, maximum [%]" VALUE 0x7563C TKW_VV_VV_SW 100.0 FORMULA_0541 -1000.0000 1000.0000 /end CHARACTERISTIC
/begin CHARACTERISTIC K_PKS_OBD_Q_MIN "Kraftstoffdruck Abweichung Q Minimum | EN: Fuel pressure deviation at flow Q, minimum [%]" VALUE 0x7563E TKW_VV_VV_SW 100.0 FORMULA_0541 -1000.0000 1000.0000 /end CHARACTERISTIC
/begin CHARACTERISTIC K_PKS_OBD_Q_EKP_MAX "Volumenstrom EKP Maximum | EN: Fuel-pump volume flow, maximum [l/h]" VALUE 0x75640 TKW_VV_VV_SW 100.0 FORMULA_0746 0.0 250.0000 FORMAT "%4.1" /end CHARACTERISTIC
/begin CHARACTERISTIC K_PKS_OBD_Q_EKP_MIN "Volumenstrom EKP Minimum | EN: Fuel-pump volume flow, minimum [l/h]" VALUE 0x75642 TKW_VV_VV_SW 100.0 FORMULA_0746 0.0 250.0000 FORMAT "%4.1" /end CHARACTERISTIC
/begin CHARACTERISTIC K_PKS_STEIGUNG "Steigung Kraftstoffdrucksensor | EN: Fuel-pressure sensor slope [bar/V]" VALUE 0x75644 TKW_VV_VV_SW 100.0 FORMULA_1038 0.0 5.0000 FORMAT "%6.3" /end CHARACTERISTIC
/begin CHARACTERISTIC K_PKS_OFFSET "Offset Kraftstoffdrucksensor | EN: Offset Kraftstoffdrucksensor" VALUE 0x75646 TKW_VV_VV_SW 100.0 FORMULA_0118 -10.0000 10.0000 FORMAT "%6.3" /end CHARACTERISTIC
/begin CHARACTERISTIC K_PKS_TAU "Filterkonstante f. Kraftstoffdruck | EN: Filterkonstante f. Kraftstof f-druck" VALUE 0x75648 TKW_VV_VV_UB 100.0 FORMULA_0651 0.0051 1.2800 /end CHARACTERISTIC
/begin CHARACTERISTIC K_PKS_TAU_EKP100 "Filterkonstante f. Kraftstoffdruck bei 100% | EN: Filterkonstante f. Kraftstof f-druck bei 100%" VALUE 0x75649 TKW_VV_VV_UB 100.0 FORMULA_0651 0.0051 1.2800 /end CHARACTERISTIC
/begin CHARACTERISTIC K_PKS_OBD_ABW_TAU "Filterkonstante f. Abweichung Kraftstoffdruck | EN: Filterkonstante f. Abweichung Kraftstoffdruck" VALUE 0x7564A TKW_VV_VV_UB 100.0 FORMULA_0683 0.1004 25.6000 /end CHARACTERISTIC
/begin CHARACTERISTIC K_PKS_OBD_ABW_TAU_QMAX "Filterkonstante bei hohen Volumenstrom | EN: Filterkonstante bei hohen Volumenstrom" VALUE 0x7564B TKW_VV_VV_UB 100.0 FORMULA_0683 0.1004 25.6000 /end CHARACTERISTIC
/begin CHARACTERISTIC K_PKS_DIAG_MIN "untere Grenze Kraftstoffdruck | EN: untere Grenze Kraftstoffdruck" VALUE 0x7564C TKW_VV_VV_SW 100.0 FORMULA_0118 0.0 10.0000 FORMAT "%6.3" /end CHARACTERISTIC
/begin CHARACTERISTIC K_PKS_DIAG_MAX "obere Grenze Kraftstoffdruck | EN: obere Grenze Kraftstoffdruck" VALUE 0x7564E TKW_VV_VV_SW 100.0 FORMULA_0118 0.0 10.0000 FORMAT "%6.3" /end CHARACTERISTIC
/begin CHARACTERISTIC K_PKS_ERSATZ "Ersatzwert Kraftstoffdruck | EN: Ersatzwert Kraftstoffdruck" VALUE 0x75650 TKW_VV_VV_SW 100.0 FORMULA_0118 0.0 10.0000 FORMAT "%6.3" /end CHARACTERISTIC
/begin CHARACTERISTIC K_PKS_OBD_ERSATZ "Ersatzwert Kraftstoffdruck bei OBD-Fehler | EN: Ersatzwert Kraftstoffdruck bei OBD-Fehler" VALUE 0x75652 TKW_VV_VV_SW 100.0 FORMULA_0118 0.0 10.0000 FORMAT "%6.3" /end CHARACTERISTIC
/begin CHARACTERISTIC K_PKS_OBD_TIME_ML_MIN "Sperrzeit Diagnose nach Start | EN: Sperrzeit Diagnose nach Start" VALUE 0x75654 TKW_VV_VV_UW 100.0 FORMULA_0021 0.0 655.0000 FORMAT "%5.2" /end CHARACTERISTIC
/begin CHARACTERISTIC K_PKS_PLAU_SCHWELLE "Fehlerschwelle fuer pks_plau_intg | EN: Fehlerschwelle fuer pks_plau_intg" VALUE 0x75656 TKW_VV_VV_SW 100.0 FORMULA_1034 0.0 10.0000 FORMAT "%6.3" /end CHARACTERISTIC
/begin CHARACTERISTIC K_PKS_PLAU_INTG_MAX "Minbegrenzung fuer pks_plau_intg | EN: Minbegrenzung fuer pks_plau_intg" VALUE 0x75658 TKW_VV_VV_UW 100.0 FORMULA_1034 0.0 65.5350 FORMAT "%6.3" /end CHARACTERISTIC
/begin CHARACTERISTIC K_PKS_PLAU_INTG_MIN "Minbegrenzung fuer pks_plau_intg | EN: Minbegrenzung fuer pks_plau_intg" VALUE 0x7565A TKW_VV_VV_UW 100.0 FORMULA_1034 0.0 65.5350 FORMAT "%6.3" /end CHARACTERISTIC
/begin CHARACTERISTIC K_PKS_DIAG_AUFBAU_MIN "Min-Druck bei Druckaufbau Vorlauf/-Start | EN: Min-Druck bei Druckaufbau Vorlauf/-Start" VALUE 0x7565C TKW_VV_VV_SW 100.0 FORMULA_0118 0.0 10.0000 FORMAT "%6.3" /end CHARACTERISTIC
/begin CHARACTERISTIC K_PKS_DIAG_AUFBAU_TAU "TAU fuer Druckabweichungsintegral | EN: TAU fuer Druckabweichung s-integral" VALUE 0x7565E TKW_VV_VV_UB 100.0 FORMULA_0683 0.1004 25.6000 /end CHARACTERISTIC
/begin CHARACTERISTIC K_PKS_DIAG_FEHLER_SCHW "Fehlerschwelle fuer Druckabweichung | EN: Fehlerschwelle fuer Drucka b-weichung" VALUE 0x75660 TKW_VV_VV_SW 100.0 FORMULA_0118 0.0 10.0000 FORMAT "%6.3" /end CHARACTERISTIC
/begin CHARACTERISTIC K_PKS_PLAU_MAX_I "MAX I-Anteil bis zu der die Plausi durchgefuehrt wird | EN: MAX I -Anteil bis zu der die Plausi durchgefuehrt wird" VALUE 0x75662 TKW_VV_VV_SW 100.0 FORMULA_0840 -3200.0000 3199.9023 FORMAT "%4.1" /end CHARACTERISTIC
/begin CHARACTERISTIC K_PKS_PLAU_MIN_T_REG "Zeit in Regeleung bis die Plausi durchgefuehrt wird | EN: Zeit in Regeleung bis die Plausi durchgefuehrt wird" VALUE 0x75664 TKW_VV_VV_UW 100.0 FORMULA_0021 0.0 655.0000 FORMAT "%5.2" /end CHARACTERISTIC
/begin CHARACTERISTIC K_PKS_DIAG_AUFBAU_DELAY "Verzoegerungszeit fuer Druckaufbaudiagnose | EN: Verzoegerungszeit fuer Druckaufbaudiagnose" VALUE 0x75666 TKW_VV_VV_UW 100.0 FORMULA_0021 0.0 655.0000 FORMAT "%5.2" /end CHARACTERISTIC
/begin CHARACTERISTIC K_PKS_PLAU_QMIN_N "Sperrschwelle bei hoher Drezahl und geringem KVA | EN: Sperrschwelle bei hoher Drezahl und geringem KVA" VALUE 0x75668 TKW_VV_VV_SW 100.0 FORMULA_0006 0.0 10000.0000 /end CHARACTERISTIC
/begin CHARACTERISTIC K_PKS_PLAU_QMIN_KVA "Sperrschwelle bei hoher Drezahl und geringem KVA | EN: Sperrschwelle bei hoher Drezahl und geringem KVA" VALUE 0x7566A TKW_VV_VV_SW 100.0 FORMULA_0746 0.0 500.0000 FORMAT "%4.1" /end CHARACTERISTIC
/begin CHARACTERISTIC KL_PKS_PLAU_INC "Incrementwerte fuer Abweichungsintegral | EN: Increment values for deviation integrator (plausibility)" CURVE 0x7566C TKL_SW_VV_SW 100.0 FORMULA_1039 -10.0000 10.0000
 /begin AXIS_DESCR STD_AXIS delta FORMULA_0118 11 -10.0000 10.0000 FORMAT "%6.3" /end AXIS_DESCR
 FORMAT "%6.3" /end CHARACTERISTIC
/begin CHARACTERISTIC KL_PKS_TAU_MODELL "TAU fuer TV in Rueckwertsinterpol | EN: Time constant for duty cycle in reverse interpolation" CURVE 0x7569A TKL_SW_VV_UW 100.0 FORMULA_1040 0.0100 655.3500
 /begin AXIS_DESCR STD_AXIS kva_q_mot FORMULA_0746 5 0.0 500.0000 FORMAT "%4.1" /end AXIS_DESCR
 FORMAT "%5.2" /end CHARACTERISTIC
/begin MEASUREMENT ekp_obd_vl_t "Vorlaufzeit Kraftstoffpumpe" UWORD FORMULA_1033 0 0 0.0 6553.5000 ECU_ADDRESS 0x3FCC76 /end MEASUREMENT
/begin MEASUREMENT ekp_obd_verz "Verzoegerung Kraftstoffpumpen-Diagnose nach Dynamik" UWORD FORMULA_1033 0 0 0.0 6553.5000 ECU_ADDRESS 0x3FCC78 /end MEASUREMENT
/begin MEASUREMENT pks_obd_abw_filt "gefiltertes Kraftstoffdruck Ist-Soll Verhaeltniss" SWORD FORMULA_0541 0 0 -1000.0000 1000.0000 ECU_ADDRESS 0x3FCC7A /end MEASUREMENT
/begin MEASUREMENT pks_ad "eingelesener Spannungswert des Kraftstoffdrucksignals" SWORD FORMULA_0123 0 0 0.0 1023.0000 ECU_ADDRESS 0x3FCC7C /end MEASUREMENT
/begin MEASUREMENT pks_ist_roh "Kraftstoffdruck, absolut, ungefiltert" SWORD FORMULA_0118 0 0 0.0 10.0000 ECU_ADDRESS 0x3FCC7E /end MEASUREMENT
/begin MEASUREMENT pks_rel_mdl "Kraftstoffdruck aus Modell" SWORD FORMULA_0118 0 0 0.0 10.0000 ECU_ADDRESS 0x3FCC80 /end MEASUREMENT
/begin MEASUREMENT pks_plau_delta "Delta zwischen Modell und pks_rel" SWORD FORMULA_0118 0 0 0.0 10.0000 ECU_ADDRESS 0x3FCC82 /end MEASUREMENT
/begin MEASUREMENT pks_plau_intg "Integrationswert Abweichung Modell zu pks_rel" UWORD FORMULA_1034 0 0 0.0 10.0000 ECU_ADDRESS 0x3FCC84 /end MEASUREMENT
/begin MEASUREMENT pks_aufbau_fehler "Differentzdruck zu PK_PKS_TV100_MIN" SWORD FORMULA_0118 0 0 0.0 10.0000 ECU_ADDRESS 0x3FCC86 /end MEASUREMENT
/begin MEASUREMENT pks_tv_mdl_norm "TV fuer PKS-Modell normiert" SWORD FORMULA_0840 0 0 -100.0000 100.0000 ECU_ADDRESS 0x3FCC88 /end MEASUREMENT
/begin MEASUREMENT pks_st "Status pks" UBYTE FORMULA_1035 0 0 0.0 255.0 ECU_ADDRESS 0x3FCC8A /end MEASUREMENT
/begin MEASUREMENT pks_obd_zust "Zustandautomat pks_obd" UBYTE FORMULA_1036 0 0 0.0 255.0 ECU_ADDRESS 0x3FCC8B /end MEASUREMENT
/* ------------------ Abschnitt erzeugt aus psau.dat ------------------ */
/begin CHARACTERISTIC K_PSAU_STEIGUNG "Steigung des Drucksensors | EN: Steigung des Drucksensors" VALUE 0x75F32 TKW_VV_VV_UW 100.0 FORMULA_1054 0.0 819.0000 FORMAT "%4.1" /end CHARACTERISTIC
/begin CHARACTERISTIC K_PSAU_OFFSET "Offset des Drucksensors | EN: Offset des Drucksensors" VALUE 0x75F34 TKW_VV_VV_SW 100.0 FORMULA_0077 -1000.0000 2000.0000 FORMAT "%4.1" /end CHARACTERISTIC
/begin CHARACTERISTIC K_PSAU_DIAG_MAX "MAX PSAU fuer Diagnose  | EN: MAX PSAU fuer Diagnose" VALUE 0x75F36 TKW_VV_VV_SW 100.0 FORMULA_0077 0.0 1200.0000 FORMAT "%4.1" /end CHARACTERISTIC
/begin CHARACTERISTIC K_PSAU_DIAG_MIN "MIN Saugrohrdruch fuer Diagnose  | EN: MIN Saugrohrdruch fuer Dia g-nose" VALUE 0x75F38 TKW_VV_VV_SW 100.0 FORMULA_0077 -625.0000 2000.0000 FORMAT "%4.1" /end CHARACTERISTIC
/begin CHARACTERISTIC K_PSAU_ADAPT_MAX "Maximaler Adaptionswert fuer PSAUx | EN: Maximaler Adaptionswert fuer PSAUx" VALUE 0x75F3A TKW_VV_VV_SW 100.0 FORMULA_0077 0.0 200.0000 FORMAT "%4.1" /end CHARACTERISTIC
/begin CHARACTERISTIC K_PSAU_ADAPT_MIN "Minimaler Adaptionswert fuer PSAUx | EN: Minimaler Adaptionswert fuer PSAUx" VALUE 0x75F3C TKW_VV_VV_SW 100.0 FORMULA_0077 -200.0000 0.0 FORMAT "%4.1" /end CHARACTERISTIC
/begin CHARACTERISTIC K_PSAU_TAU "Filterkonstante PSAU nur im Zeitraster, nicht im Segment | EN: Filterkonstante PSAU nur im Zeitraster, nicht im Segment" VALUE 0x75F3E TKW_VV_VV_UB 100.0 FORMULA_0664 0.0101 2.5600 /end CHARACTERISTIC
/begin CHARACTERISTIC K_PSAU_SENSOR_CFG "Psau Ersatzwertaktivierung | EN: 0x0 absolut 0x1 differenz ELSE ungueltig Psau Ersatzwertaktivierung" VALUE 0x75F3F TKW_VV_VV_UB 100.0 FORMULA_1055 0.0 255.0 /end CHARACTERISTIC
/begin CHARACTERISTIC KL_PSAU_ERSATZ_RGX_DELTA_KORR "Korrektur PSAU Ersatzwert" CURVE 0x75F40 TKL_SW_VV_UW 100.0 FORMULA_0075 0.0 4.0000
 /begin AXIS_DESCR STD_AXIS rg_x_stat FORMULA_0109 6 -0.5000 0.5000 FORMAT "%5.2" /end AXIS_DESCR
 FORMAT "%6.3" /end CHARACTERISTIC
/begin CHARACTERISTIC KF_PSAU_ERSATZ_DR_REL_F "Lambdapulshub in Richtung FETT" MAP 0x75F5A TKF_SW_SW_UW 100.0 FORMULA_0075 0.0 4.0000 /begin AXIS_DESCR STD_AXIS n FORMULA_0006 12 0.0 10000.0000 /end AXIS_DESCR /begin AXIS_DESCR STD_AXIS dr_rel FORMULA_0115 8 0.0 199.9938 FORMAT "%5.2" /end AXIS_DESCR FORMAT "%6.3" /end CHARACTERISTIC
/begin MEASUREMENT psau_b1.ad "Eingelesener Spannungswert fuer Saugrohrdruck" SWORD FORMULA_0123 0 0 0.0 1023.0000 ECU_ADDRESS 0x3FCDF6 /end MEASUREMENT
/begin MEASUREMENT psau_b2.ad "Eingelesener Spannungswert fuer Saugrohrdruck" SWORD FORMULA_0123 0 0 0.0 1023.0000 ECU_ADDRESS 0x3FCE08 /end MEASUREMENT
/begin MEASUREMENT psau_b1.phy "Physikalischer Wert ohne Diagnose und ohne Filter fuer Saugrohrdruck" SWORD FORMULA_0077 0 0 0.0 2000.0000 ECU_ADDRESS 0x3FCDF8 /end MEASUREMENT
/begin MEASUREMENT psau_b2.phy "Physikalischer Wert ohne Diagnose und ohne Filter fuer Saugrohrdruck" SWORD FORMULA_0077 0 0 0.0 2000.0000 ECU_ADDRESS 0x3FCE0A /end MEASUREMENT
/begin MEASUREMENT psau_b1.roh "Physikalischer Wert mit Diagnose jedoch ohne Filter fuer Saugrohrdruck" SWORD FORMULA_0077 0 0 0.0 2000.0000 ECU_ADDRESS 0x3FCDFA /end MEASUREMENT
/begin MEASUREMENT psau_b2.roh "Physikalischer Wert mit Diagnose jedoch ohne Filter fuer Saugrohrdruck" SWORD FORMULA_0077 0 0 0.0 2000.0000 ECU_ADDRESS 0x3FCE0C /end MEASUREMENT
/begin MEASUREMENT psau_b1.adapt "Adaptionswert zum PUMG, (pumg-psau)" SWORD FORMULA_0077 0 0 -200.0000 200.0000 ECU_ADDRESS 0x3FCDFC /end MEASUREMENT
/begin MEASUREMENT psau_b2.adapt "Adaptionswert zum PUMG, (pumg-psau)" SWORD FORMULA_0077 0 0 -200.0000 200.0000 ECU_ADDRESS 0x3FCE0E /end MEASUREMENT
/begin MEASUREMENT psau_b1.asp "Mittelwert ueber Arbeitsspiel" SWORD FORMULA_0077 0 0 0.0 2000.0000 ECU_ADDRESS 0x3FCDFE /end MEASUREMENT
/begin MEASUREMENT psau_b2.asp "Mittelwert ueber Arbeitsspiel" SWORD FORMULA_0077 0 0 0.0 2000.0000 ECU_ADDRESS 0x3FCE10 /end MEASUREMENT
/begin MEASUREMENT psau_b1.mzyl "Mittelwert Ges.Fuellungsermittelung" SWORD FORMULA_0077 0 0 0.0 2000.0000 ECU_ADDRESS 0x3FCE00 /end MEASUREMENT
/begin MEASUREMENT psau_b2.mzyl "Mittelwert Ges.Fuellungsermittelung" SWORD FORMULA_0077 0 0 0.0 2000.0000 ECU_ADDRESS 0x3FCE12 /end MEASUREMENT
/begin MEASUREMENT psau_b1.wf "Mittelwert Wandfilmmodellberechnung" SWORD FORMULA_0077 0 0 0.0 2000.0000 ECU_ADDRESS 0x3FCE02 /end MEASUREMENT
/begin MEASUREMENT psau_b2.wf "Mittelwert Wandfilmmodellberechnung" SWORD FORMULA_0077 0 0 0.0 2000.0000 ECU_ADDRESS 0x3FCE14 /end MEASUREMENT
/begin MEASUREMENT psau_b1.ersatz "Ersatzwert" SWORD FORMULA_0077 0 0 0.0 2000.0000 ECU_ADDRESS 0x3FCE04 /end MEASUREMENT
/begin MEASUREMENT psau_b2.ersatz "Ersatzwert" SWORD FORMULA_0077 0 0 0.0 2000.0000 ECU_ADDRESS 0x3FCE16 /end MEASUREMENT
/begin FUNCTION PKS ""
 /begin DEF_CHARACTERISTIC KL_PKS_PLAU_INC KL_PKS_TAU_MODELL K_PKS_DIAG_AUFBAU_DELAY K_PKS_DIAG_AUFBAU_MIN K_PKS_DIAG_AUFBAU_TAU K_PKS_DIAG_FEHLER_SCHW K_PKS_DIAG_MAX K_PKS_DIAG_MIN K_PKS_ERSATZ K_PKS_OBD_ABW_TAU K_PKS_OBD_ABW_TAU_QMAX K_PKS_OBD_AY K_PKS_OBD_CFG K_PKS_OBD_ERSATZ K_PKS_OBD_FST K_PKS_OBD_LL_MAX K_PKS_OBD_LL_MIN K_PKS_OBD_PUMG_MIN K_PKS_OBD_PUMPE_VL K_PKS_OBD_Q_EKP_MAX K_PKS_OBD_Q_EKP_MIN K_PKS_OBD_Q_MAX K_PKS_OBD_Q_MIN K_PKS_OBD_SOLL_DYN_MAX K_PKS_OBD_TIME_ML_MIN K_PKS_OBD_TL_MAX K_PKS_OBD_TL_MIN K_PKS_OBD_TMOT_MIN K_PKS_OBD_UB_MIN K_PKS_OBD_VERZ K_PKS_OBD_VERZ_Q_MAX K_PKS_OFFSET K_PKS_PLAU_INTG_MAX K_PKS_PLAU_INTG_MIN K_PKS_PLAU_MAX_I K_PKS_PLAU_MIN_T_REG K_PKS_PLAU_QMIN_KVA K_PKS_PLAU_QMIN_N K_PKS_PLAU_SCHWELLE K_PKS_STEIGUNG K_PKS_TAU K_PKS_TAU_EKP100 /end DEF_CHARACTERISTIC
 /begin REF_CHARACTERISTIC /end REF_CHARACTERISTIC
 /begin IN_MEASUREMENT /end IN_MEASUREMENT
 /begin OUT_MEASUREMENT ekp_obd_verz ekp_obd_vl_t pks_ad pks_aufbau_fehler pks_ist_roh pks_obd_abw_filt pks_obd_zust pks_plau_delta pks_plau_intg pks_rel_mdl pks_st pks_tv_mdl_norm /end OUT_MEASUREMENT
/end FUNCTION
/begin FUNCTION PSAU ""
 /begin DEF_CHARACTERISTIC KF_PSAU_ERSATZ_DR_REL_F KL_PSAU_ERSATZ_RGX_DELTA_KORR K_PSAU_ADAPT_MAX K_PSAU_ADAPT_MIN K_PSAU_DIAG_MAX K_PSAU_DIAG_MIN K_PSAU_OFFSET K_PSAU_SENSOR_CFG K_PSAU_STEIGUNG K_PSAU_TAU /end DEF_CHARACTERISTIC
 /begin REF_CHARACTERISTIC /end REF_CHARACTERISTIC
 /begin IN_MEASUREMENT /end IN_MEASUREMENT
 /begin OUT_MEASUREMENT psau_b1.ad psau_b1.adapt psau_b1.asp psau_b1.ersatz psau_b1.mzyl psau_b1.phy psau_b1.roh psau_b1.wf psau_b2.ad psau_b2.adapt psau_b2.asp psau_b2.ersatz psau_b2.mzyl psau_b2.phy psau_b2.roh psau_b2.wf /end OUT_MEASUREMENT
/end FUNCTION
/begin FUNCTION PTCAN-Interface ""
 /begin DEF_CHARACTERISTIC K_CAN_ALIVE_ERR_MAX K_CAN_CFG K_CAN_CFG_ANZGRB K_CAN_CFG_OBDFST K_CAN_CHKSUM_ERR_MAX K_CAN_CLAS_BAT_INIT K_CAN_CRASH_CTR_TOUT K_CAN_ED_TSPERR K_CAN_ED_UB_MIN K_CAN_I_SC_MAX_INIT K_CAN_I_SC_MIN_INIT K_CAN_KEY_NO_MCS K_CAN_QC_VEH_INIT K_CAN_TUMG_MCS /end DEF_CHARACTERISTIC
 /begin REF_CHARACTERISTIC /end REF_CHARACTERISTIC
 /begin IN_MEASUREMENT /end IN_MEASUREMENT
 /begin OUT_MEASUREMENT can_alive_BedFgr_cnt can_alive_TorqReqDSC_cnt can_alive_bedat_cnt can_alive_klst_cnt can_alive_stkombi_cnt can_alive_vehmod_cnt can_alive_vfzg_cnt can_bedat_s can_bedat_timeout can_bedfgr_timeout can_chksum_BedFgr_cnt can_chksum_TorqReqDSC_cnt can_chksum_bedat_cnt can_chksum_klst_cnt can_chksum_vehmod_cnt can_chksum_vfzg_cnt can_clas_bat can_crash_ctr can_crash_timeout can_ctr_ilicht can_ed_tsperr can_ed_tsperr_kl15 can_ev_repeat_1of5_ can_ev_repeat_2of5_ can_ev_repeat_3of5_ can_ev_repeat_4of5_ can_ev_repeat_5of5_ can_ev_timer_1of5_ can_ev_timer_2of5_ can_ev_timer_3of5_ can_ev_timer_4of5_ can_ev_timer_5of5_ can_fgr_idx can_fgr_v_idx_1_1of5_ can_fgr_v_idx_1_2of5_ can_fgr_v_idx_1_3of5_ can_fgr_v_idx_1_4of5_ can_fgr_v_idx_1_5of5_ can_fgr_v_idx_2_1of5_ can_fgr_v_idx_2_2of5_ can_fgr_v_idx_2_3of5_ can_fgr_v_idx_2_4of5_ can_fgr_v_idx_2_5of5_ can_fgr_v_idx_3_1of5_ can_fgr_v_idx_3_2of5_ can_fgr_v_idx_3_3of5_ can_fgr_v_idx_3_4of5_ can_fgr_v_idx_3_5of5_ can_fst_li can_fst_re can_fst_reserve can_i_qc_veh can_i_sc_max can_i_sc_min can_kkos_elu can_kkos_timeout can_klst_15off can_klst_s_roh can_klst_timeout can_kmst_timeout can_no_key_update can_obd_ed_timeout can_reichweite can_st_bedat can_st_crash can_st_kmst can_st_lrw can_st_obd_ed can_st_statanh can_st_statr can_st_toma can_stat_veh_mod_1of3_ can_stat_veh_mod_2of3_ can_stat_veh_mod_3of3_ can_statanh_timeout can_statr_timeout can_toma_hl can_toma_hr can_toma_timeout can_toma_vl can_toma_vr can_tuer_st can_v_rad_hl can_v_rad_hr can_v_rad_vl can_v_rad_vr can_v_tacho can_v_vorne can_vehmod_timeout can_verz_st /end OUT_MEASUREMENT
/end FUNCTION
/begin FUNCTION Powermanagement ""
 /begin DEF_CHARACTERISTIC CBATT_DEF CW_BATTCOD CW_CCMASK CW_PMDEFMASK CW_PMMASKDFP KF_DFIGEN1 KF_DFIGEN2 KF_DFIGEN3 KF_DFIGEN4 KF_ELUPWM39 KF_ELUPWM60 KF_IBTSOLL KF_PMRIBAT1 KF_PMRIBAT2 KF_PMRIBAT3 KF_PMRIBAT4 KF_PMRIBAT5 KF_PMRIBAT6 KF_PMRIBAT7 KF_PMRIBAT8 KF_SOC0UBIB KF_SOCLF KF_USOLL KL_BATTLSTR KL_CLASS2IND KL_CLASS2NENN KL_DFPRIO KL_DFPTC KL_DSOCPRIO KL_DSOCPTC KL_DUDTPTC KL_ELSLS KL_ELTEMP39 KL_ELTEMP60 KL_ELUB39 KL_ELUB60 KL_EXPALH KL_EXPALV KL_EXPBETAV KL_FITGRZ KL_I2PTC KL_IABGLMOT KL_IABGLNL KL_IABGLST KL_IREST KL_ISOLLPR KL_ITNSTART KL_LADEKENNL KL_PMSOCVU KL_PRIO2PTC KL_PRIOCF KL_PRIODF KL_PTC KL_PWRCF KL_PWRDF KL_SOC0TEMP KL_SOCPRIO KL_SSOC KL_T2RELMAX KL_T2RELMXRG KL_T3RELMAX KL_T3RELMXRG KL_T4RELMAX KL_T4RELMXRG KL_UBTPRIO KL_UB_PTC KL_UNSTART KL_USOLL KL_UTSTART KL_WUBPTC K_ABKORROVER K_ABSCHKORA K_APPTBATINI K_BATTHTAUVG K_BATTHTAUVK K_BATTINDAPP K_BATTORT0 K_BATTORT2 K_BATTREGAPP K_BATTVTAUVG K_BATTVTAUVK K_BATT_ALFAH K_BATT_ALFAV K_BATT_BETAV K_BATVFZGTAU K_BILA_OGRZ K_BILA_UGRZ K_CBATTAPP K_CCPRIOSET K_CCPRIOTIME K_CCPWRSET K_CRENGOF K_CRVVTNOT K_CRVVTOF K_CTRCBRA K_CTRCBRAPP K_CTRCBRKBM K_CTRPCOSAPP K_CTRPRIOAPP K_CTRPRIOCF_1of7_ K_CTRPRIOCF_2of7_ K_CTRPRIOCF_3of7_ K_CTRPRIOCF_4of7_ K_CTRPRIOCF_5of7_ K_CTRPRIOCF_6of7_ K_CTRPRIOCF_7of7_ K_CTRPWRCF_1of7_ K_CTRPWRCF_2of7_ K_CTRPWRCF_3of7_ K_CTRPWRCF_4of7_ K_CTRPWRCF_5of7_ K_CTRPWRCF_6of7_ K_CTRPWRCF_7of7_ K_CTRPWRDF_10of14_ K_CTRPWRDF_11of14_ K_CTRPWRDF_12of14_ K_CTRPWRDF_13of14_ K_CTRPWRDF_14of14_ K_CTRPWRDF_1of14_ K_CTRPWRDF_2of14_ K_CTRPWRDF_3of14_ K_CTRPWRDF_4of14_ K_CTRPWRDF_5of14_ K_CTRPWRDF_6of14_ K_CTRPWRDF_7of14_ K_CTRPWRDF_8of14_ K_CTRPWRDF_9of14_ K_DAB_KORR1 K_DAB_KORR2 K_DAB_KORR3 K_DFFILTAPP K_DFKOMMERR K_DFLLMIN K_DFMAX K_DFOVERRIDE K_DFPTC_LP K_DFRUTYP K_DF_LP K_DSOCA K_DSOCABSCH K_DSOCHYST K_DSOCHYSTCC K_DSOCLLANH K_DSOCLOW K_DSOCPCOS K_DTANSKOR K_DUDTPTCAUS K_HISTDMERST K_HISTIBSRST K_IABGLMOT K_IABGLNL K_IABGLST K_IBSWAKEAPP K_IB_COMMVAL K_IGENLLRANH K_IGRDETEC K_IKEINESA K_ILMINUMG K_IPMPMDEC K_IPMPMINC K_IWAKEAPP K_I_FITAUSW K_KBMCNT_APP K_KSOGRZAPP K_KSUGRZAPP K_LBATTMAXK K_LBATTMAXM K_LBATTMIN K_LBATTTUMG K_LBATTTUMGBA K_LLANHAPP K_LLPMAPP K_LLPMFILTK K_LLRABS_DF K_LLRANH_DF K_MCOBATTORT K_MN_PTCPI K_MN_PWRDFPI K_MSKIBSDFP K_MSKIBSDFP2 K_MSKIBSDIAG K_MSKIBSERR K_MSKIBSERR2 K_MX_PTCPI K_NKW2HIPTC K_NKW2LOWPTC K_NLLMIN K_NMINUMG K_NTWBGLLGEN K_OFTUMGCAN K_OFULADE K_OSPGAPP K_OSPGHYST K_OSPGPRELLZ K_OSPRELLDEC K_OSPRELLINC K_PLBATTUMG K_PMQ_UX K_PMTIMERSQ1 K_PMUBAT_MAX K_PMUBAT_MIN K_PMUGEN_MAX K_PMUGEN_MIN K_PM_IPMON K_PM_TABSMN K_PRELLDFAH K_PRELLDFRF K_PRIO15 K_PRIOCF15 K_PRIOCFAPP K_PRIOCF_R K_PRIODF_1of7_ K_PRIODF_2of7_ K_PRIODF_3of7_ K_PRIODF_4of7_ K_PRIODF_5of7_ K_PRIODF_6of7_ K_PRIODF_7of7_ K_PRIO_R K_PTCPWRAPP K_PTC_PI K_PWRCOS15 K_PWRCOSAPP K_PWRCOSHT K_PWRCOSULEV K_PWRCOS_R K_PWRCSGNDEF K_PWRCSKOMM K_PWRDF_PI K_QSOCCL1 K_QSOCCL2 K_QSOCCL3 K_QSTARTFGA K_Q_BILAPWF K_RESET_PI K_RIN_GRENZ1 K_RIN_GRENZ2 K_RIN_GRENZ3 K_RIN_GRENZ4 K_RIN_GRENZ5 K_RIN_GRENZ6 K_RIN_GRENZ7 K_RIN_GRENZ8 K_RLEITUNGK K_RLEITUNGM K_RQPCOSA K_RQPCOSAPP K_RQULCP K_RUHVERMODE K_SELSPCOSA K_SELSPCSAPP K_SOCFITAPP K_SOCFITGRZ K_SOCFITLIMH K_SOCFITLIML K_SOC_BILAWA K_SOC_QPWF K_SOC_QUALIA K_SOC_STAFGA K_STPCOSAPP K_T1PMINFO K_T2PMINFO K_T3PMINFO K_TBATINIMAN K_TBATNACHL K_TBATTFTAUV K_TBATTTAUFH K_TCODIERPM K_TD_BNMOT K_TD_PMUGEN K_TD_PWRDFPI K_TIMERDLY K_TIME_START K_TRINGSHIFT K_TSAISONFIL K_TSAISPWF K_TUMGINI K_TUMGTAU K_T_CCRUHVER K_T_IPMPRIO K_T_KMSHIFT K_T_NKPTCAUS K_T_OSPGRSET K_T_OSPGSET K_T_PMBS K_T_PMVS K_T_PTCKWAN K_T_PTCPI K_T_RUHAUSW K_T_SQSHIFT K_T_SULEVON K_T_USPGRSET K_T_USPGSET K_UBATTNORM K_UBAT_LP K_UBPTC_LP K_UBTAPP K_UBTLOWMAX K_UBTLOWMIN K_UB_GRENZ K_UGENNORM K_UIBSAPP K_UKOMPK K_UKOMPM K_ULADE_TAU K_ULEVA K_ULEVAPP K_ULOWSETAPP K_USPGAPP K_USPGHYST K_USPGPRELLZ K_USPRELLDEC K_USPRELLINC K_USTARTGRZ K_USTEPMIN K_VMINUMG S_ABSCHK S_BSDKOORD S_BSOCCALC S_DFKOMMERR S_DSOCS S_IPMPTC S_LBATT1 S_LBATT2 S_LBATTAPPL S_NKWITNSTRT S_N_IDLIBS S_PMMESS S_PMSOCFIT S_PMSTARTQ S_PMSV_HEIZ S_PMSV_KLIMA S_PMSV_LUFT S_PMTABSMN S_PM_TEST1 S_PRIOCFENA S_PRIOMANUAL S_PTCKOOR S_PTCMANUAL S_PWRCFENA S_QSTARTFK S_RIN S_SOCSTAFK S_SOC_BILA S_SOC_QUAL S_STARTAW S_UIBS ZK_PMSOC /end DEF_CHARACTERISTIC
 /begin REF_CHARACTERISTIC /end REF_CHARACTERISTIC
 /begin IN_MEASUREMENT /end IN_MEASUREMENT
 /begin OUT_MEASUREMENT Absch_korr All2ptc Allptcfilt Batt_index Batt_ort Batt_tfil C_battnenn Cbatt_lo Codiercnt Ctrcbr Ctrcbr7 Ctrcbrmem Ctrpcos Ctrpcos7 Ctrpcosmem Ctrprio Ctrprio7 Ctrpriocf Ctrpriocf7 Ctrpriocfm Ctrpriomem Ctrpwrcf Ctrpwrcos Ctrpwrcos7 Ctrpwrdf Ctrpwrmem Ctrpwspcos D_qelad D_qlad D_soc D_socw D_udtptc Df2pi Dfall2pi Dfallpi Dff_filt7 Dfgenfilt Dfpi2ptc Dfprio Dfpt1_2ptc Dfpt1filt Dfpt1ptc Dqelad7 Dqlad7 Dsoc2pi Dsoc2ptc Dudtmul F_dudtptc Fak_ttansel Fak_tubel Fs_pm Gen_dfvorhs I_craweng I_elu_vvt I_eluefter I_elupwm I_eluvfzg I_genrllrah I_gle I_sls Ib_commcnt Ib_commsta Ibs1_errstat Ibs2_errstat Ibs3_errstat Ibsbor_hb Ibsderrs1 Ibsderrs2 Ibspreco2 Ibtdiff Ibtdiff2pi Ibtsoll Ideltaabs Idiff2ptc Igenrest Ikurz_ogrz Ikurz_ugrz Ipmdfprio Isoc0loc Isolldiff Iwakeupgrz Kalevcnt Memprio1 Memprio2 Memptc1 Memptc2 N_gsllm N_idlgspec N_idlibs Nnmstart Ospgcnt Ospgprell Ospgstat Pgen2ptc Pgenrest Picntr Pm_klemmstat Pm_tsrdy Pmbscount Pminfo1_10of37_ Pminfo1_11of37_ Pminfo1_12of37_ Pminfo1_13of37_ Pminfo1_14of37_ Pminfo1_15of37_ Pminfo1_16of37_ Pminfo1_17of37_ Pminfo1_18of37_ Pminfo1_19of37_ Pminfo1_1of37_ Pminfo1_20of37_ Pminfo1_21of37_ Pminfo1_22of37_ Pminfo1_23of37_ Pminfo1_24of37_ Pminfo1_25of37_ Pminfo1_26of37_ Pminfo1_27of37_ Pminfo1_28of37_ Pminfo1_29of37_ Pminfo1_2of37_ Pminfo1_30of37_ Pminfo1_31of37_ Pminfo1_32of37_ Pminfo1_33of37_ Pminfo1_34of37_ Pminfo1_35of37_ Pminfo1_36of37_ Pminfo1_37of37_ Pminfo1_3of37_ Pminfo1_4of37_ Pminfo1_5of37_ Pminfo1_6of37_ Pminfo1_7of37_ Pminfo1_8of37_ Pminfo1_9of37_ Pminfo2_10of29_ Pminfo2_11of29_ Pminfo2_12of29_ Pminfo2_13of29_ Pminfo2_14of29_ Pminfo2_15of29_ Pminfo2_16of29_ Pminfo2_17of29_ Pminfo2_18of29_ Pminfo2_19of29_ Pminfo2_1of29_ Pminfo2_20of29_ Pminfo2_21of29_ Pminfo2_22of29_ Pminfo2_23of29_ Pminfo2_24of29_ Pminfo2_25of29_ Pminfo2_26of29_ Pminfo2_27of29_ Pminfo2_28of29_ Pminfo2_29of29_ Pminfo2_2of29_ Pminfo2_3of29_ Pminfo2_4of29_ Pminfo2_5of29_ Pminfo2_6of29_ Pminfo2_7of29_ Pminfo2_8of29_ Pminfo2_9of29_ Pmstartsta Pmvscount Priopizw1 Priopizw2 Ptc_pwr Ptc_pwr7 Ptcadd Ptcpizw1 Ptcpizw2 Pwrspmem Q_bila Q_startfgk Qeladold Qeladold7 Qladold Qladold7 Qladzwsp7 Rin_grenzh Rin_start Rqpcos Rqpcos7 Rqpcosmem Selspcos Selspcosme Soc_b_loc Soc_bila Soc_fit Soc_fit_temp Soc_korr Soc_q_kor Soc_q_loc Soc_quali Soc_rel Soc_stfgk Soc_stfgkw St_bgllgen0 St_bgllgen0.B_hysllrah St_dibs0 St_dibs0.B_dibloc1 St_dibs0.B_dibloc2 St_dibs1 St_dibs1.B_ifbsak St_dibs1.B_ifebsak St_dibs1.B_ifuplak St_dibs2 St_dibs2.B_ifisak St_dibs2.B_ifsysak St_dibs2.B_iftempak St_dibs2.B_ifusak St_dibs2.B_ifwugdak St_dibs2.B_ifwuplak St_lbattcal0 St_lbattcal0.B_dly_tbi St_lbattcal0.B_lbatteinih St_lbattcal0.B_lbatteiniv St_lbattcal0.B_lbattenh St_lbattcal0.B_lbattenv St_lbattcal0.B_lbattinit St_pmdiag0 St_pmdiag0.B_ccbtnach St_pmdiag0.B_ccbttdfk St_pmdiag0.B_ccbttknt St_pmdiag0.B_ccpmerr St_pmdiag0.B_ccprio St_pmdiag0.B_codierpm St_pmdiag0.B_pcoschg St_pmdiag0.B_tiefrset St_pmdiag1 St_pmdiag1.B_ccruhver St_pmdiag1.B_histrset St_pmdiag1.B_qelad1step St_pmdiag1.B_ruhverl7 St_pmdiag1.B_sv_ihka St_pmdiag1.B_timer_rst St_pmdiagnv St_pmdiagnv.B_ruhverl St_pmprsv_nv St_pmprsv_nv.B_enwake7 St_pmprsvcalc St_pmprsvcalc.B_gendef St_pmprsvcalc.B_ipmaktiv St_pmprsvcalc.B_ipmtimer St_pmprsvcalc.B_kwdr_old St_pmprsvcalc.B_nkwptcio St_pmprsvcalc.B_ptckoor St_pmprsvcalc.B_ubtlow St_pmprsvcalc.B_uloreset St_pmprsvcalc1 St_pmprsvcalc1.B_dubt St_pmprsvcalc1.B_enwakeup St_pmprsvcalc1.B_limcalc St_pmprsvcalc1.B_notprsv St_pmprsvcalc1.B_pireset St_pmprsvcalc1.B_pmbsdanf St_pmprsvcalc1.B_pmvsdanf St_pmprsvcalc2 St_pmprsvcalc2.B_kwdrise St_pmprsvcalc2.B_pmsulevon St_pmsocalc1 St_pmsocalc1.B_ibspwf_e St_pmsoccalc St_pmsoccalc.B_soc_pwf St_pmsoccalc.B_soccalc St_pmsockor0 St_pmsockor0.B_abschfit St_pmsockor0.B_pm_fit2 St_pmsockor0.B_pm_fit3 St_pmsockor0.B_pmsocini St_pmsockor0.B_q_start St_pmsockor0.B_soc_npl St_pmsocstart0 St_pmsocstart0.B_pmstart7 St_pmsocstart0.B_resetsta St_pmsocstart0.B_rstdatardy St_pmsocstart_nv0 St_pmsocstart_nv0.B_pmsqrdy St_pmsocstart_nv0.B_pmstartq St_pmugencalc St_pmugencalc.B_genclcon Stat_sv_reg Stat_sv_reg1 Stat_sv_reg2 Stpcos Stpcos7 Stpcosmem Svaus T1histshort T1pmcntr T2hist T2histshort T2pmcntr T3hist T3histshort T3pmcntr T4hist T4histshort T_batstiniv T_batt_ini T_batt_lb T_batt_zw T_batt_zw2 T_batt_zw3 T_battabst T_bnmotakt T_count_dibs1 T_count_dibs2 T_count_dibs3 T_count_dibs4 T_delta T_histsum T_histsummin T_saismem T_saison T_saisonalt Tsocloc Tumg_abst Tumg_battab Tumg_dt Tumg_ers Tumg_tp U_gensollm U_grenz U_ibs U_igrdetec U_kompk U_kompm U_lade U_startausw Ub_old Ubatt0 Ubatts2 Ubattsoll Ubattsoll7 Ubdiff Ubdiff2pi Ubdiffilt Ubdiffptc Ubold7 Ubt Ubt7 Ubt7mem Ubt7old Ubtpt12ptc Ubtpt1ptc Udelta Udeltaabs Udeltaabsc Udeltac Uibs7 Ulev Ulevmem Ulow Ulowtimer Uspgcnt Uspgprell Uspgstat Vvt_ib1_2 Vvt_iges Ztagedelta Ztageold Ztagestate kbmcount /end OUT_MEASUREMENT
/end FUNCTION
/begin RECORD_LAYOUT TKW_VV_VV_UB FNC_VALUES 1 UBYTE COLUMN_DIR DIRECT /end RECORD_LAYOUT
/begin RECORD_LAYOUT TKW_VV_VV_UW FNC_VALUES 1 UWORD COLUMN_DIR DIRECT /end RECORD_LAYOUT
/begin RECORD_LAYOUT TKW_VV_VV_SW FNC_VALUES 1 SWORD COLUMN_DIR DIRECT /end RECORD_LAYOUT
/begin RECORD_LAYOUT TKL_UB_VV_UB NO_AXIS_PTS_X 1 UBYTE RESERVED 2 BYTE AXIS_PTS_X 3 UBYTE INDEX_INCR DIRECT FNC_VALUES 4 UBYTE COLUMN_DIR DIRECT /end RECORD_LAYOUT
/begin RECORD_LAYOUT TKL_UB_VV_UW NO_AXIS_PTS_X 1 UBYTE RESERVED 2 BYTE AXIS_PTS_X 3 UBYTE INDEX_INCR DIRECT FNC_VALUES 4 UWORD COLUMN_DIR DIRECT /end RECORD_LAYOUT
/begin RECORD_LAYOUT TKL_UB_VV_SW NO_AXIS_PTS_X 1 UBYTE RESERVED 2 BYTE AXIS_PTS_X 3 UBYTE INDEX_INCR DIRECT FNC_VALUES 4 SWORD COLUMN_DIR DIRECT /end RECORD_LAYOUT
/begin RECORD_LAYOUT TKL_UW_VV_UB NO_AXIS_PTS_X 1 UBYTE RESERVED 2 BYTE AXIS_PTS_X 3 UWORD INDEX_INCR DIRECT FNC_VALUES 4 UBYTE COLUMN_DIR DIRECT /end RECORD_LAYOUT
/begin RECORD_LAYOUT TKL_UW_VV_UW NO_AXIS_PTS_X 1 UBYTE RESERVED 2 BYTE AXIS_PTS_X 3 UWORD INDEX_INCR DIRECT FNC_VALUES 4 UWORD COLUMN_DIR DIRECT /end RECORD_LAYOUT
/begin RECORD_LAYOUT TKL_UW_VV_SW NO_AXIS_PTS_X 1 UBYTE RESERVED 2 BYTE AXIS_PTS_X 3 UWORD INDEX_INCR DIRECT FNC_VALUES 4 SWORD COLUMN_DIR DIRECT /end RECORD_LAYOUT
/begin RECORD_LAYOUT TKL_SW_VV_UB NO_AXIS_PTS_X 1 UBYTE RESERVED 2 BYTE AXIS_PTS_X 3 SWORD INDEX_INCR DIRECT FNC_VALUES 4 UBYTE COLUMN_DIR DIRECT /end RECORD_LAYOUT
/begin RECORD_LAYOUT TKL_SW_VV_UW NO_AXIS_PTS_X 1 UBYTE RESERVED 2 BYTE AXIS_PTS_X 3 SWORD INDEX_INCR DIRECT FNC_VALUES 4 UWORD COLUMN_DIR DIRECT /end RECORD_LAYOUT
/begin RECORD_LAYOUT TKL_SW_VV_SW NO_AXIS_PTS_X 1 UBYTE RESERVED 2 BYTE AXIS_PTS_X 3 SWORD INDEX_INCR DIRECT FNC_VALUES 4 SWORD COLUMN_DIR DIRECT /end RECORD_LAYOUT
/begin RECORD_LAYOUT TKF_UB_UB_UB NO_AXIS_PTS_X 1 UBYTE NO_AXIS_PTS_Y 2 UBYTE AXIS_PTS_X 3 UBYTE INDEX_INCR DIRECT AXIS_PTS_Y 4 UBYTE INDEX_INCR DIRECT FNC_VALUES 5 UBYTE COLUMN_DIR DIRECT /end RECORD_LAYOUT
/begin RECORD_LAYOUT TKF_UW_UB_UW NO_AXIS_PTS_X 1 UBYTE NO_AXIS_PTS_Y 2 UBYTE AXIS_PTS_X 3 UBYTE INDEX_INCR DIRECT AXIS_PTS_Y 4 UWORD INDEX_INCR DIRECT FNC_VALUES 5 UWORD COLUMN_DIR DIRECT /end RECORD_LAYOUT
/begin RECORD_LAYOUT TKF_UW_SW_UB NO_AXIS_PTS_X 1 UBYTE NO_AXIS_PTS_Y 2 UBYTE AXIS_PTS_X 3 SWORD INDEX_INCR DIRECT AXIS_PTS_Y 4 UWORD INDEX_INCR DIRECT FNC_VALUES 5 UBYTE COLUMN_DIR DIRECT /end RECORD_LAYOUT
/begin RECORD_LAYOUT TKF_UW_SW_UW NO_AXIS_PTS_X 1 UBYTE NO_AXIS_PTS_Y 2 UBYTE AXIS_PTS_X 3 SWORD INDEX_INCR DIRECT AXIS_PTS_Y 4 UWORD INDEX_INCR DIRECT FNC_VALUES 5 UWORD COLUMN_DIR DIRECT /end RECORD_LAYOUT
/begin RECORD_LAYOUT TKF_SW_UW_UW NO_AXIS_PTS_X 1 UBYTE NO_AXIS_PTS_Y 2 UBYTE AXIS_PTS_X 3 UWORD INDEX_INCR DIRECT AXIS_PTS_Y 4 SWORD INDEX_INCR DIRECT FNC_VALUES 5 UWORD COLUMN_DIR DIRECT /end RECORD_LAYOUT
/begin RECORD_LAYOUT TKF_SW_SW_UW NO_AXIS_PTS_X 1 UBYTE NO_AXIS_PTS_Y 2 UBYTE AXIS_PTS_X 3 SWORD INDEX_INCR DIRECT AXIS_PTS_Y 4 SWORD INDEX_INCR DIRECT FNC_VALUES 5 UWORD COLUMN_DIR DIRECT /end RECORD_LAYOUT
/end MODULE
/end PROJECT
