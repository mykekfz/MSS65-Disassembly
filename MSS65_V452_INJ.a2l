/begin PROJECT MSS65-inj-V452 "MSS65 INJ - V452.01-B204.00, data set 0569Q60Z160E"
/begin HEADER "" VERSION "V452.01-B204.00" /end HEADER
/begin MODULE _MSS65-inj "MSS65 INJ - V452.01-B204.00, calibration xxxxxxxx"
/begin MOD_COMMON "" BYTE_ORDER MSB_FIRST /* Default byteorder (Motorola) */ /end MOD_COMMON
/* ------------------ Abschnitt erzeugt aus adapt_common.dat ------------------ */
/begin COMPU_METHOD FORMULA_0000 "FORMULA_0000" RAT_FUNC "%7.0" "-" COEFFS 0 1 0 0 0 1 /end COMPU_METHOD
/begin COMPU_METHOD FORMULA_0003 "FORMULA_0003" RAT_FUNC "%3.0" "-" COEFFS 0 1 0 0 0 1 /end COMPU_METHOD
/begin COMPU_METHOD FORMULA_0006 "FORMULA_0006" RAT_FUNC "%5.0" "Upm" COEFFS 0 1 0 0 0 1 /end COMPU_METHOD
/begin COMPU_METHOD FORMULA_0007 "FORMULA_0007" RAT_FUNC "%8.3" "-" COEFFS 0 10000 0 0 0 1 /end COMPU_METHOD
/begin COMPU_METHOD FORMULA_0010 "FORMULA_0010" RAT_FUNC "%5.0" "-" COEFFS 0 1 0 0 0 1 /end COMPU_METHOD
/begin COMPU_METHOD FORMULA_0021 "FORMULA_0021" RAT_FUNC "%7.2" "s" COEFFS 0 100 0 0 0 1 /end COMPU_METHOD
/* ------------------ Abschnitt erzeugt aus adapt_glob.dat ------------------ */
/begin COMPU_METHOD FORMULA_0023 "FORMULA_0023" RAT_FUNC "%6.1" "�C" COEFFS 0 10 2732 0 0 1 /end COMPU_METHOD
/begin COMPU_METHOD FORMULA_0024 "FORMULA_0024" RAT_FUNC "%9.4" "-" COEFFS 0 32768 0 0 0 1 /end COMPU_METHOD
/begin COMPU_METHOD FORMULA_0025 "FORMULA_0025" RAT_FUNC "%8.3" "-" COEFFS 0 16384 0 0 0 1 /end COMPU_METHOD
/begin COMPU_METHOD FORMULA_0033 "FORMULA_0033" RAT_FUNC "%5.2" "-" COEFFS 0 1 0 0 0 1 /end COMPU_METHOD
/begin COMPU_METHOD FORMULA_0062 "FORMULA_0062" RAT_FUNC "%5.0" "s" COEFFS 0 1 0 0 0 1 /end COMPU_METHOD
/begin COMPU_METHOD FORMULA_0073 "FORMULA_0073" RAT_FUNC "%6.1" "s" COEFFS 0 10 0 0 0 1 /end COMPU_METHOD
/begin COMPU_METHOD FORMULA_0075 "FORMULA_0075" RAT_FUNC "%8.3" "-" COEFFS 0 1024 0 0 0 1 /end COMPU_METHOD
/begin COMPU_METHOD FORMULA_0077 "FORMULA_0077" RAT_FUNC "%6.1" "mbar" COEFFS 0 16 0 0 0 1 /end COMPU_METHOD
/begin COMPU_METHOD FORMULA_0078 "FORMULA_0078" RAT_FUNC "%6.1" "km/h" COEFFS 0 16 0 0 0 1 /end COMPU_METHOD
/* ------------------ Abschnitt erzeugt aus glob.dat ------------------ */
/begin COMPU_METHOD FORMULA_0083 "FORMULA_0083" RAT_FUNC "%7.2" "-" COEFFS 0 1 0 0 0 1 /end COMPU_METHOD
/begin COMPU_METHOD FORMULA_0106 "FORMULA_0106" TAB_VERB "%7.2" "-" COMPU_TAB_REF FORMULA_0106_VTAB /end COMPU_METHOD
/begin COMPU_VTAB FORMULA_0106_VTAB "FORMULA_0106_VTAB" TAB_VERB 1 0 "-" DEFAULT_VALUE "aktiv" /end COMPU_VTAB
/begin COMPU_METHOD FORMULA_0112 "FORMULA_0112" RAT_FUNC "%6.1" "kg/h" COEFFS 0 10 0 0 0 1 /end COMPU_METHOD
/begin COMPU_METHOD FORMULA_0117 "FORMULA_0117" RAT_FUNC "%7.2" "s" COEFFS 0 200 0 0 0 1 /end COMPU_METHOD
/begin COMPU_METHOD FORMULA_0123 "FORMULA_0123" RAT_FUNC "%5.0" "digit" COEFFS 0 1 0 0 0 1 /end COMPU_METHOD
/begin COMPU_METHOD FORMULA_0140 "FORMULA_0140" RAT_FUNC "%5.0" "bar/s" COEFFS 0 1 0 0 0 50 /end COMPU_METHOD
/begin COMPU_METHOD FORMULA_0147 "FORMULA_0147" RAT_FUNC "%6.1" "qmm" COEFFS 0 10 0 0 0 1 /end COMPU_METHOD
/begin COMPU_METHOD FORMULA_0232 "FORMULA_0232" RAT_FUNC "%3.0" "s" COEFFS 0 1 0 0 0 1 /end COMPU_METHOD
/* ------------------ Abschnitt erzeugt aus pctrl.dat ------------------ */
/begin COMPU_METHOD FORMULA_0352 "FORMULA_0352" RAT_FUNC "%5.2" "s" COEFFS 0 200 0 0 0 1 /end COMPU_METHOD
/begin COMPU_METHOD FORMULA_0353 "FORMULA_0353" RAT_FUNC "%3.0" "ms" COEFFS 0 1 0 0 0 10 /end COMPU_METHOD
/* ------------------ Abschnitt erzeugt aus dqlt.dat ------------------ */
/begin COMPU_METHOD FORMULA_0418 "FORMULA_0418" TAB_VERB "%5.2" "-" COMPU_TAB_REF FORMULA_0418_VTAB /end COMPU_METHOD
/begin COMPU_VTAB FORMULA_0418_VTAB "FORMULA_0418_VTAB" TAB_VERB 2 0 "FALSE" 1 "TRUE" DEFAULT_VALUE "TRUE" /end COMPU_VTAB
/begin COMPU_METHOD FORMULA_0419 "FORMULA_0419" TAB_VERB "%5.2" "-" COMPU_TAB_REF FORMULA_0419_VTAB /end COMPU_METHOD
/begin COMPU_VTAB FORMULA_0419_VTAB "FORMULA_0419_VTAB" TAB_VERB 2 0 "FALSE" 1 "TRUE" DEFAULT_VALUE "TRUE" /end COMPU_VTAB
/begin COMPU_METHOD FORMULA_0420 "FORMULA_0420" TAB_VERB "%5.2" "-" COMPU_TAB_REF FORMULA_0420_VTAB /end COMPU_METHOD
/begin COMPU_VTAB FORMULA_0420_VTAB "FORMULA_0420_VTAB" TAB_VERB 2 0 "FALSE" 1 "TRUE" DEFAULT_VALUE "TRUE" /end COMPU_VTAB
/begin COMPU_METHOD FORMULA_0421 "FORMULA_0421" TAB_VERB "%5.2" "-" COMPU_TAB_REF FORMULA_0421_VTAB /end COMPU_METHOD
/begin COMPU_VTAB FORMULA_0421_VTAB "FORMULA_0421_VTAB" TAB_VERB 2 0 "FALSE" 1 "TRUE" DEFAULT_VALUE "TRUE" /end COMPU_VTAB
/begin COMPU_METHOD FORMULA_0422 "FORMULA_0422" TAB_VERB "%5.2" "-" COMPU_TAB_REF FORMULA_0422_VTAB /end COMPU_METHOD
/begin COMPU_VTAB FORMULA_0422_VTAB "FORMULA_0422_VTAB" TAB_VERB 2 0 "FALSE" 1 "TRUE" DEFAULT_VALUE "TRUE" /end COMPU_VTAB
/begin COMPU_METHOD FORMULA_0423 "FORMULA_0423" TAB_VERB "%5.2" "-" COMPU_TAB_REF FORMULA_0423_VTAB /end COMPU_METHOD
/begin COMPU_VTAB FORMULA_0423_VTAB "FORMULA_0423_VTAB" TAB_VERB 2 0 "FALSE" 1 "TRUE" DEFAULT_VALUE "TRUE" /end COMPU_VTAB
/begin COMPU_METHOD FORMULA_0424 "FORMULA_0424" TAB_VERB "%5.2" "-" COMPU_TAB_REF FORMULA_0424_VTAB /end COMPU_METHOD
/begin COMPU_VTAB FORMULA_0424_VTAB "FORMULA_0424_VTAB" TAB_VERB 2 0 "FALSE" 1 "TRUE" DEFAULT_VALUE "TRUE" /end COMPU_VTAB
/begin COMPU_METHOD FORMULA_0425 "FORMULA_0425" TAB_VERB "%5.2" "-" COMPU_TAB_REF FORMULA_0425_VTAB /end COMPU_METHOD
/begin COMPU_VTAB FORMULA_0425_VTAB "FORMULA_0425_VTAB" TAB_VERB 2 0 "FALSE" 1 "TRUE" DEFAULT_VALUE "TRUE" /end COMPU_VTAB
/begin COMPU_METHOD FORMULA_0426 "FORMULA_0426" RAT_FUNC "%5.0" "�C" COEFFS 0 10 0 0 0 1 /end COMPU_METHOD
/begin COMPU_METHOD FORMULA_0427 "FORMULA_0427" RAT_FUNC "%6.1" "V" COEFFS 0 1 0 0 0 0.0942 /end COMPU_METHOD
/* ------------------ Abschnitt erzeugt aus ozbg.dat ------------------ */
/begin COMPU_METHOD FORMULA_0428 "FORMULA_0428" RAT_FUNC "%6.1" "km" COEFFS 0 1 0 0 0 10 /end COMPU_METHOD
/begin COMPU_METHOD FORMULA_0429 "FORMULA_0429" RAT_FUNC "%3.0" "km" COEFFS 0 1 0 0 0 1000 /end COMPU_METHOD
/* ------------------ Abschnitt erzeugt aus ozgg.dat ------------------ */
/begin COMPU_METHOD FORMULA_0430 "FORMULA_0430" RAT_FUNC "%6.1" "-" COEFFS 0 65536 0 0 0 6 /end COMPU_METHOD
/begin COMPU_METHOD FORMULA_0431 "FORMULA_0431" RAT_FUNC "%5.2" "mm" COEFFS 0 256 0 0 0 75 /end COMPU_METHOD
/begin COMPU_METHOD FORMULA_0432 "FORMULA_0432" RAT_FUNC "%5.0" "km" COEFFS 0 1 0 0 0 10 /end COMPU_METHOD
/begin COMPU_METHOD FORMULA_0433 "FORMULA_0433" RAT_FUNC "%7.2" "%" COEFFS 0 65536 0 0 0 100 /end COMPU_METHOD
/begin COMPU_METHOD FORMULA_0434 "FORMULA_0434" RAT_FUNC "%5.2" "-" COEFFS 0 256 0 0 0 1 /end COMPU_METHOD
/begin COMPU_METHOD FORMULA_0435 "FORMULA_0435" RAT_FUNC "%6.3" "s" COEFFS 0 1 0 0 0 1 /end COMPU_METHOD
/* ------------------ Abschnitt erzeugt aus oznivdl.dat ------------------ */
/begin COMPU_METHOD FORMULA_0436 "FORMULA_0436" RAT_FUNC "%5.2" "Liter" COEFFS 0 10 0 0 0 1 /end COMPU_METHOD
/begin COMPU_METHOD FORMULA_0437 "FORMULA_0437" RAT_FUNC "%5.2" "mm" COEFFS 0 256 0 0 0 8 /end COMPU_METHOD
/begin COMPU_METHOD FORMULA_0438 "FORMULA_0438" RAT_FUNC "%7.2" "min" COEFFS 0 1 0 0 0 1 /end COMPU_METHOD
/begin COMPU_METHOD FORMULA_0439 "FORMULA_0439" RAT_FUNC "%8.3" "" COEFFS 0 4096 0 0 0 1 /end COMPU_METHOD
/begin COMPU_METHOD FORMULA_0440 "FORMULA_0440" RAT_FUNC "%7.2" "-" COEFFS 0 65536 0 0 0 128 /end COMPU_METHOD
/begin COMPU_METHOD FORMULA_0441 "FORMULA_0441" RAT_FUNC "%7.2" "%" COEFFS 0 65536 0 0 0 10 /end COMPU_METHOD
/begin COMPU_METHOD FORMULA_0442 "FORMULA_0442" RAT_FUNC "%5.2" "-" COEFFS 0 128 0 0 0 2 /end COMPU_METHOD
/begin COMPU_METHOD FORMULA_0443 "FORMULA_0443" RAT_FUNC "%7.2" "�C" COEFFS 0 100 0 0 0 1 /end COMPU_METHOD
/begin COMPU_METHOD FORMULA_0444 "FORMULA_0444" RAT_FUNC "%9.4" "-" COEFFS 0 32768 0 0 0 32 /end COMPU_METHOD
/begin COMPU_METHOD FORMULA_0445 "FORMULA_0445" RAT_FUNC "%8.3" "hPa" COEFFS 0 256 0 0 0 10 /end COMPU_METHOD
/begin COMPU_METHOD FORMULA_0446 "FORMULA_0446" RAT_FUNC "%4.1" "-" COEFFS 0 4 0 0 0 1 /end COMPU_METHOD
/begin COMPU_METHOD FORMULA_0447 "FORMULA_0447" RAT_FUNC "%5.2" "-" COEFFS 0 256 0 0 0 8 /end COMPU_METHOD
/begin COMPU_METHOD FORMULA_0448 "FORMULA_0448" RAT_FUNC "%7.2" "-" COEFFS 0 65536 0 0 0 2 /end COMPU_METHOD
/begin COMPU_METHOD FORMULA_0449 "FORMULA_0449" RAT_FUNC "%7.2" "mm" COEFFS 0 256 0 0 0 75 /end COMPU_METHOD
/begin COMPU_METHOD FORMULA_0450 "FORMULA_0450" RAT_FUNC "%7.2" "mm" COEFFS 0 512 0 0 0 75 /end COMPU_METHOD
/* ------------------ Abschnitt erzeugt aus ozrestkm.dat ------------------ */
/begin COMPU_METHOD FORMULA_0451 "FORMULA_0451" RAT_FUNC "%4.1" "-" COEFFS 0 100 0 0 0 1 /end COMPU_METHOD
/begin COMPU_METHOD FORMULA_0452 "FORMULA_0452" RAT_FUNC "%10.3" "" COEFFS 0 8192 0 0 0 1 /end COMPU_METHOD
/begin COMPU_METHOD FORMULA_0453 "FORMULA_0453" RAT_FUNC "%9.4" "-" COEFFS 0 1024 0 0 0 1 /end COMPU_METHOD
/begin COMPU_METHOD FORMULA_0454 "FORMULA_0454" RAT_FUNC "%6.3" "-" COEFFS 0 256 0 0 0 0.25 /end COMPU_METHOD
/begin COMPU_METHOD FORMULA_0455 "FORMULA_0455" RAT_FUNC "%5.2" "-" COEFFS 0 256 0 0 0 32 /end COMPU_METHOD
/begin COMPU_METHOD FORMULA_0456 "FORMULA_0456" RAT_FUNC "%6.3" "�KW" COEFFS 0 256 0 0 0 6 /end COMPU_METHOD
/begin COMPU_METHOD FORMULA_0457 "FORMULA_0457" RAT_FUNC "%9.4" "-" COEFFS 0 65536 0 0 0 1 /end COMPU_METHOD
/* ------------------ Abschnitt erzeugt aus dgen.dat ------------------ */
/begin COMPU_METHOD FORMULA_0458 "FORMULA_0458" RAT_FUNC "%4.1" "s" COEFFS 0 10 0 0 0 1 /end COMPU_METHOD
/begin COMPU_METHOD FORMULA_0460 "FORMULA_0460" RAT_FUNC "%6.3" "A" COEFFS 0 8 0 0 0 1 /end COMPU_METHOD
/begin COMPU_METHOD FORMULA_0461 "FORMULA_0461" RAT_FUNC "%5.2" "-" COEFFS 0 256 0 0 0 4 /end COMPU_METHOD
/begin COMPU_METHOD FORMULA_0470 "FORMULA_0470" RAT_FUNC "%5.0" "km/h" COEFFS 0 1 0 0 0 1 /end COMPU_METHOD
/begin COMPU_METHOD FORMULA_0471 "FORMULA_0471" RAT_FUNC "%5.2" "%" COEFFS 0 256 0 0 0 100 /end COMPU_METHOD
/begin COMPU_METHOD FORMULA_0472 "FORMULA_0472" RAT_FUNC "%5.2" "min" COEFFS 0 1 0 0 0 1 /end COMPU_METHOD
/begin COMPU_METHOD FORMULA_0474 "FORMULA_0474" RAT_FUNC "%4.1" "-" COEFFS 0 1 0 0 0 1 /end COMPU_METHOD
/* ------------------ Abschnitt erzeugt aus pgentred.dat ------------------ */
/begin COMPU_METHOD FORMULA_0478 "FORMULA_0478" RAT_FUNC "%7.2" "%" COEFFS 0 65536 0 0 0 256 /end COMPU_METHOD
/begin COMPU_METHOD FORMULA_0479 "FORMULA_0479" RAT_FUNC "%8.3" "V" COEFFS 0 1024 0 0 0 5 /end COMPU_METHOD
/* ------------------ Abschnitt erzeugt aus pmbnstab.dat ------------------ */
/begin COMPU_METHOD FORMULA_0486 "FORMULA_0486" RAT_FUNC "%7.4" "V" COEFFS 0 1 0 0 0 0.0942 /end COMPU_METHOD
/begin COMPU_METHOD FORMULA_0532 "FORMULA_0532" RAT_FUNC "%5.0" "mV" COEFFS 0 1024 0 0 0 5000 /end COMPU_METHOD
/begin COMPU_METHOD FORMULA_0556 "FORMULA_0556" RAT_FUNC "%9.4" "-" COEFFS 0 10000 0 0 0 1 /end COMPU_METHOD
/begin COMPU_METHOD FORMULA_0643 "FORMULA_0643" RAT_FUNC "%5.2" "" COEFFS 0 128 0 0 0 1 /end COMPU_METHOD
/begin COMPU_METHOD FORMULA_0651 "FORMULA_0651" RAT_FUNC "%6.3" "s" COEFFS 0 0 1.28 0 1 0 /end COMPU_METHOD
/begin COMPU_METHOD FORMULA_0681 "FORMULA_0681" TAB_VERB "%3.0" "-" COMPU_TAB_REF FORMULA_0681_VTAB /end COMPU_METHOD
/begin COMPU_VTAB FORMULA_0681_VTAB "FORMULA_0681_VTAB" TAB_VERB 7 0 "inaktiv" 1 "Bedingungen nicht erfuellt" 5 "aktiv" 6 "beendet" 7 "Abbruch" 8 "beendet niO" 9 "beendet iO" DEFAULT_VALUE "undef" /end COMPU_VTAB
/begin COMPU_METHOD FORMULA_0755 "FORMULA_0755" RAT_FUNC "%7.2" "-" COEFFS 0 256 0 0 0 1 /end COMPU_METHOD
/begin COMPU_METHOD FORMULA_0764 "FORMULA_0764" RAT_FUNC "%5.0" "ms" COEFFS 0 1 0 0 0 1 /end COMPU_METHOD
/begin COMPU_METHOD FORMULA_0770 "FORMULA_0770" TAB_VERB "%7.2" "-" COMPU_TAB_REF FORMULA_0770_VTAB /end COMPU_METHOD
/begin COMPU_VTAB FORMULA_0770_VTAB "FORMULA_0770_VTAB" TAB_VERB 1 0 "inaktiv" DEFAULT_VALUE "aktiv" /end COMPU_VTAB
/begin COMPU_METHOD FORMULA_0798 "FORMULA_0798" TAB_VERB "%7.2" "-" COMPU_TAB_REF FORMULA_0798_VTAB /end COMPU_METHOD
/begin COMPU_VTAB FORMULA_0798_VTAB "FORMULA_0798_VTAB" TAB_VERB 2 0 "inaktiv" 1 "aktiv" /end COMPU_VTAB
/begin COMPU_METHOD FORMULA_0799 "FORMULA_0799" RAT_FUNC "%5.0" "sec" COEFFS 0 1 0 0 0 1 /end COMPU_METHOD
/begin COMPU_METHOD FORMULA_0800 "FORMULA_0800" RAT_FUNC "%6.1" "�C" COEFFS 0 10 0 0 0 1 /end COMPU_METHOD
/begin COMPU_METHOD FORMULA_0832 "FORMULA_0832" RAT_FUNC "%5.0" "mg" COEFFS 0 1 0 0 0 1 /end COMPU_METHOD
/begin COMPU_METHOD FORMULA_0836 "FORMULA_0836" TAB_VERB "%7.2" "-" COMPU_TAB_REF FORMULA_0836_VTAB /end COMPU_METHOD
/begin COMPU_VTAB FORMULA_0836_VTAB "FORMULA_0836_VTAB" TAB_VERB 1 0 "inaktiv" DEFAULT_VALUE "aktiv" /end COMPU_VTAB
/begin COMPU_METHOD FORMULA_0932 "FORMULA_0932" RAT_FUNC "%5.0" "s" COEFFS 0 100 0 0 0 1 /end COMPU_METHOD
/* ------------------ Abschnitt erzeugt aus msg.dat ------------------ */
/begin COMPU_METHOD FORMULA_0970 "FORMULA_0970" TAB_VERB "%3.0" "-" COMPU_TAB_REF FORMULA_0970_VTAB /end COMPU_METHOD
/begin COMPU_VTAB FORMULA_0970_VTAB "FORMULA_0970_VTAB" TAB_VERB 7 0 "empty" 2 "StVehM" 1 "Req" 48 "BOS" 50 "BOS_2" 64 "CC" 65 "CCext" DEFAULT_VALUE "undef" /end COMPU_VTAB
/begin COMPU_METHOD FORMULA_0971 "FORMULA_0971" TAB_VERB "%3.0" "-" COMPU_TAB_REF FORMULA_0971_VTAB /end COMPU_METHOD
/begin COMPU_VTAB FORMULA_0971_VTAB "FORMULA_0971_VTAB" TAB_VERB 1 255 "empty" DEFAULT_VALUE "full" /end COMPU_VTAB
/begin COMPU_METHOD FORMULA_0972 "FORMULA_0972" TAB_VERB "%5.0" "-" COMPU_TAB_REF FORMULA_0972_VTAB /end COMPU_METHOD
/begin COMPU_VTAB FORMULA_0972_VTAB "FORMULA_0972_VTAB" TAB_VERB 27 0 "empty" 1 "Oel" 917 "Req395" 26 "FGR" 27 "MinOel_1" 28 "MinOel_2" 29 "EML" 31 "MIL" 32 "Tank" 33 "Auss_1" 34 "Auss_2" 39 "Tmot_rot" 103 "Tgetr" 104 "Tsmg" 182 "Oel-Err" 212 "Oeldruck" 213 "noLoad" 220 "highLoad" 229 "BattLow" 247 "PM-Err" 257 "Tmot_gelb" 304 "BattZust" 305 "BattKont" 306 "BattVerb" 367 "ZWS" 18193 "unused" 65535 "VehMode" DEFAULT_VALUE "undef" /end COMPU_VTAB
/begin COMPU_METHOD FORMULA_0973 "FORMULA_0973" TAB_VERB "%3.0" "-" COMPU_TAB_REF FORMULA_0973_VTAB /end COMPU_METHOD
/begin COMPU_VTAB FORMULA_0973_VTAB "FORMULA_0973_VTAB" TAB_VERB 3 0 "-" 1 "sende BOS nach Kl.wechsel" 2 "sende BOS nach Kombireset" /end COMPU_VTAB
/begin COMPU_METHOD FORMULA_0974 "FORMULA_0974" TAB_VERB "%5.2" "-" COMPU_TAB_REF FORMULA_0974_VTAB /end COMPU_METHOD
/begin COMPU_VTAB FORMULA_0974_VTAB "FORMULA_0974_VTAB" TAB_VERB 2 0 "Normal" 1 "SMG-CC" /end COMPU_VTAB
/* ------------------ Abschnitt erzeugt aus mvac.dat ------------------ */
/begin COMPU_METHOD FORMULA_0975 "FORMULA_0975" RAT_FUNC "%9.4" "g" COEFFS 0 512 0 0 0 1 /end COMPU_METHOD
/begin COMPU_METHOD FORMULA_0976 "FORMULA_0976" RAT_FUNC "%11.4" "kg/h" COEFFS 0 512 0 0 0 1 /end COMPU_METHOD
/begin COMPU_METHOD FORMULA_0977 "FORMULA_0977" TAB_VERB "%5.2" "-" COMPU_TAB_REF FORMULA_0977_VTAB /end COMPU_METHOD
/begin COMPU_VTAB FORMULA_0977_VTAB "FORMULA_0977_VTAB" TAB_VERB 2 0 "geschlossen" 1 "offen" DEFAULT_VALUE "undef" /end COMPU_VTAB
/begin COMPU_METHOD FORMULA_0978 "FORMULA_0978" RAT_FUNC "%8.1" "(kg/h)/mbar2^20" COEFFS 0 16 0 0 0 1 /end COMPU_METHOD
/begin COMPU_METHOD FORMULA_0979 "FORMULA_0979" RAT_FUNC "%9.4" "kg/h" COEFFS 0 512 0 0 0 1 /end COMPU_METHOD
/begin COMPU_METHOD FORMULA_0980 "FORMULA_0980" RAT_FUNC "%7.2" "(kg/h)/mbar" COEFFS 0 1024 0 0 0 1 /end COMPU_METHOD
/begin COMPU_METHOD FORMULA_0981 "FORMULA_0981" RAT_FUNC "%11.4" "Pa/s" COEFFS 0 1600 0 0 0 1 /end COMPU_METHOD
/begin COMPU_METHOD FORMULA_0982 "FORMULA_0982" TAB_VERB "%5.2" "-" COMPU_TAB_REF FORMULA_0982_VTAB /end COMPU_METHOD
/begin COMPU_VTAB FORMULA_0982_VTAB "FORMULA_0982_VTAB" TAB_VERB 2 0 "inaktiv" 1 "aktiv" DEFAULT_VALUE "undef" /end COMPU_VTAB
/begin COMPU_METHOD FORMULA_0983 "FORMULA_0983" TAB_VERB "%5.2" "-" COMPU_TAB_REF FORMULA_0983_VTAB /end COMPU_METHOD
/begin COMPU_VTAB FORMULA_0983_VTAB "FORMULA_0983_VTAB" TAB_VERB 2 0 "nein" 1 "ja" DEFAULT_VALUE "undef" /end COMPU_VTAB
/begin COMPU_METHOD FORMULA_0984 "FORMULA_0984" RAT_FUNC "%5.0" "mbar" COEFFS 0 16 0 0 0 1 /end COMPU_METHOD
/begin COMPU_METHOD FORMULA_0985 "FORMULA_0985" RAT_FUNC "%7.2" "s" COEFFS 0 0 327.67 0 1 0 /end COMPU_METHOD
/begin COMPU_METHOD FORMULA_0986 "FORMULA_0986" RAT_FUNC "%8.3" "mbar" COEFFS 0 16 0 0 0 1 /end COMPU_METHOD
/begin COMPU_METHOD FORMULA_0987 "FORMULA_0987" RAT_FUNC "%8.3" "�C" COEFFS 0 10 2732 0 0 1 /end COMPU_METHOD
/begin COMPU_METHOD FORMULA_0988 "FORMULA_0988" RAT_FUNC "%8.3" "mbar/V" COEFFS 0 80 0 0 0 1 /end COMPU_METHOD
/begin COMPU_METHOD FORMULA_0989 "FORMULA_0989" RAT_FUNC "%8.3" "s" COEFFS 0 0 327.67 0 1 0 /end COMPU_METHOD
/begin COMPU_METHOD FORMULA_0990 "FORMULA_0990" TAB_VERB "%5.2" "-" COMPU_TAB_REF FORMULA_0990_VTAB /end COMPU_METHOD
/begin COMPU_VTAB FORMULA_0990_VTAB "FORMULA_0990_VTAB" TAB_VERB 2 0 "mvac_ml_sr_rsv_mess" 1 "mvac_ml_sr_rsv_psens" DEFAULT_VALUE "undef" /end COMPU_VTAB
/begin COMPU_METHOD FORMULA_0991 "FORMULA_0991" RAT_FUNC "%8.3" "(kg/h)/mbar" COEFFS 0 1024 0 0 0 1 /end COMPU_METHOD
/begin COMPU_METHOD FORMULA_0992 "FORMULA_0992" RAT_FUNC "%7.2" "kg/h" COEFFS 0 80 0 0 0 1 /end COMPU_METHOD
/begin COMPU_METHOD FORMULA_0993 "FORMULA_0993" RAT_FUNC "%7.2" "1/2^20" COEFFS 0 16 0 0 0 1 /end COMPU_METHOD
/begin COMPU_METHOD FORMULA_0994 "FORMULA_0994" RAT_FUNC "%6.1" "1/2^20" COEFFS 0 16 0 0 0 1 /end COMPU_METHOD
/begin COMPU_METHOD FORMULA_0995 "FORMULA_0995" RAT_FUNC "%8.1" "ccm" COEFFS 0 10 0 0 0 1 /end COMPU_METHOD
/* ------------------ Abschnitt erzeugt aus nwm.dat ------------------ */
/begin COMPU_METHOD FORMULA_1006 "FORMULA_1006" TAB_VERB "%3.0" "-" COMPU_TAB_REF FORMULA_1006_VTAB /end COMPU_METHOD
/begin COMPU_VTAB FORMULA_1006_VTAB "FORMULA_1006_VTAB" TAB_VERB 13 0 "ZGM" 18 "DME1" 19 "DME2" 22 "AFS" 23 "EKP" 24 "SMG" 33 "ACC" 34 "ALC" 35 "ARS" 37 "GRS" 41 "DSC" 42 "EMF" 57 "EDCK" DEFAULT_VALUE "unbekannt" /end COMPU_VTAB
/begin COMPU_METHOD FORMULA_1007 "FORMULA_1007" TAB_VERB "%3.0" "-" COMPU_TAB_REF FORMULA_1007_VTAB /end COMPU_METHOD
/begin COMPU_VTAB FORMULA_1007_VTAB "FORMULA_1007_VTAB" TAB_VERB 21 1 "Alive" 2 "Ring" 4 "Notlauf" 8 "reserved" 16 "SleepInd" 17 "SleepInd/Alive" 18 "SleepInd/Ring" 20 "SleepInd/Notlauf" 32 "SleepAck" 33 "SleepAck/Alive" 34 "SleepAck/Ring" 36 "SleepAck/Notlauf" 64 "Umlauf" 65 "Umlauf/Alive" 66 "Umlauf/Ring" 68 "Umlauf/Notlauf" 80 "SleepInd" 81 "SleepInd/Alive" 82 "SleepInd/Ring" 84 "SleepInd/Notlauf" 128 "reserved" /end COMPU_VTAB
/begin COMPU_METHOD FORMULA_1008 "FORMULA_1008" TAB_VERB "%3.0" "-" COMPU_TAB_REF FORMULA_1008_VTAB /end COMPU_METHOD
/begin COMPU_VTAB FORMULA_1008_VTAB "FORMULA_1008_VTAB" TAB_VERB 10 0 "Nothing" 1 "Start" 2 "WaitTockenSnd" 3 "WaitRingMsg" 4 "SndSkippedAlive" 5 "WaitLimp" 6 "PrepSleep" 7 "GoSleep" 8 "Sleep" 128 "Repeat" /end COMPU_VTAB
/* ------------------ Abschnitt erzeugt aus o2_obd.dat ------------------ */
/begin COMPU_METHOD FORMULA_1014 "FORMULA_1014" TAB_VERB "%7.2" "-" COMPU_TAB_REF FORMULA_1014_VTAB /end COMPU_METHOD
/begin COMPU_VTAB FORMULA_1014_VTAB "FORMULA_1014_VTAB" TAB_VERB 1 0 "inaktiv" DEFAULT_VALUE "Pulsgenerator" /end COMPU_VTAB
/begin COMPU_METHOD FORMULA_1015 "FORMULA_1015" TAB_VERB "%7.2" "-" COMPU_TAB_REF FORMULA_1015_VTAB /end COMPU_METHOD
/begin COMPU_VTAB FORMULA_1015_VTAB "FORMULA_1015_VTAB" TAB_VERB 1 0 "-" DEFAULT_VALUE "FETT-Hub-Trigger" /end COMPU_VTAB
/begin COMPU_METHOD FORMULA_1016 "FORMULA_1016" TAB_VERB "%7.2" "-" COMPU_TAB_REF FORMULA_1016_VTAB /end COMPU_METHOD
/begin COMPU_VTAB FORMULA_1016_VTAB "FORMULA_1016_VTAB" TAB_VERB 1 0 "-" DEFAULT_VALUE "MAGER-Hub-Trigger" /end COMPU_VTAB
/begin COMPU_METHOD FORMULA_1017 "FORMULA_1017" TAB_VERB "%7.2" "-" COMPU_TAB_REF FORMULA_1017_VTAB /end COMPU_METHOD
/begin COMPU_VTAB FORMULA_1017_VTAB "FORMULA_1017_VTAB" TAB_VERB 1 0 "-" DEFAULT_VALUE "UKP" /end COMPU_VTAB
/begin COMPU_METHOD FORMULA_1018 "FORMULA_1018" TAB_VERB "%7.2" "-" COMPU_TAB_REF FORMULA_1018_VTAB /end COMPU_METHOD
/begin COMPU_VTAB FORMULA_1018_VTAB "FORMULA_1018_VTAB" TAB_VERB 1 0 "-" DEFAULT_VALUE "UKP" /end COMPU_VTAB
/begin COMPU_METHOD FORMULA_1019 "FORMULA_1019" TAB_VERB "%7.2" "-" COMPU_TAB_REF FORMULA_1019_VTAB /end COMPU_METHOD
/begin COMPU_VTAB FORMULA_1019_VTAB "FORMULA_1019_VTAB" TAB_VERB 1 0 "-" DEFAULT_VALUE "Berechnung" /end COMPU_VTAB
/begin COMPU_METHOD FORMULA_1020 "FORMULA_1020" TAB_VERB "%7.2" "-" COMPU_TAB_REF FORMULA_1020_VTAB /end COMPU_METHOD
/begin COMPU_VTAB FORMULA_1020_VTAB "FORMULA_1020_VTAB" TAB_VERB 1 0 "sperrt" DEFAULT_VALUE "Freigabe" /end COMPU_VTAB
/begin COMPU_METHOD FORMULA_1021 "FORMULA_1021" TAB_VERB "%7.2" "-" COMPU_TAB_REF FORMULA_1021_VTAB /end COMPU_METHOD
/begin COMPU_VTAB FORMULA_1021_VTAB "FORMULA_1021_VTAB" TAB_VERB 1 0 "sperrt" DEFAULT_VALUE "Freigabe" /end COMPU_VTAB
/begin COMPU_METHOD FORMULA_1022 "FORMULA_1022" TAB_VERB "%7.2" "-" COMPU_TAB_REF FORMULA_1022_VTAB /end COMPU_METHOD
/begin COMPU_VTAB FORMULA_1022_VTAB "FORMULA_1022_VTAB" TAB_VERB 1 0 "-" DEFAULT_VALUE "FETT->MAGER" /end COMPU_VTAB
/begin COMPU_METHOD FORMULA_1023 "FORMULA_1023" TAB_VERB "%7.2" "-" COMPU_TAB_REF FORMULA_1023_VTAB /end COMPU_METHOD
/begin COMPU_VTAB FORMULA_1023_VTAB "FORMULA_1023_VTAB" TAB_VERB 1 0 "-" DEFAULT_VALUE "i.O." /end COMPU_VTAB
/begin COMPU_METHOD FORMULA_1024 "FORMULA_1024" TAB_VERB "%7.2" "-" COMPU_TAB_REF FORMULA_1024_VTAB /end COMPU_METHOD
/begin COMPU_VTAB FORMULA_1024_VTAB "FORMULA_1024_VTAB" TAB_VERB 1 0 "-" DEFAULT_VALUE "i.O." /end COMPU_VTAB
/begin COMPU_METHOD FORMULA_1025 "FORMULA_1025" TAB_VERB "%7.2" "-" COMPU_TAB_REF FORMULA_1025_VTAB /end COMPU_METHOD
/begin COMPU_VTAB FORMULA_1025_VTAB "FORMULA_1025_VTAB" TAB_VERB 1 0 "-" DEFAULT_VALUE "aktiv" /end COMPU_VTAB
/begin COMPU_METHOD FORMULA_1026 "FORMULA_1026" TAB_VERB "%7.2" "-" COMPU_TAB_REF FORMULA_1026_VTAB /end COMPU_METHOD
/begin COMPU_VTAB FORMULA_1026_VTAB "FORMULA_1026_VTAB" TAB_VERB 1 0 "-" DEFAULT_VALUE "fertig" /end COMPU_VTAB
/begin COMPU_METHOD FORMULA_1027 "FORMULA_1027" TAB_VERB "%7.2" "-" COMPU_TAB_REF FORMULA_1027_VTAB /end COMPU_METHOD
/begin COMPU_VTAB FORMULA_1027_VTAB "FORMULA_1027_VTAB" TAB_VERB 1 0 "-" DEFAULT_VALUE "aktiv" /end COMPU_VTAB
/begin COMPU_METHOD FORMULA_1028 "FORMULA_1028" RAT_FUNC "%10.3" "-" COEFFS 0 16384 0 0 0 1 /end COMPU_METHOD
/begin COMPU_METHOD FORMULA_1029 "FORMULA_1029" TAB_VERB "%7.2" "-" COMPU_TAB_REF FORMULA_1029_VTAB /end COMPU_METHOD
/begin COMPU_VTAB FORMULA_1029_VTAB "FORMULA_1029_VTAB" TAB_VERB 2 0 "inaktiv" 1 "TRIMMREGELUNG" /end COMPU_VTAB
/begin COMPU_METHOD FORMULA_1030 "FORMULA_1030" RAT_FUNC "%7.2" "s" COEFFS 0 1000 0 0 0 1 /end COMPU_METHOD
/begin COMPU_METHOD FORMULA_1031 "FORMULA_1031" RAT_FUNC "%7.2" "l" COEFFS 0 30 0 0 0 1 /end COMPU_METHOD
/* ------------------ Abschnitt erzeugt aus pctrl.dat ------------------ */
/begin CHARACTERISTIC K_PCTRL_TIMEOUT "Timeout der Prozessorueberwachung | EN: Timeout der Prozessorueberwachung" VALUE 0x75534 TKW_VV_VV_UB 100.0 FORMULA_0353 0.0 2550.0000 /end CHARACTERISTIC
/begin CHARACTERISTIC K_PCTRL_TASK_ZYKL "Task-Ueberwachungszyklus | EN: Task-Ueberwachungszyklus" VALUE 0x75535 TKW_VV_VV_UB 100.0 FORMULA_0352 0.0 1.2750 /end CHARACTERISTIC
/begin CHARACTERISTIC K_PCTRL_PROZ_ZYKL "Prozess-Ueberwachungszyklus | EN: Prozess-Ueberwachungszyklus" VALUE 0x75536 TKW_VV_VV_UB 100.0 FORMULA_0352 0.0 1.2750 /end CHARACTERISTIC
/begin MEASUREMENT pctrl_t_old_ipk "vorheriger Timer Wert aus der IPK" ULONG FORMULA_0000 0 0 0.0 4294967295.0000 ECU_ADDRESS 0x3FCC64 /end MEASUREMENT
/begin MEASUREMENT pctrl_task_tb "Timerwert Task-Ueberwachungszyklus" UBYTE FORMULA_0352 0 0 0.0 1.2750 ECU_ADDRESS 0x3FCC68 /end MEASUREMENT
/begin MEASUREMENT pctrl_proz_tb "Timerwert Prozess-Ueberwachungszyklus" UBYTE FORMULA_0352 0 0 0.0 1.2750 ECU_ADDRESS 0x3FCC69 /end MEASUREMENT
/begin MEASUREMENT pctrl_tout "Timeout Zaehler" UBYTE FORMULA_0353 0 0 0.0 2550.0000 ECU_ADDRESS 0x3FCC6A /end MEASUREMENT
/begin MEASUREMENT pctrl_task "Taskueberwachung" UBYTE FORMULA_0003 0 0 0.0 255.0000 ECU_ADDRESS 0x3FCC6B /end MEASUREMENT
/begin MEASUREMENT pctrl_task_err "Fehler Taskueberwachung" UBYTE FORMULA_0003 0 0 0.0 255.0000 ECU_ADDRESS 0x3FCC6C /end MEASUREMENT
/begin MEASUREMENT pctrl_proz "Prozessueberwachung" UWORD FORMULA_0010 0 0 0.0 65535.0000 ECU_ADDRESS 0x3FCC6E /end MEASUREMENT
/begin MEASUREMENT pctrl_proz_err "Fehler Prozessueberwachung" UWORD FORMULA_0010 0 0 0.0 65535.0000 ECU_ADDRESS 0x3FCC70 /end MEASUREMENT
/* ------------------ Abschnitt erzeugt aus dqlt.dat ------------------ */
/begin CHARACTERISTIC K_TOGMAXUNPL "" VALUE 0x70878 TKW_VV_VV_UL 100.0 FORMULA_0000 0.0 4294967295.0000 /end CHARACTERISTIC
/begin CHARACTERISTIC K_TOG_CNTMAX " | EN: Max Versuche für Signal-Fehler Toens" VALUE 0x7087C TKW_VV_VV_UL 100.0 FORMULA_0000 0.0 4294967295.0000 /end CHARACTERISTIC
/begin CHARACTERISTIC K_OZDIAGNMOT "Mindestdrehzahl zur QLT-Diagnose | EN: Minimum engine speed for oil-quality diagnosis [Upm]" VALUE 0x70880 TKW_VV_VV_SW 100.0 FORMULA_0006 -32768.0000 32767.0000 /end CHARACTERISTIC
/begin CHARACTERISTIC K_OZDIAGNMOT2 "Max Drehzahl zur QLT-Diagnose | EN: Maximum engine speed for oil-quality diagnosis [Upm]" VALUE 0x70882 TKW_VV_VV_SW 100.0 FORMULA_0006 -32768.0000 32767.0000 /end CHARACTERISTIC
/begin CHARACTERISTIC K_OZTEMPQERR "Temperaturschwelle f�r den Permittivit�tsfehler | EN: Temperature threshold for permittivity fault [°C]" VALUE 0x70884 TKW_VV_VV_SW 100.0 FORMULA_0426 -3276.8000 3276.7000 /end CHARACTERISTIC
/begin CHARACTERISTIC K_DTOG_UBMIN "" VALUE 0x70886 TKW_VV_VV_UW 100.0 FORMULA_0427 0.0 6173.3970 FORMAT "%4.1" /end CHARACTERISTIC
/begin CHARACTERISTIC K_OZDELTOE "Verz�gerung f�r das Schreiben in Fehlerspeicher T�ns-Fehler | EN: Delay for writing oil-sensor fault to fault memory" VALUE 0x70888 TKW_VV_VV_UW 100.0 FORMULA_0010 0.0 65535.0000 /end CHARACTERISTIC
/begin CHARACTERISTIC K_OZDIAGSPG "Spannung, unterhalb der die Diagnose ausgeblendet wird | EN: Voltage below which the diagnosis is suppressed [V]" VALUE 0x7088A TKW_VV_VV_UW 100.0 FORMULA_0427 0.0 6173.3970 FORMAT "%4.1" /end CHARACTERISTIC
/begin CHARACTERISTIC K_OZERRD "Entprellzeit Sensor- und Kommunikationsfehler | EN: Debounce time, sensor and communication fault" VALUE 0x7088C TKW_VV_VV_UW 100.0 FORMULA_0010 0.0 65535.0000 /end CHARACTERISTIC
/begin CHARACTERISTIC K_OZHEAL "Entprellzeit Fehler-Healing | EN: Debounce time, fault healing" VALUE 0x7088E TKW_VV_VV_UW 100.0 FORMULA_0010 0.0 65535.0000 /end CHARACTERISTIC
/begin CHARACTERISTIC K_OZZTEMP "Max Zeit mit dem selben Temperaturwert (Plausibilisierung wegen ASIC-Pins Bruch) | EN: Maximum time with same temperature value (plausibility for ASIC pin break)" VALUE 0x70890 TKW_VV_VV_UW 100.0 FORMULA_0010 0.0 65535.0000 /end CHARACTERISTIC
/begin CHARACTERISTIC K_OZPLTEMP "Max Temperatursprung QLT (Plausibilisierung wegen ASIC-Pins Bruch) | EN: Max Temperatursprung QLT (Plausibilisierung wegen ASIC- Pins Bruch)" VALUE 0x70892 TKW_VV_VV_UB 100.0 FORMULA_0003 0.0 255.0000 /end CHARACTERISTIC
/begin CHARACTERISTIC K_OZPLZTEMP "Max unplausibel Spr�nge (Plausibilisierung wegen ASIC-Pins Bruch) | EN: Max unplausibel Sprünge (Plausibilisierung wegen ASIC- Pins Bruch)" VALUE 0x70893 TKW_VV_VV_UB 100.0 FORMULA_0003 0.0 255.0000 /end CHARACTERISTIC
/begin CHARACTERISTIC S_OZBSDKOORD "BSD Koordinator aktiv | EN: BSD Koordinator aktiv" VALUE 0x70894 TKW_VV_VV_UB 100.0 FORMULA_0003 0.0 255.0000 /end CHARACTERISTIC
/begin MEASUREMENT St_dqlt0.B_ozlerr "Messfehler �lniveau" UBYTE FORMULA_0418 0 0 0.0 255.0 ECU_ADDRESS 0x3FBF40 BIT_MASK 0x1 /end MEASUREMENT
/begin MEASUREMENT St_dqlt0.B_ozqerr "Messfehler �lzustand" UBYTE FORMULA_0419 0 0 0.0 255.0 ECU_ADDRESS 0x3FBF40 BIT_MASK 0x2 /end MEASUREMENT
/begin MEASUREMENT St_dqlt0.B_ozterr "Messfehler �ltemperatur" UBYTE FORMULA_0420 0 0 0.0 255.0 ECU_ADDRESS 0x3FBF40 BIT_MASK 0x4 /end MEASUREMENT
/begin MEASUREMENT St_dqlt0.B_td_ogerr "" UBYTE FORMULA_0421 0 0 0.0 255.0 ECU_ADDRESS 0x3FBF40 BIT_MASK 0x8 /end MEASUREMENT
/begin MEASUREMENT St_dqlt0.B_td_ogupl "" UBYTE FORMULA_0422 0 0 0.0 255.0 ECU_ADDRESS 0x3FBF40 BIT_MASK 0x10 /end MEASUREMENT
/begin MEASUREMENT St_dqlt0.B_ozkttoens "T�ns-Sensor verbaut" UBYTE FORMULA_0423 0 0 0.0 255.0 ECU_ADDRESS 0x3FBF40 BIT_MASK 0x20 /end MEASUREMENT
/begin MEASUREMENT St_dqlt0.B_ozerrbsd "BSD global Fehler" UBYTE FORMULA_0424 0 0 0.0 255.0 ECU_ADDRESS 0x3FBF40 BIT_MASK 0x40 /end MEASUREMENT
/begin MEASUREMENT St_dqlt0.B_ozdiagnmotok "Motordrehzahl ok f�r die Diagnose" UBYTE FORMULA_0425 0 0 0.0 255.0 ECU_ADDRESS 0x3FBF40 BIT_MASK 0x80 /end MEASUREMENT
/begin MEASUREMENT St_dqlt0 "Statuswort" UBYTE FORMULA_0003 0 0 0.0 255.0000 ECU_ADDRESS 0x3FBF40 /end MEASUREMENT
/begin MEASUREMENT St_dqlt1.B_ozerr "Sensorfehler in FS eingetragen" UBYTE FORMULA_0418 0 0 0.0 255.0 ECU_ADDRESS 0x3FBF41 BIT_MASK 0x1 /end MEASUREMENT
/begin MEASUREMENT St_dqlt1.B_ozfbsd2 "BSD Sensor Fehler von FI_BSD_4" UBYTE FORMULA_0419 0 0 0.0 255.0 ECU_ADDRESS 0x3FBF41 BIT_MASK 0x2 /end MEASUREMENT
/begin MEASUREMENT St_dqlt1.B_oztemppl "QLT Temperatur unplausibel" UBYTE FORMULA_0420 0 0 0.0 255.0 ECU_ADDRESS 0x3FBF41 BIT_MASK 0x4 /end MEASUREMENT
/begin MEASUREMENT St_dqlt1 "Statuswort" UBYTE FORMULA_0003 0 0 0.0 255.0000 ECU_ADDRESS 0x3FBF41 /end MEASUREMENT
/begin MEASUREMENT St_oz_o.B_oztemic "QLT-Temic verbaut" UBYTE FORMULA_0418 0 0 0.0 255.0 ECU_ADDRESS 0x3FBF42 BIT_MASK 0x1 /end MEASUREMENT
/begin MEASUREMENT St_oz_o.B_mol_sf "Sensorfehler in FS eingetragen f�r CC-Meldung" UBYTE FORMULA_0419 0 0 0.0 255.0 ECU_ADDRESS 0x3FBF42 BIT_MASK 0x2 /end MEASUREMENT
/begin MEASUREMENT St_oz_o "Statuswort" UBYTE FORMULA_0003 0 0 0.0 255.0000 ECU_ADDRESS 0x3FBF42 /end MEASUREMENT
/begin MEASUREMENT Oz_permerrz "" UBYTE FORMULA_0003 0 0 0.0 255.0000 ECU_ADDRESS 0x3F985E /end MEASUREMENT
/begin MEASUREMENT Oz_diagtoens "T�ns Diagnose Byte" UWORD FORMULA_0010 0 0 0.0 65535.0000 ECU_ADDRESS 0x3FAB7A /end MEASUREMENT
/begin MEASUREMENT Oz_tempplz "Anzahl der unplausibel Spr�nge QLT Temperatur" UBYTE FORMULA_0003 0 0 0.0 255.0000 ECU_ADDRESS 0x3FAB7C /end MEASUREMENT
/begin MEASUREMENT Oz_temprold "Alte QLT Temperatur f�r die Plausibilisierung" UBYTE FORMULA_0003 0 0 0.0 255.0000 ECU_ADDRESS 0x3FAB7D /end MEASUREMENT
/* ------------------ Abschnitt erzeugt aus ozbg.dat ------------------ */
/begin CHARACTERISTIC K_CW_OZ_2 " | EN: Codeword OZ - 2" VALUE 0x7516C TKW_VV_VV_UW 100.0 FORMULA_0010 0.0 65535.0000 /end CHARACTERISTIC
/begin CHARACTERISTIC K_OZZYKCBS "Zeitabstand f�rs zyklisch Senden der CBS-Nachricht" VALUE 0x7516E TKW_VV_VV_UB 100.0 FORMULA_0003 0.0 255.0000 /end CHARACTERISTIC
/begin MEASUREMENT St_ozbg0.B_bosmsgc "Bedingung f�r Absetzen einer BOS-Meldung" UBYTE FORMULA_0418 0 0 0.0 255.0 ECU_ADDRESS 0x3FCC10 BIT_MASK 0x1 /end MEASUREMENT
/begin MEASUREMENT St_ozbg0.B_mol_vb "Bedingung �lverbrauchswarnung" UBYTE FORMULA_0419 0 0 0.0 255.0 ECU_ADDRESS 0x3FCC10 BIT_MASK 0x2 /end MEASUREMENT
/begin MEASUREMENT St_ozbg0.B_mol_vl "Bedingung �lverlustwarnung" UBYTE FORMULA_0420 0 0 0.0 255.0 ECU_ADDRESS 0x3FCC10 BIT_MASK 0x4 /end MEASUREMENT
/begin MEASUREMENT St_ozbg0.B_oeltemp "Bedingung f�r CAN-Ausgabe der �ltemperatur" UBYTE FORMULA_0421 0 0 0.0 255.0 ECU_ADDRESS 0x3FCC10 BIT_MASK 0x8 /end MEASUREMENT
/begin MEASUREMENT St_ozbg0.B_oelverb "" UBYTE FORMULA_0422 0 0 0.0 255.0 ECU_ADDRESS 0x3FCC10 BIT_MASK 0x10 /end MEASUREMENT
/begin MEASUREMENT St_ozbg0.B_oelverl "" UBYTE FORMULA_0423 0 0 0.0 255.0 ECU_ADDRESS 0x3FCC10 BIT_MASK 0x20 /end MEASUREMENT
/begin MEASUREMENT St_ozbg0 "Statuswort" UBYTE FORMULA_0003 0 0 0.0 255.0000 ECU_ADDRESS 0x3FCC10 /end MEASUREMENT
/begin MEASUREMENT St_ozbg_nv0.B_ozkl15 "Merker f�r Einschalten Kl. 15" UBYTE FORMULA_0418 0 0 0.0 255.0 ECU_ADDRESS 0x3FA978 BIT_MASK 0x1 /end MEASUREMENT
/begin MEASUREMENT St_ozbg_nv0 "Statuswort" UBYTE FORMULA_0003 0 0 0.0 255.0000 ECU_ADDRESS 0x3FA978 /end MEASUREMENT
/begin MEASUREMENT Oz_tempakt "Ausgabe �ltemperatur f�r den Tester" SWORD FORMULA_0426 0 0 -3276.8000 3276.7000 ECU_ADDRESS 0x3FCC12 /end MEASUREMENT
/begin MEASUREMENT Toel "Ausgabewert Motor�ltemperatur f�r LoCAN" SWORD FORMULA_0426 0 0 -3276.8000 3276.7000 ECU_ADDRESS 0x3FCC14 /end MEASUREMENT
/begin MEASUREMENT Toel_oz "Ausgabe �ltemperatur" SWORD FORMULA_0426 0 0 -3276.8000 3276.7000 ECU_ADDRESS 0x3FCC16 /end MEASUREMENT
/begin MEASUREMENT Id_bosmg "Kennung f�r BOS-Meldung = �lservice-Info" UWORD FORMULA_0010 0 0 0.0 65535.0000 ECU_ADDRESS 0x3FCC18 /end MEASUREMENT
/begin MEASUREMENT Bosstate "Einheit der BOS-Info (km)" UBYTE FORMULA_0003 0 0 0.0 255.0000 ECU_ADDRESS 0x3FCC1A /end MEASUREMENT
/begin MEASUREMENT Id_bosmgt "Kennung f�r BOS-Meldung vom Tester" UBYTE FORMULA_0003 0 0 0.0 255.0000 ECU_ADDRESS 0x3FCC1B /end MEASUREMENT
/begin MEASUREMENT Id_bosmsg "Kennung f�r BOS-Meldung vom Kombi" UBYTE FORMULA_0003 0 0 0.0 255.0000 ECU_ADDRESS 0x3FCC1C /end MEASUREMENT
/begin MEASUREMENT Oz_reset "Zieltermin_Monat_BOS_R�ckstellung_2" UBYTE FORMULA_0003 0 0 0.0 255.0000 ECU_ADDRESS 0x3FCC1D /end MEASUREMENT
/begin MEASUREMENT Bosfxid2 "Zieltermin_Monat_BOS_R�ckstellung_2" SWORD FORMULA_0010 0 0 -32768.0000 32767.0000 ECU_ADDRESS 0x3FA97A /end MEASUREMENT
/begin MEASUREMENT Bosrlsm "Ausgabewert Restlaufstrecke Motor�l" SWORD FORMULA_0428 0 0 -327680.0000 327670.0000 ECU_ADDRESS 0x3FA97C /end MEASUREMENT
/begin MEASUREMENT Bosbtvfbk "Rest-Verf�gbarkeit Motor�l in Prozent" UBYTE FORMULA_0003 0 0 0.0 255.0000 ECU_ADDRESS 0x3FA97E /end MEASUREMENT
/begin MEASUREMENT Bosid2 "Zieltermin_Monat_BOS_R�ckstellung_2" UBYTE FORMULA_0003 0 0 0.0 255.0000 ECU_ADDRESS 0x3FA97F /end MEASUREMENT
/begin MEASUREMENT Bosjziel "Zieltermin_Monat_BOS_R�ckstellung_2" UBYTE FORMULA_0003 0 0 0.0 255.0000 ECU_ADDRESS 0x3FA980 /end MEASUREMENT
/begin MEASUREMENT Bosmziel "Zieltermin_Monat_BOS_Meldung_2" UBYTE FORMULA_0003 0 0 0.0 255.0000 ECU_ADDRESS 0x3FA981 /end MEASUREMENT
/begin MEASUREMENT Bosprog2 "Prognose_Intervall_Zeit_BOS_Meldung_2" UBYTE FORMULA_0003 0 0 0.0 255.0000 ECU_ADDRESS 0x3FA982 /end MEASUREMENT
/begin MEASUREMENT Bosres "Zieltermin_Monat_BOS_R�ckstellung_2" UBYTE FORMULA_0003 0 0 0.0 255.0000 ECU_ADDRESS 0x3FA983 /end MEASUREMENT
/begin MEASUREMENT Bosrw2 "Prognose_Intervall_Weg_BOS_Meldung_2" UBYTE FORMULA_0429 0 0 0.0 255000.0000 ECU_ADDRESS 0x3FA984 /end MEASUREMENT
/begin MEASUREMENT Zrbosmld "anzuzeigender Z�hler f�r durchgef�hrten �lservice" UBYTE FORMULA_0003 0 0 0.0 255.0000 ECU_ADDRESS 0x3FA985 /end MEASUREMENT
/* ------------------ Abschnitt erzeugt aus ozgg.dat ------------------ */
/begin CHARACTERISTIC K_OZKMUPL "F�r die Kontrolle der Km_st-Plausibilit�t | EN: Für die Kontrolle der Km_st-Plausibilität" VALUE 0x75170 TKW_VV_VV_UW 100.0 FORMULA_0432 0.0 655350.0000 /end CHARACTERISTIC
/begin CHARACTERISTIC K_CW_OZ_PERM "Codeword Permittivit�t | EN: Codeword Permittivität" VALUE 0x75172 TKW_VV_VV_UB 100.0 FORMULA_0003 0.0 255.0000 /end CHARACTERISTIC
/begin CHARACTERISTIC K_OZBZKMSTK1 "Bezugsintervall" VALUE 0x75173 TKW_VV_VV_UB 100.0 FORMULA_0429 0.0 255000.0000 /end CHARACTERISTIC
/begin CHARACTERISTIC K_OZPERGRADMAX "Obere Grenze Permittivit�tsgradient (bitte K_OZPERGRADKD ber�cksichtigen) | EN: Obere Grenze Permittivitï¿½tsgradient (bitte K_OZPERGRADKD berï¿½cksichtigen)" VALUE 0x75174 TKW_VV_VV_SW 100.0 FORMULA_0010 -32768.0000 32767.0000 /end CHARACTERISTIC
/begin CHARACTERISTIC K_OZPERGRADMIN "Untere Grenze Permittivit�tsgradient (bitte K_OZPERGRADKD ber�cksichtigen) | EN: Untere Grenze Permittivitï¿½tsgradient (bitte K_OZPERGRADKD berï¿½cksichtigen)" VALUE 0x75176 TKW_VV_VV_SW 100.0 FORMULA_0010 -32768.0000 32767.0000 /end CHARACTERISTIC
/begin CHARACTERISTIC K_OZPERMWDMAX "Max positives Delta zwischen Mittelwerten Permittivit�t | EN: Max positives Delta zwischen Mittelwerten Permittivität" VALUE 0x75178 TKW_VV_VV_SW 100.0 FORMULA_0010 -1024.0000 1024.0000 /end CHARACTERISTIC
/begin CHARACTERISTIC K_OZPERMWDMIN "Max negatives Delta zwischen Mittelwerten Permittivit�t | EN: Max negatives Delta zwischen Mittelwerten Permittivität" VALUE 0x7517A TKW_VV_VV_SW 100.0 FORMULA_0010 -1024.0000 1024.0000 /end CHARACTERISTIC
/begin CHARACTERISTIC K_OZPERINI "Startwert f�r Oz_perref | EN: Startwert für Oz_perref" VALUE 0x7517C TKW_VV_VV_UW 100.0 FORMULA_0010 0.0 1024.0000 /end CHARACTERISTIC
/begin CHARACTERISTIC K_OZPERKFIL "Zeitkonstante Permittivit�ts-LOW-Pass-Filter | EN: Zeitkonstante Permittivitäts-LOW-Pass-Filter" VALUE 0x7517E TKW_VV_VV_UW 100.0 FORMULA_0433 0.0 99.9984 FORMAT "%5.2" /end CHARACTERISTIC
/begin CHARACTERISTIC K_OZPERMRMIN "Grenze f�r Niveauberechnung aus Permittivit�t | EN: Grenze für Niveauberechnung aus Permittivität" VALUE 0x75180 TKW_VV_VV_UW 100.0 FORMULA_0010 0.0 65535.0000 /end CHARACTERISTIC
/begin CHARACTERISTIC K_OZPRREFMAX "Maximum f�r Referenzpermittivit�t | EN: Maximum für Referenzpermittivität" VALUE 0x75182 TKW_VV_VV_UW 100.0 FORMULA_0010 0.0 1024.0000 /end CHARACTERISTIC
/begin CHARACTERISTIC K_OZPRREFMIN "Minimum f�r Referenzpermittivit�t | EN: Minimum für Referenzpermittivität" VALUE 0x75184 TKW_VV_VV_UW 100.0 FORMULA_0010 0.0 1024.0000 /end CHARACTERISTIC
/begin CHARACTERISTIC K_TRTYP "Faktor f�r die Berechnung �l-Temperatur T�ns | EN: Faktor für die Berechnung Öl-Temperatur Töns" VALUE 0x75186 TKW_VV_VV_UW 100.0 FORMULA_0021 0.0 655.3500 FORMAT "%5.2" /end CHARACTERISTIC
/begin CHARACTERISTIC K_OZNIVKL "Konvertierungsfaktor f�r den Niveau-Wert QLT | EN: Konvertierungsfaktor für den Niveau-Wert QLT" VALUE 0x75188 TKW_VV_VV_UB 100.0 FORMULA_0431 0.0 74.7070 /end CHARACTERISTIC
/begin CHARACTERISTIC K_OZPERCMW "Anzahl Messungen f�r den Mittelwert Permittivit�t | EN: Anzahl Messungen für den Mit-telwert Permittivität" VALUE 0x75189 TKW_VV_VV_UB 100.0 FORMULA_0003 1.0000 255.0000 /end CHARACTERISTIC
/begin CHARACTERISTIC K_OZPERGRADKD "Delta-Verst�rkungsfaktor f�r die Berechnung Permittivit�tsgradient | EN: berücksichti- gen)" VALUE 0x7518A TKW_VV_VV_UB 100.0 FORMULA_0003 0.0 255.0000 /end CHARACTERISTIC
/begin CHARACTERISTIC K_OZPERGRADTN "Zeitkonstante f�r den Permittivit�tsgradientenverlauf | EN: Zeitkonstante für den Permittivitätsgradientenverlauf" VALUE 0x7518B TKW_VV_VV_UB 100.0 FORMULA_0434 0.0 0.9960 /end CHARACTERISTIC
/begin CHARACTERISTIC K_OZSTZYK "Max Permittivit�tsfahler f�r die Niveau-Freigabe  | EN: Max Permittivitätsfahler für die Niveau-Freigabe" VALUE 0x7518C TKW_VV_VV_UB 100.0 FORMULA_0003 0.0 255.0000 /end CHARACTERISTIC
/begin CHARACTERISTIC K_OZVERZNIVERS "Verz�gerung Umschaltung auf Niveau-Ersatzwert | EN: Verzögerung Umschaltung auf Niveau-Ersatzwert" VALUE 0x7518D TKW_VV_VV_UB 100.0 FORMULA_0435 0.0 255.0000 /end CHARACTERISTIC
/begin CHARACTERISTIC K_TOGVERZOEG "F�r das �berspringen der ersten Messungen T�ns" VALUE 0x7518E TKW_VV_VV_UB 100.0 FORMULA_0003 0.0 255.0000 /end CHARACTERISTIC
/begin CHARACTERISTIC KL_OZPERMKL "Skalierungskennlinie Permittivit�t | EN: Scaling curve, permittivity (oil quality)" CURVE 0x75190 TKL_UW_VV_UW 100.0 FORMULA_0430 0.0 5.9999 /begin AXIS_DESCR STD_AXIS Oz_permt FORMULA_0010 2 0.0 65535.0000 /end AXIS_DESCR FORMAT "%4.1" /end CHARACTERISTIC
/begin CHARACTERISTIC KL_TVTOEL "F�r die �ltemperatur-Berechnung T�ns" CURVE 0x7519A TKL_UW_VV_SW 100.0 FORMULA_0426 -3276.8000 3276.7000
 /begin AXIS_DESCR STD_AXIS NO_INPUT_QUANTITY FORMULA_0073 8 0.0 6553.5000 FORMAT "%4.1" /end AXIS_DESCR
/end CHARACTERISTIC
/begin CHARACTERISTIC KL_PERREFTKOR "Temperaturkompensation der Referenzpermittivit�t f�r den Niveauersatzwert" CURVE 0x751BC TKL_SW_VV_SW 100.0 FORMULA_0010 -1024.0000 1024.0000
 /begin AXIS_DESCR STD_AXIS NO_INPUT_QUANTITY FORMULA_0426 6 -3276.8000 3276.7000 /end AXIS_DESCR
/end CHARACTERISTIC
/begin CHARACTERISTIC KL_OZTEMPKL "F�r die �ltemperatur-Berechnung QLT | EN: Für die Öltemperatur-Berechnung QLT" CURVE 0x751D6 TKL_UW_VV_SW 100.0 FORMULA_0426 -3276.8000 3276.7000 /begin AXIS_DESCR STD_AXIS Oz_tempt FORMULA_0010 6 0.0 65535.0000 /end AXIS_DESCR /end CHARACTERISTIC
/begin CHARACTERISTIC KL_TKTOENIV "Umsetzung Tk -> Oelnivau | EN: Conversion to oil level" CURVE 0x751F0 TKL_UW_VV_UW 100.0 FORMULA_0073 0.0 75.0000
 /begin AXIS_DESCR STD_AXIS Td_og_tk FORMULA_0073 8 0.0 6553.5000 FORMAT "%4.1" /end AXIS_DESCR
 FORMAT "%4.1" /end CHARACTERISTIC
/begin MEASUREMENT St_ozgg0.B_oelwech "Bedingung �lwechsel erfolgt" UBYTE FORMULA_0418 0 0 0.0 255.0 ECU_ADDRESS 0x3FCC1E BIT_MASK 0x1 /end MEASUREMENT
/begin MEASUREMENT St_ozgg0.B_ozniv "Bedingung Niveausignal in Ordnung" UBYTE FORMULA_0419 0 0 0.0 255.0 ECU_ADDRESS 0x3FCC1E BIT_MASK 0x2 /end MEASUREMENT
/begin MEASUREMENT St_ozgg0.B_ozperm "Bedingung Permittivit�tssignal in Ordnung" UBYTE FORMULA_0420 0 0 0.0 255.0 ECU_ADDRESS 0x3FCC1E BIT_MASK 0x4 /end MEASUREMENT
/begin MEASUREMENT St_ozgg0.B_oztemp "Bedingung Temperatursignal in Ordnung" UBYTE FORMULA_0421 0 0 0.0 255.0 ECU_ADDRESS 0x3FCC1E BIT_MASK 0x8 /end MEASUREMENT
/begin MEASUREMENT St_ozgg0.B_ozvfchg "Bedingung f�r ge�nderte Verf�gbarkeit" UBYTE FORMULA_0422 0 0 0.0 255.0 ECU_ADDRESS 0x3FCC1E BIT_MASK 0x10 /end MEASUREMENT
/begin MEASUREMENT St_ozgg0.B_svcntchg "Bedingung f�r �ber Tester ge�nderten Servicez�hler" UBYTE FORMULA_0423 0 0 0.0 255.0 ECU_ADDRESS 0x3FCC1E BIT_MASK 0x20 /end MEASUREMENT
/begin MEASUREMENT St_ozgg0.B_ozvfchgt "�nderung der Verf�gbarkeit vom Tester" UBYTE FORMULA_0424 0 0 0.0 255.0 ECU_ADDRESS 0x3FCC1E BIT_MASK 0x40 /end MEASUREMENT
/begin MEASUREMENT St_ozgg0.B_ozzeitdmew "Neuer Zieltermin zu �bernehmen" UBYTE FORMULA_0425 0 0 0.0 255.0 ECU_ADDRESS 0x3FCC1E BIT_MASK 0x80 /end MEASUREMENT
/begin MEASUREMENT St_ozgg0 "Statuswort" UBYTE FORMULA_0003 0 0 0.0 255.0000 ECU_ADDRESS 0x3FCC1E /end MEASUREMENT
/begin MEASUREMENT St_ozgg1.B_ozvfchgc "Bedingung f�r ge�nderte Verf�gbarkeit vom Kombi �ber Restweg" UBYTE FORMULA_0418 0 0 0.0 255.0 ECU_ADDRESS 0x3FCC1F BIT_MASK 0x1 /end MEASUREMENT
/begin MEASUREMENT St_ozgg1.B_ozvfchgcc "Bedingung f�r ge�nderte Verf�gbarkeit vom Kombi" UBYTE FORMULA_0419 0 0 0.0 255.0 ECU_ADDRESS 0x3FCC1F BIT_MASK 0x2 /end MEASUREMENT
/begin MEASUREMENT St_ozgg1.B_ozmanip "CBS-Daten manipuliert" UBYTE FORMULA_0420 0 0 0.0 255.0 ECU_ADDRESS 0x3FCC1F BIT_MASK 0x4 /end MEASUREMENT
/begin MEASUREMENT St_ozgg1.B_ozresett "Reset vom Tester" UBYTE FORMULA_0421 0 0 0.0 255.0 ECU_ADDRESS 0x3FCC1F BIT_MASK 0x8 /end MEASUREMENT
/begin MEASUREMENT St_ozgg1.B_ozresetcan "Reset BOS vom Kombi (CAN)" UBYTE FORMULA_0422 0 0 0.0 255.0 ECU_ADDRESS 0x3FCC1F BIT_MASK 0x10 /end MEASUREMENT
/begin MEASUREMENT St_ozgg1.B_ozreset "BOS Reset (�lwechsel)" UBYTE FORMULA_0423 0 0 0.0 255.0 ECU_ADDRESS 0x3FCC1F BIT_MASK 0x20 /end MEASUREMENT
/begin MEASUREMENT St_ozgg1.B_oznivtoe "Bedingung Niveausignal T�ns in Ordnung" UBYTE FORMULA_0424 0 0 0.0 255.0 ECU_ADDRESS 0x3FCC1F BIT_MASK 0x40 /end MEASUREMENT
/begin MEASUREMENT St_ozgg1.B_oznivqlt "Bedingung Niveausignal QLT in Ordnung" UBYTE FORMULA_0425 0 0 0.0 255.0 ECU_ADDRESS 0x3FCC1F BIT_MASK 0x80 /end MEASUREMENT
/begin MEASUREMENT St_ozgg1 "Statuswort" UBYTE FORMULA_0003 0 0 0.0 255.0000 ECU_ADDRESS 0x3FCC1F /end MEASUREMENT
/begin MEASUREMENT St_ozgg2.B_oztempqlt "Bedingung Temperatursignal QLT in Ordnung" UBYTE FORMULA_0418 0 0 0.0 255.0 ECU_ADDRESS 0x3FCC20 BIT_MASK 0x1 /end MEASUREMENT
/begin MEASUREMENT St_ozgg2.B_oztemptoe "Bedingung Temperatursignal T�ns in Ordnung" UBYTE FORMULA_0419 0 0 0.0 255.0 ECU_ADDRESS 0x3FCC20 BIT_MASK 0x2 /end MEASUREMENT
/begin MEASUREMENT St_ozgg2.B_oztoeok "Bedingung kein Fehler T�ns" UBYTE FORMULA_0420 0 0 0.0 255.0 ECU_ADDRESS 0x3FCC20 BIT_MASK 0x4 /end MEASUREMENT
/begin MEASUREMENT St_ozgg2.B_oznivrers "Flag f�r Ersatzwertberechnung Niveausignal" UBYTE FORMULA_0421 0 0 0.0 255.0 ECU_ADDRESS 0x3FCC20 BIT_MASK 0x8 /end MEASUREMENT
/begin MEASUREMENT St_ozgg2.B_ozpergradok "Permittivit�tsgradient OK" UBYTE FORMULA_0422 0 0 0.0 255.0 ECU_ADDRESS 0x3FCC20 BIT_MASK 0x10 /end MEASUREMENT
/begin MEASUREMENT St_ozgg2.B_ozpermwok "Mittelwert Permittivit�t OK" UBYTE FORMULA_0423 0 0 0.0 255.0 ECU_ADDRESS 0x3FCC20 BIT_MASK 0x20 /end MEASUREMENT
/begin MEASUREMENT St_ozgg2.B_ozperrangeok "Permittivit�t innerhalb statischem G�ltigkeitsbereich" UBYTE FORMULA_0424 0 0 0.0 255.0 ECU_ADDRESS 0x3FCC20 BIT_MASK 0x40 /end MEASUREMENT
/begin MEASUREMENT St_ozgg2.B_ozperrgok "Range und Gradient der Permittivit�t sind OK" UBYTE FORMULA_0425 0 0 0.0 255.0 ECU_ADDRESS 0x3FCC20 BIT_MASK 0x80 /end MEASUREMENT
/begin MEASUREMENT St_ozgg2 "Statuswort" UBYTE FORMULA_0003 0 0 0.0 255.0000 ECU_ADDRESS 0x3FCC20 /end MEASUREMENT
/begin MEASUREMENT St_ozgg3.B_ozperrupl "Permittivit�twert ist unplausibel" UBYTE FORMULA_0418 0 0 0.0 255.0 ECU_ADDRESS 0x3FCC21 BIT_MASK 0x1 /end MEASUREMENT
/begin MEASUREMENT St_ozgg3.B_ozpersensok "Permittivit�tsmessung OK" UBYTE FORMULA_0419 0 0 0.0 255.0 ECU_ADDRESS 0x3FCC21 BIT_MASK 0x2 /end MEASUREMENT
/begin MEASUREMENT St_ozgg3.B_ozpermgrini "Gradientenfunktion bereits initialisiert" UBYTE FORMULA_0420 0 0 0.0 255.0 ECU_ADDRESS 0x3FCC21 BIT_MASK 0x4 /end MEASUREMENT
/begin MEASUREMENT St_ozgg3 "Statuswort" UBYTE FORMULA_0003 0 0 0.0 255.0000 ECU_ADDRESS 0x3FCC21 /end MEASUREMENT
/begin MEASUREMENT St_ozgg_nv0.B_dmeini "Bedingung f�r neue noch nicht initialisierte DME" UBYTE FORMULA_0418 0 0 0.0 255.0 ECU_ADDRESS 0x3FA986 BIT_MASK 0x1 /end MEASUREMENT
/begin MEASUREMENT St_ozgg_nv0.B_dmewech "Bedingung f�r getauschte DME zur Aktualisierung der BOS-Werte" UBYTE FORMULA_0419 0 0 0.0 255.0 ECU_ADDRESS 0x3FA986 BIT_MASK 0x2 /end MEASUREMENT
/begin MEASUREMENT St_ozgg_nv0.B_factoryres "CBS Factory-Reset angefordert" UBYTE FORMULA_0420 0 0 0.0 255.0 ECU_ADDRESS 0x3FA986 BIT_MASK 0x4 /end MEASUREMENT
/begin MEASUREMENT St_ozgg_nv0 "Statuswort" UBYTE FORMULA_0003 0 0 0.0 255.0000 ECU_ADDRESS 0x3FA986 /end MEASUREMENT
/begin MEASUREMENT Oz_rwrueck "Neuer CBS Restweg zu �bernehmen" SWORD FORMULA_0428 0 0 -327680.0000 327670.0000 ECU_ADDRESS 0x3FCC22 /end MEASUREMENT
/begin MEASUREMENT Oz_temp "�ltemperatur ungefiltert" SWORD FORMULA_0426 0 0 -3276.8000 3276.7000 ECU_ADDRESS 0x3FCC24 /end MEASUREMENT
/begin MEASUREMENT Oz_perm "Permittivit�t ungefiltert" UWORD FORMULA_0430 0 0 0.0 5.9999 ECU_ADDRESS 0x3FCC26 /end MEASUREMENT
/begin MEASUREMENT Oz_permakt "Permittivit�t f�r den Tester" UWORD FORMULA_0430 0 0 0.0 5.9999 ECU_ADDRESS 0x3FCC28 /end MEASUREMENT
/begin MEASUREMENT Id_bosrtak "Acknowledge f�r den Empfang der CBS-Anforderungen" UBYTE FORMULA_0003 0 0 0.0 255.0000 ECU_ADDRESS 0x3FCC2A /end MEASUREMENT
/begin MEASUREMENT Oz_niv "�lniveau ungefiltert" UBYTE FORMULA_0431 0 0 0.0 74.7070 ECU_ADDRESS 0x3FCC2B /end MEASUREMENT
/begin MEASUREMENT Oz_svcntchg "ge�nderter Servicez�hler" UBYTE FORMULA_0003 0 0 0.0 255.0000 ECU_ADDRESS 0x3FCC2C /end MEASUREMENT
/begin MEASUREMENT Oz_zjbdmew "Neues Ziel-Jahr zu �bernehmen" UBYTE FORMULA_0003 0 0 0.0 255.0000 ECU_ADDRESS 0x3FCC2D /end MEASUREMENT
/begin MEASUREMENT Oz_zmbdmew "Neuer Ziel-Monat zu �bernehmen" UBYTE FORMULA_0003 0 0 0.0 255.0000 ECU_ADDRESS 0x3FCC2E /end MEASUREMENT
/begin MEASUREMENT Oz_kmlow "Kilometerstand letzter �lwechsel" SWORD FORMULA_0428 0 0 -327680.0000 327670.0000 ECU_ADDRESS 0x3FA988 /end MEASUREMENT
/begin MEASUREMENT Oz_oelkm "�lkilometer" UWORD FORMULA_0432 0 0 0.0 655350.0000 ECU_ADDRESS 0x3FA98A /end MEASUREMENT
/begin MEASUREMENT Oz_perref "Ersatzpermittivit�t" UWORD FORMULA_0010 0 0 0.0 1024.0000 ECU_ADDRESS 0x3FA98C /end MEASUREMENT
/begin MEASUREMENT Oz_vfbdmew "Verf�gbarkeit aus Kombi bei DME-Wechsel" SBYTE FORMULA_0003 0 0 -128.0000 127.0000 ECU_ADDRESS 0x3FA98E /end MEASUREMENT
/begin MEASUREMENT Oz_manipt "Manipulation" UBYTE FORMULA_0003 0 0 0.0 255.0000 ECU_ADDRESS 0x3FA98F /end MEASUREMENT
/begin MEASUREMENT Oz_rwprueck "Neue CBS Prognose zu �bernehmen" UBYTE FORMULA_0429 0 0 0.0 255000.0000 ECU_ADDRESS 0x3FA990 /end MEASUREMENT
/begin MEASUREMENT Oz_pergrad "Permittivit�tsgradient (verst�rkt)" SWORD FORMULA_0010 0 0 -32768.0000 32767.0000 ECU_ADDRESS 0x3FB010 /end MEASUREMENT
/begin MEASUREMENT Oz_perreftkor "Temperaturkorrektur f�r die Referenzpermittivit�t" SWORD FORMULA_0010 0 0 -1024.0000 1024.0000 ECU_ADDRESS 0x3FB012 /end MEASUREMENT
/begin MEASUREMENT Oz_tempqlt "�ltemperatur qlt ungefiltert" SWORD FORMULA_0426 0 0 -3276.8000 3276.7000 ECU_ADDRESS 0x3FB014 /end MEASUREMENT
/begin MEASUREMENT Oz_temptoe "�ltemperatur T�ns ungefiltert" SWORD FORMULA_0426 0 0 -3276.8000 3276.7000 ECU_ADDRESS 0x3FB016 /end MEASUREMENT
/begin MEASUREMENT Oz_permfil "Gefilterte Permittivit�t (Rohwert)" UWORD FORMULA_0010 0 0 0.0 1024.0000 ECU_ADDRESS 0x3FB018 /end MEASUREMENT
/begin MEASUREMENT Oz_permt "begrenzter Permittivit�ts-Rohwert" UWORD FORMULA_0010 0 0 0.0 1024.0000 ECU_ADDRESS 0x3FB01A /end MEASUREMENT
/begin MEASUREMENT Oz_permw "Mittelwert Permittivit�ts-Rohwert" UWORD FORMULA_0010 0 0 0.0 1024.0000 ECU_ADDRESS 0x3FB01C /end MEASUREMENT
/begin MEASUREMENT Oz_permwalt "Alter Mittelwert Roh-Permittivit�t" UWORD FORMULA_0010 0 0 0.0 1024.0000 ECU_ADDRESS 0x3FB01E /end MEASUREMENT
/begin MEASUREMENT Oz_tempt "begrenzter Temperatur-Rohwert" UWORD FORMULA_0010 0 0 0.0 65535.0000 ECU_ADDRESS 0x3FB020 /end MEASUREMENT
/begin MEASUREMENT Oz_anztoe "Anzahl Werte von T�ns in der Sekunde" UBYTE FORMULA_0003 0 0 0.0 255.0000 ECU_ADDRESS 0x3FB022 /end MEASUREMENT
/begin MEASUREMENT Oz_nivqlt "�lniveau QLT ungefiltert" UBYTE FORMULA_0431 0 0 0.0 74.7070 ECU_ADDRESS 0x3FB023 /end MEASUREMENT
/begin MEASUREMENT Oz_nivrers "Ersatzniveau-Rohwert" UBYTE FORMULA_0003 0 0 0.0 255.0000 ECU_ADDRESS 0x3FB024 /end MEASUREMENT
/begin MEASUREMENT Oz_nivt "begrenzter Niveau-Rohwert" UBYTE FORMULA_0003 0 0 0.0 255.0000 ECU_ADDRESS 0x3FB025 /end MEASUREMENT
/begin MEASUREMENT Oz_nivtoe "�lniveau T�ns ungefiltert" UBYTE FORMULA_0431 0 0 0.0 74.7070 ECU_ADDRESS 0x3FB026 /end MEASUREMENT
/begin MEASUREMENT Oz_pertref "Temperatur f�r die Referenzpermittivit�t" SWORD FORMULA_0426 0 0 -3276.8000 3276.7000 ECU_ADDRESS 0x3FA992 /end MEASUREMENT
/* ------------------ Abschnitt erzeugt aus oznivdl.dat ------------------ */
/begin CHARACTERISTIC K_CW_OZ "" VALUE 0x75212 TKW_VV_VV_UW 100.0 FORMULA_0010 0.0 65535.0000 /end CHARACTERISTIC
/begin CHARACTERISTIC K_OZVERLORI "Schwelle f�r Orientierungswert �lniveau (Verlustwarnung) | EN: Schwelle für Orientierungswert Ölniveau (Verlustwarnung)" VALUE 0x75214 TKW_VV_VV_UB 100.0 FORMULA_0431 0.0 74.7070 /end CHARACTERISTIC
/begin CHARACTERISTIC KL_OZBEFKL "Bef�llkennlinie | EN: Fill curve (oil)" CURVE 0x75215 TKL_UB_VV_UB 100.0 FORMULA_0436 0.0 25.5000 /begin AXIS_DESCR STD_AXIS Oz_nivkrzt FORMULA_0431 6 0.0 74.7070 /end AXIS_DESCR /end CHARACTERISTIC
/begin CHARACTERISTIC K_OZMAXSLOPE "Maximale erlaubte Steigung | EN: Maximale erlaubte Steigung" VALUE 0x75224 TKW_VV_VV_SW 100.0 FORMULA_0440 -64.0000 63.9980 FORMAT "%5.2" /end CHARACTERISTIC
/begin CHARACTERISTIC K_OZMINSLOPE "Kleinste erlaubte Steigung (<0) | EN: Kleinste erlaubte Steigung (<0)" VALUE 0x75226 TKW_VV_VV_SW 100.0 FORMULA_0440 -64.0000 63.9980 FORMAT "%5.2" /end CHARACTERISTIC
/begin CHARACTERISTIC K_OZNMOTMAX "obere Drehzahlgrenze f�r drehzahlkorrigierten Niveaumittelwert | EN: obere Drehzahlgrenze für dreh-zahlkorrigierten Niveaumittelwert" VALUE 0x75228 TKW_VV_VV_SW 100.0 FORMULA_0006 -32768.0000 32767.0000 /end CHARACTERISTIC
/begin CHARACTERISTIC K_OZNMOTMIN "untere Drehzahlgrenze f�r drehzahlkorrigierten Niveaumittelwert | EN: untere Drehzahlgrenze für dreh- zahlkorrigierten Niveaumittelwert" VALUE 0x7522A TKW_VV_VV_SW 100.0 FORMULA_0006 -32768.0000 32767.0000 /end CHARACTERISTIC
/begin CHARACTERISTIC K_OZTEMPBW "Temperaturschwelle �ltemperatur Motor betriebswarm | EN: Temperaturschwelle Öltempera-tur Motor betriebswarm" VALUE 0x7522C TKW_VV_VV_SW 100.0 FORMULA_0426 -3276.8000 3276.7000 /end CHARACTERISTIC
/begin CHARACTERISTIC K_OZTORMAX "Temperaturschwelle f�r Orientierungsmessung" VALUE 0x7522E TKW_VV_VV_SW 100.0 FORMULA_0426 -3276.8000 3276.7000 /end CHARACTERISTIC
/begin CHARACTERISTIC K_OZTORMIN "Mindest Temperatur f�r OrientierungMw QLT | EN: Mindest Temperatur für OrientierungMw QLT" VALUE 0x75230 TKW_VV_VV_SW 100.0 FORMULA_0443 -327.6800 327.6700 FORMAT "%5.2" /end CHARACTERISTIC
/begin CHARACTERISTIC K_OZUEFNST "Maximale negative Steigung f�r die �berf�llungserkenung" VALUE 0x75232 TKW_VV_VV_SW 100.0 FORMULA_0440 -64.0000 63.9980 FORMAT "%5.2" /end CHARACTERISTIC
/begin CHARACTERISTIC K_OZUEFODZ "Obere Drehzahlgrenze f�r die �berf�llungserkennung" VALUE 0x75234 TKW_VV_VV_SW 100.0 FORMULA_0006 -32768.0000 32767.0000 /end CHARACTERISTIC
/begin CHARACTERISTIC K_OZUEFPST "Maximale positive Steigung f�r die �berf�llungserkenung" VALUE 0x75236 TKW_VV_VV_SW 100.0 FORMULA_0440 -64.0000 63.9980 FORMAT "%5.2" /end CHARACTERISTIC
/begin CHARACTERISTIC K_OZUEFTEM "Mindest�ltemperatur f�r die �berf�llungserkennung" VALUE 0x75238 TKW_VV_VV_SW 100.0 FORMULA_0426 -3276.8000 3276.7000 /end CHARACTERISTIC
/begin CHARACTERISTIC K_OZUEFUDZ "Untere Drehzahlgrenze f�r die �berf�llungserkennung" VALUE 0x7523A TKW_VV_VV_SW 100.0 FORMULA_0006 -32768.0000 32767.0000 /end CHARACTERISTIC
/begin CHARACTERISTIC K_OZVORMV "Korrektur von Vormw f�r Peilstab | EN: Korrektur von Vormw für Peilstab" VALUE 0x7523C TKW_VV_VV_SW 100.0 FORMULA_0444 -32.0000 31.9990 FORMAT "%7.4" /end CHARACTERISTIC
/begin CHARACTERISTIC K_OZABSTELL "Mindestwert f�r die �bernahme der Abstellzeit | EN: Mindestwert für die Übernahme der Abstellzeit" VALUE 0x7523E TKW_VV_VV_UW 100.0 FORMULA_0438 0.0 65535.0000 FORMAT "%5.2" /end CHARACTERISTIC
/begin CHARACTERISTIC K_OZALTANZABZ "Abstellzeit f�r die Ausgabe der letzten Anzeige nach dem �lcheck | EN: Abstellzeit für die Ausgabe der letzten Anzeige nach dem Ölcheck" VALUE 0x75240 TKW_VV_VV_UW 100.0 FORMULA_0438 0.0 65535.0000 FORMAT "%5.2" /end CHARACTERISTIC
/begin CHARACTERISTIC K_OZLUFTMAX "Plausibel max luftsprung | EN: hPa 0.0p 3 10*x/256 Plausibel max luftsprung" VALUE 0x75242 TKW_VV_VV_UW 100.0 FORMULA_0445 0.0 2559.9609 FORMAT "%6.3" /end CHARACTERISTIC
/begin CHARACTERISTIC K_OZMWL "Anzahl der Messwerte f�r Langzeit-Mittelwert Niveau | EN: Anzahl der Messwerte für Lang-zeit-Mittelwert Niveau" VALUE 0x75244 TKW_VV_VV_UW 100.0 FORMULA_0010 0.0 65535.0000 /end CHARACTERISTIC
/begin CHARACTERISTIC K_OZMWOR "Anzahl der Messwerte f�r Orientierungsmessung | EN: Anzahl der Messwerte für Orien-tierungsmessung" VALUE 0x75246 TKW_VV_VV_UW 100.0 FORMULA_0010 0.0 65535.0000 /end CHARACTERISTIC
/begin CHARACTERISTIC K_OZMWV "Anzahl der Messwerte f�r vorgezogenen Mittelwert Niveau | EN: Anzahl der Messwerte für vorge-zogenen Mittelwert Niveau" VALUE 0x75248 TKW_VV_VV_UW 100.0 FORMULA_0010 0.0 65535.0000 /end CHARACTERISTIC
/begin CHARACTERISTIC K_OZOELCABZ "Minimale Abstellzeit f�r den �lCheck | EN: Minimale Abstellzeit für den ÖlCheck" VALUE 0x7524A TKW_VV_VV_UW 100.0 FORMULA_0438 0.0 65535.0000 FORMAT "%5.2" /end CHARACTERISTIC
/begin CHARACTERISTIC K_OZOELVERB "�lverbrauch | EN: Ölverbrauch" VALUE 0x7524C TKW_VV_VV_UW 100.0 FORMULA_0010 0.0 65535.0000 /end CHARACTERISTIC
/begin CHARACTERISTIC K_OZSTARTABZ "Mindestlaufzeit f�r die �bernahme der Abstellzeit | EN: Mindestlaufzeit für die Übernah-me der Abstellzeit" VALUE 0x7524E TKW_VV_VV_UW 100.0 FORMULA_0021 0.0 655.3500 FORMAT "%5.2" /end CHARACTERISTIC
/begin CHARACTERISTIC K_OZSTMINW "Minimale Strecke f�r die Steigungserkennung | EN: Minimale Strecke für die Stei-gungserkennung" VALUE 0x75250 TKW_VV_VV_UW 100.0 FORMULA_0441 0.0 9.9998 FORMAT "%5.2" /end CHARACTERISTIC
/begin CHARACTERISTIC K_OZVERBDKM "Delta km f�r die �lverbrauch-Berechnung" VALUE 0x75252 TKW_VV_VV_UW 100.0 FORMULA_0432 0.0 655350.0000 /end CHARACTERISTIC
/begin CHARACTERISTIC K_OZLBESCHN "Negative L�ngsbeschleunigung Ausblendung-Schwelle  | EN: Negative Längsbeschleunigung Ausblendung-Schwelle" VALUE 0x75254 TKW_VV_VV_SB 100.0 FORMULA_0446 -32.0000 31.7500 /end CHARACTERISTIC
/begin CHARACTERISTIC K_OZLBESCHORI "L�ngsbeschleunigung Ausblendung-Schwelle beim OriMw | EN: Längsbeschleunigung Ausblen-dung-Schwelle beim OriMw" VALUE 0x75255 TKW_VV_VV_SB 100.0 FORMULA_0446 -32.0000 31.7500 /end CHARACTERISTIC
/begin CHARACTERISTIC K_OZLBESCHP "Positive L�ngsbeschleunigung Ausblendung-Schwelle  | EN: Positive Längsbeschleunigung Ausblendung-Schwelle" VALUE 0x75256 TKW_VV_VV_SB 100.0 FORMULA_0446 -32.0000 31.7500 /end CHARACTERISTIC
/begin CHARACTERISTIC K_OZLBESCHST "L�ngsbeschleunigung Ausblendung-Schwelle im Stand | EN: Längsbeschleunigung Ausblen-dung-Schwelle im Stand" VALUE 0x75257 TKW_VV_VV_SB 100.0 FORMULA_0446 -32.0000 31.7500 /end CHARACTERISTIC
/begin CHARACTERISTIC K_OZQBESCHN "Negative Querbeschleunigung Ausblendung-Schwelle  | EN: Negative Querbeschleunigung Ausblendung-Schwelle" VALUE 0x75258 TKW_VV_VV_SB 100.0 FORMULA_0446 -32.0000 31.7500 /end CHARACTERISTIC
/begin CHARACTERISTIC K_OZQBESCHORI "Querbeschleunigung Ausblendung-Schwelle Beim OriMw | EN: Querbeschleunigung Ausblen-dung-Schwelle Beim OriMw" VALUE 0x75259 TKW_VV_VV_SB 100.0 FORMULA_0446 -32.0000 31.7500 /end CHARACTERISTIC
/begin CHARACTERISTIC K_OZQBESCHP "Positive Querbeschleunigung Ausblendung-Schwelle  | EN: Positive Querbeschleunigung Ausblendung-Schwelle" VALUE 0x7525A TKW_VV_VV_SB 100.0 FORMULA_0446 -32.0000 31.7500 /end CHARACTERISTIC
/begin CHARACTERISTIC K_OZQBESCHST "Querbeschleunigung Ausblendung-Schwelle im Stand | EN: Querbeschleunigung Ausblen-dung-Schwelle im Stand" VALUE 0x7525B TKW_VV_VV_SB 100.0 FORMULA_0446 -32.0000 31.7500 /end CHARACTERISTIC
/begin CHARACTERISTIC K_OZUEFNLB "Negative L�ngsbeschleunigungsgrenze f�r die �berf�llung" VALUE 0x7525C TKW_VV_VV_SB 100.0 FORMULA_0446 -32.0000 31.7500 /end CHARACTERISTIC
/begin CHARACTERISTIC K_OZUEFNQB "Negative Querbeschleunigungsgrenze f�r die �berf�llung" VALUE 0x7525D TKW_VV_VV_SB 100.0 FORMULA_0446 -32.0000 31.7500 /end CHARACTERISTIC
/begin CHARACTERISTIC K_OZUEFPLB "Positive L�ngsbeschleunigungsgrenze f�r die �berf�llung" VALUE 0x7525E TKW_VV_VV_SB 100.0 FORMULA_0446 -32.0000 31.7500 /end CHARACTERISTIC
/begin CHARACTERISTIC K_OZUEFPQB "Positive Querbeschleunigungsgrenze f�r die �berf�llung" VALUE 0x7525F TKW_VV_VV_SB 100.0 FORMULA_0446 -32.0000 31.7500 /end CHARACTERISTIC
/begin CHARACTERISTIC K_NACHFUELL12 "Nachf�ll Erste Balken von Peistab | EN: Nachfüll Erste Balken von Peistab" VALUE 0x75260 TKW_VV_VV_UB 100.0 FORMULA_0003 0.0 255.0000 /end CHARACTERISTIC
/begin CHARACTERISTIC K_NACHFUELL25 "Nachf�ll Zweite Balken von Peistab | EN: Nachfüll Zweite Balken von Peistab" VALUE 0x75261 TKW_VV_VV_UB 100.0 FORMULA_0003 0.0 255.0000 /end CHARACTERISTIC
/begin CHARACTERISTIC K_NACHFUELL38 "Nachf�ll Dritte Balken von Peistab | EN: Nachfüll Dritte Balken von Peistab" VALUE 0x75262 TKW_VV_VV_UB 100.0 FORMULA_0003 0.0 255.0000 /end CHARACTERISTIC
/begin CHARACTERISTIC K_NACHFUELL53 "Nachf�ll Vierte Balken von Peistab | EN: Nachfüll Vierte Balken von Peistab" VALUE 0x75263 TKW_VV_VV_UB 100.0 FORMULA_0003 0.0 255.0000 /end CHARACTERISTIC
/begin CHARACTERISTIC K_NACHFUELL69 "Nachf�ll F�nfte Balken von Peistab | EN: Nachfüll Fünfte Balken von Peistab" VALUE 0x75264 TKW_VV_VV_UB 100.0 FORMULA_0003 0.0 255.0000 /end CHARACTERISTIC
/begin CHARACTERISTIC K_NACHFUELL85 "Nachf�ll Sechte Balken von Peistab | EN: Nachfüll Sechte Balken von Peistab" VALUE 0x75265 TKW_VV_VV_UB 100.0 FORMULA_0003 0.0 255.0000 /end CHARACTERISTIC
/begin CHARACTERISTIC K_NACHFUELL95 "Nachf�ll Siebte Balken von Peistab | EN: Nachfüll Siebte Balken von Peistab" VALUE 0x75266 TKW_VV_VV_UB 100.0 FORMULA_0003 0.0 255.0000 /end CHARACTERISTIC
/begin CHARACTERISTIC K_OZBESCHAUS "Zahl Ausgeblendet bei Lengsbescheunigung | EN: Zahl Ausgeblendet bei Lengsbescheunigung" VALUE 0x75267 TKW_VV_VV_UB 100.0 FORMULA_0003 0.0 255.0000 /end CHARACTERISTIC
/begin CHARACTERISTIC K_OZDKNIVN "Ersatzwert f�r die Drehzahlkorrektur bei Oz_peilaltanz = 0 | EN: Ersatzwert für die Drehzahlkor-rektur bei Oz_peilaltanz = 0" VALUE 0x75268 TKW_VV_VV_UB 100.0 FORMULA_0431 0.0 74.7070 /end CHARACTERISTIC
/begin CHARACTERISTIC K_OZMWK "Anzahl der Messwerte f�r Kurzzeit-Mittelwert Niveau | EN: Number of measurements for short-term level average" VALUE 0x75269 TKW_VV_VV_UB 100.0 FORMULA_0003 0.0 255.0000 /end CHARACTERISTIC
/begin CHARACTERISTIC K_OZNFERR "Nachf�llmengenanzeige bei PreCheck OK | EN: Top-up quantity display when pre-check OK" VALUE 0x7526A TKW_VV_VV_UB 100.0 FORMULA_0003 0.0 255.0000 /end CHARACTERISTIC
/begin CHARACTERISTIC K_OZNFML "Nachf�llmengenanzeige bei  | EN: Top-up quantity display while measuring" VALUE 0x7526B TKW_VV_VV_UB 100.0 FORMULA_0003 0.0 255.0000 /end CHARACTERISTIC
/begin CHARACTERISTIC K_OZNFOELCKO "Nachf�llmengenanzeige bei PreCheck KO | EN: Top-up quantity display when pre-check not OK" VALUE 0x7526C TKW_VV_VV_UB 100.0 FORMULA_0003 0.0 255.0000 /end CHARACTERISTIC
/begin CHARACTERISTIC K_OZNFOELCOK "Nachf�llmengenanzeige bei PreCheck OK | EN: Top-up quantity display when pre-check OK" VALUE 0x7526D TKW_VV_VV_UB 100.0 FORMULA_0003 0.0 255.0000 /end CHARACTERISTIC
/begin CHARACTERISTIC K_OZOELCOK "PreDriveCheck-Schwelle | EN: Pre-drive check threshold [mm]" VALUE 0x7526E TKW_VV_VV_UB 100.0 FORMULA_0431 0.0 74.7070 /end CHARACTERISTIC
/begin CHARACTERISTIC K_OZOELCVERZ "Verz�gerung f�r den �lcheck | EN: Delay for the oil check [s]" VALUE 0x7526F TKW_VV_VV_UB 100.0 FORMULA_0003 0.0 255.0000 /end CHARACTERISTIC
/begin CHARACTERISTIC K_OZORIPEILTZO "Ausgabeniveau f�r die tote Zone Orientierung-Check Peilstab mit alter Anzeige >= Mitte | EN: Output level for dead zone, orientation check, electronic dipstick with old display >= middle [mm]" VALUE 0x75270 TKW_VV_VV_UB 100.0 FORMULA_0431 0.0 74.7070 /end CHARACTERISTIC
/begin CHARACTERISTIC K_OZORIPEILTZU "Ausgabeniveau f�r die tote Zone Orientierung-Check Peilstab mit alter Anzeige < Mitte | EN: Output level for dead zone, orientation check, electronic dipstick with old display < middle [mm]" VALUE 0x75271 TKW_VV_VV_UB 100.0 FORMULA_0431 0.0 74.7070 /end CHARACTERISTIC
/begin CHARACTERISTIC K_OZPEIL12 "Erste Balken von Peistab | EN: First bar of electronic dipstick [mm]" VALUE 0x75272 TKW_VV_VV_UB 100.0 FORMULA_0431 0.0 74.7070 /end CHARACTERISTIC
/begin CHARACTERISTIC K_OZPEIL25 "Zweite Balken von Peistab | EN: Second bar of electronic dipstick [mm]" VALUE 0x75273 TKW_VV_VV_UB 100.0 FORMULA_0431 0.0 74.7070 /end CHARACTERISTIC
/begin CHARACTERISTIC K_OZPEIL38 "Dritte Balken von Peistab | EN: Third bar of electronic dipstick [mm]" VALUE 0x75274 TKW_VV_VV_UB 100.0 FORMULA_0431 0.0 74.7070 /end CHARACTERISTIC
/begin CHARACTERISTIC K_OZPEIL53 "Vierte Balken von Peistab | EN: Fourth bar of electronic dipstick [mm]" VALUE 0x75275 TKW_VV_VV_UB 100.0 FORMULA_0431 0.0 74.7070 /end CHARACTERISTIC
/begin CHARACTERISTIC K_OZPEIL69 "F�nfte Balken von Peistab | EN: Fifth bar of electronic dipstick [mm]" VALUE 0x75276 TKW_VV_VV_UB 100.0 FORMULA_0431 0.0 74.7070 /end CHARACTERISTIC
/begin CHARACTERISTIC K_OZPEIL85 "Sechte Balken von Peistab | EN: Sixth bar of electronic dipstick [mm]" VALUE 0x75277 TKW_VV_VV_UB 100.0 FORMULA_0431 0.0 74.7070 /end CHARACTERISTIC
/begin CHARACTERISTIC K_OZPEILDO "Delta + Hysterese Peilstab | EN: Delta + hysteresis, dipstick [mm]" VALUE 0x75278 TKW_VV_VV_UB 100.0 FORMULA_0431 0.0 74.7070 /end CHARACTERISTIC
/begin CHARACTERISTIC K_OZPEILDOMIN "Delta + Hysterese Peilstab bei Min | EN: Delta + hysteresis, dipstick at minimum [mm]" VALUE 0x75279 TKW_VV_VV_UB 100.0 FORMULA_0431 0.0 74.7070 /end CHARACTERISTIC
/begin CHARACTERISTIC K_OZPEILDU "Delta - Hysterese Peilstab | EN: Delta - hysteresis, dipstick [mm]" VALUE 0x7527A TKW_VV_VV_UB 100.0 FORMULA_0431 0.0 74.7070 /end CHARACTERISTIC
/begin CHARACTERISTIC K_OZPEILDU38 "Delta - Hysterese Peilstab bei 1/4 | EN: Delta - hysteresis, dipstick at 1/4 [mm]" VALUE 0x7527B TKW_VV_VV_UB 100.0 FORMULA_0431 0.0 74.7070 /end CHARACTERISTIC
/begin CHARACTERISTIC K_OZPEILERR "Balkenanzeige im Fehlerfall | EN: Bar display in fault case" VALUE 0x7527C TKW_VV_VV_UB 100.0 FORMULA_0003 0.0 255.0000 /end CHARACTERISTIC
/begin CHARACTERISTIC K_OZPEILKSPR "Max zul�ssiger Niveau-Unterschied zwischen alten Anzeige und VorMw | EN: Maximum permitted level difference between old display and previous mean [mm]" VALUE 0x7527D TKW_VV_VV_UB 100.0 FORMULA_0431 0.0 74.7070 /end CHARACTERISTIC
/begin CHARACTERISTIC K_OZPEILLP85 "Bankenanzeige f�r Niveau bei 85% | EN: Bar display for level at 85%" VALUE 0x7527E TKW_VV_VV_UB 100.0 FORMULA_0003 0.0 255.0000 /end CHARACTERISTIC
/begin CHARACTERISTIC K_OZPEILML "Balkenanzeige bei Messung l�uft | EN: Bar display while measuring" VALUE 0x7527F TKW_VV_VV_UB 100.0 FORMULA_0003 0.0 255.0000 /end CHARACTERISTIC
/begin CHARACTERISTIC K_OZPEILOELCKO "Balkenanzeige bei �lCheck KO | EN: Bar display when oil check not OK" VALUE 0x75280 TKW_VV_VV_UB 100.0 FORMULA_0003 0.0 255.0000 /end CHARACTERISTIC
/begin CHARACTERISTIC K_OZPEILOELCOK "Balkenanzeige bei �lCheck OK | EN: Bar display when oil check OK" VALUE 0x75281 TKW_VV_VV_UB 100.0 FORMULA_0003 0.0 255.0000 /end CHARACTERISTIC
/begin CHARACTERISTIC K_OZPEILSPRUNG "Max zul�ssiger Niveau-Unterschied zwischen LangMw | EN: Maximum permitted level difference between long-term means [mm]" VALUE 0x75282 TKW_VV_VV_UB 100.0 FORMULA_0431 0.0 74.7070 /end CHARACTERISTIC
/begin CHARACTERISTIC K_OZSTANDVERZ "Verz�gerung f�r Fahrzeug steht | EN: Delay for vehicle stationary [s]" VALUE 0x75283 TKW_VV_VV_UB 100.0 FORMULA_0003 0.0 255.0000 /end CHARACTERISTIC
/begin CHARACTERISTIC K_OZSTARTVERZ "QLT Start Verz�gerung nach Drehzal | EN: Oil-quality sensor start delay after engine speed [s]" VALUE 0x75284 TKW_VV_VV_UB 100.0 FORMULA_0003 0.0 255.0000 /end CHARACTERISTIC
/begin CHARACTERISTIC K_OZUEBERF "Schwelle f�r die �berf�llung | EN: Schwelle fï¿½r die ï¿½berfï¿½llung" VALUE 0x75285 TKW_VV_VV_UB 100.0 FORMULA_0431 0.0 74.7070 /end CHARACTERISTIC
/begin CHARACTERISTIC K_OZUEFCNT "Anzahl Werte f�r �berf�llung" VALUE 0x75286 TKW_VV_VV_UB 100.0 FORMULA_0003 0.0 255.0000 /end CHARACTERISTIC
/begin CHARACTERISTIC K_OZUEFVERZ "Verz�gerung f�r erkennung �berf�llung" VALUE 0x75287 TKW_VV_VV_UB 100.0 FORMULA_0003 0.0 255.0000 /end CHARACTERISTIC
/begin CHARACTERISTIC K_OZVERBFAK "Faktor f�r die Anpassung des �lverbrauches" VALUE 0x75288 TKW_VV_VV_UB 100.0 FORMULA_0447 0.0 7.9687 /end CHARACTERISTIC
/begin CHARACTERISTIC K_OZVERZERRBSD "Verz�gerung f�r Peilstab-Fehlerfall beim BSD-Fehler | EN: Verzögerung für Peilstab-Fehlerfall beim BSD-Fehler" VALUE 0x75289 TKW_VV_VV_UB 100.0 FORMULA_0003 0.0 255.0000 /end CHARACTERISTIC
/begin CHARACTERISTIC K_OZVORPEILMIN "Niveau Ausgabe (f�r die Peilstabanzeige) bei VorMw auf min und LangMw �ber 1/4" VALUE 0x7528A TKW_VV_VV_UB 100.0 FORMULA_0431 0.0 74.7070 /end CHARACTERISTIC
/begin CHARACTERISTIC KL_OZLN "y = ln x" CURVE 0x7528C TKL_UW_VV_SW 100.0 FORMULA_0448 -1.0000 9.99969482421875e-1 /begin AXIS_DESCR STD_AXIS Oz_pzdivp FORMULA_0024 6 0.0 1.9999 FORMAT "%7.4" /end AXIS_DESCR FORMAT "%5.2" /end CHARACTERISTIC
/begin CHARACTERISTIC KL_OZKRZMW2 "Anzahl 10er Pakete f�r Steigungsberechnung in Abh�ngigkeit von der gefahrenen Strecke" CURVE 0x752A6 TKL_UW_VV_UB 100.0 FORMULA_0003 0.0 255.0000 /begin AXIS_DESCR STD_AXIS Oz_dkm FORMULA_0441 4 0.0 9.9998 FORMAT "%5.2" /end AXIS_DESCR /end CHARACTERISTIC
/begin CHARACTERISTIC KL_OZORBERO "Toleranz f�r Orientierungsmessung nach oben in mm" CURVE 0x752B4 TKL_UB_VV_UB 100.0 FORMULA_0431 0.0 74.7070 /begin AXIS_DESCR STD_AXIS Oz_peillang FORMULA_0431 6 0.0 74.7070 /end AXIS_DESCR /end CHARACTERISTIC
/begin CHARACTERISTIC KL_OZLBNIV "Korrektur der L�ngbeschleunigungseffekte beim 10er Paket QLT" CURVE 0x752C2 TKL_SB_VV_SB 100.0 FORMULA_0431 -37.5000 37.2070 /begin AXIS_DESCR STD_AXIS Oz_lbmw FORMULA_0442 8 -2.0000 1.9843 /end AXIS_DESCR /end CHARACTERISTIC
/begin CHARACTERISTIC KL_OZNFDELTA "Delta f�r die Nachf�llerkennung | EN: Delta für die Nachfüllerken-nung" CURVE 0x752D4 TKL_UB_VV_UB 100.0 FORMULA_0431 0.0 74.7070 /begin AXIS_DESCR STD_AXIS Oz_peillang FORMULA_0431 6 0.0 74.7070 /end AXIS_DESCR /end CHARACTERISTIC
/begin CHARACTERISTIC KL_OZQBNIV "Korrektur der Querbeschleunigungseffekte beim 10er Paket QLT" CURVE 0x752E2 TKL_SB_VV_SB 100.0 FORMULA_0431 -37.5000 37.2070 /begin AXIS_DESCR STD_AXIS Oz_qbmw FORMULA_0442 8 -2.0000 1.9843 /end AXIS_DESCR /end CHARACTERISTIC
/begin CHARACTERISTIC KL_OZSTNIV "Korrektur der Steigungseffekte beim 20er Paket QLT | EN: Correction of incline effects for oil-quality sensor package" CURVE 0x752F4 TKL_SW_VV_SW 100.0 FORMULA_0449 -37.5000 37.5000
 /begin AXIS_DESCR STD_AXIS Oz_steigung FORMULA_0440 8 -64.0000 63.9980 FORMAT "%5.2" /end AXIS_DESCR
 FORMAT "%5.2" /end CHARACTERISTIC
/begin CHARACTERISTIC KF_OZKORRORI "Kennfeld f�r die Korrektur des OriMw mit Abstellzeit und �ltemperatur" MAP 0x75316 TKF_UW_SW_SW 100.0 FORMULA_0449 -37.5000 37.2070 /begin AXIS_DESCR STD_AXIS Toel FORMULA_0426 4 -3276.8000 3276.7000 /end AXIS_DESCR
 /begin AXIS_DESCR STD_AXIS Tn_abstellm FORMULA_0438 3 0.0 65535.0000 FORMAT "%5.2" /end AXIS_DESCR
 FORMAT "%5.2" /end CHARACTERISTIC
/begin CHARACTERISTIC KF_OZDREHKOR_EINFAHR "Drehzahlkorrektur Niveau Einfahrintervall | EN: Engine-speed level correction (oil level)" MAP 0x7533E TKF_UW_SW_SW 100.0 FORMULA_0450 -37.5000 37.5000 /begin AXIS_DESCR STD_AXIS N_ozmw FORMULA_0006 16 -32768.0000 32767.0000 /end AXIS_DESCR
 /begin AXIS_DESCR STD_AXIS Oz_Peilaltanz FORMULA_0449 3 0.0 19199.7070 FORMAT "%5.2" /end AXIS_DESCR
 FORMAT "%5.2" /end CHARACTERISTIC
/begin CHARACTERISTIC KF_OZDREHKOR "Drehzahlkorrektur Niveau | EN: Engine-speed level correction (oil level)" MAP 0x753C6 TKF_UW_SW_SW 100.0 FORMULA_0450 -37.5000 37.5000 /begin AXIS_DESCR STD_AXIS N_ozmw FORMULA_0006 16 -32768.0000 32767.0000 /end AXIS_DESCR
 /begin AXIS_DESCR STD_AXIS Oz_Peilaltanz FORMULA_0449 3 0.0 19199.7070 FORMAT "%5.2" /end AXIS_DESCR
 FORMAT "%5.2" /end CHARACTERISTIC
/begin CHARACTERISTIC KF_OZKORRNIV "Niveaukorrektur nach Startzeit und Temperatur | EN: Oil-level correction vs start time and temperature" MAP 0x7544E TKF_UW_SW_SW 100.0 FORMULA_0449 -37.5000 37.5000 /begin AXIS_DESCR STD_AXIS Oz_tempf FORMULA_0426 6 -3276.8000 3276.7000 /end AXIS_DESCR
 /begin AXIS_DESCR STD_AXIS Oz_nivzeit FORMULA_0021 4 0.0 655.3500 FORMAT "%5.2" /end AXIS_DESCR
 FORMAT "%5.2" /end CHARACTERISTIC
/begin CHARACTERISTIC KF_OZZEIT "Zusammenf�hr�ng Abstellzeit und Startzeit | EN: Combination of engine-off time and start time" MAP 0x75494 TKF_UW_UW_UW 100.0 FORMULA_0021 0.0 655.3500
 /begin AXIS_DESCR STD_AXIS Tn_start_10 FORMULA_0021 6 0.0 655.3500 FORMAT "%5.2" /end AXIS_DESCR
 /begin AXIS_DESCR STD_AXIS Oz_abstellm FORMULA_0438 4 0.0 65535.0000 FORMAT "%5.2" /end AXIS_DESCR
 FORMAT "%5.2" /end CHARACTERISTIC
/begin MEASUREMENT St_oznivdl0.B_oznivb "" UBYTE FORMULA_0418 0 0 0.0 255.0 ECU_ADDRESS 0x3FCC2F BIT_MASK 0x1 /end MEASUREMENT
/begin MEASUREMENT St_oznivdl0.B_ozkrzkor "Bedingung drehzahlkorrigierter Kurzzeit Niveaumittelwert berechnet" UBYTE FORMULA_0419 0 0 0.0 255.0 ECU_ADDRESS 0x3FCC2F BIT_MASK 0x2 /end MEASUREMENT
/begin MEASUREMENT St_oznivdl0.B_ozlangmw "Bedingung Langzeit-Mittelwert berechnet" UBYTE FORMULA_0420 0 0 0.0 255.0 ECU_ADDRESS 0x3FCC2F BIT_MASK 0x4 /end MEASUREMENT
/begin MEASUREMENT St_oznivdl0.B_ozor "Bedingung Orientierungsmessung erfolgt" UBYTE FORMULA_0421 0 0 0.0 255.0 ECU_ADDRESS 0x3FCC2F BIT_MASK 0x8 /end MEASUREMENT
/begin MEASUREMENT St_oznivdl0.B_ozvormw "Bedingung vorgezogener Mittelwert berechnet" UBYTE FORMULA_0422 0 0 0.0 255.0 ECU_ADDRESS 0x3FCC2F BIT_MASK 0x10 /end MEASUREMENT
/begin MEASUREMENT St_oznivdl0.B_ozkrzlkor "" UBYTE FORMULA_0423 0 0 0.0 255.0 ECU_ADDRESS 0x3FCC2F BIT_MASK 0x20 /end MEASUREMENT
/begin MEASUREMENT St_oznivdl0.B_ozluft "Umgebungsluftdruck plausibel / Steigungserkennung aktiv" UBYTE FORMULA_0424 0 0 0.0 255.0 ECU_ADDRESS 0x3FCC2F BIT_MASK 0x40 /end MEASUREMENT
/begin MEASUREMENT St_oznivdl0.B_ozkrzl "" UBYTE FORMULA_0425 0 0 0.0 255.0 ECU_ADDRESS 0x3FCC2F BIT_MASK 0x80 /end MEASUREMENT
/begin MEASUREMENT St_oznivdl0 "Statuswort" UBYTE FORMULA_0003 0 0 0.0 255.0000 ECU_ADDRESS 0x3FCC2F /end MEASUREMENT
/begin MEASUREMENT St_oznivdl1.B_ozkrzkor2 "Ein Mittelwert von zwei KurzMw ist da" UBYTE FORMULA_0418 0 0 0.0 255.0 ECU_ADDRESS 0x3FCC30 BIT_MASK 0x1 /end MEASUREMENT
/begin MEASUREMENT St_oznivdl1.B_ozkrzkornb "Bedingung drehzahlkorrigierter Kurzzeit Niveaumittelwert und nicht drehzahlbegrenzt berechnet" UBYTE FORMULA_0419 0 0 0.0 255.0 ECU_ADDRESS 0x3FCC30 BIT_MASK 0x2 /end MEASUREMENT
/begin MEASUREMENT St_oznivdl1.B_ozoelcheck "" UBYTE FORMULA_0420 0 0 0.0 255.0 ECU_ADDRESS 0x3FCC30 BIT_MASK 0x4 /end MEASUREMENT
/begin MEASUREMENT St_oznivdl1.B_ozoelchok "" UBYTE FORMULA_0421 0 0 0.0 255.0 ECU_ADDRESS 0x3FCC30 BIT_MASK 0x8 /end MEASUREMENT
/begin MEASUREMENT St_oznivdl1.B_ozfahrt "Das Fahrzeug hat sich bewegt" UBYTE FORMULA_0422 0 0 0.0 255.0 ECU_ADDRESS 0x3FCC30 BIT_MASK 0x10 /end MEASUREMENT
/begin MEASUREMENT St_oznivdl1.B_ozueberf "�berf�llung entdeckt" UBYTE FORMULA_0423 0 0 0.0 255.0 ECU_ADDRESS 0x3FCC30 BIT_MASK 0x20 /end MEASUREMENT
/begin MEASUREMENT St_oznivdl1.B_ozml "Anforderung Messung l�uft" UBYTE FORMULA_0424 0 0 0.0 255.0 ECU_ADDRESS 0x3FCC30 BIT_MASK 0x40 /end MEASUREMENT
/begin MEASUREMENT St_oznivdl1.B_ozmreset "Reset der Messungen (beim INI2-Sprung)" UBYTE FORMULA_0425 0 0 0.0 255.0 ECU_ADDRESS 0x3FCC30 BIT_MASK 0x80 /end MEASUREMENT
/begin MEASUREMENT St_oznivdl1 "Statuswort" UBYTE FORMULA_0003 0 0 0.0 255.0000 ECU_ADDRESS 0x3FCC30 /end MEASUREMENT
/begin MEASUREMENT St_oznivdl_nv0.B_ozpeilerr "" UBYTE FORMULA_0419 0 0 0.0 255.0 ECU_ADDRESS 0x3FA994 BIT_MASK 0x2 /end MEASUREMENT
/begin MEASUREMENT St_oznivdl_nv0.B_ozlmwneu "Langzeit-Mittelwert berechnet in der letzten Fahrt" UBYTE FORMULA_0420 0 0 0.0 255.0 ECU_ADDRESS 0x3FA994 BIT_MASK 0x4 /end MEASUREMENT
/begin MEASUREMENT St_oznivdl_nv0.B_oznachf "Nachf�llung erkannt" UBYTE FORMULA_0421 0 0 0.0 255.0 ECU_ADDRESS 0x3FA994 BIT_MASK 0x8 /end MEASUREMENT
/begin MEASUREMENT St_oznivdl_nv0.B_ozoelwech "�lwechsel f�r die Peilstabanzeige" UBYTE FORMULA_0422 0 0 0.0 255.0 ECU_ADDRESS 0x3FA994 BIT_MASK 0x10 /end MEASUREMENT
/begin MEASUREMENT St_oznivdl_nv0.B_ozabzlang "Abstellzeit zu lang f�r die anzeige des letzten Wertes" UBYTE FORMULA_0423 0 0 0.0 255.0 ECU_ADDRESS 0x3FA994 BIT_MASK 0x20 /end MEASUREMENT
/begin MEASUREMENT St_oznivdl_nv0 "Statuswort" UBYTE FORMULA_0003 0 0 0.0 255.0000 ECU_ADDRESS 0x3FA994 /end MEASUREMENT
/begin MEASUREMENT Oz_krzor "kurzzeitiger Mittelwert Orientierungsmessung Niveau" UBYTE FORMULA_0431 0 0 0.0 74.7070 ECU_ADDRESS 0x3FCC31 /end MEASUREMENT
/begin MEASUREMENT Oz_lp "oz level picture" UBYTE FORMULA_0003 0 0 0.0 255.0000 ECU_ADDRESS 0x3FCC32 /end MEASUREMENT
/begin MEASUREMENT Oz_lv "oz level value" UBYTE FORMULA_0003 0 0 0.0 255.0000 ECU_ADDRESS 0x3FCC33 /end MEASUREMENT
/begin MEASUREMENT Oz_nivakt "Aktuelles Niveau f�r den Tester" UBYTE FORMULA_0431 0 0 0.0 74.7070 ECU_ADDRESS 0x3FCC34 /end MEASUREMENT
/begin MEASUREMENT Oz_nivkrzt "Kurzmittelwert-Niveau f�r den Tester" UBYTE FORMULA_0431 0 0 0.0 74.7070 ECU_ADDRESS 0x3FCC35 /end MEASUREMENT
/begin MEASUREMENT Oz_nivlit "�lniveau in Liter" UBYTE FORMULA_0436 0 0 0.0 25.5000 ECU_ADDRESS 0x3FCC36 /end MEASUREMENT
/begin MEASUREMENT Oz_nivnfm "Nachf�llmenge" UBYTE FORMULA_0437 0 0 0.0 7.9687 ECU_ADDRESS 0x3FCC37 /end MEASUREMENT
/begin MEASUREMENT Oz_orikor "OriMw korrigiert" UBYTE FORMULA_0431 0 0 0.0 74.7070 ECU_ADDRESS 0x3FCC38 /end MEASUREMENT
/begin MEASUREMENT Oz_vormw "vorgezogener Mittelwert Niveau" UBYTE FORMULA_0431 0 0 0.0 74.7070 ECU_ADDRESS 0x3FCC39 /end MEASUREMENT
/begin MEASUREMENT Oz_rwpeil "Restweg laut Peilstab" SWORD FORMULA_0428 0 0 -327680.0000 327670.0000 ECU_ADDRESS 0x3FA996 /end MEASUREMENT
/begin MEASUREMENT Oz_abstellm "Abstellzeit f�r OZ" UWORD FORMULA_0438 0 0 0.0 65535.0000 ECU_ADDRESS 0x3FA998 /end MEASUREMENT
/begin MEASUREMENT Oz_oelverbr "Berechneter �lverbrauch" UWORD FORMULA_0010 0 0 0.0 65535.0000 ECU_ADDRESS 0x3FA99A /end MEASUREMENT
/begin MEASUREMENT Oz_peilkmalt "Km Stand beim 1. Sensorfehler" UWORD FORMULA_0432 0 0 0.0 655350.0000 ECU_ADDRESS 0x3FA99C /end MEASUREMENT
/begin MEASUREMENT Oz_verbkmalt "Km-Stand letzter �lverbrauch-Berechnung" UWORD FORMULA_0432 0 0 0.0 655350.0000 ECU_ADDRESS 0x3FA99E /end MEASUREMENT
/begin MEASUREMENT Oz_langmw "Langzeitmittelwert berechnet" UBYTE FORMULA_0431 0 0 0.0 74.7070 ECU_ADDRESS 0x3FA9A0 /end MEASUREMENT
/begin MEASUREMENT Oz_nivlangt "Langmittelwert f�r den Tester" UBYTE FORMULA_0431 0 0 0.0 74.7070 ECU_ADDRESS 0x3FA9A1 /end MEASUREMENT
/begin MEASUREMENT Oz_peilaltanz "Letzter Wert, der die Anzeige ge�ndert hat" UBYTE FORMULA_0431 0 0 0.0 74.7070 ECU_ADDRESS 0x3FA9A2 /end MEASUREMENT
/begin MEASUREMENT Oz_peillang "Letzter angeforderter Wert f�r die Peilstabanzeige" UBYTE FORMULA_0431 0 0 0.0 74.7070 ECU_ADDRESS 0x3FA9A3 /end MEASUREMENT
/begin MEASUREMENT Oz_verbnivalt "�lniveau letzter �lverbrauch-Berechnung" UBYTE FORMULA_0431 0 0 0.0 74.7070 ECU_ADDRESS 0x3FA9A4 /end MEASUREMENT
/begin MEASUREMENT N_ozmw "kurzzeitiger Mittelwert Drehzahl" SWORD FORMULA_0006 0 0 -32767.0000 32767.0000 ECU_ADDRESS 0x3FB036 /end MEASUREMENT
/begin MEASUREMENT Oz_hoehe "" SWORD FORMULA_0439 0 0 -8.0000 7.9997 ECU_ADDRESS 0x3FB038 /end MEASUREMENT
/begin MEASUREMENT Oz_steigung "" SWORD FORMULA_0440 0 0 -64.0000 63.9980 ECU_ADDRESS 0x3FB03A /end MEASUREMENT
/begin MEASUREMENT Oz_testtoel2 "" SWORD FORMULA_0426 0 0 -3276.8000 3276.7000 ECU_ADDRESS 0x3FB03C /end MEASUREMENT
/begin MEASUREMENT Oz_dkm "" UWORD FORMULA_0441 0 0 0.0 9.9998 ECU_ADDRESS 0x3FB03E /end MEASUREMENT
/begin MEASUREMENT Oz_nivzeit "Zeit nach dem KF_OZZEIT" UWORD FORMULA_0021 0 0 0.0 655.3500 ECU_ADDRESS 0x3FB040 /end MEASUREMENT
/begin MEASUREMENT Oz_peilkm "Max Ziel km im Fehlerfall" UWORD FORMULA_0432 0 0 0.0 655350.0000 ECU_ADDRESS 0x3FB042 /end MEASUREMENT
/begin MEASUREMENT Oz_pzdivp "Verh�ltnis oz_luftalt/oz_luftneu" UWORD FORMULA_0024 0 0 0.0 1.9999 ECU_ADDRESS 0x3FB044 /end MEASUREMENT
/begin MEASUREMENT Oz_lbmw "" SBYTE FORMULA_0442 0 0 -2.0000 1.9843 ECU_ADDRESS 0x3FB046 /end MEASUREMENT
/begin MEASUREMENT Oz_qbmw "" SBYTE FORMULA_0442 0 0 -2.0000 1.9843 ECU_ADDRESS 0x3FB047 /end MEASUREMENT
/begin MEASUREMENT Oz_uefzcnt "Zwischenz�hler �berf�llung" SBYTE FORMULA_0003 0 0 -128.0000 127.0000 ECU_ADDRESS 0x3FB048 /end MEASUREMENT
/begin MEASUREMENT Oz_beschcnt "Z�hler Beschleunigungsausblendung" UBYTE FORMULA_0003 0 0 0.0 255.0000 ECU_ADDRESS 0x3FB049 /end MEASUREMENT
/begin MEASUREMENT Oz_krz2cnt "KurzMw 2 Z�hler" UBYTE FORMULA_0003 0 0 0.0 255.0000 ECU_ADDRESS 0x3FB04A /end MEASUREMENT
/begin MEASUREMENT Oz_krzcnt "" UBYTE FORMULA_0003 0 0 0.0 255.0000 ECU_ADDRESS 0x3FB04B /end MEASUREMENT
/begin MEASUREMENT Oz_krzkor2 "Mittelwert von zwei KurzMw" UBYTE FORMULA_0431 0 0 0.0 74.7070 ECU_ADDRESS 0x3FB04C /end MEASUREMENT
/begin MEASUREMENT Oz_krzkor2k "Mittelwert von zwei KurzMw Steigungs korrigiert" UBYTE FORMULA_0431 0 0 0.0 74.7070 ECU_ADDRESS 0x3FB04D /end MEASUREMENT
/begin MEASUREMENT Oz_krzmw "" UBYTE FORMULA_0431 0 0 0.0 74.7070 ECU_ADDRESS 0x3FB04E /end MEASUREMENT
/begin MEASUREMENT Oz_krzmwkor "" UBYTE FORMULA_0431 0 0 0.0 74.7070 ECU_ADDRESS 0x3FB04F /end MEASUREMENT
/begin MEASUREMENT Oz_lgmwcnt "" UBYTE FORMULA_0003 0 0 0.0 255.0000 ECU_ADDRESS 0x3FB050 /end MEASUREMENT
/begin MEASUREMENT Oz_nivkor "Aktuelles Niveau Temperatur korrigiert" UBYTE FORMULA_0431 0 0 0.0 74.7070 ECU_ADDRESS 0x3FB051 /end MEASUREMENT
/begin MEASUREMENT Oz_oricnt "Orientierungsz�hler" UBYTE FORMULA_0003 0 0 0.0 255.0000 ECU_ADDRESS 0x3FB052 /end MEASUREMENT
/begin MEASUREMENT Oz_peil "" UBYTE FORMULA_0431 0 0 0.0 74.7070 ECU_ADDRESS 0x3FB053 /end MEASUREMENT
/begin MEASUREMENT Oz_peiloben "Obere Grenze aktuelles Balkens" UBYTE FORMULA_0431 0 0 0.0 74.7070 ECU_ADDRESS 0x3FB054 /end MEASUREMENT
/begin MEASUREMENT Oz_peilunten "Obere Grenze aktuelles Balkens" UBYTE FORMULA_0431 0 0 0.0 74.7070 ECU_ADDRESS 0x3FB055 /end MEASUREMENT
/begin MEASUREMENT Oz_uefcnt "Z�hler �berf�llung" UBYTE FORMULA_0003 0 0 0.0 255.0000 ECU_ADDRESS 0x3FB056 /end MEASUREMENT
/begin MEASUREMENT Oz_vormwcnt "" UBYTE FORMULA_0003 0 0 0.0 255.0000 ECU_ADDRESS 0x3FB057 /end MEASUREMENT
/* ------------------ Abschnitt erzeugt aus ozrestkm.dat ------------------ */
/begin CHARACTERISTIC K_OZZEITFAKT "Bereich der gesamten Laufstrecke wo die Berechnung des Zeit-RW Beainfluss hat" VALUE 0x754DA TKW_VV_VV_UB 100.0 FORMULA_0434 0.0 0.9960 /end CHARACTERISTIC
/begin CHARACTERISTIC K_OZUEBERTEMP "Schwelle f�r die �ls�bertemperatur-Kontrolle" VALUE 0x754DC TKW_VV_VV_SW 100.0 FORMULA_0426 -3276.8000 3276.7000 /end CHARACTERISTIC
/begin CHARACTERISTIC K_OZANFANZ "BOS-Startanzeigewert Restlaufstrecke" VALUE 0x754DE TKW_VV_VV_UW 100.0 FORMULA_0432 0.0 655350.0000 /end CHARACTERISTIC
/begin CHARACTERISTIC K_OZKMMAXK11 "Maximalintervall" VALUE 0x754E0 TKW_VV_VV_UW 100.0 FORMULA_0432 0.0 655350.0000 /end CHARACTERISTIC
/begin CHARACTERISTIC K_OZKVBMXK18 "maximal zul�ssige Gesamtkraftstoffbonusmenge" VALUE 0x754E2 TKW_VV_VV_UW 100.0 FORMULA_0010 0.0 65535.0000 /end CHARACTERISTIC
/begin CHARACTERISTIC K_OZKVBOK16 "Kraftstoffbonusmenge in [l] je 0,5l �lnachf�llung" VALUE 0x754E4 TKW_VV_VV_UW 100.0 FORMULA_0010 0.0 65535.0000 /end CHARACTERISTIC
/begin CHARACTERISTIC K_OZMNKMBO "Wegstrecke ab der eine Bonuszuteilung erfolgt" VALUE 0x754E6 TKW_VV_VV_UW 100.0 FORMULA_0432 0.0 655350.0000 /end CHARACTERISTIC
/begin CHARACTERISTIC K_OZMXOHK15 "Max Tage f�r den �lservice" VALUE 0x754E8 TKW_VV_VV_UW 100.0 FORMULA_0010 0.0 65535.0000 /end CHARACTERISTIC
/begin CHARACTERISTIC K_OZPERBOK17 "Er-Bonusbetrag je 0,5l �lnachf�llung" VALUE 0x754EA TKW_VV_VV_UW 100.0 FORMULA_0430 0.0 5.9999 FORMAT "%4.1" /end CHARACTERISTIC
/begin CHARACTERISTIC K_OZPERXK10 "zul�ssige Permittivit�ts�nderung im �lwechselintervall" VALUE 0x754EC TKW_VV_VV_UW 100.0 FORMULA_0430 0.0 5.9999 FORMAT "%4.1" /end CHARACTERISTIC
/begin CHARACTERISTIC K_OZTAGCTERR "Wert f�r unplausibel Tagez�hler" VALUE 0x754EE TKW_VV_VV_UW 100.0 FORMULA_0010 0.0 65535.0000 /end CHARACTERISTIC
/begin CHARACTERISTIC K_OZDAEMPF "" VALUE 0x754F0 TKW_VV_VV_UB 100.0 FORMULA_0454 0.0 0.2490 /end CHARACTERISTIC
/begin CHARACTERISTIC K_OZKVB96 "Typpr�fkraftstoffverbrauch" VALUE 0x754F1 TKW_VV_VV_UB 100.0 FORMULA_0455 0.0 31.8750 /end CHARACTERISTIC
/begin CHARACTERISTIC K_OZKVB96A "Typpr�fkraftstoffverbrauch Automatikgetriebe" VALUE 0x754F2 TKW_VV_VV_UB 100.0 FORMULA_0455 0.0 31.8750 /end CHARACTERISTIC
/begin CHARACTERISTIC K_OZLF1 "L�nderfaktor 1 Festwert" VALUE 0x754F3 TKW_VV_VV_UB 100.0 FORMULA_0451 0.0 2.5500 /end CHARACTERISTIC
/begin CHARACTERISTIC K_OZLF2 "L�nderfaktor 2 Festwert" VALUE 0x754F4 TKW_VV_VV_UB 100.0 FORMULA_0451 0.0 2.5500 /end CHARACTERISTIC
/begin CHARACTERISTIC K_OZOELMEN "�lmenge f�r den Dieseleintrag" VALUE 0x754F5 TKW_VV_VV_UB 100.0 FORMULA_0436 0.0 25.5000 /end CHARACTERISTIC
/begin CHARACTERISTIC K_OZPERBRK14 "Begrenzungsfaktor f�r Restweg aus der Permittivit�t" VALUE 0x754F6 TKW_VV_VV_UB 100.0 FORMULA_0456 0.0 5.9765 /end CHARACTERISTIC
/begin CHARACTERISTIC K_OZUTFAK "Faktor f�r den Kraftstoffverbrauch bei �bertemperatur" VALUE 0x754F7 TKW_VV_VV_UB 100.0 FORMULA_0003 0.0 255.0000 /end CHARACTERISTIC
/begin CHARACTERISTIC K_OZZEITINT "Zeitintervall f�r �lwechsel in Monate (CBS4)" VALUE 0x754F8 TKW_VV_VV_UB 100.0 FORMULA_0003 0.0 255.0000 /end CHARACTERISTIC
/begin CHARACTERISTIC KL_OZVERDFAK "Verd�nnungsfaktor von Dieseleintrag" CURVE 0x754FA TKL_UW_VV_UW 100.0 FORMULA_0457 0.0 9.99984741210938e-1
 /begin AXIS_DESCR STD_AXIS NO_INPUT_QUANTITY FORMULA_0457 5 0.0 0.9999 FORMAT "%7.4" /end AXIS_DESCR
 FORMAT "%7.4" /end CHARACTERISTIC
/begin MEASUREMENT St_ozrestkm_0.B_oznoperm "Keine Berechnung von Permittivit�t f�r die Restlaufstrecke" UBYTE FORMULA_0418 0 0 0.0 255.0 ECU_ADDRESS 0x3FCC3A BIT_MASK 0x1 /end MEASUREMENT
/begin MEASUREMENT St_ozrestkm_0 "Statuswort" UBYTE FORMULA_0003 0 0 0.0 255.0000 ECU_ADDRESS 0x3FCC3A /end MEASUREMENT
/begin MEASUREMENT St_ozrestkm_nv0.B_rwanz0 "Bedingung f�r Restweganzeige = Null" UBYTE FORMULA_0418 0 0 0.0 255.0 ECU_ADDRESS 0x3FA9A8 BIT_MASK 0x1 /end MEASUREMENT
/begin MEASUREMENT St_ozrestkm_nv0.B_ozvfk "" UBYTE FORMULA_0419 0 0 0.0 255.0 ECU_ADDRESS 0x3FA9A8 BIT_MASK 0x2 /end MEASUREMENT
/begin MEASUREMENT St_ozrestkm_nv0.B_ozini "" UBYTE FORMULA_0420 0 0 0.0 255.0 ECU_ADDRESS 0x3FA9A8 BIT_MASK 0x4 /end MEASUREMENT
/begin MEASUREMENT St_ozrestkm_nv0.B_ozcntini "Tageberechnung initialisiert" UBYTE FORMULA_0421 0 0 0.0 255.0 ECU_ADDRESS 0x3FA9A8 BIT_MASK 0x8 /end MEASUREMENT
/begin MEASUREMENT St_ozrestkm_nv0 "Statuswort" UBYTE FORMULA_0003 0 0 0.0 255.0000 ECU_ADDRESS 0x3FA9A8 /end MEASUREMENT
/begin MEASUREMENT Oz_rwkvb "" SWORD FORMULA_0428 0 0 -327680.0000 327670.0000 ECU_ADDRESS 0x3FCC3C /end MEASUREMENT
/begin MEASUREMENT Oz_rwperm "Restweg aus Permittivit�t abgeleitet" SWORD FORMULA_0428 0 0 -327680.0000 327670.0000 ECU_ADDRESS 0x3FCC3E /end MEASUREMENT
/begin MEASUREMENT Oz_rwzeit "Restweg laut Zeitverlauf" SWORD FORMULA_0428 0 0 -327680.0000 327670.0000 ECU_ADDRESS 0x3FCC40 /end MEASUREMENT
/begin MEASUREMENT Oz_oelzeit "�l-Alter in Monate" UWORD FORMULA_0010 0 0 0.0 65535.0000 ECU_ADDRESS 0x3FCC42 /end MEASUREMENT
/begin MEASUREMENT Oz_oelzeitt "�l-Alter in Tage" UWORD FORMULA_0010 0 0 0.0 65535.0000 ECU_ADDRESS 0x3FCC44 /end MEASUREMENT
/begin MEASUREMENT Oz_rwprog "Prognose_Intervall_Weg_BOS_Meldung_2" UWORD FORMULA_0432 0 0 0.0 655350.0000 ECU_ADDRESS 0x3FCC46 /end MEASUREMENT
/begin MEASUREMENT Oz_intprog "Prognose_Intervall_Zeit_BOS_Meldung_2" UBYTE FORMULA_0003 0 0 0.0 255.0000 ECU_ADDRESS 0x3FCC48 /end MEASUREMENT
/begin MEASUREMENT Oz_vfanz "anzuzeigende Verf�gbarkeit" UBYTE FORMULA_0451 0 0 0.0 2.5500 ECU_ADDRESS 0x3FCC49 /end MEASUREMENT
/begin MEASUREMENT Oz_kvbmw "" ULONG FORMULA_0452 0 0 0.0 100.0000 ECU_ADDRESS 0x3FA9AC /end MEASUREMENT
/begin MEASUREMENT Oz_kvbsm_ul "" ULONG FORMULA_0452 0 0 0.0 524287.9998 ECU_ADDRESS 0x3FA9B0 /end MEASUREMENT
/begin MEASUREMENT Oz_cttagini "Tag beim �lwechsel" SWORD FORMULA_0010 0 0 -32768.0000 32767.0000 ECU_ADDRESS 0x3FA9B4 /end MEASUREMENT
/begin MEASUREMENT Oz_rwanz "anzuzeigender Restweg" SWORD FORMULA_0428 0 0 -327680.0000 327670.0000 ECU_ADDRESS 0x3FA9B6 /end MEASUREMENT
/begin MEASUREMENT Oz_kmstrw0 "Kilometerstand bei Restweg = Null" UWORD FORMULA_0432 0 0 0.0 655350.0000 ECU_ADDRESS 0x3FA9B8 /end MEASUREMENT
/begin MEASUREMENT Oz_kvbog "zugeteilte Bonuskraftstoffmenge" UWORD FORMULA_0010 0 0 0.0 65535.0000 ECU_ADDRESS 0x3FA9BA /end MEASUREMENT
/begin MEASUREMENT Oz_permbog "zugeteilter Permittivit�tsbonus" UWORD FORMULA_0430 0 0 0.0 5.9999 ECU_ADDRESS 0x3FA9BC /end MEASUREMENT
/begin MEASUREMENT Oz_utzeit "Zeit �l in �bertemperatur" UWORD FORMULA_0010 0 0 0.0 65535.0000 ECU_ADDRESS 0x3FA9BE /end MEASUREMENT
/begin MEASUREMENT Oz_lf1t "L�nderfaktor 1" UBYTE FORMULA_0451 0 0 0.0 2.5500 ECU_ADDRESS 0x3FA9C0 /end MEASUREMENT
/begin MEASUREMENT Oz_lf2t "L�nderfaktor 2" UBYTE FORMULA_0451 0 0 0.0 2.5500 ECU_ADDRESS 0x3FA9C1 /end MEASUREMENT
/begin MEASUREMENT Oz_zieljahr "" UBYTE FORMULA_0003 0 0 0.0 255.0000 ECU_ADDRESS 0x3FA9C2 /end MEASUREMENT
/begin MEASUREMENT Oz_zielmon "" UBYTE FORMULA_0003 0 0 0.0 255.0000 ECU_ADDRESS 0x3FA9C3 /end MEASUREMENT
/begin MEASUREMENT Oz_kvbdiff "" ULONG FORMULA_0452 0 0 0.0 100.0000 ECU_ADDRESS 0x3FB05C /end MEASUREMENT
/begin MEASUREMENT Oz_kvbsm "" ULONG FORMULA_0452 0 0 0.0 10000.0000 ECU_ADDRESS 0x3FB060 /end MEASUREMENT
/begin MEASUREMENT Oz_rwde "Restweg laut Dieseleintrag" SWORD FORMULA_0428 0 0 -327680.0000 327670.0000 ECU_ADDRESS 0x3FB064 /end MEASUREMENT
/begin MEASUREMENT Oz_rwp "Zwischengr��e Restwegberechnung" SWORD FORMULA_0428 0 0 -327680.0000 327670.0000 ECU_ADDRESS 0x3FB066 /end MEASUREMENT
/begin MEASUREMENT Oz_kvbmwtmp "" UWORD FORMULA_0453 0 0 0.0 63.9990 ECU_ADDRESS 0x3FB068 /end MEASUREMENT
/begin MEASUREMENT Oz_kvbmx "" UWORD FORMULA_0010 0 0 0.0 65535.0000 ECU_ADDRESS 0x3FB06A /end MEASUREMENT
/begin MEASUREMENT Oz_kvbtmp2 "" UWORD FORMULA_0432 0 0 0.0 655350.0000 ECU_ADDRESS 0x3FB06C /end MEASUREMENT
/begin MEASUREMENT Oz_litges "Gesamtverbrauch f�r �lwechsel" UWORD FORMULA_0010 0 0 0.0 65535.0000 ECU_ADDRESS 0x3FB06E /end MEASUREMENT
/begin MEASUREMENT Oz_nivlanglit "LangMw in Liter" UBYTE FORMULA_0436 0 0 0.0 25.5000 ECU_ADDRESS 0x3FB070 /end MEASUREMENT
/begin MEASUREMENT Oz_vfkvb "Verf�gbarkeit aus Kraftstoffverbrauch" UBYTE FORMULA_0451 0 0 0.0 2.5500 ECU_ADDRESS 0x3FB071 /end MEASUREMENT
/begin MEASUREMENT Oz_vfperm "Verf�gbarkeit aus der Permittivit�t" UBYTE FORMULA_0451 0 0 0.0 2.5500 ECU_ADDRESS 0x3FB072 /end MEASUREMENT
/begin MEASUREMENT Oz_vfzeit "Verf�gbarkeit aus Zeit" UBYTE FORMULA_0451 0 0 0.0 2.5500 ECU_ADDRESS 0x3FB073 /end MEASUREMENT
/* ------------------ Abschnitt erzeugt aus oztemp.dat ------------------ */
/begin MEASUREMENT Oz_tempf "" SWORD FORMULA_0426 0 0 -3276.8000 3276.7000 ECU_ADDRESS 0x3FCC4A /end MEASUREMENT
/* ------------------ Abschnitt erzeugt aus pgentred.dat ------------------ */
/begin CHARACTERISTIC K_GENMXGRADH "Maximal zul�ssiger Gradient Chiptemperatur | EN: °C -3276.8p 2 0.75*x Maximal zulässiger Gradi ent Chiptemperatur" VALUE 0x75538 TKW_VV_VV_SW 100.0 FORMULA_0426 -3276.8000 3276.7000 /end CHARACTERISTIC
/begin CHARACTERISTIC K_NGENHTMN1 "Untere Drehzahlschwelle f�r kritischen Bereich Didentemparatur | EN: Untere Drehzahlschwelle fï¿½r kritischen Bereich Didentemparatur" VALUE 0x7553A TKW_VV_VV_SW 100.0 FORMULA_0006 0.0 32767.0000 /end CHARACTERISTIC
/begin CHARACTERISTIC K_NGENHTMX1 "Obere Drehzahlschwelle f�r kritischen Bereich Didentemparatur | EN: Obere Drehzahlschwelle fï¿½r kritischen Bereich Didentemparatur" VALUE 0x7553C TKW_VV_VV_SW 100.0 FORMULA_0006 0.0 32767.0000 /end CHARACTERISTIC
/begin CHARACTERISTIC K_TGENMXGRAD "Schwellwert f�r Erkennung mayimaler Gradient | EN: °C -3276.8p 2 0.75*x Schwellwert für Erkennung mayimaler Gradient" VALUE 0x7553E TKW_VV_VV_SW 100.0 FORMULA_0426 -3276.8000 3276.7000 /end CHARACTERISTIC
/begin CHARACTERISTIC K_TGENMXTHD "Schwellwert f�r �berh�hte Temparatur Generator | EN: °C -3276.8p 2 0.75*x Schwellwert für überhöhte Temparatur Generator" VALUE 0x75540 TKW_VV_VV_SW 100.0 FORMULA_0426 -3276.8000 3276.7000 /end CHARACTERISTIC
/begin CHARACTERISTIC K_TGENRSHT "Reset bei unterschrittener Chiptemperatur | EN: °C -3276.8p 2 0.75*x Reset bei unterschrittener Chiptemperatur" VALUE 0x75542 TKW_VV_VV_SW 100.0 FORMULA_0426 -3276.8000 3276.7000 /end CHARACTERISTIC
/begin CHARACTERISTIC K_TCHIPFIL "Filterkonstante schneller Tchip Filter | EN: Filterkonstante schneller Tchip Filter" VALUE 0x75544 TKW_VV_VV_UW 100.0 FORMULA_0457 0.0 9.99984741210938e-1 FORMAT "%7.4" /end CHARACTERISTIC
/begin CHARACTERISTIC K_TFTDIODE "Filterkonstante Deltatemparatur Diode" VALUE 0x75546 TKW_VV_VV_UW 100.0 FORMULA_0457 1.52587890625e-5 9.99984741210938e-1 FORMAT "%7.4" /end CHARACTERISTIC
/begin CHARACTERISTIC K_UGENHTMN "Schwellwert Bordnetzspannung Reset Generatorstrombefrenzung durch Hochtemperatur" VALUE 0x75548 TKW_VV_VV_UW 100.0 FORMULA_0427 0.0 6173.3970 FORMAT "%4.1" /end CHARACTERISTIC
/begin CHARACTERISTIC K_HTGENDFGRO "Schwelle Generaorauslastung zur E-L�fteranforderung | EN: Schwelle Generaorauslastung zur E-Lï¿½fteranforderung" VALUE 0x7554A TKW_VV_VV_UB 100.0 FORMULA_0003 0.0 255.0000 /end CHARACTERISTIC
/begin CHARACTERISTIC K_I_VERTEIL "Stromverteilung" VALUE 0x7554B TKW_VV_VV_UB 100.0 FORMULA_0461 0.0157 3.9843 /end CHARACTERISTIC
/begin CHARACTERISTIC K_TDNGENKRIT "Verz�gerung Generator im kritischen Drehzahlbereich | EN: Verzï¿½gerung Generator im kritischen Drehzahlbereich" VALUE 0x7554C TKW_VV_VV_UB 100.0 FORMULA_0472 0.0 255.0000 /end CHARACTERISTIC
/begin CHARACTERISTIC K_TDTCHIPKRI "Verz�gerung Generatorhochtemperatur | EN: Verzï¿½gerung Generatorhochtemperatur" VALUE 0x7554D TKW_VV_VV_UB 100.0 FORMULA_0472 0.0 255.0000 /end CHARACTERISTIC
/begin CHARACTERISTIC K_TDTCHIPMX "Verz�gerung erh�hte Chiptemperatur | EN: Verzï¿½gerung erhï¿½hte Chiptemperatur" VALUE 0x7554E TKW_VV_VV_UB 100.0 FORMULA_0003 0.0 255.0000 /end CHARACTERISTIC
/begin CHARACTERISTIC K_TDUBFZMN "Verz�gerung Bordnetzschwelle | EN: Verzï¿½gerung Bordnetzschwelle" VALUE 0x7554F TKW_VV_VV_UB 100.0 FORMULA_0472 0.0 255.0000 /end CHARACTERISTIC
/begin CHARACTERISTIC K_TFIGENHT "Filterkonstante verteilter Generatorstrom | EN: Filterkonstante verteilter Generatorstrom" VALUE 0x75550 TKW_VV_VV_UB 100.0 FORMULA_0434 0.0040 0.9960 /end CHARACTERISTIC
/begin CHARACTERISTIC K_TLCHTEP "Entprellung Hochtemperatur Generator | EN: Schalter zur Aktivierung Überwachung Diodentemparatur" VALUE 0x75551 TKW_VV_VV_UB 100.0 FORMULA_0472 0.0 255.0000 /end CHARACTERISTIC
/begin CHARACTERISTIC S_HTDETEC "Schalter zur Aktivierung �berwachung Diodentemparatur | EN: Schalter zur Aktivierung ï¿½berwachung Diodentemparatur" VALUE 0x75552 TKW_VV_VV_UB 100.0 FORMULA_0474 0.0 1.0000 /end CHARACTERISTIC
/begin CHARACTERISTIC KL_NELUEFTGE "E-L�fteranforderung Generator | EN: Electric-fan request from generator" CURVE 0x75553 TKL_UB_VV_UB 100.0 FORMULA_0471 0.0 99.6093 /begin AXIS_DESCR STD_AXIS Gen_awnumm FORMULA_0003 6 0.0 255.0000 /end AXIS_DESCR /end CHARACTERISTIC
/begin CHARACTERISTIC KL_TMAXDIODE "Zul�ssige Diodenmaximaltemperatur | EN: Zulässige Diodenmaximaltemperatur" CURVE 0x75562 TKL_UB_VV_SW 100.0 FORMULA_0426 -3276.8000 3276.7000 /begin AXIS_DESCR STD_AXIS Gen_awnumm FORMULA_0003 6 0.0 255.0000 /end AXIS_DESCR /end CHARACTERISTIC
/begin CHARACTERISTIC KL_RTHJADIOD "Temperaturkoeffizient der Diode | EN: Temperaturkoeffizient der Diode" CURVE 0x75576 TKL_UB_VV_UW 100.0 FORMULA_0433 0.0 99.9984 /begin AXIS_DESCR STD_AXIS Gen_awnumm FORMULA_0003 6 0.0 255.0000 /end AXIS_DESCR FORMAT "%5.2" /end CHARACTERISTIC
/begin CHARACTERISTIC KL_TCHIPOFFS "Offset zur gemessenen Chiptemperatur Herstellerspezifisch" CURVE 0x7558A TKL_UB_VV_SW 100.0 FORMULA_0426 -3276.8000 3276.7000 /begin AXIS_DESCR STD_AXIS Gen_manufak FORMULA_0003 8 0.0 255.0000 /end AXIS_DESCR /end CHARACTERISTIC
/begin CHARACTERISTIC KF_UFDIODE "Kennfeld f�r Diodenvorw�rtsspannung | EN: Kennfeld für Diodenvorwärtsspannung" MAP 0x755A4 TKF_UB_SW_UW 100.0 FORMULA_0479 0.0 319.9951 /begin AXIS_DESCR STD_AXIS Tans_gen FORMULA_0426 2 -3276.8000 3276.7000 /end AXIS_DESCR /begin AXIS_DESCR STD_AXIS Gen_awnumm FORMULA_0003 6 0.0 255.0000 /end AXIS_DESCR FORMAT "%6.3" /end CHARACTERISTIC
/begin CHARACTERISTIC KF_IERRGREHT "Generatorstrombegrenzung bei Generatorhochtemparatur | EN: Generator current limit at high generator temperature" MAP 0x755C8 TKF_SW_SW_UB 100.0 FORMULA_0460 0.0 31.8750 /begin AXIS_DESCR STD_AXIS N_gen FORMULA_0006 3 -32768.0000 32767.0000 /end AXIS_DESCR /begin AXIS_DESCR STD_AXIS Gen_awnumm FORMULA_0010 6 -32768.0000 32767.0000 /end AXIS_DESCR /end CHARACTERISTIC
/begin CHARACTERISTIC KF_TANSGENKO "Kennfeld zur Bestimmung Ansauglufttemparatur Generator" MAP 0x755EE TKF_SW_SW_SW 100.0 FORMULA_0426 -3276.8000 3276.7000 /begin AXIS_DESCR STD_AXIS Tchip_fil_l FORMULA_0426 4 -3276.8000 3276.7000 /end AXIS_DESCR /begin AXIS_DESCR STD_AXIS N_gen FORMULA_0006 4 -32768.0000 32767.0000 /end AXIS_DESCR /end CHARACTERISTIC
/begin MEASUREMENT St_pgentred_1s.B_genht "Bedingung Generator Hochtemperatur" UBYTE FORMULA_0418 0 0 0.0 255.0 ECU_ADDRESS 0x3FCC72 BIT_MASK 0x1 /end MEASUREMENT
/begin MEASUREMENT St_pgentred_1s.B_genhtkrit "" UBYTE FORMULA_0419 0 0 0.0 255.0 ECU_ADDRESS 0x3FCC72 BIT_MASK 0x2 /end MEASUREMENT
/begin MEASUREMENT St_pgentred_1s.B_genhtkritv "Bedingung kritische Temparatur vor Entprellung" UBYTE FORMULA_0420 0 0 0.0 255.0 ECU_ADDRESS 0x3FCC72 BIT_MASK 0x4 /end MEASUREMENT
/begin MEASUREMENT St_pgentred_1s.B_tdiodekrit "Diodentemparatur im kritischen Bereich" UBYTE FORMULA_0421 0 0 0.0 255.0 ECU_ADDRESS 0x3FCC72 BIT_MASK 0x8 /end MEASUREMENT
/begin MEASUREMENT St_pgentred_1s.B_genhtmxgra "Maximale Gradient Chiptemparatur �berstiegen" UBYTE FORMULA_0422 0 0 0.0 255.0 ECU_ADDRESS 0x3FCC72 BIT_MASK 0x10 /end MEASUREMENT
/begin MEASUREMENT St_pgentred_1s.B_ierrgrenzh "Grenzstrom aus Hochtemperatur Generator aktiv" UBYTE FORMULA_0423 0 0 0.0 255.0 ECU_ADDRESS 0x3FCC72 BIT_MASK 0x20 /end MEASUREMENT
/begin MEASUREMENT St_pgentred_1s "Statuswort" UBYTE FORMULA_0003 0 0 0.0 255.0000 ECU_ADDRESS 0x3FCC72 /end MEASUREMENT
/begin MEASUREMENT Nelueft_gen "Drehzahlanforderung E-L�fter Generator" UBYTE FORMULA_0471 0 0 0.0 99.6093 ECU_ADDRESS 0x3FCC73 /end MEASUREMENT
/begin MEASUREMENT Ierrgrenz_ht "Grenzerregerstrom durch �berhitzung Dioden" UBYTE FORMULA_0460 0 0 0.0 31.8750 ECU_ADDRESS 0x3FCC74 /end MEASUREMENT
/begin MEASUREMENT T_chipfilsdt "Differenzenquotient schnellgefilterte Chiptemparatur" SWORD FORMULA_0426 0 0 -3276.8000 3276.7000 ECU_ADDRESS 0x3FB074 /end MEASUREMENT
/begin MEASUREMENT T_diode "Diodentemparatur" SWORD FORMULA_0426 0 0 -3276.8000 3276.7000 ECU_ADDRESS 0x3FB076 /end MEASUREMENT
/begin MEASUREMENT T_diodedelta "Deltatemparatur Diode" SWORD FORMULA_0426 0 0 -3276.8000 3276.7000 ECU_ADDRESS 0x3FB078 /end MEASUREMENT
/begin MEASUREMENT Tans_gen "Ansauglufttemparatur Generator" SWORD FORMULA_0426 0 0 -3276.8000 3276.7000 ECU_ADDRESS 0x3FB07A /end MEASUREMENT
/begin MEASUREMENT Tchip_ist "Wirkliche Chiptemperatur vom Generatorregler" SWORD FORMULA_0426 0 0 -3276.8000 3276.7000 ECU_ADDRESS 0x3FB07C /end MEASUREMENT
/begin MEASUREMENT Tchip_mwa_1of16_ "Array zur Mittelwerbildung Tchip_ist" SWORD FORMULA_0426 0 0 -3276.8000 3276.7000 ECU_ADDRESS 0x3FB07E /end MEASUREMENT
/begin MEASUREMENT Tchip_mwa_2of16_ "Array zur Mittelwerbildung Tchip_ist" SWORD FORMULA_0426 0 0 -3276.8000 3276.7000 ECU_ADDRESS 0x3FB080 /end MEASUREMENT
/begin MEASUREMENT Tchip_mwa_3of16_ "Array zur Mittelwerbildung Tchip_ist" SWORD FORMULA_0426 0 0 -3276.8000 3276.7000 ECU_ADDRESS 0x3FB082 /end MEASUREMENT
/begin MEASUREMENT Tchip_mwa_4of16_ "Array zur Mittelwerbildung Tchip_ist" SWORD FORMULA_0426 0 0 -3276.8000 3276.7000 ECU_ADDRESS 0x3FB084 /end MEASUREMENT
/begin MEASUREMENT Tchip_mwa_5of16_ "Array zur Mittelwerbildung Tchip_ist" SWORD FORMULA_0426 0 0 -3276.8000 3276.7000 ECU_ADDRESS 0x3FB086 /end MEASUREMENT
/begin MEASUREMENT Tchip_mwa_6of16_ "Array zur Mittelwerbildung Tchip_ist" SWORD FORMULA_0426 0 0 -3276.8000 3276.7000 ECU_ADDRESS 0x3FB088 /end MEASUREMENT
/begin MEASUREMENT Tchip_mwa_7of16_ "Array zur Mittelwerbildung Tchip_ist" SWORD FORMULA_0426 0 0 -3276.8000 3276.7000 ECU_ADDRESS 0x3FB08A /end MEASUREMENT
/begin MEASUREMENT Tchip_mwa_8of16_ "Array zur Mittelwerbildung Tchip_ist" SWORD FORMULA_0426 0 0 -3276.8000 3276.7000 ECU_ADDRESS 0x3FB08C /end MEASUREMENT
/begin MEASUREMENT Tchip_mwa_9of16_ "Array zur Mittelwerbildung Tchip_ist" SWORD FORMULA_0426 0 0 -3276.8000 3276.7000 ECU_ADDRESS 0x3FB08E /end MEASUREMENT
/begin MEASUREMENT Tchip_mwa_10of16_ "Array zur Mittelwerbildung Tchip_ist" SWORD FORMULA_0426 0 0 -3276.8000 3276.7000 ECU_ADDRESS 0x3FB090 /end MEASUREMENT
/begin MEASUREMENT Tchip_mwa_11of16_ "Array zur Mittelwerbildung Tchip_ist" SWORD FORMULA_0426 0 0 -3276.8000 3276.7000 ECU_ADDRESS 0x3FB092 /end MEASUREMENT
/begin MEASUREMENT Tchip_mwa_12of16_ "Array zur Mittelwerbildung Tchip_ist" SWORD FORMULA_0426 0 0 -3276.8000 3276.7000 ECU_ADDRESS 0x3FB094 /end MEASUREMENT
/begin MEASUREMENT Tchip_mwa_13of16_ "Array zur Mittelwerbildung Tchip_ist" SWORD FORMULA_0426 0 0 -3276.8000 3276.7000 ECU_ADDRESS 0x3FB096 /end MEASUREMENT
/begin MEASUREMENT Tchip_mwa_14of16_ "Array zur Mittelwerbildung Tchip_ist" SWORD FORMULA_0426 0 0 -3276.8000 3276.7000 ECU_ADDRESS 0x3FB098 /end MEASUREMENT
/begin MEASUREMENT Tchip_mwa_15of16_ "Array zur Mittelwerbildung Tchip_ist" SWORD FORMULA_0426 0 0 -3276.8000 3276.7000 ECU_ADDRESS 0x3FB09A /end MEASUREMENT
/begin MEASUREMENT Tchip_mwa_16of16_ "Array zur Mittelwerbildung Tchip_ist" SWORD FORMULA_0426 0 0 -3276.8000 3276.7000 ECU_ADDRESS 0x3FB09C /end MEASUREMENT
/begin MEASUREMENT Tchip_sum "Summenwert Tchip zur Mittelwertbildung" SWORD FORMULA_0426 0 0 -3276.8000 3276.7000 ECU_ADDRESS 0x3FB09E /end MEASUREMENT
/begin MEASUREMENT Tchip_fil_l "Wirkliche Chiptemperatur vom Generatorregler als Mittelwert gefiltert" SWORD FORMULA_0426 0 0 -3276.8000 3276.7000 ECU_ADDRESS 0x3FB0A0 /end MEASUREMENT
/begin MEASUREMENT Tchip_fil_s "Wirkliche Chiptemperatur vom Generatorregler als Mittelwert gefiltert" SWORD FORMULA_0426 0 0 -3276.8000 3276.7000 ECU_ADDRESS 0x3FB0A2 /end MEASUREMENT
/begin MEASUREMENT P_totdiode "Verlustleistung der Diode" UWORD FORMULA_0478 0 0 0.0 255.9960 ECU_ADDRESS 0x3FB0A4 /end MEASUREMENT
/begin MEASUREMENT U_vordiode "Diodenvorw�rtsspannung" UWORD FORMULA_0479 0 0 0.0 319.9951 ECU_ADDRESS 0x3FB0A6 /end MEASUREMENT
/begin MEASUREMENT Z_tchip "Zaehler f�r Mittelwerbildung Tchip_ist" UBYTE FORMULA_0003 0 0 0.0 255.0000 ECU_ADDRESS 0x3FB0A8 /end MEASUREMENT
/* ------------------ Abschnitt erzeugt aus pmbnstab.dat ------------------ */
/begin CHARACTERISTIC K_BNS_VFZG "Schwelle Geschwindigkeit fuer BNS" VALUE 0x758D0 TKW_VV_VV_UW 100.0 FORMULA_0470 0.0 65535.0000 /end CHARACTERISTIC
/begin CHARACTERISTIC K_BNSMAX "Bordnetz Instabil Schwelle | EN: Bordnetz Instabil Schwelle" VALUE 0x758D2 TKW_VV_VV_UB 100.0 FORMULA_0003 0.0 255.0000 /end CHARACTERISTIC
/begin CHARACTERISTIC K_BNS_CTRINC "bnsctr inkrement" VALUE 0x758D3 TKW_VV_VV_UB 100.0 FORMULA_0003 0.0 255.0000 /end CHARACTERISTIC
/begin CHARACTERISTIC K_BNS_SCHW1 "BN Instabilit�tsschwelle 1" VALUE 0x758D4 TKW_VV_VV_UB 100.0 FORMULA_0003 0.0 255.0000 /end CHARACTERISTIC
/begin CHARACTERISTIC K_BNS_UBMAX "BN Spg. max. Schwelle" VALUE 0x758D5 TKW_VV_VV_UB 100.0 FORMULA_0486 0.0 24.0210 /end CHARACTERISTIC
/begin CHARACTERISTIC K_BNS_UBMIN "BN Spg. untere Schwelle" VALUE 0x758D6 TKW_VV_VV_UB 100.0 FORMULA_0486 0.0 24.0210 /end CHARACTERISTIC
/begin CHARACTERISTIC K_T_BNSDELAY "Delayzeit nach Motorstartende f�r BNS �berwachung" VALUE 0x758D7 TKW_VV_VV_UB 100.0 FORMULA_0472 0.0 255.0000 /end CHARACTERISTIC
/begin CHARACTERISTIC S_BNSCLRAPP "BNS Daten l�schen" VALUE 0x758D8 TKW_VV_VV_UB 100.0 FORMULA_0003 0.0 255.0000 /end CHARACTERISTIC
/begin MEASUREMENT St_bns2.B_nachlnd7 "lokales B_nachlaufende [V452 CHECK: PKSR RAM block reorganised in V452 (new ub correction of SSP flow); address not valid]" UBYTE FORMULA_0418 0 0 0.0 255.0 ECU_ADDRESS 0x3FCCF2 BIT_MASK 0x1 /end MEASUREMENT
/begin MEASUREMENT St_bns2 "Statuswort [V452 CHECK: PKSR RAM block reorganised in V452 (new ub correction of SSP flow); address not valid]" UBYTE FORMULA_0003 0 0 0.0 255.0000 ECU_ADDRESS 0x3FCCF2 /end MEASUREMENT
/begin MEASUREMENT St_bns.B_bns "Bordnetzstabilit�tsma�nahmen aktiv" UBYTE FORMULA_0418 0 0 0.0 255.0 ECU_ADDRESS 0x3FA9C4 BIT_MASK 0x1 /end MEASUREMENT
/begin MEASUREMENT St_bns "Statuswort" UBYTE FORMULA_0003 0 0 0.0 255.0000 ECU_ADDRESS 0x3FA9C4 /end MEASUREMENT
/begin MEASUREMENT Bnctrmx1s " [V452 CHECK: PKSR RAM block reorganised in V452 (new ub correction of SSP flow); address not valid]" UBYTE FORMULA_0003 0 0 0.0 255.0000 ECU_ADDRESS 0x3FCCF3 /end MEASUREMENT
/begin MEASUREMENT Bnsctrant0 "Counter 1 sec-Anteile ohne Grenzwert�berschreitung" ULONG FORMULA_0000 0 0 0.0 4294967295.0000 ECU_ADDRESS 0x3FA9C8 /end MEASUREMENT
/begin MEASUREMENT Bnsctrant1 "Counter 1 sec-Anteile 1. Bereich" UWORD FORMULA_0010 0 0 0.0 65535.0000 ECU_ADDRESS 0x3FA9CC /end MEASUREMENT
/begin MEASUREMENT Bnsctrant2 "Counter 1 sec-Anteile 2. Bereich" UWORD FORMULA_0010 0 0 0.0 65535.0000 ECU_ADDRESS 0x3FA9CE /end MEASUREMENT
/begin MEASUREMENT Bnsctrant3 "Counter 1 sec-Anteile 3. Bereich" UWORD FORMULA_0010 0 0 0.0 65535.0000 ECU_ADDRESS 0x3FA9D0 /end MEASUREMENT
/begin MEASUREMENT Bnsctr "Counter Bordnetzspannungsplausibilisierung" UBYTE FORMULA_0003 0 0 0.0 255.0000 ECU_ADDRESS 0x3FA9D2 /end MEASUREMENT
/* ------------------ Abschnitt erzeugt aus msg.dat ------------------ */
/begin CHARACTERISTIC K_MSG_CFG "CC-Konfiguration" VALUE 0x74997 TKW_VV_VV_UB 100.0 FORMULA_0974 0.0 255.0 /end CHARACTERISTIC
/begin MEASUREMENT msg_exd_st "Ext. Ansteuerung" UBYTE FORMULA_0033 0 0 0.0 255.0000 ECU_ADDRESS 0x3FC938 /end MEASUREMENT
/begin MEASUREMENT msg_send_typ "gesendeter Typ pro Zyklus" UBYTE FORMULA_0970 0 0 0.0 255.0 ECU_ADDRESS 0x3FC939 /end MEASUREMENT
/begin MEASUREMENT msg_send_st "Sendestatus" UBYTE FORMULA_0971 0 0 0.0 255.0 ECU_ADDRESS 0x3FC93A /end MEASUREMENT
/begin MEASUREMENT msg_send_timeout "Timeout der akt. ID" UBYTE FORMULA_0232 0 0 0.0 255.0000 ECU_ADDRESS 0x3FC93C /end MEASUREMENT
/begin MEASUREMENT msg_send_id "gesendete ID pro Zyklus" UWORD FORMULA_0972 0 0 0.0 65535.0 ECU_ADDRESS 0x3FC93E /end MEASUREMENT
/begin MEASUREMENT msg_timer_1of32_ "Timer Meldung" UBYTE FORMULA_0458 0 0 0.0 25.5000 ECU_ADDRESS 0x3FC940 /end MEASUREMENT
/begin MEASUREMENT msg_timer_2of32_ "Timer Meldung" UBYTE FORMULA_0458 0 0 0.0 25.5000 ECU_ADDRESS 0x3FC941 /end MEASUREMENT
/begin MEASUREMENT msg_timer_3of32_ "Timer Meldung" UBYTE FORMULA_0458 0 0 0.0 25.5000 ECU_ADDRESS 0x3FC942 /end MEASUREMENT
/begin MEASUREMENT msg_timer_4of32_ "Timer Meldung" UBYTE FORMULA_0458 0 0 0.0 25.5000 ECU_ADDRESS 0x3FC943 /end MEASUREMENT
/begin MEASUREMENT msg_timer_5of32_ "Timer Meldung" UBYTE FORMULA_0458 0 0 0.0 25.5000 ECU_ADDRESS 0x3FC944 /end MEASUREMENT
/begin MEASUREMENT msg_timer_6of32_ "Timer Meldung" UBYTE FORMULA_0458 0 0 0.0 25.5000 ECU_ADDRESS 0x3FC945 /end MEASUREMENT
/begin MEASUREMENT msg_timer_7of32_ "Timer Meldung" UBYTE FORMULA_0458 0 0 0.0 25.5000 ECU_ADDRESS 0x3FC946 /end MEASUREMENT
/begin MEASUREMENT msg_timer_8of32_ "Timer Meldung" UBYTE FORMULA_0458 0 0 0.0 25.5000 ECU_ADDRESS 0x3FC947 /end MEASUREMENT
/begin MEASUREMENT msg_timer_9of32_ "Timer Meldung" UBYTE FORMULA_0458 0 0 0.0 25.5000 ECU_ADDRESS 0x3FC948 /end MEASUREMENT
/begin MEASUREMENT msg_timer_10of32_ "Timer Meldung" UBYTE FORMULA_0458 0 0 0.0 25.5000 ECU_ADDRESS 0x3FC949 /end MEASUREMENT
/begin MEASUREMENT msg_timer_11of32_ "Timer Meldung" UBYTE FORMULA_0458 0 0 0.0 25.5000 ECU_ADDRESS 0x3FC94A /end MEASUREMENT
/begin MEASUREMENT msg_timer_12of32_ "Timer Meldung" UBYTE FORMULA_0458 0 0 0.0 25.5000 ECU_ADDRESS 0x3FC94B /end MEASUREMENT
/begin MEASUREMENT msg_timer_13of32_ "Timer Meldung" UBYTE FORMULA_0458 0 0 0.0 25.5000 ECU_ADDRESS 0x3FC94C /end MEASUREMENT
/begin MEASUREMENT msg_timer_14of32_ "Timer Meldung" UBYTE FORMULA_0458 0 0 0.0 25.5000 ECU_ADDRESS 0x3FC94D /end MEASUREMENT
/begin MEASUREMENT msg_timer_15of32_ "Timer Meldung" UBYTE FORMULA_0458 0 0 0.0 25.5000 ECU_ADDRESS 0x3FC94E /end MEASUREMENT
/begin MEASUREMENT msg_timer_16of32_ "Timer Meldung" UBYTE FORMULA_0458 0 0 0.0 25.5000 ECU_ADDRESS 0x3FC94F /end MEASUREMENT
/begin MEASUREMENT msg_timer_17of32_ "Timer Meldung" UBYTE FORMULA_0458 0 0 0.0 25.5000 ECU_ADDRESS 0x3FC950 /end MEASUREMENT
/begin MEASUREMENT msg_timer_18of32_ "Timer Meldung" UBYTE FORMULA_0458 0 0 0.0 25.5000 ECU_ADDRESS 0x3FC951 /end MEASUREMENT
/begin MEASUREMENT msg_timer_19of32_ "Timer Meldung" UBYTE FORMULA_0458 0 0 0.0 25.5000 ECU_ADDRESS 0x3FC952 /end MEASUREMENT
/begin MEASUREMENT msg_timer_20of32_ "Timer Meldung" UBYTE FORMULA_0458 0 0 0.0 25.5000 ECU_ADDRESS 0x3FC953 /end MEASUREMENT
/begin MEASUREMENT msg_timer_21of32_ "Timer Meldung" UBYTE FORMULA_0458 0 0 0.0 25.5000 ECU_ADDRESS 0x3FC954 /end MEASUREMENT
/begin MEASUREMENT msg_timer_22of32_ "Timer Meldung" UBYTE FORMULA_0458 0 0 0.0 25.5000 ECU_ADDRESS 0x3FC955 /end MEASUREMENT
/begin MEASUREMENT msg_timer_23of32_ "Timer Meldung" UBYTE FORMULA_0458 0 0 0.0 25.5000 ECU_ADDRESS 0x3FC956 /end MEASUREMENT
/begin MEASUREMENT msg_timer_24of32_ "Timer Meldung" UBYTE FORMULA_0458 0 0 0.0 25.5000 ECU_ADDRESS 0x3FC957 /end MEASUREMENT
/begin MEASUREMENT msg_timer_25of32_ "Timer Meldung" UBYTE FORMULA_0458 0 0 0.0 25.5000 ECU_ADDRESS 0x3FC958 /end MEASUREMENT
/begin MEASUREMENT msg_timer_26of32_ "Timer Meldung" UBYTE FORMULA_0458 0 0 0.0 25.5000 ECU_ADDRESS 0x3FC959 /end MEASUREMENT
/begin MEASUREMENT msg_timer_27of32_ "Timer Meldung" UBYTE FORMULA_0458 0 0 0.0 25.5000 ECU_ADDRESS 0x3FC95A /end MEASUREMENT
/begin MEASUREMENT msg_timer_28of32_ "Timer Meldung" UBYTE FORMULA_0458 0 0 0.0 25.5000 ECU_ADDRESS 0x3FC95B /end MEASUREMENT
/begin MEASUREMENT msg_timer_29of32_ "Timer Meldung" UBYTE FORMULA_0458 0 0 0.0 25.5000 ECU_ADDRESS 0x3FC95C /end MEASUREMENT
/begin MEASUREMENT msg_timer_30of32_ "Timer Meldung" UBYTE FORMULA_0458 0 0 0.0 25.5000 ECU_ADDRESS 0x3FC95D /end MEASUREMENT
/begin MEASUREMENT msg_timer_31of32_ "Timer Meldung" UBYTE FORMULA_0458 0 0 0.0 25.5000 ECU_ADDRESS 0x3FC95E /end MEASUREMENT
/begin MEASUREMENT msg_timer_32of32_ "Timer Meldung" UBYTE FORMULA_0458 0 0 0.0 25.5000 ECU_ADDRESS 0x3FC95F /end MEASUREMENT
/begin MEASUREMENT msg_send_buf "Sendebuffer" ULONG FORMULA_0000 0 0 0.0 4294967295.0000 ECU_ADDRESS 0x3FC960 /end MEASUREMENT
/begin MEASUREMENT msg_clr_buf "Clear Sendebuffer" ULONG FORMULA_0000 0 0 0.0 4294967295.0000 ECU_ADDRESS 0x3FC964 /end MEASUREMENT
/begin MEASUREMENT msg_exd_timeout_1of2_ "Timeout" UWORD FORMULA_0062 0 0 0.0 65535.0000 ECU_ADDRESS 0x3FC968 /end MEASUREMENT
/begin MEASUREMENT msg_exd_timeout_2of2_ "Timeout" UWORD FORMULA_0062 0 0 0.0 65535.0000 ECU_ADDRESS 0x3FC96A /end MEASUREMENT
/begin MEASUREMENT msg_bos_kl15 "BOS-Meldg. bei Klemmenwechsel" UBYTE FORMULA_0973 0 0 0.0 255.0 ECU_ADDRESS 0x3FC96C /end MEASUREMENT
/begin MEASUREMENT msg_rec_rtime_1of2_ "Repeattime" UBYTE FORMULA_0232 0 0 0.0 255.0000 ECU_ADDRESS 0x3FC96D /end MEASUREMENT
/begin MEASUREMENT msg_rec_rtime_2of2_ "Repeattime" UBYTE FORMULA_0232 0 0 0.0 255.0000 ECU_ADDRESS 0x3FC96E /end MEASUREMENT
/* ------------------ Abschnitt erzeugt aus mvac.dat ------------------ */
/begin CHARACTERISTIC K_MVAC_P_OBD_TIME_ML "Diagnosefreigabe via time_ml" VALUE 0x74998 TKW_VV_VV_UW 100.0 FORMULA_0021 0.0 655.0000 FORMAT "%5.2" /end CHARACTERISTIC
/begin CHARACTERISTIC K_MVAC_P_DIAG_MIN "Unter Grenze Unterdruck-MVAC | EN: Lower limit, brake-booster vacuum [mbar]" VALUE 0x7499A TKW_VV_VV_SW 100.0 FORMULA_0984 -1100.0000 200.0000 /end CHARACTERISTIC
/begin CHARACTERISTIC K_MVAC_P_DIAG_MAX "Obere Grenze Unterdruck-MVAC | EN: Upper limit, brake-booster vacuum [mbar]" VALUE 0x7499C TKW_VV_VV_SW 100.0 FORMULA_0984 -1100.0000 200.0000 /end CHARACTERISTIC
/begin CHARACTERISTIC K_MVAC_P_OBD_PDIFF_ROH_TAU "Zeitkonstante fuer mvac_p_obd_pdiff_roh-Filterwert | EN: Time constant for mvac_p_diag_pdiff_roh filter value" VALUE 0x7499E TKW_VV_VV_UW 100.0 FORMULA_0985 0.0050 327.6700 FORMAT "%5.2" /end CHARACTERISTIC
/begin CHARACTERISTIC K_MVAC_P_OBD_PDIFF_TAU "Zeitkonstante fuer mvac_p_diag_pdiff-Filterwert | EN: Time constant for mvac_p_diag_pdiff filter value" VALUE 0x749A0 TKW_VV_VV_UW 100.0 FORMULA_0985 0.0050 327.6700 FORMAT "%5.2" /end CHARACTERISTIC
/begin CHARACTERISTIC K_MVAC_P_OBD_PDIFF_DELAY "Zeitverzoegerung fuer Berechnung von mvac_p_obd_pdiff_roh | EN: Time delay for calculating mvac_p_diag_pdiff_roh" VALUE 0x749A2 TKW_VV_VV_UW 100.0 FORMULA_0117 0.0 325.0000 FORMAT "%5.2" /end CHARACTERISTIC
/begin CHARACTERISTIC K_MVAC_P_OBD_PDIFF_POS "Maximale Differenz zum Modell | EN: Maximale Differenz zum Modell" VALUE 0x749A4 TKW_VV_VV_SW 100.0 FORMULA_0986 -1100.0000 2000.0000 FORMAT "%6.3" /end CHARACTERISTIC
/begin CHARACTERISTIC K_MVAC_P_OBD_PDIFF_NEG "minimale Differenz zum Modell | EN: minimale Differenz zum M o-dell" VALUE 0x749A6 TKW_VV_VV_SW 100.0 FORMULA_0986 -1100.0000 2000.0000 FORMAT "%6.3" /end CHARACTERISTIC
/begin CHARACTERISTIC K_MVAC_P_OBD_PDIFF_TMOT "minimale Differenz zum Modell | EN: minimale Differenz zum M o-dell" VALUE 0x749A8 TKW_VV_VV_SW 100.0 FORMULA_0987 -50.0000 2000.0000 FORMAT "%6.3" /end CHARACTERISTIC
/begin CHARACTERISTIC K_MVAC_P_SENSOR_STEIGUNG "Steigung des Drucksensors | EN: Pressure-sensor slope [mbar/V]" VALUE 0x749AA TKW_VV_VV_SW 100.0 FORMULA_0988 -409.6000 275.0000 FORMAT "%6.3" /end CHARACTERISTIC
/begin CHARACTERISTIC K_MVAC_P_SENSOR_OFFSET "Offset des Drucksensors | EN: Pressure-sensor offset [mbar]" VALUE 0x749AC TKW_VV_VV_SW 100.0 FORMULA_0986 0.0 625.0000 FORMAT "%6.3" /end CHARACTERISTIC
/begin CHARACTERISTIC K_MVAC_ML_TAU "Tau fuer mvac_ml_psens PT1-Glied | EN: Tau fuer mvac_ml_psens PT1-Glied" VALUE 0x749AE TKW_VV_VV_UW 100.0 FORMULA_0989 0.0050 327.6700 FORMAT "%6.3" /end CHARACTERISTIC
/begin CHARACTERISTIC K_MVAC_ML_MIN "Schwelle Luftmassenstrom | EN: Schwelle Luftmassenstrom" VALUE 0x749B0 TKW_VV_VV_SW 100.0 FORMULA_0112 -100.0000 1400.0000 FORMAT "%4.1" /end CHARACTERISTIC
/begin CHARACTERISTIC K_MVAC_ELUP_ST_DEL "Zeitverzoegerung fuer Berechnung von mvac_ml_sr_rsv_psens | EN: Zeitverzoegerung fuer B e- rechnung von mvac_ml_sr_rsv_psens" VALUE 0x749B2 TKW_VV_VV_UW 100.0 FORMULA_0117 0.0 325.0000 FORMAT "%5.2" /end CHARACTERISTIC
/begin CHARACTERISTIC K_MVAC_P_TAU "Filterkonstante fuer den Unterdruck-MVAC | EN: Filterkonstante fuer den Unterdruck-MVAC" VALUE 0x749B4 TKW_VV_VV_UB 100.0 FORMULA_0651 0.0051 1.2800 /end CHARACTERISTIC
/begin CHARACTERISTIC K_MVAC_ML_CFG "Software-Schalter mvac_ml_sr | EN: 0x00 mvac_ml_sr_rsv_mess 0x01 mvac_ml_sr_rsv_psens ELSE undef Software-Schalter mvac_ml_sr" VALUE 0x749B5 TKW_VV_VV_UB 100.0 FORMULA_0990 0.0 255.0 /end CHARACTERISTIC
/begin CHARACTERISTIC K_MVAC_HYS_MIN "Filterschwelle Differenzdruck | EN: Filterschwelle Differenzdruck" VALUE 0x749B6 TKW_VV_VV_SW 100.0 FORMULA_0077 -2000.0000 2000.0000 FORMAT "%4.1" /end CHARACTERISTIC
/begin CHARACTERISTIC K_MVAC_HYS_MAX "Filterschwelle Differenzdruck | EN: Filterschwelle Differenzdruck" VALUE 0x749B8 TKW_VV_VV_SW 100.0 FORMULA_0077 -2000.0000 2000.0000 FORMAT "%4.1" /end CHARACTERISTIC
/begin CHARACTERISTIC K_MVAC_DEL_RSV "Verzug Schliesszeit RSV | EN: Verzug Schliesszeit RSV" VALUE 0x749BA TKW_VV_VV_UW 100.0 FORMULA_0117 0.0 325.0000 FORMAT "%5.2" /end CHARACTERISTIC
/begin CHARACTERISTIC K_MVAC_AL_SRMV "Durchflusswert SR/Mvac | EN: Durchflusswert SR/Mvac" VALUE 0x749BC TKW_VV_VV_SW 100.0 FORMULA_0991 0.0 6.4000 FORMAT "%6.3" /end CHARACTERISTIC
/begin CHARACTERISTIC K_MVAC_ML_SR_MIN "Schwelle Luftmassenstrom | EN: Air mass flow threshold [kg/h]" VALUE 0x749BE TKW_VV_VV_SW 100.0 FORMULA_0112 -100.0000 1400.0000 FORMAT "%4.1" /end CHARACTERISTIC
/begin CHARACTERISTIC K_MVAC_ML_SR_MAX "Schwelle Luftmassenstrom | EN: Air mass flow threshold [kg/h]" VALUE 0x749C0 TKW_VV_VV_SW 100.0 FORMULA_0112 -100.0000 1400.0000 FORMAT "%4.1" /end CHARACTERISTIC
/begin CHARACTERISTIC K_MVAC_MLRF_SR_SPERRE "Ausgabesperre fuer mvac_rf_sr ueber time_ml | EN: Output lock for mvac_rf_sr via time_ml [s]" VALUE 0x749C2 TKW_VV_VV_UW 100.0 FORMULA_0021 0.0 655.0000 FORMAT "%5.2" /end CHARACTERISTIC
/begin CHARACTERISTIC K_MVAC_ML_AEB_POS "Aenderungsbegrenzung positiv fuer mvac_ml_sr | EN: Positive rate limit for mvac_ml_sr [kg/h]" VALUE 0x749C4 TKW_VV_VV_UW 100.0 FORMULA_0992 0.0 200.0000 FORMAT "%5.2" /end CHARACTERISTIC
/begin CHARACTERISTIC K_MVAC_ML_AEB_NEG "Aenderungsbegrenzung negativ fuer mvac_ml_sr | EN: Negative rate limit for mvac_ml_sr [kg/h]" VALUE 0x749C6 TKW_VV_VV_UW 100.0 FORMULA_0992 0.0 200.0000 FORMAT "%5.2" /end CHARACTERISTIC
/begin CHARACTERISTIC K_MVAC_PDIFF_UM_BEGR_MIN "Min-Begrenzung Differenzdruck Mastervac/Umgebung | EN: Minimum limit, differential pressure brake booster/ambient [mbar]" VALUE 0x749C8 TKW_VV_VV_SW 100.0 FORMULA_0077 -1100.0000 200.0000 FORMAT "%4.1" /end CHARACTERISTIC
/begin CHARACTERISTIC K_MVAC_PDIFF_UM_BEGR_MAX "Max-Begrenzung Differenzdruck Mastervac/Umgebung | EN: Maximum limit, differential pressure brake booster/ambient [mbar]" VALUE 0x749CA TKW_VV_VV_SW 100.0 FORMULA_0077 -1100.0000 200.0000 FORMAT "%4.1" /end CHARACTERISTIC
/begin CHARACTERISTIC K_MVAC_AL_UMMV_STAT "Durchflusswert BKV stationaer | EN: Brake-booster steady-state flow value [1/2^20]" VALUE 0x749CC TKW_VV_VV_SW 100.0 FORMULA_0993 0.0 31.2500 FORMAT "%5.2" /end CHARACTERISTIC
/begin CHARACTERISTIC K_MVAC_AL_LECK "Durchflusswert BKV Leckluft | EN: Brake-booster leakage flow value [1/2^20]" VALUE 0x749CE TKW_VV_VV_SW 100.0 FORMULA_0994 0.0 312.5000 FORMAT "%4.1" /end CHARACTERISTIC
/begin CHARACTERISTIC K_MVAC_DEL_BLS "Verzug S_BLS bis can_brp_grad | EN: Delay from brake-light signal to brake-pressure gradient [s]" VALUE 0x749D0 TKW_VV_VV_UW 100.0 FORMULA_0117 0.0 325.0000 FORMAT "%5.2" /end CHARACTERISTIC
/begin CHARACTERISTIC K_MVAC_AL_BLS "dynamischer Durchflusswert MVAC zu Beginn S_BLS | EN: Dynamic brake-booster flow value at start of brake-light signal [(kg/h)/mbar]" VALUE 0x749D2 TKW_VV_VV_SW 100.0 FORMULA_0980 0.0 2.0000 FORMAT "%5.2" /end CHARACTERISTIC
/begin CHARACTERISTIC K_MVAC_ML_INTEGRATOR_TAU "Tau fuer mvac_ml-Integrator | EN: Time constant for mvac_ml integrator [s]" VALUE 0x749D4 TKW_VV_VV_UW 100.0 FORMULA_0985 0.0050 40.0000 FORMAT "%5.2" /end CHARACTERISTIC
/begin CHARACTERISTIC K_MVAC_BRPGRAD_SW "Aufloeseschwelle brp_grad fuer AQ-Eingriff | EN: Brake-pressure gradient release threshold for air cross-section intervention [bar/s]" VALUE 0x749D6 TKW_VV_VV_SW 100.0 FORMULA_0140 -5000.0000 5000.0000 /end CHARACTERISTIC
/begin CHARACTERISTIC K_MVAC_V "Volumen Mastervac | EN: Brake-booster volume [ccm]" VALUE 0x749D8 TKW_VV_VV_SL 100.0 FORMULA_0995 0.0 1000000.0000 FORMAT "%4.1" /end CHARACTERISTIC
/begin CHARACTERISTIC K_MVAC_N_MIN_B "Mindest-n fuer MVAC-LLS-AQ-B2-Eingriff bei Bremsung | EN: Minimum engine speed for brake-booster idle-valve bank 2 intervention during braking [Upm]" VALUE 0x749DC TKW_VV_VV_SW 100.0 FORMULA_0006 0.0 10000.0000 /end CHARACTERISTIC
/begin CHARACTERISTIC K_MVAC_BRP_GRAD_RAMPE "Zeitfaktor Abregelrampe | EN: Time factor for ramp-down [s]" VALUE 0x749DE TKW_VV_VV_SW 100.0 FORMULA_0117 0.0 150.0000 FORMAT "%5.2" /end CHARACTERISTIC
/begin CHARACTERISTIC K_MVAC_PDIFF_FILTER_TAU "Tau fuer mvac_pdiff_filter PT1-Glied | EN: Time constant for mvac_pdiff_filter PT1 element [s]" VALUE 0x749E0 TKW_VV_VV_UW 100.0 FORMULA_0989 0.0050 327.6700 FORMAT "%6.3" /end CHARACTERISTIC
/begin CHARACTERISTIC K_MVAC_N_MIN_SA "Mindest-n fuer MVAC-LLS-AQ-B2-Eingriff bei SA | EN: Minimum engine speed for brake-booster idle-valve bank 2 intervention at start [Upm]" VALUE 0x749E2 TKW_VV_VV_SW 100.0 FORMULA_0006 0.0 10000.0000 /end CHARACTERISTIC
/begin CHARACTERISTIC K_MVAC_RMP_FKT_SA_BEGR "Rampenhoechstwert fuer Zeitfaktor bei SA | EN: Ramp maximum for time factor at start [s]" VALUE 0x749E4 TKW_VV_VV_SW 100.0 FORMULA_0117 0.0 150.0000 FORMAT "%5.2" /end CHARACTERISTIC
/begin CHARACTERISTIC K_MVAC_PL_TIME_LIMIT "Timer-Limit fuer MVAC-Prueflauf | EN: Timer limit for brake-booster test run [s]" VALUE 0x749E6 TKW_VV_VV_UB 100.0 FORMULA_0232 0.0 255.0000 /end CHARACTERISTIC
/begin CHARACTERISTIC K_MVAC_PL_TIME_MS "Motorstandzeit bei MVAC-Prueflauf | EN: Engine-off time for brake-booster test run [s]" VALUE 0x749E7 TKW_VV_VV_UB 100.0 FORMULA_0232 0.0 255.0000 /end CHARACTERISTIC
/begin CHARACTERISTIC K_MVAC_PL_PDIFF "Unterdruck-Delta zw. Sensor- und Modellwert bei PL-Start | EN: Vacuum delta between sensor and model at test-run start [mbar]" VALUE 0x749E8 TKW_VV_VV_SW 100.0 FORMULA_0077 -1100.0000 200.0000 FORMAT "%4.1" /end CHARACTERISTIC
/begin CHARACTERISTIC K_MVAC_PL_P_IO_SW "IO-Schwell Unterdrucksensorwert nach 60 sec. | EN: OK threshold of vacuum sensor value after 60 s [mbar]" VALUE 0x749EA TKW_VV_VV_SW 100.0 FORMULA_0077 -1100.0000 200.0000 FORMAT "%4.1" /end CHARACTERISTIC
/begin CHARACTERISTIC K_MVAC_P_OBD_SA_TIME_MIN "Mindestzeit fuer Uebernahme von mvac_p_obd_pdiff_roh bei B_SA | EN: Mindestzeit fuer Uebernahme von mvac_p_obd_pdiff_roh bei B_SA" VALUE 0x749EC TKW_VV_VV_UW 100.0 FORMULA_0117 0.0 325.0000 FORMAT "%5.2" /end CHARACTERISTIC
/begin CHARACTERISTIC K_MVAC_P_OBD_LL_TIME_MIN "Mindestzeit fuer Uebernahme von mvac_p_obd_pdiff_roh bei B_ZUST_LL | EN: Mindestzeit fuer Uebernahme von mvac_p_obd_pdiff_roh bei B_ZUST_LL" VALUE 0x749EE TKW_VV_VV_UW 100.0 FORMULA_0021 0.0 655.0000 FORMAT "%5.2" /end CHARACTERISTIC
/begin CHARACTERISTIC KL_MVAC_ML_WICHT "Kennlinie Wichtungsfaktor von mvac_ml_sr_rsv | EN: Curve: weighting factor from mvac_ml_sr_rsv" CURVE 0x749F0 TKL_SW_VV_SW 100.0 FORMULA_0755 -128.0000 127.0000
 /begin AXIS_DESCR STD_AXIS ml_b2 FORMULA_0112 8 -100.0000 1400.0000 FORMAT "%4.1" /end AXIS_DESCR
 FORMAT "%5.2" /end CHARACTERISTIC
/begin CHARACTERISTIC KL_MVAC_ELUP "Kennlinie Wichtungsfaktor von mvac_ml_sr_rsv | EN: Curve: weighting factor from mvac_ml_sr_rsv" CURVE 0x74A12 TKL_SW_VV_SW 100.0 FORMULA_0979 -32.0000 32.0000
 /begin AXIS_DESCR STD_AXIS mvac_pdiff_um FORMULA_0077 6 -1100.0000 200.0000 FORMAT "%4.1" /end AXIS_DESCR
 FORMAT "%7.4" /end CHARACTERISTIC
/begin CHARACTERISTIC KL_MVAC_BRP_GRAD "Kennlinie Durchflusswert MVAC von can_brp_grad | EN: Curve: brake-booster flow value from brake-pressure gradient" CURVE 0x74A2C TKL_SW_VV_SW 100.0 FORMULA_0980 0.0 2.0000 /begin AXIS_DESCR STD_AXIS can_brp_grad FORMULA_0140 14 -5000.0000 5000.0000 /end AXIS_DESCR FORMAT "%5.2" /end CHARACTERISTIC
/begin CHARACTERISTIC KL_MVAC_PDIFF_B "Kennlinie Betrag AQ-Eingriff bei Bremsung | EN: Curve: air cross-section intervention amount during braking" CURVE 0x74A66 TKL_SW_VV_UW 100.0 FORMULA_0147 0.0 6500.0000
 /begin AXIS_DESCR STD_AXIS mvac_pdiff_filter FORMULA_0077 5 -2000.0000 2000.0000 FORMAT "%4.1" /end AXIS_DESCR
 FORMAT "%4.1" /end CHARACTERISTIC
/begin CHARACTERISTIC KL_MVAC_PDIFF_SA "Kennlinie Betrag AQ-Eingriff Bank 2 bei SA | EN: Curve: air cross-section intervention amount bank 2 at start" CURVE 0x74A7C TKL_SW_VV_UW 100.0 FORMULA_0147 0.0 6500.0000
 /begin AXIS_DESCR STD_AXIS mvac_pdiff_filter FORMULA_0077 5 -2000.0000 2000.0000 FORMAT "%4.1" /end AXIS_DESCR
 FORMAT "%4.1" /end CHARACTERISTIC
/begin CHARACTERISTIC KF_MVAC_ELUP_ETA "ELUP-Wirkungsgrad auf MVAC-Modellberechnung | EN: Vacuum-pump efficiency in brake-booster model calculation" MAP 0x74A92 TKF_SW_SW_UB 100.0 FORMULA_0643 0.0 1.9921
 /begin AXIS_DESCR STD_AXIS pumg FORMULA_0077 6 400.0000 1200.0000 FORMAT "%4.1" /end AXIS_DESCR
 /begin AXIS_DESCR STD_AXIS tumg FORMULA_0023 5 -50.0000 170.0000 FORMAT "%4.1" /end AXIS_DESCR
/end CHARACTERISTIC
/begin MEASUREMENT mvac_m "Luftmasse im Mastervac" SWORD FORMULA_0975 0 0 0.0 30.0000 ECU_ADDRESS 0x3FC970 /end MEASUREMENT
/begin MEASUREMENT mvac_ml_psens "Luftmassenstrom neg. MVAC -> LLS, pos LLS -> MVAC" SLONG FORMULA_0976 0 0 -1000.0000 1000.0000 ECU_ADDRESS 0x3FC974 /end MEASUREMENT
/begin MEASUREMENT mvac_ml_sr_rsv_psens_roh "Luftmassenstrom neg. MVAC -> LLS, pos LLS -> MVAC" SLONG FORMULA_0976 0 0 -1000.0000 1000.0000 ECU_ADDRESS 0x3FC978 /end MEASUREMENT
/begin MEASUREMENT mvac_ml_sr_rsv_psens "Luftmassenstrom neg. MVAC -> LLS, pos LLS -> MVAC" SWORD FORMULA_0112 0 0 -1000.0000 1000.0000 ECU_ADDRESS 0x3FC97C /end MEASUREMENT
/begin MEASUREMENT mvac_elup_st_del "Zeitverzoegerung fuer Berechnung von mvac_ml_sr_rsv_psens" UWORD FORMULA_0117 0 0 0.0 325.0000 ECU_ADDRESS 0x3FC97E /end MEASUREMENT
/begin MEASUREMENT mvac_pos_rsv "Zustand Rueckschlagventil(Modell)" UBYTE FORMULA_0977 0 0 0.0 255.0 ECU_ADDRESS 0x3FC980 /end MEASUREMENT
/begin MEASUREMENT mvac_pos_rsv_mess "Zustand Rueckschlagventil(Sensor)" UBYTE FORMULA_0977 0 0 0.0 255.0 ECU_ADDRESS 0x3FC981 /end MEASUREMENT
/begin MEASUREMENT mvac_del_rsv "Delay Schliesszeitverzug RSV(Modell)" UWORD FORMULA_0117 0 0 0.0 325.0000 ECU_ADDRESS 0x3FC982 /end MEASUREMENT
/begin MEASUREMENT mvac_del_rsv_mess "Delay Schliesszeitverzug RSV(Sensor)" UWORD FORMULA_0117 0 0 0.0 325.0000 ECU_ADDRESS 0x3FC984 /end MEASUREMENT
/begin MEASUREMENT mvac_pdiff_sr_roh "Differenzdruck(Modell) Saugrohr/Mastervac direkt" SWORD FORMULA_0077 0 0 -1200.0000 1200.0000 ECU_ADDRESS 0x3FC986 /end MEASUREMENT
/begin MEASUREMENT mvac_pdiff_sr_mess_roh "Differenzdruck(Sensor) Saugrohr/Mastervac direkt" SWORD FORMULA_0077 0 0 -1200.0000 1200.0000 ECU_ADDRESS 0x3FC988 /end MEASUREMENT
/begin MEASUREMENT mvac_pdiff_sr "Differenzdruck(Modell) Saugrohr/Mastervac mit Hysterese" SWORD FORMULA_0077 0 0 -1200.0000 1200.0000 ECU_ADDRESS 0x3FC98A /end MEASUREMENT
/begin MEASUREMENT mvac_pdiff_sr_mess "Differenzdruck(Sensor) Saugrohr/Mastervac mit Hysterese" SWORD FORMULA_0077 0 0 -1200.0000 1200.0000 ECU_ADDRESS 0x3FC98C /end MEASUREMENT
/begin MEASUREMENT mvac_ml_sr_rsv_roh "Luftmassenstromrohwert(Modell) Saugrohr/Mvac" SWORD FORMULA_0112 0 0 -100.0000 1400.0000 ECU_ADDRESS 0x3FC98E /end MEASUREMENT
/begin MEASUREMENT mvac_ml_sr_rsv_mess_roh "Luftmassenstromrohwert(Sensor) Saugrohr/Mvac" SWORD FORMULA_0112 0 0 -100.0000 1400.0000 ECU_ADDRESS 0x3FC990 /end MEASUREMENT
/begin MEASUREMENT mvac_ml_sr_rsv "Luftmassenstrom(Modell) vom Saugrohr, differenzdruckabhaengig" SWORD FORMULA_0112 0 0 -100.0000 1400.0000 ECU_ADDRESS 0x3FC992 /end MEASUREMENT
/begin MEASUREMENT mvac_ml_sr_rsv_mess "Luftmassenstrom(Senor) vom Saugrohr, differenzdruckabhaengig" SWORD FORMULA_0112 0 0 -100.0000 1400.0000 ECU_ADDRESS 0x3FC994 /end MEASUREMENT
/begin MEASUREMENT mvac_pdiff_filter "Differenzdruck Umgebung/Mastervac gefiltert" SWORD FORMULA_0077 0 0 -2000.0000 2000.0000 ECU_ADDRESS 0x3FC996 /end MEASUREMENT
/begin MEASUREMENT mvac_ml_leck "Luftmassenstrom zum Mastervac durch Leckluft" SLONG FORMULA_0976 0 0 -5.0000 5.0000 ECU_ADDRESS 0x3FC998 /end MEASUREMENT
/begin MEASUREMENT mvac_ml_brp "Luftmassenstrom zum Mastervac durch brp" SLONG FORMULA_0976 0 0 -700.0000 250.0000 ECU_ADDRESS 0x3FC99C /end MEASUREMENT
/begin MEASUREMENT mvac_ml_brp_grad "Luftmassenstrom zum Mastervac durch brp_grad" SLONG FORMULA_0976 0 0 -700.0000 250.0000 ECU_ADDRESS 0x3FC9A0 /end MEASUREMENT
/begin MEASUREMENT mvac_al_ummv_stat "Produkt aus K_MVAC_AL_UMMV_STAT und can_brp" SLONG FORMULA_0978 0 0 0.0 1000.0000 ECU_ADDRESS 0x3FC9A4 /end MEASUREMENT
/begin MEASUREMENT mvac_ml_elup "Luftmassenstrom ELUP/Mastervac" SWORD FORMULA_0979 0 0 -32.0000 32.0000 ECU_ADDRESS 0x3FC9A8 /end MEASUREMENT
/begin MEASUREMENT mvac_del_bls "Delay S_BLS bis can_brp_grad" UWORD FORMULA_0117 0 0 0.0 325.0000 ECU_ADDRESS 0x3FC9AA /end MEASUREMENT
/begin MEASUREMENT mvac_al_brp_grad "dynamischer Durchflusswert MVAC" SWORD FORMULA_0980 0 0 0.0 2.0000 ECU_ADDRESS 0x3FC9AC /end MEASUREMENT
/begin MEASUREMENT mvac_ml_sr "Luftmassenstrom vom Saugrohr Bank2 zum Mastervac" SWORD FORMULA_0112 0 0 -200.0000 200.0000 ECU_ADDRESS 0x3FC9AE /end MEASUREMENT
/begin MEASUREMENT mvac_spr_fkt_brp_grad "Wert Zeitfaktor Abregelrampe durch brp_grad" SWORD FORMULA_0117 0 0 0.0 150.0000 ECU_ADDRESS 0x3FC9B2 /end MEASUREMENT
/begin MEASUREMENT mvac_ml_elup_sr "Minimum aus ml_elup und ml_sr" SLONG FORMULA_0976 0 0 -250.0000 250.0000 ECU_ADDRESS 0x3FC9B4 /end MEASUREMENT
/begin MEASUREMENT mvac_ml "Gesamtluftmassenstrom zum Mastervac" SLONG FORMULA_0976 0 0 -250.0000 700.0000 ECU_ADDRESS 0x3FC9B8 /end MEASUREMENT
/begin MEASUREMENT mvac_ml_old "Gesamtluftmassenstrom zum Mastervac t(-5ms)" SLONG FORMULA_0976 0 0 -250.0000 700.0000 ECU_ADDRESS 0x3FC9BC /end MEASUREMENT
/begin MEASUREMENT mvac_p_modell_grad "Gradient Modelldruck Mastervac" SLONG FORMULA_0981 0 0 -1300000.0000 1300000.0000 ECU_ADDRESS 0x3FC9C4 /end MEASUREMENT
/begin MEASUREMENT mvac_aq_bre_b "AQ-Offset LL-Steller Bank 2 bei Bremsung" UWORD FORMULA_0147 0 0 0.0 6500.0000 ECU_ADDRESS 0x3FC9C8 /end MEASUREMENT
/begin MEASUREMENT mvac_rmp_fkt_sa_start "MVAC Rampe bei SA gestartet" UBYTE FORMULA_0982 0 0 0.0 255.0 ECU_ADDRESS 0x3FC9CA /end MEASUREMENT
/begin MEASUREMENT mvac_rmp_fkt_sa_frei "MVAC Rampe bei SA grundsaetzlich bereit" UBYTE FORMULA_0983 0 0 0.0 255.0 ECU_ADDRESS 0x3FC9CB /end MEASUREMENT
/begin MEASUREMENT mvac_rmp_fkt_sa_pos "Wert Zeitfaktor steigende Abregelrampe durch B_SA" SWORD FORMULA_0117 0 0 0.0 150.0000 ECU_ADDRESS 0x3FC9CC /end MEASUREMENT
/begin MEASUREMENT mvac_rmp_fkt_sa_neg "Wert Zeitfaktor fallende Abregelrampe durch B_SA" SWORD FORMULA_0117 0 0 0.0 150.0000 ECU_ADDRESS 0x3FC9CE /end MEASUREMENT
/begin MEASUREMENT mvac_rmp_fkt_sa "Wert Zeitfaktor Abregelrampe durch B_SA" SWORD FORMULA_0117 0 0 0.0 150.0000 ECU_ADDRESS 0x3FC9D0 /end MEASUREMENT
/begin MEASUREMENT mvac_aq_bre_sa "AQ-Offset LL-Steller Bank 2 bei SA" UWORD FORMULA_0147 0 0 0.0 6500.0000 ECU_ADDRESS 0x3FC9D2 /end MEASUREMENT
/begin MEASUREMENT mvac_p_ad "Eingelesener Spannungswert fuer Unterdruck-MVAC" SWORD FORMULA_0123 0 0 0.0 1023.0000 ECU_ADDRESS 0x3FC9D4 /end MEASUREMENT
/begin MEASUREMENT mvac_p_roh "Ungefilterter Messwert" SWORD FORMULA_0077 0 0 -1100.0000 200.0000 ECU_ADDRESS 0x3FC9D6 /end MEASUREMENT
/begin MEASUREMENT mvac_p_obd_pdiff_roh "Unterschied Differenzdruck Modell zu Sensor" SWORD FORMULA_0077 0 0 -1100.0000 200.0000 ECU_ADDRESS 0x3FC9D8 /end MEASUREMENT
/begin MEASUREMENT mvac_p_obd_pdiff_pos_roh "Unterschied Differenzdruck Modell > Sensor bei LL bzw. SA" SWORD FORMULA_0077 0 0 -1100.0000 200.0000 ECU_ADDRESS 0x3FC9DA /end MEASUREMENT
/begin MEASUREMENT mvac_p_obd_pdiff_neg_roh "Unterschied Differenzdruck Modell < Sensor" SWORD FORMULA_0077 0 0 -1100.0000 200.0000 ECU_ADDRESS 0x3FC9DC /end MEASUREMENT
/begin MEASUREMENT mvac_p_obd_pdiff_pos "Unterschied Differenzdruck Modellwert > Sensorwert" SWORD FORMULA_0077 0 0 -1100.0000 200.0000 ECU_ADDRESS 0x3FC9DE /end MEASUREMENT
/begin MEASUREMENT mvac_p_obd_pdiff_neg "Unterschied Differenzdruck Modellwert < Sensorwert" SWORD FORMULA_0077 0 0 -1100.0000 200.0000 ECU_ADDRESS 0x3FC9EC /end MEASUREMENT
/begin MEASUREMENT mvac_p_obd_pdiff_delay "Zeitverzoegerung fuer Berechnung von mvac_p_obd_pdiff_roh" UWORD FORMULA_0117 0 0 0.0 325.0000 ECU_ADDRESS 0x3FC9EE /end MEASUREMENT
/begin MEASUREMENT mvac_pl_st "Prueflaufstatus MVAC" UBYTE FORMULA_0681 0 0 0.0 255.0 ECU_ADDRESS 0x3FC9F0 /end MEASUREMENT
/begin MEASUREMENT mvac_pl_timer "Timer fuer MVAC-Prueflauf" UBYTE FORMULA_0232 0 0 0.0 255.0000 ECU_ADDRESS 0x3FC9F1 /end MEASUREMENT
/begin MEASUREMENT mvac_pl_p_sensor_ml "PL Differenzdruck Sensorwert bei B_ZUST_ML" SWORD FORMULA_0077 0 0 -1100.0000 200.0000 ECU_ADDRESS 0x3FC9F2 /end MEASUREMENT
/begin MEASUREMENT mvac_pl_p_modell_ml "PL Differenzdruck Modellwert bei B_ZUST_ML" SWORD FORMULA_0077 0 0 -1100.0000 200.0000 ECU_ADDRESS 0x3FC9F4 /end MEASUREMENT
/begin MEASUREMENT mvac_pl_p_sensor_ms_ende "PL Differenzdruck Sensor-Endwert bei B_ZUST_MS" SWORD FORMULA_0077 0 0 -1100.0000 200.0000 ECU_ADDRESS 0x3FC9F6 /end MEASUREMENT
/begin MEASUREMENT mvac_pl_p_sensor_ms_start "PL Differenzdruck Sensor-Startwert bei B_ZUST_MS" SWORD FORMULA_0077 0 0 -1100.0000 200.0000 ECU_ADDRESS 0x3FC9F8 /end MEASUREMENT
/* ------------------ Abschnitt erzeugt aus nwm.dat ------------------ */
/begin MEASUREMENT Nwm_var_s.state "Status" UBYTE FORMULA_0003 0 0 0.0 255.0000 ECU_ADDRESS 0x3F8E6C /end MEASUREMENT
/begin MEASUREMENT Nwm_var_s.flags1 "Flags" UBYTE FORMULA_0003 0 0 0.0 255.0000 ECU_ADDRESS 0x3F8E6D /end MEASUREMENT
/begin MEASUREMENT Nwm_var_s.MsgDest "Ring-Destination" UBYTE FORMULA_1006 0 0 0.0 255.0 ECU_ADDRESS 0x3F8E70 /end MEASUREMENT
/begin MEASUREMENT Nwm_var_s.MsgTyp "Ring-Typ" UBYTE FORMULA_1007 0 0 0.0 255.0 ECU_ADDRESS 0x3F8E71 /end MEASUREMENT
/begin MEASUREMENT Nwm_var_s.MsgUser1 "Ring-User1" UBYTE FORMULA_0003 0 0 0.0 255.0000 ECU_ADDRESS 0x3F8E72 /end MEASUREMENT
/begin MEASUREMENT Nwm_var_s.MsgUser2 "Ring-User2" UBYTE FORMULA_0003 0 0 0.0 255.0000 ECU_ADDRESS 0x3F8E73 /end MEASUREMENT
/begin MEASUREMENT Nwm_var_s.timeCounter "Timeout counter" UBYTE FORMULA_0003 0 0 0.0 255.0000 ECU_ADDRESS 0x3F8E7C /end MEASUREMENT
/begin MEASUREMENT Nwm_var_s.nwmAction "State of statemachine" UBYTE FORMULA_1008 0 0 0.0 255.0 ECU_ADDRESS 0x3F8E7D /end MEASUREMENT
/begin MEASUREMENT Nwm_var_s.successorEcu "Successor ECU" UBYTE FORMULA_1006 0 0 0.0 255.0 ECU_ADDRESS 0x3F8E7E /end MEASUREMENT
/begin MEASUREMENT Nwm_var_s.txEcuNumber "Logical sender number" UBYTE FORMULA_1006 0 0 0.0 255.0 ECU_ADDRESS 0x3F8E7F /end MEASUREMENT
/begin MEASUREMENT Nwm_var_s.rxTxCounter "counter for rx/tx" UBYTE FORMULA_0003 0 0 0.0 255.0000 ECU_ADDRESS 0x3F8E80 /end MEASUREMENT
/begin MEASUREMENT nwm_ecu_nr "ECU-Nummer" UBYTE FORMULA_0003 0 0 0.0 255.0000 ECU_ADDRESS 0x3F8E94 /end MEASUREMENT
/begin MEASUREMENT nwm_RecvCopyMsgUser_1of6_ "MsgUser" UBYTE FORMULA_0003 0 0 0.0 255.0000 ECU_ADDRESS 0x3F8EA4 /end MEASUREMENT
/begin MEASUREMENT nwm_RecvCopyMsgUser_2of6_ "MsgUser" UBYTE FORMULA_0003 0 0 0.0 255.0000 ECU_ADDRESS 0x3F8EA5 /end MEASUREMENT
/begin MEASUREMENT nwm_RecvCopyMsgUser_3of6_ "MsgUser" UBYTE FORMULA_0003 0 0 0.0 255.0000 ECU_ADDRESS 0x3F8EA6 /end MEASUREMENT
/begin MEASUREMENT nwm_RecvCopyMsgUser_4of6_ "MsgUser" UBYTE FORMULA_0003 0 0 0.0 255.0000 ECU_ADDRESS 0x3F8EA7 /end MEASUREMENT
/begin MEASUREMENT nwm_RecvCopyMsgUser_5of6_ "MsgUser" UBYTE FORMULA_0003 0 0 0.0 255.0000 ECU_ADDRESS 0x3F8EA8 /end MEASUREMENT
/begin MEASUREMENT nwm_RecvCopyMsgUser_6of6_ "MsgUser" UBYTE FORMULA_0003 0 0 0.0 255.0000 ECU_ADDRESS 0x3F8EA9 /end MEASUREMENT
/begin MEASUREMENT nwm_weckverursacher "Weck-Verursacher" UBYTE FORMULA_1006 0 0 0.0 255.0 ECU_ADDRESS 0x3F8EAA /end MEASUREMENT
/* ------------------ Abschnitt erzeugt aus o2_obd.dat ------------------ */
/begin CHARACTERISTIC K_O2_OBD_CFG "Freigabe O2-Beladung | EN: Freigabe O2-Beladung" VALUE 0x74D4C TKW_VV_VV_UW 100.0 FORMULA_0798 0.0 1.0 FORMAT "%5.2" /end CHARACTERISTIC
/begin CHARACTERISTIC K_O2_LA_TRIM_CFG "Verknuepfung mit Trimmregelung | EN: Verknuepfung mit Trimmregelung" VALUE 0x74D4E TKW_VV_VV_UW 100.0 FORMULA_1029 0.0 1.0 FORMAT "%5.2" /end CHARACTERISTIC
/begin CHARACTERISTIC K_O2_OBD_TMOT "min. TMOT-Schwelle f. O2-Beladung | EN: min. TMOT-Schwelle f. O2-Beladung" VALUE 0x74D50 TKW_VV_VV_SW 100.0 FORMULA_0023 -50.0000 170.0000 FORMAT "%4.1" /end CHARACTERISTIC
/begin CHARACTERISTIC K_O2_OBD_RF_MAX "max. relative F�llung f. O2-Beladung | EN: max. relative Fï¿½llung f. O2-Beladung" VALUE 0x74D52 TKW_VV_VV_SW 100.0 FORMULA_0007 0.0 2.0000 FORMAT "%6.3" /end CHARACTERISTIC
/begin CHARACTERISTIC K_O2_OBD_RF_MIN_HYS "Hysterese f.die min. RF-Schwelle | EN: Hysterese f.die min. RF-Schwelle" VALUE 0x74D54 TKW_VV_VV_SW 100.0 FORMULA_0007 0.0 2.0000 FORMAT "%6.3" /end CHARACTERISTIC
/begin CHARACTERISTIC K_O2_OBD_TKAT_MIN "min. KAT-Temperatur f. O2-Beladung | EN: min. KAT-Temperatur f. O2-Beladung" VALUE 0x74D56 TKW_VV_VV_SW 100.0 FORMULA_0023 -50.0000 1200.0000 FORMAT "%4.1" /end CHARACTERISTIC
/begin CHARACTERISTIC K_O2_OBD_TKAT_HYS "min. KAT-Temperatur f. O2-Beladung | EN: min. KAT-Temperatur f. O2-Beladung" VALUE 0x74D58 TKW_VV_VV_SW 100.0 FORMULA_0800 -1000.0000 1000.0000 FORMAT "%4.1" /end CHARACTERISTIC
/begin CHARACTERISTIC K_O2_OBD_TKAT_MAX "max. KAT-Temperatur f. O2-Beladung | EN: max. KAT-Temperatur f. O2-Beladung" VALUE 0x74D5A TKW_VV_VV_SW 100.0 FORMULA_0023 -50.0000 1200.0000 FORMAT "%4.1" /end CHARACTERISTIC
/begin CHARACTERISTIC K_O2_OBD_N_MAX "max. Drehzahl f. O2-Beladung | EN: max. Drehzahl f. O2-Beladung" VALUE 0x74D5C TKW_VV_VV_SW 100.0 FORMULA_0006 0.0 10000.0000 /end CHARACTERISTIC
/begin CHARACTERISTIC K_O2_OBD_N_MIN "min. Drehzahl f. O2-Beladung | EN: Minimum engine speed for O2 loading [Upm]" VALUE 0x74D5E TKW_VV_VV_SW 100.0 FORMULA_0006 0.0 10000.0000 /end CHARACTERISTIC
/begin CHARACTERISTIC K_O2_OBD_RF_T_MIN "Verzoegerungszeit bei RF-MIN-Unterschreitung | EN: Delay time when relative charge drops below minimum [s]" VALUE 0x74D60 TKW_VV_VV_UW 100.0 FORMULA_1030 0.0 65.5350 FORMAT "%5.2" /end CHARACTERISTIC
/begin CHARACTERISTIC K_O2_OBD_DYN_T_VERZ "Verzoegerungszeit bei Dynamik | EN: Delay time during dynamics [s]" VALUE 0x74D62 TKW_VV_VV_UW 100.0 FORMULA_1030 0.0 65.5350 FORMAT "%5.2" /end CHARACTERISTIC
/begin CHARACTERISTIC K_O2_OBD_PUMG_MIN "min. Umgebungsdruck | EN: Minimum ambient pressure [mbar]" VALUE 0x74D64 TKW_VV_VV_SW 100.0 FORMULA_0077 400.0000 1200.0000 FORMAT "%4.1" /end CHARACTERISTIC
/begin CHARACTERISTIC K_O2_OBD_LAVK_AD_OFFS_MAX "max. OFFEST-Sonden-Adapt fuer Pulsfreigabe | EN: Maximum sensor offset adaptation for pulse enable [mV]" VALUE 0x74D66 TKW_VV_VV_SW 100.0 FORMULA_0532 -5000.0000 5000.0000 /end CHARACTERISTIC
/begin CHARACTERISTIC K_O2_OBD_LAVK_AD_OFFS_MIN "min. OFFEST-Sonden-Adapt. fuer Pulsfreigabe | EN: Minimum sensor offset adaptation for pulse enable [mV]" VALUE 0x74D68 TKW_VV_VV_SW 100.0 FORMULA_0532 -5000.0000 5000.0000 /end CHARACTERISTIC
/begin CHARACTERISTIC K_O2_OBD_LAM_SOLL_OFFS "LAM-SOLL-OFFSET - zusaetzliche Anfettung/Abmagerung | EN: Target-lambda offset - additional enrichment/enleanment" VALUE 0x74D6A TKW_VV_VV_SW 100.0 FORMULA_0025 -0.0100 0.0100 FORMAT "%6.3" /end CHARACTERISTIC
/begin CHARACTERISTIC K_KAT_OBD_CFG "Freigabe KAT-Diagnose" VALUE 0x74D6C TKW_VV_VV_UW 100.0 FORMULA_0798 0.0 1.0 FORMAT "%5.2" /end CHARACTERISTIC
/begin CHARACTERISTIC K_KAT_OBD_M_HUB_CNT "min. Anzahl - Zwangsanregung | EN: Minimum number - forced excitation" VALUE 0x74D6E TKW_VV_VV_UW 100.0 FORMULA_0010 0.0 65535.0000 /end CHARACTERISTIC
/begin CHARACTERISTIC K_KAT_OBD_LANK_MW_MAX "max. Mittelwert LAM-NKAT | EN: max. Mittelwert LAM-NKAT" VALUE 0x74D70 TKW_VV_VV_UW 100.0 FORMULA_0025 0.0 3.9990 FORMAT "%6.3" /end CHARACTERISTIC
/begin CHARACTERISTIC K_KAT_OBD_LANK_MW_MIN "min. Mittelwert LAM-NKAT | EN: min. Mittelwert LAM-NKAT" VALUE 0x74D72 TKW_VV_VV_UW 100.0 FORMULA_0025 0.0 3.9990 FORMAT "%6.3" /end CHARACTERISTIC
/begin CHARACTERISTIC K_KAT_OBD_LANK_MW_DELTA_MAX "max. Diff d. akt. Wertes zum MW | EN: max. Diff d. akt. Wertes zum MW" VALUE 0x74D74 TKW_VV_VV_UW 100.0 FORMULA_0025 0.0 3.9990 FORMAT "%6.3" /end CHARACTERISTIC
/begin CHARACTERISTIC K_KAT_OBD_LANK_MW_DIFF_MAX "max. Diff d. MW zum vorherigen Zyklus | EN: max. Diff d. MW zum vorher i-gen Zyklus" VALUE 0x74D76 TKW_VV_VV_UW 100.0 FORMULA_0025 0.0 3.9990 FORMAT "%6.3" /end CHARACTERISTIC
/begin CHARACTERISTIC K_KAT_OBD_ZYKL_CNT_MAX "max. Anzahl fuer Diag.Zyklus | EN: max. Anzahl fuer Diag.Zyklus" VALUE 0x74D78 TKW_VV_VV_UW 100.0 FORMULA_0010 0.0 65535.0000 /end CHARACTERISTIC
/begin CHARACTERISTIC K_KAT_OBD_VERH "Schwelle f. Wichtungsverhaeltnis - Diag.Wert | EN: Schwelle f. Wichtungsverhaeltnis - Diag.Wert" VALUE 0x74D7A TKW_VV_VV_UW 100.0 FORMULA_0075 0.0 20.0000 FORMAT "%6.3" /end CHARACTERISTIC
/begin CHARACTERISTIC K_KAT_OBD_VERH_SCHWELLE "max. Schelle f. Anzahl d. verworfenen Messungen | EN: max. Schelle f. Anzahl d. verworfenen Messungen" VALUE 0x74D7C TKW_VV_VV_UW 100.0 FORMULA_0010 0.0 65535.0000 /end CHARACTERISTIC
/begin CHARACTERISTIC K_KAT_OBD_WERT_MODE6 "max. KAT-Diag.-Schwelle fuer MODE6 | EN: max. KAT-Diag.-Schwelle fuer MODE6" VALUE 0x74D7E TKW_VV_VV_UW 100.0 FORMULA_0025 0.0 3.9990 FORMAT "%6.3" /end CHARACTERISTIC
/begin CHARACTERISTIC K_KAT_OBD_TABG_T_VERZ "Verzoegerungszeit bei Abgas-Temperaturgradient | EN: Verzoegerungszeit bei A b-gas-Temperaturgradient" VALUE 0x74D80 TKW_VV_VV_UW 100.0 FORMULA_0021 0.0 655.0000 FORMAT "%5.2" /end CHARACTERISTIC
/begin CHARACTERISTIC K_O2_OBD_ML_MIN "min. aufsummierte Luftmassenstr. nach SA_WE | EN: min. aufsummierte Luftmassenstr. nach SA_WE" VALUE 0x74D82 TKW_VV_VV_UW 100.0 FORMULA_0832 0.0 65535.0000 /end CHARACTERISTIC
/begin CHARACTERISTIC K_O2_OBD_SA_ML_MAX "max. aufsummierte Luftmassenstr. in SA | EN: max. aufsummierte Luftmassenstr. in SA" VALUE 0x74D84 TKW_VV_VV_UW 100.0 FORMULA_0832 0.0 65535.0000 /end CHARACTERISTIC
/begin CHARACTERISTIC K_O2_OBD_WE_ML_MIN "min. aufsum. Luftmassenstr. nach SA_WE f. lange SA | EN: min. aufsum. Luftmassenstr. nach SA_WE f. lange SA" VALUE 0x74D86 TKW_VV_VV_UW 100.0 FORMULA_0832 0.0 65535.0000 /end CHARACTERISTIC
/begin CHARACTERISTIC K_O2_OBD_V_MIN "min. Fahrzeuggeschwindigkeit | EN: min. Fahrzeuggeschwindigkeit" VALUE 0x74D88 TKW_VV_VV_SW 100.0 FORMULA_0078 -80.0000 360.0000 FORMAT "%4.1" /end CHARACTERISTIC
/begin CHARACTERISTIC K_O2_OBD_V_MAX "max. Fahrzeuggeschwindigkeit | EN: max. Fahrzeuggeschwindigkeit" VALUE 0x74D8A TKW_VV_VV_SW 100.0 FORMULA_0078 -80.0000 360.0000 FORMAT "%4.1" /end CHARACTERISTIC
/begin CHARACTERISTIC K_LAVK_OBD_DYN_CFG "Freigabe dynamische Sonden-VKAT-Diagnose | EN: 0 inaktiv 1 aktiv Freigabe dynamische Sonden -VKAT- Diagnose" VALUE 0x74D8C TKW_VV_VV_UW 100.0 FORMULA_0798 0.0 1.0 FORMAT "%5.2" /end CHARACTERISTIC
/begin CHARACTERISTIC K_LAVK_OBD_DYN_MW_HYS "Delta f. min/max LA-Regeleingriff-Ermittlung" VALUE 0x74D8E TKW_VV_VV_UW 100.0 FORMULA_0025 0.0 1.9900 FORMAT "%6.3" /end CHARACTERISTIC
/begin CHARACTERISTIC K_LAVK_OBD_DYN_MW_MAX "max. LAM-IST-Toleranzschwelle" VALUE 0x74D90 TKW_VV_VV_UW 100.0 FORMULA_0025 0.0 3.9990 FORMAT "%6.3" /end CHARACTERISTIC
/begin CHARACTERISTIC K_LAVK_OBD_DYN_MW_MIN "min. LAM-IST-Toleranzschwelle" VALUE 0x74D92 TKW_VV_VV_UW 100.0 FORMULA_0025 0.0 3.9990 FORMAT "%6.3" /end CHARACTERISTIC
/begin CHARACTERISTIC K_LAVK_OBD_DYN_AMPL_MAX "Offset fuer max. Amplitude" VALUE 0x74D94 TKW_VV_VV_UW 100.0 FORMULA_0025 0.0 1.0000 FORMAT "%6.3" /end CHARACTERISTIC
/begin CHARACTERISTIC K_LAVK_OBD_DYN_AMPL_MIN "Offset fuer min. Amplitude" VALUE 0x74D96 TKW_VV_VV_UW 100.0 FORMULA_0025 0.0 1.0000 FORMAT "%6.3" /end CHARACTERISTIC
/begin CHARACTERISTIC K_LAVK_OBD_DYN_AMPL_CNT "Anzahl gueltiger Perioden f. MW" VALUE 0x74D98 TKW_VV_VV_UW 100.0 FORMULA_0010 1.0000 65535.0000 /end CHARACTERISTIC
/begin CHARACTERISTIC K_LAVK_OBD_DYN_NORM_CNT "Anzahl gueltiger MW f. Diagnosewert | EN: Anzahl gueltiger MW f. Diagnosewert Dynamische Diagnose der stetigen Lambdasonde Seite 217 von 629" VALUE 0x74D9A TKW_VV_VV_UW 100.0 FORMULA_0010 1.0000 65535.0000 /end CHARACTERISTIC
/begin CHARACTERISTIC K_LAVK_OBD_DYN_LAM_REG_MIN "min. Regelabweichung bei dyn. LA-Diagnose | EN: min. Regelabweichung bei dyn. LA -Diagnose" VALUE 0x74D9C TKW_VV_VV_UW 100.0 FORMULA_0024 0.0 1.9990 FORMAT "%7.4" /end CHARACTERISTIC
/begin CHARACTERISTIC K_LAVK_OBD_DYN_LAM_REG_MAX "max. Regelabweichung bei dyn. LA-Diagnose | EN: max. Regelabweichung bei dyn. LA -Diagnose" VALUE 0x74D9E TKW_VV_VV_UW 100.0 FORMULA_0024 0.0 1.9990 FORMAT "%7.4" /end CHARACTERISTIC
/begin CHARACTERISTIC K_O2_OBD_T_ML "Verzoegerungszeit - O2-Beladung | EN: Verzoegerungszeit - O2-Beladung" VALUE 0x74DA0 TKW_VV_VV_UW 100.0 FORMULA_0799 0.0 65535.0000 /end CHARACTERISTIC
/begin CHARACTERISTIC K_LAVK_OBD_DYN_KAT_EXD_N_SOLL "Prueflauf - angeforderte Drehzahl | EN: Prueflauf - angeforderte Drehzahl" VALUE 0x74DA2 TKW_VV_VV_SW 100.0 FORMULA_0006 0.0 10000.0000 /end CHARACTERISTIC
/begin CHARACTERISTIC K_LAVK_OBD_DYN_KAT_EXD_T "Prueflauf Freigabezeit | EN: Prueflauf Freigabezeit" VALUE 0x74DA4 TKW_VV_VV_UW 100.0 FORMULA_0932 0.0 655.3500 /end CHARACTERISTIC
/begin CHARACTERISTIC K_LAVK_OBD_DYN_KAT_EXD_RF_MAX "max. relative F�llung fuer Ansteuerung dyn. Diag. u. KAT-Diag. | EN: max. relative Füllung fuer Ansteuer ung dyn. Diag. u. KAT-Diag." VALUE 0x74DA6 TKW_VV_VV_SW 100.0 FORMULA_0007 0.0 2.0000 FORMAT "%6.3" /end CHARACTERISTIC
/begin CHARACTERISTIC K_LAVK_OBD_DYN_KAT_EXD_RF_MIN "min. relative F�llung fuer Ansteuerung dyn. Diag. u. KAT-Diag. | EN: min. relative Füllung fuer Ansteuerung dyn. Diag. u. KAT-Diag." VALUE 0x74DA8 TKW_VV_VV_SW 100.0 FORMULA_0007 0.0 2.0000 FORMAT "%6.3" /end CHARACTERISTIC
/begin CHARACTERISTIC K_LAVK_OBD_DYN_KAT_EXD_LAM_SOLL "LAM-SOLL-OFFSET - zusaetzliche Anfettung/Abmagerung | EN: LAM-SOLL-OFFSET-zusätzliche Anfettung/Abmagerung" VALUE 0x74DAA TKW_VV_VV_SW 100.0 FORMULA_0025 -0.1000 0.1000 FORMAT "%6.3" /end CHARACTERISTIC
/begin CHARACTERISTIC K_LAVK_OBD_DYN_KAT_EXD_FETT_LAM_SOLL "LAM-SOLL-OFFSET - um NKAT-Signal nach FETT vor Diagnose zu bringen | EN: LAM-SOLL-OFFSET-um NKAT -Signal nach FETT vor Diagnose zu bringen" VALUE 0x74DAC TKW_VV_VV_SW 100.0 FORMULA_0025 -0.2000 0.2000 FORMAT "%6.3" /end CHARACTERISTIC
/begin CHARACTERISTIC K_LAVK_OBD_DYN_KAT_EXD_LANK_FETT "FETT-Schwelle fuer Freigabe KAT/dyn.Sondendiag. bei ext. Ansteuerung | EN: FETT-Schelle für Freigabe KAT/ dyn.Sondendiag. bei ext. Ansteuerung" VALUE 0x74DAE TKW_VV_VV_UW 100.0 FORMULA_0532 0.0 1200.0000 /end CHARACTERISTIC
/begin CHARACTERISTIC K_O2_OBD_DYN_DELTA_RF "rf Differenz fuer Dynamikerkennung | EN: rf Differnez fuer Dynamikerkennung" VALUE 0x74DB0 TKW_VV_VV_SW 100.0 FORMULA_0007 0.0 2.0000 FORMAT "%6.3" /end CHARACTERISTIC
/begin CHARACTERISTIC K_O2_OBD_DYN_DELTA_PUMP_RF "rf Differenz fuer Dynamikerkennung gegen Pumpen | EN: rf Differnez fuer Dynamikerkennung gegen Pumpen" VALUE 0x74DB2 TKW_VV_VV_SW 100.0 FORMULA_0007 0.0 2.0000 FORMAT "%6.3" /end CHARACTERISTIC
/begin CHARACTERISTIC K_O2_OBD_DYN_DELTA_CNT "Anzahl der dyn Triggers bis status gesetzt wird | EN: Anzahl der dyn Triggers bis status gesetzt wird" VALUE 0x74DB4 TKW_VV_VV_UW 100.0 FORMULA_0083 0.0 65535.0000 FORMAT "%5.2" /end CHARACTERISTIC
/begin CHARACTERISTIC K_O2_OBD_DYN_CNT_INC "Counter increments fuer rf_dyn_o2_cnt | EN: Counter increments fuer rf_dyn_o2_cnt" VALUE 0x74DB6 TKW_VV_VV_UB 100.0 FORMULA_0033 0.0 255.0000 /end CHARACTERISTIC
/begin CHARACTERISTIC K_O2_OBD_DYN_RF_T "Sperrzeit fuer Ruecknahme rf-Dynamik | EN: Sperrzeit fuer Ruecknahme rf-Dynamik" VALUE 0x74DB8 TKW_VV_VV_UW 100.0 FORMULA_0021 0.0 655.3500 FORMAT "%5.2" /end CHARACTERISTIC
/begin CHARACTERISTIC K_O2_OBD_TEV_MAX "max. Konzentration aus AKF | EN: max. Konzentration aus AKF" VALUE 0x74DBA TKW_VV_VV_UW 100.0 FORMULA_0556 0.0 2.0000 FORMAT "%7.4" /end CHARACTERISTIC
/begin CHARACTERISTIC K_LAVK_OBD_DYN_WERT_MODE6 "Diagnoseschwelle fuer MODE6 | EN: Diagnoseschwelle fuer MODE6" VALUE 0x74DBC TKW_VV_VV_UW 100.0 FORMULA_0025 0.0 3.9990 FORMAT "%6.3" /end CHARACTERISTIC
/begin CHARACTERISTIC K_LAVK_OBD_DYN_TE_VOL_SUM "min. TE-Volumenstrom in Motorlauf | EN: Min. TE-Volumenstrom in Motorlauf" VALUE 0x74DBE TKW_VV_VV_UW 100.0 FORMULA_1031 0.0 2184.5000 FORMAT "%5.2" /end CHARACTERISTIC
/begin CHARACTERISTIC K_KAT_OBD_LANK_MW_HYS_CHK1 "Hys. um kat_obd_lank_mw f. Verifikation CHK1 | EN: Hys. um kat_obd_lank_mw f. Verifikation CHK1" VALUE 0x74DC0 TKW_VV_VV_UW 100.0 FORMULA_0025 0.0 0.0100 FORMAT "%6.3" /end CHARACTERISTIC
/begin CHARACTERISTIC KL_O2_OBD_RF_MIN "min. relative F�llung f. O2-Beladung | EN: min. relative Füllung f. O2 -Beladung" CURVE 0x74DC2 TKL_SW_VV_SW 100.0 FORMULA_0007 0.0 2.0000 /begin AXIS_DESCR STD_AXIS n FORMULA_0006 5 0.0 10000.0000 /end AXIS_DESCR FORMAT "%6.3" /end CHARACTERISTIC
/begin CHARACTERISTIC KL_KAT_OBD_IO_VERZ "Verzoegerung d. Heilung abh. vom Diag.Wert | EN: Delay of healing depending on diagnosis value" CURVE 0x74DD8 TKL_UW_VV_UW 100.0 FORMULA_0021 0.0 655.0000
 /begin AXIS_DESCR STD_AXIS kat_obd_wert_nv FORMULA_0025 5 0.0 3.9990 FORMAT "%6.3" /end AXIS_DESCR
 FORMAT "%5.2" /end CHARACTERISTIC
/begin CHARACTERISTIC KL_LAVK_OBD_DYN_IO_VERZ "Verzoegerung d. Heilung abh. vom Diag.Wert | EN: Delay of healing depending on diagnosis value" CURVE 0x74DEE TKL_UW_VV_UW 100.0 FORMULA_0021 0.0 655.0000
 /begin AXIS_DESCR STD_AXIS lavk_obd_dyn_wert_nv FORMULA_0025 5 0.0 3.9990 FORMAT "%6.3" /end AXIS_DESCR
 FORMAT "%5.2" /end CHARACTERISTIC
/begin CHARACTERISTIC KL_LAVK_OBD_DYN_WERT_MAX "Diagnoseschwelle - dyn. Sondendiagnose | EN: Diagnosis threshold - dynamic sensor diagnosis" CURVE 0x74E04 TKL_UW_VV_UW 100.0 FORMULA_0025 0.0 3.9990 /begin AXIS_DESCR STD_AXIS te_c_akf FORMULA_0556 4 0.0 2.0000 FORMAT "%7.4" /end AXIS_DESCR FORMAT "%6.3" /end CHARACTERISTIC
/begin CHARACTERISTIC KL_LAVK_OBD_DYN_RF_MIN "min. relative F�llung f. dyn. Sondendiag. | EN: Minimum relative charge for dynamic sensor diagnosis" CURVE 0x74E16 TKL_SW_VV_SW 100.0 FORMULA_0007 0.0 2.0000 /begin AXIS_DESCR STD_AXIS n FORMULA_0006 5 0.0 10000.0000 /end AXIS_DESCR FORMAT "%6.3" /end CHARACTERISTIC
/begin CHARACTERISTIC KL_KAT_OBD_WERT_MAX "Diagnoseschwelle - max. KAT-Diag. | EN: Diagnoseschwelle - max. KAT-Diag." CURVE 0x74E2C TKL_UW_VV_UW 100.0 FORMULA_0025 0.0 3.9990 /begin AXIS_DESCR STD_AXIS te_c_akf FORMULA_0556 4 0.0 2.0000 FORMAT "%7.4" /end AXIS_DESCR FORMAT "%6.3" /end CHARACTERISTIC
/begin CHARACTERISTIC KL_KAT_OBD_GESAMT_MAX "Diagnoseschwelle - Gesamtsystem-KAT-Diag. | EN: Diagnoseschwelle - Gesamt-system-KAT-Diag." CURVE 0x74E3E TKL_UW_VV_UW 100.0 FORMULA_0025 0.0 3.9990 /begin AXIS_DESCR STD_AXIS te_c_akf FORMULA_0556 4 0.0 2.0000 FORMAT "%7.4" /end AXIS_DESCR FORMAT "%6.3" /end CHARACTERISTIC
/begin CHARACTERISTIC KL_LAVK_OBD_DYN_GESAMT_MAX "Diagnoseschwelle - Gesamtsystem-dyn. Sonden-Diag." CURVE 0x74E50 TKL_UW_VV_UW 100.0 FORMULA_0025 0.0 3.9990 /begin AXIS_DESCR STD_AXIS te_c_akf FORMULA_0556 4 0.0 2.0000 FORMAT "%7.4" /end AXIS_DESCR FORMAT "%6.3" /end CHARACTERISTIC
/begin CHARACTERISTIC KF_KAT_OBD_INT_WICHT "Wichtungskennfeld | EN: Wichtungskennfeld" MAP 0x74E62 TKF_SW_SW_UW 100.0 FORMULA_0075 0.0 2.0000 /begin AXIS_DESCR STD_AXIS n FORMULA_0006 6 0.0 10000.0000 /end AXIS_DESCR /begin AXIS_DESCR STD_AXIS rf FORMULA_0007 6 0.0 2.0000 FORMAT "%6.3" /end AXIS_DESCR FORMAT "%6.3" /end CHARACTERISTIC
/begin CHARACTERISTIC KF_KAT_OBD_WICHT_GESAMT "Ermittlung - Gesamtsystemdiagnosewert | EN: Determination - overall system diagnosis value" MAP 0x74EC4 TKF_UW_UW_UW 100.0 FORMULA_0025 0.0 3.9990
 /begin AXIS_DESCR STD_AXIS kat_obd_wert_b1 FORMULA_0025 10 0.0 3.9990 FORMAT "%6.3" /end AXIS_DESCR
 /begin AXIS_DESCR STD_AXIS kat_obd_wert_b2 FORMULA_0025 10 0.0 3.9990 FORMAT "%6.3" /end AXIS_DESCR
 FORMAT "%6.3" /end CHARACTERISTIC
/begin CHARACTERISTIC KF_LAVK_OBD_DYN_AMPL_MAX "max. zulaessige Amplitude" MAP 0x74FB6 TKF_SW_SW_UW 100.0 FORMULA_0025 0.0 1.0000 /begin AXIS_DESCR STD_AXIS n FORMULA_0006 6 0.0 10000.0000 /end AXIS_DESCR /begin AXIS_DESCR STD_AXIS rf FORMULA_0007 6 0.0 2.0000 FORMAT "%6.3" /end AXIS_DESCR FORMAT "%6.3" /end CHARACTERISTIC
/begin CHARACTERISTIC KF_LAVK_OBD_DYN_AMPL_MIN "min. zulaessige Amplitude" MAP 0x75018 TKF_SW_SW_UW 100.0 FORMULA_0025 0.0 1.0000 /begin AXIS_DESCR STD_AXIS n FORMULA_0006 6 0.0 10000.0000 /end AXIS_DESCR /begin AXIS_DESCR STD_AXIS rf FORMULA_0007 6 0.0 2.0000 FORMAT "%6.3" /end AXIS_DESCR FORMAT "%6.3" /end CHARACTERISTIC
/begin CHARACTERISTIC KF_LAVK_OBD_DYN_WICHT_GESAMT "Ermittlung - Gesamtsystemdiagnosewert | EN: Determination - overall system diagnosis value" MAP 0x7507A TKF_UW_UW_UW 100.0 FORMULA_0025 0.0 3.9990
 /begin AXIS_DESCR STD_AXIS lavk_obd_dyn_wert_b1 FORMULA_0025 10 0.0 3.9990 FORMAT "%6.3" /end AXIS_DESCR
 /begin AXIS_DESCR STD_AXIS lavk_obd_dyn_wert_b2 FORMULA_0025 10 0.0 3.9990 FORMAT "%6.3" /end AXIS_DESCR
 FORMAT "%6.3" /end CHARACTERISTIC
/begin MEASUREMENT o2_obd_st_b1 "O2-OBD-Status" UWORD FORMULA_0083 0 0 0.0 65535.0000 ECU_ADDRESS 0x3FCB0C /end MEASUREMENT
/begin MEASUREMENT o2_obd_st_b2 "O2-OBD-Status" UWORD FORMULA_0083 0 0 0.0 65535.0000 ECU_ADDRESS 0x3FCB0E /end MEASUREMENT
/begin MEASUREMENT o2_lam_soll_pus_b1 "Aktivierung Pulsgenerator" UWORD FORMULA_1014 0 0 0.0 65535.0 ECU_ADDRESS 0x3FCB0C BIT_MASK 0x1 /end MEASUREMENT
/begin MEASUREMENT o2_lam_soll_pus_b2 "Aktivierung Pulsgenerator" UWORD FORMULA_1014 0 0 0.0 65535.0 ECU_ADDRESS 0x3FCB0E BIT_MASK 0x1 /end MEASUREMENT
/begin MEASUREMENT o2_lam_soll_fett_hub_trig_b1 "FETT-HUB nach Adaption" UWORD FORMULA_1015 0 0 0.0 65535.0 ECU_ADDRESS 0x3FCB0C BIT_MASK 0x2 /end MEASUREMENT
/begin MEASUREMENT o2_lam_soll_fett_hub_trig_b2 "FETT-HUB nach Adaption" UWORD FORMULA_1015 0 0 0.0 65535.0 ECU_ADDRESS 0x3FCB0E BIT_MASK 0x2 /end MEASUREMENT
/begin MEASUREMENT o2_lam_soll_mager_hub_trig_b1 "MAGER-HUB nach Adaption" UWORD FORMULA_1016 0 0 0.0 65535.0 ECU_ADDRESS 0x3FCB0C BIT_MASK 0x4 /end MEASUREMENT
/begin MEASUREMENT o2_lam_soll_mager_hub_trig_b2 "MAGER-HUB nach Adaption" UWORD FORMULA_1016 0 0 0.0 65535.0 ECU_ADDRESS 0x3FCB0E BIT_MASK 0x4 /end MEASUREMENT
/begin MEASUREMENT o2_lam_soll_fett_hub_b1 "FETT-HUB" UWORD FORMULA_0836 0 0 0.0 65535.0 ECU_ADDRESS 0x3FCB0C BIT_MASK 0x8 /end MEASUREMENT
/begin MEASUREMENT o2_lam_soll_fett_hub_b2 "FETT-HUB" UWORD FORMULA_0836 0 0 0.0 65535.0 ECU_ADDRESS 0x3FCB0E BIT_MASK 0x8 /end MEASUREMENT
/begin MEASUREMENT o2_lam_soll_mager_hub_b1 "MAGER-HUB" UWORD FORMULA_0770 0 0 0.0 65535.0 ECU_ADDRESS 0x3FCB0C BIT_MASK 0x10 /end MEASUREMENT
/begin MEASUREMENT o2_lam_soll_mager_hub_b2 "MAGER-HUB" UWORD FORMULA_0770 0 0 0.0 65535.0 ECU_ADDRESS 0x3FCB0E BIT_MASK 0x10 /end MEASUREMENT
/begin MEASUREMENT o2_lam_soll_fett_ukp_b1 "Umkehrpunkt im FETT-Hub" UWORD FORMULA_1017 0 0 0.0 65535.0 ECU_ADDRESS 0x3FCB0C BIT_MASK 0x20 /end MEASUREMENT
/begin MEASUREMENT o2_lam_soll_fett_ukp_b2 "Umkehrpunkt im FETT-Hub" UWORD FORMULA_1017 0 0 0.0 65535.0 ECU_ADDRESS 0x3FCB0E BIT_MASK 0x20 /end MEASUREMENT
/begin MEASUREMENT o2_lam_soll_mager_ukp_b1 "Umkehrpunkt im MAGER-Hub" UWORD FORMULA_1018 0 0 0.0 65535.0 ECU_ADDRESS 0x3FCB0C BIT_MASK 0x40 /end MEASUREMENT
/begin MEASUREMENT o2_lam_soll_mager_ukp_b2 "Umkehrpunkt im MAGER-Hub" UWORD FORMULA_1018 0 0 0.0 65535.0 ECU_ADDRESS 0x3FCB0E BIT_MASK 0x40 /end MEASUREMENT
/begin MEASUREMENT o2_lam_soll_mager_per_b1 "Periodendauerberechnung auf MAGER-HUB" UWORD FORMULA_1019 0 0 0.0 65535.0 ECU_ADDRESS 0x3FCB0C BIT_MASK 0x80 /end MEASUREMENT
/begin MEASUREMENT o2_lam_soll_mager_per_b2 "Periodendauerberechnung auf MAGER-HUB" UWORD FORMULA_1019 0 0 0.0 65535.0 ECU_ADDRESS 0x3FCB0E BIT_MASK 0x80 /end MEASUREMENT
/begin MEASUREMENT o2_obd_dyn_t_verz_b1 "Verzoegerungszeit nach Dynamik" UWORD FORMULA_0106 0 0 0.0 65535.0 ECU_ADDRESS 0x3FCB0C BIT_MASK 0x100 /end MEASUREMENT
/begin MEASUREMENT o2_obd_dyn_t_verz_b2 "Verzoegerungszeit nach Dynamik" UWORD FORMULA_0106 0 0 0.0 65535.0 ECU_ADDRESS 0x3FCB0E BIT_MASK 0x100 /end MEASUREMENT
/begin MEASUREMENT o2_obd_tkat_min_b1 "TKAT-MIN-Schwelle" UWORD FORMULA_1020 0 0 0.0 65535.0 ECU_ADDRESS 0x3FCB0C BIT_MASK 0x200 /end MEASUREMENT
/begin MEASUREMENT o2_obd_tkat_min_b2 "TKAT-MIN-Schwelle" UWORD FORMULA_1020 0 0 0.0 65535.0 ECU_ADDRESS 0x3FCB0E BIT_MASK 0x200 /end MEASUREMENT
/begin MEASUREMENT o2_obd_rf_min_schwelle_b1 "RF-MIN-Schwelle" UWORD FORMULA_1021 0 0 0.0 65535.0 ECU_ADDRESS 0x3FCB0C BIT_MASK 0x400 /end MEASUREMENT
/begin MEASUREMENT o2_obd_rf_min_schwelle_b2 "RF-MIN-Schwelle" UWORD FORMULA_1021 0 0 0.0 65535.0 ECU_ADDRESS 0x3FCB0E BIT_MASK 0x400 /end MEASUREMENT
/begin MEASUREMENT o2_obd_t_sum_b1 "Periodendauer d. Zwangsanregung" UWORD FORMULA_0764 0 0 0.0 65535.0000 ECU_ADDRESS 0x3FCB10 /end MEASUREMENT
/begin MEASUREMENT o2_obd_t_sum_b2 "Periodendauer d. Zwangsanregung" UWORD FORMULA_0764 0 0 0.0 65535.0000 ECU_ADDRESS 0x3FCB12 /end MEASUREMENT
/begin MEASUREMENT o2_obd_t_mager_b1 "Zeit der MAGER-Beladung" UWORD FORMULA_0764 0 0 0.0 65535.0000 ECU_ADDRESS 0x3FCB14 /end MEASUREMENT
/begin MEASUREMENT o2_obd_t_mager_b2 "Zeit der MAGER-Beladung" UWORD FORMULA_0764 0 0 0.0 65535.0000 ECU_ADDRESS 0x3FCB16 /end MEASUREMENT
/begin MEASUREMENT o2_obd_t_fett_b1 "Zeit der FETT-Beladung" UWORD FORMULA_0764 0 0 0.0 65535.0000 ECU_ADDRESS 0x3FCB18 /end MEASUREMENT
/begin MEASUREMENT o2_obd_t_fett_b2 "Zeit der FETT-Beladung" UWORD FORMULA_0764 0 0 0.0 65535.0000 ECU_ADDRESS 0x3FCB1A /end MEASUREMENT
/begin MEASUREMENT o2_obd_period_cnt_b1 "Anzahl d. durchgefuehrten Zwangsperioden" UWORD FORMULA_0010 0 0 0.0 65535.0000 ECU_ADDRESS 0x3FCB1C /end MEASUREMENT
/begin MEASUREMENT o2_obd_period_cnt_b2 "Anzahl d. durchgefuehrten Zwangsperioden" UWORD FORMULA_0010 0 0 0.0 65535.0000 ECU_ADDRESS 0x3FCB1E /end MEASUREMENT
/begin MEASUREMENT o2_rf_min_schw_t_b1 "Verzoegerungszeit bei RF-MIN-Verletzung" UWORD FORMULA_0764 0 0 0.0 65535.0000 ECU_ADDRESS 0x3FCB20 /end MEASUREMENT
/begin MEASUREMENT o2_rf_min_schw_t_b2 "Verzoegerungszeit bei RF-MIN-Verletzung" UWORD FORMULA_0764 0 0 0.0 65535.0000 ECU_ADDRESS 0x3FCB22 /end MEASUREMENT
/begin MEASUREMENT o2_obd_dyn_t_b1 "Verzoegerungszeit bei Dynamik" UWORD FORMULA_0764 0 0 0.0 65535.0000 ECU_ADDRESS 0x3FCB24 /end MEASUREMENT
/begin MEASUREMENT o2_obd_dyn_t_b2 "Verzoegerungszeit bei Dynamik" UWORD FORMULA_0764 0 0 0.0 65535.0000 ECU_ADDRESS 0x3FCB26 /end MEASUREMENT
/begin MEASUREMENT o2_obd_lam_soll_offs_b1 "LAM-SOLL-OFFSET - zusaetzliche Anfettung/Abmagerung" SWORD FORMULA_0025 0 0 -2.0000 1.9990 ECU_ADDRESS 0x3FCB28 /end MEASUREMENT
/begin MEASUREMENT o2_obd_lam_soll_offs_b2 "LAM-SOLL-OFFSET - zusaetzliche Anfettung/Abmagerung" SWORD FORMULA_0025 0 0 -2.0000 1.9990 ECU_ADDRESS 0x3FCB2A /end MEASUREMENT
/begin MEASUREMENT kat_obd_st_b1 "KAT-Diagnose Status" UWORD FORMULA_0083 0 0 0.0 65535.0000 ECU_ADDRESS 0x3FCB2C /end MEASUREMENT
/begin MEASUREMENT kat_obd_st_b2 "KAT-Diagnose Status" UWORD FORMULA_0083 0 0 0.0 65535.0000 ECU_ADDRESS 0x3FCB2E /end MEASUREMENT
/begin MEASUREMENT kat_obd_fett_mager_b1 "Uebergang zu FETT nach MAGER" UWORD FORMULA_1022 0 0 0.0 65535.0 ECU_ADDRESS 0x3FCB2C BIT_MASK 0x1 /end MEASUREMENT
/begin MEASUREMENT kat_obd_fett_mager_b2 "Uebergang zu FETT nach MAGER" UWORD FORMULA_1022 0 0 0.0 65535.0 ECU_ADDRESS 0x3FCB2E BIT_MASK 0x1 /end MEASUREMENT
/begin MEASUREMENT kat_obd_lank_chk1_b1 "Verifikationscheck1" UWORD FORMULA_1023 0 0 0.0 65535.0 ECU_ADDRESS 0x3FCB2C BIT_MASK 0x2 /end MEASUREMENT
/begin MEASUREMENT kat_obd_lank_chk1_b2 "Verifikationscheck1" UWORD FORMULA_1023 0 0 0.0 65535.0 ECU_ADDRESS 0x3FCB2E BIT_MASK 0x2 /end MEASUREMENT
/begin MEASUREMENT kat_obd_lank_chk2_b1 "Verifikationscheck2" UWORD FORMULA_1024 0 0 0.0 65535.0 ECU_ADDRESS 0x3FCB2C BIT_MASK 0x4 /end MEASUREMENT
/begin MEASUREMENT kat_obd_lank_chk2_b2 "Verifikationscheck2" UWORD FORMULA_1024 0 0 0.0 65535.0 ECU_ADDRESS 0x3FCB2E BIT_MASK 0x4 /end MEASUREMENT
/begin MEASUREMENT kat_obd_io_verz_b1 "Verzoegerung Fehlerheilung" UWORD FORMULA_1025 0 0 0.0 65535.0 ECU_ADDRESS 0x3FCB2C BIT_MASK 0x8 /end MEASUREMENT
/begin MEASUREMENT kat_obd_io_verz_b2 "Verzoegerung Fehlerheilung" UWORD FORMULA_1025 0 0 0.0 65535.0 ECU_ADDRESS 0x3FCB2E BIT_MASK 0x8 /end MEASUREMENT
/begin MEASUREMENT kat_obd_wert_ermittlung_b1 "Diagnosewert-Ermittlung" UWORD FORMULA_1026 0 0 0.0 65535.0 ECU_ADDRESS 0x3FCB2C BIT_MASK 0x10 /end MEASUREMENT
/begin MEASUREMENT kat_obd_wert_ermittlung_b2 "Diagnosewert-Ermittlung" UWORD FORMULA_1026 0 0 0.0 65535.0 ECU_ADDRESS 0x3FCB2E BIT_MASK 0x10 /end MEASUREMENT
/begin MEASUREMENT kat_obd_tabg_t_verz_b1 "Verzoegerung Temperaturgradient Abgas" UWORD FORMULA_1027 0 0 0.0 65535.0 ECU_ADDRESS 0x3FCB2C BIT_MASK 0x20 /end MEASUREMENT
/begin MEASUREMENT kat_obd_tabg_t_verz_b2 "Verzoegerung Temperaturgradient Abgas" UWORD FORMULA_1027 0 0 0.0 65535.0 ECU_ADDRESS 0x3FCB2E BIT_MASK 0x20 /end MEASUREMENT
/begin MEASUREMENT kat_o2_per_cnt_passiv_b1 "akt, Zahl d. Zwangsperioden in PASSIV" UWORD FORMULA_0010 0 0 0.0 65535.0000 ECU_ADDRESS 0x3FCB30 /end MEASUREMENT
/begin MEASUREMENT kat_o2_per_cnt_passiv_b2 "akt, Zahl d. Zwangsperioden in PASSIV" UWORD FORMULA_0010 0 0 0.0 65535.0000 ECU_ADDRESS 0x3FCB32 /end MEASUREMENT
/begin MEASUREMENT kat_obd_zykl_cnt_b1 "Anzahl d. gueltigen Zyklen" UWORD FORMULA_0010 0 0 0.0 65535.0000 ECU_ADDRESS 0x3FCB34 /end MEASUREMENT
/begin MEASUREMENT kat_obd_zykl_cnt_b2 "Anzahl d. gueltigen Zyklen" UWORD FORMULA_0010 0 0 0.0 65535.0000 ECU_ADDRESS 0x3FCB36 /end MEASUREMENT
/begin MEASUREMENT kat_obd_lank_sum_b1 "aufsummierter NKAT-LA-Wert" ULONG FORMULA_1028 0 0 0.0 262143.9999 ECU_ADDRESS 0x3FCB38 /end MEASUREMENT
/begin MEASUREMENT kat_obd_lank_sum_b2 "aufsummierter NKAT-LA-Wert" ULONG FORMULA_1028 0 0 0.0 262143.9999 ECU_ADDRESS 0x3FCB3C /end MEASUREMENT
/begin MEASUREMENT kat_obd_t_cnt_b1 "Zaehler - aufsummierten NKAT-LA-Werte" UWORD FORMULA_0010 0 0 0.0 65535.0000 ECU_ADDRESS 0x3FCB40 /end MEASUREMENT
/begin MEASUREMENT kat_obd_t_cnt_b2 "Zaehler - aufsummierten NKAT-LA-Werte" UWORD FORMULA_0010 0 0 0.0 65535.0000 ECU_ADDRESS 0x3FCB42 /end MEASUREMENT
/begin MEASUREMENT kat_obd_lank_mw_b1 "gemittelter NKAT-LA-Wert" UWORD FORMULA_0025 0 0 0.0 3.9990 ECU_ADDRESS 0x3FCB44 /end MEASUREMENT
/begin MEASUREMENT kat_obd_lank_mw_b2 "gemittelter NKAT-LA-Wert" UWORD FORMULA_0025 0 0 0.0 3.9990 ECU_ADDRESS 0x3FCB46 /end MEASUREMENT
/begin MEASUREMENT kat_obd_lank_diff_b1 "Abweichung des akt. LANK-LA-Werts zum Mittelwert" UWORD FORMULA_0025 0 0 0.0 3.9990 ECU_ADDRESS 0x3FCB48 /end MEASUREMENT
/begin MEASUREMENT kat_obd_lank_diff_b2 "Abweichung des akt. LANK-LA-Werts zum Mittelwert" UWORD FORMULA_0025 0 0 0.0 3.9990 ECU_ADDRESS 0x3FCB4A /end MEASUREMENT
/begin MEASUREMENT kat_obd_lank_diff_sum_b1 "aufsummierte Abweichung d. akt. Werts zum Mittelwert" ULONG FORMULA_1028 0 0 0.0 262143.9999 ECU_ADDRESS 0x3FCB4C /end MEASUREMENT
/begin MEASUREMENT kat_obd_lank_diff_sum_b2 "aufsummierte Abweichung d. akt. Werts zum Mittelwert" ULONG FORMULA_1028 0 0 0.0 262143.9999 ECU_ADDRESS 0x3FCB50 /end MEASUREMENT
/begin MEASUREMENT kat_obd_lank_diff_sum_f_b1 "aufsummierte Abweichung zum MW - Zyklus FETT" ULONG FORMULA_1028 0 0 0.0 262143.9999 ECU_ADDRESS 0x3FCB54 /end MEASUREMENT
/begin MEASUREMENT kat_obd_lank_diff_sum_f_b2 "aufsummierte Abweichung zum MW - Zyklus FETT" ULONG FORMULA_1028 0 0 0.0 262143.9999 ECU_ADDRESS 0x3FCB58 /end MEASUREMENT
/begin MEASUREMENT kat_obd_lank_diff_sum_m_b1 "aufsummierte Abweichung zum MW - Zyklus MAGER" ULONG FORMULA_1028 0 0 0.0 262143.9999 ECU_ADDRESS 0x3FCB5C /end MEASUREMENT
/begin MEASUREMENT kat_obd_lank_diff_sum_m_b2 "aufsummierte Abweichung zum MW - Zyklus MAGER" ULONG FORMULA_1028 0 0 0.0 262143.9999 ECU_ADDRESS 0x3FCB60 /end MEASUREMENT
/begin MEASUREMENT kat_obd_int_b1 "gemittelte Abweichung zum Mittelwert" UWORD FORMULA_0025 0 0 0.0 3.9990 ECU_ADDRESS 0x3FCB64 /end MEASUREMENT
/begin MEASUREMENT kat_obd_int_b2 "gemittelte Abweichung zum Mittelwert" UWORD FORMULA_0025 0 0 0.0 3.9990 ECU_ADDRESS 0x3FCB66 /end MEASUREMENT
/begin MEASUREMENT kat_obd_wicht_b1 "gewichtete gem. Abweichung zum Mittelwert" UWORD FORMULA_0025 0 0 0.0 3.9990 ECU_ADDRESS 0x3FCB68 /end MEASUREMENT
/begin MEASUREMENT kat_obd_wicht_b2 "gewichtete gem. Abweichung zum Mittelwert" UWORD FORMULA_0025 0 0 0.0 3.9990 ECU_ADDRESS 0x3FCB6A /end MEASUREMENT
/begin MEASUREMENT kat_obd_wicht_sum_b1 "aufsum. gewichtete gem. Abweichung z. MW" ULONG FORMULA_1028 0 0 0.0 262143.9999 ECU_ADDRESS 0x3FCB6C /end MEASUREMENT
/begin MEASUREMENT kat_obd_wicht_sum_b2 "aufsum. gewichtete gem. Abweichung z. MW" ULONG FORMULA_1028 0 0 0.0 262143.9999 ECU_ADDRESS 0x3FCB70 /end MEASUREMENT
/begin MEASUREMENT kat_obd_verh_b1 "Wichtungsverhaeltnis - Diag.Wert" UWORD FORMULA_0075 0 0 0.0 20.0000 ECU_ADDRESS 0x3FCB74 /end MEASUREMENT
/begin MEASUREMENT kat_obd_verh_b2 "Wichtungsverhaeltnis - Diag.Wert" UWORD FORMULA_0075 0 0 0.0 20.0000 ECU_ADDRESS 0x3FCB76 /end MEASUREMENT
/begin MEASUREMENT kat_obd_verh_cnt_b1 "Zaehler - verworfene Messungen" UWORD FORMULA_0010 0 0 0.0 65535.0000 ECU_ADDRESS 0x3FCB78 /end MEASUREMENT
/begin MEASUREMENT kat_obd_verh_cnt_b2 "Zaehler - verworfene Messungen" UWORD FORMULA_0010 0 0 0.0 65535.0000 ECU_ADDRESS 0x3FCB7A /end MEASUREMENT
/begin MEASUREMENT kat_obd_io_t_b1 "Verzoegerung d. Heilung" UWORD FORMULA_0021 0 0 0.0 655.0000 ECU_ADDRESS 0x3FCB7C /end MEASUREMENT
/begin MEASUREMENT kat_obd_io_t_b2 "Verzoegerung d. Heilung" UWORD FORMULA_0021 0 0 0.0 655.0000 ECU_ADDRESS 0x3FCB7E /end MEASUREMENT
/begin MEASUREMENT kat_obd_gesamt_max "Diagnoseschwelle - Gesamtsystem-KAT-Diag." UWORD FORMULA_0025 0 0 0.0 3.9990 ECU_ADDRESS 0x3FCB80 /end MEASUREMENT
/begin MEASUREMENT kat_obd_wert_max_b1 "Diagnoseschwelle - max. KAT-Diag." UWORD FORMULA_0025 0 0 0.0 3.9990 ECU_ADDRESS 0x3FCB82 /end MEASUREMENT
/begin MEASUREMENT kat_obd_wert_max_b2 "Diagnoseschwelle - max. KAT-Diag." UWORD FORMULA_0025 0 0 0.0 3.9990 ECU_ADDRESS 0x3FCB84 /end MEASUREMENT
/begin MEASUREMENT kat_obd_tabg_t_b1 "Verzoegerung bei Abgas-Temperaturgradient" UWORD FORMULA_0021 0 0 0.0 655.0000 ECU_ADDRESS 0x3FCB86 /end MEASUREMENT
/begin MEASUREMENT kat_obd_tabg_t_b2 "Verzoegerung bei Abgas-Temperaturgradient" UWORD FORMULA_0021 0 0 0.0 655.0000 ECU_ADDRESS 0x3FCB88 /end MEASUREMENT
/begin MEASUREMENT lavk_obd_dyn_mw_max_b1 "max. Lambda-Regeleingriff pro Periode" UWORD FORMULA_0025 0 0 0.0 1.9900 ECU_ADDRESS 0x3FCB8A /end MEASUREMENT
/begin MEASUREMENT lavk_obd_dyn_mw_max_b2 "max. Lambda-Regeleingriff pro Periode" UWORD FORMULA_0025 0 0 0.0 1.9900 ECU_ADDRESS 0x3FCB8C /end MEASUREMENT
/begin MEASUREMENT lavk_obd_dyn_mw_min_b1 "min. Lambda-Regeleingriff pro Periode" UWORD FORMULA_0025 0 0 0.0 1.9900 ECU_ADDRESS 0x3FCB8E /end MEASUREMENT
/begin MEASUREMENT lavk_obd_dyn_mw_min_b2 "min. Lambda-Regeleingriff pro Periode" UWORD FORMULA_0025 0 0 0.0 1.9900 ECU_ADDRESS 0x3FCB90 /end MEASUREMENT
/begin MEASUREMENT lavk_obd_dyn_ampl_b1 "Amplitude pro Periode" UWORD FORMULA_0025 0 0 0.0 3.9990 ECU_ADDRESS 0x3FCB92 /end MEASUREMENT
/begin MEASUREMENT lavk_obd_dyn_ampl_b2 "Amplitude pro Periode" UWORD FORMULA_0025 0 0 0.0 3.9990 ECU_ADDRESS 0x3FCB94 /end MEASUREMENT
/begin MEASUREMENT lavk_obd_dyn_ampl_mw_b1 "gemittelte Amplitude" UWORD FORMULA_0025 0 0 0.0 3.9990 ECU_ADDRESS 0x3FCB96 /end MEASUREMENT
/begin MEASUREMENT lavk_obd_dyn_ampl_mw_b2 "gemittelte Amplitude" UWORD FORMULA_0025 0 0 0.0 3.9990 ECU_ADDRESS 0x3FCB98 /end MEASUREMENT
/begin MEASUREMENT lavk_obd_dyn_ampl_max_b1 "max. zulaessige Amplitude" UWORD FORMULA_0025 0 0 0.0 3.9990 ECU_ADDRESS 0x3FCB9A /end MEASUREMENT
/begin MEASUREMENT lavk_obd_dyn_ampl_max_b2 "max. zulaessige Amplitude" UWORD FORMULA_0025 0 0 0.0 3.9990 ECU_ADDRESS 0x3FCB9C /end MEASUREMENT
/begin MEASUREMENT lavk_obd_dyn_ampl_min_b1 "min. zulaessige Amplitude" UWORD FORMULA_0025 0 0 0.0 3.9990 ECU_ADDRESS 0x3FCB9E /end MEASUREMENT
/begin MEASUREMENT lavk_obd_dyn_ampl_min_b2 "min. zulaessige Amplitude" UWORD FORMULA_0025 0 0 0.0 3.9990 ECU_ADDRESS 0x3FCBA0 /end MEASUREMENT
/begin MEASUREMENT lavk_obd_dyn_ampl_max_mw_b1 "gem. max. Amplitude" UWORD FORMULA_0025 0 0 0.0 3.9990 ECU_ADDRESS 0x3FCBA2 /end MEASUREMENT
/begin MEASUREMENT lavk_obd_dyn_ampl_max_mw_b2 "gem. max. Amplitude" UWORD FORMULA_0025 0 0 0.0 3.9990 ECU_ADDRESS 0x3FCBA4 /end MEASUREMENT
/begin MEASUREMENT lavk_obd_dyn_ampl_min_mw_b1 "gem. min. Amplitude" UWORD FORMULA_0025 0 0 0.0 3.9990 ECU_ADDRESS 0x3FCBA6 /end MEASUREMENT
/begin MEASUREMENT lavk_obd_dyn_ampl_min_mw_b2 "gem. min. Amplitude" UWORD FORMULA_0025 0 0 0.0 3.9990 ECU_ADDRESS 0x3FCBA8 /end MEASUREMENT
/begin MEASUREMENT lavk_obd_dyn_ampl_sum_b1 "aufsummierte Amplitude" ULONG FORMULA_1028 0 0 0.0 262143.9999 ECU_ADDRESS 0x3FCBAC /end MEASUREMENT
/begin MEASUREMENT lavk_obd_dyn_ampl_sum_b2 "aufsummierte Amplitude" ULONG FORMULA_1028 0 0 0.0 262143.9999 ECU_ADDRESS 0x3FCBB0 /end MEASUREMENT
/begin MEASUREMENT lavk_obd_dyn_norm_sum_b1 "aufsummierte normierte Amplitude" ULONG FORMULA_1028 0 0 0.0 262143.9999 ECU_ADDRESS 0x3FCBB4 /end MEASUREMENT
/begin MEASUREMENT lavk_obd_dyn_norm_sum_b2 "aufsummierte normierte Amplitude" ULONG FORMULA_1028 0 0 0.0 262143.9999 ECU_ADDRESS 0x3FCBB8 /end MEASUREMENT
/begin MEASUREMENT lavk_obd_dyn_ampl_cnt_b1 "Zaehler - gueltige Perioden" UWORD FORMULA_0010 0 0 0.0 65535.0000 ECU_ADDRESS 0x3FCBBC /end MEASUREMENT
/begin MEASUREMENT lavk_obd_dyn_ampl_cnt_b2 "Zaehler - gueltige Perioden" UWORD FORMULA_0010 0 0 0.0 65535.0000 ECU_ADDRESS 0x3FCBBE /end MEASUREMENT
/begin MEASUREMENT lavk_obd_dyn_norm_cnt_b1 "Zaehler - gueltige Diagnosezyklen" UWORD FORMULA_0010 0 0 0.0 65535.0000 ECU_ADDRESS 0x3FCBC0 /end MEASUREMENT
/begin MEASUREMENT lavk_obd_dyn_norm_cnt_b2 "Zaehler - gueltige Diagnosezyklen" UWORD FORMULA_0010 0 0 0.0 65535.0000 ECU_ADDRESS 0x3FCBC2 /end MEASUREMENT
/begin MEASUREMENT lavk_obd_dyn_norm_b1 "normierte Amplitude" UWORD FORMULA_0025 0 0 0.0 3.9990 ECU_ADDRESS 0x3FCBC4 /end MEASUREMENT
/begin MEASUREMENT lavk_obd_dyn_norm_b2 "normierte Amplitude" UWORD FORMULA_0025 0 0 0.0 3.9990 ECU_ADDRESS 0x3FCBC6 /end MEASUREMENT
/begin MEASUREMENT lavk_obd_dyn_kat_exd_t_b1 "Prueflauf Freigabezeit" UWORD FORMULA_0932 0 0 0.0 655.3500 ECU_ADDRESS 0x3FCBC8 /end MEASUREMENT
/begin MEASUREMENT lavk_obd_dyn_kat_exd_t_b2 "Prueflauf Freigabezeit" UWORD FORMULA_0932 0 0 0.0 655.3500 ECU_ADDRESS 0x3FCBCA /end MEASUREMENT
/begin MEASUREMENT lavk_obd_dyn_io_t_b1 "Verzoegerung d. Heilung" UWORD FORMULA_0021 0 0 0.0 655.0000 ECU_ADDRESS 0x3FCBCC /end MEASUREMENT
/begin MEASUREMENT lavk_obd_dyn_io_t_b2 "Verzoegerung d. Heilung" UWORD FORMULA_0021 0 0 0.0 655.0000 ECU_ADDRESS 0x3FCBCE /end MEASUREMENT
/begin MEASUREMENT lavk_obd_dyn_wert_max_b1 "Diagnoseschwelle - dyn. Sondendiag." UWORD FORMULA_0025 0 0 0.0 3.9990 ECU_ADDRESS 0x3FCBD0 /end MEASUREMENT
/begin MEASUREMENT lavk_obd_dyn_wert_max_b2 "Diagnoseschwelle - dyn. Sondendiag." UWORD FORMULA_0025 0 0 0.0 3.9990 ECU_ADDRESS 0x3FCBD2 /end MEASUREMENT
/begin MEASUREMENT lavk_obd_dyn_rf_min "min. relative F�llung f. dyn. Sondendiag." SWORD FORMULA_0007 0 0 0.0 2.0000 ECU_ADDRESS 0x3FCBD4 /end MEASUREMENT
/begin MEASUREMENT lavk_obd_dyn_gesamt_max "Diagnoseschwelle - Gesamtsystem dyn. Sondendiag." UWORD FORMULA_0025 0 0 0.0 3.9990 ECU_ADDRESS 0x3FCBD6 /end MEASUREMENT
/begin MEASUREMENT lavk_obd_dyn_kat_exd_lam_soll "zusaetzlicher LAM-SOLL-OFFSET - bei ext. Anforderung" SWORD FORMULA_0025 0 0 -2.0000 1.9990 ECU_ADDRESS 0x3FCBD8 /end MEASUREMENT
/begin MEASUREMENT lavk_obd_dyn_kat_exd_fett_lam_soll "LAM-SOLL-OFFSET - um NKAT-Signal nach FETT vor Diagnose zu bringen" SWORD FORMULA_0025 0 0 -2.0000 1.9990 ECU_ADDRESS 0x3FCBDA /end MEASUREMENT
/begin FUNCTION Mastervac ""
 /begin DEF_CHARACTERISTIC KF_MVAC_ELUP_ETA KL_MVAC_BRP_GRAD KL_MVAC_ELUP KL_MVAC_ML_WICHT KL_MVAC_PDIFF_B KL_MVAC_PDIFF_SA K_MVAC_AL_BLS K_MVAC_AL_LECK K_MVAC_AL_SRMV K_MVAC_AL_UMMV_STAT K_MVAC_BRPGRAD_SW K_MVAC_BRP_GRAD_RAMPE K_MVAC_DEL_BLS K_MVAC_DEL_RSV K_MVAC_ELUP_ST_DEL K_MVAC_HYS_MAX K_MVAC_HYS_MIN K_MVAC_MLRF_SR_SPERRE K_MVAC_ML_AEB_NEG K_MVAC_ML_AEB_POS K_MVAC_ML_CFG K_MVAC_ML_INTEGRATOR_TAU K_MVAC_ML_MIN K_MVAC_ML_SR_MAX K_MVAC_ML_SR_MIN K_MVAC_ML_TAU K_MVAC_N_MIN_B K_MVAC_N_MIN_SA K_MVAC_PDIFF_FILTER_TAU K_MVAC_PDIFF_UM_BEGR_MAX K_MVAC_PDIFF_UM_BEGR_MIN K_MVAC_PL_PDIFF K_MVAC_PL_P_IO_SW K_MVAC_PL_TIME_LIMIT K_MVAC_PL_TIME_MS K_MVAC_P_DIAG_MAX K_MVAC_P_DIAG_MIN K_MVAC_P_OBD_LL_TIME_MIN K_MVAC_P_OBD_PDIFF_DELAY K_MVAC_P_OBD_PDIFF_NEG K_MVAC_P_OBD_PDIFF_POS K_MVAC_P_OBD_PDIFF_ROH_TAU K_MVAC_P_OBD_PDIFF_TAU K_MVAC_P_OBD_PDIFF_TMOT K_MVAC_P_OBD_SA_TIME_MIN K_MVAC_P_OBD_TIME_ML K_MVAC_P_SENSOR_OFFSET K_MVAC_P_SENSOR_STEIGUNG K_MVAC_P_TAU K_MVAC_RMP_FKT_SA_BEGR K_MVAC_V /end DEF_CHARACTERISTIC
 /begin REF_CHARACTERISTIC /end REF_CHARACTERISTIC
 /begin IN_MEASUREMENT /end IN_MEASUREMENT
 /begin OUT_MEASUREMENT mvac_al_brp_grad mvac_al_ummv_stat mvac_aq_bre_b mvac_aq_bre_sa mvac_del_bls mvac_del_rsv mvac_del_rsv_mess mvac_elup_st_del mvac_m mvac_ml mvac_ml_brp mvac_ml_brp_grad mvac_ml_elup mvac_ml_elup_sr mvac_ml_leck mvac_ml_old mvac_ml_psens mvac_ml_sr mvac_ml_sr_rsv mvac_ml_sr_rsv_mess mvac_ml_sr_rsv_mess_roh mvac_ml_sr_rsv_psens mvac_ml_sr_rsv_psens_roh mvac_ml_sr_rsv_roh mvac_p_ad mvac_p_modell_grad mvac_p_obd_pdiff_delay mvac_p_obd_pdiff_neg mvac_p_obd_pdiff_neg_roh mvac_p_obd_pdiff_pos mvac_p_obd_pdiff_pos_roh mvac_p_obd_pdiff_roh mvac_p_roh mvac_pdiff_filter mvac_pdiff_sr mvac_pdiff_sr_mess mvac_pdiff_sr_mess_roh mvac_pdiff_sr_roh mvac_pl_p_modell_ml mvac_pl_p_sensor_ml mvac_pl_p_sensor_ms_ende mvac_pl_p_sensor_ms_start mvac_pl_st mvac_pl_timer mvac_pos_rsv mvac_pos_rsv_mess mvac_rmp_fkt_sa mvac_rmp_fkt_sa_frei mvac_rmp_fkt_sa_neg mvac_rmp_fkt_sa_pos mvac_rmp_fkt_sa_start mvac_spr_fkt_brp_grad /end OUT_MEASUREMENT
/end FUNCTION
/begin FUNCTION Message-Kanal "" /begin DEF_CHARACTERISTIC K_MSG_CFG /end DEF_CHARACTERISTIC /begin REF_CHARACTERISTIC /end REF_CHARACTERISTIC /begin IN_MEASUREMENT /end IN_MEASUREMENT
 /begin OUT_MEASUREMENT msg_bos_kl15 msg_clr_buf msg_exd_st msg_exd_timeout_1of2_ msg_exd_timeout_2of2_ msg_rec_rtime_1of2_ msg_rec_rtime_2of2_ msg_send_buf msg_send_id msg_send_st msg_send_timeout msg_send_typ msg_timer_10of32_ msg_timer_11of32_ msg_timer_12of32_ msg_timer_13of32_ msg_timer_14of32_ msg_timer_15of32_ msg_timer_16of32_ msg_timer_17of32_ msg_timer_18of32_ msg_timer_19of32_ msg_timer_1of32_ msg_timer_20of32_ msg_timer_21of32_ msg_timer_22of32_ msg_timer_23of32_ msg_timer_24of32_ msg_timer_25of32_ msg_timer_26of32_ msg_timer_27of32_ msg_timer_28of32_ msg_timer_29of32_ msg_timer_2of32_ msg_timer_30of32_ msg_timer_31of32_ msg_timer_32of32_ msg_timer_3of32_ msg_timer_4of32_ msg_timer_5of32_ msg_timer_6of32_ msg_timer_7of32_ msg_timer_8of32_ msg_timer_9of32_ /end OUT_MEASUREMENT
/end FUNCTION
/begin FUNCTION NO_FUNCTION ""
 /begin DEF_CHARACTERISTIC KF_IERRGREHT KF_TANSGENKO KF_UFDIODE KL_NELUEFTGE KL_RTHJADIOD KL_TCHIPOFFS KL_TMAXDIODE K_BNSMAX K_BNS_CTRINC K_BNS_SCHW1 K_BNS_UBMAX K_BNS_UBMIN K_BNS_VFZG K_GENMXGRADH K_HTGENDFGRO K_I_VERTEIL K_NGENHTMN1 K_NGENHTMX1 K_TCHIPFIL K_TDNGENKRIT K_TDTCHIPKRI K_TDTCHIPMX K_TDUBFZMN K_TFIGENHT K_TFTDIODE K_TGENMXGRAD K_TGENMXTHD K_TGENRSHT K_TLCHTEP K_T_BNSDELAY K_UGENHTMN S_BNSCLRAPP S_HTDETEC /end DEF_CHARACTERISTIC
 /begin REF_CHARACTERISTIC /end REF_CHARACTERISTIC
 /begin IN_MEASUREMENT /end IN_MEASUREMENT
 /begin OUT_MEASUREMENT Bnctrmx1s Bnsctr Bnsctrant0 Bnsctrant1 Bnsctrant2 Bnsctrant3 Ierrgrenz_ht Nelueft_gen P_totdiode St_bns St_bns.B_bns St_bns2 St_bns2.B_nachlnd7 St_pgentred_1s St_pgentred_1s.B_genht St_pgentred_1s.B_genhtkrit St_pgentred_1s.B_genhtkritv St_pgentred_1s.B_genhtmxgra St_pgentred_1s.B_ierrgrenzh St_pgentred_1s.B_tdiodekrit T_chipfilsdt T_diode T_diodedelta Tans_gen Tchip_fil_l Tchip_fil_s Tchip_ist Tchip_mwa_10of16_ Tchip_mwa_11of16_ Tchip_mwa_12of16_ Tchip_mwa_13of16_ Tchip_mwa_14of16_ Tchip_mwa_15of16_ Tchip_mwa_16of16_ Tchip_mwa_1of16_ Tchip_mwa_2of16_ Tchip_mwa_3of16_ Tchip_mwa_4of16_ Tchip_mwa_5of16_ Tchip_mwa_6of16_ Tchip_mwa_7of16_ Tchip_mwa_8of16_ Tchip_mwa_9of16_ Tchip_sum U_vordiode Z_tchip /end OUT_MEASUREMENT
/end FUNCTION
/begin FUNCTION NWM "" /begin DEF_CHARACTERISTIC /end DEF_CHARACTERISTIC /begin REF_CHARACTERISTIC /end REF_CHARACTERISTIC /begin IN_MEASUREMENT /end IN_MEASUREMENT
 /begin OUT_MEASUREMENT Nwm_var_s.MsgDest Nwm_var_s.MsgTyp Nwm_var_s.MsgUser1 Nwm_var_s.MsgUser2 Nwm_var_s.flags1 Nwm_var_s.nwmAction Nwm_var_s.rxTxCounter Nwm_var_s.state Nwm_var_s.successorEcu Nwm_var_s.timeCounter Nwm_var_s.txEcuNumber nwm_RecvCopyMsgUser_1of6_ nwm_RecvCopyMsgUser_2of6_ nwm_RecvCopyMsgUser_3of6_ nwm_RecvCopyMsgUser_4of6_ nwm_RecvCopyMsgUser_5of6_ nwm_RecvCopyMsgUser_6of6_ nwm_ecu_nr nwm_weckverursacher /end OUT_MEASUREMENT
/end FUNCTION
/begin FUNCTION OBD ""
 /begin DEF_CHARACTERISTIC KF_KAT_OBD_INT_WICHT KF_KAT_OBD_WICHT_GESAMT KF_LAVK_OBD_DYN_AMPL_MAX KF_LAVK_OBD_DYN_AMPL_MIN KF_LAVK_OBD_DYN_WICHT_GESAMT KL_KAT_OBD_GESAMT_MAX KL_KAT_OBD_IO_VERZ KL_KAT_OBD_WERT_MAX KL_LAVK_OBD_DYN_GESAMT_MAX KL_LAVK_OBD_DYN_IO_VERZ KL_LAVK_OBD_DYN_RF_MIN KL_LAVK_OBD_DYN_WERT_MAX KL_O2_OBD_RF_MIN K_KAT_OBD_CFG K_KAT_OBD_LANK_MW_DELTA_MAX K_KAT_OBD_LANK_MW_DIFF_MAX K_KAT_OBD_LANK_MW_HYS_CHK1 K_KAT_OBD_LANK_MW_MAX K_KAT_OBD_LANK_MW_MIN K_KAT_OBD_M_HUB_CNT K_KAT_OBD_TABG_T_VERZ K_KAT_OBD_VERH K_KAT_OBD_VERH_SCHWELLE K_KAT_OBD_WERT_MODE6 K_KAT_OBD_ZYKL_CNT_MAX K_LAVK_OBD_DYN_AMPL_CNT K_LAVK_OBD_DYN_AMPL_MAX K_LAVK_OBD_DYN_AMPL_MIN K_LAVK_OBD_DYN_CFG K_LAVK_OBD_DYN_KAT_EXD_FETT_LAM_SOLL K_LAVK_OBD_DYN_KAT_EXD_LAM_SOLL K_LAVK_OBD_DYN_KAT_EXD_LANK_FETT K_LAVK_OBD_DYN_KAT_EXD_N_SOLL K_LAVK_OBD_DYN_KAT_EXD_RF_MAX K_LAVK_OBD_DYN_KAT_EXD_RF_MIN K_LAVK_OBD_DYN_KAT_EXD_T K_LAVK_OBD_DYN_LAM_REG_MAX K_LAVK_OBD_DYN_LAM_REG_MIN K_LAVK_OBD_DYN_MW_HYS K_LAVK_OBD_DYN_MW_MAX K_LAVK_OBD_DYN_MW_MIN K_LAVK_OBD_DYN_NORM_CNT K_LAVK_OBD_DYN_TE_VOL_SUM K_LAVK_OBD_DYN_WERT_MODE6 K_O2_LA_TRIM_CFG K_O2_OBD_CFG K_O2_OBD_DYN_CNT_INC K_O2_OBD_DYN_DELTA_CNT K_O2_OBD_DYN_DELTA_PUMP_RF K_O2_OBD_DYN_DELTA_RF K_O2_OBD_DYN_RF_T K_O2_OBD_DYN_T_VERZ K_O2_OBD_LAM_SOLL_OFFS K_O2_OBD_LAVK_AD_OFFS_MAX K_O2_OBD_LAVK_AD_OFFS_MIN K_O2_OBD_ML_MIN K_O2_OBD_N_MAX K_O2_OBD_N_MIN K_O2_OBD_PUMG_MIN K_O2_OBD_RF_MAX K_O2_OBD_RF_MIN_HYS K_O2_OBD_RF_T_MIN K_O2_OBD_SA_ML_MAX K_O2_OBD_TEV_MAX K_O2_OBD_TKAT_HYS K_O2_OBD_TKAT_MAX K_O2_OBD_TKAT_MIN K_O2_OBD_TMOT K_O2_OBD_T_ML K_O2_OBD_V_MAX K_O2_OBD_V_MIN K_O2_OBD_WE_ML_MIN /end DEF_CHARACTERISTIC
 /begin REF_CHARACTERISTIC /end REF_CHARACTERISTIC
 /begin IN_MEASUREMENT /end IN_MEASUREMENT
 /begin OUT_MEASUREMENT kat_o2_per_cnt_passiv_b1 kat_o2_per_cnt_passiv_b2 kat_obd_fett_mager_b1 kat_obd_fett_mager_b2 kat_obd_gesamt_max kat_obd_int_b1 kat_obd_int_b2 kat_obd_io_t_b1 kat_obd_io_t_b2 kat_obd_io_verz_b1 kat_obd_io_verz_b2 kat_obd_lank_chk1_b1 kat_obd_lank_chk1_b2 kat_obd_lank_chk2_b1 kat_obd_lank_chk2_b2 kat_obd_lank_diff_b1 kat_obd_lank_diff_b2 kat_obd_lank_diff_sum_b1 kat_obd_lank_diff_sum_b2 kat_obd_lank_diff_sum_f_b1 kat_obd_lank_diff_sum_f_b2 kat_obd_lank_diff_sum_m_b1 kat_obd_lank_diff_sum_m_b2 kat_obd_lank_mw_b1 kat_obd_lank_mw_b2 kat_obd_lank_sum_b1 kat_obd_lank_sum_b2 kat_obd_st_b1 kat_obd_st_b2 kat_obd_t_cnt_b1 kat_obd_t_cnt_b2 kat_obd_tabg_t_b1 kat_obd_tabg_t_b2 kat_obd_tabg_t_verz_b1 kat_obd_tabg_t_verz_b2 kat_obd_verh_b1 kat_obd_verh_b2 kat_obd_verh_cnt_b1 kat_obd_verh_cnt_b2 kat_obd_wert_ermittlung_b1 kat_obd_wert_ermittlung_b2 kat_obd_wert_max_b1 kat_obd_wert_max_b2 kat_obd_wicht_b1 kat_obd_wicht_b2 kat_obd_wicht_sum_b1 kat_obd_wicht_sum_b2 kat_obd_zykl_cnt_b1 kat_obd_zykl_cnt_b2 lavk_obd_dyn_ampl_b1 lavk_obd_dyn_ampl_b2 lavk_obd_dyn_ampl_cnt_b1 lavk_obd_dyn_ampl_cnt_b2 lavk_obd_dyn_ampl_max_b1 lavk_obd_dyn_ampl_max_b2 lavk_obd_dyn_ampl_max_mw_b1 lavk_obd_dyn_ampl_max_mw_b2 lavk_obd_dyn_ampl_min_b1 lavk_obd_dyn_ampl_min_b2 lavk_obd_dyn_ampl_min_mw_b1 lavk_obd_dyn_ampl_min_mw_b2 lavk_obd_dyn_ampl_mw_b1 lavk_obd_dyn_ampl_mw_b2 lavk_obd_dyn_ampl_sum_b1 lavk_obd_dyn_ampl_sum_b2 lavk_obd_dyn_gesamt_max lavk_obd_dyn_io_t_b1 lavk_obd_dyn_io_t_b2 lavk_obd_dyn_kat_exd_fett_lam_soll lavk_obd_dyn_kat_exd_lam_soll lavk_obd_dyn_kat_exd_t_b1 lavk_obd_dyn_kat_exd_t_b2 lavk_obd_dyn_mw_max_b1 lavk_obd_dyn_mw_max_b2 lavk_obd_dyn_mw_min_b1 lavk_obd_dyn_mw_min_b2 lavk_obd_dyn_norm_b1 lavk_obd_dyn_norm_b2 lavk_obd_dyn_norm_cnt_b1 lavk_obd_dyn_norm_cnt_b2 lavk_obd_dyn_norm_sum_b1 lavk_obd_dyn_norm_sum_b2 lavk_obd_dyn_rf_min lavk_obd_dyn_wert_max_b1 lavk_obd_dyn_wert_max_b2 o2_lam_soll_fett_hub_b1 o2_lam_soll_fett_hub_b2 o2_lam_soll_fett_hub_trig_b1 o2_lam_soll_fett_hub_trig_b2 o2_lam_soll_fett_ukp_b1 o2_lam_soll_fett_ukp_b2 o2_lam_soll_mager_hub_b1 o2_lam_soll_mager_hub_b2 o2_lam_soll_mager_hub_trig_b1 o2_lam_soll_mager_hub_trig_b2 o2_lam_soll_mager_per_b1 o2_lam_soll_mager_per_b2 o2_lam_soll_mager_ukp_b1 o2_lam_soll_mager_ukp_b2 o2_lam_soll_pus_b1 o2_lam_soll_pus_b2 o2_obd_dyn_t_b1 o2_obd_dyn_t_b2 o2_obd_dyn_t_verz_b1 o2_obd_dyn_t_verz_b2 o2_obd_lam_soll_offs_b1 o2_obd_lam_soll_offs_b2 o2_obd_period_cnt_b1 o2_obd_period_cnt_b2 o2_obd_rf_min_schwelle_b1 o2_obd_rf_min_schwelle_b2 o2_obd_st_b1 o2_obd_st_b2 o2_obd_t_fett_b1 o2_obd_t_fett_b2 o2_obd_t_mager_b1 o2_obd_t_mager_b2 o2_obd_t_sum_b1 o2_obd_t_sum_b2 o2_obd_tkat_min_b1 o2_obd_tkat_min_b2 o2_rf_min_schw_t_b1 o2_rf_min_schw_t_b2 /end OUT_MEASUREMENT
/end FUNCTION
/begin FUNCTION Oelsensor-Module ""
 /begin DEF_CHARACTERISTIC KF_OZDREHKOR KF_OZDREHKOR_EINFAHR KF_OZKORRNIV KF_OZKORRORI KF_OZZEIT KL_OZBEFKL KL_OZKRZMW2 KL_OZLBNIV KL_OZLN KL_OZNFDELTA KL_OZORBERO KL_OZPERMKL KL_OZQBNIV KL_OZSTNIV KL_OZTEMPKL KL_OZVERDFAK KL_PERREFTKOR KL_TKTOENIV KL_TVTOEL K_CW_OZ K_CW_OZ_2 K_CW_OZ_PERM K_DTOG_UBMIN K_NACHFUELL12 K_NACHFUELL25 K_NACHFUELL38 K_NACHFUELL53 K_NACHFUELL69 K_NACHFUELL85 K_NACHFUELL95 K_OZABSTELL K_OZALTANZABZ K_OZANFANZ K_OZBESCHAUS K_OZBZKMSTK1 K_OZDAEMPF K_OZDELTOE K_OZDIAGNMOT K_OZDIAGNMOT2 K_OZDIAGSPG K_OZDKNIVN K_OZERRD K_OZHEAL K_OZKMMAXK11 K_OZKMUPL K_OZKVB96 K_OZKVB96A K_OZKVBMXK18 K_OZKVBOK16 K_OZLBESCHN K_OZLBESCHORI K_OZLBESCHP K_OZLBESCHST K_OZLF1 K_OZLF2 K_OZLUFTMAX K_OZMAXSLOPE K_OZMINSLOPE K_OZMNKMBO K_OZMWK K_OZMWL K_OZMWOR K_OZMWV K_OZMXOHK15 K_OZNFERR K_OZNFML K_OZNFOELCKO K_OZNFOELCOK K_OZNIVKL K_OZNMOTMAX K_OZNMOTMIN K_OZOELCABZ K_OZOELCOK K_OZOELCVERZ K_OZOELMEN K_OZOELVERB K_OZORIPEILTZO K_OZORIPEILTZU K_OZPEIL12 K_OZPEIL25 K_OZPEIL38 K_OZPEIL53 K_OZPEIL69 K_OZPEIL85 K_OZPEILDO K_OZPEILDOMIN K_OZPEILDU K_OZPEILDU38 K_OZPEILERR K_OZPEILKSPR K_OZPEILLP85 K_OZPEILML K_OZPEILOELCKO K_OZPEILOELCOK K_OZPEILSPRUNG K_OZPERBOK17 K_OZPERBRK14 K_OZPERCMW K_OZPERGRADKD K_OZPERGRADMAX K_OZPERGRADMIN K_OZPERGRADTN K_OZPERINI K_OZPERKFIL K_OZPERMRMIN K_OZPERMWDMAX K_OZPERMWDMIN K_OZPERXK10 K_OZPLTEMP K_OZPLZTEMP K_OZPRREFMAX K_OZPRREFMIN K_OZQBESCHN K_OZQBESCHORI K_OZQBESCHP K_OZQBESCHST K_OZSTANDVERZ K_OZSTARTABZ K_OZSTARTVERZ K_OZSTMINW K_OZSTZYK K_OZTAGCTERR K_OZTEMPBW K_OZTEMPQERR K_OZTORMAX K_OZTORMIN K_OZUEBERF K_OZUEBERTEMP K_OZUEFCNT K_OZUEFNLB K_OZUEFNQB K_OZUEFNST K_OZUEFODZ K_OZUEFPLB K_OZUEFPQB K_OZUEFPST K_OZUEFTEM K_OZUEFUDZ K_OZUEFVERZ K_OZUTFAK K_OZVERBDKM K_OZVERBFAK K_OZVERLORI K_OZVERZERRBSD K_OZVERZNIVERS K_OZVORMV K_OZVORPEILMIN K_OZZEITFAKT K_OZZEITINT K_OZZTEMP K_OZZYKCBS K_TOGMAXUNPL K_TOGVERZOEG K_TOG_CNTMAX K_TRTYP S_OZBSDKOORD /end DEF_CHARACTERISTIC
 /begin REF_CHARACTERISTIC /end REF_CHARACTERISTIC
 /begin IN_MEASUREMENT /end IN_MEASUREMENT
 /begin OUT_MEASUREMENT Bosbtvfbk Bosfxid2 Bosid2 Bosjziel Bosmziel Bosprog2 Bosres Bosrlsm Bosrw2 Bosstate Id_bosmg Id_bosmgt Id_bosmsg Id_bosrtak N_ozmw Oz_abstellm Oz_anztoe Oz_beschcnt Oz_cttagini Oz_diagtoens Oz_dkm Oz_hoehe Oz_intprog Oz_kmlow Oz_kmstrw0 Oz_krz2cnt Oz_krzcnt Oz_krzkor2 Oz_krzkor2k Oz_krzmw Oz_krzmwkor Oz_krzor Oz_kvbdiff Oz_kvbmw Oz_kvbmwtmp Oz_kvbmx Oz_kvbog Oz_kvbsm Oz_kvbsm_ul Oz_kvbtmp2 Oz_langmw Oz_lbmw Oz_lf1t Oz_lf2t Oz_lgmwcnt Oz_litges Oz_lp Oz_lv Oz_manipt Oz_niv Oz_nivakt Oz_nivkor Oz_nivkrzt Oz_nivlanglit Oz_nivlangt Oz_nivlit Oz_nivnfm Oz_nivqlt Oz_nivrers Oz_nivt Oz_nivtoe Oz_nivzeit Oz_oelkm Oz_oelverbr Oz_oelzeit Oz_oelzeitt Oz_oricnt Oz_orikor Oz_peil Oz_peilaltanz Oz_peilkm Oz_peilkmalt Oz_peillang Oz_peiloben Oz_peilunten Oz_pergrad Oz_perm Oz_permakt Oz_permbog Oz_permerrz Oz_permfil Oz_permt Oz_permw Oz_permwalt Oz_perref Oz_perreftkor Oz_pertref Oz_pzdivp Oz_qbmw Oz_reset Oz_rwanz Oz_rwde Oz_rwkvb Oz_rwp Oz_rwpeil Oz_rwperm Oz_rwprog Oz_rwprueck Oz_rwrueck Oz_rwzeit Oz_steigung Oz_svcntchg Oz_temp Oz_tempakt Oz_tempf Oz_tempplz Oz_tempqlt Oz_temprold Oz_tempt Oz_temptoe Oz_testtoel2 Oz_uefcnt Oz_uefzcnt Oz_utzeit Oz_verbkmalt Oz_verbnivalt Oz_vfanz Oz_vfbdmew Oz_vfkvb Oz_vfperm Oz_vfzeit Oz_vormw Oz_vormwcnt Oz_zieljahr Oz_zielmon Oz_zjbdmew Oz_zmbdmew St_dqlt0 St_dqlt0.B_ozdiagnmotok St_dqlt0.B_ozerrbsd St_dqlt0.B_ozkttoens St_dqlt0.B_ozlerr St_dqlt0.B_ozqerr St_dqlt0.B_ozterr St_dqlt0.B_td_ogerr St_dqlt0.B_td_ogupl St_dqlt1 St_dqlt1.B_ozerr St_dqlt1.B_ozfbsd2 St_dqlt1.B_oztemppl St_oz_o St_oz_o.B_mol_sf St_oz_o.B_oztemic St_ozbg0 St_ozbg0.B_bosmsgc St_ozbg0.B_mol_vb St_ozbg0.B_mol_vl St_ozbg0.B_oeltemp St_ozbg0.B_oelverb St_ozbg0.B_oelverl St_ozbg_nv0 St_ozbg_nv0.B_ozkl15 St_ozgg0 St_ozgg0.B_oelwech St_ozgg0.B_ozniv St_ozgg0.B_ozperm St_ozgg0.B_oztemp St_ozgg0.B_ozvfchg St_ozgg0.B_ozvfchgt St_ozgg0.B_ozzeitdmew St_ozgg0.B_svcntchg St_ozgg1 St_ozgg1.B_ozmanip St_ozgg1.B_oznivqlt St_ozgg1.B_oznivtoe St_ozgg1.B_ozreset St_ozgg1.B_ozresetcan St_ozgg1.B_ozresett St_ozgg1.B_ozvfchgc St_ozgg1.B_ozvfchgcc St_ozgg2 St_ozgg2.B_oznivrers St_ozgg2.B_ozpergradok St_ozgg2.B_ozpermwok St_ozgg2.B_ozperrangeok St_ozgg2.B_ozperrgok St_ozgg2.B_oztempqlt St_ozgg2.B_oztemptoe St_ozgg2.B_oztoeok St_ozgg3 St_ozgg3.B_ozpermgrini St_ozgg3.B_ozperrupl St_ozgg3.B_ozpersensok St_ozgg_nv0 St_ozgg_nv0.B_dmeini St_ozgg_nv0.B_dmewech St_ozgg_nv0.B_factoryres St_oznivdl0 St_oznivdl0.B_ozkrzkor St_oznivdl0.B_ozkrzl St_oznivdl0.B_ozkrzlkor St_oznivdl0.B_ozlangmw St_oznivdl0.B_ozluft St_oznivdl0.B_oznivb St_oznivdl0.B_ozor St_oznivdl0.B_ozvormw St_oznivdl1 St_oznivdl1.B_ozfahrt St_oznivdl1.B_ozkrzkor2 St_oznivdl1.B_ozkrzkornb St_oznivdl1.B_ozml St_oznivdl1.B_ozmreset St_oznivdl1.B_ozoelcheck St_oznivdl1.B_ozoelchok St_oznivdl1.B_ozueberf St_oznivdl_nv0 St_oznivdl_nv0.B_ozabzlang St_oznivdl_nv0.B_ozlmwneu St_oznivdl_nv0.B_oznachf St_oznivdl_nv0.B_ozoelwech St_oznivdl_nv0.B_ozpeilerr St_ozrestkm_0 St_ozrestkm_0.B_oznoperm St_ozrestkm_nv0 St_ozrestkm_nv0.B_ozcntini St_ozrestkm_nv0.B_ozini St_ozrestkm_nv0.B_ozvfk St_ozrestkm_nv0.B_rwanz0 Toel Toel_oz Zrbosmld /end OUT_MEASUREMENT
/end FUNCTION
/begin FUNCTION PCTRL "" /begin DEF_CHARACTERISTIC K_PCTRL_PROZ_ZYKL K_PCTRL_TASK_ZYKL K_PCTRL_TIMEOUT /end DEF_CHARACTERISTIC /begin REF_CHARACTERISTIC /end REF_CHARACTERISTIC /begin IN_MEASUREMENT /end IN_MEASUREMENT
 /begin OUT_MEASUREMENT pctrl_proz pctrl_proz_err pctrl_proz_tb pctrl_t_old_ipk pctrl_task pctrl_task_err pctrl_task_tb pctrl_tout /end OUT_MEASUREMENT
/end FUNCTION
/begin RECORD_LAYOUT TKW_VV_VV_UB FNC_VALUES 1 UBYTE COLUMN_DIR DIRECT /end RECORD_LAYOUT
/begin RECORD_LAYOUT TKW_VV_VV_SB FNC_VALUES 1 SBYTE COLUMN_DIR DIRECT /end RECORD_LAYOUT
/begin RECORD_LAYOUT TKW_VV_VV_UW FNC_VALUES 1 UWORD COLUMN_DIR DIRECT /end RECORD_LAYOUT
/begin RECORD_LAYOUT TKW_VV_VV_SW FNC_VALUES 1 SWORD COLUMN_DIR DIRECT /end RECORD_LAYOUT
/begin RECORD_LAYOUT TKW_VV_VV_UL FNC_VALUES 1 ULONG COLUMN_DIR DIRECT /end RECORD_LAYOUT
/begin RECORD_LAYOUT TKW_VV_VV_SL FNC_VALUES 1 SLONG COLUMN_DIR DIRECT /end RECORD_LAYOUT
/begin RECORD_LAYOUT TKL_UB_VV_UB NO_AXIS_PTS_X 1 UBYTE RESERVED 2 BYTE AXIS_PTS_X 3 UBYTE INDEX_INCR DIRECT FNC_VALUES 4 UBYTE COLUMN_DIR DIRECT /end RECORD_LAYOUT
/begin RECORD_LAYOUT TKL_UB_VV_UW NO_AXIS_PTS_X 1 UBYTE RESERVED 2 BYTE AXIS_PTS_X 3 UBYTE INDEX_INCR DIRECT FNC_VALUES 4 UWORD COLUMN_DIR DIRECT /end RECORD_LAYOUT
/begin RECORD_LAYOUT TKL_UB_VV_SW NO_AXIS_PTS_X 1 UBYTE RESERVED 2 BYTE AXIS_PTS_X 3 UBYTE INDEX_INCR DIRECT FNC_VALUES 4 SWORD COLUMN_DIR DIRECT /end RECORD_LAYOUT
/begin RECORD_LAYOUT TKL_SB_VV_SB NO_AXIS_PTS_X 1 UBYTE RESERVED 2 BYTE AXIS_PTS_X 3 SBYTE INDEX_INCR DIRECT FNC_VALUES 4 SBYTE COLUMN_DIR DIRECT /end RECORD_LAYOUT
/begin RECORD_LAYOUT TKL_UW_VV_UB NO_AXIS_PTS_X 1 UBYTE RESERVED 2 BYTE AXIS_PTS_X 3 UWORD INDEX_INCR DIRECT FNC_VALUES 4 UBYTE COLUMN_DIR DIRECT /end RECORD_LAYOUT
/begin RECORD_LAYOUT TKL_UW_VV_UW NO_AXIS_PTS_X 1 UBYTE RESERVED 2 BYTE AXIS_PTS_X 3 UWORD INDEX_INCR DIRECT FNC_VALUES 4 UWORD COLUMN_DIR DIRECT /end RECORD_LAYOUT
/begin RECORD_LAYOUT TKL_UW_VV_SW NO_AXIS_PTS_X 1 UBYTE RESERVED 2 BYTE AXIS_PTS_X 3 UWORD INDEX_INCR DIRECT FNC_VALUES 4 SWORD COLUMN_DIR DIRECT /end RECORD_LAYOUT
/begin RECORD_LAYOUT TKL_SW_VV_UW NO_AXIS_PTS_X 1 UBYTE RESERVED 2 BYTE AXIS_PTS_X 3 SWORD INDEX_INCR DIRECT FNC_VALUES 4 UWORD COLUMN_DIR DIRECT /end RECORD_LAYOUT
/begin RECORD_LAYOUT TKL_SW_VV_SW NO_AXIS_PTS_X 1 UBYTE RESERVED 2 BYTE AXIS_PTS_X 3 SWORD INDEX_INCR DIRECT FNC_VALUES 4 SWORD COLUMN_DIR DIRECT /end RECORD_LAYOUT
/begin RECORD_LAYOUT TKF_UB_SW_UW NO_AXIS_PTS_X 1 UBYTE NO_AXIS_PTS_Y 2 UBYTE AXIS_PTS_X 3 SWORD INDEX_INCR DIRECT AXIS_PTS_Y 4 UBYTE INDEX_INCR DIRECT FNC_VALUES 5 UWORD COLUMN_DIR DIRECT /end RECORD_LAYOUT
/begin RECORD_LAYOUT TKF_UW_UW_UW NO_AXIS_PTS_X 1 UBYTE NO_AXIS_PTS_Y 2 UBYTE AXIS_PTS_X 3 UWORD INDEX_INCR DIRECT AXIS_PTS_Y 4 UWORD INDEX_INCR DIRECT FNC_VALUES 5 UWORD COLUMN_DIR DIRECT /end RECORD_LAYOUT
/begin RECORD_LAYOUT TKF_UW_SW_SW NO_AXIS_PTS_X 1 UBYTE NO_AXIS_PTS_Y 2 UBYTE AXIS_PTS_X 3 SWORD INDEX_INCR DIRECT AXIS_PTS_Y 4 UWORD INDEX_INCR DIRECT FNC_VALUES 5 SWORD COLUMN_DIR DIRECT /end RECORD_LAYOUT
/begin RECORD_LAYOUT TKF_SW_SW_UB NO_AXIS_PTS_X 1 UBYTE NO_AXIS_PTS_Y 2 UBYTE AXIS_PTS_X 3 SWORD INDEX_INCR DIRECT AXIS_PTS_Y 4 SWORD INDEX_INCR DIRECT FNC_VALUES 5 UBYTE COLUMN_DIR DIRECT /end RECORD_LAYOUT
/begin RECORD_LAYOUT TKF_SW_SW_UW NO_AXIS_PTS_X 1 UBYTE NO_AXIS_PTS_Y 2 UBYTE AXIS_PTS_X 3 SWORD INDEX_INCR DIRECT AXIS_PTS_Y 4 SWORD INDEX_INCR DIRECT FNC_VALUES 5 UWORD COLUMN_DIR DIRECT /end RECORD_LAYOUT
/begin RECORD_LAYOUT TKF_SW_SW_SW NO_AXIS_PTS_X 1 UBYTE NO_AXIS_PTS_Y 2 UBYTE AXIS_PTS_X 3 SWORD INDEX_INCR DIRECT AXIS_PTS_Y 4 SWORD INDEX_INCR DIRECT FNC_VALUES 5 SWORD COLUMN_DIR DIRECT /end RECORD_LAYOUT
/end MODULE
/end PROJECT
