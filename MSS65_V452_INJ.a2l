/begin PROJECT MSS65-inj-V452 "MSS65 INJ - V452.01-B204.00, data set 0569Q60Z160E"
/begin HEADER "" VERSION "V452.01-B204.00" /end HEADER
/begin MODULE _MSS65-inj "MSS65 INJ - V452.01-B204.00, calibration xxxxxxxx"
/begin MOD_COMMON "" BYTE_ORDER MSB_FIRST /* Default byteorder (Motorola) */ /end MOD_COMMON
/begin COMPU_METHOD FORMULA_0001 "FORMULA_0001" RAT_FUNC "%6.1" "%" COEFFS 0 10 0 0 0 1 /end COMPU_METHOD
/begin COMPU_METHOD FORMULA_0003 "FORMULA_0003" RAT_FUNC "%3.0" "-" COEFFS 0 1 0 0 0 1 /end COMPU_METHOD
/begin COMPU_METHOD FORMULA_0006 "FORMULA_0006" RAT_FUNC "%5.0" "Upm" COEFFS 0 1 0 0 0 1 /end COMPU_METHOD
/begin COMPU_METHOD FORMULA_0007 "FORMULA_0007" RAT_FUNC "%8.3" "-" COEFFS 0 10000 0 0 0 1 /end COMPU_METHOD
/begin COMPU_METHOD FORMULA_0010 "FORMULA_0010" RAT_FUNC "%5.0" "-" COEFFS 0 1 0 0 0 1 /end COMPU_METHOD
/begin COMPU_METHOD FORMULA_0021 "FORMULA_0021" RAT_FUNC "%7.2" "s" COEFFS 0 100 0 0 0 1 /end COMPU_METHOD
/* ------------------ Abschnitt erzeugt aus adapt_glob.dat ------------------ */
/begin COMPU_METHOD FORMULA_0023 "FORMULA_0023" RAT_FUNC "%6.1" "�C" COEFFS 0 10 2732 0 0 1 /end COMPU_METHOD
/begin COMPU_METHOD FORMULA_0024 "FORMULA_0024" RAT_FUNC "%9.4" "-" COEFFS 0 32768 0 0 0 1 /end COMPU_METHOD
/begin COMPU_METHOD FORMULA_0025 "FORMULA_0025" RAT_FUNC "%8.3" "-" COEFFS 0 16384 0 0 0 1 /end COMPU_METHOD
/begin COMPU_METHOD FORMULA_0033 "FORMULA_0033" RAT_FUNC "%5.2" "-" COEFFS 0 1 0 0 0 1 /end COMPU_METHOD
/begin COMPU_METHOD FORMULA_0062 "FORMULA_0062" RAT_FUNC "%5.0" "s" COEFFS 0 1 0 0 0 1 /end COMPU_METHOD
/begin COMPU_METHOD FORMULA_0073 "FORMULA_0073" RAT_FUNC "%6.1" "s" COEFFS 0 10 0 0 0 1 /end COMPU_METHOD
/begin COMPU_METHOD FORMULA_0075 "FORMULA_0075" RAT_FUNC "%8.3" "-" COEFFS 0 1024 0 0 0 1 /end COMPU_METHOD
/begin COMPU_METHOD FORMULA_0077 "FORMULA_0077" RAT_FUNC "%6.1" "mbar" COEFFS 0 16 0 0 0 1 /end COMPU_METHOD
/* ------------------ Abschnitt erzeugt aus glob.dat ------------------ */
/begin COMPU_METHOD FORMULA_0083 "FORMULA_0083" RAT_FUNC "%7.2" "-" COEFFS 0 1 0 0 0 1 /end COMPU_METHOD
/begin COMPU_METHOD FORMULA_0093 "FORMULA_0093" RAT_FUNC "%7.2" "mg" COEFFS 0 10 0 0 0 1 /end COMPU_METHOD
/begin COMPU_METHOD FORMULA_0107 "FORMULA_0107" TAB_VERB "%7.2" "-" COMPU_TAB_REF FORMULA_0107_VTAB /end COMPU_METHOD
/begin COMPU_VTAB FORMULA_0107_VTAB "FORMULA_0107_VTAB" TAB_VERB 1 0 "inaktiv" DEFAULT_VALUE "aktiv" /end COMPU_VTAB
/begin COMPU_METHOD FORMULA_0111 "FORMULA_0111" RAT_FUNC "%6.1" "�KW" COEFFS 0 10 0 0 0 1 /end COMPU_METHOD
/begin COMPU_METHOD FORMULA_0112 "FORMULA_0112" RAT_FUNC "%6.1" "kg/h" COEFFS 0 10 0 0 0 1 /end COMPU_METHOD
/begin COMPU_METHOD FORMULA_0113 "FORMULA_0113" RAT_FUNC "%6.1" "mg/asp" COEFFS 0 10 0 0 0 1 /end COMPU_METHOD
/begin COMPU_METHOD FORMULA_0115 "FORMULA_0115" RAT_FUNC "%7.2" "%" COEFFS 0 16384 0 0 0 100 /end COMPU_METHOD
/begin COMPU_METHOD FORMULA_0118 "FORMULA_0118" RAT_FUNC "%8.3" "bar" COEFFS 0 1000 0 0 0 1 /end COMPU_METHOD
/begin COMPU_METHOD FORMULA_0152 "FORMULA_0152" RAT_FUNC "%9.2" "s" COEFFS 0 100 0 0 0 1 /end COMPU_METHOD
/begin COMPU_METHOD FORMULA_0233 "FORMULA_0233" TAB_VERB "%3.0" "-" COMPU_TAB_REF FORMULA_0233_VTAB /end COMPU_METHOD
/begin COMPU_VTAB FORMULA_0233_VTAB "FORMULA_0233_VTAB" TAB_VERB 4 0 "k. Aenderung" 1 "Aus" 2 "Ein" 4 "Sport" DEFAULT_VALUE "undef" /end COMPU_VTAB
/begin COMPU_METHOD FORMULA_0234 "FORMULA_0234" TAB_VERB "%3.0" "-" COMPU_TAB_REF FORMULA_0234_VTAB /end COMPU_METHOD
/begin COMPU_VTAB FORMULA_0234_VTAB "FORMULA_0234_VTAB" TAB_VERB 3 0 "k. Aenderung" 1 "Automat" 2 "Sequentiell" DEFAULT_VALUE "undef" /end COMPU_VTAB
/begin COMPU_METHOD FORMULA_0236 "FORMULA_0236" TAB_VERB "%3.0" "-" COMPU_TAB_REF FORMULA_0236_VTAB /end COMPU_METHOD
/begin COMPU_VTAB FORMULA_0236_VTAB "FORMULA_0236_VTAB" TAB_VERB 4 0 "k. Aenderung" 1 "Komfort" 2 "Normal" 3 "Sport" DEFAULT_VALUE "undef" /end COMPU_VTAB
/begin COMPU_METHOD FORMULA_0237 "FORMULA_0237" TAB_VERB "%3.0" "-" COMPU_TAB_REF FORMULA_0237_VTAB /end COMPU_METHOD
/begin COMPU_VTAB FORMULA_0237_VTAB "FORMULA_0237_VTAB" TAB_VERB 4 0 "k. Aenderung" 1 "KL1" 2 "KL2" 3 "KL3" DEFAULT_VALUE "undef" /end COMPU_VTAB
/begin COMPU_METHOD FORMULA_0238 "FORMULA_0238" TAB_VERB "%3.0" "-" COMPU_TAB_REF FORMULA_0238_VTAB /end COMPU_METHOD
/begin COMPU_VTAB FORMULA_0238_VTAB "FORMULA_0238_VTAB" TAB_VERB 2 0 "k. Aenderung" 1 "M-Cfg" DEFAULT_VALUE "undef" /end COMPU_VTAB
/begin COMPU_METHOD FORMULA_0317 "FORMULA_0317" RAT_FUNC "%5.2" "s" COEFFS 0 100 0 0 0 1 /end COMPU_METHOD
/begin COMPU_METHOD FORMULA_0531 "FORMULA_0531" RAT_FUNC "%8.3" "mg/ASP" COEFFS 0 64 0 0 0 1 /end COMPU_METHOD
/begin COMPU_METHOD FORMULA_0532 "FORMULA_0532" RAT_FUNC "%5.0" "mV" COEFFS 0 1024 0 0 0 5000 /end COMPU_METHOD
/begin COMPU_METHOD FORMULA_0537 "FORMULA_0537" RAT_FUNC "%6.1" "Ohm" COEFFS 0 10 0 0 0 1 /end COMPU_METHOD
/begin COMPU_METHOD FORMULA_0538 "FORMULA_0538" RAT_FUNC "%5.0" "ms" COEFFS 0 1 0 0 0 10 /end COMPU_METHOD
/begin COMPU_METHOD FORMULA_0539 "FORMULA_0539" RAT_FUNC "%5.0" "ms" COEFFS 0 1 0 0 0 100 /end COMPU_METHOD
/begin COMPU_METHOD FORMULA_0556 "FORMULA_0556" RAT_FUNC "%9.4" "-" COEFFS 0 10000 0 0 0 1 /end COMPU_METHOD
/begin COMPU_METHOD FORMULA_0595 "FORMULA_0595" RAT_FUNC "%5.0" "-" COEFFS 0 1 0 0 0 10 /end COMPU_METHOD
/begin COMPU_METHOD FORMULA_0643 "FORMULA_0643" RAT_FUNC "%5.2" "" COEFFS 0 128 0 0 0 1 /end COMPU_METHOD
/begin COMPU_METHOD FORMULA_0664 "FORMULA_0664" RAT_FUNC "%5.2" "s" COEFFS 0 0 2.56 0 1 0 /end COMPU_METHOD
/* ------------------ Abschnitt erzeugt aus la.dat ------------------ */
/begin COMPU_METHOD FORMULA_0748 "FORMULA_0748" TAB_VERB "%7.2" "-" COMPU_TAB_REF FORMULA_0748_VTAB /end COMPU_METHOD
/begin COMPU_VTAB FORMULA_0748_VTAB "FORMULA_0748_VTAB" TAB_VERB 3 1 "Sonde verf" 3 "Sonde FETT" 5 "Sonde MAGER" DEFAULT_VALUE "undefiniert" /end COMPU_VTAB
/begin COMPU_METHOD FORMULA_0749 "FORMULA_0749" TAB_VERB "%7.2" "-" COMPU_TAB_REF FORMULA_0749_VTAB /end COMPU_METHOD
/begin COMPU_VTAB FORMULA_0749_VTAB "FORMULA_0749_VTAB" TAB_VERB 1 0 "GAIN8" DEFAULT_VALUE "GAIN16" /end COMPU_VTAB
/begin COMPU_METHOD FORMULA_0750 "FORMULA_0750" RAT_FUNC "%9.4" "mA" COEFFS 0 32768 0 0 0 10 /end COMPU_METHOD
/begin COMPU_METHOD FORMULA_0751 "FORMULA_0751" RAT_FUNC "%9.4" "1/ms" COEFFS 0 16384000 0 0 0 1 /end COMPU_METHOD
/begin COMPU_METHOD FORMULA_0752 "FORMULA_0752" RAT_FUNC "%7.2" "mg" COEFFS 0 64 0 0 0 1 /end COMPU_METHOD
/begin COMPU_METHOD FORMULA_0753 "FORMULA_0753" RAT_FUNC "%8.3" "s" COEFFS 0 1000 0 0 0 1 /end COMPU_METHOD
/begin COMPU_METHOD FORMULA_0754 "FORMULA_0754" RAT_FUNC "%7.2" "ms" COEFFS 0 1000 0 0 0 32 /end COMPU_METHOD
/begin COMPU_METHOD FORMULA_0755 "FORMULA_0755" RAT_FUNC "%7.2" "-" COEFFS 0 256 0 0 0 1 /end COMPU_METHOD
/begin COMPU_METHOD FORMULA_0756 "FORMULA_0756" TAB_VERB "%7.2" "-" COMPU_TAB_REF FORMULA_0756_VTAB /end COMPU_METHOD
/begin COMPU_VTAB FORMULA_0756_VTAB "FORMULA_0756_VTAB" TAB_VERB 5 1 "LAA-RESET" 2 "LAA-AUS" 4 "LAA-F" 8 "LAA-TE-F" 16 "LAA-OFFS" /end COMPU_VTAB
/begin COMPU_METHOD FORMULA_0757 "FORMULA_0757" TAB_VERB "%7.2" "-" COMPU_TAB_REF FORMULA_0757_VTAB /end COMPU_METHOD
/begin COMPU_VTAB FORMULA_0757_VTAB "FORMULA_0757_VTAB" TAB_VERB 3 0 "-" 1 "F_MIN" 2 "F_MAX" /end COMPU_VTAB
/begin COMPU_METHOD FORMULA_0758 "FORMULA_0758" TAB_VERB "%7.2" "-" COMPU_TAB_REF FORMULA_0758_VTAB /end COMPU_METHOD
/begin COMPU_VTAB FORMULA_0758_VTAB "FORMULA_0758_VTAB" TAB_VERB 3 0 "-" 1 "F_TE_MIN" 2 "F_TE_MAX" /end COMPU_VTAB
/begin COMPU_METHOD FORMULA_0759 "FORMULA_0759" TAB_VERB "%7.2" "-" COMPU_TAB_REF FORMULA_0759_VTAB /end COMPU_METHOD
/begin COMPU_VTAB FORMULA_0759_VTAB "FORMULA_0759_VTAB" TAB_VERB 3 0 "-" 1 "OFFS_MIN" 2 "OFFS_MAX" /end COMPU_VTAB
/begin COMPU_METHOD FORMULA_0760 "FORMULA_0760" TAB_VERB "%7.2" "-" COMPU_TAB_REF FORMULA_0760_VTAB /end COMPU_METHOD
/begin COMPU_VTAB FORMULA_0760_VTAB "FORMULA_0760_VTAB" TAB_VERB 1 0 "-" DEFAULT_VALUE "TI_IST" /end COMPU_VTAB
/begin COMPU_METHOD FORMULA_0761 "FORMULA_0761" TAB_VERB "%7.2" "-" COMPU_TAB_REF FORMULA_0761_VTAB /end COMPU_METHOD
/begin COMPU_VTAB FORMULA_0761_VTAB "FORMULA_0761_VTAB" TAB_VERB 1 0 "no" DEFAULT_VALUE "yes" /end COMPU_VTAB
/begin COMPU_METHOD FORMULA_0762 "FORMULA_0762" RAT_FUNC "%5.0" "ms" COEFFS 0 1000 0 0 0 32 /end COMPU_METHOD
/begin COMPU_METHOD FORMULA_0763 "FORMULA_0763" RAT_FUNC "%8.3" "-" COEFFS 0 8192 0 0 0 1 /end COMPU_METHOD
/begin COMPU_METHOD FORMULA_0764 "FORMULA_0764" RAT_FUNC "%5.0" "ms" COEFFS 0 1 0 0 0 1 /end COMPU_METHOD
/begin COMPU_METHOD FORMULA_0765 "FORMULA_0765" RAT_FUNC "%8.3" "-" COEFFS 0 32768 0 0 0 1 /end COMPU_METHOD
/begin COMPU_METHOD FORMULA_0766 "FORMULA_0766" TAB_VERB "%7.2" "-" COMPU_TAB_REF FORMULA_0766_VTAB /end COMPU_METHOD
/begin COMPU_VTAB FORMULA_0766_VTAB "FORMULA_0766_VTAB" TAB_VERB 1 0 "inaktiv" DEFAULT_VALUE "MS" /end COMPU_VTAB
/begin COMPU_METHOD FORMULA_0767 "FORMULA_0767" TAB_VERB "%7.2" "-" COMPU_TAB_REF FORMULA_0767_VTAB /end COMPU_METHOD
/begin COMPU_VTAB FORMULA_0767_VTAB "FORMULA_0767_VTAB" TAB_VERB 1 0 "inaktiv" DEFAULT_VALUE "ML" /end COMPU_VTAB
/begin COMPU_METHOD FORMULA_0768 "FORMULA_0768" TAB_VERB "%7.2" "-" COMPU_TAB_REF FORMULA_0768_VTAB /end COMPU_METHOD
/begin COMPU_VTAB FORMULA_0768_VTAB "FORMULA_0768_VTAB" TAB_VERB 1 0 "inaktiv" DEFAULT_VALUE "aktiv" /end COMPU_VTAB
/begin COMPU_METHOD FORMULA_0769 "FORMULA_0769" TAB_VERB "%7.2" "-" COMPU_TAB_REF FORMULA_0769_VTAB /end COMPU_METHOD
/begin COMPU_VTAB FORMULA_0769_VTAB "FORMULA_0769_VTAB" TAB_VERB 1 0 "laeuft" DEFAULT_VALUE "fertig" /end COMPU_VTAB
/begin COMPU_METHOD FORMULA_0770 "FORMULA_0770" TAB_VERB "%7.2" "-" COMPU_TAB_REF FORMULA_0770_VTAB /end COMPU_METHOD
/begin COMPU_VTAB FORMULA_0770_VTAB "FORMULA_0770_VTAB" TAB_VERB 1 0 "inaktiv" DEFAULT_VALUE "aktiv" /end COMPU_VTAB
/begin COMPU_METHOD FORMULA_0771 "FORMULA_0771" TAB_VERB "%7.2" "-" COMPU_TAB_REF FORMULA_0771_VTAB /end COMPU_METHOD
/begin COMPU_VTAB FORMULA_0771_VTAB "FORMULA_0771_VTAB" TAB_VERB 1 0 "inaktiv" DEFAULT_VALUE "aktiv" /end COMPU_VTAB
/begin COMPU_METHOD FORMULA_0772 "FORMULA_0772" TAB_VERB "%7.2" "-" COMPU_TAB_REF FORMULA_0772_VTAB /end COMPU_METHOD
/begin COMPU_VTAB FORMULA_0772_VTAB "FORMULA_0772_VTAB" TAB_VERB 1 0 "inaktiv" DEFAULT_VALUE "aktiv" /end COMPU_VTAB
/begin COMPU_METHOD FORMULA_0773 "FORMULA_0773" TAB_VERB "%7.2" "-" COMPU_TAB_REF FORMULA_0773_VTAB /end COMPU_METHOD
/begin COMPU_VTAB FORMULA_0773_VTAB "FORMULA_0773_VTAB" TAB_VERB 1 0 "laeuft" DEFAULT_VALUE "fertig" /end COMPU_VTAB
/begin COMPU_METHOD FORMULA_0774 "FORMULA_0774" TAB_VERB "%7.2" "-" COMPU_TAB_REF FORMULA_0774_VTAB /end COMPU_METHOD
/begin COMPU_VTAB FORMULA_0774_VTAB "FORMULA_0774_VTAB" TAB_VERB 1 0 "inaktiv" DEFAULT_VALUE "Zeit laeuft" /end COMPU_VTAB
/begin COMPU_METHOD FORMULA_0775 "FORMULA_0775" TAB_VERB "%7.2" "-" COMPU_TAB_REF FORMULA_0775_VTAB /end COMPU_METHOD
/begin COMPU_VTAB FORMULA_0775_VTAB "FORMULA_0775_VTAB" TAB_VERB 1 0 "inaktiv" DEFAULT_VALUE "Zeit laeuft" /end COMPU_VTAB
/begin COMPU_METHOD FORMULA_0776 "FORMULA_0776" TAB_VERB "%7.2" "-" COMPU_TAB_REF FORMULA_0776_VTAB /end COMPU_METHOD
/begin COMPU_VTAB FORMULA_0776_VTAB "FORMULA_0776_VTAB" TAB_VERB 1 0 "inaktiv" DEFAULT_VALUE "Zeit laeuft" /end COMPU_VTAB
/begin COMPU_METHOD FORMULA_0777 "FORMULA_0777" TAB_VERB "%7.2" "-" COMPU_TAB_REF FORMULA_0777_VTAB /end COMPU_METHOD
/begin COMPU_VTAB FORMULA_0777_VTAB "FORMULA_0777_VTAB" TAB_VERB 1 0 "inaktiv" DEFAULT_VALUE "Zeit laeuft" /end COMPU_VTAB
/begin COMPU_METHOD FORMULA_0778 "FORMULA_0778" TAB_VERB "%7.2" "-" COMPU_TAB_REF FORMULA_0778_VTAB /end COMPU_METHOD
/begin COMPU_VTAB FORMULA_0778_VTAB "FORMULA_0778_VTAB" TAB_VERB 1 0 "inaktiv" DEFAULT_VALUE "Zeit laeuft" /end COMPU_VTAB
/begin COMPU_METHOD FORMULA_0779 "FORMULA_0779" TAB_VERB "%7.2" "-" COMPU_TAB_REF FORMULA_0779_VTAB /end COMPU_METHOD
/begin COMPU_VTAB FORMULA_0779_VTAB "FORMULA_0779_VTAB" TAB_VERB 1 0 "inaktiv" DEFAULT_VALUE "Zeit laeuft" /end COMPU_VTAB
/begin COMPU_METHOD FORMULA_0780 "FORMULA_0780" TAB_VERB "%7.2" "-" COMPU_TAB_REF FORMULA_0780_VTAB /end COMPU_METHOD
/begin COMPU_VTAB FORMULA_0780_VTAB "FORMULA_0780_VTAB" TAB_VERB 1 0 "-" DEFAULT_VALUE "SCDN" /end COMPU_VTAB
/begin COMPU_METHOD FORMULA_0781 "FORMULA_0781" TAB_VERB "%7.2" "-" COMPU_TAB_REF FORMULA_0781_VTAB /end COMPU_METHOD
/begin COMPU_VTAB FORMULA_0781_VTAB "FORMULA_0781_VTAB" TAB_VERB 1 0 "-" DEFAULT_VALUE "SCDN" /end COMPU_VTAB
/begin COMPU_METHOD FORMULA_0782 "FORMULA_0782" TAB_VERB "%7.2" "-" COMPU_TAB_REF FORMULA_0782_VTAB /end COMPU_METHOD
/begin COMPU_VTAB FORMULA_0782_VTAB "FORMULA_0782_VTAB" TAB_VERB 2 0 "automatisch" 1 "manuell" /end COMPU_VTAB
/begin COMPU_METHOD FORMULA_0783 "FORMULA_0783" TAB_VERB "%7.2" "-" COMPU_TAB_REF FORMULA_0783_VTAB /end COMPU_METHOD
/begin COMPU_VTAB FORMULA_0783_VTAB "FORMULA_0783_VTAB" TAB_VERB 2 0 "Regler inaktiv" 1 "Regler aktiv" /end COMPU_VTAB
/begin COMPU_METHOD FORMULA_0784 "FORMULA_0784" TAB_VERB "%7.2" "-" COMPU_TAB_REF FORMULA_0784_VTAB /end COMPU_METHOD
/begin COMPU_VTAB FORMULA_0784_VTAB "FORMULA_0784_VTAB" TAB_VERB 2 0 "ADAPTION" 1 "RESET" /end COMPU_VTAB
/begin COMPU_METHOD FORMULA_0785 "FORMULA_0785" TAB_VERB "%7.2" "-" COMPU_TAB_REF FORMULA_0785_VTAB /end COMPU_METHOD
/begin COMPU_VTAB FORMULA_0785_VTAB "FORMULA_0785_VTAB" TAB_VERB 2 0 "keine RESET-Anforderung" 1 "LA-RESET-Anforderung" /end COMPU_VTAB
/begin COMPU_METHOD FORMULA_0786 "FORMULA_0786" RAT_FUNC "%7.2" "ms" COEFFS 0 1000 0 0 0 1 /end COMPU_METHOD
/begin COMPU_METHOD FORMULA_0787 "FORMULA_0787" TAB_VERB "%7.2" "-" COMPU_TAB_REF FORMULA_0787_VTAB /end COMPU_METHOD
/begin COMPU_VTAB FORMULA_0787_VTAB "FORMULA_0787_VTAB" TAB_VERB 2 0 "Adaption inaktiv" 1 "Adaption aktiv" /end COMPU_VTAB
/begin COMPU_METHOD FORMULA_0788 "FORMULA_0788" TAB_VERB "%7.2" "-" COMPU_TAB_REF FORMULA_0788_VTAB /end COMPU_METHOD
/begin COMPU_VTAB FORMULA_0788_VTAB "FORMULA_0788_VTAB" TAB_VERB 2 0 "RESET inaktiv" 1 "RESET aktiv" /end COMPU_VTAB
/begin COMPU_METHOD FORMULA_0789 "FORMULA_0789" TAB_VERB "%7.2" "-" COMPU_TAB_REF FORMULA_0789_VTAB /end COMPU_METHOD
/begin COMPU_VTAB FORMULA_0789_VTAB "FORMULA_0789_VTAB" TAB_VERB 2 0 "keine Filterung" 1 "Filterung" /end COMPU_VTAB
/begin COMPU_METHOD FORMULA_0790 "FORMULA_0790" TAB_VERB "%7.2" "-" COMPU_TAB_REF FORMULA_0790_VTAB /end COMPU_METHOD
/begin COMPU_VTAB FORMULA_0790_VTAB "FORMULA_0790_VTAB" TAB_VERB 2 0 "inaktiv" 1 "aktiv" /end COMPU_VTAB
/begin COMPU_METHOD FORMULA_0791 "FORMULA_0791" RAT_FUNC "%5.0" "�C" COEFFS 0 1 0 0 0 1 /end COMPU_METHOD
/begin COMPU_METHOD FORMULA_0792 "FORMULA_0792" RAT_FUNC "%6.1" "-" COEFFS 0 512 0 0 0 1 /end COMPU_METHOD
/* ------------------ Abschnitt erzeugt aus lam_soll.dat ------------------ */
/begin COMPU_METHOD FORMULA_0793 "FORMULA_0793" TAB_VERB "%7.2" "-" COMPU_TAB_REF FORMULA_0793_VTAB /end COMPU_METHOD
/begin COMPU_VTAB FORMULA_0793_VTAB "FORMULA_0793_VTAB" TAB_VERB 21 1 "START" 2 "Normalbetrieb" 4 "SL-Betrieb" 8 "Klopfschutz" 16 "Warmlauf" 32 "Vollast" 64 "SK-Manager" 512 "BEGR-AKTIV" 513 "START/BEGR" 514 "NORMAL/BEGR" 516 "SL/BEGR" 520 "KR-Schutz/BEGR" 528 "WL/BEGR" 544 "VL/BEGR" 576 "SK/BEGR" 1024 "SL-BEGR" 2048 "WL-BEGR" 1536 "SL-BEGR/BEGR" 1540 "SL/BEGR" 2560 "WL-BEGR/BEGR" 2576 "WL/BEGR" DEFAULT_VALUE "undefiniert" /end COMPU_VTAB
/begin COMPU_METHOD FORMULA_0794 "FORMULA_0794" TAB_VERB "%7.2" "-" COMPU_TAB_REF FORMULA_0794_VTAB /end COMPU_METHOD
/begin COMPU_VTAB FORMULA_0794_VTAB "FORMULA_0794_VTAB" TAB_VERB 19 1 "START" 2 "Normalbetrieb" 4 "SL-Betrieb" 8 "Klopfschutz" 16 "Warmlauf" 32 "Vollast" 64 "SK-Manager" 128 "KATS-AKTIV" 129 "KATS-AKTIV" 132 "KATS-AKTIV" 136 "KATS-AKTIV" 144 "KATS-AKTIV" 160 "KATS-AKTIV" 256 "PST-AKTIV" 257 "PST-AKTIV" 260 "PST-AKTIV" 264 "PST-AKTIV" 272 "PST-AKTIV" 288 "PST-AKTIV" DEFAULT_VALUE "undefiniert" /end COMPU_VTAB
/begin COMPU_METHOD FORMULA_0795 "FORMULA_0795" RAT_FUNC "%8.3" "mg" COEFFS 0 40 0 0 0 1 /end COMPU_METHOD
/begin COMPU_METHOD FORMULA_0796 "FORMULA_0796" TAB_VERB "%5.2" "-" COMPU_TAB_REF FORMULA_0796_VTAB /end COMPU_METHOD
/begin COMPU_VTAB FORMULA_0796_VTAB "FORMULA_0796_VTAB" TAB_VERB 1 1 "Triggerung ueber SA" DEFAULT_VALUE "keine Triggerung" /end COMPU_VTAB
/begin COMPU_METHOD FORMULA_0797 "FORMULA_0797" TAB_VERB "%7.2" "-" COMPU_TAB_REF FORMULA_0797_VTAB /end COMPU_METHOD
/begin COMPU_VTAB FORMULA_0797_VTAB "FORMULA_0797_VTAB" TAB_VERB 2 1 "t_segm-144�KW" 2 "t_segm-72�KW" /end COMPU_VTAB
/begin COMPU_METHOD FORMULA_0798 "FORMULA_0798" TAB_VERB "%7.2" "-" COMPU_TAB_REF FORMULA_0798_VTAB /end COMPU_METHOD
/begin COMPU_VTAB FORMULA_0798_VTAB "FORMULA_0798_VTAB" TAB_VERB 2 0 "inaktiv" 1 "aktiv" /end COMPU_VTAB
/begin COMPU_METHOD FORMULA_0799 "FORMULA_0799" RAT_FUNC "%5.0" "sec" COEFFS 0 1 0 0 0 1 /end COMPU_METHOD
/begin COMPU_METHOD FORMULA_0800 "FORMULA_0800" RAT_FUNC "%6.1" "�C" COEFFS 0 10 0 0 0 1 /end COMPU_METHOD
/begin COMPU_METHOD FORMULA_0801 "FORMULA_0801" RAT_FUNC "%8.3" "1/s" COEFFS 0 16384 0 0 0 1 /end COMPU_METHOD
/begin COMPU_METHOD FORMULA_0802 "FORMULA_0802" RAT_FUNC "%8.3" "-/s" COEFFS 0 16384 0 0 0 1 /end COMPU_METHOD
/begin COMPU_METHOD FORMULA_0803 "FORMULA_0803" RAT_FUNC "%6.1" "mg" COEFFS 0 10 0 0 0 1 /end COMPU_METHOD
/begin COMPU_METHOD FORMULA_0804 "FORMULA_0804" RAT_FUNC "%5.0" "sec" COEFFS 0 100 0 0 0 1 /end COMPU_METHOD
/begin COMPU_METHOD FORMULA_0805 "FORMULA_0805" RAT_FUNC "%7.2" "-" COEFFS 0 128 0 0 0 1 /end COMPU_METHOD
/begin COMPU_METHOD FORMULA_0806 "FORMULA_0806" RAT_FUNC "%8.3" "1/�KW" COEFFS 0 1024 0 0 0 1 /end COMPU_METHOD
/begin COMPU_METHOD FORMULA_0807 "FORMULA_0807" TAB_VERB "%7.2" "-" COMPU_TAB_REF FORMULA_0807_VTAB /end COMPU_METHOD
/begin COMPU_VTAB FORMULA_0807_VTAB "FORMULA_0807_VTAB" TAB_VERB 2 0 "no" 1 "yes" /end COMPU_VTAB
/* ------------------ Abschnitt erzeugt aus lank.dat ------------------ */
/begin COMPU_METHOD FORMULA_0808 "FORMULA_0808" TAB_VERB "%5.2" "-" COMPU_TAB_REF FORMULA_0808_VTAB /end COMPU_METHOD
/begin COMPU_VTAB FORMULA_0808_VTAB "FORMULA_0808_VTAB" TAB_VERB 3 0 "unplausibel" 1 "mager" 2 "fett" /end COMPU_VTAB
/begin COMPU_METHOD FORMULA_0809 "FORMULA_0809" TAB_VERB "%7.2" "-" COMPU_TAB_REF FORMULA_0809_VTAB /end COMPU_METHOD
/begin COMPU_VTAB FORMULA_0809_VTAB "FORMULA_0809_VTAB" TAB_VERB 5 0 "-" 1 "Sonde AUS" 2 "UEBERW.EIN" 4 "Sonde EIN" 8 "UEBERW.AUS" /end COMPU_VTAB
/begin COMPU_METHOD FORMULA_0810 "FORMULA_0810" TAB_VERB "%7.2" "-" COMPU_TAB_REF FORMULA_0810_VTAB /end COMPU_METHOD
/begin COMPU_VTAB FORMULA_0810_VTAB "FORMULA_0810_VTAB" TAB_VERB 1 0 "Einschwingzeit aktiv" DEFAULT_VALUE "Einschwingzeit abgelaufen" /end COMPU_VTAB
/begin COMPU_METHOD FORMULA_0811 "FORMULA_0811" TAB_VERB "%7.2" "-" COMPU_TAB_REF FORMULA_0811_VTAB /end COMPU_METHOD
/begin COMPU_VTAB FORMULA_0811_VTAB "FORMULA_0811_VTAB" TAB_VERB 1 0 "i.O." DEFAULT_VALUE "n.i.O." /end COMPU_VTAB
/begin COMPU_METHOD FORMULA_0812 "FORMULA_0812" TAB_VERB "%7.2" "-" COMPU_TAB_REF FORMULA_0812_VTAB /end COMPU_METHOD
/begin COMPU_VTAB FORMULA_0812_VTAB "FORMULA_0812_VTAB" TAB_VERB 1 0 "i.O." DEFAULT_VALUE "n.i.O." /end COMPU_VTAB
/begin COMPU_METHOD FORMULA_0813 "FORMULA_0813" TAB_VERB "%7.2" "-" COMPU_TAB_REF FORMULA_0813_VTAB /end COMPU_METHOD
/begin COMPU_VTAB FORMULA_0813_VTAB "FORMULA_0813_VTAB" TAB_VERB 1 0 "i.O." DEFAULT_VALUE "n.i.O." /end COMPU_VTAB
/begin COMPU_METHOD FORMULA_0814 "FORMULA_0814" TAB_VERB "%7.2" "-" COMPU_TAB_REF FORMULA_0814_VTAB /end COMPU_METHOD
/begin COMPU_VTAB FORMULA_0814_VTAB "FORMULA_0814_VTAB" TAB_VERB 1 0 "i.O." DEFAULT_VALUE "n.i.O." /end COMPU_VTAB
/begin COMPU_METHOD FORMULA_0815 "FORMULA_0815" TAB_VERB "%7.2" "-" COMPU_TAB_REF FORMULA_0815_VTAB /end COMPU_METHOD
/begin COMPU_VTAB FORMULA_0815_VTAB "FORMULA_0815_VTAB" TAB_VERB 1 0 "i.O." DEFAULT_VALUE "SH_TO_UB" /end COMPU_VTAB
/begin COMPU_METHOD FORMULA_0816 "FORMULA_0816" TAB_VERB "%7.2" "-" COMPU_TAB_REF FORMULA_0816_VTAB /end COMPU_METHOD
/begin COMPU_VTAB FORMULA_0816_VTAB "FORMULA_0816_VTAB" TAB_VERB 1 0 "i.O." DEFAULT_VALUE "SH_TO_GND" /end COMPU_VTAB
/begin COMPU_METHOD FORMULA_0817 "FORMULA_0817" TAB_VERB "%7.2" "-" COMPU_TAB_REF FORMULA_0817_VTAB /end COMPU_METHOD
/begin COMPU_VTAB FORMULA_0817_VTAB "FORMULA_0817_VTAB" TAB_VERB 1 0 "i.O." DEFAULT_VALUE "openload" /end COMPU_VTAB
/begin COMPU_METHOD FORMULA_0818 "FORMULA_0818" TAB_VERB "%7.2" "-" COMPU_TAB_REF FORMULA_0818_VTAB /end COMPU_METHOD
/begin COMPU_VTAB FORMULA_0818_VTAB "FORMULA_0818_VTAB" TAB_VERB 1 0 "n.i.O." DEFAULT_VALUE "Temp. i.O." /end COMPU_VTAB
/begin COMPU_METHOD FORMULA_0819 "FORMULA_0819" TAB_VERB "%7.2" "-" COMPU_TAB_REF FORMULA_0819_VTAB /end COMPU_METHOD
/begin COMPU_VTAB FORMULA_0819_VTAB "FORMULA_0819_VTAB" TAB_VERB 1 0 "n.i.O." DEFAULT_VALUE "Signal i.O." /end COMPU_VTAB
/begin COMPU_METHOD FORMULA_0820 "FORMULA_0820" TAB_VERB "%7.2" "-" COMPU_TAB_REF FORMULA_0820_VTAB /end COMPU_METHOD
/begin COMPU_VTAB FORMULA_0820_VTAB "FORMULA_0820_VTAB" TAB_VERB 1 0 "no" DEFAULT_VALUE "yes" /end COMPU_VTAB
/begin COMPU_METHOD FORMULA_0821 "FORMULA_0821" TAB_VERB "%7.2" "-" COMPU_TAB_REF FORMULA_0821_VTAB /end COMPU_METHOD
/begin COMPU_VTAB FORMULA_0821_VTAB "FORMULA_0821_VTAB" TAB_VERB 1 0 "inaktiv." DEFAULT_VALUE "aktiv" /end COMPU_VTAB
/begin COMPU_METHOD FORMULA_0822 "FORMULA_0822" TAB_VERB "%7.2" "-" COMPU_TAB_REF FORMULA_0822_VTAB /end COMPU_METHOD
/begin COMPU_VTAB FORMULA_0822_VTAB "FORMULA_0822_VTAB" TAB_VERB 1 0 "inaktive Diag." DEFAULT_VALUE "aktive Diag." /end COMPU_VTAB
/begin COMPU_METHOD FORMULA_0823 "FORMULA_0823" TAB_VERB "%7.2" "-" COMPU_TAB_REF FORMULA_0823_VTAB /end COMPU_METHOD
/begin COMPU_VTAB FORMULA_0823_VTAB "FORMULA_0823_VTAB" TAB_VERB 1 0 "nicht beendet" DEFAULT_VALUE "Diag. abgelaufen" /end COMPU_VTAB
/begin COMPU_METHOD FORMULA_0824 "FORMULA_0824" TAB_VERB "%7.2" "-" COMPU_TAB_REF FORMULA_0824_VTAB /end COMPU_METHOD
/begin COMPU_VTAB FORMULA_0824_VTAB "FORMULA_0824_VTAB" TAB_VERB 1 0 "nicht erfuellt" DEFAULT_VALUE "def. SA-Phase" /end COMPU_VTAB
/begin COMPU_METHOD FORMULA_0825 "FORMULA_0825" TAB_VERB "%7.2" "-" COMPU_TAB_REF FORMULA_0825_VTAB /end COMPU_METHOD
/begin COMPU_VTAB FORMULA_0825_VTAB "FORMULA_0825_VTAB" TAB_VERB 1 0 "-" DEFAULT_VALUE "Zeit ist beendet" /end COMPU_VTAB
/begin COMPU_METHOD FORMULA_0826 "FORMULA_0826" TAB_VERB "%7.2" "-" COMPU_TAB_REF FORMULA_0826_VTAB /end COMPU_METHOD
/begin COMPU_VTAB FORMULA_0826_VTAB "FORMULA_0826_VTAB" TAB_VERB 1 0 "-" DEFAULT_VALUE "Anfettung ist beendet" /end COMPU_VTAB
/begin COMPU_METHOD FORMULA_0827 "FORMULA_0827" TAB_VERB "%7.2" "-" COMPU_TAB_REF FORMULA_0827_VTAB /end COMPU_METHOD
/begin COMPU_VTAB FORMULA_0827_VTAB "FORMULA_0827_VTAB" TAB_VERB 1 0 "inaktiv" DEFAULT_VALUE "aktiv" /end COMPU_VTAB
/begin COMPU_METHOD FORMULA_0828 "FORMULA_0828" TAB_VERB "%7.2" "-" COMPU_TAB_REF FORMULA_0828_VTAB /end COMPU_METHOD
/begin COMPU_VTAB FORMULA_0828_VTAB "FORMULA_0828_VTAB" TAB_VERB 1 0 "aus MAGER" DEFAULT_VALUE "aus FETT" /end COMPU_VTAB
/begin COMPU_METHOD FORMULA_0829 "FORMULA_0829" TAB_VERB "%7.2" "-" COMPU_TAB_REF FORMULA_0829_VTAB /end COMPU_METHOD
/begin COMPU_VTAB FORMULA_0829_VTAB "FORMULA_0829_VTAB" TAB_VERB 1 0 "aus FETT" DEFAULT_VALUE "aus MAGER" /end COMPU_VTAB
/begin COMPU_METHOD FORMULA_0830 "FORMULA_0830" TAB_VERB "%7.2" "-" COMPU_TAB_REF FORMULA_0830_VTAB /end COMPU_METHOD
/begin COMPU_VTAB FORMULA_0830_VTAB "FORMULA_0830_VTAB" TAB_VERB 1 0 "kein WE" DEFAULT_VALUE "WE erkannt" /end COMPU_VTAB
/begin COMPU_METHOD FORMULA_0831 "FORMULA_0831" TAB_VERB "%7.2" "-" COMPU_TAB_REF FORMULA_0831_VTAB /end COMPU_METHOD
/begin COMPU_VTAB FORMULA_0831_VTAB "FORMULA_0831_VTAB" TAB_VERB 1 0 "no" DEFAULT_VALUE "yes" /end COMPU_VTAB
/begin COMPU_METHOD FORMULA_0832 "FORMULA_0832" RAT_FUNC "%5.0" "mg" COEFFS 0 1 0 0 0 1 /end COMPU_METHOD
/begin COMPU_METHOD FORMULA_0833 "FORMULA_0833" TAB_VERB "%7.2" "-" COMPU_TAB_REF FORMULA_0833_VTAB /end COMPU_METHOD
/begin COMPU_VTAB FORMULA_0833_VTAB "FORMULA_0833_VTAB" TAB_VERB 1 0 "-" DEFAULT_VALUE "unterschritten" /end COMPU_VTAB
/begin COMPU_METHOD FORMULA_0834 "FORMULA_0834" TAB_VERB "%7.2" "-" COMPU_TAB_REF FORMULA_0834_VTAB /end COMPU_METHOD
/begin COMPU_VTAB FORMULA_0834_VTAB "FORMULA_0834_VTAB" TAB_VERB 1 0 "-" DEFAULT_VALUE "unterschritten" /end COMPU_VTAB
/begin COMPU_METHOD FORMULA_0835 "FORMULA_0835" TAB_VERB "%7.2" "-" COMPU_TAB_REF FORMULA_0835_VTAB /end COMPU_METHOD
/begin COMPU_VTAB FORMULA_0835_VTAB "FORMULA_0835_VTAB" TAB_VERB 1 0 "no" DEFAULT_VALUE "yes" /end COMPU_VTAB
/begin COMPU_METHOD FORMULA_0836 "FORMULA_0836" TAB_VERB "%7.2" "-" COMPU_TAB_REF FORMULA_0836_VTAB /end COMPU_METHOD
/begin COMPU_VTAB FORMULA_0836_VTAB "FORMULA_0836_VTAB" TAB_VERB 1 0 "inaktiv" DEFAULT_VALUE "aktiv" /end COMPU_VTAB
/begin COMPU_METHOD FORMULA_0837 "FORMULA_0837" TAB_VERB "%7.2" "-" COMPU_TAB_REF FORMULA_0837_VTAB /end COMPU_METHOD
/begin COMPU_VTAB FORMULA_0837_VTAB "FORMULA_0837_VTAB" TAB_VERB 1 0 "im Bereich" DEFAULT_VALUE "ausserhalb Bereich" /end COMPU_VTAB
/begin COMPU_METHOD FORMULA_0838 "FORMULA_0838" RAT_FUNC "%7.2" "-" COEFFS 0 255 0 0 0 1 /end COMPU_METHOD
/begin COMPU_METHOD FORMULA_0839 "FORMULA_0839" TAB_VERB "%5.2" "-" COMPU_TAB_REF FORMULA_0839_VTAB /end COMPU_METHOD
/begin COMPU_VTAB FORMULA_0839_VTAB "FORMULA_0839_VTAB" TAB_VERB 2 0 "inaktiv" 1 "aktiv" /end COMPU_VTAB
/begin COMPU_METHOD FORMULA_0840 "FORMULA_0840" RAT_FUNC "%6.1" "%" COEFFS 0 1024 0 0 0 100 /end COMPU_METHOD
/* ------------------ Abschnitt erzeugt aus lavk_spi.dat ------------------ */
/begin COMPU_METHOD FORMULA_0872 "FORMULA_0872" TAB_VERB "%3.0" "-" COMPU_TAB_REF FORMULA_0872_VTAB /end COMPU_METHOD
/begin COMPU_VTAB FORMULA_0872_VTAB "FORMULA_0872_VTAB" TAB_VERB 5 0 "IDLE" 1 "Init Sonde" 2 "RESET Sensor" 3 "Diagnose Sensor" 4 "Chip Code" /end COMPU_VTAB
/begin COMPU_METHOD FORMULA_0873 "FORMULA_0873" TAB_VERB "%5.2" "-" COMPU_TAB_REF FORMULA_0873_VTAB /end COMPU_METHOD
/begin COMPU_VTAB FORMULA_0873_VTAB "FORMULA_0873_VTAB" TAB_VERB 1 0 "Gain 8" DEFAULT_VALUE "Gain 16" /end COMPU_VTAB
/begin COMPU_METHOD FORMULA_0874 "FORMULA_0874" TAB_VERB "%5.2" "-" COMPU_TAB_REF FORMULA_0874_VTAB /end COMPU_METHOD
/begin COMPU_VTAB FORMULA_0874_VTAB "FORMULA_0874_VTAB" TAB_VERB 1 0 "Off" DEFAULT_VALUE "On" /end COMPU_VTAB
/begin COMPU_METHOD FORMULA_0875 "FORMULA_0875" TAB_VERB "%5.2" "-" COMPU_TAB_REF FORMULA_0875_VTAB /end COMPU_METHOD
/begin COMPU_VTAB FORMULA_0875_VTAB "FORMULA_0875_VTAB" TAB_VERB 1 0 "Off" DEFAULT_VALUE "On" /end COMPU_VTAB
/begin COMPU_METHOD FORMULA_0876 "FORMULA_0876" TAB_VERB "%5.2" "-" COMPU_TAB_REF FORMULA_0876_VTAB /end COMPU_METHOD
/begin COMPU_VTAB FORMULA_0876_VTAB "FORMULA_0876_VTAB" TAB_VERB 1 0 "Disable" DEFAULT_VALUE "Enable" /end COMPU_VTAB
/begin COMPU_METHOD FORMULA_0877 "FORMULA_0877" TAB_VERB "%5.2" "-" COMPU_TAB_REF FORMULA_0877_VTAB /end COMPU_METHOD
/begin COMPU_VTAB FORMULA_0877_VTAB "FORMULA_0877_VTAB" TAB_VERB 1 0 "Off" DEFAULT_VALUE "On" /end COMPU_VTAB
/begin COMPU_METHOD FORMULA_0878 "FORMULA_0878" TAB_VERB "%5.2" "-" COMPU_TAB_REF FORMULA_0878_VTAB /end COMPU_METHOD
/begin COMPU_VTAB FORMULA_0878_VTAB "FORMULA_0878_VTAB" TAB_VERB 1 0 "Disable" DEFAULT_VALUE "Enable" /end COMPU_VTAB
/begin COMPU_METHOD FORMULA_0879 "FORMULA_0879" TAB_VERB "%5.2" "-" COMPU_TAB_REF FORMULA_0879_VTAB /end COMPU_METHOD
/begin COMPU_VTAB FORMULA_0879_VTAB "FORMULA_0879_VTAB" TAB_VERB 1 0 "Range 1" DEFAULT_VALUE "Range 2" /end COMPU_VTAB
/begin COMPU_METHOD FORMULA_0880 "FORMULA_0880" TAB_VERB "%7.2" "-" COMPU_TAB_REF FORMULA_0880_VTAB /end COMPU_METHOD
/begin COMPU_VTAB FORMULA_0880_VTAB "FORMULA_0880_VTAB" TAB_VERB 1 0 "Off" DEFAULT_VALUE "On" /end COMPU_VTAB
/begin COMPU_METHOD FORMULA_0881 "FORMULA_0881" TAB_VERB "%7.2" "-" COMPU_TAB_REF FORMULA_0881_VTAB /end COMPU_METHOD
/begin COMPU_VTAB FORMULA_0881_VTAB "FORMULA_0881_VTAB" TAB_VERB 1 0 "Off" DEFAULT_VALUE "On" /end COMPU_VTAB
/begin COMPU_METHOD FORMULA_0882 "FORMULA_0882" TAB_VERB "%5.2" "-" COMPU_TAB_REF FORMULA_0882_VTAB /end COMPU_METHOD
/begin COMPU_VTAB FORMULA_0882_VTAB "FORMULA_0882_VTAB" TAB_VERB 2 0 "Range 1" 1 "Range 2" /end COMPU_VTAB
/begin COMPU_METHOD FORMULA_0883 "FORMULA_0883" TAB_VERB "%5.2" "-" COMPU_TAB_REF FORMULA_0883_VTAB /end COMPU_METHOD
/begin COMPU_VTAB FORMULA_0883_VTAB "FORMULA_0883_VTAB" TAB_VERB 2 0 "Disable" 1 "Enable" /end COMPU_VTAB
/begin COMPU_METHOD FORMULA_0884 "FORMULA_0884" TAB_VERB "%5.2" "-" COMPU_TAB_REF FORMULA_0884_VTAB /end COMPU_METHOD
/begin COMPU_VTAB FORMULA_0884_VTAB "FORMULA_0884_VTAB" TAB_VERB 2 0 "inaktiv" 1 "aktiv" /end COMPU_VTAB
/begin COMPU_METHOD FORMULA_0885 "FORMULA_0885" RAT_FUNC "%5.0" "uA" COEFFS 0 -1 5.15 0 0 -5.15 /end COMPU_METHOD
/begin COMPU_METHOD FORMULA_0886 "FORMULA_0886" RAT_FUNC "%6.1" "ms" COEFFS 0 -1 0.8 0 0 -0.1 /end COMPU_METHOD
/begin COMPU_METHOD FORMULA_0887 "FORMULA_0887" RAT_FUNC "%8.3" "kHz" COEFFS 0 -1 1.9531 0 0 -0.122 /end COMPU_METHOD
/begin COMPU_METHOD FORMULA_0888 "FORMULA_0888" TAB_VERB "%5.2" "-" COMPU_TAB_REF FORMULA_0888_VTAB /end COMPU_METHOD
/begin COMPU_VTAB FORMULA_0888_VTAB "FORMULA_0888_VTAB" TAB_VERB 2 0 "keine DIAG-Info" 1 "DIAG-Info" /end COMPU_VTAB
/begin COMPU_METHOD FORMULA_0889 "FORMULA_0889" TAB_VERB "%3.0" "-" COMPU_TAB_REF FORMULA_0889_VTAB /end COMPU_METHOD
/begin COMPU_VTAB FORMULA_0889_VTAB "FORMULA_0889_VTAB" TAB_VERB 2 0 "Off" 1 "On" DEFAULT_VALUE "nicht definiert" /end COMPU_VTAB
/begin COMPU_METHOD FORMULA_0890 "FORMULA_0890" TAB_VERB "%3.0" "-" COMPU_TAB_REF FORMULA_0890_VTAB /end COMPU_METHOD
/begin COMPU_VTAB FORMULA_0890_VTAB "FORMULA_0890_VTAB" TAB_VERB 2 0 "Disable" 1 "Enable" DEFAULT_VALUE "nicht definiert" /end COMPU_VTAB
/begin COMPU_METHOD FORMULA_0891 "FORMULA_0891" RAT_FUNC "%3.0" "uA" COEFFS 0 -1 5.15 0 0 -5.15 /end COMPU_METHOD
/begin COMPU_METHOD FORMULA_0892 "FORMULA_0892" RAT_FUNC "%4.1" "ms" COEFFS 0 -1 0.8 0 0 -0.1 /end COMPU_METHOD
/begin COMPU_METHOD FORMULA_0893 "FORMULA_0893" RAT_FUNC "%6.3" "kHz" COEFFS 0 -1 1.9531 0 0 -0.122 /end COMPU_METHOD
/begin COMPU_METHOD FORMULA_0894 "FORMULA_0894" TAB_VERB "%3.0" "-" COMPU_TAB_REF FORMULA_0894_VTAB /end COMPU_METHOD
/begin COMPU_VTAB FORMULA_0894_VTAB "FORMULA_0894_VTAB" TAB_VERB 2 0 "inaktiv" 1 "aktiv" DEFAULT_VALUE "nicht definiert" /end COMPU_VTAB
/* ------------------ Abschnitt erzeugt aus mdrv.dat ------------------ */
/begin COMPU_METHOD FORMULA_0963 "FORMULA_0963" TAB_VERB "%3.0" "-" COMPU_TAB_REF FORMULA_0963_VTAB /end COMPU_METHOD
/begin COMPU_VTAB FORMULA_0963_VTAB "FORMULA_0963_VTAB" TAB_VERB 3 0 "MDrv off" 1 "MDrv on" 2 "MDrv left" DEFAULT_VALUE "undef" /end COMPU_VTAB
/begin COMPU_METHOD FORMULA_0964 "FORMULA_0964" TAB_VERB "%3.0" "-" COMPU_TAB_REF FORMULA_0964_VTAB /end COMPU_METHOD
/begin COMPU_VTAB FORMULA_0964_VTAB "FORMULA_0964_VTAB" TAB_VERB 1 0 "Aus" DEFAULT_VALUE "Ein" /end COMPU_VTAB
/begin COMPU_METHOD FORMULA_0965 "FORMULA_0965" TAB_VERB "%3.0" "-" COMPU_TAB_REF FORMULA_0965_VTAB /end COMPU_METHOD
/begin COMPU_VTAB FORMULA_0965_VTAB "FORMULA_0965_VTAB" TAB_VERB 1 0 "Aus" DEFAULT_VALUE "Ein" /end COMPU_VTAB
/begin COMPU_METHOD FORMULA_0966 "FORMULA_0966" TAB_VERB "%5.2" "-" COMPU_TAB_REF FORMULA_0966_VTAB /end COMPU_METHOD
/begin COMPU_VTAB FORMULA_0966_VTAB "FORMULA_0966_VTAB" TAB_VERB 5 0 "Schalter" 1 "Komfort" 2 "Normal" 3 "Sport" 4 "Konfigmode" DEFAULT_VALUE "undef" /end COMPU_VTAB
/begin COMPU_METHOD FORMULA_0967 "FORMULA_0967" TAB_VERB "%5.2" "-" COMPU_TAB_REF FORMULA_0967_VTAB /end COMPU_METHOD
/begin COMPU_VTAB FORMULA_0967_VTAB "FORMULA_0967_VTAB" TAB_VERB 2 0 "nur US" 1 "immer" /end COMPU_VTAB
/* ------------------ Abschnitt erzeugt aus msa.dat ------------------ */
/begin COMPU_METHOD FORMULA_0968 "FORMULA_0968" TAB_VERB "%5.2" "-" COMPU_TAB_REF FORMULA_0968_VTAB /end COMPU_METHOD
/begin COMPU_VTAB FORMULA_0968_VTAB "FORMULA_0968_VTAB" TAB_VERB 2 0 "gesperrt" 1 "frei" /end COMPU_VTAB
/begin COMPU_METHOD FORMULA_0969 "FORMULA_0969" TAB_VERB "%5.2" "-" COMPU_TAB_REF FORMULA_0969_VTAB /end COMPU_METHOD
/begin COMPU_VTAB FORMULA_0969_VTAB "FORMULA_0969_VTAB" TAB_VERB 2 0 "Low" 1 "High" /end COMPU_VTAB
/* ------------------ Abschnitt erzeugt aus mzyl.dat ------------------ */
/begin COMPU_METHOD FORMULA_0996 "FORMULA_0996" RAT_FUNC "%8.1" "mg" COEFFS 0 10 0 0 0 1 /end COMPU_METHOD
/begin COMPU_METHOD FORMULA_0997 "FORMULA_0997" RAT_FUNC "%8.3" "qcm" COEFFS 0 1000 0 0 0 1 /end COMPU_METHOD
/begin COMPU_METHOD FORMULA_0998 "FORMULA_0998" RAT_FUNC "%7.2" "ms" COEFFS 0 100 0 0 0 1 /end COMPU_METHOD
/begin COMPU_METHOD FORMULA_0999 "FORMULA_0999" TAB_VERB "%3.0" "-" COMPU_TAB_REF FORMULA_0999_VTAB /end COMPU_METHOD
/begin COMPU_VTAB FORMULA_0999_VTAB "FORMULA_0999_VTAB" TAB_VERB 4 1 "HFM" 2 "PSAU" 4 "AQ" 8 "HFM-AQ Komb" DEFAULT_VALUE "undefiniert" /end COMPU_VTAB
/begin COMPU_METHOD FORMULA_1000 "FORMULA_1000" TAB_VERB "%5.2" "-" COMPU_TAB_REF FORMULA_1000_VTAB /end COMPU_METHOD
/begin COMPU_VTAB FORMULA_1000_VTAB "FORMULA_1000_VTAB" TAB_VERB 4 1 "HFM" 2 "PSAU" 4 "AQ" 8 "HFM-AQ Komb" DEFAULT_VALUE "undefiniert" /end COMPU_VTAB
/begin COMPU_METHOD FORMULA_1001 "FORMULA_1001" TAB_VERB "%5.2" "-" COMPU_TAB_REF FORMULA_1001_VTAB /end COMPU_METHOD
/begin COMPU_VTAB FORMULA_1001_VTAB "FORMULA_1001_VTAB" TAB_VERB 3 1 "HFM" 2 "PSAU" 4 "AQ" DEFAULT_VALUE "undefiniert" /end COMPU_VTAB
/begin COMPU_METHOD FORMULA_1002 "FORMULA_1002" TAB_VERB "%5.2" "-" COMPU_TAB_REF FORMULA_1002_VTAB /end COMPU_METHOD
/begin COMPU_VTAB FORMULA_1002_VTAB "FORMULA_1002_VTAB" TAB_VERB 4 1 "TAN HFM" 2 "TAN Modell" 4 "TMOT" 8 "TAN+TMOT/2" /end COMPU_VTAB
/begin COMPU_METHOD FORMULA_1003 "FORMULA_1003" RAT_FUNC "%6.1" "J/K*mol" COEFFS 0 10 0 0 0 1 /end COMPU_METHOD
/begin COMPU_METHOD FORMULA_1004 "FORMULA_1004" RAT_FUNC "%9.4" "-/tseg" COEFFS 0 10000 0 0 0 1 /end COMPU_METHOD
/* ------------------ Abschnitt erzeugt aus la.dat ------------------ */
/begin CHARACTERISTIC K_LAVK_AD_TEST " d. Sondenadaption | EN: Sensor adaptation" VALUE 0x735AC TKW_VV_VV_UW 100.0 FORMULA_0782 0.0 1.0 FORMAT "%5.2" /end CHARACTERISTIC
/begin CHARACTERISTIC K_LAVK_AD_MIN "MIN-AD-Wert d. Sondensignals | EN: Minimum A/D value of sensor signal [mV]" VALUE 0x735AE TKW_VV_VV_UW 100.0 FORMULA_0532 0.0 5000.0000 /end CHARACTERISTIC
/begin CHARACTERISTIC K_LAVK_AD_MAX "MAX-AD-Wert d. Sondensignals | EN: Maximum A/D value of sensor signal [mV]" VALUE 0x735B0 TKW_VV_VV_UW 100.0 FORMULA_0532 0.0 5000.0000 /end CHARACTERISTIC
/begin CHARACTERISTIC K_LAVK_US_REF "Referenzspannung lambda=1,0 | EN: Reference voltage lambda = 1.0 [mV]" VALUE 0x735B2 TKW_VV_VV_UW 100.0 FORMULA_0532 0.0 5000.0000 /end CHARACTERISTIC
/begin CHARACTERISTIC K_LAVK_R7 "Widerstand R7 | EN: Resistor R7 [Ohm]" VALUE 0x735B4 TKW_VV_VV_UW 100.0 FORMULA_0537 0.0 6553.5000 FORMAT "%4.1" /end CHARACTERISTIC
/begin CHARACTERISTIC K_LAVK_GAIN_LAM_SCHW "Umschaltschw. f. Signalverstaerkung | EN: Switching threshold for signal gain" VALUE 0x735B6 TKW_VV_VV_UW 100.0 FORMULA_0025 0.0 3.9990 FORMAT "%6.3" /end CHARACTERISTIC
/begin CHARACTERISTIC K_LAVK_AD_OFFS_CNT_MIN "MIN-Zaehler fuer OFFSET-Sondenadaption | EN: Minimum counter for sensor offset adaptation" VALUE 0x735B8 TKW_VV_VV_UW 100.0 FORMULA_0010 0.0 65535.0000 /end CHARACTERISTIC
/begin CHARACTERISTIC K_LAVK_AD_OFFS_CNT_MIN_MS "MIN-Zaehler fuer MS-OFFSET-Sondenadapt. | EN: Minimum counter for MS sensor offset adaptation" VALUE 0x735BA TKW_VV_VV_UW 100.0 FORMULA_0010 0.0 65535.0000 /end CHARACTERISTIC
/begin CHARACTERISTIC K_LAVK_AD_OFFS_CNT "Zaehler fuer OFFSET-Sondenadaption | EN: Counter for sensor offset adaptation" VALUE 0x735BC TKW_VV_VV_UW 100.0 FORMULA_0010 0.0 65535.0000 /end CHARACTERISTIC
/begin CHARACTERISTIC K_LAVK_AD_OFFS_CNT_MS "Zaehler fuer MS-OFFSET-Sondenadapt. | EN: Counter for MS sensor offset adaptation" VALUE 0x735BE TKW_VV_VV_UW 100.0 FORMULA_0010 0.0 65535.0000 /end CHARACTERISTIC
/begin CHARACTERISTIC K_LAVK_AD_GAIN_CNT_MIN "MIN-Zaehler fuer GAIN-Sondenadaption | EN: Minimum counter for sensor gain adaptation" VALUE 0x735C0 TKW_VV_VV_UW 100.0 FORMULA_0010 0.0 65535.0000 /end CHARACTERISTIC
/begin CHARACTERISTIC K_LAVK_AD_GAIN_CNT "Zaehler fuer GAIN-Sondenadapt. | EN: Zaehler fuer GAIN-Sondenadapt." VALUE 0x735C2 TKW_VV_VV_UW 100.0 FORMULA_0010 0.0 65535.0000 /end CHARACTERISTIC
/begin CHARACTERISTIC K_LAVK_AD_OFFS_T "MIN-Zeit zwischen zwei OFFSET-Adapt. | EN: MIN-Zeit zwischen zwei OFF-SET-Adapt." VALUE 0x735C4 TKW_VV_VV_UW 100.0 FORMULA_0021 0.0 655.0000 FORMAT "%5.2" /end CHARACTERISTIC
/begin CHARACTERISTIC K_LAVK_AD_GAIN_T "MIN-Zeit zwischen zwei GAIN-Adapt. | EN: MIN-Zeit zwischen zwei GAIN-Adapt." VALUE 0x735C6 TKW_VV_VV_UW 100.0 FORMULA_0021 0.0 655.0000 FORMAT "%5.2" /end CHARACTERISTIC
/begin CHARACTERISTIC K_LAVK_AD_OFFS_T1 "Filterkoeffizient - OFFSET-Sondenadapt. | EN: Filterkoeffizient - OFFSET-Sondenadapt." VALUE 0x735C8 TKW_VV_VV_UW 100.0 FORMULA_0595 0.0 655350.0000 /end CHARACTERISTIC
/begin CHARACTERISTIC K_LAVK_AD_GAIN_T1 "Filterkoeffizient - GAIN-Sondenadapt. | EN: Filterkoeffizient - GAIN-Sondenadapt." VALUE 0x735CA TKW_VV_VV_UW 100.0 FORMULA_0595 0.0 655350.0000 /end CHARACTERISTIC
/begin CHARACTERISTIC K_LAVK_AD_OFFS_MAX "MAX-Schwelle f. Offset-Sondenadaption | EN: MAX-Schwelle f. Offset-Sondenadaption" VALUE 0x735CC TKW_VV_VV_UW 100.0 FORMULA_0532 0.0 5000.0000 /end CHARACTERISTIC
/begin CHARACTERISTIC K_LAVK_AD_OFFS_MIN "MIN-Schwelle f. Offset-Sondenadaption | EN: MIN-Schwelle f. Offset-Sondenadaption" VALUE 0x735CE TKW_VV_VV_UW 100.0 FORMULA_0532 0.0 5000.0000 /end CHARACTERISTIC
/begin CHARACTERISTIC K_LAVK_AD_GAIN_MIN "MIN-Schwelle f. GAIN-Sondenadaption | EN: MIN-Schwelle f. GAIN-Sondenadaption" VALUE 0x735D0 TKW_VV_VV_UW 100.0 FORMULA_0532 0.0 5000.0000 /end CHARACTERISTIC
/begin CHARACTERISTIC K_LAVK_AD_OFFS_GRAD "max. OFFEST-Gradient | EN: max. OFFEST-Gradient" VALUE 0x735D2 TKW_VV_VV_UW 100.0 FORMULA_0532 0.0 5000.0000 /end CHARACTERISTIC
/begin CHARACTERISTIC K_LAVK_AD_GAIN_GRAD "max. GAIN-Gradient | EN: max. GAIN-Gradient" VALUE 0x735D4 TKW_VV_VV_UW 100.0 FORMULA_0075 0.0 4.0000 FORMAT "%6.3" /end CHARACTERISTIC
/begin CHARACTERISTIC K_LAVK_AD_GAIN_ML_MIN "MIN-Luftmasse pro Bank | EN: MIN-Luftmasse pro Bank" VALUE 0x735D6 TKW_VV_VV_SW 100.0 FORMULA_0112 -100.0000 1400.0000 FORMAT "%4.1" /end CHARACTERISTIC
/begin CHARACTERISTIC K_LAVK_AD_OFFS_NV_MAX "max. Grenze fuer OFFEST-Sonden-Adapt. | EN: max. Grenze fuer OFFEST-Sonden-Adapt." VALUE 0x735D8 TKW_VV_VV_SW 100.0 FORMULA_0532 -5000.0000 5000.0000 /end CHARACTERISTIC
/begin CHARACTERISTIC K_LAVK_AD_OFFS_NV_MIN "min. Grenze fuer OFFEST-Sonden-Adapt. | EN: min. Grenze fuer OFFEST-Sonden-Adapt." VALUE 0x735DA TKW_VV_VV_SW 100.0 FORMULA_0532 -5000.0000 5000.0000 /end CHARACTERISTIC
/begin CHARACTERISTIC K_LAVK_AD_GAIN_NV_MAX "max. Grenze fuer GAIN-Sonden-Adapt. | EN: max. Grenze fuer GAIN-Sonden-Adapt." VALUE 0x735DC TKW_VV_VV_UW 100.0 FORMULA_0075 0.0 4.0000 FORMAT "%6.3" /end CHARACTERISTIC
/begin CHARACTERISTIC K_LAVK_AD_GAIN_NV_MIN "min. Grenze fuer GAIN-Sonden-Adapt. | EN: min. Grenze fuer GAIN-Sonden-Adapt." VALUE 0x735DE TKW_VV_VV_UW 100.0 FORMULA_0075 0.0 4.0000 FORMAT "%6.3" /end CHARACTERISTIC
/begin CHARACTERISTIC K_LAM_REG_CFG "Freigabe Lambdaregler | EN: 0 keine RESET- Anforderung 1 LA-RESET- Anforderung Freigabe Lambdaregler" VALUE 0x735E0 TKW_VV_VV_UW 100.0 FORMULA_0783 0.0 1.0 FORMAT "%5.2" /end CHARACTERISTIC
/begin CHARACTERISTIC K_LAVK_US_LUFT_REF "Referenzspannung LUFT | EN: Referenzspannung LUFT" VALUE 0x735E2 TKW_VV_VV_UW 100.0 FORMULA_0532 0.0 5000.0000 /end CHARACTERISTIC
/begin CHARACTERISTIC K_LAVK_AD_RESET "RESET d. Sondenadaption | EN: 0 ADAPTION 1 RESET RESET d. Sondenadaption" VALUE 0x735E4 TKW_VV_VV_UW 100.0 FORMULA_0784 0.0 1.0 FORMAT "%5.2" /end CHARACTERISTIC
/begin CHARACTERISTIC K_LAM_REG_RESET_CFG "RESET Lambdaregler | EN: 0 keine RESET- Anforderung 1 LA-RESET- Anforderung RESET Lambdaregler" VALUE 0x735E6 TKW_VV_VV_UW 100.0 FORMULA_0785 0.0 1.0 FORMAT "%5.2" /end CHARACTERISTIC
/begin CHARACTERISTIC K_LAM_REG_START_TIME "Verzaegerungszeit nach Startende | EN: Verzoegerungszeit nach Startende" VALUE 0x735E8 TKW_VV_VV_UW 100.0 FORMULA_0021 0.0 655.3500 FORMAT "%5.2" /end CHARACTERISTIC
/begin CHARACTERISTIC K_LAM_REG_TI_IST_MIN "min. SOLL-TI" VALUE 0x735EA TKW_VV_VV_UW 100.0 FORMULA_0786 0.0 65.5350 FORMAT "%5.2" /end CHARACTERISTIC
/begin CHARACTERISTIC K_LAM_REG_IST_MW_MIN "min. IST-Lambdawert | EN: Minimum actual lambda value" VALUE 0x735EC TKW_VV_VV_UW 100.0 FORMULA_0025 0.0 3.9990 FORMAT "%6.3" /end CHARACTERISTIC
/begin CHARACTERISTIC K_LAM_REG_IST_MW_MAX "max. IST_Lambdawert | EN: Maximum actual lambda value" VALUE 0x735EE TKW_VV_VV_UW 100.0 FORMULA_0025 0.0 3.9990 FORMAT "%6.3" /end CHARACTERISTIC
/begin CHARACTERISTIC K_LAM_REG_SOLL_MIN "min. SOLL-Lambdawert | EN: Minimum target lambda value" VALUE 0x735F0 TKW_VV_VV_UW 100.0 FORMULA_0025 0.0 3.9990 FORMAT "%6.3" /end CHARACTERISTIC
/begin CHARACTERISTIC K_LAM_REG_SOLL_MAX "max. SOLL_Lambdawert | EN: Maximum target lambda value" VALUE 0x735F2 TKW_VV_VV_UW 100.0 FORMULA_0025 0.0 3.9990 FORMAT "%6.3" /end CHARACTERISTIC
/begin CHARACTERISTIC K_LAM_REG_DELTA_MIN "min. Reglerabweichung | EN: Minimum control error" VALUE 0x735F4 TKW_VV_VV_SW 100.0 FORMULA_0025 -2.0000 1.9999 FORMAT "%6.3" /end CHARACTERISTIC
/begin CHARACTERISTIC K_LAM_REG_DELTA_MAX "max. Reglerabweichung | EN: Maximum control error" VALUE 0x735F6 TKW_VV_VV_SW 100.0 FORMULA_0025 -2.0000 1.9999 FORMAT "%6.3" /end CHARACTERISTIC
/begin CHARACTERISTIC K_LAM_REG_DELTA_STAT_MAX "Regelabweichung f. stationaeren Zustand | EN: Control error for steady state" VALUE 0x735F8 TKW_VV_VV_UW 100.0 FORMULA_0025 0.0 3.9990 FORMAT "%6.3" /end CHARACTERISTIC
/begin CHARACTERISTIC K_LAM_REG_DELTA_STAT_MAX_TE "Regelabweichung f. stat. Zustand bei TE | EN: Control error for steady state during purge" VALUE 0x735FA TKW_VV_VV_UW 100.0 FORMULA_0025 0.0 3.9990 FORMAT "%6.3" /end CHARACTERISTIC
/begin CHARACTERISTIC K_LAM_REG_DELTA_STAT_TRIM "Regelabweichung f. stat. Zustand - Trimmregelung | EN: Control error for steady state - trim control" VALUE 0x735FC TKW_VV_VV_UW 100.0 FORMULA_0025 0.0 3.9990 FORMAT "%6.3" /end CHARACTERISTIC
/begin CHARACTERISTIC K_LAM_REG_F_MIN "Regelabweichung f. stationaeren Zustand | EN: Control error for steady state" VALUE 0x735FE TKW_VV_VV_UW 100.0 FORMULA_0024 0.0 1.9990 FORMAT "%7.4" /end CHARACTERISTIC
/begin CHARACTERISTIC K_LAM_REG_F_MAX "Regelabweichung f. stationaeren Zustand | EN: Control error for steady state" VALUE 0x73600 TKW_VV_VV_UW 100.0 FORMULA_0024 0.0 1.9990 FORMAT "%7.4" /end CHARACTERISTIC
/begin CHARACTERISTIC K_LAM_REG_TV_TU_F "Tuningfaktor Vorhaltezeit | EN: Tuning factor, derivative time" VALUE 0x73602 TKW_VV_VV_UB 100.0 FORMULA_0643 0.0 1.9921 /end CHARACTERISTIC
/begin CHARACTERISTIC K_LAM_REG_TN_TU_F "Tuningfaktor Nachstellzeit | EN: Tuning factor, integral time" VALUE 0x73603 TKW_VV_VV_UB 100.0 FORMULA_0643 0.0 1.9921 /end CHARACTERISTIC
/begin CHARACTERISTIC K_LAM_REG_RESET_SA_TMOT_MIN "min. TMOT-Schwelle f. LAA | EN: Minimum engine-temperature threshold for lambda adaptation [°C]" VALUE 0x73604 TKW_VV_VV_SW 100.0 FORMULA_0023 -50.0000 170.0000 FORMAT "%4.1" /end CHARACTERISTIC
/begin CHARACTERISTIC K_LAA_CFG "Freigabe Lambdaadaption" VALUE 0x73606 TKW_VV_VV_UW 100.0 FORMULA_0787 0.0 1.0 FORMAT "%5.2" /end CHARACTERISTIC
/begin CHARACTERISTIC K_LAA_RESET_CFG "Ruecksetzen d.  Lambdaadaption" VALUE 0x73608 TKW_VV_VV_UW 100.0 FORMULA_0788 0.0 1.0 FORMAT "%5.2" /end CHARACTERISTIC
/begin CHARACTERISTIC K_LAA_TAN_MAX "max. TAN-Schwelle fuer LAA | EN: Maximum intake-air-temperature threshold for lambda adaptation [°C]" VALUE 0x7360A TKW_VV_VV_SW 100.0 FORMULA_0023 -50.0000 170.0000 FORMAT "%4.1" /end CHARACTERISTIC
/begin CHARACTERISTIC K_LAA_TMOT_MIN "min. TMOT-Schwelle f. LAA | EN: Minimum engine-temperature threshold for lambda adaptation [°C]" VALUE 0x7360C TKW_VV_VV_SW 100.0 FORMULA_0023 -50.0000 170.0000 FORMAT "%4.1" /end CHARACTERISTIC
/begin CHARACTERISTIC K_LAA_PKS_MAX "max. PKS-Schwelle f. LAA | EN: Maximum fuel-pressure threshold for lambda adaptation [bar]" VALUE 0x7360E TKW_VV_VV_SW 100.0 FORMULA_0118 0.0 10.0000 FORMAT "%6.3" /end CHARACTERISTIC
/begin CHARACTERISTIC K_LAA_F_TE_N_MAX "max. Drehzahl f. TE-LAA | EN: Maximum engine speed for purge lambda adaptation [Upm]" VALUE 0x73610 TKW_VV_VV_SW 100.0 FORMULA_0006 0.0 10000.0000 /end CHARACTERISTIC
/begin CHARACTERISTIC K_LAA_F_N_MIN "min. Drehzahl f. Faktor-LAA | EN: Minimum engine speed for factor lambda adaptation [Upm]" VALUE 0x73612 TKW_VV_VV_SW 100.0 FORMULA_0006 0.0 10000.0000 /end CHARACTERISTIC
/begin CHARACTERISTIC K_LAA_F_N_MAX "max. Drehzahl f. Faktor-LAA | EN: Maximum engine speed for factor lambda adaptation [Upm]" VALUE 0x73614 TKW_VV_VV_SW 100.0 FORMULA_0006 0.0 10000.0000 /end CHARACTERISTIC
/begin CHARACTERISTIC K_LAA_OFFS_N_MAX "max. Drehzahl f. Offset-LAA | EN: Maximum engine speed for offset lambda adaptation [Upm]" VALUE 0x73616 TKW_VV_VV_SW 100.0 FORMULA_0006 0.0 10000.0000 /end CHARACTERISTIC
/begin CHARACTERISTIC K_LAA_F_TE_RF_MAX "max. relative F�llung f. TE-LAA | EN: Maximum relative charge for purge lambda adaptation" VALUE 0x73618 TKW_VV_VV_SW 100.0 FORMULA_0007 0.0 2.0000 FORMAT "%6.3" /end CHARACTERISTIC
/begin CHARACTERISTIC K_LAA_F_RF_MIN "min. relative F�llung f. Faktor-LAA | EN: Minimum relative charge for factor lambda adaptation" VALUE 0x7361A TKW_VV_VV_SW 100.0 FORMULA_0007 0.0 2.0000 FORMAT "%6.3" /end CHARACTERISTIC
/begin CHARACTERISTIC K_LAA_F_RF_MAX "max. relative F�llung f. Faktor-LAA | EN: Maximum relative charge for factor lambda adaptation" VALUE 0x7361C TKW_VV_VV_SW 100.0 FORMULA_0007 0.0 2.0000 FORMAT "%6.3" /end CHARACTERISTIC
/begin CHARACTERISTIC K_LAA_OFFS_RF_MAX "max. relative F�llung f. Offset-LAA | EN: Maximum relative charge for offset lambda adaptation" VALUE 0x7361E TKW_VV_VV_SW 100.0 FORMULA_0007 0.0 2.0000 FORMAT "%6.3" /end CHARACTERISTIC
/begin CHARACTERISTIC K_LAA_F_T_ADAPT "Adaptionszeitraum f. F-Adaption | EN: Adaptation period for factor adaptation [ms]" VALUE 0x73620 TKW_VV_VV_UW 100.0 FORMULA_0764 0.0 65535.0000 /end CHARACTERISTIC
/begin CHARACTERISTIC K_LAA_F_TE_T_ADAPT "Adaptionszeitraum f. F-TE-Adaption | EN: Adaptionszeitraum f. F-TE-Adaption" VALUE 0x73622 TKW_VV_VV_UW 100.0 FORMULA_0764 0.0 65535.0000 /end CHARACTERISTIC
/begin CHARACTERISTIC K_LAA_OFFS_T_ADAPT "Adaptionszeitraum f. OFFS-Adaption | EN: Adaptionszeitraum f. OFFS-Adaption" VALUE 0x73624 TKW_VV_VV_UW 100.0 FORMULA_0764 0.0 65535.0000 /end CHARACTERISTIC
/begin CHARACTERISTIC K_LAA_F_MCS_B1 "MCS-INIT Adaptionsfaktor | EN: MCS-INIT Adaptionsfaktor" VALUE 0x73626 TKW_VV_VV_UW 100.0 FORMULA_0024 0.0 1.9990 FORMAT "%7.4" /end CHARACTERISTIC
/begin CHARACTERISTIC K_LAA_F_MCS_B2 "MCS-INIT Adaptionsfaktor | EN: MCS-INIT Adaptionsfaktor" VALUE 0x73628 TKW_VV_VV_UW 100.0 FORMULA_0024 0.0 1.9990 FORMAT "%7.4" /end CHARACTERISTIC
/begin CHARACTERISTIC K_LAA_F_MAX "max. Adaptionsfaktor | EN: max. Adaptionsfaktor" VALUE 0x7362A TKW_VV_VV_UW 100.0 FORMULA_0024 0.0 1.9990 FORMAT "%7.4" /end CHARACTERISTIC
/begin CHARACTERISTIC K_LAA_F_MIN "min. Adaptionsfaktor | EN: min. Adaptionsfaktor" VALUE 0x7362C TKW_VV_VV_UW 100.0 FORMULA_0024 0.0 1.9990 FORMAT "%7.4" /end CHARACTERISTIC
/begin CHARACTERISTIC K_LAA_F_TE_MAX "max. Offset auf LAA-Faktor ueber TE | EN: max. Offset auf LAA-Faktor ueber TE" VALUE 0x7362E TKW_VV_VV_SW 100.0 FORMULA_0024 -1.0000 0.9999 FORMAT "%7.4" /end CHARACTERISTIC
/begin CHARACTERISTIC K_LAA_F_TE_MIN "min. Offset auf LAA-Faktor ueber TE | EN: min. Offset auf LAA-Faktor ueber TE" VALUE 0x73630 TKW_VV_VV_SW 100.0 FORMULA_0024 -1.0000 0.9999 FORMAT "%7.4" /end CHARACTERISTIC
/begin CHARACTERISTIC K_LAA_OFFS_MCS_B1 "MCS-INIT Offset-Adaption | EN: MCS-INIT Offset-Adaption" VALUE 0x73632 TKW_VV_VV_SW 100.0 FORMULA_0531 -512.0000 511.0000 FORMAT "%6.3" /end CHARACTERISTIC
/begin CHARACTERISTIC K_LAA_OFFS_MCS_B2 "MCS-INIT Offset-Adaption | EN: MCS-INIT Offset-Adaption" VALUE 0x73634 TKW_VV_VV_SW 100.0 FORMULA_0531 -512.0000 511.0000 FORMAT "%6.3" /end CHARACTERISTIC
/begin CHARACTERISTIC K_LAA_OFFS_MAX "max. Offset-Adaption | EN: max. Offset-Adaption" VALUE 0x73636 TKW_VV_VV_SW 100.0 FORMULA_0531 -512.0000 511.0000 FORMAT "%6.3" /end CHARACTERISTIC
/begin CHARACTERISTIC K_LAA_OFFS_MIN "min. Offset-Adaption | EN: min. Offset-Adaption Stetiger Lambdaregler und Lambdaadaption Seite 125 von 198" VALUE 0x73638 TKW_VV_VV_SW 100.0 FORMULA_0531 -512.0000 511.0000 FORMAT "%6.3" /end CHARACTERISTIC
/begin CHARACTERISTIC K_LAA_TI_IST_MIN "min. SOLL-TI | EN: min. SOLL-TI" VALUE 0x7363A TKW_VV_VV_UW 100.0 FORMULA_0786 0.0 65.5350 FORMAT "%5.2" /end CHARACTERISTIC
/begin CHARACTERISTIC K_LAA_OFFS_GRAD "LAA-OFFEST-Gradient | EN: LAA-OFFEST-Gradient" VALUE 0x7363C TKW_VV_VV_SW 100.0 FORMULA_0531 0.0 511.0000 FORMAT "%6.3" /end CHARACTERISTIC
/begin CHARACTERISTIC K_LAA_F_GRAD "LAA-F-Gradient | EN: LAA-F-Gradient" VALUE 0x7363E TKW_VV_VV_UW 100.0 FORMULA_0024 0.0 1.9990 FORMAT "%7.4" /end CHARACTERISTIC
/begin CHARACTERISTIC K_LAA_F_TE_GRAD "LAA-F-Gradient | EN: LAA-F-Gradient" VALUE 0x73640 TKW_VV_VV_UW 100.0 FORMULA_0024 0.0 1.9990 FORMAT "%7.4" /end CHARACTERISTIC
/begin CHARACTERISTIC K_LAA_LAM_REG_F_DELTA "Regelabweichung f. stationaere LAA | EN: Regelabweichung f. stationaere LAA" VALUE 0x73642 TKW_VV_VV_UW 100.0 FORMULA_0024 0.0 1.9990 FORMAT "%7.4" /end CHARACTERISTIC
/begin CHARACTERISTIC K_LAA_F_TE_RAMPE "Abregelwert fuer laa_f_te | EN: Abregelwert fuer laa_f_te" VALUE 0x73644 TKW_VV_VV_UW 100.0 FORMULA_0024 0.0 1.9990 FORMAT "%7.4" /end CHARACTERISTIC
/begin CHARACTERISTIC K_LAVK_FILT_CFG "Filterung IST-LA-Wert" VALUE 0x73646 TKW_VV_VV_UW 100.0 FORMULA_0789 0.0 1.0 FORMAT "%5.2" /end CHARACTERISTIC
/begin CHARACTERISTIC K_LAM_DIAG_CFG "Diagnose LAM_REG/LAA-Anschlag | EN: 0 inaktiv 1 aktiv Diagnose LAM_REG/LAA- Anschlag" VALUE 0x73648 TKW_VV_VV_UW 100.0 FORMULA_0790 0.0 1.0 FORMAT "%5.2" /end CHARACTERISTIC
/begin CHARACTERISTIC K_LAM_DIAG_REG_T "Diagnosezeit - LA-Regleranschlag | EN: Diagnosezeit - LA-Regleranschlag" VALUE 0x7364A TKW_VV_VV_UW 100.0 FORMULA_0073 0.0 6553.5000 FORMAT "%4.1" /end CHARACTERISTIC
/begin CHARACTERISTIC K_LAM_DIAG_LAA_T "Diagnosezeit - LA-Adaptionanschlag | EN: Diagnosezeit - LA-Adaptionanschlag" VALUE 0x7364C TKW_VV_VV_UW 100.0 FORMULA_0073 0.0 6553.5000 FORMAT "%4.1" /end CHARACTERISTIC
/begin CHARACTERISTIC K_LAM_DIAG_LAA_IO_T "Heilungszeit - LA-Adaptionanschlag" VALUE 0x7364E TKW_VV_VV_UW 100.0 FORMULA_0073 0.0 6553.5000 FORMAT "%4.1" /end CHARACTERISTIC
/begin CHARACTERISTIC K_LAM_REG_T_SA_VERZ "Wartezeit LA-Regler nach SA | EN: Wartezeit LA-Regler nach SA" VALUE 0x73650 TKW_VV_VV_UW 100.0 FORMULA_0753 0.0 65.5350 FORMAT "%6.3" /end CHARACTERISTIC
/begin CHARACTERISTIC K_LAM_REG_T_SLP_VERZ "Wartezeit LA-Regler nach aktiver SLP | EN: Wait time for lambda controller after active secondary-air pump [s]" VALUE 0x73652 TKW_VV_VV_UW 100.0 FORMULA_0753 0.0 65.5350 FORMAT "%6.3" /end CHARACTERISTIC
/begin CHARACTERISTIC K_LAM_DIAG_LAA_F_HYS "Faktor-Hysterese fuer LAA-Diag. | EN: Factor hysteresis for lambda adaptation diagnosis" VALUE 0x73654 TKW_VV_VV_UW 100.0 FORMULA_0024 0.0 1.9990 FORMAT "%7.4" /end CHARACTERISTIC
/begin CHARACTERISTIC K_LAM_DIAG_LAA_OFFS_HYS "Offset-Hysterese fuer LAA-Diag. | EN: Offset hysteresis for lambda adaptation diagnosis [mg/ASP]" VALUE 0x73656 TKW_VV_VV_SW 100.0 FORMULA_0531 -512.0000 511.0000 FORMAT "%6.3" /end CHARACTERISTIC
/begin CHARACTERISTIC KL_LAVK_IST_OFFS "Adaptionsoffset der Lambdasonde | EN: Lambda sensor adaptation offset" CURVE 0x73658 TKL_UW_VV_SW 100.0 FORMULA_0532 -5000.0000 5000.0000 /begin AXIS_DESCR STD_AXIS Abgasbank FORMULA_0010 2 1.0000 2.0000 /end AXIS_DESCR /end CHARACTERISTIC
/begin CHARACTERISTIC KL_LAVK_IST_F "Adaptionsfaktor der Lambdasonde | EN: Lambda sensor adaptation factor" CURVE 0x73662 TKL_UW_VV_UW 100.0 FORMULA_0075 0.0 4.0000 /begin AXIS_DESCR STD_AXIS Abgasbank FORMULA_0010 2 1.0000 2.0000 /end AXIS_DESCR FORMAT "%6.3" /end CHARACTERISTIC
/begin CHARACTERISTIC KL_LAVK_T_KORR_F "Korrekturfaktor - Temperaturgang Sonde | EN: Correction factor - sensor temperature dependence" CURVE 0x7366C TKL_SW_VV_UW 100.0 FORMULA_0075 0.0 4.0000
 /begin AXIS_DESCR STD_AXIS lshvk_temp_dif FORMULA_0791 6 -1300.0000 1300.0000 /end AXIS_DESCR
 FORMAT "%6.3" /end CHARACTERISTIC
/begin CHARACTERISTIC KL_LAM_IST "IST-Lambda | EN: Actual lambda" CURVE 0x73686 TKL_SW_VV_UW 100.0 FORMULA_0025 0.0 3.9990
 /begin AXIS_DESCR STD_AXIS lavk_ip_korr FORMULA_0750 24 -10.0000 9.9996 FORMAT "%7.4" /end AXIS_DESCR
 FORMAT "%6.3" /end CHARACTERISTIC
/begin CHARACTERISTIC KL_LAVK_P_KORR_F_FETT "Korrekturfaktor FETT - Druckgang Sonde | EN: Correction factor RICH - sensor pressure dependence" CURVE 0x736E8 TKL_SW_VV_UW 100.0 FORMULA_0075 0.0 4.0000 /begin AXIS_DESCR STD_AXIS pabg FORMULA_0077 12 0.0 2000.0000 FORMAT "%4.1" /end AXIS_DESCR FORMAT "%6.3" /end CHARACTERISTIC
/begin CHARACTERISTIC KL_LAVK_P_KORR_F_MAGER "Korrekturfaktor MAGER - Druckgang Sonde | EN: Correction factor LEAN - sensor pressure dependence" CURVE 0x7371A TKL_SW_VV_UW 100.0 FORMULA_0075 0.0 4.0000 /begin AXIS_DESCR STD_AXIS pabg FORMULA_0077 12 0.0 2000.0000 FORMAT "%4.1" /end AXIS_DESCR FORMAT "%6.3" /end CHARACTERISTIC
/begin CHARACTERISTIC KF_LAM_REG_K "Reglerverstaerkung | EN: Controller gain" MAP 0x7374C TKF_SW_SW_SW 100.0 FORMULA_0755 -2.0000 2.0000
 /begin AXIS_DESCR STD_AXIS lam_delta_lim FORMULA_0025 7 -2.0000 1.9999 FORMAT "%6.3" /end AXIS_DESCR
 /begin AXIS_DESCR STD_AXIS wf_mks_rel FORMULA_0075 3 0.0 31.9990 FORMAT "%6.3" /end AXIS_DESCR
 FORMAT "%5.2" /end CHARACTERISTIC
/begin CHARACTERISTIC KF_LAM_REG_KORR_F "Korrekturfaktor fuer Reglerverstaerkung | EN: Correction factor for controller gain" MAP 0x7378C TKF_SW_SW_UW 100.0 FORMULA_0075 0.0 4.0000 /begin AXIS_DESCR STD_AXIS lam_soll FORMULA_0025 4 0.0 1.9999 FORMAT "%6.3" /end AXIS_DESCR
 /begin AXIS_DESCR STD_AXIS tmot FORMULA_0023 4 -50.0000 170.0000 FORMAT "%4.1" /end AXIS_DESCR
 FORMAT "%6.3" /end CHARACTERISTIC
/begin CHARACTERISTIC KF_LAVK_FILT_T1 "Fiterkonstante IST-LA-Wert | EN: Filter constant, actual lambda value" MAP 0x737BE TKF_SW_SW_UW 100.0 FORMULA_0762 0.0 2097.0000
 /begin AXIS_DESCR STD_AXIS lam_delta_lim FORMULA_0025 4 -2.0000 1.9999 FORMAT "%6.3" /end AXIS_DESCR
 /begin AXIS_DESCR STD_AXIS n FORMULA_0006 4 0.0 10000.0000 /end AXIS_DESCR
/end CHARACTERISTIC
/begin CHARACTERISTIC KF_LAM_REG_WF_MKS_REL_MAX "max. rel. Eingriff - WF-Modell | EN: Maximum relative intervention - wall-film model" MAP 0x737F0 TKF_SW_SW_UW 100.0 FORMULA_0075 0.0 4.0000 /begin AXIS_DESCR STD_AXIS n FORMULA_0006 6 0.0 10000.0000 /end AXIS_DESCR /begin AXIS_DESCR STD_AXIS rf FORMULA_0007 6 0.0 2.0000 FORMAT "%6.3" /end AXIS_DESCR FORMAT "%6.3" /end CHARACTERISTIC
/begin CHARACTERISTIC KF_LAM_REG_WF_VERZ_F "Verzoegerungsfaktor - Wandfilmeingriff | EN: Delay factor - wall-film intervention" MAP 0x73852 TKF_SW_SW_UW 100.0 FORMULA_0792 0.0 127.9980 /begin AXIS_DESCR STD_AXIS n FORMULA_0006 6 0.0 10000.0000 /end AXIS_DESCR /begin AXIS_DESCR STD_AXIS rf FORMULA_0007 6 0.0 2.0000 FORMAT "%6.3" /end AXIS_DESCR FORMAT "%4.1" /end CHARACTERISTIC
/begin MEASUREMENT lam_b1.lavk_st "Sonden-Status" UWORD FORMULA_0083 0 0 0.0 65535.0000 ECU_ADDRESS 0x3FC48C /end MEASUREMENT
/begin MEASUREMENT lam_b2.lavk_st "Sonden-Status" UWORD FORMULA_0083 0 0 0.0 65535.0000 ECU_ADDRESS 0x3FC4D6 /end MEASUREMENT
/begin MEASUREMENT lam.lavk_status_b1 "Sonden-Status" UWORD FORMULA_0748 0 0 0.0 65535.0 ECU_ADDRESS 0x3FC48C BIT_MASK 0x7 /end MEASUREMENT
/begin MEASUREMENT lam.lavk_status_b2 "Sonden-Status" UWORD FORMULA_0748 0 0 0.0 65535.0 ECU_ADDRESS 0x3FC4D6 BIT_MASK 0x7 /end MEASUREMENT
/begin MEASUREMENT lam.atic42_ip_gain_b1 "ATIC42 IP-GAIN" UWORD FORMULA_0749 0 0 0.0 65535.0 ECU_ADDRESS 0x3FC48C BIT_MASK 0x8 /end MEASUREMENT
/begin MEASUREMENT lam.atic42_ip_gain_b2 "ATIC42 IP-GAIN" UWORD FORMULA_0749 0 0 0.0 65535.0 ECU_ADDRESS 0x3FC4D6 BIT_MASK 0x8 /end MEASUREMENT
/begin MEASUREMENT lam_b1.lavk_ad "AD-Wert d. Sondensignals" UWORD FORMULA_0532 0 0 0.0 5000.0000 ECU_ADDRESS 0x3FC48E /end MEASUREMENT
/begin MEASUREMENT lam_b2.lavk_ad "AD-Wert d. Sondensignals" UWORD FORMULA_0532 0 0 0.0 5000.0000 ECU_ADDRESS 0x3FC4D8 /end MEASUREMENT
/begin MEASUREMENT lam_b1.lavk_ad_mw "AD-Wert d. Sondensignals - 1kHz-Abtastung" UWORD FORMULA_0532 0 0 0.0 5000.0000 ECU_ADDRESS 0x3FC490 /end MEASUREMENT
/begin MEASUREMENT lam_b2.lavk_ad_mw "AD-Wert d. Sondensignals - 1kHz-Abtastung" UWORD FORMULA_0532 0 0 0.0 5000.0000 ECU_ADDRESS 0x3FC4DA /end MEASUREMENT
/begin MEASUREMENT lam_b1.lavk_ad_korr "korrigierter AD-Wert." SWORD FORMULA_0532 0 0 -5000.0000 5000.0000 ECU_ADDRESS 0x3FC492 /end MEASUREMENT
/begin MEASUREMENT lam_b2.lavk_ad_korr "korrigierter AD-Wert." SWORD FORMULA_0532 0 0 -5000.0000 5000.0000 ECU_ADDRESS 0x3FC4DC /end MEASUREMENT
/begin MEASUREMENT lam_b1.lavk_ad_mw_korr "korrigierter AD-Wert. - 1kHz-Abtastung" SWORD FORMULA_0532 0 0 -5000.0000 5000.0000 ECU_ADDRESS 0x3FC494 /end MEASUREMENT
/begin MEASUREMENT lam_b2.lavk_ad_mw_korr "korrigierter AD-Wert. - 1kHz-Abtastung" SWORD FORMULA_0532 0 0 -5000.0000 5000.0000 ECU_ADDRESS 0x3FC4DE /end MEASUREMENT
/begin MEASUREMENT lam_b1.lavk_korr_f "Ip-Korrekturfaktor" UWORD FORMULA_0075 0 0 0.0 4.0000 ECU_ADDRESS 0x3FC496 /end MEASUREMENT
/begin MEASUREMENT lam_b2.lavk_korr_f "Ip-Korrekturfaktor" UWORD FORMULA_0075 0 0 0.0 4.0000 ECU_ADDRESS 0x3FC4E0 /end MEASUREMENT
/begin MEASUREMENT lam_b1.ip_gain "Pumpstromverstaerkung" UWORD FORMULA_0010 0 0 8.0000 16.0000 ECU_ADDRESS 0x3FC498 /end MEASUREMENT
/begin MEASUREMENT lam_b2.ip_gain "Pumpstromverstaerkung" UWORD FORMULA_0010 0 0 8.0000 16.0000 ECU_ADDRESS 0x3FC4E2 /end MEASUREMENT
/begin MEASUREMENT lam_b1.lavk_ip "Pumpsptrom" SWORD FORMULA_0750 0 0 -10.0000 9.9996 ECU_ADDRESS 0x3FC49A /end MEASUREMENT
/begin MEASUREMENT lam_b2.lavk_ip "Pumpsptrom" SWORD FORMULA_0750 0 0 -10.0000 9.9996 ECU_ADDRESS 0x3FC4E4 /end MEASUREMENT
/begin MEASUREMENT lam_b1.lavk_ip_mw "Pumpsptrom - 1kHz-Abtastung" SWORD FORMULA_0750 0 0 -10.0000 9.9996 ECU_ADDRESS 0x3FC49C /end MEASUREMENT
/begin MEASUREMENT lam_b2.lavk_ip_mw "Pumpsptrom - 1kHz-Abtastung" SWORD FORMULA_0750 0 0 -10.0000 9.9996 ECU_ADDRESS 0x3FC4E6 /end MEASUREMENT
/begin MEASUREMENT lam_b1.lavk_ip_korr "korrigierter Pumpsptrom" SWORD FORMULA_0750 0 0 -10.0000 9.9996 ECU_ADDRESS 0x3FC49E /end MEASUREMENT
/begin MEASUREMENT lam_b2.lavk_ip_korr "korrigierter Pumpsptrom" SWORD FORMULA_0750 0 0 -10.0000 9.9996 ECU_ADDRESS 0x3FC4E8 /end MEASUREMENT
/begin MEASUREMENT lam_b1.lavk_ip_mw_korr "korrigierter Pumpsptrom - 1kHz-Abtastung" SWORD FORMULA_0750 0 0 -10.0000 9.9996 ECU_ADDRESS 0x3FC4A0 /end MEASUREMENT
/begin MEASUREMENT lam_b2.lavk_ip_mw_korr "korrigierter Pumpsptrom - 1kHz-Abtastung" SWORD FORMULA_0750 0 0 -10.0000 9.9996 ECU_ADDRESS 0x3FC4EA /end MEASUREMENT
/begin MEASUREMENT lam_b1.ist_ad "LAM-IST aus Kennlinie" UWORD FORMULA_0025 0 0 0.0 3.9990 ECU_ADDRESS 0x3FC4A2 /end MEASUREMENT
/begin MEASUREMENT lam_b2.ist_ad "LAM-IST aus Kennlinie" UWORD FORMULA_0025 0 0 0.0 3.9990 ECU_ADDRESS 0x3FC4EC /end MEASUREMENT
/begin MEASUREMENT lam_b1.ist_mw_grad "Gradient d. LA-IST-MW" SWORD FORMULA_0751 0 0 -0.0019 0.0019 ECU_ADDRESS 0x3FC4A6 /end MEASUREMENT
/begin MEASUREMENT lam_b2.ist_mw_grad "Gradient d. LA-IST-MW" SWORD FORMULA_0751 0 0 -0.0019 0.0019 ECU_ADDRESS 0x3FC4F0 /end MEASUREMENT
/begin MEASUREMENT lam_b1.zahn_nr "aktueller KW-Zahn" UWORD FORMULA_0010 0 0 0.0 65535.0000 ECU_ADDRESS 0x3FC4A8 /end MEASUREMENT
/begin MEASUREMENT lam_b2.zahn_nr "aktueller KW-Zahn" UWORD FORMULA_0010 0 0 0.0 65535.0000 ECU_ADDRESS 0x3FC4F2 /end MEASUREMENT
/begin MEASUREMENT lam_b1.ad_offs_cnt "Zahler fuer Glaettungszeit" UWORD FORMULA_0010 0 0 0.0 65535.0000 ECU_ADDRESS 0x3FC4AA /end MEASUREMENT
/begin MEASUREMENT lam_b2.ad_offs_cnt "Zahler fuer Glaettungszeit" UWORD FORMULA_0010 0 0 0.0 65535.0000 ECU_ADDRESS 0x3FC4F4 /end MEASUREMENT
/begin MEASUREMENT lam_b1.ad_gain_cnt "Zahler fuer Glaettungszeit" UWORD FORMULA_0010 0 0 0.0 65535.0000 ECU_ADDRESS 0x3FC4AC /end MEASUREMENT
/begin MEASUREMENT lam_b2.ad_gain_cnt "Zahler fuer Glaettungszeit" UWORD FORMULA_0010 0 0 0.0 65535.0000 ECU_ADDRESS 0x3FC4F6 /end MEASUREMENT
/begin MEASUREMENT lam_b1.lavk_ad_offs_filt "gem. AD-Wert f. OFFSET-Sondenadapt." UWORD FORMULA_0532 0 0 0.0 5000.0000 ECU_ADDRESS 0x3FC4AE /end MEASUREMENT
/begin MEASUREMENT lam_b2.lavk_ad_offs_filt "gem. AD-Wert f. OFFSET-Sondenadapt." UWORD FORMULA_0532 0 0 0.0 5000.0000 ECU_ADDRESS 0x3FC4F8 /end MEASUREMENT
/begin MEASUREMENT lam_b1.lavk_ad_gain_filt "gem. AD-Wert f. Sondenadapt." UWORD FORMULA_0532 0 0 0.0 5000.0000 ECU_ADDRESS 0x3FC4B0 /end MEASUREMENT
/begin MEASUREMENT lam_b2.lavk_ad_gain_filt "gem. AD-Wert f. Sondenadapt." UWORD FORMULA_0532 0 0 0.0 5000.0000 ECU_ADDRESS 0x3FC4FA /end MEASUREMENT
/begin MEASUREMENT lam_b1.mks_soll_zyl "gefilterte SOLL-Kraftstoffmasse" UWORD FORMULA_0752 0 0 0.0 1023.9843 ECU_ADDRESS 0x3FC4B2 /end MEASUREMENT
/begin MEASUREMENT lam_b2.mks_soll_zyl "gefilterte SOLL-Kraftstoffmasse" UWORD FORMULA_0752 0 0 0.0 1023.9843 ECU_ADDRESS 0x3FC4FC /end MEASUREMENT
/begin MEASUREMENT lam_b1.wf_verz_time "Verzoegerungszeit f. WF-Eingriff" UWORD FORMULA_0753 0 0 0.0 65.5350 ECU_ADDRESS 0x3FC4B4 /end MEASUREMENT
/begin MEASUREMENT lam_b2.wf_verz_time "Verzoegerungszeit f. WF-Eingriff" UWORD FORMULA_0753 0 0 0.0 65.5350 ECU_ADDRESS 0x3FC4FE /end MEASUREMENT
/begin MEASUREMENT lam_b1.reg_tn_roh "Nachstellzeit - roh" UWORD FORMULA_0754 0 0 0.0 2097.1200 ECU_ADDRESS 0x3FC4B6 /end MEASUREMENT
/begin MEASUREMENT lam_b2.reg_tn_roh "Nachstellzeit - roh" UWORD FORMULA_0754 0 0 0.0 2097.1200 ECU_ADDRESS 0x3FC500 /end MEASUREMENT
/begin MEASUREMENT lam_b1.reg_tn_i "Nachstellzeit - I-Anteil" UWORD FORMULA_0754 0 0 0.0 2097.1200 ECU_ADDRESS 0x3FC4B8 /end MEASUREMENT
/begin MEASUREMENT lam_b2.reg_tn_i "Nachstellzeit - I-Anteil" UWORD FORMULA_0754 0 0 0.0 2097.1200 ECU_ADDRESS 0x3FC502 /end MEASUREMENT
/begin MEASUREMENT lam_b1.reg_tv_d "Nachstellzeit - D-Anteil" UWORD FORMULA_0754 0 0 0.0 2097.1200 ECU_ADDRESS 0x3FC4BA /end MEASUREMENT
/begin MEASUREMENT lam_b2.reg_tv_d "Nachstellzeit - D-Anteil" UWORD FORMULA_0754 0 0 0.0 2097.1200 ECU_ADDRESS 0x3FC504 /end MEASUREMENT
/begin MEASUREMENT lam_b1.reg_k "Verstaerkungsfaktor" SWORD FORMULA_0755 0 0 -2.0000 2.0000 ECU_ADDRESS 0x3FC4BC /end MEASUREMENT
/begin MEASUREMENT lam_b2.reg_k "Verstaerkungsfaktor" SWORD FORMULA_0755 0 0 -2.0000 2.0000 ECU_ADDRESS 0x3FC506 /end MEASUREMENT
/begin MEASUREMENT lam_b1.ml_delta "absolute Regelabweichung" SWORD FORMULA_0752 0 0 -512.0000 511.9843 ECU_ADDRESS 0x3FC4BE /end MEASUREMENT
/begin MEASUREMENT lam_b2.ml_delta "absolute Regelabweichung" SWORD FORMULA_0752 0 0 -512.0000 511.9843 ECU_ADDRESS 0x3FC508 /end MEASUREMENT
/begin MEASUREMENT lam_b1.laa_st "LA-Adaption-Status" UWORD FORMULA_0083 0 0 0.0 65535.0000 ECU_ADDRESS 0x3FC4C0 /end MEASUREMENT
/begin MEASUREMENT lam_b2.laa_st "LA-Adaption-Status" UWORD FORMULA_0083 0 0 0.0 65535.0000 ECU_ADDRESS 0x3FC50A /end MEASUREMENT
/begin MEASUREMENT lam.laa_status_b1 "LA-Adaption-Status" UWORD FORMULA_0756 0 0 0.0 65535.0 ECU_ADDRESS 0x3FC4C0 BIT_MASK 0x1F /end MEASUREMENT
/begin MEASUREMENT lam.laa_status_b2 "LA-Adaption-Status" UWORD FORMULA_0756 0 0 0.0 65535.0 ECU_ADDRESS 0x3FC50A BIT_MASK 0x1F /end MEASUREMENT
/begin MEASUREMENT lam.laa_f_begr_b1 "LAA-F-Begr." UWORD FORMULA_0757 0 0 0.0 65535.0 ECU_ADDRESS 0x3FC4C0 BIT_MASK 0x300 /end MEASUREMENT
/begin MEASUREMENT lam.laa_f_begr_b2 "LAA-F-Begr." UWORD FORMULA_0757 0 0 0.0 65535.0 ECU_ADDRESS 0x3FC50A BIT_MASK 0x300 /end MEASUREMENT
/begin MEASUREMENT lam.laa_f_te_begr_b1 "LAA-F-TE-Begr." UWORD FORMULA_0758 0 0 0.0 65535.0 ECU_ADDRESS 0x3FC4C0 BIT_MASK 0xC00 /end MEASUREMENT
/begin MEASUREMENT lam.laa_f_te_begr_b2 "LAA-F-TE-Begr." UWORD FORMULA_0758 0 0 0.0 65535.0 ECU_ADDRESS 0x3FC50A BIT_MASK 0xC00 /end MEASUREMENT
/begin MEASUREMENT lam.laa_offs_begr_b1 "LAA-OFFS-Begr." UWORD FORMULA_0759 0 0 0.0 65535.0 ECU_ADDRESS 0x3FC4C0 BIT_MASK 0x3000 /end MEASUREMENT
/begin MEASUREMENT lam.laa_offs_begr_b2 "LAA-OFFS-Begr." UWORD FORMULA_0759 0 0 0.0 65535.0 ECU_ADDRESS 0x3FC50A BIT_MASK 0x3000 /end MEASUREMENT
/begin MEASUREMENT lam.laa_ti_ist_b1 "TI_IST-Schwelle" UWORD FORMULA_0760 0 0 0.0 65535.0 ECU_ADDRESS 0x3FC4C0 BIT_MASK 0x4000 /end MEASUREMENT
/begin MEASUREMENT lam.laa_ti_ist_b2 "TI_IST-Schwelle" UWORD FORMULA_0760 0 0 0.0 65535.0 ECU_ADDRESS 0x3FC50A BIT_MASK 0x4000 /end MEASUREMENT
/begin MEASUREMENT lam.laa_stat_b1 "LAA-Stationaer" UWORD FORMULA_0761 0 0 0.0 65535.0 ECU_ADDRESS 0x3FC4C0 BIT_MASK 0x8000 /end MEASUREMENT
/begin MEASUREMENT lam.laa_stat_b2 "LAA-Stationaer" UWORD FORMULA_0761 0 0 0.0 65535.0 ECU_ADDRESS 0x3FC50A BIT_MASK 0x8000 /end MEASUREMENT
/begin MEASUREMENT lam_b1.laa_ml_offs "Ermittlung Luftmassenoffset" SWORD FORMULA_0531 0 0 -512.0000 511.0000 ECU_ADDRESS 0x3FC4C2 /end MEASUREMENT
/begin MEASUREMENT lam_b2.laa_ml_offs "Ermittlung Luftmassenoffset" SWORD FORMULA_0531 0 0 -512.0000 511.0000 ECU_ADDRESS 0x3FC50C /end MEASUREMENT
/begin MEASUREMENT lam_b1.laa_f_te "Offset auf LAA-Faktor ueber TE" SWORD FORMULA_0024 0 0 -1.0000 0.9999 ECU_ADDRESS 0x3FC4C6 /end MEASUREMENT
/begin MEASUREMENT lam_b2.laa_f_te "Offset auf LAA-Faktor ueber TE" SWORD FORMULA_0024 0 0 -1.0000 0.9999 ECU_ADDRESS 0x3FC510 /end MEASUREMENT
/begin MEASUREMENT lam_b1.laa_f_te_grad_neg "Abregelwert fuer Vergessen des LAA-Faktor ueber TE" UWORD FORMULA_0024 0 0 0.0 1.9990 ECU_ADDRESS 0x3FC4CA /end MEASUREMENT
/begin MEASUREMENT lam_b2.laa_f_te_grad_neg "Abregelwert fuer Vergessen des LAA-Faktor ueber TE" UWORD FORMULA_0024 0 0 0.0 1.9990 ECU_ADDRESS 0x3FC514 /end MEASUREMENT
/begin MEASUREMENT lam_b1.laa_ml_f "Ermittlung Luftmassenfaktor" UWORD FORMULA_0024 0 0 0.0 1.9990 ECU_ADDRESS 0x3FC4C4 /end MEASUREMENT
/begin MEASUREMENT lam_b2.laa_ml_f "Ermittlung Luftmassenfaktor" UWORD FORMULA_0024 0 0 0.0 1.9990 ECU_ADDRESS 0x3FC50E /end MEASUREMENT
/begin MEASUREMENT lam_b1.laa_ml_f_te "Ermittlung TE-Luftmassenfaktor" UWORD FORMULA_0024 0 0 0.0 1.9990 ECU_ADDRESS 0x3FC4CC /end MEASUREMENT
/begin MEASUREMENT lam_b2.laa_ml_f_te "Ermittlung TE-Luftmassenfaktor" UWORD FORMULA_0024 0 0 0.0 1.9990 ECU_ADDRESS 0x3FC516 /end MEASUREMENT
/begin MEASUREMENT lam_b1.lavk_tau1 "TAU1 - IST-LA-Filter" UWORD FORMULA_0762 0 0 0.0 2097.0000 ECU_ADDRESS 0x3FC4CE /end MEASUREMENT
/begin MEASUREMENT lam_b2.lavk_tau1 "TAU1 - IST-LA-Filter" UWORD FORMULA_0762 0 0 0.0 2097.0000 ECU_ADDRESS 0x3FC518 /end MEASUREMENT
/begin MEASUREMENT lam_b1.lavk_filt_konst "IST-LA-Filterkonstante" UWORD FORMULA_0763 0 0 0.0 7.9998 ECU_ADDRESS 0x3FC4D2 /end MEASUREMENT
/begin MEASUREMENT lam_b2.lavk_filt_konst "IST-LA-Filterkonstante" UWORD FORMULA_0763 0 0 0.0 7.9998 ECU_ADDRESS 0x3FC51C /end MEASUREMENT
/begin MEASUREMENT lam_reg_f_min_b1 "min. Regeleingriff" UWORD FORMULA_0024 0 0 0.0 1.9990 ECU_ADDRESS 0x3FC520 /end MEASUREMENT
/begin MEASUREMENT lam_reg_f_min_b2 "min. Regeleingriff" UWORD FORMULA_0024 0 0 0.0 1.9990 ECU_ADDRESS 0x3FC522 /end MEASUREMENT
/begin MEASUREMENT lam_reg_f_max_b1 "max. Regeleingriff" UWORD FORMULA_0024 0 0 0.0 1.9990 ECU_ADDRESS 0x3FC524 /end MEASUREMENT
/begin MEASUREMENT lam_reg_f_max_b2 "max. Regeleingriff" UWORD FORMULA_0024 0 0 0.0 1.9990 ECU_ADDRESS 0x3FC526 /end MEASUREMENT
/begin MEASUREMENT laa_f_b1 "Faktor-Lambdaadaption" UWORD FORMULA_0024 0 0 0.0 1.9990 ECU_ADDRESS 0x3FC528 /end MEASUREMENT
/begin MEASUREMENT laa_f_b2 "Faktor-Lambdaadaption" UWORD FORMULA_0024 0 0 0.0 1.9990 ECU_ADDRESS 0x3FC52A /end MEASUREMENT
/begin MEASUREMENT laa_offs_begr_b1 "Offset-Wert aus Aenderungsbegr." SWORD FORMULA_0531 0 0 -512.0000 511.0000 ECU_ADDRESS 0x3FC52C /end MEASUREMENT
/begin MEASUREMENT laa_offs_begr_b2 "Offset-Wert aus Aenderungsbegr." SWORD FORMULA_0531 0 0 -512.0000 511.0000 ECU_ADDRESS 0x3FC52E /end MEASUREMENT
/begin MEASUREMENT laa_offs_mw_t_b1 "Zeitzaehler f. Mittelwertbildung" UWORD FORMULA_0764 0 0 0.0 65535.0000 ECU_ADDRESS 0x3FC530 /end MEASUREMENT
/begin MEASUREMENT laa_offs_mw_t_b2 "Zeitzaehler f. Mittelwertbildung" UWORD FORMULA_0764 0 0 0.0 65535.0000 ECU_ADDRESS 0x3FC532 /end MEASUREMENT
/begin MEASUREMENT laa_f_mw_t_b1 "Zeitzaehler f. Mittelwertbildung" UWORD FORMULA_0764 0 0 0.0 65535.0000 ECU_ADDRESS 0x3FC534 /end MEASUREMENT
/begin MEASUREMENT laa_f_mw_t_b2 "Zeitzaehler f. Mittelwertbildung" UWORD FORMULA_0764 0 0 0.0 65535.0000 ECU_ADDRESS 0x3FC536 /end MEASUREMENT
/begin MEASUREMENT laa_f_te_mw_t_b1 "Zeitzaehler f. Mittelwertbildung" UWORD FORMULA_0764 0 0 0.0 65535.0000 ECU_ADDRESS 0x3FC538 /end MEASUREMENT
/begin MEASUREMENT laa_f_te_mw_t_b2 "Zeitzaehler f. Mittelwertbildung" UWORD FORMULA_0764 0 0 0.0 65535.0000 ECU_ADDRESS 0x3FC53A /end MEASUREMENT
/begin MEASUREMENT laa_offs_mw_cnt_b1 "Zaehlervariable f. Mittelwertbildung" UWORD FORMULA_0010 0 0 0.0 65535.0000 ECU_ADDRESS 0x3FC53C /end MEASUREMENT
/begin MEASUREMENT laa_offs_mw_cnt_b2 "Zaehlervariable f. Mittelwertbildung" UWORD FORMULA_0010 0 0 0.0 65535.0000 ECU_ADDRESS 0x3FC53E /end MEASUREMENT
/begin MEASUREMENT laa_f_mw_cnt_b1 "Zaehlervariable f. Mittelwertbildung" UWORD FORMULA_0010 0 0 0.0 65535.0000 ECU_ADDRESS 0x3FC540 /end MEASUREMENT
/begin MEASUREMENT laa_f_mw_cnt_b2 "Zaehlervariable f. Mittelwertbildung" UWORD FORMULA_0010 0 0 0.0 65535.0000 ECU_ADDRESS 0x3FC542 /end MEASUREMENT
/begin MEASUREMENT laa_f_te_mw_cnt_b1 "Zaehlervariable f. Mittelwertbildung" UWORD FORMULA_0010 0 0 0.0 65535.0000 ECU_ADDRESS 0x3FC544 /end MEASUREMENT
/begin MEASUREMENT laa_f_te_mw_cnt_b2 "Zaehlervariable f. Mittelwertbildung" UWORD FORMULA_0010 0 0 0.0 65535.0000 ECU_ADDRESS 0x3FC546 /end MEASUREMENT
/begin MEASUREMENT lam_ist_1of2_1of5_ "Lambda Istwert" UWORD FORMULA_0025 0 0 0.0 3.9990 ECU_ADDRESS 0x3FC548 /end MEASUREMENT
/begin MEASUREMENT lam_ist_1of2_2of5_ "Lambda Istwert" UWORD FORMULA_0025 0 0 0.0 3.9990 ECU_ADDRESS 0x3FC54A /end MEASUREMENT
/begin MEASUREMENT lam_ist_1of2_3of5_ "Lambda Istwert" UWORD FORMULA_0025 0 0 0.0 3.9990 ECU_ADDRESS 0x3FC54C /end MEASUREMENT
/begin MEASUREMENT lam_ist_1of2_4of5_ "Lambda Istwert" UWORD FORMULA_0025 0 0 0.0 3.9990 ECU_ADDRESS 0x3FC54E /end MEASUREMENT
/begin MEASUREMENT lam_ist_1of2_5of5_ "Lambda Istwert" UWORD FORMULA_0025 0 0 0.0 3.9990 ECU_ADDRESS 0x3FC550 /end MEASUREMENT
/begin MEASUREMENT lam_ist_2of2_1of5_ "Lambda Istwert" UWORD FORMULA_0025 0 0 0.0 3.9990 ECU_ADDRESS 0x3FC552 /end MEASUREMENT
/begin MEASUREMENT lam_ist_2of2_2of5_ "Lambda Istwert" UWORD FORMULA_0025 0 0 0.0 3.9990 ECU_ADDRESS 0x3FC554 /end MEASUREMENT
/begin MEASUREMENT lam_ist_2of2_3of5_ "Lambda Istwert" UWORD FORMULA_0025 0 0 0.0 3.9990 ECU_ADDRESS 0x3FC556 /end MEASUREMENT
/begin MEASUREMENT lam_ist_2of2_4of5_ "Lambda Istwert" UWORD FORMULA_0025 0 0 0.0 3.9990 ECU_ADDRESS 0x3FC558 /end MEASUREMENT
/begin MEASUREMENT lam_ist_2of2_5of5_ "Lambda Istwert" UWORD FORMULA_0025 0 0 0.0 3.9990 ECU_ADDRESS 0x3FC55A /end MEASUREMENT
/begin MEASUREMENT lam_ist_seg_1of2_1of5_ "Lambda Istwert - 1kHz-Abtastung" UWORD FORMULA_0025 0 0 0.0 3.9990 ECU_ADDRESS 0x3FC55C /end MEASUREMENT
/begin MEASUREMENT lam_ist_seg_1of2_2of5_ "Lambda Istwert - 1kHz-Abtastung" UWORD FORMULA_0025 0 0 0.0 3.9990 ECU_ADDRESS 0x3FC55E /end MEASUREMENT
/begin MEASUREMENT lam_ist_seg_1of2_3of5_ "Lambda Istwert - 1kHz-Abtastung" UWORD FORMULA_0025 0 0 0.0 3.9990 ECU_ADDRESS 0x3FC560 /end MEASUREMENT
/begin MEASUREMENT lam_ist_seg_1of2_4of5_ "Lambda Istwert - 1kHz-Abtastung" UWORD FORMULA_0025 0 0 0.0 3.9990 ECU_ADDRESS 0x3FC562 /end MEASUREMENT
/begin MEASUREMENT lam_ist_seg_1of2_5of5_ "Lambda Istwert - 1kHz-Abtastung" UWORD FORMULA_0025 0 0 0.0 3.9990 ECU_ADDRESS 0x3FC564 /end MEASUREMENT
/begin MEASUREMENT lam_ist_seg_2of2_1of5_ "Lambda Istwert - 1kHz-Abtastung" UWORD FORMULA_0025 0 0 0.0 3.9990 ECU_ADDRESS 0x3FC566 /end MEASUREMENT
/begin MEASUREMENT lam_ist_seg_2of2_2of5_ "Lambda Istwert - 1kHz-Abtastung" UWORD FORMULA_0025 0 0 0.0 3.9990 ECU_ADDRESS 0x3FC568 /end MEASUREMENT
/begin MEASUREMENT lam_ist_seg_2of2_3of5_ "Lambda Istwert - 1kHz-Abtastung" UWORD FORMULA_0025 0 0 0.0 3.9990 ECU_ADDRESS 0x3FC56A /end MEASUREMENT
/begin MEASUREMENT lam_ist_seg_2of2_4of5_ "Lambda Istwert - 1kHz-Abtastung" UWORD FORMULA_0025 0 0 0.0 3.9990 ECU_ADDRESS 0x3FC56C /end MEASUREMENT
/begin MEASUREMENT lam_ist_seg_2of2_5of5_ "Lambda Istwert - 1kHz-Abtastung" UWORD FORMULA_0025 0 0 0.0 3.9990 ECU_ADDRESS 0x3FC56E /end MEASUREMENT
/begin MEASUREMENT wf_mks_rel_1of2_1of5_ "relativer Eingriff WF-Modell" UWORD FORMULA_0075 0 0 0.0 4.0000 ECU_ADDRESS 0x3FC570 /end MEASUREMENT
/begin MEASUREMENT wf_mks_rel_1of2_2of5_ "relativer Eingriff WF-Modell" UWORD FORMULA_0075 0 0 0.0 4.0000 ECU_ADDRESS 0x3FC572 /end MEASUREMENT
/begin MEASUREMENT wf_mks_rel_1of2_3of5_ "relativer Eingriff WF-Modell" UWORD FORMULA_0075 0 0 0.0 4.0000 ECU_ADDRESS 0x3FC574 /end MEASUREMENT
/begin MEASUREMENT wf_mks_rel_1of2_4of5_ "relativer Eingriff WF-Modell" UWORD FORMULA_0075 0 0 0.0 4.0000 ECU_ADDRESS 0x3FC576 /end MEASUREMENT
/begin MEASUREMENT wf_mks_rel_1of2_5of5_ "relativer Eingriff WF-Modell" UWORD FORMULA_0075 0 0 0.0 4.0000 ECU_ADDRESS 0x3FC578 /end MEASUREMENT
/begin MEASUREMENT wf_mks_rel_2of2_1of5_ "relativer Eingriff WF-Modell" UWORD FORMULA_0075 0 0 0.0 4.0000 ECU_ADDRESS 0x3FC57A /end MEASUREMENT
/begin MEASUREMENT wf_mks_rel_2of2_2of5_ "relativer Eingriff WF-Modell" UWORD FORMULA_0075 0 0 0.0 4.0000 ECU_ADDRESS 0x3FC57C /end MEASUREMENT
/begin MEASUREMENT wf_mks_rel_2of2_3of5_ "relativer Eingriff WF-Modell" UWORD FORMULA_0075 0 0 0.0 4.0000 ECU_ADDRESS 0x3FC57E /end MEASUREMENT
/begin MEASUREMENT wf_mks_rel_2of2_4of5_ "relativer Eingriff WF-Modell" UWORD FORMULA_0075 0 0 0.0 4.0000 ECU_ADDRESS 0x3FC580 /end MEASUREMENT
/begin MEASUREMENT wf_mks_rel_2of2_5of5_ "relativer Eingriff WF-Modell" UWORD FORMULA_0075 0 0 0.0 4.0000 ECU_ADDRESS 0x3FC582 /end MEASUREMENT
/begin MEASUREMENT lam_ml_delta_rel_1of2_1of3_ "relative Regelabweichung" SWORD FORMULA_0765 0 0 -1.0000 0.9999 ECU_ADDRESS 0x3FC584 /end MEASUREMENT
/begin MEASUREMENT lam_ml_delta_rel_1of2_2of3_ "relative Regelabweichung" SWORD FORMULA_0765 0 0 -1.0000 0.9999 ECU_ADDRESS 0x3FC586 /end MEASUREMENT
/begin MEASUREMENT lam_ml_delta_rel_1of2_3of3_ "relative Regelabweichung" SWORD FORMULA_0765 0 0 -1.0000 0.9999 ECU_ADDRESS 0x3FC588 /end MEASUREMENT
/begin MEASUREMENT lam_ml_delta_rel_2of2_1of3_ "relative Regelabweichung" SWORD FORMULA_0765 0 0 -1.0000 0.9999 ECU_ADDRESS 0x3FC58A /end MEASUREMENT
/begin MEASUREMENT lam_ml_delta_rel_2of2_2of3_ "relative Regelabweichung" SWORD FORMULA_0765 0 0 -1.0000 0.9999 ECU_ADDRESS 0x3FC58C /end MEASUREMENT
/begin MEASUREMENT lam_ml_delta_rel_2of2_3of3_ "relative Regelabweichung" SWORD FORMULA_0765 0 0 -1.0000 0.9999 ECU_ADDRESS 0x3FC58E /end MEASUREMENT
/begin MEASUREMENT lavk_ad_st_b1 "Sondenadation-Status" UWORD FORMULA_0083 0 0 0.0 65535.0000 ECU_ADDRESS 0x3FC590 /end MEASUREMENT
/begin MEASUREMENT lavk_ad_st_b2 "Sondenadation-Status" UWORD FORMULA_0083 0 0 0.0 65535.0000 ECU_ADDRESS 0x3FC592 /end MEASUREMENT
/begin MEASUREMENT lavk_ad_offs_ms_b1 "OFFSET-Sondenadaption bei MS" UWORD FORMULA_0766 0 0 0.0 65535.0 ECU_ADDRESS 0x3FC590 BIT_MASK 0x1 /end MEASUREMENT
/begin MEASUREMENT lavk_ad_offs_ms_b2 "OFFSET-Sondenadaption bei MS" UWORD FORMULA_0766 0 0 0.0 65535.0 ECU_ADDRESS 0x3FC592 BIT_MASK 0x1 /end MEASUREMENT
/begin MEASUREMENT lavk_ad_offs_ml_b1 "OFFSET-Sondenadaption bei ML" UWORD FORMULA_0767 0 0 0.0 65535.0 ECU_ADDRESS 0x3FC590 BIT_MASK 0x2 /end MEASUREMENT
/begin MEASUREMENT lavk_ad_offs_ml_b2 "OFFSET-Sondenadaption bei ML" UWORD FORMULA_0767 0 0 0.0 65535.0 ECU_ADDRESS 0x3FC592 BIT_MASK 0x2 /end MEASUREMENT
/begin MEASUREMENT lavk_ad_offs_spi_b1 "OFFSET-Sondenadaption - ATIC42" UWORD FORMULA_0768 0 0 0.0 65535.0 ECU_ADDRESS 0x3FC590 BIT_MASK 0x4 /end MEASUREMENT
/begin MEASUREMENT lavk_ad_offs_spi_b2 "OFFSET-Sondenadaption - ATIC42" UWORD FORMULA_0768 0 0 0.0 65535.0 ECU_ADDRESS 0x3FC592 BIT_MASK 0x4 /end MEASUREMENT
/begin MEASUREMENT lavk_ad_offs_cnt_t_b1 "OFFSET-Glaettungszeit" UWORD FORMULA_0769 0 0 0.0 65535.0 ECU_ADDRESS 0x3FC590 BIT_MASK 0x8 /end MEASUREMENT
/begin MEASUREMENT lavk_ad_offs_cnt_t_b2 "OFFSET-Glaettungszeit" UWORD FORMULA_0769 0 0 0.0 65535.0 ECU_ADDRESS 0x3FC592 BIT_MASK 0x8 /end MEASUREMENT
/begin MEASUREMENT lavk_ad_offs_st_b1 "OFFSET-Sondenadaption" UWORD FORMULA_0770 0 0 0.0 65535.0 ECU_ADDRESS 0x3FC590 BIT_MASK 0x10 /end MEASUREMENT
/begin MEASUREMENT lavk_ad_offs_st_b2 "OFFSET-Sondenadaption" UWORD FORMULA_0770 0 0 0.0 65535.0 ECU_ADDRESS 0x3FC592 BIT_MASK 0x10 /end MEASUREMENT
/begin MEASUREMENT lavk_ad_offs_freig_b1 "OFFSET-Sondenadaption FREIGABE" UWORD FORMULA_0771 0 0 0.0 65535.0 ECU_ADDRESS 0x3FC590 BIT_MASK 0x20 /end MEASUREMENT
/begin MEASUREMENT lavk_ad_offs_freig_b2 "OFFSET-Sondenadaption FREIGABE" UWORD FORMULA_0771 0 0 0.0 65535.0 ECU_ADDRESS 0x3FC592 BIT_MASK 0x20 /end MEASUREMENT
/begin MEASUREMENT lavk_ad_gain_freig_b1 "GAIN-Sondenadaption FREIGABE" UWORD FORMULA_0772 0 0 0.0 65535.0 ECU_ADDRESS 0x3FC590 BIT_MASK 0x100 /end MEASUREMENT
/begin MEASUREMENT lavk_ad_gain_freig_b2 "GAIN-Sondenadaption FREIGABE" UWORD FORMULA_0772 0 0 0.0 65535.0 ECU_ADDRESS 0x3FC592 BIT_MASK 0x100 /end MEASUREMENT
/begin MEASUREMENT lavk_ad_gain_cnt_t_b1 "GAIN-Glaettungszeit" UWORD FORMULA_0773 0 0 0.0 65535.0 ECU_ADDRESS 0x3FC590 BIT_MASK 0x200 /end MEASUREMENT
/begin MEASUREMENT lavk_ad_gain_cnt_t_b2 "GAIN-Glaettungszeit" UWORD FORMULA_0773 0 0 0.0 65535.0 ECU_ADDRESS 0x3FC592 BIT_MASK 0x200 /end MEASUREMENT
/begin MEASUREMENT lavk_ad_gain_st_b1 "GAIN-Sondenadaption" UWORD FORMULA_0107 0 0 0.0 65535.0 ECU_ADDRESS 0x3FC590 BIT_MASK 0x400 /end MEASUREMENT
/begin MEASUREMENT lavk_ad_gain_st_b2 "GAIN-Sondenadaption" UWORD FORMULA_0107 0 0 0.0 65535.0 ECU_ADDRESS 0x3FC592 BIT_MASK 0x400 /end MEASUREMENT
/begin MEASUREMENT lavk_ad_gain_delta_t_b1 "Delta-Zeit zwischen 2 GAIN-Adaptionen" ULONG FORMULA_0152 0 0 0.0 655.0000 ECU_ADDRESS 0x3FC594 /end MEASUREMENT
/begin MEASUREMENT lavk_ad_gain_delta_t_b2 "Delta-Zeit zwischen 2 GAIN-Adaptionen" ULONG FORMULA_0152 0 0 0.0 655.0000 ECU_ADDRESS 0x3FC598 /end MEASUREMENT
/begin MEASUREMENT lavk_ad_offs_delta_t_b1 "Delta-Zeit zwischen 2 OFFSET-Adaptionen" ULONG FORMULA_0152 0 0 0.0 655.0000 ECU_ADDRESS 0x3FC59C /end MEASUREMENT
/begin MEASUREMENT lavk_ad_offs_delta_t_b2 "Delta-Zeit zwischen 2 OFFSET-Adaptionen" ULONG FORMULA_0152 0 0 0.0 655.0000 ECU_ADDRESS 0x3FC5A0 /end MEASUREMENT
/begin MEASUREMENT lam_diag_st_b1 "Status LA-Anschlagsdiagnose" UWORD FORMULA_0083 0 0 0.0 65535.0000 ECU_ADDRESS 0x3FC5A4 /end MEASUREMENT
/begin MEASUREMENT lam_diag_st_b2 "Status LA-Anschlagsdiagnose" UWORD FORMULA_0083 0 0 0.0 65535.0000 ECU_ADDRESS 0x3FC5A6 /end MEASUREMENT
/begin MEASUREMENT lam_diag_reg_max_aktiv_b1 "oberer LA-Regler-Anschlag" UWORD FORMULA_0774 0 0 0.0 65535.0 ECU_ADDRESS 0x3FC5A4 BIT_MASK 0x1 /end MEASUREMENT
/begin MEASUREMENT lam_diag_reg_max_aktiv_b2 "oberer LA-Regler-Anschlag" UWORD FORMULA_0774 0 0 0.0 65535.0 ECU_ADDRESS 0x3FC5A6 BIT_MASK 0x1 /end MEASUREMENT
/begin MEASUREMENT lam_diag_reg_min_aktiv_b1 "unterer LA-Regler-Anschlag" UWORD FORMULA_0775 0 0 0.0 65535.0 ECU_ADDRESS 0x3FC5A4 BIT_MASK 0x2 /end MEASUREMENT
/begin MEASUREMENT lam_diag_reg_min_aktiv_b2 "unterer LA-Regler-Anschlag" UWORD FORMULA_0775 0 0 0.0 65535.0 ECU_ADDRESS 0x3FC5A6 BIT_MASK 0x2 /end MEASUREMENT
/begin MEASUREMENT lam_diag_laa_f_max_aktiv_b1 "oberer LAA-Faktor-Anschlag" UWORD FORMULA_0776 0 0 0.0 65535.0 ECU_ADDRESS 0x3FC5A4 BIT_MASK 0x4 /end MEASUREMENT
/begin MEASUREMENT lam_diag_laa_f_max_aktiv_b2 "oberer LAA-Faktor-Anschlag" UWORD FORMULA_0776 0 0 0.0 65535.0 ECU_ADDRESS 0x3FC5A6 BIT_MASK 0x4 /end MEASUREMENT
/begin MEASUREMENT lam_diag_laa_f_min_aktiv_b1 "unterer LAA-Faktor-Anschlag" UWORD FORMULA_0777 0 0 0.0 65535.0 ECU_ADDRESS 0x3FC5A4 BIT_MASK 0x8 /end MEASUREMENT
/begin MEASUREMENT lam_diag_laa_f_min_aktiv_b2 "unterer LAA-Faktor-Anschlag" UWORD FORMULA_0777 0 0 0.0 65535.0 ECU_ADDRESS 0x3FC5A6 BIT_MASK 0x8 /end MEASUREMENT
/begin MEASUREMENT lam_diag_laa_offs_max_aktiv_b1 "oberer LAA-Offset-Anschlag" UWORD FORMULA_0778 0 0 0.0 65535.0 ECU_ADDRESS 0x3FC5A4 BIT_MASK 0x10 /end MEASUREMENT
/begin MEASUREMENT lam_diag_laa_offs_max_aktiv_b2 "oberer LAA-Offset-Anschlag" UWORD FORMULA_0778 0 0 0.0 65535.0 ECU_ADDRESS 0x3FC5A6 BIT_MASK 0x10 /end MEASUREMENT
/begin MEASUREMENT lam_diag_laa_offs_min_aktiv_b1 "unterer LAA-Offset-Anschlag" UWORD FORMULA_0779 0 0 0.0 65535.0 ECU_ADDRESS 0x3FC5A4 BIT_MASK 0x20 /end MEASUREMENT
/begin MEASUREMENT lam_diag_laa_offs_min_aktiv_b2 "unterer LAA-Offset-Anschlag" UWORD FORMULA_0779 0 0 0.0 65535.0 ECU_ADDRESS 0x3FC5A6 BIT_MASK 0x20 /end MEASUREMENT
/begin MEASUREMENT lam_diag_lam_reg_scdn_b1 "Diagnose LA-Regler - SCDN" UWORD FORMULA_0780 0 0 0.0 65535.0 ECU_ADDRESS 0x3FC5A4 BIT_MASK 0x40 /end MEASUREMENT
/begin MEASUREMENT lam_diag_lam_reg_scdn_b2 "Diagnose LA-Regler - SCDN" UWORD FORMULA_0780 0 0 0.0 65535.0 ECU_ADDRESS 0x3FC5A6 BIT_MASK 0x40 /end MEASUREMENT
/begin MEASUREMENT lam_diag_la_adapt_scdn_b1 "Diagnose LAA-Adaption - SCDN" UWORD FORMULA_0781 0 0 0.0 65535.0 ECU_ADDRESS 0x3FC5A4 BIT_MASK 0x80 /end MEASUREMENT
/begin MEASUREMENT lam_diag_la_adapt_scdn_b2 "Diagnose LAA-Adaption - SCDN" UWORD FORMULA_0781 0 0 0.0 65535.0 ECU_ADDRESS 0x3FC5A6 BIT_MASK 0x80 /end MEASUREMENT
/begin MEASUREMENT lam_diag_reg_t_b1 "LA-Regleranschlag - Start" UWORD FORMULA_0010 0 0 0.0 65535.0000 ECU_ADDRESS 0x3FC5A8 /end MEASUREMENT
/begin MEASUREMENT lam_diag_reg_t_b2 "LA-Regleranschlag - Start" UWORD FORMULA_0010 0 0 0.0 65535.0000 ECU_ADDRESS 0x3FC5AA /end MEASUREMENT
/begin MEASUREMENT lam_diag_reg_io_t_b1 "LA-Regleranschlag - Heilung" UWORD FORMULA_0010 0 0 0.0 65535.0000 ECU_ADDRESS 0x3FC5AC /end MEASUREMENT
/begin MEASUREMENT lam_diag_reg_io_t_b2 "LA-Regleranschlag - Heilung" UWORD FORMULA_0010 0 0 0.0 65535.0000 ECU_ADDRESS 0x3FC5AE /end MEASUREMENT
/begin MEASUREMENT lam_diag_laa_f_t_b1 "LAA-Faktoranschlagszeit" UWORD FORMULA_0073 0 0 0.0 6553.5000 ECU_ADDRESS 0x3FC5B0 /end MEASUREMENT
/begin MEASUREMENT lam_diag_laa_f_t_b2 "LAA-Faktoranschlagszeit" UWORD FORMULA_0073 0 0 0.0 6553.5000 ECU_ADDRESS 0x3FC5B2 /end MEASUREMENT
/begin MEASUREMENT lam_diag_laa_io_t_b1 "LAA-Aanschlag - Heilung" UWORD FORMULA_0010 0 0 0.0 65535.0000 ECU_ADDRESS 0x3FC5B4 /end MEASUREMENT
/begin MEASUREMENT lam_diag_laa_io_t_b2 "LAA-Aanschlag - Heilung" UWORD FORMULA_0010 0 0 0.0 65535.0000 ECU_ADDRESS 0x3FC5B6 /end MEASUREMENT
/begin MEASUREMENT lam_diag_laa_offs_t_b1 "LAA-Offsetanschlagszeit" UWORD FORMULA_0073 0 0 0.0 6553.5000 ECU_ADDRESS 0x3FC5B8 /end MEASUREMENT
/begin MEASUREMENT lam_diag_laa_offs_t_b2 "LAA-Offsetanschlagszeit" UWORD FORMULA_0073 0 0 0.0 6553.5000 ECU_ADDRESS 0x3FC5BA /end MEASUREMENT
/begin MEASUREMENT lam_diag_laa_f_cnt_b1 "Zahler fuer LAA-Faktoranschlagszeit" UWORD FORMULA_0010 0 0 0.0 65535.0000 ECU_ADDRESS 0x3FC5BC /end MEASUREMENT
/begin MEASUREMENT lam_diag_laa_f_cnt_b2 "Zahler fuer LAA-Faktoranschlagszeit" UWORD FORMULA_0010 0 0 0.0 65535.0000 ECU_ADDRESS 0x3FC5BE /end MEASUREMENT
/begin MEASUREMENT lam_diag_laa_offs_cnt_b1 "Zeit fuer LAA-Offsetanschlagszeit" UWORD FORMULA_0010 0 0 0.0 65535.0000 ECU_ADDRESS 0x3FC5C0 /end MEASUREMENT
/begin MEASUREMENT lam_diag_laa_offs_cnt_b2 "Zeit fuer LAA-Offsetanschlagszeit" UWORD FORMULA_0010 0 0 0.0 65535.0000 ECU_ADDRESS 0x3FC5C2 /end MEASUREMENT
/* ------------------ Abschnitt erzeugt aus lam_soll.dat ------------------ */
/begin CHARACTERISTIC K_LAM_SEGM_V214_FAK2 "Anpassungsfaktor fuer Segmentzeit" VALUE 0x738B4 TKW_VV_VV_UW 100.0 FORMULA_0797 1.0 2.0 FORMAT "%5.2" /end CHARACTERISTIC
/begin CHARACTERISTIC K_LAM_SOLL_MS_KAT_F_OBD "Wichtungsfak. auf Lambdapulshub bei KAT_ZUST_PASSIV | EN: Weighting factor on lambda pulse amplitude when catalyst passive" VALUE 0x738B6 TKW_VV_VV_UW 100.0 FORMULA_0075 0.0 1.0000 FORMAT "%6.3" /end CHARACTERISTIC
/begin CHARACTERISTIC K_LAM_SOLL_KONV_CFG "KONV-Pulsgenerator" VALUE 0x738B8 TKW_VV_VV_UW 100.0 FORMULA_0798 0.0 1.0 FORMAT "%5.2" /end CHARACTERISTIC
/begin CHARACTERISTIC K_LAM_SOLL_OFFS_MCS "LAM-SOLL-Offset - Fummeloffset | EN: Target lambda offset (MCS) | [Code V452 INJ 0x4596C] Global lambda target offset added to every state after the cat-protection min() (0 here)." VALUE 0x738BA TKW_VV_VV_SW 100.0 FORMULA_0025 -2.0000 1.9999 FORMAT "%6.3" /end CHARACTERISTIC
/begin CHARACTERISTIC K_LAM_SOLL_KATH_T_ML_MAX "max. Zeit fuer den Zustand SL (frueher KATH-Heizen) | EN: Max. time in state SL (former cat heating) [s]" VALUE 0x738BC TKW_VV_VV_UW 100.0 FORMULA_0799 0.0 65535.0000 /end CHARACTERISTIC
/begin CHARACTERISTIC K_LAM_SOLL_WL_TMOT_MAX "TMOT-Schwelle f. WL-Zustand-Erkennung | [Code V452 INJ 0x453C4/0x455EC] Coolant temperature above which the warm-up lambda state is left (with K_LAM_SOLL_WL_TMOT_HYS)." VALUE 0x738BE TKW_VV_VV_SW 100.0 FORMULA_0023 -50.0000 170.0000 FORMAT "%4.1" /end CHARACTERISTIC
/begin CHARACTERISTIC K_LAM_SOLL_WL_TMOT_HYS "TMOT-Schwelle f. WL-Zustand-Erkennung | EN: TMOT hysteresis for warm-up state detection [degC x/10] | [Code V452 INJ 0x453C4] Hysteresis of the warm-up state threshold." VALUE 0x738C0 TKW_VV_VV_SW 100.0 FORMULA_0800 -1000.0000 1000.0000 FORMAT "%4.1" /end CHARACTERISTIC
/begin CHARACTERISTIC K_LAM_SOLL_KATH_DELTA_POS "pos. Aenderungsbegr. in SL (frueher KATH) | EN: Pos. lambda rate limit in SL [1/s]" VALUE 0x738C2 TKW_VV_VV_UW 100.0 FORMULA_0801 0.0 1.9990 FORMAT "%6.3" /end CHARACTERISTIC
/begin CHARACTERISTIC K_LAM_SOLL_KATH_DELTA_NEG "neg. Aenderungsbegr. in SL (frueher KATH) | EN: Neg. lambda rate limit in SL [1/s]" VALUE 0x738C4 TKW_VV_VV_SW 100.0 FORMULA_0802 0.0 -2.0000 FORMAT "%6.3" /end CHARACTERISTIC
/begin CHARACTERISTIC K_LAM_SOLL_WL_DELTA_POS "pos. Aenderungsbegr. im WL | EN: Pos. lambda rate limit in warm-up [1/s]" VALUE 0x738C6 TKW_VV_VV_UW 100.0 FORMULA_0801 0.0 1.9990 FORMAT "%6.3" /end CHARACTERISTIC
/begin CHARACTERISTIC K_LAM_SOLL_WL_DELTA_NEG "neg. Aenderungsbegr. im WL | EN: Neg. lambda rate limit in warm-up [1/s]" VALUE 0x738C8 TKW_VV_VV_SW 100.0 FORMULA_0802 0.0 -2.0000 FORMAT "%6.3" /end CHARACTERISTIC
/begin CHARACTERISTIC K_LAM_SOLL_FETT_ERK "FETT-Erkennung f. MS_KAT-Adaption | EN: Rich detection for MS_KAT adaptation" VALUE 0x738CA TKW_VV_VV_UW 100.0 FORMULA_0025 0.0 3.9990 FORMAT "%6.3" /end CHARACTERISTIC
/begin CHARACTERISTIC K_LAM_SOLL_MS_KAT_MIN "KAT befuellt mit min. Sauerstoffmasse | EN: Cat filled with min. O2 mass" VALUE 0x738CC TKW_VV_VV_SW 100.0 FORMULA_0803 -3276.8000 3276.7000 FORMAT "%4.1" /end CHARACTERISTIC
/begin CHARACTERISTIC K_LAM_SOLL_MS_KAT_SOLL_MAX_OBD "max. gespeicherte Sauerstoffmasse im KAT - O2-Ermittlung | EN: Max. stored O2 mass in cat - O2 determination" VALUE 0x738CE TKW_VV_VV_SW 100.0 FORMULA_0803 -3276.8000 3276.7000 FORMAT "%4.1" /end CHARACTERISTIC
/begin CHARACTERISTIC K_LAM_SOLL_T_SA_SLP_MIN "min. Zeit in SA/SLP-ON f. Adaption | EN: Min. time in SA/SLP-ON for adaptation" VALUE 0x738D0 TKW_VV_VV_UW 100.0 FORMULA_0804 0.0 655.3500 /end CHARACTERISTIC
/begin CHARACTERISTIC K_LAM_SOLL_T_FETT_MIN "min. Zeit in FETT f. Adaption | EN: Min. time rich for adaptation" VALUE 0x738D2 TKW_VV_VV_UW 100.0 FORMULA_0804 0.0 655.3500 /end CHARACTERISTIC
/begin CHARACTERISTIC K_LAM_SOLL_FILT_F "Filterfaktor f. lam_soll_filt | EN: Filter factor for lam_soll_filt (x/128)" VALUE 0x738D4 TKW_VV_VV_UW 100.0 FORMULA_0805 0.0 511.9921 FORMAT "%5.2" /end CHARACTERISTIC
/begin CHARACTERISTIC K_LAM_SOLL_O2_ANT "Sauerstoffanteil d. Luft | EN: Oxygen fraction of air (x/128)" VALUE 0x738D6 TKW_VV_VV_UW 100.0 FORMULA_0805 0.0 511.9921 FORMAT "%5.2" /end CHARACTERISTIC
/begin CHARACTERISTIC K_LAM_SOLL_PULS_O2_HYST "min. Schwelle f. Berechnung Sauerstoffmassengradient | EN: Min. |lambda-1| for O2 mass gradient calculation" VALUE 0x738D8 TKW_VV_VV_UW 100.0 FORMULA_0025 0.0 3.9990 FORMAT "%6.3" /end CHARACTERISTIC
/begin CHARACTERISTIC K_LAM_SOLL_KR_KATS "KR-LA-Faktor | EN: Knock-retard to lambda factor [1/degKW] | [Code V452 INJ 0x4596C] Knock-to-lambda factor: target offset = (kr_dtz_sum + ka_dtz_sum - KF_LAM_SOLL_KR_KATS_OFFS) x factor (only when the retard exceeds the map offset). 0 here = off." VALUE 0x738DA TKW_VV_VV_UW 100.0 FORMULA_0806 0.0 1.0000 FORMAT "%6.3" /end CHARACTERISTIC
/begin CHARACTERISTIC K_LAM_SOLL_ADD_KONV_GRAD "Pulshub - Aenderungsbegrenzung | EN: Pulse amplitude rate limit" VALUE 0x738DC TKW_VV_VV_UW 100.0 FORMULA_0025 0.0 3.9990 FORMAT "%6.3" /end CHARACTERISTIC
/begin CHARACTERISTIC K_LAM_SOLL_MAX "MAX-Begrenzung LAM_SOLL | EN: Max. limit of target lambda | [Code V452 INJ 0x46CB8] Leanest allowed final lambda target." VALUE 0x738DE TKW_VV_VV_UW 100.0 FORMULA_0025 0.0 3.9990 FORMAT "%6.3" /end CHARACTERISTIC
/begin CHARACTERISTIC K_LAM_SOLL_MIN "MIN-Begrenzung LAM_SOLL | EN: Min. limit of target lambda | [Code V452 INJ 0x46CB8] Richest allowed final lambda target (after trim offset)." VALUE 0x738E0 TKW_VV_VV_UW 100.0 FORMULA_0025 0.0 3.9990 FORMAT "%6.3" /end CHARACTERISTIC
/begin CHARACTERISTIC K_LAM_SOLL_PULS_AUSR_CFG "O2-Ausraeumfunktion | EN: O2 clearing function enable (0 inactive, 1 active)" VALUE 0x738E2 TKW_VV_VV_UW 100.0 FORMULA_0798 0.0 1.0 FORMAT "%5.2" /end CHARACTERISTIC
/begin CHARACTERISTIC K_LAM_SOLL_PULS_AUSR_SL_CFG "O2-Ausraeumfunktion - nach SLP-Betrieb | EN: O2 clearing after secondary-air operation enable" VALUE 0x738E4 TKW_VV_VV_UW 100.0 FORMULA_0798 0.0 1.0 FORMAT "%5.2" /end CHARACTERISTIC
/begin CHARACTERISTIC K_LAM_SOLL_PULS_LANK_CFG "O2-Ausraeumfunktion - Fuehrung duch NKAT-Signal | EN: O2 clearing guided by post-cat probe signal" VALUE 0x738E6 TKW_VV_VV_UW 100.0 FORMULA_0807 0.0 1.0 FORMAT "%5.2" /end CHARACTERISTIC
/begin CHARACTERISTIC K_LAM_SOLL_PULS_LANK_MAX "O2-Ausraeumfunktion - max. Schwelle fuer NKAT-Fuehrung | EN: O2 clearing - max. threshold for post-cat guidance" VALUE 0x738E8 TKW_VV_VV_SW 100.0 FORMULA_0532 -1200.0000 1200.0000 /end CHARACTERISTIC
/begin CHARACTERISTIC K_LAM_SOLL_PULS_LANK_MIN "O2-Ausraeumfunktion - min. Schwelle fuer NKAT-Fuehrung | EN: O2 clearing - min. threshold for post-cat guidance" VALUE 0x738EA TKW_VV_VV_SW 100.0 FORMULA_0532 -1200.0000 1200.0000 /end CHARACTERISTIC
/begin CHARACTERISTIC K_LAM_SOLL_PULS_AUSR_SL_T "Verzaegerungszeit nach Startende | EN: Delay after start end (O2 clearing)" VALUE 0x738EC TKW_VV_VV_UW 100.0 FORMULA_0021 0.0 655.3500 FORMAT "%5.2" /end CHARACTERISTIC
/begin CHARACTERISTIC K_LAM_SOLL_MS_KAT_OFFSET_OBD "OFFSET auf min. Sauerstoffmasse im Zustand PASSIV | EN: OFFSET für max. Sauerstoff- masse im Zustand PASSIV /WARTEN" VALUE 0x738EE TKW_VV_VV_SW 100.0 FORMULA_0803 -3276.8000 3276.7000 FORMAT "%4.1" /end CHARACTERISTIC
/begin CHARACTERISTIC KL_LAM_SOLL_START "SOLL-Lambda von START -> ML | EN: Target lambda at start | [Code V452 INJ 0xF7008] Start lambda over tmot (state 'start')." CURVE 0x738F0 TKL_SW_VV_UW 100.0 FORMULA_0025 0.0 3.9990
 /begin AXIS_DESCR STD_AXIS tmot FORMULA_0023 6 -50.0000 170.0000 FORMAT "%4.1" /end AXIS_DESCR
 FORMAT "%6.3" /end CHARACTERISTIC
/begin CHARACTERISTIC KL_LAM_SOLL_VL "SOLL-Lambda - Vollast | EN: Target lambda - full load | [Code V452 INJ 0x4596C] Full-load lambda over n. On entering full load the current target is frozen as lam_w.soll_vl_bezug; then target = bezug + f x (KL_LAM_SOLL_VL - bezug) + knock offset, f = (md_wunsch_rel - zust_md_rel_tl_vl)/(100 % - threshold): 0 at 90 % torque demand, 1.0 at 100 %. Full value only at 100 % demand. Cat protection can make it richer, never leaner." CURVE 0x7390A TKL_SW_VV_UW 100.0 FORMULA_0025 0.0 3.9990 /begin AXIS_DESCR STD_AXIS n FORMULA_0006 8 0.0 10000.0000 /end AXIS_DESCR FORMAT "%6.3" /end CHARACTERISTIC
/begin CHARACTERISTIC KL_LAM_SOLL_PULS_PW_OBD "Pulsdauer f. Pulsgenerator OBD" CURVE 0x7392C TKL_UW_VV_UW 100.0 FORMULA_0021 0.0 655.3500 /begin AXIS_DESCR STD_AXIS Abgasbank FORMULA_0010 2 1.0000 2.0000 /end AXIS_DESCR FORMAT "%5.2" /end CHARACTERISTIC
/begin CHARACTERISTIC KL_LAM_SOLL_PULS_ADD_OBD "Pulshub f. Pulsgenerator OBD" CURVE 0x73936 TKL_UW_VV_SW 100.0 FORMULA_0025 -2.0000 1.9999 /begin AXIS_DESCR STD_AXIS Abgasbank FORMULA_0010 2 1.0000 2.0000 /end AXIS_DESCR FORMAT "%6.3" /end CHARACTERISTIC
/begin CHARACTERISTIC KL_LAM_SOLL_ADD_KAT_ALT_F "Wichtungsfaktor ueber KAT-Alterung | EN: Weighting factor over catalyst ageing" CURVE 0x73940 TKL_UW_VV_UW 100.0 FORMULA_0075 0.0 4.0000
 /begin AXIS_DESCR STD_AXIS kat_obd_wert_nv FORMULA_0025 6 0.0 3.9990 FORMAT "%6.3" /end AXIS_DESCR
 FORMAT "%6.3" /end CHARACTERISTIC
/begin CHARACTERISTIC KL_LAM_SOLL_AUSS_F "Korrekturfak. f. Zustand Sicherheitskonzept | EN: Correction factor for safety-concept state" CURVE 0x7395A TKL_SW_VV_UW 100.0 FORMULA_0075 0.0 4.0000
 /begin AXIS_DESCR STD_AXIS tmot_modell FORMULA_0023 8 -50.0000 170.0000 FORMAT "%4.1" /end AXIS_DESCR
 FORMAT "%6.3" /end CHARACTERISTIC
/begin CHARACTERISTIC KL_LAM_SOLL_MS_KAT_MAX "KAT befuellt mit max. Sauerstoffmasse | EN: Catalyst filled with max. oxygen mass" CURVE 0x7397C TKL_UW_VV_SW 100.0 FORMULA_0803 -3276.8000 3276.7000
 /begin AXIS_DESCR STD_AXIS kat_obd_wert_gesamt_nv FORMULA_0025 6 0.0 3.9990 FORMAT "%6.3" /end AXIS_DESCR
 FORMAT "%4.1" /end CHARACTERISTIC
/begin CHARACTERISTIC KL_LAM_SOLL_MS_KAT_SOLL_HYS "relative Vorgabe d. Hysterese auf max. Sauerstoffmasse | EN: Relative hysteresis on max. oxygen mass" CURVE 0x73996 TKL_UW_VV_SW 100.0 FORMULA_0001 0.0 100.0000
 /begin AXIS_DESCR STD_AXIS kat_obd_wert_gesamt_nv FORMULA_0025 6 0.0 3.9990 FORMAT "%6.3" /end AXIS_DESCR
 FORMAT "%4.1" /end CHARACTERISTIC
/begin CHARACTERISTIC KF_LAM_SOLL_WL "SOLL-Lambda - Warmlaufbetrieb | EN: Target lambda - warm-up operation | [Code V452 INJ 0x4596C] Warm-up lambda (n x rf_m) x KF_LAM_SOLL_WL_F/1024; used while tmot < K_LAM_SOLL_WL_TMOT_MAX (+hyst). Full load still blends from this value to KL_LAM_SOLL_VL." MAP 0x739B0 TKF_SW_SW_UW 100.0 FORMULA_0025 0.0 3.9990 /begin AXIS_DESCR STD_AXIS n FORMULA_0006 8 0.0 10000.0000 /end AXIS_DESCR /begin AXIS_DESCR STD_AXIS rf FORMULA_0007 8 0.0 2.0000 FORMAT "%6.3" /end AXIS_DESCR FORMAT "%6.3" /end CHARACTERISTIC
/begin CHARACTERISTIC KF_LAM_SOLL_TAU1_ABG "Zeitkonstante Abgassystem u. Sonde | EN: Time constant of exhaust system and sensor | [Code V452 INJ 0x46CB8] Exhaust/probe delay time constant for the filtered target lam_soll_filt (used by lambda control comparison)." MAP 0x73A52 TKF_SW_SW_UW 100.0 FORMULA_0762 0.0 2097.0000 /begin AXIS_DESCR STD_AXIS n FORMULA_0006 6 0.0 10000.0000 /end AXIS_DESCR /begin AXIS_DESCR STD_AXIS rf FORMULA_0007 4 0.0 2.0000 FORMAT "%6.3" /end AXIS_DESCR /end CHARACTERISTIC
/begin CHARACTERISTIC KF_LAM_SOLL_GRUND "SOLL-Lambda - Normalbetrieb | EN: Target lambda - normal operation | [Code V452 INJ 0x4596C] Part-load lambda target (n x rf_m), per bank via state machine lam_w.soll_zust_st: start KL_LAM_SOLL_START | normal KF_LAM_SOLL_GRUND + wall-film offset + knock offset (K_LAM_SOLL_KR_KATS) | warm-up KF_LAM_SOLL_WL x KF_LAM_SOLL_WL_F | full load: blend to KL_LAM_SOLL_VL | safety/misfire KF_LAM_SOLL_AUSS_KATS. Then min(target, cat-protection lambda) -> + K_LAM_SOLL_OFFS_MCS -> change limit -> K_LAM_SOLL_MIN..MAX -> lam_soll_b." MAP 0x73A98 TKF_SW_SW_UW 100.0 FORMULA_0025 0.9501 1.0200 /begin AXIS_DESCR STD_AXIS n FORMULA_0006 8 0.0 10000.0000 /end AXIS_DESCR /begin AXIS_DESCR STD_AXIS rf FORMULA_0007 8 0.0 2.0000 FORMAT "%6.3" /end AXIS_DESCR FORMAT "%6.3" /end CHARACTERISTIC
/begin CHARACTERISTIC KF_LAM_SOLL_GRUND_PST "SOLL-Lambda - Normalbetrieb PST | EN: Target lambda - normal operation, test bench | [Code V452 INJ 0x4596C] Replaces KF_LAM_SOLL_GRUND in PST (test-bench / production) mode (soll_st bit, or cfg.betriebsmode / tester operating mode)." MAP 0x73B3A TKF_SW_SW_UW 100.0 FORMULA_0025 0.0 3.9990 /begin AXIS_DESCR STD_AXIS n FORMULA_0006 8 0.0 10000.0000 /end AXIS_DESCR /begin AXIS_DESCR STD_AXIS rf FORMULA_0007 8 0.0 2.0000 FORMAT "%6.3" /end AXIS_DESCR FORMAT "%6.3" /end CHARACTERISTIC
/begin CHARACTERISTIC KF_LAM_SOLL_KR_KATS_OFFS "TZ-OFFSET aus KR | EN: Ignition-angle offset from knock control | [Code V452 INJ 0x4596C] Knock retard threshold (n x rf_m) above which K_LAM_SOLL_KR_KATS enriches. -100 here = never." MAP 0x73BDC TKF_SW_SW_SW 100.0 FORMULA_0111 -100.0000 60.0000 /begin AXIS_DESCR STD_AXIS n FORMULA_0006 6 0.0 10000.0000 /end AXIS_DESCR /begin AXIS_DESCR STD_AXIS rf FORMULA_0007 6 0.0 2.0000 FORMAT "%6.3" /end AXIS_DESCR FORMAT "%4.1" /end CHARACTERISTIC
/begin CHARACTERISTIC KF_LAM_SOLL_AUSS_KATS "KATS-Lambda beim SK-Manager | EN: Catalyst-protection lambda from safety-concept manager | [Code V452 INJ 0x4596C] Lambda in the safety-concept/misfire state: KF_LAM_SOLL_AUSS_KATS - KF_LAM_SOLL_AUSS_OFFS x KL_LAM_SOLL_AUSS_F." MAP 0x73C3E TKF_SW_SW_UW 100.0 FORMULA_0025 0.0 3.9990 /begin AXIS_DESCR STD_AXIS n FORMULA_0006 6 0.0 10000.0000 /end AXIS_DESCR /begin AXIS_DESCR STD_AXIS rf FORMULA_0007 6 0.0 2.0000 FORMAT "%6.3" /end AXIS_DESCR FORMAT "%6.3" /end CHARACTERISTIC
/begin CHARACTERISTIC KF_LAM_SOLL_AUSS_OFFS "OFFSET auf KATS-Lambda beim SK-Manager | [Code V452 INJ 0x4596C] Offset subtracted in the safety-concept/misfire lambda state, weighted by KL_LAM_SOLL_AUSS_F(tmot_modell)." MAP 0x73CA0 TKF_SW_SW_UW 100.0 FORMULA_0025 0.0 3.9990 /begin AXIS_DESCR STD_AXIS n FORMULA_0006 6 0.0 10000.0000 /end AXIS_DESCR /begin AXIS_DESCR STD_AXIS rf FORMULA_0007 6 0.0 2.0000 FORMAT "%6.3" /end AXIS_DESCR FORMAT "%6.3" /end CHARACTERISTIC
/begin CHARACTERISTIC KF_LAM_SOLL_MS_KAT_SOLL_MAX "relative Vorgabe fuer max. gespeicherte Sauerstoffmasse im KAT" MAP 0x73D02 TKF_SW_SW_SW 100.0 FORMULA_0001 0.0 100.0000 /begin AXIS_DESCR STD_AXIS n FORMULA_0006 8 0.0 10000.0000 /end AXIS_DESCR /begin AXIS_DESCR STD_AXIS rf FORMULA_0007 8 0.0 2.0000 FORMAT "%6.3" /end AXIS_DESCR FORMAT "%4.1" /end CHARACTERISTIC
/begin CHARACTERISTIC KF_LAM_SOLL_MS_KAT_SOLL_MIN "relative Vorgabe fuer min. gespeicherte Sauerstoffmasse im KAT" MAP 0x73DA4 TKF_SW_SW_SW 100.0 FORMULA_0001 0.0 100.0000 /begin AXIS_DESCR STD_AXIS n FORMULA_0006 8 0.0 10000.0000 /end AXIS_DESCR /begin AXIS_DESCR STD_AXIS rf FORMULA_0007 8 0.0 2.0000 FORMAT "%6.3" /end AXIS_DESCR FORMAT "%4.1" /end CHARACTERISTIC
/begin CHARACTERISTIC KF_LAM_SOLL_MS_KAT_SOLL_MIN_OBD "min. gespeicherte Sauerstoffmasse im KAT - O2-Ermittlung | EN: Minimum stored oxygen mass in catalyst - O2 determination" MAP 0x73E46 TKF_SW_SW_SW 100.0 FORMULA_0093 -3276.8000 3276.7000 /begin AXIS_DESCR STD_AXIS n FORMULA_0006 6 0.0 10000.0000 /end AXIS_DESCR /begin AXIS_DESCR STD_AXIS rf FORMULA_0007 6 0.0 2.0000 FORMAT "%6.3" /end AXIS_DESCR FORMAT "%5.2" /end CHARACTERISTIC
/begin CHARACTERISTIC KF_LAM_SOLL_ADD_POS_OBD "Lambdapulshub in Richtung MAGER | EN: Lambda pulse amplitude towards LEAN" MAP 0x73EA8 TKF_SW_SW_UW 100.0 FORMULA_0025 0.0 3.9990 /begin AXIS_DESCR STD_AXIS n FORMULA_0006 6 0.0 10000.0000 /end AXIS_DESCR /begin AXIS_DESCR STD_AXIS rf FORMULA_0007 6 0.0 2.0000 FORMAT "%6.3" /end AXIS_DESCR FORMAT "%6.3" /end CHARACTERISTIC
/begin CHARACTERISTIC KF_LAM_SOLL_ADD_NEG_OBD "Lambdapulshub in Richtung FETT | EN: Lambda pulse amplitude towards RICH" MAP 0x73F0A TKF_SW_SW_UW 100.0 FORMULA_0025 0.0 3.9990 /begin AXIS_DESCR STD_AXIS n FORMULA_0006 6 0.0 10000.0000 /end AXIS_DESCR /begin AXIS_DESCR STD_AXIS rf FORMULA_0007 6 0.0 2.0000 FORMAT "%6.3" /end AXIS_DESCR FORMAT "%6.3" /end CHARACTERISTIC
/begin CHARACTERISTIC KF_LAM_SOLL_ADD_KONV "Lambdapulshub in Richtung MAGER/FETT | EN: Lambda pulse amplitude (normal operation)" MAP 0x73F6C TKF_SW_SW_UW 100.0 FORMULA_0025 0.0 3.9990 /begin AXIS_DESCR STD_AXIS n FORMULA_0006 8 0.0 10000.0000 /end AXIS_DESCR /begin AXIS_DESCR STD_AXIS rf FORMULA_0007 8 0.0 2.0000 FORMAT "%6.3" /end AXIS_DESCR FORMAT "%6.3" /end CHARACTERISTIC
/begin CHARACTERISTIC KF_LAM_SOLL_PULS_OFFS_AUSR "Pulshub - O2-Ausraeumfunktion | EN: Pulse amplitude - O2 clearing (applied rich)" MAP 0x7400E TKF_SW_SW_UW 100.0 FORMULA_0025 0.0 3.9990 /begin AXIS_DESCR STD_AXIS n FORMULA_0006 8 0.0 10000.0000 /end AXIS_DESCR /begin AXIS_DESCR STD_AXIS rf FORMULA_0007 8 0.0 2.0000 FORMAT "%6.3" /end AXIS_DESCR FORMAT "%6.3" /end CHARACTERISTIC
/begin CHARACTERISTIC KF_LAM_SOLL_WL_F "Korrekturfak. f. Zustand Warmlaufbetrieb | EN: Correction factor for warm-up state (target lambda) | [Code V452 INJ 0xF7008] Warm-up factor over tmot x pumg applied to KF_LAM_SOLL_WL (richer at low temperature / altitude)." MAP 0x740B0 TKF_SW_SW_UW 100.0 FORMULA_0075 0.0 4.0000
 /begin AXIS_DESCR STD_AXIS tmot FORMULA_0023 8 -50.0000 170.0000 FORMAT "%4.1" /end AXIS_DESCR
 /begin AXIS_DESCR STD_AXIS pumg FORMULA_0077 4 400.0000 1200.0000 FORMAT "%4.1" /end AXIS_DESCR
 FORMAT "%6.3" /end CHARACTERISTIC
/begin MEASUREMENT lam_w_b1.soll_zust_st "Zustandsautomat LAM_SOLL" UWORD FORMULA_0793 0 0 0.0 65535.0 ECU_ADDRESS 0x3FC5C8 BIT_MASK 0xFFF /end MEASUREMENT
/begin MEASUREMENT lam_w_b2.soll_zust_st "Zustandsautomat LAM_SOLL" UWORD FORMULA_0793 0 0 0.0 65535.0 ECU_ADDRESS 0x3FC5F6 BIT_MASK 0xFFF /end MEASUREMENT
/begin MEASUREMENT lam_w_b1.soll_st "LAM_SOLL-Status" UWORD FORMULA_0794 0 0 0.0 65535.0 ECU_ADDRESS 0x3FC5CA BIT_MASK 0x1FF /end MEASUREMENT
/begin MEASUREMENT lam_w_b2.soll_st "LAM_SOLL-Status" UWORD FORMULA_0794 0 0 0.0 65535.0 ECU_ADDRESS 0x3FC5F8 BIT_MASK 0x1FF /end MEASUREMENT
/begin MEASUREMENT lam_w_b1.soll_stat "SOLL-Lambda entsprechend dem LAM_SOLL-Zustand" UWORD FORMULA_0025 0 0 0.0 3.9990 ECU_ADDRESS 0x3FC5CC /end MEASUREMENT
/begin MEASUREMENT lam_w_b2.soll_stat "SOLL-Lambda entsprechend dem LAM_SOLL-Zustand" UWORD FORMULA_0025 0 0 0.0 3.9990 ECU_ADDRESS 0x3FC5FA /end MEASUREMENT
/begin MEASUREMENT lam_w_b1.soll_bas "gewuenschtes SOLL-Lambda" UWORD FORMULA_0025 0 0 0.0 3.9990 ECU_ADDRESS 0x3FC5CE /end MEASUREMENT
/begin MEASUREMENT lam_w_b2.soll_bas "gewuenschtes SOLL-Lambda" UWORD FORMULA_0025 0 0 0.0 3.9990 ECU_ADDRESS 0x3FC5FC /end MEASUREMENT
/begin MEASUREMENT lam_w_b1.soll_bas_lim "aenderungsbegr. SOLL-Lambda" UWORD FORMULA_0025 0 0 0.0 3.9990 ECU_ADDRESS 0x3FC5D0 /end MEASUREMENT
/begin MEASUREMENT lam_w_b2.soll_bas_lim "aenderungsbegr. SOLL-Lambda" UWORD FORMULA_0025 0 0 0.0 3.9990 ECU_ADDRESS 0x3FC5FE /end MEASUREMENT
/begin MEASUREMENT lam_w_b1.soll_bas_diff "lam_soll_bas-lam_soll_bas_lim" SWORD FORMULA_0025 0 0 -2.0000 1.9999 ECU_ADDRESS 0x3FC5D2 /end MEASUREMENT
/begin MEASUREMENT lam_w_b2.soll_bas_diff "lam_soll_bas-lam_soll_bas_lim" SWORD FORMULA_0025 0 0 -2.0000 1.9999 ECU_ADDRESS 0x3FC600 /end MEASUREMENT
/begin MEASUREMENT lam_w_b1.soll_vl_bezug "Bezugswert f. Ermittlung VL-SOLL-Lambda" UWORD FORMULA_0025 0 0 0.0 3.9990 ECU_ADDRESS 0x3FC5D4 /end MEASUREMENT
/begin MEASUREMENT lam_w_b2.soll_vl_bezug "Bezugswert f. Ermittlung VL-SOLL-Lambda" UWORD FORMULA_0025 0 0 0.0 3.9990 ECU_ADDRESS 0x3FC602 /end MEASUREMENT
/begin MEASUREMENT lam_w_b1.soll_delta_pos "pos. Aenderungsbegrenzung" SWORD FORMULA_0025 0 0 -2.0000 1.9999 ECU_ADDRESS 0x3FC5D6 /end MEASUREMENT
/begin MEASUREMENT lam_w_b2.soll_delta_pos "pos. Aenderungsbegrenzung" SWORD FORMULA_0025 0 0 -2.0000 1.9999 ECU_ADDRESS 0x3FC604 /end MEASUREMENT
/begin MEASUREMENT lam_w_b1.soll_delta_neg "neg. Aenderungsbegrenzung" SWORD FORMULA_0025 0 0 -2.0000 1.9999 ECU_ADDRESS 0x3FC5D8 /end MEASUREMENT
/begin MEASUREMENT lam_w_b2.soll_delta_neg "neg. Aenderungsbegrenzung" SWORD FORMULA_0025 0 0 -2.0000 1.9999 ECU_ADDRESS 0x3FC606 /end MEASUREMENT
/begin MEASUREMENT lam_w_b1.soll_add_konv "Pulshub - Konvertierung" SWORD FORMULA_0025 0 0 -2.0000 1.9999 ECU_ADDRESS 0x3FC5DA /end MEASUREMENT
/begin MEASUREMENT lam_w_b2.soll_add_konv "Pulshub - Konvertierung" SWORD FORMULA_0025 0 0 -2.0000 1.9999 ECU_ADDRESS 0x3FC608 /end MEASUREMENT
/begin MEASUREMENT lam_w_b1.soll_ms_kat_delta "zugefuehrte Sauerstoffmasse im KAT/ASP" SWORD FORMULA_0795 0 0 -819.2000 819.1750 ECU_ADDRESS 0x3FC5DC /end MEASUREMENT
/begin MEASUREMENT lam_w_b2.soll_ms_kat_delta "zugefuehrte Sauerstoffmasse im KAT/ASP" SWORD FORMULA_0795 0 0 -819.2000 819.1750 ECU_ADDRESS 0x3FC60A /end MEASUREMENT
/begin MEASUREMENT lam_w_b1.soll_ms_kat_init "Ausgangspunkt f. Sauerstoffmassenintegration im KAT" SWORD FORMULA_0093 0 0 -3276.8000 3276.7000 ECU_ADDRESS 0x3FC5DE /end MEASUREMENT
/begin MEASUREMENT lam_w_b2.soll_ms_kat_init "Ausgangspunkt f. Sauerstoffmassenintegration im KAT" SWORD FORMULA_0093 0 0 -3276.8000 3276.7000 ECU_ADDRESS 0x3FC60C /end MEASUREMENT
/begin MEASUREMENT lam_w_b1.soll_add_temp "additiver Pulshub - vor AEBG" SWORD FORMULA_0025 0 0 -2.0000 1.9999 ECU_ADDRESS 0x3FC5E0 /end MEASUREMENT
/begin MEASUREMENT lam_w_b2.soll_add_temp "additiver Pulshub - vor AEBG" SWORD FORMULA_0025 0 0 -2.0000 1.9999 ECU_ADDRESS 0x3FC60E /end MEASUREMENT
/begin MEASUREMENT lam_w_b1.soll_filt "gefiltertes LAM_SOLL" UWORD FORMULA_0025 0 0 0.0 3.9990 ECU_ADDRESS 0x3FC5E2 /end MEASUREMENT
/begin MEASUREMENT lam_w_b2.soll_filt "gefiltertes LAM_SOLL" UWORD FORMULA_0025 0 0 0.0 3.9990 ECU_ADDRESS 0x3FC610 /end MEASUREMENT
/begin MEASUREMENT lam_w_b1.soll_tau1 "TAU1 - SOLL-Filter" UWORD FORMULA_0762 0 0 0.0 2097.0000 ECU_ADDRESS 0x3FC5E4 /end MEASUREMENT
/begin MEASUREMENT lam_w_b2.soll_tau1 "TAU1 - SOLL-Filter" UWORD FORMULA_0762 0 0 0.0 2097.0000 ECU_ADDRESS 0x3FC612 /end MEASUREMENT
/begin MEASUREMENT lam_w_b1.soll_filt_konst "SOLL-Filterkonstante" UWORD FORMULA_0763 0 0 0.0 7.9998 ECU_ADDRESS 0x3FC5E6 /end MEASUREMENT
/begin MEASUREMENT lam_w_b2.soll_filt_konst "SOLL-Filterkonstante" UWORD FORMULA_0763 0 0 0.0 7.9998 ECU_ADDRESS 0x3FC614 /end MEASUREMENT
/begin MEASUREMENT lam_w_b1.ml_zyl_filt "gefilterte zyl. Luftmasse in mg/ASP" SWORD FORMULA_0093 0 0 -3276.7000 3276.7000 ECU_ADDRESS 0x3FC5E8 /end MEASUREMENT
/begin MEASUREMENT lam_w_b2.ml_zyl_filt "gefilterte zyl. Luftmasse in mg/ASP" SWORD FORMULA_0093 0 0 -3276.7000 3276.7000 ECU_ADDRESS 0x3FC616 /end MEASUREMENT
/begin MEASUREMENT lam_w_b1.tz_offs_kats "TZ-OFFSET aus KR" SWORD FORMULA_0111 0 0 -50.0000 60.0000 ECU_ADDRESS 0x3FC5F0 /end MEASUREMENT
/begin MEASUREMENT lam_w_b2.tz_offs_kats "TZ-OFFSET aus KR" SWORD FORMULA_0111 0 0 -50.0000 60.0000 ECU_ADDRESS 0x3FC61E /end MEASUREMENT
/begin MEASUREMENT lam_w_b1.soll_kr_kats_offs "LAM-SOLL-OFFSET aus KR" SWORD FORMULA_0025 0 0 -2.0000 1.9999 ECU_ADDRESS 0x3FC5F2 /end MEASUREMENT
/begin MEASUREMENT lam_w_b2.soll_kr_kats_offs "LAM-SOLL-OFFSET aus KR" SWORD FORMULA_0025 0 0 -2.0000 1.9999 ECU_ADDRESS 0x3FC620 /end MEASUREMENT
/begin MEASUREMENT lam_soll_verz_1of2_1of5_ "verzoegertes SOLL-Lambda" UWORD FORMULA_0025 0 0 0.0 3.9990 ECU_ADDRESS 0x3FC624 /end MEASUREMENT
/begin MEASUREMENT lam_soll_verz_1of2_2of5_ "verzoegertes SOLL-Lambda" UWORD FORMULA_0025 0 0 0.0 3.9990 ECU_ADDRESS 0x3FC626 /end MEASUREMENT
/begin MEASUREMENT lam_soll_verz_1of2_3of5_ "verzoegertes SOLL-Lambda" UWORD FORMULA_0025 0 0 0.0 3.9990 ECU_ADDRESS 0x3FC628 /end MEASUREMENT
/begin MEASUREMENT lam_soll_verz_1of2_4of5_ "verzoegertes SOLL-Lambda" UWORD FORMULA_0025 0 0 0.0 3.9990 ECU_ADDRESS 0x3FC62A /end MEASUREMENT
/begin MEASUREMENT lam_soll_verz_1of2_5of5_ "verzoegertes SOLL-Lambda" UWORD FORMULA_0025 0 0 0.0 3.9990 ECU_ADDRESS 0x3FC62C /end MEASUREMENT
/begin MEASUREMENT lam_soll_verz_2of2_1of5_ "verzoegertes SOLL-Lambda" UWORD FORMULA_0025 0 0 0.0 3.9990 ECU_ADDRESS 0x3FC62E /end MEASUREMENT
/begin MEASUREMENT lam_soll_verz_2of2_2of5_ "verzoegertes SOLL-Lambda" UWORD FORMULA_0025 0 0 0.0 3.9990 ECU_ADDRESS 0x3FC630 /end MEASUREMENT
/begin MEASUREMENT lam_soll_verz_2of2_3of5_ "verzoegertes SOLL-Lambda" UWORD FORMULA_0025 0 0 0.0 3.9990 ECU_ADDRESS 0x3FC632 /end MEASUREMENT
/begin MEASUREMENT lam_soll_verz_2of2_4of5_ "verzoegertes SOLL-Lambda" UWORD FORMULA_0025 0 0 0.0 3.9990 ECU_ADDRESS 0x3FC634 /end MEASUREMENT
/begin MEASUREMENT lam_soll_verz_2of2_5of5_ "verzoegertes SOLL-Lambda" UWORD FORMULA_0025 0 0 0.0 3.9990 ECU_ADDRESS 0x3FC636 /end MEASUREMENT
/begin MEASUREMENT lam_soll_bz_md "md f. Uebergang TL -> VL" SWORD FORMULA_0001 0 0 0.0 100.0000 ECU_ADDRESS 0x3FC638 /end MEASUREMENT
/begin MEASUREMENT lam_soll_tau1_abg "Zeitkonstante Abgassystem u. Sonde" UWORD FORMULA_0762 0 0 0.0 2097.0000 ECU_ADDRESS 0x3FC63A /end MEASUREMENT
/begin MEASUREMENT ml_zyl_verz_1of2_1of5_ "verzoegerte zyl. Luftmasse in mg/ASP" SWORD FORMULA_0093 0 0 -3276.7000 3276.7000 ECU_ADDRESS 0x3FC63C /end MEASUREMENT
/begin MEASUREMENT ml_zyl_verz_1of2_2of5_ "verzoegerte zyl. Luftmasse in mg/ASP" SWORD FORMULA_0093 0 0 -3276.7000 3276.7000 ECU_ADDRESS 0x3FC63E /end MEASUREMENT
/begin MEASUREMENT ml_zyl_verz_1of2_3of5_ "verzoegerte zyl. Luftmasse in mg/ASP" SWORD FORMULA_0093 0 0 -3276.7000 3276.7000 ECU_ADDRESS 0x3FC640 /end MEASUREMENT
/begin MEASUREMENT ml_zyl_verz_1of2_4of5_ "verzoegerte zyl. Luftmasse in mg/ASP" SWORD FORMULA_0093 0 0 -3276.7000 3276.7000 ECU_ADDRESS 0x3FC642 /end MEASUREMENT
/begin MEASUREMENT ml_zyl_verz_1of2_5of5_ "verzoegerte zyl. Luftmasse in mg/ASP" SWORD FORMULA_0093 0 0 -3276.7000 3276.7000 ECU_ADDRESS 0x3FC644 /end MEASUREMENT
/begin MEASUREMENT ml_zyl_verz_2of2_1of5_ "verzoegerte zyl. Luftmasse in mg/ASP" SWORD FORMULA_0093 0 0 -3276.7000 3276.7000 ECU_ADDRESS 0x3FC646 /end MEASUREMENT
/begin MEASUREMENT ml_zyl_verz_2of2_2of5_ "verzoegerte zyl. Luftmasse in mg/ASP" SWORD FORMULA_0093 0 0 -3276.7000 3276.7000 ECU_ADDRESS 0x3FC648 /end MEASUREMENT
/begin MEASUREMENT ml_zyl_verz_2of2_3of5_ "verzoegerte zyl. Luftmasse in mg/ASP" SWORD FORMULA_0093 0 0 -3276.7000 3276.7000 ECU_ADDRESS 0x3FC64A /end MEASUREMENT
/begin MEASUREMENT ml_zyl_verz_2of2_4of5_ "verzoegerte zyl. Luftmasse in mg/ASP" SWORD FORMULA_0093 0 0 -3276.7000 3276.7000 ECU_ADDRESS 0x3FC64C /end MEASUREMENT
/begin MEASUREMENT ml_zyl_verz_2of2_5of5_ "verzoegerte zyl. Luftmasse in mg/ASP" SWORD FORMULA_0093 0 0 -3276.7000 3276.7000 ECU_ADDRESS 0x3FC64E /end MEASUREMENT
/begin MEASUREMENT lam_soll_norm_b1 "SOLL-Lambda - Bezugsgroesse Lambda-SOLL" UWORD FORMULA_0025 0 0 0.0 3.9990 ECU_ADDRESS 0x3FC650 /end MEASUREMENT
/begin MEASUREMENT lam_soll_norm_b2 "SOLL-Lambda - Bezugsgroesse Lambda-SOLL" UWORD FORMULA_0025 0 0 0.0 3.9990 ECU_ADDRESS 0x3FC652 /end MEASUREMENT
/begin MEASUREMENT lam_soll_start "SOLL-Lambda von START -> ML" UWORD FORMULA_0025 0 0 0.0 3.9990 ECU_ADDRESS 0x3FC654 /end MEASUREMENT
/begin MEASUREMENT lam_soll_wf_f "Korrekturfak. f. Zustand Warmlaufbetrieb" UWORD FORMULA_0075 0 0 0.0 4.0000 ECU_ADDRESS 0x3FC656 /end MEASUREMENT
/begin MEASUREMENT lam_soll_ms_kat_soll_max "max. gespeicherte Sauerstoffmasse im KAT" SWORD FORMULA_0093 0 0 -3276.8000 3276.7000 ECU_ADDRESS 0x3FC658 /end MEASUREMENT
/begin MEASUREMENT lam_soll_ms_kat_soll_min "min. gespeicherte Sauerstoffmasse im KAT" SWORD FORMULA_0093 0 0 -3276.8000 3276.7000 ECU_ADDRESS 0x3FC65A /end MEASUREMENT
/begin MEASUREMENT lam_soll_ms_kat_f_obd "Wichtungsfaktor fuer B_KAT_ZUST_PASSIV" UWORD FORMULA_0075 0 0 0.0 4.0000 ECU_ADDRESS 0x3FC65C /end MEASUREMENT
/begin MEASUREMENT lam_ist_mw_korr_b1 "korrigierter Mittelwert IST-Lambda" UWORD FORMULA_0025 0 0 0.0 3.9990 ECU_ADDRESS 0x3FC662 /end MEASUREMENT
/begin MEASUREMENT lam_ist_mw_korr_b2 "korrigierter Mittelwert IST-Lambda" UWORD FORMULA_0025 0 0 0.0 3.9990 ECU_ADDRESS 0x3FC664 /end MEASUREMENT
/begin MEASUREMENT lam_soll_add_kat_alt_f_b1 "Wichtungsfaktor ueber KAT-Alterung" UWORD FORMULA_0075 0 0 0.0 4.0000 ECU_ADDRESS 0x3FC66A /end MEASUREMENT
/begin MEASUREMENT lam_soll_add_kat_alt_f_b2 "Wichtungsfaktor ueber KAT-Alterung" UWORD FORMULA_0075 0 0 0.0 4.0000 ECU_ADDRESS 0x3FC66C /end MEASUREMENT
/begin MEASUREMENT lam_soll_auss_f "Korrekturfak. f. Zustand Sicherheitskonzept" UWORD FORMULA_0075 0 0 0.0 4.0000 ECU_ADDRESS 0x3FC66E /end MEASUREMENT
/begin MEASUREMENT lam_soll_auss_offs "OFFSET auf KATS-Lambda beim SK-Manager" UWORD FORMULA_0025 0 0 0.0 3.9990 ECU_ADDRESS 0x3FC670 /end MEASUREMENT
/begin MEASUREMENT lam_soll_ms_kat_max "MAX. Sauerstoffmasse im KAT" SWORD FORMULA_0093 0 0 -3276.8000 3276.7000 ECU_ADDRESS 0x3FC672 /end MEASUREMENT
/begin MEASUREMENT lam_soll_ms_kat_offs_obd "OFFSET auf min. Sauerstoffmasse im Zustand PASSIV" SWORD FORMULA_0093 0 0 -3276.8000 3276.7000 ECU_ADDRESS 0x3FC674 /end MEASUREMENT
/begin MEASUREMENT lam_soll_ms_kat_trig_sa_b1 "Triggerung SA-Sauerstoffausrauemfunktion" UBYTE FORMULA_0796 0 0 0.0 255.0 ECU_ADDRESS 0x3FC676 /end MEASUREMENT
/begin MEASUREMENT lam_soll_ms_kat_trig_sa_b2 "Triggerung SA-Sauerstoffausrauemfunktion" UBYTE FORMULA_0796 0 0 0.0 255.0 ECU_ADDRESS 0x3FC677 /end MEASUREMENT
/begin MEASUREMENT lam_soll_ms_kat_trig_schw "Schwelle fuer SA-Sauerstoffausrauemfunktion" SWORD FORMULA_0093 0 0 -3276.8000 3276.7000 ECU_ADDRESS 0x3FC678 /end MEASUREMENT
/* ------------------ Abschnitt erzeugt aus lank.dat ------------------ */
/begin CHARACTERISTIC K_LANK_US_TAU_S "schnelle Filterkonstante NKAT-Signal | EN: Fast filter constant, post-cat signal" VALUE 0x7410A TKW_VV_VV_UW 100.0 FORMULA_0838 0.0 257.0000 FORMAT "%5.2" /end CHARACTERISTIC
/begin CHARACTERISTIC K_LANK_US_FILT_UNT "Filterband - untere Schwelle | EN: Filter band - lower threshold [mV]" VALUE 0x7410C TKW_VV_VV_UW 100.0 FORMULA_0532 0.0 1200.0000 /end CHARACTERISTIC
/begin CHARACTERISTIC K_LANK_US_FILT_OB "Filterband - obere Schwelle | EN: Filter band - upper threshold [mV]" VALUE 0x7410E TKW_VV_VV_UW 100.0 FORMULA_0532 0.0 1200.0000 /end CHARACTERISTIC
/begin CHARACTERISTIC K_LANK_US_FILT_T "Einschwingzeit - NKAT-Signal | EN: Settling time - post-cat signal [ms]" VALUE 0x74110 TKW_VV_VV_UW 100.0 FORMULA_0538 0.0 655350.0000 /end CHARACTERISTIC
/begin CHARACTERISTIC K_LANK_US_TAU "Zeitkonstante NKAT-Signal | EN: Time constant, post-cat signal [s]" VALUE 0x74112 TKW_VV_VV_UB 100.0 FORMULA_0664 0.0101 2.5600 /end CHARACTERISTIC
/begin CHARACTERISTIC K_LANK_USF "Fettschwelle fuer verbotenes Band | EN: Rich threshold for forbidden band [mV]" VALUE 0x74114 TKW_VV_VV_UW 100.0 FORMULA_0532 0.0 1200.0000 /end CHARACTERISTIC
/begin CHARACTERISTIC K_LANK_USM "Magerschwelle fuer verbotenes Band | EN: Lean threshold for forbidden band [mV]" VALUE 0x74116 TKW_VV_VV_UW 100.0 FORMULA_0532 0.0 1200.0000 /end CHARACTERISTIC
/begin CHARACTERISTIC K_LANK_FETT "Fettschwelle fuer NKAT-Signal | EN: Rich threshold for post-cat signal [mV]" VALUE 0x74118 TKW_VV_VV_UW 100.0 FORMULA_0532 0.0 1200.0000 /end CHARACTERISTIC
/begin CHARACTERISTIC K_LANK_MAGER "Magerschwelle fuer NKAT-Signal | EN: Lean threshold for post-cat signal [mV]" VALUE 0x7411A TKW_VV_VV_UW 100.0 FORMULA_0532 0.0 1200.0000 /end CHARACTERISTIC
/begin CHARACTERISTIC K_LANK_T_EIN "Einschaltueberwachungszeit NKAT-Signal | EN: Switch-on monitoring time, post-cat signal [s]" VALUE 0x7411C TKW_VV_VV_UW 100.0 FORMULA_0021 0.0 655.0000 FORMAT "%5.2" /end CHARACTERISTIC
/begin CHARACTERISTIC K_LANK_T_AUS "Ausschaltueberwachungszeit NKAT-Signal | EN: Switch-off monitoring time, post-cat signal [s]" VALUE 0x7411E TKW_VV_VV_UW 100.0 FORMULA_0021 0.0 655.0000 FORMAT "%5.2" /end CHARACTERISTIC
/begin CHARACTERISTIC K_LANK_N_MAX "obere n-Schwelle als Ausschaltbedingung | EN: obere n-Schwelle als Ausschaltbedingung" VALUE 0x74120 TKW_VV_VV_SW 100.0 FORMULA_0006 0.0 10000.0000 /end CHARACTERISTIC
/begin CHARACTERISTIC K_LANK_N_MIN "untere n-Schwelle als Ausschaltbedingung | EN: untere n -Schwelle als Ausschaltbedi n-gung" VALUE 0x74122 TKW_VV_VV_SW 100.0 FORMULA_0006 0.0 10000.0000 /end CHARACTERISTIC
/begin CHARACTERISTIC K_LANK_RF_MAX "obere rf-Schwelle als Ausschaltbedingung | EN: obere rf -Schwelle als Ausschaltbedin-gung" VALUE 0x74124 TKW_VV_VV_SW 100.0 FORMULA_0007 0.0 2.0000 FORMAT "%6.3" /end CHARACTERISTIC
/begin CHARACTERISTIC K_LANK_RF_MIN "untere rf-Schwelle als Ausschaltbedingung | EN: untere rf -Schwelle als Ausschaltbedi n-gung" VALUE 0x74126 TKW_VV_VV_SW 100.0 FORMULA_0007 0.0 2.0000 FORMAT "%6.3" /end CHARACTERISTIC
/begin CHARACTERISTIC K_LANK_TKAT_SCHW "Kattemperaturschwelle als Einschaltbedingung | EN: Kattemperaturschwelle als Einschaltb e-dingung" VALUE 0x74128 TKW_VV_VV_SW 100.0 FORMULA_0023 -50.0000 1200.0000 FORMAT "%4.1" /end CHARACTERISTIC
/begin CHARACTERISTIC K_LANK_DIAG_CFG "Freigabe d. elektrischen Diag. NKAT | EN: Freigabe d. elektrischen Diag. NKAT" VALUE 0x7412A TKW_VV_VV_UB 100.0 FORMULA_0839 0.0 1.0 /end CHARACTERISTIC
/begin CHARACTERISTIC K_LANK_DIAG_VK_REG_T "Aktivzeit VKAT-Regler | EN: Aktivzeit VKAT-Regler" VALUE 0x7412C TKW_VV_VV_UW 100.0 FORMULA_0021 0.0 655.0000 FORMAT "%5.2" /end CHARACTERISTIC
/begin CHARACTERISTIC K_LANK_DIAG_TKAT "KAT-Temperaturschwelle | EN: KAT-Temperaturschwelle" VALUE 0x7412E TKW_VV_VV_SW 100.0 FORMULA_0023 -50.0000 1250.0000 FORMAT "%4.1" /end CHARACTERISTIC
/begin CHARACTERISTIC K_LANK_DIAG_SONDTEMP "min. Sondentemperatur | EN: min. Sondentemperatur" VALUE 0x74130 TKW_VV_VV_SW 100.0 FORMULA_0023 -50.0000 1250.0000 FORMAT "%4.1" /end CHARACTERISTIC
/begin CHARACTERISTIC K_LANK_DIAG_STAB_T "Zeitschwelle f. stab. Zustand | EN: Zeitschwelle f. stab. Zustand" VALUE 0x74132 TKW_VV_VV_UW 100.0 FORMULA_0021 0.0 655.0000 FORMAT "%5.2" /end CHARACTERISTIC
/begin CHARACTERISTIC K_LANK_DIAG_MAX_T "Zeitschwelle-NKAT fuer UBATT | EN: Zeitschwelle-NKAT fuer UBATT" VALUE 0x74134 TKW_VV_VV_UW 100.0 FORMULA_0021 0.0 655.0000 FORMAT "%5.2" /end CHARACTERISTIC
/begin CHARACTERISTIC K_LANK_DIAG_GND_T "Zeitschwelle-NKAT fuer GND | EN: Zeitschwelle-NKAT fuer GND" VALUE 0x74136 TKW_VV_VV_UW 100.0 FORMULA_0021 0.0 655.0000 FORMAT "%5.2" /end CHARACTERISTIC
/begin CHARACTERISTIC K_LANK_DIAG_OL_T "Zeitschwelle-NKAT fuer OL | EN: Zeitschwelle-NKAT fuer OL" VALUE 0x74138 TKW_VV_VV_UW 100.0 FORMULA_0062 0.0 65535.0000 /end CHARACTERISTIC
/begin CHARACTERISTIC K_LANK_DIAG_OL_N_MIN "min. n-Schwelle f. OL-Diagnose" VALUE 0x7413A TKW_VV_VV_SW 100.0 FORMULA_0006 0.0 10000.0000 /end CHARACTERISTIC
/begin CHARACTERISTIC K_LANK_DIAG_OL_N_MAX "max. n-Schwelle f. OL-Diagnose | EN: max. n-Schwelle f. OL-Diagnose" VALUE 0x7413C TKW_VV_VV_SW 100.0 FORMULA_0006 0.0 10000.0000 /end CHARACTERISTIC
/begin CHARACTERISTIC K_LANK_DIAG_UMAX "MAX. NKAT-Sondenspannung | EN: MAX. NKAT-Sondenspannung" VALUE 0x7413E TKW_VV_VV_UW 100.0 FORMULA_0532 0.0 1200.0000 /end CHARACTERISTIC
/begin CHARACTERISTIC K_LANK_DIAG_UMIN "MIN. NKAT-Sondenspannung | EN: MIN. NKAT-Sondenspannung" VALUE 0x74140 TKW_VV_VV_UW 100.0 FORMULA_0532 0.0 1200.0000 /end CHARACTERISTIC
/begin CHARACTERISTIC K_LANK_DIAG_OL_LAM_SOLL_M "SOLL-Lambda-Magersprung - OL-Diagnose" VALUE 0x74142 TKW_VV_VV_UW 100.0 FORMULA_0025 0.0 3.9990 FORMAT "%6.3" /end CHARACTERISTIC
/begin CHARACTERISTIC K_LANK_DIAG_OL_ML_MIN "min. Luftmassendurchsatz f. best. Zeit  | EN: min. Luftmassendurchsatz f. best. Zeit" VALUE 0x74144 TKW_VV_VV_SW 100.0 FORMULA_0112 -100.0000 1400.0000 FORMAT "%4.1" /end CHARACTERISTIC
/begin CHARACTERISTIC K_LANK_DIAG_OL_ML_STABIL_T "min. Zeitschwelle f. Luftmassendurchsatz | EN: min. Zeitschwelle f. Luftmassendurchsatz" VALUE 0x74146 TKW_VV_VV_UW 100.0 FORMULA_0062 0.0 65535.0000 /end CHARACTERISTIC
/begin CHARACTERISTIC K_LANK_DIAG_OL_MAGER_T "Zeit fuer MAGERSPRUNG - OL-Diag. | EN: Zeit fuer MAGERSPRUNG - OL-Diag." VALUE 0x74148 TKW_VV_VV_UW 100.0 FORMULA_0062 0.0 65535.0000 /end CHARACTERISTIC
/begin CHARACTERISTIC K_LANK_DIAG_OL_MAGER_CNT "max. Anzahl der MAGERSPRUENGE - OL-Diag. | EN: max. Anzahl der MAGERSPRUENGE - OL-Diag." VALUE 0x7414A TKW_VV_VV_UW 100.0 FORMULA_0010 0.0 65535.0000 /end CHARACTERISTIC
/begin CHARACTERISTIC K_LANK_OBD_S_CFG "Freigabe d. NKAT-Schwingungspr. | EN: 0 inaktiv 1 aktiv Freigabe d. NKAT - Schwingungspr." VALUE 0x7414C TKW_VV_VV_UW 100.0 FORMULA_0798 0.0 1.0 FORMAT "%5.2" /end CHARACTERISTIC
/begin CHARACTERISTIC K_LANK_OBD_S_USF_SA "Fettschwelle f. Aktivierung SA-Diag. | EN: Fettschwelle fuer Aktivierung SA-Diag." VALUE 0x7414E TKW_VV_VV_UW 100.0 FORMULA_0532 0.0 1200.0000 /end CHARACTERISTIC
/begin CHARACTERISTIC K_LANK_OBD_S_USF_WE "Magerschwelle f. Aktivierung WE-Diag." VALUE 0x74150 TKW_VV_VV_UW 100.0 FORMULA_0532 0.0 1200.0000 /end CHARACTERISTIC
/begin CHARACTERISTIC K_LANK_OBD_S_NMAX "obere n-Schwelle als Ausschaltbedingung" VALUE 0x74152 TKW_VV_VV_SW 100.0 FORMULA_0006 0.0 10000.0000 /end CHARACTERISTIC
/begin CHARACTERISTIC K_LANK_OBD_S_NMIN "untere n-Schwelle als Ausschaltbedingung" VALUE 0x74154 TKW_VV_VV_SW 100.0 FORMULA_0006 0.0 10000.0000 /end CHARACTERISTIC
/begin CHARACTERISTIC K_LANK_OBD_S_VL_US "Fehlerschwelle fuer OBD-S-Diag." VALUE 0x74156 TKW_VV_VV_UW 100.0 FORMULA_0532 0.0 1200.0000 /end CHARACTERISTIC
/begin CHARACTERISTIC K_LANK_OBD_S_VL_T "Wartezeit VL - OBD-S-Diag. | EN: Wartezeit VL - OBD-S-Diag." VALUE 0x74158 TKW_VV_VV_UW 100.0 FORMULA_0021 0.0 655.0000 FORMAT "%5.2" /end CHARACTERISTIC
/begin CHARACTERISTIC K_LANK_OBD_S_LAM_VKAT "VKAT-FETT-Schwelle f. VL-S-Diag." VALUE 0x7415A TKW_VV_VV_UW 100.0 FORMULA_0025 0.0 3.9990 FORMAT "%6.3" /end CHARACTERISTIC
/begin CHARACTERISTIC K_LANK_OBD_S_WE_US "Fehlerschwelle fuer OBD-WE-Diag." VALUE 0x7415C TKW_VV_VV_UW 100.0 FORMULA_0532 0.0 1200.0000 /end CHARACTERISTIC
/begin CHARACTERISTIC K_LANK_OBD_S_SA_US "Fehlerschwelle fuer OBD-SA-Diag." VALUE 0x7415E TKW_VV_VV_UW 100.0 FORMULA_0532 0.0 1200.0000 /end CHARACTERISTIC
/begin CHARACTERISTIC K_LANK_OBD_S_SA_T "Wartezeit SCHUBDAUER - OBD-S-Diag." VALUE 0x74160 TKW_VV_VV_UW 100.0 FORMULA_0073 0.0 6553.5000 FORMAT "%4.1" /end CHARACTERISTIC
/begin CHARACTERISTIC K_LANK_OBD_S_TML "min. ML-Zeit" VALUE 0x74162 TKW_VV_VV_UW 100.0 FORMULA_0021 0.0 655.0000 FORMAT "%5.2" /end CHARACTERISTIC
/begin CHARACTERISTIC K_LANK_OBD_S_WE_T "Wartezeit WE - OBD-S-Diag." VALUE 0x74164 TKW_VV_VV_UW 100.0 FORMULA_0073 0.0 6553.5000 FORMAT "%4.1" /end CHARACTERISTIC
/begin CHARACTERISTIC K_LANK_OBD_S_SA_WE_T "max. SCHUBDAUER fuer Schaltvorgang | EN: max. SCHUBDAUER fuer Schaltvorgang" VALUE 0x74166 TKW_VV_VV_UW 100.0 FORMULA_0073 0.0 6553.5000 FORMAT "%4.1" /end CHARACTERISTIC
/begin CHARACTERISTIC K_LANK_OBD_S_WE_LAM_T "max. Zeit in d. zus. Anfettung wirkt - OBD-S-Diag." VALUE 0x74168 TKW_VV_VV_UW 100.0 FORMULA_0073 0.0 6553.5000 FORMAT "%4.1" /end CHARACTERISTIC
/begin CHARACTERISTIC K_LANK_OBD_S_SA_ML_SUM "min. aufsummierte Luftmassenstr. fuer SA-Diag. | EN: min. aufsummierte Luftmassen-str. fuer SA-Diag." VALUE 0x7416A TKW_VV_VV_UW 100.0 FORMULA_0832 0.0 65535.0000 /end CHARACTERISTIC
/begin CHARACTERISTIC K_LANK_OBD_S_SA_AUTOM "Anzahl der Automatikprogramme" VALUE 0x7416C TKW_VV_VV_UB 100.0 FORMULA_0003 0.0 255.0000 /end CHARACTERISTIC
/begin CHARACTERISTIC K_LANK_OBD_S_AUTOM_CNT "Anzahl d.fehlerhafte Diagnosen - Automatikprog." VALUE 0x7416D TKW_VV_VV_UB 100.0 FORMULA_0003 0.0 255.0000 /end CHARACTERISTIC
/begin CHARACTERISTIC K_LANK_OBD_S_CNT "Anzahl d.fehlerhafte Diagnosen" VALUE 0x7416E TKW_VV_VV_UB 100.0 FORMULA_0003 0.0 255.0000 /end CHARACTERISTIC
/begin CHARACTERISTIC K_LANK_OBD_S_WE_CNT "Anzahl durchzufuehrende WE-Diagnosen" VALUE 0x7416F TKW_VV_VV_UB 100.0 FORMULA_0003 0.0 255.0000 /end CHARACTERISTIC
/begin CHARACTERISTIC K_LANK_OBD_SLOPE_F_MAX "Wichtung d. Bezugswertes f. MAX-Schwelle - SLOPE-SA-Diag. | EN: Wichtung d. Bezugswertes f. MAX-Schwelle - SLOPE-SA-Diag." VALUE 0x74170 TKW_VV_VV_UW 100.0 FORMULA_0840 0.0 100.0000 FORMAT "%4.1" /end CHARACTERISTIC
/begin CHARACTERISTIC K_LANK_OBD_SLOPE_F_MIN "Wichtung d. Bezugswertes f. MIN-Schwelle - SLOPE-SA-Diag. | EN: Wichtung d. Bezugswertes f. MIN-Schwelle - SLOPE-SA-Diag." VALUE 0x74172 TKW_VV_VV_UW 100.0 FORMULA_0840 0.0 100.0000 FORMAT "%4.1" /end CHARACTERISTIC
/begin CHARACTERISTIC K_LANK_OBD_SLOPE_HYS "Hysterese fuer  | EN: Hysterese fuer" VALUE 0x74174 TKW_VV_VV_SW 100.0 FORMULA_0532 0.0 100.0000 /end CHARACTERISTIC
/begin CHARACTERISTIC K_LANK_OBD_SLOPE_CNT_IO "Anzahl i.O. Slope-Diagnosen im DCY | EN: Anzahl i.O. Slope-Diagnosen im DCY" VALUE 0x74176 TKW_VV_VV_UB 100.0 FORMULA_0003 0.0 255.0000 /end CHARACTERISTIC
/begin CHARACTERISTIC K_LANK_OBD_SLOPE_CNT "Anzahl d. gueltigen Messungen" VALUE 0x74177 TKW_VV_VV_UB 100.0 FORMULA_0003 0.0 255.0000 /end CHARACTERISTIC
/begin CHARACTERISTIC K_LANK_OBD_SLOPE_NASE_CNT "NASE-Ermittlung ueber X-Messungen" VALUE 0x74178 TKW_VV_VV_UB 100.0 FORMULA_0003 0.0 255.0000 /end CHARACTERISTIC
/begin CHARACTERISTIC K_LANK_OBD_S_USF_SLOPE_MAX "max. Fettschwelle f. Freigabe d. SLOPE-Diag. | EN: Max. Fettschwelle fuer Freigabe d. SLOPE-Diag." VALUE 0x7417A TKW_VV_VV_UW 100.0 FORMULA_0532 0.0 1200.0000 /end CHARACTERISTIC
/begin CHARACTERISTIC K_LANK_OBD_SLOPE_T_MAX_MODE5 "max. Schwelle SLOPE-Zeit f. MODE 5/6" VALUE 0x7417C TKW_VV_VV_UW 100.0 FORMULA_0538 0.0 655350.0000 /end CHARACTERISTIC
/begin CHARACTERISTIC K_LANK_OBD_SLOPE_T_MIN_MODE5 "min. Schwelle SLOPE-Zeit f. MODE 5/6" VALUE 0x7417E TKW_VV_VV_UW 100.0 FORMULA_0538 0.0 655350.0000 /end CHARACTERISTIC
/begin CHARACTERISTIC K_LANK_OBD_S_SA_T_MAX_MODE6 "max. Abfallszeit des NKAT-Signals in SA f. MODE 6" VALUE 0x74180 TKW_VV_VV_UW 100.0 FORMULA_0539 0.0 6553500.0000 /end CHARACTERISTIC
/begin CHARACTERISTIC K_LANK_OBD_S_SA_T_MIN_MODE6 "min. Abfallszeit des NKAT-Signals in SA f. MODE 6 | EN: Min. Abfallszeit des NKAT -Signals in SA f. MODE 6" VALUE 0x74182 TKW_VV_VV_UW 100.0 FORMULA_0539 0.0 6553500.0000 /end CHARACTERISTIC
/begin CHARACTERISTIC K_LANK_OBD_S_SA_T_MODE6_FALSE "fehlerhafte Abfallszeit des NKAT-Signals in SA f. MODE 6 | EN: fehlerhafte Abfallszeit des NKAT-Signals in SA f. MODE 6" VALUE 0x74184 TKW_VV_VV_UW 100.0 FORMULA_0539 0.0 6553500.0000 /end CHARACTERISTIC
/begin CHARACTERISTIC KL_KAT_OBD_LANK_LAM "Lambda der NKAT-Sonde | EN: Lambda from post-cat sensor" CURVE 0x74186 TKL_UW_VV_UW 100.0 FORMULA_0025 0.0 3.9990 /begin AXIS_DESCR STD_AXIS lank_us FORMULA_0532 16 0.0 1200.0000 /end AXIS_DESCR FORMAT "%6.3" /end CHARACTERISTIC
/begin CHARACTERISTIC KL_LANK_OBD_S_WE_ML_SUM "min. aufsummierte Luftmassenstr. fuer. WE-Diag." CURVE 0x741C8 TKL_SW_VV_UW 100.0 FORMULA_0832 0.0 65535.0000 /begin AXIS_DESCR STD_AXIS n FORMULA_0006 4 0.0 10000.0000 /end AXIS_DESCR /end CHARACTERISTIC
/begin CHARACTERISTIC KL_LANK_OBD_SLOPE_ML_T "SLOPE-Zeit fuer SA-Diagnose" CURVE 0x741DA TKL_UW_VV_UW 100.0 FORMULA_0538 0.0 655350.0000 /begin AXIS_DESCR STD_AXIS mzyl_ml_sum_sa FORMULA_0832 5 0.0 65535.0000 /end AXIS_DESCR /end CHARACTERISTIC
/begin CHARACTERISTIC KF_LANK_US_TAU_L "langsame Filterkonstante NKAT-Signal | EN: Slow filter constant, post-cat sensor signal" MAP 0x741F0 TKF_SW_SW_UW 100.0 FORMULA_0838 0.0 257.0000 /begin AXIS_DESCR STD_AXIS n FORMULA_0006 4 0.0 10000.0000 /end AXIS_DESCR /begin AXIS_DESCR STD_AXIS rf FORMULA_0007 4 0.0 2.0000 FORMAT "%6.3" /end AXIS_DESCR FORMAT "%5.2" /end CHARACTERISTIC
/begin CHARACTERISTIC KF_LANK_OBD_S_LAM_SOLL "OFFSET SOLL-Lambda - zusaetzliche WE-Anfettung" MAP 0x74222 TKF_SW_SW_SW 100.0 FORMULA_0025 -2.0000 0.0 /begin AXIS_DESCR STD_AXIS n FORMULA_0006 6 0.0 10000.0000 /end AXIS_DESCR /begin AXIS_DESCR STD_AXIS rf FORMULA_0007 6 0.0 2.0000 FORMAT "%6.3" /end AXIS_DESCR FORMAT "%6.3" /end CHARACTERISTIC
/begin MEASUREMENT lank_ad_b1 "AD-Wert des NKAT-Signals" UWORD FORMULA_0532 0 0 0.0 1200.0000 ECU_ADDRESS 0x3FC6D6 /end MEASUREMENT
/begin MEASUREMENT lank_ad_b2 "AD-Wert des NKAT-Signals" UWORD FORMULA_0532 0 0 0.0 1200.0000 ECU_ADDRESS 0x3FC6D8 /end MEASUREMENT
/begin MEASUREMENT lank_us_b1 "NKAT-Sondensignal" UWORD FORMULA_0532 0 0 0.0 1200.0000 ECU_ADDRESS 0x3FC6DA /end MEASUREMENT
/begin MEASUREMENT lank_us_b2 "NKAT-Sondensignal" UWORD FORMULA_0532 0 0 0.0 1200.0000 ECU_ADDRESS 0x3FC6DC /end MEASUREMENT
/begin MEASUREMENT lank_us_filt_b1 "gefiltertes NKAT-Signal f. NKAT-Regler" UWORD FORMULA_0532 0 0 0.0 1200.0000 ECU_ADDRESS 0x3FC6DE /end MEASUREMENT
/begin MEASUREMENT lank_us_filt_b2 "gefiltertes NKAT-Signal f. NKAT-Regler" UWORD FORMULA_0532 0 0 0.0 1200.0000 ECU_ADDRESS 0x3FC6E0 /end MEASUREMENT
/begin MEASUREMENT lank_sgn_b1 "NKAT-Signallage" UBYTE FORMULA_0808 0 0 0.0 255.0 ECU_ADDRESS 0x3FC6E2 BIT_MASK 0x3 /end MEASUREMENT
/begin MEASUREMENT lank_sgn_b2 "NKAT-Signallage" UBYTE FORMULA_0808 0 0 0.0 255.0 ECU_ADDRESS 0x3FC6E3 BIT_MASK 0x3 /end MEASUREMENT
/begin MEASUREMENT lank_lam_b1 "NKAT-Lambdawert" UWORD FORMULA_0025 0 0 0.0 3.9990 ECU_ADDRESS 0x3FC6E4 /end MEASUREMENT
/begin MEASUREMENT lank_lam_b2 "NKAT-Lambdawert" UWORD FORMULA_0025 0 0 0.0 3.9990 ECU_ADDRESS 0x3FC6E6 /end MEASUREMENT
/begin MEASUREMENT lank_st_ein_b1 "NKAT-Status EIN-Bedingungen" UWORD FORMULA_0083 0 0 0.0 65535.0000 ECU_ADDRESS 0x3FC6E8 /end MEASUREMENT
/begin MEASUREMENT lank_st_ein_b2 "NKAT-Status EIN-Bedingungen" UWORD FORMULA_0083 0 0 0.0 65535.0000 ECU_ADDRESS 0x3FC6EA /end MEASUREMENT
/begin MEASUREMENT lank_st_sonde_b1 "Betriebsbereitschaft NKAT-Sonde" UWORD FORMULA_0809 0 0 0.0 65535.0 ECU_ADDRESS 0x3FC6E8 BIT_MASK 0xF /end MEASUREMENT
/begin MEASUREMENT lank_st_sonde_b2 "Betriebsbereitschaft NKAT-Sonde" UWORD FORMULA_0809 0 0 0.0 65535.0 ECU_ADDRESS 0x3FC6EA BIT_MASK 0xF /end MEASUREMENT
/begin MEASUREMENT lank_st_us_tau_t_b1 "Einschwingzeit fuer NKAT-Regler" UWORD FORMULA_0810 0 0 0.0 65535.0 ECU_ADDRESS 0x3FC6E8 BIT_MASK 0x10 /end MEASUREMENT
/begin MEASUREMENT lank_st_us_tau_t_b2 "Einschwingzeit fuer NKAT-Regler" UWORD FORMULA_0810 0 0 0.0 65535.0 ECU_ADDRESS 0x3FC6EA BIT_MASK 0x10 /end MEASUREMENT
/begin MEASUREMENT lank_st_aus_b1 "NKAT-Status AUS-Bedingungen" UWORD FORMULA_0083 0 0 0.0 65535.0000 ECU_ADDRESS 0x3FC6EC /end MEASUREMENT
/begin MEASUREMENT lank_st_aus_b2 "NKAT-Status AUS-Bedingungen" UWORD FORMULA_0083 0 0 0.0 65535.0000 ECU_ADDRESS 0x3FC6EE /end MEASUREMENT
/begin MEASUREMENT lank_st_aus_n_b1 "N-Schwelle verletzt" UWORD FORMULA_0811 0 0 0.0 65535.0 ECU_ADDRESS 0x3FC6EC BIT_MASK 0x1 /end MEASUREMENT
/begin MEASUREMENT lank_st_aus_n_b2 "N-Schwelle verletzt" UWORD FORMULA_0811 0 0 0.0 65535.0 ECU_ADDRESS 0x3FC6EE BIT_MASK 0x1 /end MEASUREMENT
/begin MEASUREMENT lank_st_aus_rf_b1 "RF-Schwelle verletzt" UWORD FORMULA_0812 0 0 0.0 65535.0 ECU_ADDRESS 0x3FC6EC BIT_MASK 0x2 /end MEASUREMENT
/begin MEASUREMENT lank_st_aus_rf_b2 "RF-Schwelle verletzt" UWORD FORMULA_0812 0 0 0.0 65535.0 ECU_ADDRESS 0x3FC6EE BIT_MASK 0x2 /end MEASUREMENT
/begin MEASUREMENT lank_st_aus_tkat_b1 "TKAT-Schwelle verletzt" UWORD FORMULA_0813 0 0 0.0 65535.0 ECU_ADDRESS 0x3FC6EC BIT_MASK 0x4 /end MEASUREMENT
/begin MEASUREMENT lank_st_aus_tkat_b2 "TKAT-Schwelle verletzt" UWORD FORMULA_0813 0 0 0.0 65535.0 ECU_ADDRESS 0x3FC6EE BIT_MASK 0x4 /end MEASUREMENT
/begin MEASUREMENT lank_st_aus_diag_b1 "Diag.Fehler vorhanden" UWORD FORMULA_0814 0 0 0.0 65535.0 ECU_ADDRESS 0x3FC6EC BIT_MASK 0x8 /end MEASUREMENT
/begin MEASUREMENT lank_st_aus_diag_b2 "Diag.Fehler vorhanden" UWORD FORMULA_0814 0 0 0.0 65535.0 ECU_ADDRESS 0x3FC6EE BIT_MASK 0x8 /end MEASUREMENT
/begin MEASUREMENT lank_diag_st_b1 "NKAT-Diag.-Status" UWORD FORMULA_0083 0 0 0.0 65535.0000 ECU_ADDRESS 0x3FC6F0 /end MEASUREMENT
/begin MEASUREMENT lank_diag_st_b2 "NKAT-Diag.-Status" UWORD FORMULA_0083 0 0 0.0 65535.0000 ECU_ADDRESS 0x3FC6F2 /end MEASUREMENT
/begin MEASUREMENT lank_diag_sh_to_ub_b1 "SH_TO_UB erkannt" UWORD FORMULA_0815 0 0 0.0 65535.0 ECU_ADDRESS 0x3FC6F0 BIT_MASK 0x1 /end MEASUREMENT
/begin MEASUREMENT lank_diag_sh_to_ub_b2 "SH_TO_UB erkannt" UWORD FORMULA_0815 0 0 0.0 65535.0 ECU_ADDRESS 0x3FC6F2 BIT_MASK 0x1 /end MEASUREMENT
/begin MEASUREMENT lank_diag_sh_to_gnd_b1 "SH_TO_GND erkannt" UWORD FORMULA_0816 0 0 0.0 65535.0 ECU_ADDRESS 0x3FC6F0 BIT_MASK 0x2 /end MEASUREMENT
/begin MEASUREMENT lank_diag_sh_to_gnd_b2 "SH_TO_GND erkannt" UWORD FORMULA_0816 0 0 0.0 65535.0 ECU_ADDRESS 0x3FC6F2 BIT_MASK 0x2 /end MEASUREMENT
/begin MEASUREMENT lank_diag_ol_b1 "OPENLOAD erkannt" UWORD FORMULA_0817 0 0 0.0 65535.0 ECU_ADDRESS 0x3FC6F0 BIT_MASK 0x4 /end MEASUREMENT
/begin MEASUREMENT lank_diag_ol_b2 "OPENLOAD erkannt" UWORD FORMULA_0817 0 0 0.0 65535.0 ECU_ADDRESS 0x3FC6F2 BIT_MASK 0x4 /end MEASUREMENT
/begin MEASUREMENT lank_diag_temp_b1 "min. Sondentemperatur erreicht" UWORD FORMULA_0818 0 0 0.0 65535.0 ECU_ADDRESS 0x3FC6F0 BIT_MASK 0x8 /end MEASUREMENT
/begin MEASUREMENT lank_diag_temp_b2 "min. Sondentemperatur erreicht" UWORD FORMULA_0818 0 0 0.0 65535.0 ECU_ADDRESS 0x3FC6F2 BIT_MASK 0x8 /end MEASUREMENT
/begin MEASUREMENT lank_diag_stab_b1 "Sondensignal stabil" UWORD FORMULA_0819 0 0 0.0 65535.0 ECU_ADDRESS 0x3FC6F0 BIT_MASK 0x10 /end MEASUREMENT
/begin MEASUREMENT lank_diag_stab_b2 "Sondensignal stabil" UWORD FORMULA_0819 0 0 0.0 65535.0 ECU_ADDRESS 0x3FC6F2 BIT_MASK 0x10 /end MEASUREMENT
/begin MEASUREMENT lank_diag_ol_ml_min_b1 "min. Luftmassendurchsatz erreicht" UWORD FORMULA_0820 0 0 0.0 65535.0 ECU_ADDRESS 0x3FC6F0 BIT_MASK 0x100 /end MEASUREMENT
/begin MEASUREMENT lank_diag_ol_ml_min_b2 "min. Luftmassendurchsatz erreicht" UWORD FORMULA_0820 0 0 0.0 65535.0 ECU_ADDRESS 0x3FC6F2 BIT_MASK 0x100 /end MEASUREMENT
/begin MEASUREMENT lank_diag_ol_mager_puls_b1 "OL-Diag.-MAGER-Puls" UWORD FORMULA_0821 0 0 0.0 65535.0 ECU_ADDRESS 0x3FC6F0 BIT_MASK 0x200 /end MEASUREMENT
/begin MEASUREMENT lank_diag_ol_mager_puls_b2 "OL-Diag.-MAGER-Puls" UWORD FORMULA_0821 0 0 0.0 65535.0 ECU_ADDRESS 0x3FC6F2 BIT_MASK 0x200 /end MEASUREMENT
/begin MEASUREMENT lank_diag_ol_band_b1 "OL-Diag. - Zeit innerhalb verbotenen Band" UWORD FORMULA_0062 0 0 0.0 65535.0000 ECU_ADDRESS 0x3FC6F4 /end MEASUREMENT
/begin MEASUREMENT lank_diag_ol_band_b2 "OL-Diag. - Zeit innerhalb verbotenen Band" UWORD FORMULA_0062 0 0 0.0 65535.0000 ECU_ADDRESS 0x3FC6F6 /end MEASUREMENT
/begin MEASUREMENT lank_diag_ol_mager_cnt_b1 "OL-Diag. - Anzahl der MAGERSPRUENGE" UWORD FORMULA_0010 0 0 0.0 65535.0000 ECU_ADDRESS 0x3FC6F8 /end MEASUREMENT
/begin MEASUREMENT lank_diag_ol_mager_cnt_b2 "OL-Diag. - Anzahl der MAGERSPRUENGE" UWORD FORMULA_0010 0 0 0.0 65535.0000 ECU_ADDRESS 0x3FC6FA /end MEASUREMENT
/begin MEASUREMENT lank_diag_ol_aussen_b1 "OL-Diag. - Zeit ausserhalb verbotenen Band" UWORD FORMULA_0062 0 0 0.0 65535.0000 ECU_ADDRESS 0x3FC6FC /end MEASUREMENT
/begin MEASUREMENT lank_diag_ol_aussen_b2 "OL-Diag. - Zeit ausserhalb verbotenen Band" UWORD FORMULA_0062 0 0 0.0 65535.0000 ECU_ADDRESS 0x3FC6FE /end MEASUREMENT
/begin MEASUREMENT lank_obd_s_st_b1 "NKAT-OBD-S-Diag.-Status" UWORD FORMULA_0083 0 0 0.0 65535.0000 ECU_ADDRESS 0x3FC700 /end MEASUREMENT
/begin MEASUREMENT lank_obd_s_st_b2 "NKAT-OBD-S-Diag.-Status" UWORD FORMULA_0083 0 0 0.0 65535.0000 ECU_ADDRESS 0x3FC702 /end MEASUREMENT
/begin MEASUREMENT lank_obd_s_diag_b1 "S-Diag. Zustand" UWORD FORMULA_0822 0 0 0.0 65535.0 ECU_ADDRESS 0x3FC700 BIT_MASK 0x1 /end MEASUREMENT
/begin MEASUREMENT lank_obd_s_diag_b2 "S-Diag. Zustand" UWORD FORMULA_0822 0 0 0.0 65535.0 ECU_ADDRESS 0x3FC702 BIT_MASK 0x1 /end MEASUREMENT
/begin MEASUREMENT lank_obd_s_bed_b1 "S-Diag.-Ende" UWORD FORMULA_0823 0 0 0.0 65535.0 ECU_ADDRESS 0x3FC700 BIT_MASK 0x2 /end MEASUREMENT
/begin MEASUREMENT lank_obd_s_bed_b2 "S-Diag.-Ende" UWORD FORMULA_0823 0 0 0.0 65535.0 ECU_ADDRESS 0x3FC702 BIT_MASK 0x2 /end MEASUREMENT
/begin MEASUREMENT lank_obd_s_sa_diag_b1 "SA-Diagnose" UWORD FORMULA_0768 0 0 0.0 65535.0 ECU_ADDRESS 0x3FC700 BIT_MASK 0x4 /end MEASUREMENT
/begin MEASUREMENT lank_obd_s_sa_diag_b2 "SA-Diagnose" UWORD FORMULA_0768 0 0 0.0 65535.0 ECU_ADDRESS 0x3FC702 BIT_MASK 0x4 /end MEASUREMENT
/begin MEASUREMENT lank_obd_s_sa_phase_b1 "definierte SA-Phase" UWORD FORMULA_0824 0 0 0.0 65535.0 ECU_ADDRESS 0x3FC700 BIT_MASK 0x8 /end MEASUREMENT
/begin MEASUREMENT lank_obd_s_sa_phase_b2 "definierte SA-Phase" UWORD FORMULA_0824 0 0 0.0 65535.0 ECU_ADDRESS 0x3FC702 BIT_MASK 0x8 /end MEASUREMENT
/begin MEASUREMENT lank_obd_s_we_diag_b1 "WE-Diagnose" UWORD FORMULA_0770 0 0 0.0 65535.0 ECU_ADDRESS 0x3FC700 BIT_MASK 0x10 /end MEASUREMENT
/begin MEASUREMENT lank_obd_s_we_diag_b2 "WE-Diagnose" UWORD FORMULA_0770 0 0 0.0 65535.0 ECU_ADDRESS 0x3FC702 BIT_MASK 0x10 /end MEASUREMENT
/begin MEASUREMENT lank_obd_s_we_time_b1 "WE-Wartezeit ohne Anfettung" UWORD FORMULA_0825 0 0 0.0 65535.0 ECU_ADDRESS 0x3FC700 BIT_MASK 0x20 /end MEASUREMENT
/begin MEASUREMENT lank_obd_s_we_time_b2 "WE-Wartezeit ohne Anfettung" UWORD FORMULA_0825 0 0 0.0 65535.0 ECU_ADDRESS 0x3FC702 BIT_MASK 0x20 /end MEASUREMENT
/begin MEASUREMENT lank_obd_s_we_lam_time_b1 "WE-Wartezeit mit Anfettung" UWORD FORMULA_0826 0 0 0.0 65535.0 ECU_ADDRESS 0x3FC700 BIT_MASK 0x40 /end MEASUREMENT
/begin MEASUREMENT lank_obd_s_we_lam_time_b2 "WE-Wartezeit mit Anfettung" UWORD FORMULA_0826 0 0 0.0 65535.0 ECU_ADDRESS 0x3FC702 BIT_MASK 0x40 /end MEASUREMENT
/begin MEASUREMENT lank_obd_s_vl_diag_b1 "VL-Diagnose" UWORD FORMULA_0827 0 0 0.0 65535.0 ECU_ADDRESS 0x3FC700 BIT_MASK 0x80 /end MEASUREMENT
/begin MEASUREMENT lank_obd_s_vl_diag_b2 "VL-Diagnose" UWORD FORMULA_0827 0 0 0.0 65535.0 ECU_ADDRESS 0x3FC702 BIT_MASK 0x80 /end MEASUREMENT
/begin MEASUREMENT lank_obd_s_usf_sa_b1 "Signallage fuer SA-Diag" UWORD FORMULA_0828 0 0 0.0 65535.0 ECU_ADDRESS 0x3FC700 BIT_MASK 0x100 /end MEASUREMENT
/begin MEASUREMENT lank_obd_s_usf_sa_b2 "Signallage fuer SA-Diag" UWORD FORMULA_0828 0 0 0.0 65535.0 ECU_ADDRESS 0x3FC702 BIT_MASK 0x100 /end MEASUREMENT
/begin MEASUREMENT lank_obd_s_usf_we_b1 "Signallage fuer WE-Diag" UWORD FORMULA_0829 0 0 0.0 65535.0 ECU_ADDRESS 0x3FC700 BIT_MASK 0x200 /end MEASUREMENT
/begin MEASUREMENT lank_obd_s_usf_we_b2 "Signallage fuer WE-Diag" UWORD FORMULA_0829 0 0 0.0 65535.0 ECU_ADDRESS 0x3FC702 BIT_MASK 0x200 /end MEASUREMENT
/begin MEASUREMENT lank_obd_s_sa_we_b1 "Erkennung auf WE" UWORD FORMULA_0830 0 0 0.0 65535.0 ECU_ADDRESS 0x3FC700 BIT_MASK 0x800 /end MEASUREMENT
/begin MEASUREMENT lank_obd_s_sa_we_b2 "Erkennung auf WE" UWORD FORMULA_0830 0 0 0.0 65535.0 ECU_ADDRESS 0x3FC702 BIT_MASK 0x800 /end MEASUREMENT
/begin MEASUREMENT lank_obd_s_sa_schalt_b1 "Erkennung auf Schaltvorgang" UWORD FORMULA_0831 0 0 0.0 65535.0 ECU_ADDRESS 0x3FC700 BIT_MASK 0x1000 /end MEASUREMENT
/begin MEASUREMENT lank_obd_s_sa_schalt_b2 "Erkennung auf Schaltvorgang" UWORD FORMULA_0831 0 0 0.0 65535.0 ECU_ADDRESS 0x3FC702 BIT_MASK 0x1000 /end MEASUREMENT
/begin MEASUREMENT lank_obd_s_cnt_b1 "Zaehler fehlerhafte Diagnose" UBYTE FORMULA_0003 0 0 0.0 255.0000 ECU_ADDRESS 0x3FC704 /end MEASUREMENT
/begin MEASUREMENT lank_obd_s_cnt_b2 "Zaehler fehlerhafte Diagnose" UBYTE FORMULA_0003 0 0 0.0 255.0000 ECU_ADDRESS 0x3FC705 /end MEASUREMENT
/begin MEASUREMENT lank_obd_s_cnt_ausw_b1 "Zaehlerschwelle f. fehlerhafte Diagnose" UBYTE FORMULA_0003 0 0 0.0 255.0000 ECU_ADDRESS 0x3FC706 /end MEASUREMENT
/begin MEASUREMENT lank_obd_s_cnt_ausw_b2 "Zaehlerschwelle f. fehlerhafte Diagnose" UBYTE FORMULA_0003 0 0 0.0 255.0000 ECU_ADDRESS 0x3FC707 /end MEASUREMENT
/begin MEASUREMENT lank_obd_s_lam_soll_b1 "LAM-SOLL-OFFSET - zusaetzliche Anfettung" SWORD FORMULA_0025 0 0 -2.0000 1.9990 ECU_ADDRESS 0x3FC708 /end MEASUREMENT
/begin MEASUREMENT lank_obd_s_lam_soll_b2 "LAM-SOLL-OFFSET - zusaetzliche Anfettung" SWORD FORMULA_0025 0 0 -2.0000 1.9990 ECU_ADDRESS 0x3FC70A /end MEASUREMENT
/begin MEASUREMENT lank_obd_s_we_cnt_b1 "Zaehler - durchgefuehrte WE-Diagnosen" UBYTE FORMULA_0003 0 0 0.0 255.0000 ECU_ADDRESS 0x3FC70C /end MEASUREMENT
/begin MEASUREMENT lank_obd_s_we_cnt_b2 "Zaehler - durchgefuehrte WE-Diagnosen" UBYTE FORMULA_0003 0 0 0.0 255.0000 ECU_ADDRESS 0x3FC70D /end MEASUREMENT
/begin MEASUREMENT lank_obd_s_we_ml_sum_b1 "min. aufsummierte Luftmassenstr. fuer. WE-Diag." UWORD FORMULA_0832 0 0 0.0 65535.0000 ECU_ADDRESS 0x3FC70E /end MEASUREMENT
/begin MEASUREMENT lank_obd_s_we_ml_sum_b2 "min. aufsummierte Luftmassenstr. fuer. WE-Diag." UWORD FORMULA_0832 0 0 0.0 65535.0000 ECU_ADDRESS 0x3FC710 /end MEASUREMENT
/begin MEASUREMENT lank_obd_slope_st_b1 "NKAT-SLOPE-Diag.-Status" UWORD FORMULA_0083 0 0 0.0 65535.0000 ECU_ADDRESS 0x3FC712 /end MEASUREMENT
/begin MEASUREMENT lank_obd_slope_st_b2 "NKAT-SLOPE-Diag.-Status" UWORD FORMULA_0083 0 0 0.0 65535.0000 ECU_ADDRESS 0x3FC714 /end MEASUREMENT
/begin MEASUREMENT lank_obd_slope_sa_max_schw_b1 "MAX-Schwelle f. Messfenster" UWORD FORMULA_0833 0 0 0.0 65535.0 ECU_ADDRESS 0x3FC712 BIT_MASK 0x1 /end MEASUREMENT
/begin MEASUREMENT lank_obd_slope_sa_max_schw_b2 "MAX-Schwelle f. Messfenster" UWORD FORMULA_0833 0 0 0.0 65535.0 ECU_ADDRESS 0x3FC714 BIT_MASK 0x1 /end MEASUREMENT
/begin MEASUREMENT lank_obd_slope_sa_min_schw_b1 "MIN-Schwelle f. Messfenster" UWORD FORMULA_0834 0 0 0.0 65535.0 ECU_ADDRESS 0x3FC712 BIT_MASK 0x2 /end MEASUREMENT
/begin MEASUREMENT lank_obd_slope_sa_min_schw_b2 "MIN-Schwelle f. Messfenster" UWORD FORMULA_0834 0 0 0.0 65535.0 ECU_ADDRESS 0x3FC714 BIT_MASK 0x2 /end MEASUREMENT
/begin MEASUREMENT lank_obd_slope_sa_nase_b1 "NASE im SA-Sondenverlauf" UWORD FORMULA_0835 0 0 0.0 65535.0 ECU_ADDRESS 0x3FC712 BIT_MASK 0x4 /end MEASUREMENT
/begin MEASUREMENT lank_obd_slope_sa_nase_b2 "NASE im SA-Sondenverlauf" UWORD FORMULA_0835 0 0 0.0 65535.0 ECU_ADDRESS 0x3FC714 BIT_MASK 0x4 /end MEASUREMENT
/begin MEASUREMENT lank_obd_slope_sa_aktiv_b1 "SLOPE-Diagnose ist aktiv" UWORD FORMULA_0836 0 0 0.0 65535.0 ECU_ADDRESS 0x3FC712 BIT_MASK 0x8 /end MEASUREMENT
/begin MEASUREMENT lank_obd_slope_sa_aktiv_b2 "SLOPE-Diagnose ist aktiv" UWORD FORMULA_0836 0 0 0.0 65535.0 ECU_ADDRESS 0x3FC714 BIT_MASK 0x8 /end MEASUREMENT
/begin MEASUREMENT lank_obd_slope_sa_usf_io_b1 "SLOPE-Diag.- Ausgangspunkt NKAT-Sonde" UWORD FORMULA_0837 0 0 0.0 65535.0 ECU_ADDRESS 0x3FC712 BIT_MASK 0x10 /end MEASUREMENT
/begin MEASUREMENT lank_obd_slope_sa_usf_io_b2 "SLOPE-Diag.- Ausgangspunkt NKAT-Sonde" UWORD FORMULA_0837 0 0 0.0 65535.0 ECU_ADDRESS 0x3FC714 BIT_MASK 0x10 /end MEASUREMENT
/begin MEASUREMENT lank_us_old_slope_b1 "NKAT-Sondensignal-(n-1) f. SLOPE Diag." UWORD FORMULA_0532 0 0 0.0 1200.0000 ECU_ADDRESS 0x3FC716 /end MEASUREMENT
/begin MEASUREMENT lank_us_old_slope_b2 "NKAT-Sondensignal-(n-1) f. SLOPE Diag." UWORD FORMULA_0532 0 0 0.0 1200.0000 ECU_ADDRESS 0x3FC718 /end MEASUREMENT
/begin MEASUREMENT lank_obd_slope_sa_bezug_b1 "Bezugswert fuer SLOPE-SA-Diagnose" UWORD FORMULA_0532 0 0 0.0 1200.0000 ECU_ADDRESS 0x3FC71A /end MEASUREMENT
/begin MEASUREMENT lank_obd_slope_sa_bezug_b2 "Bezugswert fuer SLOPE-SA-Diagnose" UWORD FORMULA_0532 0 0 0.0 1200.0000 ECU_ADDRESS 0x3FC71C /end MEASUREMENT
/begin MEASUREMENT lank_obd_slope_sa_max_b1 "MAX-Schwelle fuer SLOPE-SA-Diagnose" UWORD FORMULA_0532 0 0 0.0 1200.0000 ECU_ADDRESS 0x3FC71E /end MEASUREMENT
/begin MEASUREMENT lank_obd_slope_sa_max_b2 "MAX-Schwelle fuer SLOPE-SA-Diagnose" UWORD FORMULA_0532 0 0 0.0 1200.0000 ECU_ADDRESS 0x3FC720 /end MEASUREMENT
/begin MEASUREMENT lank_obd_slope_sa_min_b1 "MIN-Schwelle fuer SLOPE-SA-Diagnose" UWORD FORMULA_0532 0 0 0.0 1200.0000 ECU_ADDRESS 0x3FC722 /end MEASUREMENT
/begin MEASUREMENT lank_obd_slope_sa_min_b2 "MIN-Schwelle fuer SLOPE-SA-Diagnose" UWORD FORMULA_0532 0 0 0.0 1200.0000 ECU_ADDRESS 0x3FC724 /end MEASUREMENT
/begin MEASUREMENT lank_obd_slope_t_b1 "SLOPE-Zeit - SA-Diagnose" UWORD FORMULA_0538 0 0 0.0 655350.0000 ECU_ADDRESS 0x3FC726 /end MEASUREMENT
/begin MEASUREMENT lank_obd_slope_t_b2 "SLOPE-Zeit - SA-Diagnose" UWORD FORMULA_0538 0 0 0.0 655350.0000 ECU_ADDRESS 0x3FC728 /end MEASUREMENT
/begin MEASUREMENT lank_obd_slope_t_mw_b1 "Mittelwert de. SLOPE-Zeiten - SA-Diagnose" UWORD FORMULA_0538 0 0 0.0 655350.0000 ECU_ADDRESS 0x3FC72A /end MEASUREMENT
/begin MEASUREMENT lank_obd_slope_t_mw_b2 "Mittelwert de. SLOPE-Zeiten - SA-Diagnose" UWORD FORMULA_0538 0 0 0.0 655350.0000 ECU_ADDRESS 0x3FC72C /end MEASUREMENT
/begin MEASUREMENT lank_obd_slope_cnt_b1 "Anzahl gueltiger SLOPE-Messungen" UBYTE FORMULA_0003 0 0 0.0 255.0000 ECU_ADDRESS 0x3FC72E /end MEASUREMENT
/begin MEASUREMENT lank_obd_slope_cnt_b2 "Anzahl gueltiger SLOPE-Messungen" UBYTE FORMULA_0003 0 0 0.0 255.0000 ECU_ADDRESS 0x3FC72F /end MEASUREMENT
/begin MEASUREMENT lank_obd_slope_cnt_io_b1 "Anzahl i.O. Slope-Diagnosen" UBYTE FORMULA_0003 0 0 0.0 255.0000 ECU_ADDRESS 0x3FC730 /end MEASUREMENT
/begin MEASUREMENT lank_obd_slope_cnt_io_b2 "Anzahl i.O. Slope-Diagnosen" UBYTE FORMULA_0003 0 0 0.0 255.0000 ECU_ADDRESS 0x3FC731 /end MEASUREMENT
/begin MEASUREMENT lank_obd_slope_nase_cnt_b1 "NASE-Ermittlung ueber X-Messungen" UBYTE FORMULA_0003 0 0 0.0 255.0000 ECU_ADDRESS 0x3FC732 /end MEASUREMENT
/begin MEASUREMENT lank_obd_slope_nase_cnt_b2 "NASE-Ermittlung ueber X-Messungen" UBYTE FORMULA_0003 0 0 0.0 255.0000 ECU_ADDRESS 0x3FC733 /end MEASUREMENT
/begin MEASUREMENT lank_obd_s_sa_t_mess_b1 "Abfallszeit des NKAT-Signals in SA f. MODE 6" UWORD FORMULA_0539 0 0 0.0 6553500.0000 ECU_ADDRESS 0x3FC734 /end MEASUREMENT
/begin MEASUREMENT lank_obd_s_sa_t_mess_b2 "Abfallszeit des NKAT-Signals in SA f. MODE 6" UWORD FORMULA_0539 0 0 0.0 6553500.0000 ECU_ADDRESS 0x3FC736 /end MEASUREMENT
/* ------------------ Abschnitt erzeugt aus lavk_spi.dat ------------------ */
/begin CHARACTERISTIC K_LAVK_ATIC42_IP_OFFSET_MEAS_B1 "ATIC42 Pumpstromoffset-Messung | EN: ATIC42 pump-current offset measurement" VALUE 0x7434A TKW_VV_VV_UB 100.0 FORMULA_0889 0.0 1.0 /end CHARACTERISTIC
/begin CHARACTERISTIC K_LAVK_ATIC42_IP_OFFSET_MEAS_B2 "ATIC42 Pumpstromoffset-Messung | EN: ATIC42 pump-current offset measurement" VALUE 0x7434B TKW_VV_VV_UB 100.0 FORMULA_0889 0.0 1.0 /end CHARACTERISTIC
/begin CHARACTERISTIC K_LAVK_ATIC42_ICP_ENABLE_B1 "ATIC42 ICP Einspeisung | EN: ATIC42 ICP feed" VALUE 0x7434C TKW_VV_VV_UB 100.0 FORMULA_0889 0.0 1.0 /end CHARACTERISTIC
/begin CHARACTERISTIC K_LAVK_ATIC42_ICP_ENABLE_B2 "ATIC42 ICP Einspeisung | EN: ATIC42 ICP feed" VALUE 0x7434D TKW_VV_VV_UB 100.0 FORMULA_0889 0.0 1.0 /end CHARACTERISTIC
/begin CHARACTERISTIC K_LAVK_ATIC42_RI_CALIB_B1 "ATIC42 Innenwiderstands Kalibrierung | EN: ATIC42 internal-resistance calibration" VALUE 0x7434E TKW_VV_VV_UB 100.0 FORMULA_0889 0.0 1.0 /end CHARACTERISTIC
/begin CHARACTERISTIC K_LAVK_ATIC42_RI_CALIB_B2 "ATIC42 Innenwiderstands Kalibrierung | EN: ATIC42 internal-resistance calibration" VALUE 0x7434F TKW_VV_VV_UB 100.0 FORMULA_0889 0.0 1.0 /end CHARACTERISTIC
/begin CHARACTERISTIC K_LAVK_ATIC42_RI_OSCI_B1 "ATIC42 Innenwiderstands Oszillator | EN: ATIC42 internal-resistance oscillator" VALUE 0x74350 TKW_VV_VV_UB 100.0 FORMULA_0889 0.0 1.0 /end CHARACTERISTIC
/begin CHARACTERISTIC K_LAVK_ATIC42_RI_OSCI_B2 "ATIC42 Innenwiderstands Oszillator | EN: ATIC42 internal-resistance oscillator" VALUE 0x74351 TKW_VV_VV_UB 100.0 FORMULA_0889 0.0 1.0 /end CHARACTERISTIC
/begin CHARACTERISTIC K_LAVK_ATIC42_SENSOR_B1 "ATIC42 Lambda Sonde | EN: ATIC42 lambda sensor" VALUE 0x74352 TKW_VV_VV_UB 100.0 FORMULA_0890 0.0 1.0 /end CHARACTERISTIC
/begin CHARACTERISTIC K_LAVK_ATIC42_SENSOR_B2 "ATIC42 Lambda Sonde | EN: ATIC42 lambda sensor" VALUE 0x74353 TKW_VV_VV_UB 100.0 FORMULA_0890 0.0 1.0 /end CHARACTERISTIC
/begin CHARACTERISTIC K_LAVK_ATIC42_ICP_VALUE_B1 "ATIC42 ICP Wert | EN: ATIC42 ICP value" VALUE 0x74354 TKW_VV_VV_UB 100.0 FORMULA_0891 5.0000 160.0000 /end CHARACTERISTIC
/begin CHARACTERISTIC K_LAVK_ATIC42_ICP_VALUE_B2 "ATIC42 ICP Wert | EN: ATIC42 ICP value" VALUE 0x74355 TKW_VV_VV_UB 100.0 FORMULA_0891 5.0000 160.0000 /end CHARACTERISTIC
/begin CHARACTERISTIC K_LAVK_ATIC42_PROTEC_TIME_B1 "ATIC42 Zeit in der der Sensor nach einem Fehler getrennt wird | EN: ATIC42 time the sensor is disconnected after a fault" VALUE 0x74356 TKW_VV_VV_UB 100.0 FORMULA_0892 0.8000 1.5000 /end CHARACTERISTIC
/begin CHARACTERISTIC K_LAVK_ATIC42_PROTEC_TIME_B2 "ATIC42 Zeit in der der Sensor nach einem Fehler getrennt wird | EN: ATIC42 time the sensor is disconnected after a fault" VALUE 0x74357 TKW_VV_VV_UB 100.0 FORMULA_0892 0.8000 1.5000 /end CHARACTERISTIC
/begin CHARACTERISTIC K_LAVK_ATIC42_RI_MEAS_FREQ_B1 "ATIC42 Frequenz der Oszillators zur Innenwiderstandsmessung | EN: ATIC42 oscillator frequency for internal-resistance measurement" VALUE 0x74358 TKW_VV_VV_UB 100.0 FORMULA_0893 2.0000 9.8750 /end CHARACTERISTIC
/begin CHARACTERISTIC K_LAVK_ATIC42_RI_MEAS_FREQ_B2 "ATIC42 Frequenz der Oszillators zur Innenwiderstandsmessung | EN: ATIC42 oscillator frequency for internal-resistance measurement" VALUE 0x74359 TKW_VV_VV_UB 100.0 FORMULA_0893 2.0000 9.8750 /end CHARACTERISTIC
/begin CHARACTERISTIC K_LAVK_ATIC42_PIN_CFG_B1 "ATIC42 PIN-Freigabe | EN: ATIC42 pin enable" VALUE 0x7435A TKW_VV_VV_UB 100.0 FORMULA_0894 0.0 1.0 /end CHARACTERISTIC
/begin CHARACTERISTIC K_LAVK_ATIC42_PIN_CFG_B2 "ATIC42 PIN-Freigabe | EN: ATIC42 pin enable" VALUE 0x7435B TKW_VV_VV_UB 100.0 FORMULA_0894 0.0 1.0 /end CHARACTERISTIC
/begin CHARACTERISTIC K_LAVK_ATIC42_SPI_DIAG_CNT "Fehlerschwelle f. ATIC42-SPI-Diag. | EN: Fehlerschwelle f. ATIC42-SPI-Diag." VALUE 0x7435C TKW_VV_VV_UW 100.0 FORMULA_0010 0.0 65535.0000 /end CHARACTERISTIC
/begin MEASUREMENT lavk_spi_buffer_ret "SPi-Antwortpuffer" UWORD FORMULA_0010 0 0 0.0 65535.0000 ECU_ADDRESS 0x3FC7C8 /end MEASUREMENT
/begin MEASUREMENT lavk_atic42_mode_b1 "SPI Mode ATIC42" UBYTE FORMULA_0872 0 0 0.0 255.0 ECU_ADDRESS 0x3FC7CA /end MEASUREMENT
/begin MEASUREMENT lavk_atic42_mode_b2 "SPI Mode ATIC42" UBYTE FORMULA_0872 0 0 0.0 255.0 ECU_ADDRESS 0x3FC7CB /end MEASUREMENT
/begin MEASUREMENT lavk_atic42_cnt_b1 "Ablaufzaeker SPI ATIC42" UBYTE FORMULA_0003 0 0 0.0 10.0000 ECU_ADDRESS 0x3FC7CC /end MEASUREMENT
/begin MEASUREMENT lavk_atic42_cnt_b2 "Ablaufzaeker SPI ATIC42" UBYTE FORMULA_0003 0 0 0.0 10.0000 ECU_ADDRESS 0x3FC7CD /end MEASUREMENT
/begin MEASUREMENT lavk_atic42_ip_st_b1 "ATIC42-IP-Status" UBYTE FORMULA_0033 0 0 0.0 255.0000 ECU_ADDRESS 0x3FC7CE /end MEASUREMENT
/begin MEASUREMENT lavk_atic42_ip_st_b2 "ATIC42-IP-Status" UBYTE FORMULA_0033 0 0 0.0 255.0000 ECU_ADDRESS 0x3FC7CF /end MEASUREMENT
/begin MEASUREMENT lavk_atic42_ip_gain_b1 "ATIC42 Pumpstromverstaerkung" UBYTE FORMULA_0873 0 0 0.0 255.0 ECU_ADDRESS 0x3FC7CE BIT_MASK 0x1 /end MEASUREMENT
/begin MEASUREMENT lavk_atic42_ip_gain_b2 "ATIC42 Pumpstromverstaerkung" UBYTE FORMULA_0873 0 0 0.0 255.0 ECU_ADDRESS 0x3FC7CF BIT_MASK 0x1 /end MEASUREMENT
/begin MEASUREMENT lavk_atic42_ip_offset_meas_b1 "ATIC42 Pumpstromoffset-Messung" UBYTE FORMULA_0874 0 0 0.0 255.0 ECU_ADDRESS 0x3FC7CE BIT_MASK 0x2 /end MEASUREMENT
/begin MEASUREMENT lavk_atic42_ip_offset_meas_b2 "ATIC42 Pumpstromoffset-Messung" UBYTE FORMULA_0874 0 0 0.0 255.0 ECU_ADDRESS 0x3FC7CF BIT_MASK 0x2 /end MEASUREMENT
/begin MEASUREMENT lavk_atic42_icp_enable_b1 "ATIC42 ICP Einspeisung" UBYTE FORMULA_0875 0 0 0.0 255.0 ECU_ADDRESS 0x3FC7CE BIT_MASK 0x4 /end MEASUREMENT
/begin MEASUREMENT lavk_atic42_icp_enable_b2 "ATIC42 ICP Einspeisung" UBYTE FORMULA_0875 0 0 0.0 255.0 ECU_ADDRESS 0x3FC7CF BIT_MASK 0x4 /end MEASUREMENT
/begin MEASUREMENT lavk_atic42_ip_loop_enable_spi_b1 "ATIC42 Pumpstrom Regelung" UBYTE FORMULA_0876 0 0 0.0 255.0 ECU_ADDRESS 0x3FC7CE BIT_MASK 0x8 /end MEASUREMENT
/begin MEASUREMENT lavk_atic42_ip_loop_enable_spi_b2 "ATIC42 Pumpstrom Regelung" UBYTE FORMULA_0876 0 0 0.0 255.0 ECU_ADDRESS 0x3FC7CF BIT_MASK 0x8 /end MEASUREMENT
/begin MEASUREMENT lavk_atic42_ri_st_b1 "ATIC42-RI-Status" UBYTE FORMULA_0033 0 0 0.0 255.0000 ECU_ADDRESS 0x3FC7D0 /end MEASUREMENT
/begin MEASUREMENT lavk_atic42_ri_st_b2 "ATIC42-RI-Status" UBYTE FORMULA_0033 0 0 0.0 255.0000 ECU_ADDRESS 0x3FC7D1 /end MEASUREMENT
/begin MEASUREMENT lavk_atic42_ri_calib_b1 "ATIC42 Innenwiderstands Kalibrierung" UBYTE FORMULA_0877 0 0 0.0 255.0 ECU_ADDRESS 0x3FC7D0 BIT_MASK 0x1 /end MEASUREMENT
/begin MEASUREMENT lavk_atic42_ri_calib_b2 "ATIC42 Innenwiderstands Kalibrierung" UBYTE FORMULA_0877 0 0 0.0 255.0 ECU_ADDRESS 0x3FC7D1 BIT_MASK 0x1 /end MEASUREMENT
/begin MEASUREMENT lavk_atic42_ri_osci_b1 "ATIC42 Innenwiderstands Oszillator" UBYTE FORMULA_0874 0 0 0.0 255.0 ECU_ADDRESS 0x3FC7D0 BIT_MASK 0x2 /end MEASUREMENT
/begin MEASUREMENT lavk_atic42_ri_osci_b2 "ATIC42 Innenwiderstands Oszillator" UBYTE FORMULA_0874 0 0 0.0 255.0 ECU_ADDRESS 0x3FC7D1 BIT_MASK 0x2 /end MEASUREMENT
/begin MEASUREMENT lavk_atic42_sensor_b1 "ATIC42 Lambda Sonde" UBYTE FORMULA_0878 0 0 0.0 255.0 ECU_ADDRESS 0x3FC7D0 BIT_MASK 0x4 /end MEASUREMENT
/begin MEASUREMENT lavk_atic42_sensor_b2 "ATIC42 Lambda Sonde" UBYTE FORMULA_0878 0 0 0.0 255.0 ECU_ADDRESS 0x3FC7D1 BIT_MASK 0x4 /end MEASUREMENT
/begin MEASUREMENT lavk_atic42_ri_range_spi_b1 "ATIC42 Innenwiderstands Messbereich" UBYTE FORMULA_0879 0 0 0.0 255.0 ECU_ADDRESS 0x3FC7D0 BIT_MASK 0x8 /end MEASUREMENT
/begin MEASUREMENT lavk_atic42_ri_range_spi_b2 "ATIC42 Innenwiderstands Messbereich" UBYTE FORMULA_0879 0 0 0.0 255.0 ECU_ADDRESS 0x3FC7D1 BIT_MASK 0x8 /end MEASUREMENT
/begin MEASUREMENT lavk_atic42_ip_offs_meas_b1 "ATIC42 Pumpstromoffset-Messung" UWORD FORMULA_0880 0 0 0.0 65535.0 ECU_ADDRESS 0x3FC7D2 BIT_MASK 0x4 /end MEASUREMENT
/begin MEASUREMENT lavk_atic42_ip_offs_meas_b2 "ATIC42 Pumpstromoffset-Messung" UWORD FORMULA_0880 0 0 0.0 65535.0 ECU_ADDRESS 0x3FC7D4 BIT_MASK 0x4 /end MEASUREMENT
/begin MEASUREMENT lavk_atic42_ri_calib_spi_b1 "ATIC42 Innenwiderstands Kalibrierung - SPI" UWORD FORMULA_0881 0 0 0.0 65535.0 ECU_ADDRESS 0x3FC7D6 BIT_MASK 0x8 /end MEASUREMENT
/begin MEASUREMENT lavk_atic42_ri_calib_spi_b2 "ATIC42 Innenwiderstands Kalibrierung - SPI" UWORD FORMULA_0881 0 0 0.0 65535.0 ECU_ADDRESS 0x3FC7D8 BIT_MASK 0x8 /end MEASUREMENT
/begin MEASUREMENT lavk_atic42_ri_osci_spi_b1 "ATIC42 Innenwiderstands Oszillator - SPI" UWORD FORMULA_0880 0 0 0.0 65535.0 ECU_ADDRESS 0x3FC7DA BIT_MASK 0x4 /end MEASUREMENT
/begin MEASUREMENT lavk_atic42_ri_osci_spi_b2 "ATIC42 Innenwiderstands Oszillator - SPI" UWORD FORMULA_0880 0 0 0.0 65535.0 ECU_ADDRESS 0x3FC7DC BIT_MASK 0x4 /end MEASUREMENT
/begin MEASUREMENT lavk_atic42_ri_range_b1 "ATIC42 Innenwiderstands Messbereich" UBYTE FORMULA_0882 0 0 0.0 255.0 ECU_ADDRESS 0x3FC7DE BIT_MASK 0x1 /end MEASUREMENT
/begin MEASUREMENT lavk_atic42_ri_range_b2 "ATIC42 Innenwiderstands Messbereich" UBYTE FORMULA_0882 0 0 0.0 255.0 ECU_ADDRESS 0x3FC7DF BIT_MASK 0x1 /end MEASUREMENT
/begin MEASUREMENT lavk_atic42_ip_loop_enable_b1 "ATIC42 Pumpstrom Regelung" UBYTE FORMULA_0883 0 0 0.0 255.0 ECU_ADDRESS 0x3FC7E0 BIT_MASK 0x1 /end MEASUREMENT
/begin MEASUREMENT lavk_atic42_ip_loop_enable_b2 "ATIC42 Pumpstrom Regelung" UBYTE FORMULA_0883 0 0 0.0 255.0 ECU_ADDRESS 0x3FC7E1 BIT_MASK 0x1 /end MEASUREMENT
/begin MEASUREMENT lavk_atic42_pin_b1 "Pin-Freigabe" UBYTE FORMULA_0884 0 0 0.0 255.0 ECU_ADDRESS 0x3FC7E2 BIT_MASK 0x1 /end MEASUREMENT
/begin MEASUREMENT lavk_atic42_pin_b2 "Pin-Freigabe" UBYTE FORMULA_0884 0 0 0.0 255.0 ECU_ADDRESS 0x3FC7E3 BIT_MASK 0x1 /end MEASUREMENT
/begin MEASUREMENT lavk_atic42_icp_value_b1 "ATIC42 ICP Wert" UWORD FORMULA_0885 0 0 5.0000 160.0000 ECU_ADDRESS 0x3FC7E4 /end MEASUREMENT
/begin MEASUREMENT lavk_atic42_icp_value_b2 "ATIC42 ICP Wert" UWORD FORMULA_0885 0 0 5.0000 160.0000 ECU_ADDRESS 0x3FC7E6 /end MEASUREMENT
/begin MEASUREMENT lavk_atic42_protec_time_b1 "ATIC42 Zeit in der der Sensor nach einem Fehler getrennt wird" UWORD FORMULA_0886 0 0 0.8000 1.5000 ECU_ADDRESS 0x3FC7E8 /end MEASUREMENT
/begin MEASUREMENT lavk_atic42_protec_time_b2 "ATIC42 Zeit in der der Sensor nach einem Fehler getrennt wird" UWORD FORMULA_0886 0 0 0.8000 1.5000 ECU_ADDRESS 0x3FC7EA /end MEASUREMENT
/begin MEASUREMENT lavk_atic42_ri_freq_b1 "ATIC42 Frequenz der Oszillators zur Innenwiderstandsmessung" UWORD FORMULA_0887 0 0 2.0000 9.8750 ECU_ADDRESS 0x3FC7EC /end MEASUREMENT
/begin MEASUREMENT lavk_atic42_ri_freq_b2 "ATIC42 Frequenz der Oszillators zur Innenwiderstandsmessung" UWORD FORMULA_0887 0 0 2.0000 9.8750 ECU_ADDRESS 0x3FC7EE /end MEASUREMENT
/begin MEASUREMENT lavk_atic42_pin_diag_b1 "ATIC42 - Pin Diagnose" UBYTE FORMULA_0003 0 0 0.0 255.0000 ECU_ADDRESS 0x3FC7F0 /end MEASUREMENT
/begin MEASUREMENT lavk_atic42_pin_diag_b2 "ATIC42 - Pin Diagnose" UBYTE FORMULA_0003 0 0 0.0 255.0000 ECU_ADDRESS 0x3FC7F1 /end MEASUREMENT
/begin MEASUREMENT lavk_atic42_diag_byte_b1 "ATIC42 - Diagnose Byte" UBYTE FORMULA_0003 0 0 0.0 255.0000 ECU_ADDRESS 0x3FC7F2 /end MEASUREMENT
/begin MEASUREMENT lavk_atic42_diag_byte_b2 "ATIC42 - Diagnose Byte" UBYTE FORMULA_0003 0 0 0.0 255.0000 ECU_ADDRESS 0x3FC7F3 /end MEASUREMENT
/begin MEASUREMENT lavk_atic42_identity_b1 "" UWORD FORMULA_0010 0 0 0.0 65535.0000 ECU_ADDRESS 0x3FC7F4 /end MEASUREMENT
/begin MEASUREMENT lavk_atic42_identity_b2 "" UWORD FORMULA_0010 0 0 0.0 65535.0000 ECU_ADDRESS 0x3FC7F6 /end MEASUREMENT
/begin MEASUREMENT lavk_atic42_diag_st_b1 "" UBYTE FORMULA_0888 0 0 0.0 255.0 ECU_ADDRESS 0x3FC7F8 BIT_MASK 0x1 /end MEASUREMENT
/begin MEASUREMENT lavk_atic42_diag_st_b2 "" UBYTE FORMULA_0888 0 0 0.0 255.0 ECU_ADDRESS 0x3FC7F9 BIT_MASK 0x1 /end MEASUREMENT
/begin MEASUREMENT lavk_atic42_spi_diag_cnt_b1 "Fehlerzaehler ATIC42-SPI-Diag." UWORD FORMULA_0010 0 0 0.0 65535.0000 ECU_ADDRESS 0x3FC7FA /end MEASUREMENT
/begin MEASUREMENT lavk_atic42_spi_diag_cnt_b2 "Fehlerzaehler ATIC42-SPI-Diag." UWORD FORMULA_0010 0 0 0.0 65535.0000 ECU_ADDRESS 0x3FC7FC /end MEASUREMENT
/* ------------------ Abschnitt erzeugt aus mdrv.dat ------------------ */
/begin CHARACTERISTIC K_MDRV_CFG "Konfiguration | EN: 0 Schalter 1 Komfort 2 Normal 3 Sport 4 Konfigmode ELSE undef Konfiguration" VALUE 0x74986 TKW_VV_VV_UB 100.0 FORMULA_0966 0.0 255.0 /end CHARACTERISTIC
/begin CHARACTERISTIC K_MDRV_CFG_P400 "Konfiguration P400-Only | EN: 0 nur US 1 immer Konfiguration P400-Only" VALUE 0x74987 TKW_VV_VV_UB 100.0 FORMULA_0967 0.0 255.0 /end CHARACTERISTIC
/begin CHARACTERISTIC K_MDRV_PTH_CNT_MAX "max. Entprellcounter | EN: max. Entprellcounter" VALUE 0x74988 TKW_VV_VV_UB 100.0 FORMULA_0003 0.0 255.0000 /end CHARACTERISTIC
/begin CHARACTERISTIC K_MDRV_DSC "Default-Konfiguration DSC | EN: 0 k. Aenderung 1 Aus 2 Ein 4 MDM ELSE undef Default-Konfiguration DSC" VALUE 0x74989 TKW_VV_VV_UB 100.0 FORMULA_0233 0.0 255.0 /end CHARACTERISTIC
/begin CHARACTERISTIC K_MDRV_MOD_SMG "Default-Konfiguration SMG-Mode | EN: 0 k. Aenderung 1 Automat 2 Sequentiell ELSE undef Default-Konfiguration SMG - Mode" VALUE 0x7498A TKW_VV_VV_UB 100.0 FORMULA_0234 0.0 255.0 /end CHARACTERISTIC
/begin CHARACTERISTIC K_MDRV_STG_SMG "Default-Konfiguration SMG-Sufe | EN: Default-Konfiguration SMG-Sufe" VALUE 0x7498B TKW_VV_VV_UB 100.0 FORMULA_0003 0.0 255.0000 /end CHARACTERISTIC
/begin CHARACTERISTIC K_MDRV_ENG "Default-Konfiguration Motor | EN: 0 k. Aenderung 1 Komfort 2 Normal 3 Sport ELSE undef Default-Konfiguration Motor" VALUE 0x7498C TKW_VV_VV_UB 100.0 FORMULA_0236 0.0 255.0 /end CHARACTERISTIC
/begin CHARACTERISTIC K_MDRV_EDCK "Default-Konfiguration EDCK | EN: 0 k. Aenderung 1 Komfort 2 Normal 10 Sport ELSE undef Default-Konfiguration EDCK" VALUE 0x7498D TKW_VV_VV_UB 100.0 FORMULA_0237 0.0 255.0 /end CHARACTERISTIC
/begin CHARACTERISTIC K_MDRV_ALBV "Default-Konfiguration ALBV | EN: 0 k. Aenderung 1 KL1 2 KL2 3 KL3 ELSE undef Default-Konfiguration ALBV" VALUE 0x7498E TKW_VV_VV_UB 100.0 FORMULA_0237 0.0 255.0 /end CHARACTERISTIC
/begin CHARACTERISTIC K_MDRV_HUD "Default-Konfiguration HUD | EN: 0 k. Aenderung 1 M-Cfg ELSE undef Default-Konfiguration HUD" VALUE 0x7498F TKW_VV_VV_UB 100.0 FORMULA_0238 0.0 255.0 /end CHARACTERISTIC
/begin CHARACTERISTIC K_MDRV_P400_ONLY "P400-Sperre | EN: P400-Sperre" VALUE 0x74990 TKW_VV_VV_UW 100.0 FORMULA_0010 0.0 65535.0000 /end CHARACTERISTIC
/begin CHARACTERISTIC K_MDRV_P500_START "P500-Hochlauf | EN: P500-Hochlauf" VALUE 0x74992 TKW_VV_VV_UW 100.0 FORMULA_0010 0.0 65535.0000 /end CHARACTERISTIC
/begin CHARACTERISTIC K_MDRV_TBLINK "Blinkzeit | EN: Blinkzeit" VALUE 0x74994 TKW_VV_VV_UW 100.0 FORMULA_0021 0.0 655.0000 FORMAT "%5.2" /end CHARACTERISTIC
/begin MEASUREMENT mdrv_flags "MDRV fuer DME" UBYTE FORMULA_0003 0 0 0.0 255.0000 ECU_ADDRESS 0x3FC929 /end MEASUREMENT
/begin MEASUREMENT mdrv_flags_stat "MDRV fuer DME" UBYTE FORMULA_0963 0 0 0.0 255.0 ECU_ADDRESS 0x3FC929 BIT_MASK 0x3 /end MEASUREMENT
/begin MEASUREMENT mdrv_flags_power "MDRV Powertaster" UBYTE FORMULA_0964 0 0 0.0 255.0 ECU_ADDRESS 0x3FC929 BIT_MASK 0x4 /end MEASUREMENT
/begin MEASUREMENT mdrv_flags_kl15 "MDRV Kl15" UBYTE FORMULA_0965 0 0 0.0 255.0 ECU_ADDRESS 0x3FC929 BIT_MASK 0x8 /end MEASUREMENT
/begin MEASUREMENT mdrv_pth_cnt "max. Entprellcounter" UBYTE FORMULA_0003 0 0 0.0 255.0000 ECU_ADDRESS 0x3FC92A /end MEASUREMENT
/begin MEASUREMENT mdrv_tblink "Blinktimer" UWORD FORMULA_0021 0 0 0.0 655.0000 ECU_ADDRESS 0x3FC92C /end MEASUREMENT
/* ------------------ Abschnitt erzeugt aus msa.dat ------------------ */
/begin CHARACTERISTIC K_MSA_Kl15OFF_T_LOW "max. Lowzeit MSA-Pin bei Kl15 aus | EN: max. Lowzeit MSA-Pin bei Kl15 aus" VALUE 0x74996 TKW_VV_VV_UB 100.0 FORMULA_0317 0.0 2.5500 /end CHARACTERISTIC
/begin MEASUREMENT msa_kl15off_ack "CAN-Acknowledge" UBYTE FORMULA_0968 0 0 0.0 255.0 ECU_ADDRESS 0x3FC934 /end MEASUREMENT
/begin MEASUREMENT msa_pin "Status MSA-Pin" UBYTE FORMULA_0969 0 0 0.0 255.0 ECU_ADDRESS 0x3FC935 /end MEASUREMENT
/begin MEASUREMENT msa_pin_t_low "Lowzeit MSA-Pin" UBYTE FORMULA_0317 0 0 0.0 2.5500 ECU_ADDRESS 0x3FC936 /end MEASUREMENT
/* ------------------ Abschnitt erzeugt aus mzyl.dat ------------------ */
/begin CHARACTERISTIC K_MZYL_CFG "Schalter Fuellungsberechnung | EN: 0x2 PSAU 0x4 AQ ELSE undefiniert Schalter Fuellungsberechnung" VALUE 0x74AC8 TKW_VV_VV_UB 100.0 FORMULA_1000 0.0 255.0 /end CHARACTERISTIC
/begin CHARACTERISTIC K_MZYL_START_CFG "Schalter Fuellungsber. im Start | EN: 0x2 PSAU 0x4 AQ ELSE undefiniert Schalter Fuellungsber. im Start" VALUE 0x74AC9 TKW_VV_VV_UB 100.0 FORMULA_1001 0.0 255.0 /end CHARACTERISTIC
/begin CHARACTERISTIC K_MZYL_T_CFG "TAN fuer Fuellungsber. aus PSAU" VALUE 0x74ACA TKW_VV_VV_UB 100.0 FORMULA_1002 0.0 255.0 /end CHARACTERISTIC
/begin CHARACTERISTIC K_MZYL_R "Allgemeine Gaskonstante R | EN: Allgemeine Gaskonstante R" VALUE 0x74ACC TKW_VV_VV_UW 100.0 FORMULA_1003 0.0 6553.5000 FORMAT "%4.1" /end CHARACTERISTIC
/begin CHARACTERISTIC K_MZYL_EV_RUECK "Vanos-Spreizung Delta" VALUE 0x74ACE TKW_VV_VV_SW 100.0 FORMULA_0111 -80.0000 350.0000 FORMAT "%4.1" /end CHARACTERISTIC
/begin CHARACTERISTIC K_MZYL_EV_RUECK_TMAX "Max. Zeit fuer EV Rueck" VALUE 0x74AD0 TKW_VV_VV_UW 100.0 FORMULA_0998 0.0 40.0000 FORMAT "%5.2" /end CHARACTERISTIC
/begin CHARACTERISTIC K_MZYL_HFM_AQ_MIN_FAK "Min. Wert fuer hfm_aq_fak" VALUE 0x74AD2 TKW_VV_VV_SW 100.0 FORMULA_0556 -3.0000 3.0000 FORMAT "%7.4" /end CHARACTERISTIC
/begin CHARACTERISTIC K_MZYL_HFM_AQ_MAX_FAK "Max. Wert fuer hfm_aq_fak" VALUE 0x74AD4 TKW_VV_VV_SW 100.0 FORMULA_0556 -3.0000 3.0000 FORMAT "%7.4" /end CHARACTERISTIC
/begin CHARACTERISTIC KL_MZYL_EV_A_MEAN "Wirksamer EV-Quersch. Rueckstr." CURVE 0x74AD6 TKL_SW_VV_UW 100.0 FORMULA_0997 0.0 15.0000 /begin AXIS_DESCR STD_AXIS van_xd FORMULA_0111 12 0.0 160.0000 FORMAT "%4.1" /end AXIS_DESCR FORMAT "%6.3" /end CHARACTERISTIC
/begin CHARACTERISTIC KL_MZYL_PZYL_DP "Offset pzyl fuer EV-schliesst" CURVE 0x74B08 TKL_SW_VV_SW 100.0 FORMULA_0077 0.0 2000.0000 /begin AXIS_DESCR STD_AXIS n FORMULA_0006 8 0.0 10000.0000 /end AXIS_DESCR FORMAT "%4.1" /end CHARACTERISTIC
/begin CHARACTERISTIC KL_MZYL_PZYL_DP_F "Faktor pzyl fuer EV-schliesst" CURVE 0x74B2A TKL_SW_VV_SW 100.0 FORMULA_0075 -4.0000 4.0000
 /begin AXIS_DESCR STD_AXIS psau_rel FORMULA_0115 4 0.0 120.0000 FORMAT "%5.2" /end AXIS_DESCR
 FORMAT "%6.3" /end CHARACTERISTIC
/begin CHARACTERISTIC KF_MZYL_ADAPT_RAMPE_UP "Rampe fuer Verhaeltniss hfm/aq" MAP 0x74B3C TKF_SW_SW_SW 100.0 FORMULA_1004 0.0 3.0000 /begin AXIS_DESCR STD_AXIS n FORMULA_0006 6 0.0 10000.0000 /end AXIS_DESCR
 /begin AXIS_DESCR STD_AXIS dr_rel_1of2_ FORMULA_0115 6 0.0 199.9938 FORMAT "%5.2" /end AXIS_DESCR
 FORMAT "%7.4" /end CHARACTERISTIC
/begin CHARACTERISTIC KF_MZYL_ADAPT_RAMPE_DOWN "Rampe fuer Verhaeltniss hfm/aq" MAP 0x74B9E TKF_SW_SW_SW 100.0 FORMULA_1004 0.0 3.0000 /begin AXIS_DESCR STD_AXIS n FORMULA_0006 6 0.0 10000.0000 /end AXIS_DESCR
 /begin AXIS_DESCR STD_AXIS dr_rel_1of2_ FORMULA_0115 6 0.0 199.9938 FORMAT "%5.2" /end AXIS_DESCR
 FORMAT "%7.4" /end CHARACTERISTIC
/begin CHARACTERISTIC KF_MZYL_ADAPT_GEW "Rampe fuer Verhaeltniss hfm/aq" MAP 0x74C00 TKF_SW_SW_UW 100.0 FORMULA_0075 0.5000 2.0000 /begin AXIS_DESCR STD_AXIS n FORMULA_0006 6 0.0 10000.0000 /end AXIS_DESCR
 /begin AXIS_DESCR STD_AXIS dr_rel_1of2_ FORMULA_0115 6 0.0 199.9938 FORMAT "%5.2" /end AXIS_DESCR
 FORMAT "%6.3" /end CHARACTERISTIC
/begin MEASUREMENT mzyl_b1.ges_asp "Wirksame Gesamtmasse/ASP" SWORD FORMULA_0113 0 0 -500.0000 1500.0000 ECU_ADDRESS 0x3FCA00 /end MEASUREMENT
/begin MEASUREMENT mzyl_b2.ges_asp "Wirksame Gesamtmasse/ASP" SWORD FORMULA_0113 0 0 -500.0000 1500.0000 ECU_ADDRESS 0x3FCA30 /end MEASUREMENT
/begin MEASUREMENT mzyl_b1.rg_asp "Wirksame RG-Masse/ASP" SWORD FORMULA_0113 0 0 -500.0000 1500.0000 ECU_ADDRESS 0x3FCA02 /end MEASUREMENT
/begin MEASUREMENT mzyl_b2.rg_asp "Wirksame RG-Masse/ASP" SWORD FORMULA_0113 0 0 -500.0000 1500.0000 ECU_ADDRESS 0x3FCA32 /end MEASUREMENT
/begin MEASUREMENT mzyl_b1.ml_asp "Wirksame Luftmasse/ASP" SWORD FORMULA_0113 0 0 -500.0000 1500.0000 ECU_ADDRESS 0x3FCA04 /end MEASUREMENT
/begin MEASUREMENT mzyl_b2.ml_asp "Wirksame Luftmasse/ASP" SWORD FORMULA_0113 0 0 -500.0000 1500.0000 ECU_ADDRESS 0x3FCA34 /end MEASUREMENT
/begin MEASUREMENT mzyl_b1.rf "Wirksames rf" SWORD FORMULA_0007 0 0 0.0 2.0000 ECU_ADDRESS 0x3FCA06 /end MEASUREMENT
/begin MEASUREMENT mzyl_b2.rf "Wirksames rf" SWORD FORMULA_0007 0 0 0.0 2.0000 ECU_ADDRESS 0x3FCA36 /end MEASUREMENT
/begin MEASUREMENT mzyl_b1.mldt "Wirksamer Luftmassenstrom" SWORD FORMULA_0112 0 0 -100.0000 1400.0000 ECU_ADDRESS 0x3FCA08 /end MEASUREMENT
/begin MEASUREMENT mzyl_b2.mldt "Wirksamer Luftmassenstrom" SWORD FORMULA_0112 0 0 -100.0000 1400.0000 ECU_ADDRESS 0x3FCA38 /end MEASUREMENT
/begin MEASUREMENT mzyl_b1.ml_psau "Luftmasse/ASP aus psau" SWORD FORMULA_0113 0 0 -500.0000 1500.0000 ECU_ADDRESS 0x3FCA0A /end MEASUREMENT
/begin MEASUREMENT mzyl_b2.ml_psau "Luftmasse/ASP aus psau" SWORD FORMULA_0113 0 0 -500.0000 1500.0000 ECU_ADDRESS 0x3FCA3A /end MEASUREMENT
/begin MEASUREMENT mzyl_b1.ges_psau "Gesamtmasse/ASP aus psau" SWORD FORMULA_0113 0 0 -500.0000 1500.0000 ECU_ADDRESS 0x3FCA0C /end MEASUREMENT
/begin MEASUREMENT mzyl_b2.ges_psau "Gesamtmasse/ASP aus psau" SWORD FORMULA_0113 0 0 -500.0000 1500.0000 ECU_ADDRESS 0x3FCA3C /end MEASUREMENT
/begin MEASUREMENT mzyl_b1.ges_roh "Ges.masse/ASP aus psau + EV-Verl" SWORD FORMULA_0113 0 0 -500.0000 1500.0000 ECU_ADDRESS 0x3FCA0E /end MEASUREMENT
/begin MEASUREMENT mzyl_b2.ges_roh "Ges.masse/ASP aus psau + EV-Verl" SWORD FORMULA_0113 0 0 -500.0000 1500.0000 ECU_ADDRESS 0x3FCA3E /end MEASUREMENT
/begin MEASUREMENT mzyl_b1.ml_sum_sa "Summe Luftmassenstr. im ZUST_SA" SLONG FORMULA_0996 0 0 -214748364.8000 214748364.7000 ECU_ADDRESS 0x3FCA10 /end MEASUREMENT
/begin MEASUREMENT mzyl_b2.ml_sum_sa "Summe Luftmassenstr. im ZUST_SA" SLONG FORMULA_0996 0 0 -214748364.8000 214748364.7000 ECU_ADDRESS 0x3FCA40 /end MEASUREMENT
/begin MEASUREMENT mzyl_b1.ml_sum_we "Summe Luftmassenstr. nach SA_WE" SLONG FORMULA_0996 0 0 -214748364.8000 214748364.7000 ECU_ADDRESS 0x3FCA14 /end MEASUREMENT
/begin MEASUREMENT mzyl_b2.ml_sum_we "Summe Luftmassenstr. nach SA_WE" SLONG FORMULA_0996 0 0 -214748364.8000 214748364.7000 ECU_ADDRESS 0x3FCA44 /end MEASUREMENT
/begin MEASUREMENT ml_psau_b1 "Luftmassenstrom aus psau" SWORD FORMULA_0112 0 0 -100.0000 1400.0000 ECU_ADDRESS 0x3FCA18 /end MEASUREMENT
/begin MEASUREMENT ml_psau_b2 "Luftmassenstrom aus psau" SWORD FORMULA_0112 0 0 -100.0000 1400.0000 ECU_ADDRESS 0x3FCA48 /end MEASUREMENT
/begin MEASUREMENT mzyl_b1.e_mean_ues "Wirksamer Rueckstr. EV-Quers." UWORD FORMULA_0997 0 0 0.0 15.0000 ECU_ADDRESS 0x3FCA1A /end MEASUREMENT
/begin MEASUREMENT mzyl_b2.e_mean_ues "Wirksamer Rueckstr. EV-Quers." UWORD FORMULA_0997 0 0 0.0 15.0000 ECU_ADDRESS 0x3FCA4A /end MEASUREMENT
/begin MEASUREMENT mzyl_b1.w_ues_ev "Winkel Rueckstr. EV" SWORD FORMULA_0111 0 0 50.0000 160.0000 ECU_ADDRESS 0x3FCA1C /end MEASUREMENT
/begin MEASUREMENT mzyl_b2.w_ues_ev "Winkel Rueckstr. EV" SWORD FORMULA_0111 0 0 50.0000 160.0000 ECU_ADDRESS 0x3FCA4C /end MEASUREMENT
/begin MEASUREMENT mzyl_b1.phi_ev_mean "Durchflussbeiwert EV" SWORD FORMULA_0556 0 0 -0.0001 1.0000 ECU_ADDRESS 0x3FCA1E /end MEASUREMENT
/begin MEASUREMENT mzyl_b2.phi_ev_mean "Durchflussbeiwert EV" SWORD FORMULA_0556 0 0 -0.0001 1.0000 ECU_ADDRESS 0x3FCA4E /end MEASUREMENT
/begin MEASUREMENT mzyl_b1.ges_rueck "Rueckstr. Gesamtmasse durch EV" SWORD FORMULA_0113 0 0 -500.0000 1500.0000 ECU_ADDRESS 0x3FCA20 /end MEASUREMENT
/begin MEASUREMENT mzyl_b2.ges_rueck "Rueckstr. Gesamtmasse durch EV" SWORD FORMULA_0113 0 0 -500.0000 1500.0000 ECU_ADDRESS 0x3FCA50 /end MEASUREMENT
/begin MEASUREMENT mzyl_b1.t_ues_ev "Zeit Rueckstr. EV" UWORD FORMULA_0998 0 0 0.0 40.0000 ECU_ADDRESS 0x3FCA22 /end MEASUREMENT
/begin MEASUREMENT mzyl_b2.t_ues_ev "Zeit Rueckstr. EV" UWORD FORMULA_0998 0 0 0.0 40.0000 ECU_ADDRESS 0x3FCA52 /end MEASUREMENT
/begin MEASUREMENT mzyl_b1.pzyl "Zylinderinnendruck EV schliesst" SWORD FORMULA_0077 0 0 0.0 2000.0000 ECU_ADDRESS 0x3FCA24 /end MEASUREMENT
/begin MEASUREMENT mzyl_b2.pzyl "Zylinderinnendruck EV schliesst" SWORD FORMULA_0077 0 0 0.0 2000.0000 ECU_ADDRESS 0x3FCA54 /end MEASUREMENT
/begin MEASUREMENT mzyl_b1.gas_zustand "Gaszustand EV" UWORD FORMULA_0010 0 0 0.0 65535.0000 ECU_ADDRESS 0x3FCA26 /end MEASUREMENT
/begin MEASUREMENT mzyl_b2.gas_zustand "Gaszustand EV" UWORD FORMULA_0010 0 0 0.0 65535.0000 ECU_ADDRESS 0x3FCA56 /end MEASUREMENT
/begin MEASUREMENT mzyl_b1.aq_rf_fak "Gewichtungsfaktor fuer rf Bildung aus aq" SWORD FORMULA_0556 0 0 -3.0000 3.0000 ECU_ADDRESS 0x3FCA28 /end MEASUREMENT
/begin MEASUREMENT mzyl_b2.aq_rf_fak "Gewichtungsfaktor fuer rf Bildung aus aq" SWORD FORMULA_0556 0 0 -3.0000 3.0000 ECU_ADDRESS 0x3FCA58 /end MEASUREMENT
/begin MEASUREMENT ml_lam_b1 "Luftmassenstrom aus Lambda" SWORD FORMULA_0112 0 0 -100.0000 1400.0000 ECU_ADDRESS 0x3FCA2A /end MEASUREMENT
/begin MEASUREMENT ml_lam_b2 "Luftmassenstrom aus Lambda" SWORD FORMULA_0112 0 0 -100.0000 1400.0000 ECU_ADDRESS 0x3FCA5A /end MEASUREMENT
/begin MEASUREMENT mzyl_b1.ml_lam "Luftmasse aus Lambda" SWORD FORMULA_0113 0 0 -500.0000 1500.0000 ECU_ADDRESS 0x3FCA2C /end MEASUREMENT
/begin MEASUREMENT mzyl_b2.ml_lam "Luftmasse aus Lambda" SWORD FORMULA_0113 0 0 -500.0000 1500.0000 ECU_ADDRESS 0x3FCA5C /end MEASUREMENT
/begin MEASUREMENT rf_lam_b1 "Wirksames rf aus Lambda" SWORD FORMULA_0007 0 0 0.0 2.0000 ECU_ADDRESS 0x3FCA2E /end MEASUREMENT
/begin MEASUREMENT rf_lam_b2 "Wirksames rf aus Lambda" SWORD FORMULA_0007 0 0 0.0 2.0000 ECU_ADDRESS 0x3FCA5E /end MEASUREMENT
/begin MEASUREMENT mzyl_st "Status mzyl" UBYTE FORMULA_0999 0 0 0.0 255.0 ECU_ADDRESS 0x3FCA60 /end MEASUREMENT
/begin MEASUREMENT ml_aq_b1 "ml aus aq" SWORD FORMULA_0112 0 0 -100.0000 1400.0000 ECU_ADDRESS 0x3FCA62 /end MEASUREMENT
/begin MEASUREMENT ml_aq_b2 "ml aus aq" SWORD FORMULA_0112 0 0 -100.0000 1400.0000 ECU_ADDRESS 0x3FCA64 /end MEASUREMENT
/begin MEASUREMENT mzyl_aq_b1 "mzyl aus aq" SWORD FORMULA_0113 0 0 -500.0000 1500.0000 ECU_ADDRESS 0x3FCA66 /end MEASUREMENT
/begin MEASUREMENT mzyl_aq_b2 "mzyl aus aq" SWORD FORMULA_0113 0 0 -500.0000 1500.0000 ECU_ADDRESS 0x3FCA68 /end MEASUREMENT
/begin MEASUREMENT rf_aq_hfm_b1 "rf aus Kombination von aq und hfm bestimmt" SWORD FORMULA_0007 0 0 0.0 2.0000 ECU_ADDRESS 0x3FCA6A /end MEASUREMENT
/begin MEASUREMENT rf_aq_hfm_b2 "rf aus Kombination von aq und hfm bestimmt" SWORD FORMULA_0007 0 0 0.0 2.0000 ECU_ADDRESS 0x3FCA6C /end MEASUREMENT
/begin MEASUREMENT ml_aq_hfm_b1 "ml aus Kombination von aq und hfm bestimmt" SWORD FORMULA_0112 0 0 -100.0000 1400.0000 ECU_ADDRESS 0x3FCA6E /end MEASUREMENT
/begin MEASUREMENT ml_aq_hfm_b2 "ml aus Kombination von aq und hfm bestimmt" SWORD FORMULA_0112 0 0 -100.0000 1400.0000 ECU_ADDRESS 0x3FCA70 /end MEASUREMENT
/begin MEASUREMENT mzyl_aq_hfm_b1 "mzyl aus Kombination von aq und hfm bestimmt" SWORD FORMULA_0113 0 0 -500.0000 1500.0000 ECU_ADDRESS 0x3FCA72 /end MEASUREMENT
/begin MEASUREMENT mzyl_aq_hfm_b2 "mzyl aus Kombination von aq und hfm bestimmt" SWORD FORMULA_0113 0 0 -500.0000 1500.0000 ECU_ADDRESS 0x3FCA74 /end MEASUREMENT
/begin FUNCTION Lambda ""
 /begin DEF_CHARACTERISTIC KF_LAM_REG_K KF_LAM_REG_KORR_F KF_LAM_REG_WF_MKS_REL_MAX KF_LAM_REG_WF_VERZ_F KF_LAM_SOLL_ADD_KONV KF_LAM_SOLL_ADD_NEG_OBD KF_LAM_SOLL_ADD_POS_OBD KF_LAM_SOLL_AUSS_KATS KF_LAM_SOLL_AUSS_OFFS KF_LAM_SOLL_GRUND KF_LAM_SOLL_GRUND_PST KF_LAM_SOLL_KR_KATS_OFFS KF_LAM_SOLL_MS_KAT_SOLL_MAX KF_LAM_SOLL_MS_KAT_SOLL_MIN KF_LAM_SOLL_MS_KAT_SOLL_MIN_OBD KF_LAM_SOLL_PULS_OFFS_AUSR KF_LAM_SOLL_TAU1_ABG KF_LAM_SOLL_WL KF_LAM_SOLL_WL_F KF_LAVK_FILT_T1 KL_LAM_IST KL_LAM_SOLL_ADD_KAT_ALT_F KL_LAM_SOLL_AUSS_F KL_LAM_SOLL_MS_KAT_MAX KL_LAM_SOLL_MS_KAT_SOLL_HYS KL_LAM_SOLL_PULS_ADD_OBD KL_LAM_SOLL_PULS_PW_OBD KL_LAM_SOLL_START KL_LAM_SOLL_VL KL_LAVK_IST_F KL_LAVK_IST_OFFS KL_LAVK_P_KORR_F_FETT KL_LAVK_P_KORR_F_MAGER KL_LAVK_T_KORR_F K_LAA_CFG K_LAA_F_GRAD K_LAA_F_MAX K_LAA_F_MCS_B1 K_LAA_F_MCS_B2 K_LAA_F_MIN K_LAA_F_N_MAX K_LAA_F_N_MIN K_LAA_F_RF_MAX K_LAA_F_RF_MIN K_LAA_F_TE_GRAD K_LAA_F_TE_MAX K_LAA_F_TE_MIN K_LAA_F_TE_N_MAX K_LAA_F_TE_RAMPE K_LAA_F_TE_RF_MAX K_LAA_F_TE_T_ADAPT K_LAA_F_T_ADAPT K_LAA_LAM_REG_F_DELTA K_LAA_OFFS_GRAD K_LAA_OFFS_MAX K_LAA_OFFS_MCS_B1 K_LAA_OFFS_MCS_B2 K_LAA_OFFS_MIN K_LAA_OFFS_N_MAX K_LAA_OFFS_RF_MAX K_LAA_OFFS_T_ADAPT K_LAA_PKS_MAX K_LAA_RESET_CFG K_LAA_TAN_MAX K_LAA_TI_IST_MIN K_LAA_TMOT_MIN K_LAM_DIAG_CFG K_LAM_DIAG_LAA_F_HYS K_LAM_DIAG_LAA_IO_T K_LAM_DIAG_LAA_OFFS_HYS K_LAM_DIAG_LAA_T K_LAM_DIAG_REG_T K_LAM_REG_CFG K_LAM_REG_DELTA_MAX K_LAM_REG_DELTA_MIN K_LAM_REG_DELTA_STAT_MAX K_LAM_REG_DELTA_STAT_MAX_TE K_LAM_REG_DELTA_STAT_TRIM K_LAM_REG_F_MAX K_LAM_REG_F_MIN K_LAM_REG_IST_MW_MAX K_LAM_REG_IST_MW_MIN K_LAM_REG_RESET_CFG K_LAM_REG_RESET_SA_TMOT_MIN K_LAM_REG_SOLL_MAX K_LAM_REG_SOLL_MIN K_LAM_REG_START_TIME K_LAM_REG_TI_IST_MIN K_LAM_REG_TN_TU_F K_LAM_REG_TV_TU_F K_LAM_REG_T_SA_VERZ K_LAM_REG_T_SLP_VERZ K_LAM_SEGM_V214_FAK2 K_LAM_SOLL_ADD_KONV_GRAD K_LAM_SOLL_FETT_ERK K_LAM_SOLL_FILT_F K_LAM_SOLL_KATH_DELTA_NEG K_LAM_SOLL_KATH_DELTA_POS K_LAM_SOLL_KATH_T_ML_MAX K_LAM_SOLL_KONV_CFG K_LAM_SOLL_KR_KATS K_LAM_SOLL_MAX K_LAM_SOLL_MIN K_LAM_SOLL_MS_KAT_F_OBD K_LAM_SOLL_MS_KAT_MIN K_LAM_SOLL_MS_KAT_OFFSET_OBD K_LAM_SOLL_MS_KAT_SOLL_MAX_OBD K_LAM_SOLL_O2_ANT K_LAM_SOLL_OFFS_MCS K_LAM_SOLL_PULS_AUSR_CFG K_LAM_SOLL_PULS_AUSR_SL_CFG K_LAM_SOLL_PULS_AUSR_SL_T K_LAM_SOLL_PULS_LANK_CFG K_LAM_SOLL_PULS_LANK_MAX K_LAM_SOLL_PULS_LANK_MIN K_LAM_SOLL_PULS_O2_HYST K_LAM_SOLL_T_FETT_MIN K_LAM_SOLL_T_SA_SLP_MIN K_LAM_SOLL_WL_DELTA_NEG K_LAM_SOLL_WL_DELTA_POS K_LAM_SOLL_WL_TMOT_HYS K_LAM_SOLL_WL_TMOT_MAX K_LAVK_AD_GAIN_CNT K_LAVK_AD_GAIN_CNT_MIN K_LAVK_AD_GAIN_GRAD K_LAVK_AD_GAIN_MIN K_LAVK_AD_GAIN_ML_MIN K_LAVK_AD_GAIN_NV_MAX K_LAVK_AD_GAIN_NV_MIN K_LAVK_AD_GAIN_T K_LAVK_AD_GAIN_T1 K_LAVK_AD_MAX K_LAVK_AD_MIN K_LAVK_AD_OFFS_CNT K_LAVK_AD_OFFS_CNT_MIN K_LAVK_AD_OFFS_CNT_MIN_MS K_LAVK_AD_OFFS_CNT_MS K_LAVK_AD_OFFS_GRAD K_LAVK_AD_OFFS_MAX K_LAVK_AD_OFFS_MIN K_LAVK_AD_OFFS_NV_MAX K_LAVK_AD_OFFS_NV_MIN K_LAVK_AD_OFFS_T K_LAVK_AD_OFFS_T1 K_LAVK_AD_RESET K_LAVK_AD_TEST K_LAVK_ATIC42_ICP_ENABLE_B1 K_LAVK_ATIC42_ICP_ENABLE_B2 K_LAVK_ATIC42_ICP_VALUE_B1 K_LAVK_ATIC42_ICP_VALUE_B2 K_LAVK_ATIC42_IP_OFFSET_MEAS_B1 K_LAVK_ATIC42_IP_OFFSET_MEAS_B2 K_LAVK_ATIC42_PIN_CFG_B1 K_LAVK_ATIC42_PIN_CFG_B2 K_LAVK_ATIC42_PROTEC_TIME_B1 K_LAVK_ATIC42_PROTEC_TIME_B2 K_LAVK_ATIC42_RI_CALIB_B1 K_LAVK_ATIC42_RI_CALIB_B2 K_LAVK_ATIC42_RI_MEAS_FREQ_B1 K_LAVK_ATIC42_RI_MEAS_FREQ_B2 K_LAVK_ATIC42_RI_OSCI_B1 K_LAVK_ATIC42_RI_OSCI_B2 K_LAVK_ATIC42_SENSOR_B1 K_LAVK_ATIC42_SENSOR_B2 K_LAVK_ATIC42_SPI_DIAG_CNT K_LAVK_FILT_CFG K_LAVK_GAIN_LAM_SCHW K_LAVK_R7 K_LAVK_US_LUFT_REF K_LAVK_US_REF /end DEF_CHARACTERISTIC
 /begin REF_CHARACTERISTIC /end REF_CHARACTERISTIC
 /begin IN_MEASUREMENT /end IN_MEASUREMENT
 /begin OUT_MEASUREMENT laa_f_b1 laa_f_b2 laa_f_mw_cnt_b1 laa_f_mw_cnt_b2 laa_f_mw_t_b1 laa_f_mw_t_b2 laa_f_te_mw_cnt_b1 laa_f_te_mw_cnt_b2 laa_f_te_mw_t_b1 laa_f_te_mw_t_b2 laa_offs_begr_b1 laa_offs_begr_b2 laa_offs_mw_cnt_b1 laa_offs_mw_cnt_b2 laa_offs_mw_t_b1 laa_offs_mw_t_b2 lam.atic42_ip_gain_b1 lam.atic42_ip_gain_b2 lam.laa_f_begr_b1 lam.laa_f_begr_b2 lam.laa_f_te_begr_b1 lam.laa_f_te_begr_b2 lam.laa_offs_begr_b1 lam.laa_offs_begr_b2 lam.laa_stat_b1 lam.laa_stat_b2 lam.laa_status_b1 lam.laa_status_b2 lam.laa_ti_ist_b1 lam.laa_ti_ist_b2 lam.lavk_status_b1 lam.lavk_status_b2 lam_b1.ad_gain_cnt lam_b1.ad_offs_cnt lam_b1.ip_gain lam_b1.ist_ad lam_b1.ist_mw_grad lam_b1.laa_f_te lam_b1.laa_f_te_grad_neg lam_b1.laa_ml_f lam_b1.laa_ml_f_te lam_b1.laa_ml_offs lam_b1.laa_st lam_b1.lavk_ad lam_b1.lavk_ad_gain_filt lam_b1.lavk_ad_korr lam_b1.lavk_ad_mw lam_b1.lavk_ad_mw_korr lam_b1.lavk_ad_offs_filt lam_b1.lavk_filt_konst lam_b1.lavk_ip lam_b1.lavk_ip_korr lam_b1.lavk_ip_mw lam_b1.lavk_ip_mw_korr lam_b1.lavk_korr_f lam_b1.lavk_st lam_b1.lavk_tau1 lam_b1.mks_soll_zyl lam_b1.ml_delta lam_b1.reg_k lam_b1.reg_tn_i lam_b1.reg_tn_roh lam_b1.reg_tv_d lam_b1.wf_verz_time lam_b1.zahn_nr lam_b2.ad_gain_cnt lam_b2.ad_offs_cnt lam_b2.ip_gain lam_b2.ist_ad lam_b2.ist_mw_grad lam_b2.laa_f_te lam_b2.laa_f_te_grad_neg lam_b2.laa_ml_f lam_b2.laa_ml_f_te lam_b2.laa_ml_offs lam_b2.laa_st lam_b2.lavk_ad lam_b2.lavk_ad_gain_filt lam_b2.lavk_ad_korr lam_b2.lavk_ad_mw lam_b2.lavk_ad_mw_korr lam_b2.lavk_ad_offs_filt lam_b2.lavk_filt_konst lam_b2.lavk_ip lam_b2.lavk_ip_korr lam_b2.lavk_ip_mw lam_b2.lavk_ip_mw_korr lam_b2.lavk_korr_f lam_b2.lavk_st lam_b2.lavk_tau1 lam_b2.mks_soll_zyl lam_b2.ml_delta lam_b2.reg_k lam_b2.reg_tn_i lam_b2.reg_tn_roh lam_b2.reg_tv_d lam_b2.wf_verz_time lam_b2.zahn_nr lam_diag_la_adapt_scdn_b1 lam_diag_la_adapt_scdn_b2 lam_diag_laa_f_cnt_b1 lam_diag_laa_f_cnt_b2 lam_diag_laa_f_max_aktiv_b1 lam_diag_laa_f_max_aktiv_b2 lam_diag_laa_f_min_aktiv_b1 lam_diag_laa_f_min_aktiv_b2 lam_diag_laa_f_t_b1 lam_diag_laa_f_t_b2 lam_diag_laa_io_t_b1 lam_diag_laa_io_t_b2 lam_diag_laa_offs_cnt_b1 lam_diag_laa_offs_cnt_b2 lam_diag_laa_offs_max_aktiv_b1 lam_diag_laa_offs_max_aktiv_b2 lam_diag_laa_offs_min_aktiv_b1 lam_diag_laa_offs_min_aktiv_b2 lam_diag_laa_offs_t_b1 lam_diag_laa_offs_t_b2 lam_diag_lam_reg_scdn_b1 lam_diag_lam_reg_scdn_b2 lam_diag_reg_io_t_b1 lam_diag_reg_io_t_b2 lam_diag_reg_max_aktiv_b1 lam_diag_reg_max_aktiv_b2 lam_diag_reg_min_aktiv_b1 lam_diag_reg_min_aktiv_b2 lam_diag_reg_t_b1 lam_diag_reg_t_b2 lam_diag_st_b1 lam_diag_st_b2 lam_ist_1of2_1of5_ lam_ist_1of2_2of5_ lam_ist_1of2_3of5_ lam_ist_1of2_4of5_ lam_ist_1of2_5of5_ lam_ist_2of2_1of5_ lam_ist_2of2_2of5_ lam_ist_2of2_3of5_ lam_ist_2of2_4of5_ lam_ist_2of2_5of5_ lam_ist_mw_korr_b1 lam_ist_mw_korr_b2 lam_ist_seg_1of2_1of5_ lam_ist_seg_1of2_2of5_ lam_ist_seg_1of2_3of5_ lam_ist_seg_1of2_4of5_ lam_ist_seg_1of2_5of5_ lam_ist_seg_2of2_1of5_ lam_ist_seg_2of2_2of5_ lam_ist_seg_2of2_3of5_ lam_ist_seg_2of2_4of5_ lam_ist_seg_2of2_5of5_ lam_ml_delta_rel_1of2_1of3_ lam_ml_delta_rel_1of2_2of3_ lam_ml_delta_rel_1of2_3of3_ lam_ml_delta_rel_2of2_1of3_ lam_ml_delta_rel_2of2_2of3_ lam_ml_delta_rel_2of2_3of3_ lam_reg_f_max_b1 lam_reg_f_max_b2 lam_reg_f_min_b1 lam_reg_f_min_b2 lam_soll_add_kat_alt_f_b1 lam_soll_add_kat_alt_f_b2 lam_soll_auss_f lam_soll_auss_offs lam_soll_bz_md lam_soll_ms_kat_f_obd lam_soll_ms_kat_max lam_soll_ms_kat_offs_obd lam_soll_ms_kat_soll_max lam_soll_ms_kat_soll_min lam_soll_ms_kat_trig_sa_b1 lam_soll_ms_kat_trig_sa_b2 lam_soll_ms_kat_trig_schw lam_soll_norm_b1 lam_soll_norm_b2 lam_soll_start lam_soll_tau1_abg lam_soll_verz_1of2_1of5_ lam_soll_verz_1of2_2of5_ lam_soll_verz_1of2_3of5_ lam_soll_verz_1of2_4of5_ lam_soll_verz_1of2_5of5_ lam_soll_verz_2of2_1of5_ lam_soll_verz_2of2_2of5_ lam_soll_verz_2of2_3of5_ lam_soll_verz_2of2_4of5_ lam_soll_verz_2of2_5of5_ lam_soll_wf_f lam_w_b1.ml_zyl_filt lam_w_b1.soll_add_konv lam_w_b1.soll_add_temp lam_w_b1.soll_bas lam_w_b1.soll_bas_diff lam_w_b1.soll_bas_lim lam_w_b1.soll_delta_neg lam_w_b1.soll_delta_pos lam_w_b1.soll_filt lam_w_b1.soll_filt_konst lam_w_b1.soll_kr_kats_offs lam_w_b1.soll_ms_kat_delta lam_w_b1.soll_ms_kat_init lam_w_b1.soll_st lam_w_b1.soll_stat lam_w_b1.soll_tau1 lam_w_b1.soll_vl_bezug lam_w_b1.soll_zust_st lam_w_b1.tz_offs_kats lam_w_b2.ml_zyl_filt lam_w_b2.soll_add_konv lam_w_b2.soll_add_temp lam_w_b2.soll_bas lam_w_b2.soll_bas_diff lam_w_b2.soll_bas_lim lam_w_b2.soll_delta_neg lam_w_b2.soll_delta_pos lam_w_b2.soll_filt lam_w_b2.soll_filt_konst lam_w_b2.soll_kr_kats_offs lam_w_b2.soll_ms_kat_delta lam_w_b2.soll_ms_kat_init lam_w_b2.soll_st lam_w_b2.soll_stat lam_w_b2.soll_tau1 lam_w_b2.soll_vl_bezug lam_w_b2.soll_zust_st lam_w_b2.tz_offs_kats lavk_ad_gain_cnt_t_b1 lavk_ad_gain_cnt_t_b2 lavk_ad_gain_delta_t_b1 lavk_ad_gain_delta_t_b2 lavk_ad_gain_freig_b1 lavk_ad_gain_freig_b2 lavk_ad_gain_st_b1 lavk_ad_gain_st_b2 lavk_ad_offs_cnt_t_b1 lavk_ad_offs_cnt_t_b2 lavk_ad_offs_delta_t_b1 lavk_ad_offs_delta_t_b2 lavk_ad_offs_freig_b1 lavk_ad_offs_freig_b2 lavk_ad_offs_ml_b1 lavk_ad_offs_ml_b2 lavk_ad_offs_ms_b1 lavk_ad_offs_ms_b2 lavk_ad_offs_spi_b1 lavk_ad_offs_spi_b2 lavk_ad_offs_st_b1 lavk_ad_offs_st_b2 lavk_ad_st_b1 lavk_ad_st_b2 lavk_atic42_cnt_b1 lavk_atic42_cnt_b2 lavk_atic42_diag_byte_b1 lavk_atic42_diag_byte_b2 lavk_atic42_diag_st_b1 lavk_atic42_diag_st_b2 lavk_atic42_icp_enable_b1 lavk_atic42_icp_enable_b2 lavk_atic42_icp_value_b1 lavk_atic42_icp_value_b2 lavk_atic42_identity_b1 lavk_atic42_identity_b2 lavk_atic42_ip_gain_b1 lavk_atic42_ip_gain_b2 lavk_atic42_ip_loop_enable_b1 lavk_atic42_ip_loop_enable_b2 lavk_atic42_ip_loop_enable_spi_b1 lavk_atic42_ip_loop_enable_spi_b2 lavk_atic42_ip_offs_meas_b1 lavk_atic42_ip_offs_meas_b2 lavk_atic42_ip_offset_meas_b1 lavk_atic42_ip_offset_meas_b2 lavk_atic42_ip_st_b1 lavk_atic42_ip_st_b2 lavk_atic42_mode_b1 lavk_atic42_mode_b2 lavk_atic42_pin_b1 lavk_atic42_pin_b2 lavk_atic42_pin_diag_b1 lavk_atic42_pin_diag_b2 lavk_atic42_protec_time_b1 lavk_atic42_protec_time_b2 lavk_atic42_ri_calib_b1 lavk_atic42_ri_calib_b2 lavk_atic42_ri_calib_spi_b1 lavk_atic42_ri_calib_spi_b2 lavk_atic42_ri_freq_b1 lavk_atic42_ri_freq_b2 lavk_atic42_ri_osci_b1 lavk_atic42_ri_osci_b2 lavk_atic42_ri_osci_spi_b1 lavk_atic42_ri_osci_spi_b2 lavk_atic42_ri_range_b1 lavk_atic42_ri_range_b2 lavk_atic42_ri_range_spi_b1 lavk_atic42_ri_range_spi_b2 lavk_atic42_ri_st_b1 lavk_atic42_ri_st_b2 lavk_atic42_sensor_b1 lavk_atic42_sensor_b2 lavk_atic42_spi_diag_cnt_b1 lavk_atic42_spi_diag_cnt_b2 lavk_spi_buffer_ret ml_zyl_verz_1of2_1of5_ ml_zyl_verz_1of2_2of5_ ml_zyl_verz_1of2_3of5_ ml_zyl_verz_1of2_4of5_ ml_zyl_verz_1of2_5of5_ ml_zyl_verz_2of2_1of5_ ml_zyl_verz_2of2_2of5_ ml_zyl_verz_2of2_3of5_ ml_zyl_verz_2of2_4of5_ ml_zyl_verz_2of2_5of5_ wf_mks_rel_1of2_1of5_ wf_mks_rel_1of2_2of5_ wf_mks_rel_1of2_3of5_ wf_mks_rel_1of2_4of5_ wf_mks_rel_1of2_5of5_ wf_mks_rel_2of2_1of5_ wf_mks_rel_2of2_2of5_ wf_mks_rel_2of2_3of5_ wf_mks_rel_2of2_4of5_ wf_mks_rel_2of2_5of5_ /end OUT_MEASUREMENT
/end FUNCTION
/begin FUNCTION Lambda-NK ""
 /begin DEF_CHARACTERISTIC KF_LANK_OBD_S_LAM_SOLL KF_LANK_US_TAU_L KL_KAT_OBD_LANK_LAM KL_LANK_OBD_SLOPE_ML_T KL_LANK_OBD_S_WE_ML_SUM K_LANK_DIAG_CFG K_LANK_DIAG_GND_T K_LANK_DIAG_MAX_T K_LANK_DIAG_OL_LAM_SOLL_M K_LANK_DIAG_OL_MAGER_CNT K_LANK_DIAG_OL_MAGER_T K_LANK_DIAG_OL_ML_MIN K_LANK_DIAG_OL_ML_STABIL_T K_LANK_DIAG_OL_N_MAX K_LANK_DIAG_OL_N_MIN K_LANK_DIAG_OL_T K_LANK_DIAG_SONDTEMP K_LANK_DIAG_STAB_T K_LANK_DIAG_TKAT K_LANK_DIAG_UMAX K_LANK_DIAG_UMIN K_LANK_DIAG_VK_REG_T K_LANK_FETT K_LANK_MAGER K_LANK_N_MAX K_LANK_N_MIN K_LANK_OBD_SLOPE_CNT K_LANK_OBD_SLOPE_CNT_IO K_LANK_OBD_SLOPE_F_MAX K_LANK_OBD_SLOPE_F_MIN K_LANK_OBD_SLOPE_HYS K_LANK_OBD_SLOPE_NASE_CNT K_LANK_OBD_SLOPE_T_MAX_MODE5 K_LANK_OBD_SLOPE_T_MIN_MODE5 K_LANK_OBD_S_AUTOM_CNT K_LANK_OBD_S_CFG K_LANK_OBD_S_CNT K_LANK_OBD_S_LAM_VKAT K_LANK_OBD_S_NMAX K_LANK_OBD_S_NMIN K_LANK_OBD_S_SA_AUTOM K_LANK_OBD_S_SA_ML_SUM K_LANK_OBD_S_SA_T K_LANK_OBD_S_SA_T_MAX_MODE6 K_LANK_OBD_S_SA_T_MIN_MODE6 K_LANK_OBD_S_SA_T_MODE6_FALSE K_LANK_OBD_S_SA_US K_LANK_OBD_S_SA_WE_T K_LANK_OBD_S_TML K_LANK_OBD_S_USF_SA K_LANK_OBD_S_USF_SLOPE_MAX K_LANK_OBD_S_USF_WE K_LANK_OBD_S_VL_T K_LANK_OBD_S_VL_US K_LANK_OBD_S_WE_CNT K_LANK_OBD_S_WE_LAM_T K_LANK_OBD_S_WE_T K_LANK_OBD_S_WE_US K_LANK_RF_MAX K_LANK_RF_MIN K_LANK_TKAT_SCHW K_LANK_T_AUS K_LANK_T_EIN K_LANK_USF K_LANK_USM K_LANK_US_FILT_OB K_LANK_US_FILT_T K_LANK_US_FILT_UNT K_LANK_US_TAU K_LANK_US_TAU_S /end DEF_CHARACTERISTIC
 /begin REF_CHARACTERISTIC /end REF_CHARACTERISTIC
 /begin IN_MEASUREMENT /end IN_MEASUREMENT
 /begin OUT_MEASUREMENT lank_ad_b1 lank_ad_b2 lank_diag_ol_aussen_b1 lank_diag_ol_aussen_b2 lank_diag_ol_b1 lank_diag_ol_b2 lank_diag_ol_band_b1 lank_diag_ol_band_b2 lank_diag_ol_mager_cnt_b1 lank_diag_ol_mager_cnt_b2 lank_diag_ol_mager_puls_b1 lank_diag_ol_mager_puls_b2 lank_diag_ol_ml_min_b1 lank_diag_ol_ml_min_b2 lank_diag_sh_to_gnd_b1 lank_diag_sh_to_gnd_b2 lank_diag_sh_to_ub_b1 lank_diag_sh_to_ub_b2 lank_diag_st_b1 lank_diag_st_b2 lank_diag_stab_b1 lank_diag_stab_b2 lank_diag_temp_b1 lank_diag_temp_b2 lank_lam_b1 lank_lam_b2 lank_obd_s_bed_b1 lank_obd_s_bed_b2 lank_obd_s_cnt_ausw_b1 lank_obd_s_cnt_ausw_b2 lank_obd_s_cnt_b1 lank_obd_s_cnt_b2 lank_obd_s_diag_b1 lank_obd_s_diag_b2 lank_obd_s_lam_soll_b1 lank_obd_s_lam_soll_b2 lank_obd_s_sa_diag_b1 lank_obd_s_sa_diag_b2 lank_obd_s_sa_phase_b1 lank_obd_s_sa_phase_b2 lank_obd_s_sa_schalt_b1 lank_obd_s_sa_schalt_b2 lank_obd_s_sa_t_mess_b1 lank_obd_s_sa_t_mess_b2 lank_obd_s_sa_we_b1 lank_obd_s_sa_we_b2 lank_obd_s_st_b1 lank_obd_s_st_b2 lank_obd_s_usf_sa_b1 lank_obd_s_usf_sa_b2 lank_obd_s_usf_we_b1 lank_obd_s_usf_we_b2 lank_obd_s_vl_diag_b1 lank_obd_s_vl_diag_b2 lank_obd_s_we_cnt_b1 lank_obd_s_we_cnt_b2 lank_obd_s_we_diag_b1 lank_obd_s_we_diag_b2 lank_obd_s_we_lam_time_b1 lank_obd_s_we_lam_time_b2 lank_obd_s_we_ml_sum_b1 lank_obd_s_we_ml_sum_b2 lank_obd_s_we_time_b1 lank_obd_s_we_time_b2 lank_obd_slope_cnt_b1 lank_obd_slope_cnt_b2 lank_obd_slope_cnt_io_b1 lank_obd_slope_cnt_io_b2 lank_obd_slope_nase_cnt_b1 lank_obd_slope_nase_cnt_b2 lank_obd_slope_sa_aktiv_b1 lank_obd_slope_sa_aktiv_b2 lank_obd_slope_sa_bezug_b1 lank_obd_slope_sa_bezug_b2 lank_obd_slope_sa_max_b1 lank_obd_slope_sa_max_b2 lank_obd_slope_sa_max_schw_b1 lank_obd_slope_sa_max_schw_b2 lank_obd_slope_sa_min_b1 lank_obd_slope_sa_min_b2 lank_obd_slope_sa_min_schw_b1 lank_obd_slope_sa_min_schw_b2 lank_obd_slope_sa_nase_b1 lank_obd_slope_sa_nase_b2 lank_obd_slope_sa_usf_io_b1 lank_obd_slope_sa_usf_io_b2 lank_obd_slope_st_b1 lank_obd_slope_st_b2 lank_obd_slope_t_b1 lank_obd_slope_t_b2 lank_obd_slope_t_mw_b1 lank_obd_slope_t_mw_b2 lank_sgn_b1 lank_sgn_b2 lank_st_aus_b1 lank_st_aus_b2 lank_st_aus_diag_b1 lank_st_aus_diag_b2 lank_st_aus_n_b1 lank_st_aus_n_b2 lank_st_aus_rf_b1 lank_st_aus_rf_b2 lank_st_aus_tkat_b1 lank_st_aus_tkat_b2 lank_st_ein_b1 lank_st_ein_b2 lank_st_sonde_b1 lank_st_sonde_b2 lank_st_us_tau_t_b1 lank_st_us_tau_t_b2 lank_us_b1 lank_us_b2 lank_us_filt_b1 lank_us_filt_b2 lank_us_old_slope_b1 lank_us_old_slope_b2 /end OUT_MEASUREMENT
/end FUNCTION
/begin FUNCTION M-Drive ""
 /begin DEF_CHARACTERISTIC K_MDRV_ALBV K_MDRV_CFG K_MDRV_CFG_P400 K_MDRV_DSC K_MDRV_EDCK K_MDRV_ENG K_MDRV_HUD K_MDRV_MOD_SMG K_MDRV_P400_ONLY K_MDRV_P500_START K_MDRV_PTH_CNT_MAX K_MDRV_STG_SMG K_MDRV_TBLINK /end DEF_CHARACTERISTIC
 /begin REF_CHARACTERISTIC /end REF_CHARACTERISTIC
 /begin IN_MEASUREMENT /end IN_MEASUREMENT
 /begin OUT_MEASUREMENT mdrv_flags mdrv_flags_kl15 mdrv_flags_power mdrv_flags_stat mdrv_pth_cnt mdrv_tblink /end OUT_MEASUREMENT
/end FUNCTION
/begin FUNCTION MSA "" /begin DEF_CHARACTERISTIC K_MSA_Kl15OFF_T_LOW /end DEF_CHARACTERISTIC /begin REF_CHARACTERISTIC /end REF_CHARACTERISTIC /begin IN_MEASUREMENT /end IN_MEASUREMENT /begin OUT_MEASUREMENT msa_kl15off_ack msa_pin msa_pin_t_low /end OUT_MEASUREMENT /end FUNCTION
/begin FUNCTION MZYL ""
 /begin DEF_CHARACTERISTIC KF_MZYL_ADAPT_GEW KF_MZYL_ADAPT_RAMPE_DOWN KF_MZYL_ADAPT_RAMPE_UP KL_MZYL_EV_A_MEAN KL_MZYL_PZYL_DP KL_MZYL_PZYL_DP_F K_MZYL_CFG K_MZYL_EV_RUECK K_MZYL_EV_RUECK_TMAX K_MZYL_HFM_AQ_MAX_FAK K_MZYL_HFM_AQ_MIN_FAK K_MZYL_R K_MZYL_START_CFG K_MZYL_T_CFG /end DEF_CHARACTERISTIC
 /begin REF_CHARACTERISTIC /end REF_CHARACTERISTIC
 /begin IN_MEASUREMENT /end IN_MEASUREMENT
 /begin OUT_MEASUREMENT ml_aq_b1 ml_aq_b2 ml_aq_hfm_b1 ml_aq_hfm_b2 ml_lam_b1 ml_lam_b2 ml_psau_b1 ml_psau_b2 mzyl_aq_b1 mzyl_aq_b2 mzyl_aq_hfm_b1 mzyl_aq_hfm_b2 mzyl_b1.aq_rf_fak mzyl_b1.e_mean_ues mzyl_b1.gas_zustand mzyl_b1.ges_asp mzyl_b1.ges_psau mzyl_b1.ges_roh mzyl_b1.ges_rueck mzyl_b1.ml_asp mzyl_b1.ml_lam mzyl_b1.ml_psau mzyl_b1.ml_sum_sa mzyl_b1.ml_sum_we mzyl_b1.mldt mzyl_b1.phi_ev_mean mzyl_b1.pzyl mzyl_b1.rf mzyl_b1.rg_asp mzyl_b1.t_ues_ev mzyl_b1.w_ues_ev mzyl_b2.aq_rf_fak mzyl_b2.e_mean_ues mzyl_b2.gas_zustand mzyl_b2.ges_asp mzyl_b2.ges_psau mzyl_b2.ges_roh mzyl_b2.ges_rueck mzyl_b2.ml_asp mzyl_b2.ml_lam mzyl_b2.ml_psau mzyl_b2.ml_sum_sa mzyl_b2.ml_sum_we mzyl_b2.mldt mzyl_b2.phi_ev_mean mzyl_b2.pzyl mzyl_b2.rf mzyl_b2.rg_asp mzyl_b2.t_ues_ev mzyl_b2.w_ues_ev mzyl_st rf_aq_hfm_b1 rf_aq_hfm_b2 rf_lam_b1 rf_lam_b2 /end OUT_MEASUREMENT
/end FUNCTION
/begin RECORD_LAYOUT TKW_VV_VV_UB FNC_VALUES 1 UBYTE COLUMN_DIR DIRECT /end RECORD_LAYOUT
/begin RECORD_LAYOUT TKW_VV_VV_UW FNC_VALUES 1 UWORD COLUMN_DIR DIRECT /end RECORD_LAYOUT
/begin RECORD_LAYOUT TKW_VV_VV_SW FNC_VALUES 1 SWORD COLUMN_DIR DIRECT /end RECORD_LAYOUT
/begin RECORD_LAYOUT TKL_UW_VV_UW NO_AXIS_PTS_X 1 UBYTE RESERVED 2 BYTE AXIS_PTS_X 3 UWORD INDEX_INCR DIRECT FNC_VALUES 4 UWORD COLUMN_DIR DIRECT /end RECORD_LAYOUT
/begin RECORD_LAYOUT TKL_UW_VV_SW NO_AXIS_PTS_X 1 UBYTE RESERVED 2 BYTE AXIS_PTS_X 3 UWORD INDEX_INCR DIRECT FNC_VALUES 4 SWORD COLUMN_DIR DIRECT /end RECORD_LAYOUT
/begin RECORD_LAYOUT TKL_SW_VV_UW NO_AXIS_PTS_X 1 UBYTE RESERVED 2 BYTE AXIS_PTS_X 3 SWORD INDEX_INCR DIRECT FNC_VALUES 4 UWORD COLUMN_DIR DIRECT /end RECORD_LAYOUT
/begin RECORD_LAYOUT TKL_SW_VV_SW NO_AXIS_PTS_X 1 UBYTE RESERVED 2 BYTE AXIS_PTS_X 3 SWORD INDEX_INCR DIRECT FNC_VALUES 4 SWORD COLUMN_DIR DIRECT /end RECORD_LAYOUT
/begin RECORD_LAYOUT TKF_SW_SW_UW NO_AXIS_PTS_X 1 UBYTE NO_AXIS_PTS_Y 2 UBYTE AXIS_PTS_X 3 SWORD INDEX_INCR DIRECT AXIS_PTS_Y 4 SWORD INDEX_INCR DIRECT FNC_VALUES 5 UWORD COLUMN_DIR DIRECT /end RECORD_LAYOUT
/begin RECORD_LAYOUT TKF_SW_SW_SW NO_AXIS_PTS_X 1 UBYTE NO_AXIS_PTS_Y 2 UBYTE AXIS_PTS_X 3 SWORD INDEX_INCR DIRECT AXIS_PTS_Y 4 SWORD INDEX_INCR DIRECT FNC_VALUES 5 SWORD COLUMN_DIR DIRECT /end RECORD_LAYOUT
/end MODULE
/end PROJECT
