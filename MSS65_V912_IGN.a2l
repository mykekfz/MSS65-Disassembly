/begin PROJECT MSS65-ign-V912 "MSS65 IGN - V912.00-B204.00, data set 0569Q60Z520E"
/begin HEADER "" VERSION "V912.00-B204.00" /end HEADER
/begin MODULE _MSS65-ign "MSS65 IGN - V912.00-B204.00, data 7842800"
/begin MOD_COMMON "" BYTE_ORDER MSB_FIRST /* Default byteorder (Motorola) */ /end MOD_COMMON
/begin COMPU_METHOD FORMULA_0003 "FORMULA_0003" RAT_FUNC "%3.0" "-" COEFFS 0 1 0 0 0 1 /end COMPU_METHOD
/begin COMPU_METHOD FORMULA_0010 "FORMULA_0010" RAT_FUNC "%5.0" "-" COEFFS 0 1 0 0 0 1 /end COMPU_METHOD
/* ------------------ Abschnitt erzeugt aus adapt_glob.dat ------------------ */
/begin COMPU_METHOD FORMULA_0023 "FORMULA_0023" RAT_FUNC "%6.1" "�C" COEFFS 0 10 2732 0 0 1 /end COMPU_METHOD
/begin COMPU_METHOD FORMULA_0073 "FORMULA_0073" RAT_FUNC "%6.1" "s" COEFFS 0 10 0 0 0 1 /end COMPU_METHOD
/begin COMPU_METHOD FORMULA_0075 "FORMULA_0075" RAT_FUNC "%8.3" "-" COEFFS 0 1024 0 0 0 1 /end COMPU_METHOD
/begin COMPU_METHOD FORMULA_0076 "FORMULA_0076" RAT_FUNC "%6.1" "Kelvin" COEFFS 0 10 0 0 0 1 /end COMPU_METHOD
/begin COMPU_METHOD FORMULA_0077 "FORMULA_0077" RAT_FUNC "%6.1" "mbar" COEFFS 0 16 0 0 0 1 /end COMPU_METHOD
/begin COMPU_METHOD FORMULA_0078 "FORMULA_0078" RAT_FUNC "%6.1" "km/h" COEFFS 0 16 0 0 0 1 /end COMPU_METHOD
/* ------------------ Abschnitt erzeugt aus ed_glob.dat ------------------ */
/begin CHARACTERISTIC K_ED_SCDN_ABDECKUNG_EINTRAG "Similar Abdeckung fuer Fehlerspeichereintrag  | EN: Similar-conditions coverage for fault-memory entry" VALUE 0x7195E TKW_VV_VV_UW 100.0 FORMULA_0075 0.0 4.0000 FORMAT "%6.3" /end CHARACTERISTIC
/begin CHARACTERISTIC K_ED_SCDN_ABDECKUNG_AUSTRAG "Similar Abdeckung fuer Fehlerspeicheraustrag  | EN: Similar-conditions coverage for fault-memory clearing" VALUE 0x71960 TKW_VV_VV_UW 100.0 FORMULA_0075 0.0 4.0000 FORMAT "%6.3" /end CHARACTERISTIC
/begin CHARACTERISTIC K_ED_RBM_PUMG_MIN "Mindestluftdruck fuer Rate-Based | EN: Minimum air pressure for rate-based OBD monitoring" VALUE 0x71966 TKW_VV_VV_SW 100.0 FORMULA_0077 400.0000 1200.0000 FORMAT "%4.1" /end CHARACTERISTIC
/begin CHARACTERISTIC K_ED_RBM_TUMG_MIN "Mindesttemperatur | EN: Minimum ambient temperature (rate-based monitoring)" VALUE 0x71968 TKW_VV_VV_SW 100.0 FORMULA_0023 -50.0000 170.0000 FORMAT "%4.1" /end CHARACTERISTIC
/begin CHARACTERISTIC K_ED_RBM_TIME "Gesamtzeit fuer Fahrzyklus | EN: Total time for drive cycle (rate-based monitoring)" VALUE 0x7196A TKW_VV_VV_UW 100.0 FORMULA_0073 0.0 6553.5000 FORMAT "%4.1" /end CHARACTERISTIC
/begin CHARACTERISTIC K_ED_RBM_TIME_V "Geschwindigkeitszeit Fahrzyklus | EN: Time at speed in drive cycle (rate-based monitoring)" VALUE 0x7196C TKW_VV_VV_UW 100.0 FORMULA_0073 0.0 6553.5000 FORMAT "%4.1" /end CHARACTERISTIC
/begin CHARACTERISTIC K_ED_RBM_TIME_LL "Mindestleerlauf Fahrzyklus | EN: Minimum idle time in drive cycle (rate-based monitoring)" VALUE 0x7196E TKW_VV_VV_UW 100.0 FORMULA_0073 0.0 6553.5000 FORMAT "%4.1" /end CHARACTERISTIC
/begin CHARACTERISTIC K_ED_RBM_V_MIN "Mindestgeschwindigkeit Fahrzyklus | EN: Minimum vehicle speed in drive cycle (rate-based monitoring)" VALUE 0x71970 TKW_VV_VV_SW 100.0 FORMULA_0078 -80.0000 360.0000 FORMAT "%4.1" /end CHARACTERISTIC
/begin CHARACTERISTIC K_ED_RBM_EVAP_MIN "Mindesttemperatur EVAP | EN: Mindesttemperatur EVAP" VALUE 0x71972 TKW_VV_VV_SW 100.0 FORMULA_0023 -50.0000 170.0000 FORMAT "%4.1" /end CHARACTERISTIC
/begin CHARACTERISTIC K_ED_RBM_EVAP_MAX "Maximaltemperatur EVAP | EN: Maximaltemperatur EVAP" VALUE 0x71974 TKW_VV_VV_SW 100.0 FORMULA_0023 -50.0000 170.0000 FORMAT "%4.1" /end CHARACTERISTIC
/begin CHARACTERISTIC K_ED_RBM_EVAP_TEMP_DELTA "Max. Differenz zwischen tmot und tumg fuer EVAP | EN: Max. Differenz zwischen tmot und tumg fuer EVAP" VALUE 0x71976 TKW_VV_VV_SW 100.0 FORMULA_0076 -1000.0000 1000.0000 FORMAT "%4.1" /end CHARACTERISTIC
/* ------------------ Abschnitt erzeugt aus dsp.dat ------------------ */ /* ------------------ Abschnitt erzeugt aus ed.dat ------------------ */
/begin CHARACTERISTIC K_ED_SK_TR_IGN.P_CODE_SH_TO_UB "P-Code fuer die Art SH_TO_UB | EN: P-Code fuer die Art SH_TO_UB" VALUE 0x70C60 TKW_VV_VV_UW 100.0 FORMULA_0010 0.0 65535.0000 /end CHARACTERISTIC
/begin CHARACTERISTIC K_ED_TMOT.P_CODE_SH_TO_UB "P-Code fuer die Art SH_TO_UB | EN: Fault code TMOT - OBD P-code reported for short to battery voltage" VALUE 0x70C7A TKW_VV_VV_UW 100.0 FORMULA_0010 0.0 65535.0000 /end CHARACTERISTIC
/begin CHARACTERISTIC K_ED_TMOT_OBD.P_CODE_SH_TO_UB "P-Code fuer die Art SH_TO_UB | EN: Fault code TMOT_OBD - OBD P-code reported for short to battery voltage" VALUE 0x70C94 TKW_VV_VV_UW 100.0 FORMULA_0010 0.0 65535.0000 /end CHARACTERISTIC
/begin CHARACTERISTIC K_ED_TAN1.P_CODE_SH_TO_UB "P-Code fuer die Art SH_TO_UB | EN: Fault code TAN1 - OBD P-code reported for short to battery voltage" VALUE 0x70CAE TKW_VV_VV_UW 100.0 FORMULA_0010 0.0 65535.0000 /end CHARACTERISTIC
/begin CHARACTERISTIC K_ED_TAN2.P_CODE_SH_TO_UB "P-Code fuer die Art SH_TO_UB | EN: Fault code TAN2 - OBD P-code reported for short to battery voltage" VALUE 0x70CC8 TKW_VV_VV_UW 100.0 FORMULA_0010 0.0 65535.0000 /end CHARACTERISTIC
/begin CHARACTERISTIC K_ED_TIME_REL_OBD.P_CODE_SH_TO_UB "P-Code fuer die Art SH_TO_UB | EN: Fault code TIME_REL_OBD - OBD P-code reported for short to battery voltage" VALUE 0x70CE2 TKW_VV_VV_UW 100.0 FORMULA_0010 0.0 65535.0000 /end CHARACTERISTIC
/begin CHARACTERISTIC K_ED_TKA.P_CODE_SH_TO_UB "P-Code fuer die Art SH_TO_UB | EN: Fault code TKA - OBD P-code reported for short to battery voltage" VALUE 0x70D16 TKW_VV_VV_UW 100.0 FORMULA_0010 0.0 65535.0000 /end CHARACTERISTIC
/begin CHARACTERISTIC K_ED_TDME.P_CODE_SH_TO_UB "P-Code fuer die Art SH_TO_UB | EN: Fault code TDME - OBD P-code reported for short to battery voltage" VALUE 0x70D30 TKW_VV_VV_UW 100.0 FORMULA_0010 0.0 65535.0000 /end CHARACTERISTIC
/begin CHARACTERISTIC K_ED_TKA_OBD.P_CODE_SH_TO_UB "P-Code fuer die Art SH_TO_UB | EN: Fault code TKA_OBD - OBD P-code reported for short to battery voltage" VALUE 0x70D98 TKW_VV_VV_UW 100.0 FORMULA_0010 0.0 65535.0000 /end CHARACTERISTIC
/begin CHARACTERISTIC K_ED_PWG1.P_CODE_SH_TO_UB "P-Code fuer die Art SH_TO_UB | EN: Fault code PWG1 - OBD P-code reported for short to battery voltage" VALUE 0x70DB2 TKW_VV_VV_UW 100.0 FORMULA_0010 0.0 65535.0000 /end CHARACTERISTIC
/begin CHARACTERISTIC K_ED_PWG2.P_CODE_SH_TO_UB "P-Code fuer die Art SH_TO_UB | EN: Fault code PWG2 - OBD P-code reported for short to battery voltage" VALUE 0x70DCC TKW_VV_VV_UW 100.0 FORMULA_0010 0.0 65535.0000 /end CHARACTERISTIC
/begin CHARACTERISTIC K_ED_PWG_VGL.P_CODE_SH_TO_UB "P-Code fuer die Art SH_TO_UB | EN: Fault code PWG_VGL - OBD P-code reported for short to battery voltage" VALUE 0x70DE6 TKW_VV_VV_UW 100.0 FORMULA_0010 0.0 65535.0000 /end CHARACTERISTIC
/begin CHARACTERISTIC K_ED_PCTRL_IGN.P_CODE_SH_TO_UB "P-Code fuer die Art SH_TO_UB | EN: Fault code PCTRL_IGN - OBD P-code reported for short to battery voltage" VALUE 0x70E00 TKW_VV_VV_UW 100.0 FORMULA_0010 0.0 65535.0000 /end CHARACTERISTIC
/begin CHARACTERISTIC K_ED_LLS1_CAN.P_CODE_SH_TO_UB "P-Code fuer die Art SH_TO_UB | EN: Fault code LLS1_CAN - OBD P-code reported for short to battery voltage" VALUE 0x70E1A TKW_VV_VV_UW 100.0 FORMULA_0010 0.0 65535.0000 /end CHARACTERISTIC
/begin CHARACTERISTIC K_ED_LLS2_CAN.P_CODE_SH_TO_UB "P-Code fuer die Art SH_TO_UB | EN: Fault code LLS2_CAN - OBD P-code reported for short to battery voltage" VALUE 0x70E34 TKW_VV_VV_UW 100.0 FORMULA_0010 0.0 65535.0000 /end CHARACTERISTIC
/begin CHARACTERISTIC K_ED_LLS1_SK.P_CODE_SH_TO_UB "P-Code fuer die Art SH_TO_UB | EN: Fault code LLS1_SK - OBD P-code reported for short to battery voltage" VALUE 0x70E82 TKW_VV_VV_UW 100.0 FORMULA_0010 0.0 65535.0000 /end CHARACTERISTIC
/begin CHARACTERISTIC K_ED_LLS2_SK.P_CODE_SH_TO_UB "P-Code fuer die Art SH_TO_UB | EN: Fault code LLS2_SK - OBD P-code reported for short to battery voltage" VALUE 0x70E9C TKW_VV_VV_UW 100.0 FORMULA_0010 0.0 65535.0000 /end CHARACTERISTIC
/begin CHARACTERISTIC K_ED_SMG_SCHALTAB.P_CODE_SH_TO_UB "P-Code fuer die Art SH_TO_UB | EN: Fault code SMG_SCHALTAB - OBD P-code reported for short to battery voltage" VALUE 0x70EB6 TKW_VV_VV_UW 100.0 FORMULA_0010 0.0 65535.0000 /end CHARACTERISTIC
/begin CHARACTERISTIC K_ED_SMG_SK.P_CODE_SH_TO_UB "P-Code fuer die Art SH_TO_UB | EN: Fault code SMG_SK - OBD P-code reported for short to battery voltage" VALUE 0x70ED0 TKW_VV_VV_UW 100.0 FORMULA_0010 0.0 65535.0000 /end CHARACTERISTIC
/begin CHARACTERISTIC K_ED_SMG_SK_N.P_CODE_SH_TO_UB "P-Code fuer die Art SH_TO_UB | EN: Fault code SMG_SK_N - OBD P-code reported for short to battery voltage" VALUE 0x70EEA TKW_VV_VV_UW 100.0 FORMULA_0010 0.0 65535.0000 /end CHARACTERISTIC
/begin CHARACTERISTIC K_ED_IONVERST_B1.P_CODE_SH_TO_UB "P-Code fuer die Art SH_TO_UB" VALUE 0x70FBA TKW_VV_VV_UW 100.0 FORMULA_0010 0.0 65535.0000 /end CHARACTERISTIC
/begin CHARACTERISTIC K_ED_IONSPG_B1.P_CODE_SH_TO_UB "P-Code fuer die Art SH_TO_UB" VALUE 0x70FD4 TKW_VV_VV_UW 100.0 FORMULA_0010 0.0 65535.0000 /end CHARACTERISTIC
/begin CHARACTERISTIC K_ED_IONVERST_B2.P_CODE_SH_TO_UB "P-Code fuer die Art SH_TO_UB" VALUE 0x70FEE TKW_VV_VV_UW 100.0 FORMULA_0010 0.0 65535.0000 /end CHARACTERISTIC
/begin CHARACTERISTIC K_ED_IONSPG_B2.P_CODE_SH_TO_UB "P-Code fuer die Art SH_TO_UB" VALUE 0x71008 TKW_VV_VV_UW 100.0 FORMULA_0010 0.0 65535.0000 /end CHARACTERISTIC
/begin CHARACTERISTIC K_ED_TABG1.P_CODE_SH_TO_UB "P-Code fuer die Art SH_TO_UB | EN: Fault code TABG1 - OBD P-code reported for short to battery voltage" VALUE 0x71022 TKW_VV_VV_UW 100.0 FORMULA_0010 0.0 65535.0000 /end CHARACTERISTIC
/begin CHARACTERISTIC K_ED_TABG2.P_CODE_SH_TO_UB "P-Code fuer die Art SH_TO_UB | EN: Fault code TABG2 - OBD P-code reported for short to battery voltage" VALUE 0x7103C TKW_VV_VV_UW 100.0 FORMULA_0010 0.0 65535.0000 /end CHARACTERISTIC
/begin CHARACTERISTIC K_ED_LLS1_REGLER.P_CODE_SH_TO_UB "P-Code fuer die Art SH_TO_UB | EN: Fault code LLS1_REGLER - OBD P-code reported for short to battery voltage" VALUE 0x710BE TKW_VV_VV_UW 100.0 FORMULA_0010 0.0 65535.0000 /end CHARACTERISTIC
/begin CHARACTERISTIC K_ED_LLS2_REGLER.P_CODE_SH_TO_UB "P-Code fuer die Art SH_TO_UB | EN: Fault code LLS2_REGLER - OBD P-code reported for short to battery voltage" VALUE 0x710D8 TKW_VV_VV_UW 100.0 FORMULA_0010 0.0 65535.0000 /end CHARACTERISTIC
/begin CHARACTERISTIC K_ED_MD_SK_ERR.P_CODE_SH_TO_UB "P-Code fuer die Art SH_TO_UB | EN: Fault code MD_SK_ERR - OBD P-code reported for short to battery voltage" VALUE 0x7115A TKW_VV_VV_UW 100.0 FORMULA_0010 0.0 65535.0000 /end CHARACTERISTIC
/begin CHARACTERISTIC K_ED_LLS_INIT.P_CODE_SH_TO_UB "P-Code fuer die Art SH_TO_UB | EN: Fault code LLS_INIT - OBD P-code reported for short to battery voltage" VALUE 0x71174 TKW_VV_VV_UW 100.0 FORMULA_0010 0.0 65535.0000 /end CHARACTERISTIC
/begin CHARACTERISTIC K_ED_LLS1_CMD.P_CODE_SH_TO_UB "P-Code fuer die Art SH_TO_UB | EN: Fault code LLS1_CMD - OBD P-code reported for short to battery voltage" VALUE 0x711DC TKW_VV_VV_UW 100.0 FORMULA_0010 0.0 65535.0000 /end CHARACTERISTIC
/begin CHARACTERISTIC K_ED_LLS2_CMD.P_CODE_SH_TO_UB "P-Code fuer die Art SH_TO_UB | EN: Fault code LLS2_CMD - OBD P-code reported for short to battery voltage" VALUE 0x711F6 TKW_VV_VV_UW 100.0 FORMULA_0010 0.0 65535.0000 /end CHARACTERISTIC
/begin CHARACTERISTIC K_ED_SC_SMG1.P_CODE_SH_TO_UB "P-Code fuer die Art SH_TO_UB | EN: Fault code SC_SMG1 - OBD P-code reported for short to battery voltage" VALUE 0x71210 TKW_VV_VV_UW 100.0 FORMULA_0010 0.0 65535.0000 /end CHARACTERISTIC
/begin CHARACTERISTIC K_ED_SC_SMG2.P_CODE_SH_TO_UB "P-Code fuer die Art SH_TO_UB | EN: Fault code SC_SMG2 - OBD P-code reported for short to battery voltage" VALUE 0x7122A TKW_VV_VV_UW 100.0 FORMULA_0010 0.0 65535.0000 /end CHARACTERISTIC
/begin CHARACTERISTIC K_ED_SC_SMG3.P_CODE_SH_TO_UB "P-Code fuer die Art SH_TO_UB | EN: Fault code SC_SMG3 - OBD P-code reported for short to battery voltage" VALUE 0x71244 TKW_VV_VV_UW 100.0 FORMULA_0010 0.0 65535.0000 /end CHARACTERISTIC
/begin CHARACTERISTIC K_ED_SC_BUSOFF.P_CODE_SH_TO_UB "P-Code fuer die Art SH_TO_UB | EN: Fault code SC_BUSOFF - OBD P-code reported for short to battery voltage" VALUE 0x7125E TKW_VV_VV_UW 100.0 FORMULA_0010 0.0 65535.0000 /end CHARACTERISTIC
/begin CHARACTERISTIC K_ED_ION_SIG_B1.P_CODE_SH_TO_UB "P-Code fuer die Art SH_TO_UB" VALUE 0x71396 TKW_VV_VV_UW 100.0 FORMULA_0010 0.0 65535.0000 /end CHARACTERISTIC
/begin CHARACTERISTIC K_ED_ION_SIG_B2.P_CODE_SH_TO_UB "P-Code fuer die Art SH_TO_UB" VALUE 0x713B0 TKW_VV_VV_UW 100.0 FORMULA_0010 0.0 65535.0000 /end CHARACTERISTIC
/begin CHARACTERISTIC K_ED_ION_SAT_B1.P_CODE_SH_TO_UB "P-Code fuer die Art SH_TO_UB" VALUE 0x714E8 TKW_VV_VV_UW 100.0 FORMULA_0010 0.0 65535.0000 /end CHARACTERISTIC
/begin CHARACTERISTIC K_ED_ION_SAT_B2.P_CODE_SH_TO_UB "P-Code fuer die Art SH_TO_UB" VALUE 0x71502 TKW_VV_VV_UW 100.0 FORMULA_0010 0.0 65535.0000 /end CHARACTERISTIC
/begin CHARACTERISTIC K_ED_TAN_OBD_B1.P_CODE_SH_TO_UB "P-Code fuer die Art SH_TO_UB | EN: Fault code TAN_OBD_B1 - OBD P-code reported for short to battery voltage" VALUE 0x71536 TKW_VV_VV_UW 100.0 FORMULA_0010 0.0 65535.0000 /end CHARACTERISTIC
/begin CHARACTERISTIC K_ED_INDEX_88_IGN.P_CODE_SH_TO_UB "P-Code fuer die Art SH_TO_UB | EN: P-Code fuer die Art SH_TO_UB" VALUE 0x71550 TKW_VV_VV_UW 100.0 FORMULA_0010 0.0 65535.0000 /end CHARACTERISTIC
/begin CHARACTERISTIC K_ED_INDEX_89_IGN.P_CODE_SH_TO_UB "P-Code fuer die Art SH_TO_UB" VALUE 0x7156A TKW_VV_VV_UW 100.0 FORMULA_0010 0.0 65535.0000 /end CHARACTERISTIC
/begin CHARACTERISTIC K_ED_SG_IGN.P_CODE_SH_TO_UB "P-Code fuer die Art SH_TO_UB | EN: Fault code SG_IGN - OBD P-code reported for short to battery voltage" VALUE 0x715B8 TKW_VV_VV_UW 100.0 FORMULA_0010 0.0 65535.0000 /end CHARACTERISTIC
/begin CHARACTERISTIC K_ED_SK_MANAGER_IGN.P_CODE_SH_TO_UB "P-Code fuer die Art SH_TO_UB | EN: Fault code SK_MANAGER_IGN - OBD P-code reported for short to battery voltage" VALUE 0x71606 TKW_VV_VV_UW 100.0 FORMULA_0010 0.0 65535.0000 /end CHARACTERISTIC
/begin CHARACTERISTIC K_ED_LLR_DIAG.P_CODE_SH_TO_UB "P-Code fuer die Art SH_TO_UB | EN: Fault code LLR_DIAG - OBD P-code reported for short to battery voltage" VALUE 0x71620 TKW_VV_VV_UW 100.0 FORMULA_0010 0.0 65535.0000 /end CHARACTERISTIC
/begin CHARACTERISTIC K_ED_THERMOSTAT.P_CODE_SH_TO_UB "P-Code fuer die Art SH_TO_UB | EN: Fault code THERMOSTAT - OBD P-code reported for short to battery voltage" VALUE 0x7163A TKW_VV_VV_UW 100.0 FORMULA_0010 0.0 65535.0000 /end CHARACTERISTIC
/begin CHARACTERISTIC K_ED_TAN_OBD_B2.P_CODE_SH_TO_UB "P-Code fuer die Art SH_TO_UB | EN: Fault code TAN_OBD_B2 - OBD P-code reported for short to battery voltage" VALUE 0x71654 TKW_VV_VV_UW 100.0 FORMULA_0010 0.0 65535.0000 /end CHARACTERISTIC
/begin CHARACTERISTIC K_ED_PWG_BLS.P_CODE_SH_TO_UB "P-Code fuer die Art SH_TO_UB | EN: Fault code PWG_BLS - OBD P-code reported for short to battery voltage" VALUE 0x716BC TKW_VV_VV_UW 100.0 FORMULA_0010 0.0 65535.0000 /end CHARACTERISTIC
/begin CHARACTERISTIC K_ED_START_RL.P_CODE_SH_TO_UB "P-Code fuer die Art SH_TO_UB | EN: Fault code START_RL - OBD P-code reported for short to battery voltage" VALUE 0x716D6 TKW_VV_VV_UW 100.0 FORMULA_0010 0.0 65535.0000 /end CHARACTERISTIC
/begin CHARACTERISTIC K_ED_N_GETR_EIN_HS.P_CODE_SH_TO_UB "P-Code fuer die Art SH_TO_UB | EN: Fault code N_GETR_EIN_HS - OBD P-code reported for short to battery voltage" VALUE 0x7170A TKW_VV_VV_UW 100.0 FORMULA_0010 0.0 65535.0000 /end CHARACTERISTIC
/begin CHARACTERISTIC K_ED_LLR_DIAG_CSS.P_CODE_SH_TO_UB "P-Code fuer die Art SH_TO_UB | EN: Fault code LLR_DIAG_CSS - OBD P-code reported for short to battery voltage" VALUE 0x7173E TKW_VV_VV_UW 100.0 FORMULA_0010 0.0 65535.0000 /end CHARACTERISTIC
/begin CHARACTERISTIC K_ED_TMOT_OBD_HIGH.P_CODE_SH_TO_UB "P-Code fuer die Art SH_TO_UB | EN: Fault code TMOT_OBD_HIGH - OBD P-code reported for short to battery voltage" VALUE 0x71758 TKW_VV_VV_UW 100.0 FORMULA_0010 0.0 65535.0000 /end CHARACTERISTIC
/begin CHARACTERISTIC K_ED_INDEX_121_IGN.P_CODE_SH_TO_UB "P-Code fuer die Art SH_TO_UB | EN: Fault code INDEX_121_IGN - OBD P-code reported for short to battery voltage" VALUE 0x718AA TKW_VV_VV_UW 100.0 FORMULA_0010 0.0 65535.0000 /end CHARACTERISTIC
/begin CHARACTERISTIC K_ED_INDEX_122_IGN.P_CODE_SH_TO_UB "P-Code fuer die Art SH_TO_UB | EN: Fault code INDEX_122_IGN - OBD P-code reported for short to battery voltage" VALUE 0x718C4 TKW_VV_VV_UW 100.0 FORMULA_0010 0.0 65535.0000 /end CHARACTERISTIC
/begin CHARACTERISTIC K_ED_INDEX_123_IGN.P_CODE_SH_TO_UB "P-Code fuer die Art SH_TO_UB | EN: Fault code INDEX_123_IGN - OBD P-code reported for short to battery voltage" VALUE 0x718DE TKW_VV_VV_UW 100.0 FORMULA_0010 0.0 65535.0000 /end CHARACTERISTIC
/begin CHARACTERISTIC K_ED_INDEX_124_IGN.P_CODE_SH_TO_UB "P-Code fuer die Art SH_TO_UB | EN: Fault code INDEX_124_IGN - OBD P-code reported for short to battery voltage" VALUE 0x718F8 TKW_VV_VV_UW 100.0 FORMULA_0010 0.0 65535.0000 /end CHARACTERISTIC
/begin CHARACTERISTIC K_ED_INDEX_125_IGN.P_CODE_SH_TO_UB "P-Code fuer die Art SH_TO_UB | EN: Fault code INDEX_125_IGN - OBD P-code reported for short to battery voltage" VALUE 0x71912 TKW_VV_VV_UW 100.0 FORMULA_0010 0.0 65535.0000 /end CHARACTERISTIC
/begin CHARACTERISTIC K_ED_INDEX_126_IGN.P_CODE_SH_TO_UB "P-Code fuer die Art SH_TO_UB | EN: Fault code INDEX_126_IGN - OBD P-code reported for short to battery voltage" VALUE 0x7192C TKW_VV_VV_UW 100.0 FORMULA_0010 0.0 65535.0000 /end CHARACTERISTIC
/begin CHARACTERISTIC K_ED_INDEX_127_IGN.P_CODE_SH_TO_UB "P-Code fuer die Art SH_TO_UB | EN: Fault code INDEX_127_IGN - OBD P-code reported for short to battery voltage" VALUE 0x71946 TKW_VV_VV_UW 100.0 FORMULA_0010 0.0 65535.0000 /end CHARACTERISTIC
/begin CHARACTERISTIC K_ED_SK_TR_IGN.P_CODE_SH_TO_GND "P-Code fuer die Art SH_TO_GND | EN: P-Code fuer die Art SH_TO_GND" VALUE 0x70C62 TKW_VV_VV_UW 100.0 FORMULA_0010 0.0 65535.0000 /end CHARACTERISTIC
/begin CHARACTERISTIC K_ED_TMOT.P_CODE_SH_TO_GND "P-Code fuer die Art SH_TO_GND | EN: Fault code TMOT - OBD P-code reported for short to ground" VALUE 0x70C7C TKW_VV_VV_UW 100.0 FORMULA_0010 0.0 65535.0000 /end CHARACTERISTIC
/begin CHARACTERISTIC K_ED_TMOT_OBD.P_CODE_SH_TO_GND "P-Code fuer die Art SH_TO_GND | EN: Fault code TMOT_OBD - OBD P-code reported for short to ground" VALUE 0x70C96 TKW_VV_VV_UW 100.0 FORMULA_0010 0.0 65535.0000 /end CHARACTERISTIC
/begin CHARACTERISTIC K_ED_TAN1.P_CODE_SH_TO_GND "P-Code fuer die Art SH_TO_GND | EN: Fault code TAN1 - OBD P-code reported for short to ground" VALUE 0x70CB0 TKW_VV_VV_UW 100.0 FORMULA_0010 0.0 65535.0000 /end CHARACTERISTIC
/begin CHARACTERISTIC K_ED_TAN2.P_CODE_SH_TO_GND "P-Code fuer die Art SH_TO_GND | EN: Fault code TAN2 - OBD P-code reported for short to ground" VALUE 0x70CCA TKW_VV_VV_UW 100.0 FORMULA_0010 0.0 65535.0000 /end CHARACTERISTIC
/begin CHARACTERISTIC K_ED_TIME_REL_OBD.P_CODE_SH_TO_GND "P-Code fuer die Art SH_TO_GND | EN: Fault code TIME_REL_OBD - OBD P-code reported for short to ground" VALUE 0x70CE4 TKW_VV_VV_UW 100.0 FORMULA_0010 0.0 65535.0000 /end CHARACTERISTIC
/begin CHARACTERISTIC K_ED_TKA.P_CODE_SH_TO_GND "P-Code fuer die Art SH_TO_GND | EN: Fault code TKA - OBD P-code reported for short to ground" VALUE 0x70D18 TKW_VV_VV_UW 100.0 FORMULA_0010 0.0 65535.0000 /end CHARACTERISTIC
/begin CHARACTERISTIC K_ED_TDME.P_CODE_SH_TO_GND "P-Code fuer die Art SH_TO_GND | EN: Fault code TDME - OBD P-code reported for short to ground" VALUE 0x70D32 TKW_VV_VV_UW 100.0 FORMULA_0010 0.0 65535.0000 /end CHARACTERISTIC
/begin CHARACTERISTIC K_ED_TKA_OBD.P_CODE_SH_TO_GND "P-Code fuer die Art SH_TO_GND | EN: Fault code TKA_OBD - OBD P-code reported for short to ground" VALUE 0x70D9A TKW_VV_VV_UW 100.0 FORMULA_0010 0.0 65535.0000 /end CHARACTERISTIC
/begin CHARACTERISTIC K_ED_PWG1.P_CODE_SH_TO_GND "P-Code fuer die Art SH_TO_GND | EN: Fault code PWG1 - OBD P-code reported for short to ground" VALUE 0x70DB4 TKW_VV_VV_UW 100.0 FORMULA_0010 0.0 65535.0000 /end CHARACTERISTIC
/begin CHARACTERISTIC K_ED_PWG2.P_CODE_SH_TO_GND "P-Code fuer die Art SH_TO_GND | EN: Fault code PWG2 - OBD P-code reported for short to ground" VALUE 0x70DCE TKW_VV_VV_UW 100.0 FORMULA_0010 0.0 65535.0000 /end CHARACTERISTIC
/begin CHARACTERISTIC K_ED_PWG_VGL.P_CODE_SH_TO_GND "P-Code fuer die Art SH_TO_GND | EN: Fault code PWG_VGL - OBD P-code reported for short to ground" VALUE 0x70DE8 TKW_VV_VV_UW 100.0 FORMULA_0010 0.0 65535.0000 /end CHARACTERISTIC
/begin CHARACTERISTIC K_ED_PCTRL_IGN.P_CODE_SH_TO_GND "P-Code fuer die Art SH_TO_GND | EN: Fault code PCTRL_IGN - OBD P-code reported for short to ground" VALUE 0x70E02 TKW_VV_VV_UW 100.0 FORMULA_0010 0.0 65535.0000 /end CHARACTERISTIC
/begin CHARACTERISTIC K_ED_LLS1_CAN.P_CODE_SH_TO_GND "P-Code fuer die Art SH_TO_GND | EN: Fault code LLS1_CAN - OBD P-code reported for short to ground" VALUE 0x70E1C TKW_VV_VV_UW 100.0 FORMULA_0010 0.0 65535.0000 /end CHARACTERISTIC
/begin CHARACTERISTIC K_ED_LLS2_CAN.P_CODE_SH_TO_GND "P-Code fuer die Art SH_TO_GND | EN: Fault code LLS2_CAN - OBD P-code reported for short to ground" VALUE 0x70E36 TKW_VV_VV_UW 100.0 FORMULA_0010 0.0 65535.0000 /end CHARACTERISTIC
/begin CHARACTERISTIC K_ED_LLS1_SK.P_CODE_SH_TO_GND "P-Code fuer die Art SH_TO_GND | EN: Fault code LLS1_SK - OBD P-code reported for short to ground" VALUE 0x70E84 TKW_VV_VV_UW 100.0 FORMULA_0010 0.0 65535.0000 /end CHARACTERISTIC
/begin CHARACTERISTIC K_ED_LLS2_SK.P_CODE_SH_TO_GND "P-Code fuer die Art SH_TO_GND | EN: Fault code LLS2_SK - OBD P-code reported for short to ground" VALUE 0x70E9E TKW_VV_VV_UW 100.0 FORMULA_0010 0.0 65535.0000 /end CHARACTERISTIC
/begin CHARACTERISTIC K_ED_SMG_SCHALTAB.P_CODE_SH_TO_GND "P-Code fuer die Art SH_TO_GND | EN: Fault code SMG_SCHALTAB - OBD P-code reported for short to ground" VALUE 0x70EB8 TKW_VV_VV_UW 100.0 FORMULA_0010 0.0 65535.0000 /end CHARACTERISTIC
/begin CHARACTERISTIC K_ED_SMG_SK.P_CODE_SH_TO_GND "P-Code fuer die Art SH_TO_GND | EN: Fault code SMG_SK - OBD P-code reported for short to ground" VALUE 0x70ED2 TKW_VV_VV_UW 100.0 FORMULA_0010 0.0 65535.0000 /end CHARACTERISTIC
/begin CHARACTERISTIC K_ED_SMG_SK_N.P_CODE_SH_TO_GND "P-Code fuer die Art SH_TO_GND | EN: Fault code SMG_SK_N - OBD P-code reported for short to ground" VALUE 0x70EEC TKW_VV_VV_UW 100.0 FORMULA_0010 0.0 65535.0000 /end CHARACTERISTIC
/begin CHARACTERISTIC K_ED_IONVERST_B1.P_CODE_SH_TO_GND "P-Code fuer die Art SH_TO_GND" VALUE 0x70FBC TKW_VV_VV_UW 100.0 FORMULA_0010 0.0 65535.0000 /end CHARACTERISTIC
/begin CHARACTERISTIC K_ED_IONSPG_B1.P_CODE_SH_TO_GND "P-Code fuer die Art SH_TO_GND" VALUE 0x70FD6 TKW_VV_VV_UW 100.0 FORMULA_0010 0.0 65535.0000 /end CHARACTERISTIC
/begin CHARACTERISTIC K_ED_IONVERST_B2.P_CODE_SH_TO_GND "P-Code fuer die Art SH_TO_GND" VALUE 0x70FF0 TKW_VV_VV_UW 100.0 FORMULA_0010 0.0 65535.0000 /end CHARACTERISTIC
/begin CHARACTERISTIC K_ED_IONSPG_B2.P_CODE_SH_TO_GND "P-Code fuer die Art SH_TO_GND" VALUE 0x7100A TKW_VV_VV_UW 100.0 FORMULA_0010 0.0 65535.0000 /end CHARACTERISTIC
/begin CHARACTERISTIC K_ED_TABG1.P_CODE_SH_TO_GND "P-Code fuer die Art SH_TO_GND | EN: Fault code TABG1 - OBD P-code reported for short to ground" VALUE 0x71024 TKW_VV_VV_UW 100.0 FORMULA_0010 0.0 65535.0000 /end CHARACTERISTIC
/begin CHARACTERISTIC K_ED_TABG2.P_CODE_SH_TO_GND "P-Code fuer die Art SH_TO_GND | EN: Fault code TABG2 - OBD P-code reported for short to ground" VALUE 0x7103E TKW_VV_VV_UW 100.0 FORMULA_0010 0.0 65535.0000 /end CHARACTERISTIC
/begin CHARACTERISTIC K_ED_LLS1_REGLER.P_CODE_SH_TO_GND "P-Code fuer die Art SH_TO_GND | EN: Fault code LLS1_REGLER - OBD P-code reported for short to ground" VALUE 0x710C0 TKW_VV_VV_UW 100.0 FORMULA_0010 0.0 65535.0000 /end CHARACTERISTIC
/begin CHARACTERISTIC K_ED_LLS2_REGLER.P_CODE_SH_TO_GND "P-Code fuer die Art SH_TO_GND | EN: Fault code LLS2_REGLER - OBD P-code reported for short to ground" VALUE 0x710DA TKW_VV_VV_UW 100.0 FORMULA_0010 0.0 65535.0000 /end CHARACTERISTIC
/begin CHARACTERISTIC K_ED_MD_SK_ERR.P_CODE_SH_TO_GND "P-Code fuer die Art SH_TO_GND | EN: Fault code MD_SK_ERR - OBD P-code reported for short to ground" VALUE 0x7115C TKW_VV_VV_UW 100.0 FORMULA_0010 0.0 65535.0000 /end CHARACTERISTIC
/begin CHARACTERISTIC K_ED_LLS_INIT.P_CODE_SH_TO_GND "P-Code fuer die Art SH_TO_GND | EN: Fault code LLS_INIT - OBD P-code reported for short to ground" VALUE 0x71176 TKW_VV_VV_UW 100.0 FORMULA_0010 0.0 65535.0000 /end CHARACTERISTIC
/begin CHARACTERISTIC K_ED_LLS1_CMD.P_CODE_SH_TO_GND "P-Code fuer die Art SH_TO_GND | EN: Fault code LLS1_CMD - OBD P-code reported for short to ground" VALUE 0x711DE TKW_VV_VV_UW 100.0 FORMULA_0010 0.0 65535.0000 /end CHARACTERISTIC
/begin CHARACTERISTIC K_ED_LLS2_CMD.P_CODE_SH_TO_GND "P-Code fuer die Art SH_TO_GND | EN: Fault code LLS2_CMD - OBD P-code reported for short to ground" VALUE 0x711F8 TKW_VV_VV_UW 100.0 FORMULA_0010 0.0 65535.0000 /end CHARACTERISTIC
/begin CHARACTERISTIC K_ED_SC_SMG1.P_CODE_SH_TO_GND "P-Code fuer die Art SH_TO_GND | EN: Fault code SC_SMG1 - OBD P-code reported for short to ground" VALUE 0x71212 TKW_VV_VV_UW 100.0 FORMULA_0010 0.0 65535.0000 /end CHARACTERISTIC
/begin CHARACTERISTIC K_ED_SC_SMG2.P_CODE_SH_TO_GND "P-Code fuer die Art SH_TO_GND | EN: Fault code SC_SMG2 - OBD P-code reported for short to ground" VALUE 0x7122C TKW_VV_VV_UW 100.0 FORMULA_0010 0.0 65535.0000 /end CHARACTERISTIC
/begin CHARACTERISTIC K_ED_SC_SMG3.P_CODE_SH_TO_GND "P-Code fuer die Art SH_TO_GND | EN: Fault code SC_SMG3 - OBD P-code reported for short to ground" VALUE 0x71246 TKW_VV_VV_UW 100.0 FORMULA_0010 0.0 65535.0000 /end CHARACTERISTIC
/begin CHARACTERISTIC K_ED_SC_BUSOFF.P_CODE_SH_TO_GND "P-Code fuer die Art SH_TO_GND | EN: Fault code SC_BUSOFF - OBD P-code reported for short to ground" VALUE 0x71260 TKW_VV_VV_UW 100.0 FORMULA_0010 0.0 65535.0000 /end CHARACTERISTIC
/begin CHARACTERISTIC K_ED_ION_SIG_B1.P_CODE_SH_TO_GND "P-Code fuer die Art SH_TO_GND" VALUE 0x71398 TKW_VV_VV_UW 100.0 FORMULA_0010 0.0 65535.0000 /end CHARACTERISTIC
/begin CHARACTERISTIC K_ED_ION_SIG_B2.P_CODE_SH_TO_GND "P-Code fuer die Art SH_TO_GND" VALUE 0x713B2 TKW_VV_VV_UW 100.0 FORMULA_0010 0.0 65535.0000 /end CHARACTERISTIC
/begin CHARACTERISTIC K_ED_ION_SAT_B1.P_CODE_SH_TO_GND "P-Code fuer die Art SH_TO_GND" VALUE 0x714EA TKW_VV_VV_UW 100.0 FORMULA_0010 0.0 65535.0000 /end CHARACTERISTIC
/begin CHARACTERISTIC K_ED_ION_SAT_B2.P_CODE_SH_TO_GND "P-Code fuer die Art SH_TO_GND" VALUE 0x71504 TKW_VV_VV_UW 100.0 FORMULA_0010 0.0 65535.0000 /end CHARACTERISTIC
/begin CHARACTERISTIC K_ED_TAN_OBD_B1.P_CODE_SH_TO_GND "P-Code fuer die Art SH_TO_GND | EN: Fault code TAN_OBD_B1 - OBD P-code reported for short to ground" VALUE 0x71538 TKW_VV_VV_UW 100.0 FORMULA_0010 0.0 65535.0000 /end CHARACTERISTIC
/begin CHARACTERISTIC K_ED_INDEX_88_IGN.P_CODE_SH_TO_GND "P-Code fuer die Art SH_TO_GND | EN: P-Code fuer die Art SH_TO_GND" VALUE 0x71552 TKW_VV_VV_UW 100.0 FORMULA_0010 0.0 65535.0000 /end CHARACTERISTIC
/begin CHARACTERISTIC K_ED_INDEX_89_IGN.P_CODE_SH_TO_GND "P-Code fuer die Art SH_TO_GND" VALUE 0x7156C TKW_VV_VV_UW 100.0 FORMULA_0010 0.0 65535.0000 /end CHARACTERISTIC
/begin CHARACTERISTIC K_ED_SG_IGN.P_CODE_SH_TO_GND "P-Code fuer die Art SH_TO_GND | EN: Fault code SG_IGN - OBD P-code reported for short to ground" VALUE 0x715BA TKW_VV_VV_UW 100.0 FORMULA_0010 0.0 65535.0000 /end CHARACTERISTIC
/begin CHARACTERISTIC K_ED_SK_MANAGER_IGN.P_CODE_SH_TO_GND "P-Code fuer die Art SH_TO_GND | EN: Fault code SK_MANAGER_IGN - OBD P-code reported for short to ground" VALUE 0x71608 TKW_VV_VV_UW 100.0 FORMULA_0010 0.0 65535.0000 /end CHARACTERISTIC
/begin CHARACTERISTIC K_ED_LLR_DIAG.P_CODE_SH_TO_GND "P-Code fuer die Art SH_TO_GND | EN: Fault code LLR_DIAG - OBD P-code reported for short to ground" VALUE 0x71622 TKW_VV_VV_UW 100.0 FORMULA_0010 0.0 65535.0000 /end CHARACTERISTIC
/begin CHARACTERISTIC K_ED_THERMOSTAT.P_CODE_SH_TO_GND "P-Code fuer die Art SH_TO_GND | EN: Fault code THERMOSTAT - OBD P-code reported for short to ground" VALUE 0x7163C TKW_VV_VV_UW 100.0 FORMULA_0010 0.0 65535.0000 /end CHARACTERISTIC
/begin CHARACTERISTIC K_ED_TAN_OBD_B2.P_CODE_SH_TO_GND "P-Code fuer die Art SH_TO_GND | EN: Fault code TAN_OBD_B2 - OBD P-code reported for short to ground" VALUE 0x71656 TKW_VV_VV_UW 100.0 FORMULA_0010 0.0 65535.0000 /end CHARACTERISTIC
/begin CHARACTERISTIC K_ED_PWG_BLS.P_CODE_SH_TO_GND "P-Code fuer die Art SH_TO_GND | EN: Fault code PWG_BLS - OBD P-code reported for short to ground" VALUE 0x716BE TKW_VV_VV_UW 100.0 FORMULA_0010 0.0 65535.0000 /end CHARACTERISTIC
/begin CHARACTERISTIC K_ED_START_RL.P_CODE_SH_TO_GND "P-Code fuer die Art SH_TO_GND | EN: Fault code START_RL - OBD P-code reported for short to ground" VALUE 0x716D8 TKW_VV_VV_UW 100.0 FORMULA_0010 0.0 65535.0000 /end CHARACTERISTIC
/begin CHARACTERISTIC K_ED_N_GETR_EIN_HS.P_CODE_SH_TO_GND "P-Code fuer die Art SH_TO_GND | EN: Fault code N_GETR_EIN_HS - OBD P-code reported for short to ground" VALUE 0x7170C TKW_VV_VV_UW 100.0 FORMULA_0010 0.0 65535.0000 /end CHARACTERISTIC
/begin CHARACTERISTIC K_ED_LLR_DIAG_CSS.P_CODE_SH_TO_GND "P-Code fuer die Art SH_TO_GND | EN: Fault code LLR_DIAG_CSS - OBD P-code reported for short to ground" VALUE 0x71740 TKW_VV_VV_UW 100.0 FORMULA_0010 0.0 65535.0000 /end CHARACTERISTIC
/begin CHARACTERISTIC K_ED_TMOT_OBD_HIGH.P_CODE_SH_TO_GND "P-Code fuer die Art SH_TO_GND | EN: Fault code TMOT_OBD_HIGH - OBD P-code reported for short to ground" VALUE 0x7175A TKW_VV_VV_UW 100.0 FORMULA_0010 0.0 65535.0000 /end CHARACTERISTIC
/begin CHARACTERISTIC K_ED_INDEX_121_IGN.P_CODE_SH_TO_GND "P-Code fuer die Art SH_TO_GND | EN: Fault code INDEX_121_IGN - OBD P-code reported for short to ground" VALUE 0x718AC TKW_VV_VV_UW 100.0 FORMULA_0010 0.0 65535.0000 /end CHARACTERISTIC
/begin CHARACTERISTIC K_ED_INDEX_122_IGN.P_CODE_SH_TO_GND "P-Code fuer die Art SH_TO_GND | EN: Fault code INDEX_122_IGN - OBD P-code reported for short to ground" VALUE 0x718C6 TKW_VV_VV_UW 100.0 FORMULA_0010 0.0 65535.0000 /end CHARACTERISTIC
/begin CHARACTERISTIC K_ED_INDEX_123_IGN.P_CODE_SH_TO_GND "P-Code fuer die Art SH_TO_GND | EN: Fault code INDEX_123_IGN - OBD P-code reported for short to ground" VALUE 0x718E0 TKW_VV_VV_UW 100.0 FORMULA_0010 0.0 65535.0000 /end CHARACTERISTIC
/begin CHARACTERISTIC K_ED_INDEX_124_IGN.P_CODE_SH_TO_GND "P-Code fuer die Art SH_TO_GND | EN: Fault code INDEX_124_IGN - OBD P-code reported for short to ground" VALUE 0x718FA TKW_VV_VV_UW 100.0 FORMULA_0010 0.0 65535.0000 /end CHARACTERISTIC
/begin CHARACTERISTIC K_ED_INDEX_125_IGN.P_CODE_SH_TO_GND "P-Code fuer die Art SH_TO_GND | EN: Fault code INDEX_125_IGN - OBD P-code reported for short to ground" VALUE 0x71914 TKW_VV_VV_UW 100.0 FORMULA_0010 0.0 65535.0000 /end CHARACTERISTIC
/begin CHARACTERISTIC K_ED_INDEX_126_IGN.P_CODE_SH_TO_GND "P-Code fuer die Art SH_TO_GND | EN: Fault code INDEX_126_IGN - OBD P-code reported for short to ground" VALUE 0x7192E TKW_VV_VV_UW 100.0 FORMULA_0010 0.0 65535.0000 /end CHARACTERISTIC
/begin CHARACTERISTIC K_ED_INDEX_127_IGN.P_CODE_SH_TO_GND "P-Code fuer die Art SH_TO_GND | EN: Fault code INDEX_127_IGN - OBD P-code reported for short to ground" VALUE 0x71948 TKW_VV_VV_UW 100.0 FORMULA_0010 0.0 65535.0000 /end CHARACTERISTIC
/begin CHARACTERISTIC K_ED_SK_TR_IGN.P_CODE_OPENLOAD "P-Code fuer die Art OPENLOAD | EN: P-Code fuer die Art OPENLOAD" VALUE 0x70C64 TKW_VV_VV_UW 100.0 FORMULA_0010 0.0 65535.0000 /end CHARACTERISTIC
/begin CHARACTERISTIC K_ED_TMOT.P_CODE_OPENLOAD "P-Code fuer die Art OPENLOAD | EN: Fault code TMOT - OBD P-code reported for open circuit" VALUE 0x70C7E TKW_VV_VV_UW 100.0 FORMULA_0010 0.0 65535.0000 /end CHARACTERISTIC
/begin CHARACTERISTIC K_ED_TMOT_OBD.P_CODE_OPENLOAD "P-Code fuer die Art OPENLOAD | EN: Fault code TMOT_OBD - OBD P-code reported for open circuit" VALUE 0x70C98 TKW_VV_VV_UW 100.0 FORMULA_0010 0.0 65535.0000 /end CHARACTERISTIC
/begin CHARACTERISTIC K_ED_TAN1.P_CODE_OPENLOAD "P-Code fuer die Art OPENLOAD | EN: Fault code TAN1 - OBD P-code reported for open circuit" VALUE 0x70CB2 TKW_VV_VV_UW 100.0 FORMULA_0010 0.0 65535.0000 /end CHARACTERISTIC
/begin CHARACTERISTIC K_ED_TAN2.P_CODE_OPENLOAD "P-Code fuer die Art OPENLOAD | EN: Fault code TAN2 - OBD P-code reported for open circuit" VALUE 0x70CCC TKW_VV_VV_UW 100.0 FORMULA_0010 0.0 65535.0000 /end CHARACTERISTIC
/begin CHARACTERISTIC K_ED_TIME_REL_OBD.P_CODE_OPENLOAD "P-Code fuer die Art OPENLOAD | EN: Fault code TIME_REL_OBD - OBD P-code reported for open circuit" VALUE 0x70CE6 TKW_VV_VV_UW 100.0 FORMULA_0010 0.0 65535.0000 /end CHARACTERISTIC
/begin CHARACTERISTIC K_ED_TKA.P_CODE_OPENLOAD "P-Code fuer die Art OPENLOAD | EN: Fault code TKA - OBD P-code reported for open circuit" VALUE 0x70D1A TKW_VV_VV_UW 100.0 FORMULA_0010 0.0 65535.0000 /end CHARACTERISTIC
/begin CHARACTERISTIC K_ED_TDME.P_CODE_OPENLOAD "P-Code fuer die Art OPENLOAD | EN: Fault code TDME - OBD P-code reported for open circuit" VALUE 0x70D34 TKW_VV_VV_UW 100.0 FORMULA_0010 0.0 65535.0000 /end CHARACTERISTIC
/begin CHARACTERISTIC K_ED_TKA_OBD.P_CODE_OPENLOAD "P-Code fuer die Art OPENLOAD | EN: Fault code TKA_OBD - OBD P-code reported for open circuit" VALUE 0x70D9C TKW_VV_VV_UW 100.0 FORMULA_0010 0.0 65535.0000 /end CHARACTERISTIC
/begin CHARACTERISTIC K_ED_PWG1.P_CODE_OPENLOAD "P-Code fuer die Art OPENLOAD | EN: Fault code PWG1 - OBD P-code reported for open circuit" VALUE 0x70DB6 TKW_VV_VV_UW 100.0 FORMULA_0010 0.0 65535.0000 /end CHARACTERISTIC
/begin CHARACTERISTIC K_ED_PWG2.P_CODE_OPENLOAD "P-Code fuer die Art OPENLOAD | EN: Fault code PWG2 - OBD P-code reported for open circuit" VALUE 0x70DD0 TKW_VV_VV_UW 100.0 FORMULA_0010 0.0 65535.0000 /end CHARACTERISTIC
/begin CHARACTERISTIC K_ED_PWG_VGL.P_CODE_OPENLOAD "P-Code fuer die Art OPENLOAD | EN: Fault code PWG_VGL - OBD P-code reported for open circuit" VALUE 0x70DEA TKW_VV_VV_UW 100.0 FORMULA_0010 0.0 65535.0000 /end CHARACTERISTIC
/begin CHARACTERISTIC K_ED_PCTRL_IGN.P_CODE_OPENLOAD "P-Code fuer die Art OPENLOAD | EN: Fault code PCTRL_IGN - OBD P-code reported for open circuit" VALUE 0x70E04 TKW_VV_VV_UW 100.0 FORMULA_0010 0.0 65535.0000 /end CHARACTERISTIC
/begin CHARACTERISTIC K_ED_LLS1_CAN.P_CODE_OPENLOAD "P-Code fuer die Art OPENLOAD | EN: Fault code LLS1_CAN - OBD P-code reported for open circuit" VALUE 0x70E1E TKW_VV_VV_UW 100.0 FORMULA_0010 0.0 65535.0000 /end CHARACTERISTIC
/begin CHARACTERISTIC K_ED_LLS2_CAN.P_CODE_OPENLOAD "P-Code fuer die Art OPENLOAD | EN: Fault code LLS2_CAN - OBD P-code reported for open circuit" VALUE 0x70E38 TKW_VV_VV_UW 100.0 FORMULA_0010 0.0 65535.0000 /end CHARACTERISTIC
/begin CHARACTERISTIC K_ED_LLS1_SK.P_CODE_OPENLOAD "P-Code fuer die Art OPENLOAD | EN: Fault code LLS1_SK - OBD P-code reported for open circuit" VALUE 0x70E86 TKW_VV_VV_UW 100.0 FORMULA_0010 0.0 65535.0000 /end CHARACTERISTIC
/begin CHARACTERISTIC K_ED_LLS2_SK.P_CODE_OPENLOAD "P-Code fuer die Art OPENLOAD | EN: Fault code LLS2_SK - OBD P-code reported for open circuit" VALUE 0x70EA0 TKW_VV_VV_UW 100.0 FORMULA_0010 0.0 65535.0000 /end CHARACTERISTIC
/begin CHARACTERISTIC K_ED_SMG_SCHALTAB.P_CODE_OPENLOAD "P-Code fuer die Art OPENLOAD | EN: Fault code SMG_SCHALTAB - OBD P-code reported for open circuit" VALUE 0x70EBA TKW_VV_VV_UW 100.0 FORMULA_0010 0.0 65535.0000 /end CHARACTERISTIC
/begin CHARACTERISTIC K_ED_SMG_SK.P_CODE_OPENLOAD "P-Code fuer die Art OPENLOAD | EN: Fault code SMG_SK - OBD P-code reported for open circuit" VALUE 0x70ED4 TKW_VV_VV_UW 100.0 FORMULA_0010 0.0 65535.0000 /end CHARACTERISTIC
/begin CHARACTERISTIC K_ED_SMG_SK_N.P_CODE_OPENLOAD "P-Code fuer die Art OPENLOAD | EN: Fault code SMG_SK_N - OBD P-code reported for open circuit" VALUE 0x70EEE TKW_VV_VV_UW 100.0 FORMULA_0010 0.0 65535.0000 /end CHARACTERISTIC
/begin CHARACTERISTIC K_ED_IONVERST_B1.P_CODE_OPENLOAD "P-Code fuer die Art OPENLOAD" VALUE 0x70FBE TKW_VV_VV_UW 100.0 FORMULA_0010 0.0 65535.0000 /end CHARACTERISTIC
/begin CHARACTERISTIC K_ED_IONSPG_B1.P_CODE_OPENLOAD "P-Code fuer die Art OPENLOAD" VALUE 0x70FD8 TKW_VV_VV_UW 100.0 FORMULA_0010 0.0 65535.0000 /end CHARACTERISTIC
/begin CHARACTERISTIC K_ED_IONVERST_B2.P_CODE_OPENLOAD "P-Code fuer die Art OPENLOAD" VALUE 0x70FF2 TKW_VV_VV_UW 100.0 FORMULA_0010 0.0 65535.0000 /end CHARACTERISTIC
/begin CHARACTERISTIC K_ED_IONSPG_B2.P_CODE_OPENLOAD "P-Code fuer die Art OPENLOAD" VALUE 0x7100C TKW_VV_VV_UW 100.0 FORMULA_0010 0.0 65535.0000 /end CHARACTERISTIC
/begin CHARACTERISTIC K_ED_TABG1.P_CODE_OPENLOAD "P-Code fuer die Art OPENLOAD | EN: Fault code TABG1 - OBD P-code reported for open circuit" VALUE 0x71026 TKW_VV_VV_UW 100.0 FORMULA_0010 0.0 65535.0000 /end CHARACTERISTIC
/begin CHARACTERISTIC K_ED_TABG2.P_CODE_OPENLOAD "P-Code fuer die Art OPENLOAD | EN: Fault code TABG2 - OBD P-code reported for open circuit" VALUE 0x71040 TKW_VV_VV_UW 100.0 FORMULA_0010 0.0 65535.0000 /end CHARACTERISTIC
/begin CHARACTERISTIC K_ED_LLS1_REGLER.P_CODE_OPENLOAD "P-Code fuer die Art OPENLOAD | EN: Fault code LLS1_REGLER - OBD P-code reported for open circuit" VALUE 0x710C2 TKW_VV_VV_UW 100.0 FORMULA_0010 0.0 65535.0000 /end CHARACTERISTIC
/begin CHARACTERISTIC K_ED_LLS2_REGLER.P_CODE_OPENLOAD "P-Code fuer die Art OPENLOAD | EN: Fault code LLS2_REGLER - OBD P-code reported for open circuit" VALUE 0x710DC TKW_VV_VV_UW 100.0 FORMULA_0010 0.0 65535.0000 /end CHARACTERISTIC
/begin CHARACTERISTIC K_ED_MD_SK_ERR.P_CODE_OPENLOAD "P-Code fuer die Art OPENLOAD | EN: Fault code MD_SK_ERR - OBD P-code reported for open circuit" VALUE 0x7115E TKW_VV_VV_UW 100.0 FORMULA_0010 0.0 65535.0000 /end CHARACTERISTIC
/begin CHARACTERISTIC K_ED_LLS_INIT.P_CODE_OPENLOAD "P-Code fuer die Art OPENLOAD | EN: Fault code LLS_INIT - OBD P-code reported for open circuit" VALUE 0x71178 TKW_VV_VV_UW 100.0 FORMULA_0010 0.0 65535.0000 /end CHARACTERISTIC
/begin CHARACTERISTIC K_ED_LLS1_CMD.P_CODE_OPENLOAD "P-Code fuer die Art OPENLOAD | EN: Fault code LLS1_CMD - OBD P-code reported for open circuit" VALUE 0x711E0 TKW_VV_VV_UW 100.0 FORMULA_0010 0.0 65535.0000 /end CHARACTERISTIC
/begin CHARACTERISTIC K_ED_LLS2_CMD.P_CODE_OPENLOAD "P-Code fuer die Art OPENLOAD | EN: Fault code LLS2_CMD - OBD P-code reported for open circuit" VALUE 0x711FA TKW_VV_VV_UW 100.0 FORMULA_0010 0.0 65535.0000 /end CHARACTERISTIC
/begin CHARACTERISTIC K_ED_SC_SMG1.P_CODE_OPENLOAD "P-Code fuer die Art OPENLOAD | EN: Fault code SC_SMG1 - OBD P-code reported for open circuit" VALUE 0x71214 TKW_VV_VV_UW 100.0 FORMULA_0010 0.0 65535.0000 /end CHARACTERISTIC
/begin CHARACTERISTIC K_ED_SC_SMG2.P_CODE_OPENLOAD "P-Code fuer die Art OPENLOAD | EN: Fault code SC_SMG2 - OBD P-code reported for open circuit" VALUE 0x7122E TKW_VV_VV_UW 100.0 FORMULA_0010 0.0 65535.0000 /end CHARACTERISTIC
/begin CHARACTERISTIC K_ED_SC_SMG3.P_CODE_OPENLOAD "P-Code fuer die Art OPENLOAD | EN: Fault code SC_SMG3 - OBD P-code reported for open circuit" VALUE 0x71248 TKW_VV_VV_UW 100.0 FORMULA_0010 0.0 65535.0000 /end CHARACTERISTIC
/begin CHARACTERISTIC K_ED_SC_BUSOFF.P_CODE_OPENLOAD "P-Code fuer die Art OPENLOAD | EN: Fault code SC_BUSOFF - OBD P-code reported for open circuit" VALUE 0x71262 TKW_VV_VV_UW 100.0 FORMULA_0010 0.0 65535.0000 /end CHARACTERISTIC
/begin CHARACTERISTIC K_ED_ION_SIG_B1.P_CODE_OPENLOAD "P-Code fuer die Art OPENLOAD" VALUE 0x7139A TKW_VV_VV_UW 100.0 FORMULA_0010 0.0 65535.0000 /end CHARACTERISTIC
/begin CHARACTERISTIC K_ED_ION_SIG_B2.P_CODE_OPENLOAD "P-Code fuer die Art OPENLOAD" VALUE 0x713B4 TKW_VV_VV_UW 100.0 FORMULA_0010 0.0 65535.0000 /end CHARACTERISTIC
/begin CHARACTERISTIC K_ED_ION_SAT_B1.P_CODE_OPENLOAD "P-Code fuer die Art OPENLOAD" VALUE 0x714EC TKW_VV_VV_UW 100.0 FORMULA_0010 0.0 65535.0000 /end CHARACTERISTIC
/begin CHARACTERISTIC K_ED_ION_SAT_B2.P_CODE_OPENLOAD "P-Code fuer die Art OPENLOAD" VALUE 0x71506 TKW_VV_VV_UW 100.0 FORMULA_0010 0.0 65535.0000 /end CHARACTERISTIC
/begin CHARACTERISTIC K_ED_TAN_OBD_B1.P_CODE_OPENLOAD "P-Code fuer die Art OPENLOAD | EN: Fault code TAN_OBD_B1 - OBD P-code reported for open circuit" VALUE 0x7153A TKW_VV_VV_UW 100.0 FORMULA_0010 0.0 65535.0000 /end CHARACTERISTIC
/begin CHARACTERISTIC K_ED_INDEX_88_IGN.P_CODE_OPENLOAD "P-Code fuer die Art OPENLOAD | EN: P-Code fuer die Art OPENLOAD" VALUE 0x71554 TKW_VV_VV_UW 100.0 FORMULA_0010 0.0 65535.0000 /end CHARACTERISTIC
/begin CHARACTERISTIC K_ED_INDEX_89_IGN.P_CODE_OPENLOAD "P-Code fuer die Art OPENLOAD" VALUE 0x7156E TKW_VV_VV_UW 100.0 FORMULA_0010 0.0 65535.0000 /end CHARACTERISTIC
/begin CHARACTERISTIC K_ED_SG_IGN.P_CODE_OPENLOAD "P-Code fuer die Art OPENLOAD | EN: Fault code SG_IGN - OBD P-code reported for open circuit" VALUE 0x715BC TKW_VV_VV_UW 100.0 FORMULA_0010 0.0 65535.0000 /end CHARACTERISTIC
/begin CHARACTERISTIC K_ED_SK_MANAGER_IGN.P_CODE_OPENLOAD "P-Code fuer die Art OPENLOAD | EN: Fault code SK_MANAGER_IGN - OBD P-code reported for open circuit" VALUE 0x7160A TKW_VV_VV_UW 100.0 FORMULA_0010 0.0 65535.0000 /end CHARACTERISTIC
/begin CHARACTERISTIC K_ED_LLR_DIAG.P_CODE_OPENLOAD "P-Code fuer die Art OPENLOAD | EN: Fault code LLR_DIAG - OBD P-code reported for open circuit" VALUE 0x71624 TKW_VV_VV_UW 100.0 FORMULA_0010 0.0 65535.0000 /end CHARACTERISTIC
/begin CHARACTERISTIC K_ED_THERMOSTAT.P_CODE_OPENLOAD "P-Code fuer die Art OPENLOAD | EN: Fault code THERMOSTAT - OBD P-code reported for open circuit" VALUE 0x7163E TKW_VV_VV_UW 100.0 FORMULA_0010 0.0 65535.0000 /end CHARACTERISTIC
/begin CHARACTERISTIC K_ED_TAN_OBD_B2.P_CODE_OPENLOAD "P-Code fuer die Art OPENLOAD | EN: Fault code TAN_OBD_B2 - OBD P-code reported for open circuit" VALUE 0x71658 TKW_VV_VV_UW 100.0 FORMULA_0010 0.0 65535.0000 /end CHARACTERISTIC
/begin CHARACTERISTIC K_ED_PWG_BLS.P_CODE_OPENLOAD "P-Code fuer die Art OPENLOAD | EN: Fault code PWG_BLS - OBD P-code reported for open circuit" VALUE 0x716C0 TKW_VV_VV_UW 100.0 FORMULA_0010 0.0 65535.0000 /end CHARACTERISTIC
/begin CHARACTERISTIC K_ED_START_RL.P_CODE_OPENLOAD "P-Code fuer die Art OPENLOAD | EN: Fault code START_RL - OBD P-code reported for open circuit" VALUE 0x716DA TKW_VV_VV_UW 100.0 FORMULA_0010 0.0 65535.0000 /end CHARACTERISTIC
/begin CHARACTERISTIC K_ED_N_GETR_EIN_HS.P_CODE_OPENLOAD "P-Code fuer die Art OPENLOAD | EN: Fault code N_GETR_EIN_HS - OBD P-code reported for open circuit" VALUE 0x7170E TKW_VV_VV_UW 100.0 FORMULA_0010 0.0 65535.0000 /end CHARACTERISTIC
/begin CHARACTERISTIC K_ED_LLR_DIAG_CSS.P_CODE_OPENLOAD "P-Code fuer die Art OPENLOAD | EN: Fault code LLR_DIAG_CSS - OBD P-code reported for open circuit" VALUE 0x71742 TKW_VV_VV_UW 100.0 FORMULA_0010 0.0 65535.0000 /end CHARACTERISTIC
/begin CHARACTERISTIC K_ED_TMOT_OBD_HIGH.P_CODE_OPENLOAD "P-Code fuer die Art OPENLOAD | EN: Fault code TMOT_OBD_HIGH - OBD P-code reported for open circuit" VALUE 0x7175C TKW_VV_VV_UW 100.0 FORMULA_0010 0.0 65535.0000 /end CHARACTERISTIC
/begin CHARACTERISTIC K_ED_INDEX_121_IGN.P_CODE_OPENLOAD "P-Code fuer die Art OPENLOAD | EN: Fault code INDEX_121_IGN - OBD P-code reported for open circuit" VALUE 0x718AE TKW_VV_VV_UW 100.0 FORMULA_0010 0.0 65535.0000 /end CHARACTERISTIC
/begin CHARACTERISTIC K_ED_INDEX_122_IGN.P_CODE_OPENLOAD "P-Code fuer die Art OPENLOAD | EN: Fault code INDEX_122_IGN - OBD P-code reported for open circuit" VALUE 0x718C8 TKW_VV_VV_UW 100.0 FORMULA_0010 0.0 65535.0000 /end CHARACTERISTIC
/begin CHARACTERISTIC K_ED_INDEX_123_IGN.P_CODE_OPENLOAD "P-Code fuer die Art OPENLOAD | EN: Fault code INDEX_123_IGN - OBD P-code reported for open circuit" VALUE 0x718E2 TKW_VV_VV_UW 100.0 FORMULA_0010 0.0 65535.0000 /end CHARACTERISTIC
/begin CHARACTERISTIC K_ED_INDEX_124_IGN.P_CODE_OPENLOAD "P-Code fuer die Art OPENLOAD | EN: Fault code INDEX_124_IGN - OBD P-code reported for open circuit" VALUE 0x718FC TKW_VV_VV_UW 100.0 FORMULA_0010 0.0 65535.0000 /end CHARACTERISTIC
/begin CHARACTERISTIC K_ED_INDEX_125_IGN.P_CODE_OPENLOAD "P-Code fuer die Art OPENLOAD | EN: Fault code INDEX_125_IGN - OBD P-code reported for open circuit" VALUE 0x71916 TKW_VV_VV_UW 100.0 FORMULA_0010 0.0 65535.0000 /end CHARACTERISTIC
/begin CHARACTERISTIC K_ED_INDEX_126_IGN.P_CODE_OPENLOAD "P-Code fuer die Art OPENLOAD | EN: Fault code INDEX_126_IGN - OBD P-code reported for open circuit" VALUE 0x71930 TKW_VV_VV_UW 100.0 FORMULA_0010 0.0 65535.0000 /end CHARACTERISTIC
/begin CHARACTERISTIC K_ED_INDEX_127_IGN.P_CODE_OPENLOAD "P-Code fuer die Art OPENLOAD | EN: Fault code INDEX_127_IGN - OBD P-code reported for open circuit" VALUE 0x7194A TKW_VV_VV_UW 100.0 FORMULA_0010 0.0 65535.0000 /end CHARACTERISTIC
/begin CHARACTERISTIC K_ED_SK_TR_IGN.P_CODE_UNPLAUSIBEL "P-Code fuer die Art UNPLAUSIBEL | EN: P-Code fuer die Art UNPLAUSIBEL" VALUE 0x70C66 TKW_VV_VV_UW 100.0 FORMULA_0010 0.0 65535.0000 /end CHARACTERISTIC
/begin CHARACTERISTIC K_ED_TMOT.P_CODE_UNPLAUSIBEL "P-Code fuer die Art UNPLAUSIBEL | EN: Fault code TMOT - OBD P-code reported for implausible signal" VALUE 0x70C80 TKW_VV_VV_UW 100.0 FORMULA_0010 0.0 65535.0000 /end CHARACTERISTIC
/begin CHARACTERISTIC K_ED_TMOT_OBD.P_CODE_UNPLAUSIBEL "P-Code fuer die Art UNPLAUSIBEL | EN: Fault code TMOT_OBD - OBD P-code reported for implausible signal" VALUE 0x70C9A TKW_VV_VV_UW 100.0 FORMULA_0010 0.0 65535.0000 /end CHARACTERISTIC
/begin CHARACTERISTIC K_ED_TAN1.P_CODE_UNPLAUSIBEL "P-Code fuer die Art UNPLAUSIBEL | EN: Fault code TAN1 - OBD P-code reported for implausible signal" VALUE 0x70CB4 TKW_VV_VV_UW 100.0 FORMULA_0010 0.0 65535.0000 /end CHARACTERISTIC
/begin CHARACTERISTIC K_ED_TAN2.P_CODE_UNPLAUSIBEL "P-Code fuer die Art UNPLAUSIBEL | EN: Fault code TAN2 - OBD P-code reported for implausible signal" VALUE 0x70CCE TKW_VV_VV_UW 100.0 FORMULA_0010 0.0 65535.0000 /end CHARACTERISTIC
/begin CHARACTERISTIC K_ED_TIME_REL_OBD.P_CODE_UNPLAUSIBEL "P-Code fuer die Art UNPLAUSIBEL | EN: Fault code TIME_REL_OBD - OBD P-code reported for implausible signal" VALUE 0x70CE8 TKW_VV_VV_UW 100.0 FORMULA_0010 0.0 65535.0000 /end CHARACTERISTIC
/begin CHARACTERISTIC K_ED_TKA.P_CODE_UNPLAUSIBEL "P-Code fuer die Art UNPLAUSIBEL | EN: Fault code TKA - OBD P-code reported for implausible signal" VALUE 0x70D1C TKW_VV_VV_UW 100.0 FORMULA_0010 0.0 65535.0000 /end CHARACTERISTIC
/begin CHARACTERISTIC K_ED_TDME.P_CODE_UNPLAUSIBEL "P-Code fuer die Art UNPLAUSIBEL | EN: Fault code TDME - OBD P-code reported for implausible signal" VALUE 0x70D36 TKW_VV_VV_UW 100.0 FORMULA_0010 0.0 65535.0000 /end CHARACTERISTIC
/begin CHARACTERISTIC K_ED_TKA_OBD.P_CODE_UNPLAUSIBEL "P-Code fuer die Art UNPLAUSIBEL | EN: Fault code TKA_OBD - OBD P-code reported for implausible signal" VALUE 0x70D9E TKW_VV_VV_UW 100.0 FORMULA_0010 0.0 65535.0000 /end CHARACTERISTIC
/begin CHARACTERISTIC K_ED_PWG1.P_CODE_UNPLAUSIBEL "P-Code fuer die Art UNPLAUSIBEL | EN: Fault code PWG1 - OBD P-code reported for implausible signal" VALUE 0x70DB8 TKW_VV_VV_UW 100.0 FORMULA_0010 0.0 65535.0000 /end CHARACTERISTIC
/begin CHARACTERISTIC K_ED_PWG2.P_CODE_UNPLAUSIBEL "P-Code fuer die Art UNPLAUSIBEL | EN: Fault code PWG2 - OBD P-code reported for implausible signal" VALUE 0x70DD2 TKW_VV_VV_UW 100.0 FORMULA_0010 0.0 65535.0000 /end CHARACTERISTIC
/begin CHARACTERISTIC K_ED_PWG_VGL.P_CODE_UNPLAUSIBEL "P-Code fuer die Art UNPLAUSIBEL | EN: Fault code PWG_VGL - OBD P-code reported for implausible signal" VALUE 0x70DEC TKW_VV_VV_UW 100.0 FORMULA_0010 0.0 65535.0000 /end CHARACTERISTIC
/begin CHARACTERISTIC K_ED_PCTRL_IGN.P_CODE_UNPLAUSIBEL "P-Code fuer die Art UNPLAUSIBEL | EN: Fault code PCTRL_IGN - OBD P-code reported for implausible signal" VALUE 0x70E06 TKW_VV_VV_UW 100.0 FORMULA_0010 0.0 65535.0000 /end CHARACTERISTIC
/begin CHARACTERISTIC K_ED_LLS1_CAN.P_CODE_UNPLAUSIBEL "P-Code fuer die Art UNPLAUSIBEL | EN: Fault code LLS1_CAN - OBD P-code reported for implausible signal" VALUE 0x70E20 TKW_VV_VV_UW 100.0 FORMULA_0010 0.0 65535.0000 /end CHARACTERISTIC
/begin CHARACTERISTIC K_ED_LLS2_CAN.P_CODE_UNPLAUSIBEL "P-Code fuer die Art UNPLAUSIBEL | EN: Fault code LLS2_CAN - OBD P-code reported for implausible signal" VALUE 0x70E3A TKW_VV_VV_UW 100.0 FORMULA_0010 0.0 65535.0000 /end CHARACTERISTIC
/begin CHARACTERISTIC K_ED_LLS1_SK.P_CODE_UNPLAUSIBEL "P-Code fuer die Art UNPLAUSIBEL | EN: Fault code LLS1_SK - OBD P-code reported for implausible signal" VALUE 0x70E88 TKW_VV_VV_UW 100.0 FORMULA_0010 0.0 65535.0000 /end CHARACTERISTIC
/begin CHARACTERISTIC K_ED_LLS2_SK.P_CODE_UNPLAUSIBEL "P-Code fuer die Art UNPLAUSIBEL | EN: Fault code LLS2_SK - OBD P-code reported for implausible signal" VALUE 0x70EA2 TKW_VV_VV_UW 100.0 FORMULA_0010 0.0 65535.0000 /end CHARACTERISTIC
/begin CHARACTERISTIC K_ED_SMG_SCHALTAB.P_CODE_UNPLAUSIBEL "P-Code fuer die Art UNPLAUSIBEL | EN: Fault code SMG_SCHALTAB - OBD P-code reported for implausible signal" VALUE 0x70EBC TKW_VV_VV_UW 100.0 FORMULA_0010 0.0 65535.0000 /end CHARACTERISTIC
/begin CHARACTERISTIC K_ED_SMG_SK.P_CODE_UNPLAUSIBEL "P-Code fuer die Art UNPLAUSIBEL | EN: Fault code SMG_SK - OBD P-code reported for implausible signal" VALUE 0x70ED6 TKW_VV_VV_UW 100.0 FORMULA_0010 0.0 65535.0000 /end CHARACTERISTIC
/begin CHARACTERISTIC K_ED_SMG_SK_N.P_CODE_UNPLAUSIBEL "P-Code fuer die Art UNPLAUSIBEL | EN: Fault code SMG_SK_N - OBD P-code reported for implausible signal" VALUE 0x70EF0 TKW_VV_VV_UW 100.0 FORMULA_0010 0.0 65535.0000 /end CHARACTERISTIC
/begin CHARACTERISTIC K_ED_IONVERST_B1.P_CODE_UNPLAUSIBEL "P-Code fuer die Art UNPLAUSIBEL" VALUE 0x70FC0 TKW_VV_VV_UW 100.0 FORMULA_0010 0.0 65535.0000 /end CHARACTERISTIC
/begin CHARACTERISTIC K_ED_IONSPG_B1.P_CODE_UNPLAUSIBEL "P-Code fuer die Art UNPLAUSIBEL" VALUE 0x70FDA TKW_VV_VV_UW 100.0 FORMULA_0010 0.0 65535.0000 /end CHARACTERISTIC
/begin CHARACTERISTIC K_ED_IONVERST_B2.P_CODE_UNPLAUSIBEL "P-Code fuer die Art UNPLAUSIBEL" VALUE 0x70FF4 TKW_VV_VV_UW 100.0 FORMULA_0010 0.0 65535.0000 /end CHARACTERISTIC
/begin CHARACTERISTIC K_ED_IONSPG_B2.P_CODE_UNPLAUSIBEL "P-Code fuer die Art UNPLAUSIBEL" VALUE 0x7100E TKW_VV_VV_UW 100.0 FORMULA_0010 0.0 65535.0000 /end CHARACTERISTIC
/begin CHARACTERISTIC K_ED_TABG1.P_CODE_UNPLAUSIBEL "P-Code fuer die Art UNPLAUSIBEL | EN: Fault code TABG1 - OBD P-code reported for implausible signal" VALUE 0x71028 TKW_VV_VV_UW 100.0 FORMULA_0010 0.0 65535.0000 /end CHARACTERISTIC
/begin CHARACTERISTIC K_ED_TABG2.P_CODE_UNPLAUSIBEL "P-Code fuer die Art UNPLAUSIBEL | EN: Fault code TABG2 - OBD P-code reported for implausible signal" VALUE 0x71042 TKW_VV_VV_UW 100.0 FORMULA_0010 0.0 65535.0000 /end CHARACTERISTIC
/begin CHARACTERISTIC K_ED_LLS1_REGLER.P_CODE_UNPLAUSIBEL "P-Code fuer die Art UNPLAUSIBEL | EN: Fault code LLS1_REGLER - OBD P-code reported for implausible signal" VALUE 0x710C4 TKW_VV_VV_UW 100.0 FORMULA_0010 0.0 65535.0000 /end CHARACTERISTIC
/begin CHARACTERISTIC K_ED_LLS2_REGLER.P_CODE_UNPLAUSIBEL "P-Code fuer die Art UNPLAUSIBEL | EN: Fault code LLS2_REGLER - OBD P-code reported for implausible signal" VALUE 0x710DE TKW_VV_VV_UW 100.0 FORMULA_0010 0.0 65535.0000 /end CHARACTERISTIC
/begin CHARACTERISTIC K_ED_MD_SK_ERR.P_CODE_UNPLAUSIBEL "P-Code fuer die Art UNPLAUSIBEL | EN: Fault code MD_SK_ERR - OBD P-code reported for implausible signal" VALUE 0x71160 TKW_VV_VV_UW 100.0 FORMULA_0010 0.0 65535.0000 /end CHARACTERISTIC
/begin CHARACTERISTIC K_ED_LLS_INIT.P_CODE_UNPLAUSIBEL "P-Code fuer die Art UNPLAUSIBEL | EN: Fault code LLS_INIT - OBD P-code reported for implausible signal" VALUE 0x7117A TKW_VV_VV_UW 100.0 FORMULA_0010 0.0 65535.0000 /end CHARACTERISTIC
/begin CHARACTERISTIC K_ED_LLS1_CMD.P_CODE_UNPLAUSIBEL "P-Code fuer die Art UNPLAUSIBEL | EN: Fault code LLS1_CMD - OBD P-code reported for implausible signal" VALUE 0x711E2 TKW_VV_VV_UW 100.0 FORMULA_0010 0.0 65535.0000 /end CHARACTERISTIC
/begin CHARACTERISTIC K_ED_LLS2_CMD.P_CODE_UNPLAUSIBEL "P-Code fuer die Art UNPLAUSIBEL | EN: Fault code LLS2_CMD - OBD P-code reported for implausible signal" VALUE 0x711FC TKW_VV_VV_UW 100.0 FORMULA_0010 0.0 65535.0000 /end CHARACTERISTIC
/begin CHARACTERISTIC K_ED_SC_SMG1.P_CODE_UNPLAUSIBEL "P-Code fuer die Art UNPLAUSIBEL | EN: Fault code SC_SMG1 - OBD P-code reported for implausible signal" VALUE 0x71216 TKW_VV_VV_UW 100.0 FORMULA_0010 0.0 65535.0000 /end CHARACTERISTIC
/begin CHARACTERISTIC K_ED_SC_SMG2.P_CODE_UNPLAUSIBEL "P-Code fuer die Art UNPLAUSIBEL | EN: Fault code SC_SMG2 - OBD P-code reported for implausible signal" VALUE 0x71230 TKW_VV_VV_UW 100.0 FORMULA_0010 0.0 65535.0000 /end CHARACTERISTIC
/begin CHARACTERISTIC K_ED_SC_SMG3.P_CODE_UNPLAUSIBEL "P-Code fuer die Art UNPLAUSIBEL | EN: Fault code SC_SMG3 - OBD P-code reported for implausible signal" VALUE 0x7124A TKW_VV_VV_UW 100.0 FORMULA_0010 0.0 65535.0000 /end CHARACTERISTIC
/begin CHARACTERISTIC K_ED_SC_BUSOFF.P_CODE_UNPLAUSIBEL "P-Code fuer die Art UNPLAUSIBEL | EN: Fault code SC_BUSOFF - OBD P-code reported for implausible signal" VALUE 0x71264 TKW_VV_VV_UW 100.0 FORMULA_0010 0.0 65535.0000 /end CHARACTERISTIC
/begin CHARACTERISTIC K_ED_ION_SIG_B1.P_CODE_UNPLAUSIBEL "P-Code fuer die Art UNPLAUSIBEL" VALUE 0x7139C TKW_VV_VV_UW 100.0 FORMULA_0010 0.0 65535.0000 /end CHARACTERISTIC
/begin CHARACTERISTIC K_ED_ION_SIG_B2.P_CODE_UNPLAUSIBEL "P-Code fuer die Art UNPLAUSIBEL" VALUE 0x713B6 TKW_VV_VV_UW 100.0 FORMULA_0010 0.0 65535.0000 /end CHARACTERISTIC
/begin CHARACTERISTIC K_ED_ION_SAT_B1.P_CODE_UNPLAUSIBEL "P-Code fuer die Art UNPLAUSIBEL" VALUE 0x714EE TKW_VV_VV_UW 100.0 FORMULA_0010 0.0 65535.0000 /end CHARACTERISTIC
/begin CHARACTERISTIC K_ED_ION_SAT_B2.P_CODE_UNPLAUSIBEL "P-Code fuer die Art UNPLAUSIBEL" VALUE 0x71508 TKW_VV_VV_UW 100.0 FORMULA_0010 0.0 65535.0000 /end CHARACTERISTIC
/begin CHARACTERISTIC K_ED_TAN_OBD_B1.P_CODE_UNPLAUSIBEL "P-Code fuer die Art UNPLAUSIBEL | EN: Fault code TAN_OBD_B1 - OBD P-code reported for implausible signal" VALUE 0x7153C TKW_VV_VV_UW 100.0 FORMULA_0010 0.0 65535.0000 /end CHARACTERISTIC
/begin CHARACTERISTIC K_ED_INDEX_88_IGN.P_CODE_UNPLAUSIBEL "P-Code fuer die Art UNPLAUSIBEL | EN: P-Code fuer die Art UNPLAUSIBEL" VALUE 0x71556 TKW_VV_VV_UW 100.0 FORMULA_0010 0.0 65535.0000 /end CHARACTERISTIC
/begin CHARACTERISTIC K_ED_INDEX_89_IGN.P_CODE_UNPLAUSIBEL "P-Code fuer die Art UNPLAUSIBEL" VALUE 0x71570 TKW_VV_VV_UW 100.0 FORMULA_0010 0.0 65535.0000 /end CHARACTERISTIC
/begin CHARACTERISTIC K_ED_SG_IGN.P_CODE_UNPLAUSIBEL "P-Code fuer die Art UNPLAUSIBEL | EN: Fault code SG_IGN - OBD P-code reported for implausible signal" VALUE 0x715BE TKW_VV_VV_UW 100.0 FORMULA_0010 0.0 65535.0000 /end CHARACTERISTIC
/begin CHARACTERISTIC K_ED_SK_MANAGER_IGN.P_CODE_UNPLAUSIBEL "P-Code fuer die Art UNPLAUSIBEL | EN: Fault code SK_MANAGER_IGN - OBD P-code reported for implausible signal" VALUE 0x7160C TKW_VV_VV_UW 100.0 FORMULA_0010 0.0 65535.0000 /end CHARACTERISTIC
/begin CHARACTERISTIC K_ED_LLR_DIAG.P_CODE_UNPLAUSIBEL "P-Code fuer die Art UNPLAUSIBEL | EN: Fault code LLR_DIAG - OBD P-code reported for implausible signal" VALUE 0x71626 TKW_VV_VV_UW 100.0 FORMULA_0010 0.0 65535.0000 /end CHARACTERISTIC
/begin CHARACTERISTIC K_ED_THERMOSTAT.P_CODE_UNPLAUSIBEL "P-Code fuer die Art UNPLAUSIBEL | EN: Fault code THERMOSTAT - OBD P-code reported for implausible signal" VALUE 0x71640 TKW_VV_VV_UW 100.0 FORMULA_0010 0.0 65535.0000 /end CHARACTERISTIC
/begin CHARACTERISTIC K_ED_TAN_OBD_B2.P_CODE_UNPLAUSIBEL "P-Code fuer die Art UNPLAUSIBEL | EN: Fault code TAN_OBD_B2 - OBD P-code reported for implausible signal" VALUE 0x7165A TKW_VV_VV_UW 100.0 FORMULA_0010 0.0 65535.0000 /end CHARACTERISTIC
/begin CHARACTERISTIC K_ED_PWG_BLS.P_CODE_UNPLAUSIBEL "P-Code fuer die Art UNPLAUSIBEL | EN: Fault code PWG_BLS - OBD P-code reported for implausible signal" VALUE 0x716C2 TKW_VV_VV_UW 100.0 FORMULA_0010 0.0 65535.0000 /end CHARACTERISTIC
/begin CHARACTERISTIC K_ED_START_RL.P_CODE_UNPLAUSIBEL "P-Code fuer die Art UNPLAUSIBEL | EN: Fault code START_RL - OBD P-code reported for implausible signal" VALUE 0x716DC TKW_VV_VV_UW 100.0 FORMULA_0010 0.0 65535.0000 /end CHARACTERISTIC
/begin CHARACTERISTIC K_ED_N_GETR_EIN_HS.P_CODE_UNPLAUSIBEL "P-Code fuer die Art UNPLAUSIBEL | EN: Fault code N_GETR_EIN_HS - OBD P-code reported for implausible signal" VALUE 0x71710 TKW_VV_VV_UW 100.0 FORMULA_0010 0.0 65535.0000 /end CHARACTERISTIC
/begin CHARACTERISTIC K_ED_LLR_DIAG_CSS.P_CODE_UNPLAUSIBEL "P-Code fuer die Art UNPLAUSIBEL | EN: Fault code LLR_DIAG_CSS - OBD P-code reported for implausible signal" VALUE 0x71744 TKW_VV_VV_UW 100.0 FORMULA_0010 0.0 65535.0000 /end CHARACTERISTIC
/begin CHARACTERISTIC K_ED_TMOT_OBD_HIGH.P_CODE_UNPLAUSIBEL "P-Code fuer die Art UNPLAUSIBEL | EN: Fault code TMOT_OBD_HIGH - OBD P-code reported for implausible signal" VALUE 0x7175E TKW_VV_VV_UW 100.0 FORMULA_0010 0.0 65535.0000 /end CHARACTERISTIC
/begin CHARACTERISTIC K_ED_INDEX_121_IGN.P_CODE_UNPLAUSIBEL "P-Code fuer die Art UNPLAUSIBEL | EN: Fault code INDEX_121_IGN - OBD P-code reported for implausible signal" VALUE 0x718B0 TKW_VV_VV_UW 100.0 FORMULA_0010 0.0 65535.0000 /end CHARACTERISTIC
/begin CHARACTERISTIC K_ED_INDEX_122_IGN.P_CODE_UNPLAUSIBEL "P-Code fuer die Art UNPLAUSIBEL | EN: Fault code INDEX_122_IGN - OBD P-code reported for implausible signal" VALUE 0x718CA TKW_VV_VV_UW 100.0 FORMULA_0010 0.0 65535.0000 /end CHARACTERISTIC
/begin CHARACTERISTIC K_ED_INDEX_123_IGN.P_CODE_UNPLAUSIBEL "P-Code fuer die Art UNPLAUSIBEL | EN: Fault code INDEX_123_IGN - OBD P-code reported for implausible signal" VALUE 0x718E4 TKW_VV_VV_UW 100.0 FORMULA_0010 0.0 65535.0000 /end CHARACTERISTIC
/begin CHARACTERISTIC K_ED_INDEX_124_IGN.P_CODE_UNPLAUSIBEL "P-Code fuer die Art UNPLAUSIBEL | EN: Fault code INDEX_124_IGN - OBD P-code reported for implausible signal" VALUE 0x718FE TKW_VV_VV_UW 100.0 FORMULA_0010 0.0 65535.0000 /end CHARACTERISTIC
/begin CHARACTERISTIC K_ED_INDEX_125_IGN.P_CODE_UNPLAUSIBEL "P-Code fuer die Art UNPLAUSIBEL | EN: Fault code INDEX_125_IGN - OBD P-code reported for implausible signal" VALUE 0x71918 TKW_VV_VV_UW 100.0 FORMULA_0010 0.0 65535.0000 /end CHARACTERISTIC
/begin CHARACTERISTIC K_ED_INDEX_126_IGN.P_CODE_UNPLAUSIBEL "P-Code fuer die Art UNPLAUSIBEL | EN: Fault code INDEX_126_IGN - OBD P-code reported for implausible signal" VALUE 0x71932 TKW_VV_VV_UW 100.0 FORMULA_0010 0.0 65535.0000 /end CHARACTERISTIC
/begin CHARACTERISTIC K_ED_INDEX_127_IGN.P_CODE_UNPLAUSIBEL "P-Code fuer die Art UNPLAUSIBEL | EN: Fault code INDEX_127_IGN - OBD P-code reported for implausible signal" VALUE 0x7194C TKW_VV_VV_UW 100.0 FORMULA_0010 0.0 65535.0000 /end CHARACTERISTIC
/begin CHARACTERISTIC K_ED_SK_TR_IGN.FEHLERSCHWELLE "Filterschwelle fuer Fehlereintrag | EN: Filterschwelle fuer Fehlereintrag" VALUE 0x70C68 TKW_VV_VV_UB 100.0 FORMULA_0003 0.0 255.0000 /end CHARACTERISTIC
/begin CHARACTERISTIC K_ED_TMOT.FEHLERSCHWELLE "Filterschwelle fuer Fehlereintrag | EN: Fault code TMOT - debounce filter threshold for setting the fault" VALUE 0x70C82 TKW_VV_VV_UB 100.0 FORMULA_0003 0.0 255.0000 /end CHARACTERISTIC
/begin CHARACTERISTIC K_ED_TMOT_OBD.FEHLERSCHWELLE "Filterschwelle fuer Fehlereintrag | EN: Fault code TMOT_OBD - debounce filter threshold for setting the fault" VALUE 0x70C9C TKW_VV_VV_UB 100.0 FORMULA_0003 0.0 255.0000 /end CHARACTERISTIC
/begin CHARACTERISTIC K_ED_TAN1.FEHLERSCHWELLE "Filterschwelle fuer Fehlereintrag | EN: Fault code TAN1 - debounce filter threshold for setting the fault" VALUE 0x70CB6 TKW_VV_VV_UB 100.0 FORMULA_0003 0.0 255.0000 /end CHARACTERISTIC
/begin CHARACTERISTIC K_ED_TAN2.FEHLERSCHWELLE "Filterschwelle fuer Fehlereintrag | EN: Fault code TAN2 - debounce filter threshold for setting the fault" VALUE 0x70CD0 TKW_VV_VV_UB 100.0 FORMULA_0003 0.0 255.0000 /end CHARACTERISTIC
/begin CHARACTERISTIC K_ED_TIME_REL_OBD.FEHLERSCHWELLE "Filterschwelle fuer Fehlereintrag | EN: Fault code TIME_REL_OBD - debounce filter threshold for setting the fault" VALUE 0x70CEA TKW_VV_VV_UB 100.0 FORMULA_0003 0.0 255.0000 /end CHARACTERISTIC
/begin CHARACTERISTIC K_ED_TKA.FEHLERSCHWELLE "Filterschwelle fuer Fehlereintrag | EN: Fault code TKA - debounce filter threshold for setting the fault" VALUE 0x70D1E TKW_VV_VV_UB 100.0 FORMULA_0003 0.0 255.0000 /end CHARACTERISTIC
/begin CHARACTERISTIC K_ED_TDME.FEHLERSCHWELLE "Filterschwelle fuer Fehlereintrag | EN: Fault code TDME - debounce filter threshold for setting the fault" VALUE 0x70D38 TKW_VV_VV_UB 100.0 FORMULA_0003 0.0 255.0000 /end CHARACTERISTIC
/begin CHARACTERISTIC K_ED_TKA_OBD.FEHLERSCHWELLE "Filterschwelle fuer Fehlereintrag | EN: Fault code TKA_OBD - debounce filter threshold for setting the fault" VALUE 0x70DA0 TKW_VV_VV_UB 100.0 FORMULA_0003 0.0 255.0000 /end CHARACTERISTIC
/begin CHARACTERISTIC K_ED_PWG1.FEHLERSCHWELLE "Filterschwelle fuer Fehlereintrag | EN: Fault code PWG1 - debounce filter threshold for setting the fault" VALUE 0x70DBA TKW_VV_VV_UB 100.0 FORMULA_0003 0.0 255.0000 /end CHARACTERISTIC
/begin CHARACTERISTIC K_ED_PWG2.FEHLERSCHWELLE "Filterschwelle fuer Fehlereintrag | EN: Fault code PWG2 - debounce filter threshold for setting the fault" VALUE 0x70DD4 TKW_VV_VV_UB 100.0 FORMULA_0003 0.0 255.0000 /end CHARACTERISTIC
/begin CHARACTERISTIC K_ED_PWG_VGL.FEHLERSCHWELLE "Filterschwelle fuer Fehlereintrag | EN: Fault code PWG_VGL - debounce filter threshold for setting the fault" VALUE 0x70DEE TKW_VV_VV_UB 100.0 FORMULA_0003 0.0 255.0000 /end CHARACTERISTIC
/begin CHARACTERISTIC K_ED_PCTRL_IGN.FEHLERSCHWELLE "Filterschwelle fuer Fehlereintrag | EN: Fault code PCTRL_IGN - debounce filter threshold for setting the fault" VALUE 0x70E08 TKW_VV_VV_UB 100.0 FORMULA_0003 0.0 255.0000 /end CHARACTERISTIC
/begin CHARACTERISTIC K_ED_LLS1_CAN.FEHLERSCHWELLE "Filterschwelle fuer Fehlereintrag | EN: Fault code LLS1_CAN - debounce filter threshold for setting the fault" VALUE 0x70E22 TKW_VV_VV_UB 100.0 FORMULA_0003 0.0 255.0000 /end CHARACTERISTIC
/begin CHARACTERISTIC K_ED_LLS2_CAN.FEHLERSCHWELLE "Filterschwelle fuer Fehlereintrag | EN: Fault code LLS2_CAN - debounce filter threshold for setting the fault" VALUE 0x70E3C TKW_VV_VV_UB 100.0 FORMULA_0003 0.0 255.0000 /end CHARACTERISTIC
/begin CHARACTERISTIC K_ED_LLS1_SK.FEHLERSCHWELLE "Filterschwelle fuer Fehlereintrag | EN: Fault code LLS1_SK - debounce filter threshold for setting the fault" VALUE 0x70E8A TKW_VV_VV_UB 100.0 FORMULA_0003 0.0 255.0000 /end CHARACTERISTIC
/begin CHARACTERISTIC K_ED_LLS2_SK.FEHLERSCHWELLE "Filterschwelle fuer Fehlereintrag | EN: Fault code LLS2_SK - debounce filter threshold for setting the fault" VALUE 0x70EA4 TKW_VV_VV_UB 100.0 FORMULA_0003 0.0 255.0000 /end CHARACTERISTIC
/begin CHARACTERISTIC K_ED_SMG_SCHALTAB.FEHLERSCHWELLE "Filterschwelle fuer Fehlereintrag | EN: Fault code SMG_SCHALTAB - debounce filter threshold for setting the fault" VALUE 0x70EBE TKW_VV_VV_UB 100.0 FORMULA_0003 0.0 255.0000 /end CHARACTERISTIC
/begin CHARACTERISTIC K_ED_SMG_SK.FEHLERSCHWELLE "Filterschwelle fuer Fehlereintrag | EN: Fault code SMG_SK - debounce filter threshold for setting the fault" VALUE 0x70ED8 TKW_VV_VV_UB 100.0 FORMULA_0003 0.0 255.0000 /end CHARACTERISTIC
/begin CHARACTERISTIC K_ED_SMG_SK_N.FEHLERSCHWELLE "Filterschwelle fuer Fehlereintrag | EN: Fault code SMG_SK_N - debounce filter threshold for setting the fault" VALUE 0x70EF2 TKW_VV_VV_UB 100.0 FORMULA_0003 0.0 255.0000 /end CHARACTERISTIC
/begin CHARACTERISTIC K_ED_IONVERST_B1.FEHLERSCHWELLE "Filterschwelle fuer Fehlereintrag" VALUE 0x70FC2 TKW_VV_VV_UB 100.0 FORMULA_0003 0.0 255.0000 /end CHARACTERISTIC
/begin CHARACTERISTIC K_ED_IONSPG_B1.FEHLERSCHWELLE "Filterschwelle fuer Fehlereintrag" VALUE 0x70FDC TKW_VV_VV_UB 100.0 FORMULA_0003 0.0 255.0000 /end CHARACTERISTIC
/begin CHARACTERISTIC K_ED_IONVERST_B2.FEHLERSCHWELLE "Filterschwelle fuer Fehlereintrag" VALUE 0x70FF6 TKW_VV_VV_UB 100.0 FORMULA_0003 0.0 255.0000 /end CHARACTERISTIC
/begin CHARACTERISTIC K_ED_IONSPG_B2.FEHLERSCHWELLE "Filterschwelle fuer Fehlereintrag" VALUE 0x71010 TKW_VV_VV_UB 100.0 FORMULA_0003 0.0 255.0000 /end CHARACTERISTIC
/begin CHARACTERISTIC K_ED_TABG1.FEHLERSCHWELLE "Filterschwelle fuer Fehlereintrag | EN: Fault code TABG1 - debounce filter threshold for setting the fault" VALUE 0x7102A TKW_VV_VV_UB 100.0 FORMULA_0003 0.0 255.0000 /end CHARACTERISTIC
/begin CHARACTERISTIC K_ED_TABG2.FEHLERSCHWELLE "Filterschwelle fuer Fehlereintrag | EN: Fault code TABG2 - debounce filter threshold for setting the fault" VALUE 0x71044 TKW_VV_VV_UB 100.0 FORMULA_0003 0.0 255.0000 /end CHARACTERISTIC
/begin CHARACTERISTIC K_ED_LLS1_REGLER.FEHLERSCHWELLE "Filterschwelle fuer Fehlereintrag | EN: Fault code LLS1_REGLER - debounce filter threshold for setting the fault" VALUE 0x710C6 TKW_VV_VV_UB 100.0 FORMULA_0003 0.0 255.0000 /end CHARACTERISTIC
/begin CHARACTERISTIC K_ED_LLS2_REGLER.FEHLERSCHWELLE "Filterschwelle fuer Fehlereintrag | EN: Fault code LLS2_REGLER - debounce filter threshold for setting the fault" VALUE 0x710E0 TKW_VV_VV_UB 100.0 FORMULA_0003 0.0 255.0000 /end CHARACTERISTIC
/begin CHARACTERISTIC K_ED_MD_SK_ERR.FEHLERSCHWELLE "Filterschwelle fuer Fehlereintrag | EN: Fault code MD_SK_ERR - debounce filter threshold for setting the fault" VALUE 0x71162 TKW_VV_VV_UB 100.0 FORMULA_0003 0.0 255.0000 /end CHARACTERISTIC
/begin CHARACTERISTIC K_ED_LLS_INIT.FEHLERSCHWELLE "Filterschwelle fuer Fehlereintrag | EN: Fault code LLS_INIT - debounce filter threshold for setting the fault" VALUE 0x7117C TKW_VV_VV_UB 100.0 FORMULA_0003 0.0 255.0000 /end CHARACTERISTIC
/begin CHARACTERISTIC K_ED_LLS1_CMD.FEHLERSCHWELLE "Filterschwelle fuer Fehlereintrag | EN: Fault code LLS1_CMD - debounce filter threshold for setting the fault" VALUE 0x711E4 TKW_VV_VV_UB 100.0 FORMULA_0003 0.0 255.0000 /end CHARACTERISTIC
/begin CHARACTERISTIC K_ED_LLS2_CMD.FEHLERSCHWELLE "Filterschwelle fuer Fehlereintrag | EN: Fault code LLS2_CMD - debounce filter threshold for setting the fault" VALUE 0x711FE TKW_VV_VV_UB 100.0 FORMULA_0003 0.0 255.0000 /end CHARACTERISTIC
/begin CHARACTERISTIC K_ED_SC_SMG1.FEHLERSCHWELLE "Filterschwelle fuer Fehlereintrag | EN: Fault code SC_SMG1 - debounce filter threshold for setting the fault" VALUE 0x71218 TKW_VV_VV_UB 100.0 FORMULA_0003 0.0 255.0000 /end CHARACTERISTIC
/begin CHARACTERISTIC K_ED_SC_SMG2.FEHLERSCHWELLE "Filterschwelle fuer Fehlereintrag | EN: Fault code SC_SMG2 - debounce filter threshold for setting the fault" VALUE 0x71232 TKW_VV_VV_UB 100.0 FORMULA_0003 0.0 255.0000 /end CHARACTERISTIC
/begin CHARACTERISTIC K_ED_SC_SMG3.FEHLERSCHWELLE "Filterschwelle fuer Fehlereintrag | EN: Fault code SC_SMG3 - debounce filter threshold for setting the fault" VALUE 0x7124C TKW_VV_VV_UB 100.0 FORMULA_0003 0.0 255.0000 /end CHARACTERISTIC
/begin CHARACTERISTIC K_ED_SC_BUSOFF.FEHLERSCHWELLE "Filterschwelle fuer Fehlereintrag | EN: Fault code SC_BUSOFF - debounce filter threshold for setting the fault" VALUE 0x71266 TKW_VV_VV_UB 100.0 FORMULA_0003 0.0 255.0000 /end CHARACTERISTIC
/begin CHARACTERISTIC K_ED_ION_SIG_B1.FEHLERSCHWELLE "Filterschwelle fuer Fehlereintrag" VALUE 0x7139E TKW_VV_VV_UB 100.0 FORMULA_0003 0.0 255.0000 /end CHARACTERISTIC
/begin CHARACTERISTIC K_ED_ION_SIG_B2.FEHLERSCHWELLE "Filterschwelle fuer Fehlereintrag" VALUE 0x713B8 TKW_VV_VV_UB 100.0 FORMULA_0003 0.0 255.0000 /end CHARACTERISTIC
/begin CHARACTERISTIC K_ED_ION_SAT_B1.FEHLERSCHWELLE "Filterschwelle fuer Fehlereintrag" VALUE 0x714F0 TKW_VV_VV_UB 100.0 FORMULA_0003 0.0 255.0000 /end CHARACTERISTIC
/begin CHARACTERISTIC K_ED_ION_SAT_B2.FEHLERSCHWELLE "Filterschwelle fuer Fehlereintrag" VALUE 0x7150A TKW_VV_VV_UB 100.0 FORMULA_0003 0.0 255.0000 /end CHARACTERISTIC
/begin CHARACTERISTIC K_ED_TAN_OBD_B1.FEHLERSCHWELLE "Filterschwelle fuer Fehlereintrag | EN: Fault code TAN_OBD_B1 - debounce filter threshold for setting the fault" VALUE 0x7153E TKW_VV_VV_UB 100.0 FORMULA_0003 0.0 255.0000 /end CHARACTERISTIC
/begin CHARACTERISTIC K_ED_INDEX_88_IGN.FEHLERSCHWELLE "Filterschwelle fuer Fehlereintrag | EN: Filterschwelle fuer Fehlereintrag" VALUE 0x71558 TKW_VV_VV_UB 100.0 FORMULA_0003 0.0 255.0000 /end CHARACTERISTIC
/begin CHARACTERISTIC K_ED_INDEX_89_IGN.FEHLERSCHWELLE "Filterschwelle fuer Fehlereintrag" VALUE 0x71572 TKW_VV_VV_UB 100.0 FORMULA_0003 0.0 255.0000 /end CHARACTERISTIC
/begin CHARACTERISTIC K_ED_SG_IGN.FEHLERSCHWELLE "Filterschwelle fuer Fehlereintrag | EN: Fault code SG_IGN - debounce filter threshold for setting the fault" VALUE 0x715C0 TKW_VV_VV_UB 100.0 FORMULA_0003 0.0 255.0000 /end CHARACTERISTIC
/begin CHARACTERISTIC K_ED_SK_MANAGER_IGN.FEHLERSCHWELLE "Filterschwelle fuer Fehlereintrag | EN: Fault code SK_MANAGER_IGN - debounce filter threshold for setting the fault" VALUE 0x7160E TKW_VV_VV_UB 100.0 FORMULA_0003 0.0 255.0000 /end CHARACTERISTIC
/begin CHARACTERISTIC K_ED_LLR_DIAG.FEHLERSCHWELLE "Filterschwelle fuer Fehlereintrag | EN: Fault code LLR_DIAG - debounce filter threshold for setting the fault" VALUE 0x71628 TKW_VV_VV_UB 100.0 FORMULA_0003 0.0 255.0000 /end CHARACTERISTIC
/begin CHARACTERISTIC K_ED_THERMOSTAT.FEHLERSCHWELLE "Filterschwelle fuer Fehlereintrag | EN: Fault code THERMOSTAT - debounce filter threshold for setting the fault" VALUE 0x71642 TKW_VV_VV_UB 100.0 FORMULA_0003 0.0 255.0000 /end CHARACTERISTIC
/begin CHARACTERISTIC K_ED_TAN_OBD_B2.FEHLERSCHWELLE "Filterschwelle fuer Fehlereintrag | EN: Fault code TAN_OBD_B2 - debounce filter threshold for setting the fault" VALUE 0x7165C TKW_VV_VV_UB 100.0 FORMULA_0003 0.0 255.0000 /end CHARACTERISTIC
/begin CHARACTERISTIC K_ED_PWG_BLS.FEHLERSCHWELLE "Filterschwelle fuer Fehlereintrag | EN: Fault code PWG_BLS - debounce filter threshold for setting the fault" VALUE 0x716C4 TKW_VV_VV_UB 100.0 FORMULA_0003 0.0 255.0000 /end CHARACTERISTIC
/begin CHARACTERISTIC K_ED_START_RL.FEHLERSCHWELLE "Filterschwelle fuer Fehlereintrag | EN: Fault code START_RL - debounce filter threshold for setting the fault" VALUE 0x716DE TKW_VV_VV_UB 100.0 FORMULA_0003 0.0 255.0000 /end CHARACTERISTIC
/begin CHARACTERISTIC K_ED_N_GETR_EIN_HS.FEHLERSCHWELLE "Filterschwelle fuer Fehlereintrag | EN: Fault code N_GETR_EIN_HS - debounce filter threshold for setting the fault" VALUE 0x71712 TKW_VV_VV_UB 100.0 FORMULA_0003 0.0 255.0000 /end CHARACTERISTIC
/begin CHARACTERISTIC K_ED_LLR_DIAG_CSS.FEHLERSCHWELLE "Filterschwelle fuer Fehlereintrag | EN: Fault code LLR_DIAG_CSS - debounce filter threshold for setting the fault" VALUE 0x71746 TKW_VV_VV_UB 100.0 FORMULA_0003 0.0 255.0000 /end CHARACTERISTIC
/begin CHARACTERISTIC K_ED_TMOT_OBD_HIGH.FEHLERSCHWELLE "Filterschwelle fuer Fehlereintrag | EN: Fault code TMOT_OBD_HIGH - debounce filter threshold for setting the fault" VALUE 0x71760 TKW_VV_VV_UB 100.0 FORMULA_0003 0.0 255.0000 /end CHARACTERISTIC
/begin CHARACTERISTIC K_ED_INDEX_122_IGN.FEHLERSCHWELLE "Filterschwelle fuer Fehlereintrag | EN: Fault code INDEX_122_IGN - debounce filter threshold for setting the fault" VALUE 0x718CC TKW_VV_VV_UB 100.0 FORMULA_0003 0.0 255.0000 /end CHARACTERISTIC
/begin CHARACTERISTIC K_ED_INDEX_123_IGN.FEHLERSCHWELLE "Filterschwelle fuer Fehlereintrag | EN: Fault code INDEX_123_IGN - debounce filter threshold for setting the fault" VALUE 0x718E6 TKW_VV_VV_UB 100.0 FORMULA_0003 0.0 255.0000 /end CHARACTERISTIC
/begin CHARACTERISTIC K_ED_INDEX_124_IGN.FEHLERSCHWELLE "Filterschwelle fuer Fehlereintrag | EN: Fault code INDEX_124_IGN - debounce filter threshold for setting the fault" VALUE 0x71900 TKW_VV_VV_UB 100.0 FORMULA_0003 0.0 255.0000 /end CHARACTERISTIC
/begin CHARACTERISTIC K_ED_INDEX_125_IGN.FEHLERSCHWELLE "Filterschwelle fuer Fehlereintrag | EN: Fault code INDEX_125_IGN - debounce filter threshold for setting the fault" VALUE 0x7191A TKW_VV_VV_UB 100.0 FORMULA_0003 0.0 255.0000 /end CHARACTERISTIC
/begin CHARACTERISTIC K_ED_INDEX_126_IGN.FEHLERSCHWELLE "Filterschwelle fuer Fehlereintrag | EN: Fault code INDEX_126_IGN - debounce filter threshold for setting the fault" VALUE 0x71934 TKW_VV_VV_UB 100.0 FORMULA_0003 0.0 255.0000 /end CHARACTERISTIC
/begin CHARACTERISTIC K_ED_INDEX_127_IGN.FEHLERSCHWELLE "Filterschwelle fuer Fehlereintrag | EN: Fault code INDEX_127_IGN - debounce filter threshold for setting the fault" VALUE 0x7194E TKW_VV_VV_UB 100.0 FORMULA_0003 0.0 255.0000 /end CHARACTERISTIC
/begin CHARACTERISTIC K_ED_SK_TR_IGN.OK_SCHWELLE "Filterschwelle fuer Fehleraustrag | EN: Filterschwelle fuer Fehleraustrag" VALUE 0x70C69 TKW_VV_VV_UB 100.0 FORMULA_0003 0.0 255.0000 /end CHARACTERISTIC
/begin CHARACTERISTIC K_ED_TMOT.OK_SCHWELLE "Filterschwelle fuer Fehleraustrag | EN: Fault code TMOT - debounce filter threshold for clearing (healing) the fault" VALUE 0x70C83 TKW_VV_VV_UB 100.0 FORMULA_0003 0.0 255.0000 /end CHARACTERISTIC
/begin CHARACTERISTIC K_ED_TMOT_OBD.OK_SCHWELLE "Filterschwelle fuer Fehleraustrag | EN: Fault code TMOT_OBD - debounce filter threshold for clearing (healing) the fault" VALUE 0x70C9D TKW_VV_VV_UB 100.0 FORMULA_0003 0.0 255.0000 /end CHARACTERISTIC
/begin CHARACTERISTIC K_ED_TAN1.OK_SCHWELLE "Filterschwelle fuer Fehleraustrag | EN: Fault code TAN1 - debounce filter threshold for clearing (healing) the fault" VALUE 0x70CB7 TKW_VV_VV_UB 100.0 FORMULA_0003 0.0 255.0000 /end CHARACTERISTIC
/begin CHARACTERISTIC K_ED_TAN2.OK_SCHWELLE "Filterschwelle fuer Fehleraustrag | EN: Fault code TAN2 - debounce filter threshold for clearing (healing) the fault" VALUE 0x70CD1 TKW_VV_VV_UB 100.0 FORMULA_0003 0.0 255.0000 /end CHARACTERISTIC
/begin CHARACTERISTIC K_ED_TIME_REL_OBD.OK_SCHWELLE "Filterschwelle fuer Fehleraustrag | EN: Fault code TIME_REL_OBD - debounce filter threshold for clearing (healing) the fault" VALUE 0x70CEB TKW_VV_VV_UB 100.0 FORMULA_0003 0.0 255.0000 /end CHARACTERISTIC
/begin CHARACTERISTIC K_ED_TKA.OK_SCHWELLE "Filterschwelle fuer Fehleraustrag | EN: Fault code TKA - debounce filter threshold for clearing (healing) the fault" VALUE 0x70D1F TKW_VV_VV_UB 100.0 FORMULA_0003 0.0 255.0000 /end CHARACTERISTIC
/begin CHARACTERISTIC K_ED_TDME.OK_SCHWELLE "Filterschwelle fuer Fehleraustrag | EN: Fault code TDME - debounce filter threshold for clearing (healing) the fault" VALUE 0x70D39 TKW_VV_VV_UB 100.0 FORMULA_0003 0.0 255.0000 /end CHARACTERISTIC
/begin CHARACTERISTIC K_ED_TKA_OBD.OK_SCHWELLE "Filterschwelle fuer Fehleraustrag | EN: Fault code TKA_OBD - debounce filter threshold for clearing (healing) the fault" VALUE 0x70DA1 TKW_VV_VV_UB 100.0 FORMULA_0003 0.0 255.0000 /end CHARACTERISTIC
/begin CHARACTERISTIC K_ED_PWG1.OK_SCHWELLE "Filterschwelle fuer Fehleraustrag | EN: Fault code PWG1 - debounce filter threshold for clearing (healing) the fault" VALUE 0x70DBB TKW_VV_VV_UB 100.0 FORMULA_0003 0.0 255.0000 /end CHARACTERISTIC
/begin CHARACTERISTIC K_ED_PWG2.OK_SCHWELLE "Filterschwelle fuer Fehleraustrag | EN: Fault code PWG2 - debounce filter threshold for clearing (healing) the fault" VALUE 0x70DD5 TKW_VV_VV_UB 100.0 FORMULA_0003 0.0 255.0000 /end CHARACTERISTIC
/begin CHARACTERISTIC K_ED_PWG_VGL.OK_SCHWELLE "Filterschwelle fuer Fehleraustrag | EN: Fault code PWG_VGL - debounce filter threshold for clearing (healing) the fault" VALUE 0x70DEF TKW_VV_VV_UB 100.0 FORMULA_0003 0.0 255.0000 /end CHARACTERISTIC
/begin CHARACTERISTIC K_ED_PCTRL_IGN.OK_SCHWELLE "Filterschwelle fuer Fehleraustrag | EN: Fault code PCTRL_IGN - debounce filter threshold for clearing (healing) the fault" VALUE 0x70E09 TKW_VV_VV_UB 100.0 FORMULA_0003 0.0 255.0000 /end CHARACTERISTIC
/begin CHARACTERISTIC K_ED_LLS1_CAN.OK_SCHWELLE "Filterschwelle fuer Fehleraustrag | EN: Fault code LLS1_CAN - debounce filter threshold for clearing (healing) the fault" VALUE 0x70E23 TKW_VV_VV_UB 100.0 FORMULA_0003 0.0 255.0000 /end CHARACTERISTIC
/begin CHARACTERISTIC K_ED_LLS2_CAN.OK_SCHWELLE "Filterschwelle fuer Fehleraustrag | EN: Fault code LLS2_CAN - debounce filter threshold for clearing (healing) the fault" VALUE 0x70E3D TKW_VV_VV_UB 100.0 FORMULA_0003 0.0 255.0000 /end CHARACTERISTIC
/begin CHARACTERISTIC K_ED_LLS1_SK.OK_SCHWELLE "Filterschwelle fuer Fehleraustrag | EN: Fault code LLS1_SK - debounce filter threshold for clearing (healing) the fault" VALUE 0x70E8B TKW_VV_VV_UB 100.0 FORMULA_0003 0.0 255.0000 /end CHARACTERISTIC
/begin CHARACTERISTIC K_ED_LLS2_SK.OK_SCHWELLE "Filterschwelle fuer Fehleraustrag | EN: Fault code LLS2_SK - debounce filter threshold for clearing (healing) the fault" VALUE 0x70EA5 TKW_VV_VV_UB 100.0 FORMULA_0003 0.0 255.0000 /end CHARACTERISTIC
/begin CHARACTERISTIC K_ED_SMG_SCHALTAB.OK_SCHWELLE "Filterschwelle fuer Fehleraustrag | EN: Fault code SMG_SCHALTAB - debounce filter threshold for clearing (healing) the fault" VALUE 0x70EBF TKW_VV_VV_UB 100.0 FORMULA_0003 0.0 255.0000 /end CHARACTERISTIC
/begin CHARACTERISTIC K_ED_SMG_SK.OK_SCHWELLE "Filterschwelle fuer Fehleraustrag | EN: Fault code SMG_SK - debounce filter threshold for clearing (healing) the fault" VALUE 0x70ED9 TKW_VV_VV_UB 100.0 FORMULA_0003 0.0 255.0000 /end CHARACTERISTIC
/begin CHARACTERISTIC K_ED_SMG_SK_N.OK_SCHWELLE "Filterschwelle fuer Fehleraustrag | EN: Fault code SMG_SK_N - debounce filter threshold for clearing (healing) the fault" VALUE 0x70EF3 TKW_VV_VV_UB 100.0 FORMULA_0003 0.0 255.0000 /end CHARACTERISTIC
/begin CHARACTERISTIC K_ED_IONVERST_B1.OK_SCHWELLE "Filterschwelle fuer Fehleraustrag" VALUE 0x70FC3 TKW_VV_VV_UB 100.0 FORMULA_0003 0.0 255.0000 /end CHARACTERISTIC
/begin CHARACTERISTIC K_ED_IONSPG_B1.OK_SCHWELLE "Filterschwelle fuer Fehleraustrag" VALUE 0x70FDD TKW_VV_VV_UB 100.0 FORMULA_0003 0.0 255.0000 /end CHARACTERISTIC
/begin CHARACTERISTIC K_ED_IONVERST_B2.OK_SCHWELLE "Filterschwelle fuer Fehleraustrag" VALUE 0x70FF7 TKW_VV_VV_UB 100.0 FORMULA_0003 0.0 255.0000 /end CHARACTERISTIC
/begin CHARACTERISTIC K_ED_IONSPG_B2.OK_SCHWELLE "Filterschwelle fuer Fehleraustrag" VALUE 0x71011 TKW_VV_VV_UB 100.0 FORMULA_0003 0.0 255.0000 /end CHARACTERISTIC
/begin CHARACTERISTIC K_ED_TABG1.OK_SCHWELLE "Filterschwelle fuer Fehleraustrag | EN: Fault code TABG1 - debounce filter threshold for clearing (healing) the fault" VALUE 0x7102B TKW_VV_VV_UB 100.0 FORMULA_0003 0.0 255.0000 /end CHARACTERISTIC
/begin CHARACTERISTIC K_ED_TABG2.OK_SCHWELLE "Filterschwelle fuer Fehleraustrag | EN: Fault code TABG2 - debounce filter threshold for clearing (healing) the fault" VALUE 0x71045 TKW_VV_VV_UB 100.0 FORMULA_0003 0.0 255.0000 /end CHARACTERISTIC
/begin CHARACTERISTIC K_ED_LLS1_REGLER.OK_SCHWELLE "Filterschwelle fuer Fehleraustrag | EN: Fault code LLS1_REGLER - debounce filter threshold for clearing (healing) the fault" VALUE 0x710C7 TKW_VV_VV_UB 100.0 FORMULA_0003 0.0 255.0000 /end CHARACTERISTIC
/begin CHARACTERISTIC K_ED_LLS2_REGLER.OK_SCHWELLE "Filterschwelle fuer Fehleraustrag | EN: Fault code LLS2_REGLER - debounce filter threshold for clearing (healing) the fault" VALUE 0x710E1 TKW_VV_VV_UB 100.0 FORMULA_0003 0.0 255.0000 /end CHARACTERISTIC
/begin CHARACTERISTIC K_ED_MD_SK_ERR.OK_SCHWELLE "Filterschwelle fuer Fehleraustrag | EN: Fault code MD_SK_ERR - debounce filter threshold for clearing (healing) the fault" VALUE 0x71163 TKW_VV_VV_UB 100.0 FORMULA_0003 0.0 255.0000 /end CHARACTERISTIC
/begin CHARACTERISTIC K_ED_LLS_INIT.OK_SCHWELLE "Filterschwelle fuer Fehleraustrag | EN: Fault code LLS_INIT - debounce filter threshold for clearing (healing) the fault" VALUE 0x7117D TKW_VV_VV_UB 100.0 FORMULA_0003 0.0 255.0000 /end CHARACTERISTIC
/begin CHARACTERISTIC K_ED_LLS1_CMD.OK_SCHWELLE "Filterschwelle fuer Fehleraustrag | EN: Fault code LLS1_CMD - debounce filter threshold for clearing (healing) the fault" VALUE 0x711E5 TKW_VV_VV_UB 100.0 FORMULA_0003 0.0 255.0000 /end CHARACTERISTIC
/begin CHARACTERISTIC K_ED_LLS2_CMD.OK_SCHWELLE "Filterschwelle fuer Fehleraustrag | EN: Fault code LLS2_CMD - debounce filter threshold for clearing (healing) the fault" VALUE 0x711FF TKW_VV_VV_UB 100.0 FORMULA_0003 0.0 255.0000 /end CHARACTERISTIC
/begin CHARACTERISTIC K_ED_SC_SMG1.OK_SCHWELLE "Filterschwelle fuer Fehleraustrag | EN: Fault code SC_SMG1 - debounce filter threshold for clearing (healing) the fault" VALUE 0x71219 TKW_VV_VV_UB 100.0 FORMULA_0003 0.0 255.0000 /end CHARACTERISTIC
/begin CHARACTERISTIC K_ED_SC_SMG2.OK_SCHWELLE "Filterschwelle fuer Fehleraustrag | EN: Fault code SC_SMG2 - debounce filter threshold for clearing (healing) the fault" VALUE 0x71233 TKW_VV_VV_UB 100.0 FORMULA_0003 0.0 255.0000 /end CHARACTERISTIC
/begin CHARACTERISTIC K_ED_SC_SMG3.OK_SCHWELLE "Filterschwelle fuer Fehleraustrag | EN: Fault code SC_SMG3 - debounce filter threshold for clearing (healing) the fault" VALUE 0x7124D TKW_VV_VV_UB 100.0 FORMULA_0003 0.0 255.0000 /end CHARACTERISTIC
/begin CHARACTERISTIC K_ED_SC_BUSOFF.OK_SCHWELLE "Filterschwelle fuer Fehleraustrag | EN: Fault code SC_BUSOFF - debounce filter threshold for clearing (healing) the fault" VALUE 0x71267 TKW_VV_VV_UB 100.0 FORMULA_0003 0.0 255.0000 /end CHARACTERISTIC
/begin CHARACTERISTIC K_ED_ION_SIG_B1.OK_SCHWELLE "Filterschwelle fuer Fehleraustrag" VALUE 0x7139F TKW_VV_VV_UB 100.0 FORMULA_0003 0.0 255.0000 /end CHARACTERISTIC
/begin CHARACTERISTIC K_ED_ION_SIG_B2.OK_SCHWELLE "Filterschwelle fuer Fehleraustrag" VALUE 0x713B9 TKW_VV_VV_UB 100.0 FORMULA_0003 0.0 255.0000 /end CHARACTERISTIC
/begin CHARACTERISTIC K_ED_ION_SAT_B1.OK_SCHWELLE "Filterschwelle fuer Fehleraustrag" VALUE 0x714F1 TKW_VV_VV_UB 100.0 FORMULA_0003 0.0 255.0000 /end CHARACTERISTIC
/begin CHARACTERISTIC K_ED_ION_SAT_B2.OK_SCHWELLE "Filterschwelle fuer Fehleraustrag" VALUE 0x7150B TKW_VV_VV_UB 100.0 FORMULA_0003 0.0 255.0000 /end CHARACTERISTIC
/begin CHARACTERISTIC K_ED_TAN_OBD_B1.OK_SCHWELLE "Filterschwelle fuer Fehleraustrag | EN: Fault code TAN_OBD_B1 - debounce filter threshold for clearing (healing) the fault" VALUE 0x7153F TKW_VV_VV_UB 100.0 FORMULA_0003 0.0 255.0000 /end CHARACTERISTIC
/begin CHARACTERISTIC K_ED_INDEX_88_IGN.OK_SCHWELLE "Filterschwelle fuer Fehleraustrag | EN: Filterschwelle fuer Fehleraustrag" VALUE 0x71559 TKW_VV_VV_UB 100.0 FORMULA_0003 0.0 255.0000 /end CHARACTERISTIC
/begin CHARACTERISTIC K_ED_INDEX_89_IGN.OK_SCHWELLE "Filterschwelle fuer Fehleraustrag" VALUE 0x71573 TKW_VV_VV_UB 100.0 FORMULA_0003 0.0 255.0000 /end CHARACTERISTIC
/begin CHARACTERISTIC K_ED_SG_IGN.OK_SCHWELLE "Filterschwelle fuer Fehleraustrag | EN: Fault code SG_IGN - debounce filter threshold for clearing (healing) the fault" VALUE 0x715C1 TKW_VV_VV_UB 100.0 FORMULA_0003 0.0 255.0000 /end CHARACTERISTIC
/begin CHARACTERISTIC K_ED_SK_MANAGER_IGN.OK_SCHWELLE "Filterschwelle fuer Fehleraustrag | EN: Fault code SK_MANAGER_IGN - debounce filter threshold for clearing (healing) the fault" VALUE 0x7160F TKW_VV_VV_UB 100.0 FORMULA_0003 0.0 255.0000 /end CHARACTERISTIC
/begin CHARACTERISTIC K_ED_LLR_DIAG.OK_SCHWELLE "Filterschwelle fuer Fehleraustrag | EN: Fault code LLR_DIAG - debounce filter threshold for clearing (healing) the fault" VALUE 0x71629 TKW_VV_VV_UB 100.0 FORMULA_0003 0.0 255.0000 /end CHARACTERISTIC
/begin CHARACTERISTIC K_ED_THERMOSTAT.OK_SCHWELLE "Filterschwelle fuer Fehleraustrag | EN: Fault code THERMOSTAT - debounce filter threshold for clearing (healing) the fault" VALUE 0x71643 TKW_VV_VV_UB 100.0 FORMULA_0003 0.0 255.0000 /end CHARACTERISTIC
/begin CHARACTERISTIC K_ED_TAN_OBD_B2.OK_SCHWELLE "Filterschwelle fuer Fehleraustrag | EN: Fault code TAN_OBD_B2 - debounce filter threshold for clearing (healing) the fault" VALUE 0x7165D TKW_VV_VV_UB 100.0 FORMULA_0003 0.0 255.0000 /end CHARACTERISTIC
/begin CHARACTERISTIC K_ED_PWG_BLS.OK_SCHWELLE "Filterschwelle fuer Fehleraustrag | EN: Fault code PWG_BLS - debounce filter threshold for clearing (healing) the fault" VALUE 0x716C5 TKW_VV_VV_UB 100.0 FORMULA_0003 0.0 255.0000 /end CHARACTERISTIC
/begin CHARACTERISTIC K_ED_START_RL.OK_SCHWELLE "Filterschwelle fuer Fehleraustrag | EN: Fault code START_RL - debounce filter threshold for clearing (healing) the fault" VALUE 0x716DF TKW_VV_VV_UB 100.0 FORMULA_0003 0.0 255.0000 /end CHARACTERISTIC
/begin CHARACTERISTIC K_ED_N_GETR_EIN_HS.OK_SCHWELLE "Filterschwelle fuer Fehleraustrag | EN: Fault code N_GETR_EIN_HS - debounce filter threshold for clearing (healing) the fault" VALUE 0x71713 TKW_VV_VV_UB 100.0 FORMULA_0003 0.0 255.0000 /end CHARACTERISTIC
/begin CHARACTERISTIC K_ED_LLR_DIAG_CSS.OK_SCHWELLE "Filterschwelle fuer Fehleraustrag | EN: Fault code LLR_DIAG_CSS - debounce filter threshold for clearing (healing) the fault" VALUE 0x71747 TKW_VV_VV_UB 100.0 FORMULA_0003 0.0 255.0000 /end CHARACTERISTIC
/begin CHARACTERISTIC K_ED_TMOT_OBD_HIGH.OK_SCHWELLE "Filterschwelle fuer Fehleraustrag | EN: Fault code TMOT_OBD_HIGH - debounce filter threshold for clearing (healing) the fault" VALUE 0x71761 TKW_VV_VV_UB 100.0 FORMULA_0003 0.0 255.0000 /end CHARACTERISTIC
/begin CHARACTERISTIC K_ED_INDEX_121_IGN.OK_SCHWELLE "Filterschwelle fuer Fehleraustrag | EN: Fault code INDEX_121_IGN - debounce filter threshold for clearing (healing) the fault" VALUE 0x718B3 TKW_VV_VV_UB 100.0 FORMULA_0003 0.0 255.0000 /end CHARACTERISTIC
/begin CHARACTERISTIC K_ED_INDEX_122_IGN.OK_SCHWELLE "Filterschwelle fuer Fehleraustrag | EN: Fault code INDEX_122_IGN - debounce filter threshold for clearing (healing) the fault" VALUE 0x718CD TKW_VV_VV_UB 100.0 FORMULA_0003 0.0 255.0000 /end CHARACTERISTIC
/begin CHARACTERISTIC K_ED_INDEX_123_IGN.OK_SCHWELLE "Filterschwelle fuer Fehleraustrag | EN: Fault code INDEX_123_IGN - debounce filter threshold for clearing (healing) the fault" VALUE 0x718E7 TKW_VV_VV_UB 100.0 FORMULA_0003 0.0 255.0000 /end CHARACTERISTIC
/begin CHARACTERISTIC K_ED_INDEX_124_IGN.OK_SCHWELLE "Filterschwelle fuer Fehleraustrag | EN: Fault code INDEX_124_IGN - debounce filter threshold for clearing (healing) the fault" VALUE 0x71901 TKW_VV_VV_UB 100.0 FORMULA_0003 0.0 255.0000 /end CHARACTERISTIC
/begin CHARACTERISTIC K_ED_INDEX_125_IGN.OK_SCHWELLE "Filterschwelle fuer Fehleraustrag | EN: Fault code INDEX_125_IGN - debounce filter threshold for clearing (healing) the fault" VALUE 0x7191B TKW_VV_VV_UB 100.0 FORMULA_0003 0.0 255.0000 /end CHARACTERISTIC
/begin CHARACTERISTIC K_ED_INDEX_126_IGN.OK_SCHWELLE "Filterschwelle fuer Fehleraustrag | EN: Fault code INDEX_126_IGN - debounce filter threshold for clearing (healing) the fault" VALUE 0x71935 TKW_VV_VV_UB 100.0 FORMULA_0003 0.0 255.0000 /end CHARACTERISTIC
/begin CHARACTERISTIC K_ED_INDEX_127_IGN.OK_SCHWELLE "Filterschwelle fuer Fehleraustrag | EN: Fault code INDEX_127_IGN - debounce filter threshold for clearing (healing) the fault" VALUE 0x7194F TKW_VV_VV_UB 100.0 FORMULA_0003 0.0 255.0000 /end CHARACTERISTIC
/begin CHARACTERISTIC K_ED_SK_TR_IGN.INC_VOR_EINTRAG "Filtererhoehung vorm Fehlerspeichereintrag | EN: Filtererhoehung vorm Fehlerspeichereintrag" VALUE 0x70C6A TKW_VV_VV_UB 100.0 FORMULA_0003 0.0 255.0000 /end CHARACTERISTIC
/begin CHARACTERISTIC K_ED_TMOT.INC_VOR_EINTRAG "Filtererhoehung vorm Fehlerspeichereintrag | EN: Fault code TMOT - debounce filter increment before fault-memory entry" VALUE 0x70C84 TKW_VV_VV_UB 100.0 FORMULA_0003 0.0 255.0000 /end CHARACTERISTIC
/begin CHARACTERISTIC K_ED_TMOT_OBD.INC_VOR_EINTRAG "Filtererhoehung vorm Fehlerspeichereintrag | EN: Fault code TMOT_OBD - debounce filter increment before fault-memory entry" VALUE 0x70C9E TKW_VV_VV_UB 100.0 FORMULA_0003 0.0 255.0000 /end CHARACTERISTIC
/begin CHARACTERISTIC K_ED_TAN1.INC_VOR_EINTRAG "Filtererhoehung vorm Fehlerspeichereintrag | EN: Fault code TAN1 - debounce filter increment before fault-memory entry" VALUE 0x70CB8 TKW_VV_VV_UB 100.0 FORMULA_0003 0.0 255.0000 /end CHARACTERISTIC
/begin CHARACTERISTIC K_ED_TAN2.INC_VOR_EINTRAG "Filtererhoehung vorm Fehlerspeichereintrag | EN: Fault code TAN2 - debounce filter increment before fault-memory entry" VALUE 0x70CD2 TKW_VV_VV_UB 100.0 FORMULA_0003 0.0 255.0000 /end CHARACTERISTIC
/begin CHARACTERISTIC K_ED_TIME_REL_OBD.INC_VOR_EINTRAG "Filtererhoehung vorm Fehlerspeichereintrag | EN: Fault code TIME_REL_OBD - debounce filter increment before fault-memory entry" VALUE 0x70CEC TKW_VV_VV_UB 100.0 FORMULA_0003 0.0 255.0000 /end CHARACTERISTIC
/begin CHARACTERISTIC K_ED_TKA.INC_VOR_EINTRAG "Filtererhoehung vorm Fehlerspeichereintrag | EN: Fault code TKA - debounce filter increment before fault-memory entry" VALUE 0x70D20 TKW_VV_VV_UB 100.0 FORMULA_0003 0.0 255.0000 /end CHARACTERISTIC
/begin CHARACTERISTIC K_ED_TDME.INC_VOR_EINTRAG "Filtererhoehung vorm Fehlerspeichereintrag | EN: Fault code TDME - debounce filter increment before fault-memory entry" VALUE 0x70D3A TKW_VV_VV_UB 100.0 FORMULA_0003 0.0 255.0000 /end CHARACTERISTIC
/begin CHARACTERISTIC K_ED_TKA_OBD.INC_VOR_EINTRAG "Filtererhoehung vorm Fehlerspeichereintrag | EN: Fault code TKA_OBD - debounce filter increment before fault-memory entry" VALUE 0x70DA2 TKW_VV_VV_UB 100.0 FORMULA_0003 0.0 255.0000 /end CHARACTERISTIC
/begin CHARACTERISTIC K_ED_PWG1.INC_VOR_EINTRAG "Filtererhoehung vorm Fehlerspeichereintrag | EN: Fault code PWG1 - debounce filter increment before fault-memory entry" VALUE 0x70DBC TKW_VV_VV_UB 100.0 FORMULA_0003 0.0 255.0000 /end CHARACTERISTIC
/begin CHARACTERISTIC K_ED_PWG2.INC_VOR_EINTRAG "Filtererhoehung vorm Fehlerspeichereintrag | EN: Fault code PWG2 - debounce filter increment before fault-memory entry" VALUE 0x70DD6 TKW_VV_VV_UB 100.0 FORMULA_0003 0.0 255.0000 /end CHARACTERISTIC
/begin CHARACTERISTIC K_ED_PWG_VGL.INC_VOR_EINTRAG "Filtererhoehung vorm Fehlerspeichereintrag | EN: Fault code PWG_VGL - debounce filter increment before fault-memory entry" VALUE 0x70DF0 TKW_VV_VV_UB 100.0 FORMULA_0003 0.0 255.0000 /end CHARACTERISTIC
/begin CHARACTERISTIC K_ED_PCTRL_IGN.INC_VOR_EINTRAG "Filtererhoehung vorm Fehlerspeichereintrag | EN: Fault code PCTRL_IGN - debounce filter increment before fault-memory entry" VALUE 0x70E0A TKW_VV_VV_UB 100.0 FORMULA_0003 0.0 255.0000 /end CHARACTERISTIC
/begin CHARACTERISTIC K_ED_LLS1_CAN.INC_VOR_EINTRAG "Filtererhoehung vorm Fehlerspeichereintrag | EN: Fault code LLS1_CAN - debounce filter increment before fault-memory entry" VALUE 0x70E24 TKW_VV_VV_UB 100.0 FORMULA_0003 0.0 255.0000 /end CHARACTERISTIC
/begin CHARACTERISTIC K_ED_LLS2_CAN.INC_VOR_EINTRAG "Filtererhoehung vorm Fehlerspeichereintrag | EN: Fault code LLS2_CAN - debounce filter increment before fault-memory entry" VALUE 0x70E3E TKW_VV_VV_UB 100.0 FORMULA_0003 0.0 255.0000 /end CHARACTERISTIC
/begin CHARACTERISTIC K_ED_LLS1_SK.INC_VOR_EINTRAG "Filtererhoehung vorm Fehlerspeichereintrag | EN: Fault code LLS1_SK - debounce filter increment before fault-memory entry" VALUE 0x70E8C TKW_VV_VV_UB 100.0 FORMULA_0003 0.0 255.0000 /end CHARACTERISTIC
/begin CHARACTERISTIC K_ED_LLS2_SK.INC_VOR_EINTRAG "Filtererhoehung vorm Fehlerspeichereintrag | EN: Fault code LLS2_SK - debounce filter increment before fault-memory entry" VALUE 0x70EA6 TKW_VV_VV_UB 100.0 FORMULA_0003 0.0 255.0000 /end CHARACTERISTIC
/begin CHARACTERISTIC K_ED_SMG_SCHALTAB.INC_VOR_EINTRAG "Filtererhoehung vorm Fehlerspeichereintrag | EN: Fault code SMG_SCHALTAB - debounce filter increment before fault-memory entry" VALUE 0x70EC0 TKW_VV_VV_UB 100.0 FORMULA_0003 0.0 255.0000 /end CHARACTERISTIC
/begin CHARACTERISTIC K_ED_SMG_SK.INC_VOR_EINTRAG "Filtererhoehung vorm Fehlerspeichereintrag | EN: Fault code SMG_SK - debounce filter increment before fault-memory entry" VALUE 0x70EDA TKW_VV_VV_UB 100.0 FORMULA_0003 0.0 255.0000 /end CHARACTERISTIC
/begin CHARACTERISTIC K_ED_SMG_SK_N.INC_VOR_EINTRAG "Filtererhoehung vorm Fehlerspeichereintrag | EN: Fault code SMG_SK_N - debounce filter increment before fault-memory entry" VALUE 0x70EF4 TKW_VV_VV_UB 100.0 FORMULA_0003 0.0 255.0000 /end CHARACTERISTIC
/begin CHARACTERISTIC K_ED_IONVERST_B1.INC_VOR_EINTRAG "Filtererhoehung vorm Fehlerspeichereintrag" VALUE 0x70FC4 TKW_VV_VV_UB 100.0 FORMULA_0003 0.0 255.0000 /end CHARACTERISTIC
/begin CHARACTERISTIC K_ED_IONSPG_B1.INC_VOR_EINTRAG "Filtererhoehung vorm Fehlerspeichereintrag" VALUE 0x70FDE TKW_VV_VV_UB 100.0 FORMULA_0003 0.0 255.0000 /end CHARACTERISTIC
/begin CHARACTERISTIC K_ED_IONVERST_B2.INC_VOR_EINTRAG "Filtererhoehung vorm Fehlerspeichereintrag" VALUE 0x70FF8 TKW_VV_VV_UB 100.0 FORMULA_0003 0.0 255.0000 /end CHARACTERISTIC
/begin CHARACTERISTIC K_ED_IONSPG_B2.INC_VOR_EINTRAG "Filtererhoehung vorm Fehlerspeichereintrag" VALUE 0x71012 TKW_VV_VV_UB 100.0 FORMULA_0003 0.0 255.0000 /end CHARACTERISTIC
/begin CHARACTERISTIC K_ED_TABG1.INC_VOR_EINTRAG "Filtererhoehung vorm Fehlerspeichereintrag | EN: Fault code TABG1 - debounce filter increment before fault-memory entry" VALUE 0x7102C TKW_VV_VV_UB 100.0 FORMULA_0003 0.0 255.0000 /end CHARACTERISTIC
/begin CHARACTERISTIC K_ED_TABG2.INC_VOR_EINTRAG "Filtererhoehung vorm Fehlerspeichereintrag | EN: Fault code TABG2 - debounce filter increment before fault-memory entry" VALUE 0x71046 TKW_VV_VV_UB 100.0 FORMULA_0003 0.0 255.0000 /end CHARACTERISTIC
/begin CHARACTERISTIC K_ED_LLS1_REGLER.INC_VOR_EINTRAG "Filtererhoehung vorm Fehlerspeichereintrag | EN: Fault code LLS1_REGLER - debounce filter increment before fault-memory entry" VALUE 0x710C8 TKW_VV_VV_UB 100.0 FORMULA_0003 0.0 255.0000 /end CHARACTERISTIC
/begin CHARACTERISTIC K_ED_LLS2_REGLER.INC_VOR_EINTRAG "Filtererhoehung vorm Fehlerspeichereintrag | EN: Fault code LLS2_REGLER - debounce filter increment before fault-memory entry" VALUE 0x710E2 TKW_VV_VV_UB 100.0 FORMULA_0003 0.0 255.0000 /end CHARACTERISTIC
/begin CHARACTERISTIC K_ED_MD_SK_ERR.INC_VOR_EINTRAG "Filtererhoehung vorm Fehlerspeichereintrag | EN: Fault code MD_SK_ERR - debounce filter increment before fault-memory entry" VALUE 0x71164 TKW_VV_VV_UB 100.0 FORMULA_0003 0.0 255.0000 /end CHARACTERISTIC
/begin CHARACTERISTIC K_ED_LLS_INIT.INC_VOR_EINTRAG "Filtererhoehung vorm Fehlerspeichereintrag | EN: Fault code LLS_INIT - debounce filter increment before fault-memory entry" VALUE 0x7117E TKW_VV_VV_UB 100.0 FORMULA_0003 0.0 255.0000 /end CHARACTERISTIC
/begin CHARACTERISTIC K_ED_LLS1_CMD.INC_VOR_EINTRAG "Filtererhoehung vorm Fehlerspeichereintrag | EN: Fault code LLS1_CMD - debounce filter increment before fault-memory entry" VALUE 0x711E6 TKW_VV_VV_UB 100.0 FORMULA_0003 0.0 255.0000 /end CHARACTERISTIC
/begin CHARACTERISTIC K_ED_LLS2_CMD.INC_VOR_EINTRAG "Filtererhoehung vorm Fehlerspeichereintrag | EN: Fault code LLS2_CMD - debounce filter increment before fault-memory entry" VALUE 0x71200 TKW_VV_VV_UB 100.0 FORMULA_0003 0.0 255.0000 /end CHARACTERISTIC
/begin CHARACTERISTIC K_ED_SC_SMG1.INC_VOR_EINTRAG "Filtererhoehung vorm Fehlerspeichereintrag | EN: Fault code SC_SMG1 - debounce filter increment before fault-memory entry" VALUE 0x7121A TKW_VV_VV_UB 100.0 FORMULA_0003 0.0 255.0000 /end CHARACTERISTIC
/begin CHARACTERISTIC K_ED_SC_SMG2.INC_VOR_EINTRAG "Filtererhoehung vorm Fehlerspeichereintrag | EN: Fault code SC_SMG2 - debounce filter increment before fault-memory entry" VALUE 0x71234 TKW_VV_VV_UB 100.0 FORMULA_0003 0.0 255.0000 /end CHARACTERISTIC
/begin CHARACTERISTIC K_ED_SC_SMG3.INC_VOR_EINTRAG "Filtererhoehung vorm Fehlerspeichereintrag | EN: Fault code SC_SMG3 - debounce filter increment before fault-memory entry" VALUE 0x7124E TKW_VV_VV_UB 100.0 FORMULA_0003 0.0 255.0000 /end CHARACTERISTIC
/begin CHARACTERISTIC K_ED_SC_BUSOFF.INC_VOR_EINTRAG "Filtererhoehung vorm Fehlerspeichereintrag | EN: Fault code SC_BUSOFF - debounce filter increment before fault-memory entry" VALUE 0x71268 TKW_VV_VV_UB 100.0 FORMULA_0003 0.0 255.0000 /end CHARACTERISTIC
/begin CHARACTERISTIC K_ED_ION_SIG_B1.INC_VOR_EINTRAG "Filtererhoehung vorm Fehlerspeichereintrag" VALUE 0x713A0 TKW_VV_VV_UB 100.0 FORMULA_0003 0.0 255.0000 /end CHARACTERISTIC
/begin CHARACTERISTIC K_ED_ION_SIG_B2.INC_VOR_EINTRAG "Filtererhoehung vorm Fehlerspeichereintrag" VALUE 0x713BA TKW_VV_VV_UB 100.0 FORMULA_0003 0.0 255.0000 /end CHARACTERISTIC
/begin CHARACTERISTIC K_ED_ION_SAT_B1.INC_VOR_EINTRAG "Filtererhoehung vorm Fehlerspeichereintrag" VALUE 0x714F2 TKW_VV_VV_UB 100.0 FORMULA_0003 0.0 255.0000 /end CHARACTERISTIC
/begin CHARACTERISTIC K_ED_ION_SAT_B2.INC_VOR_EINTRAG "Filtererhoehung vorm Fehlerspeichereintrag" VALUE 0x7150C TKW_VV_VV_UB 100.0 FORMULA_0003 0.0 255.0000 /end CHARACTERISTIC
/begin CHARACTERISTIC K_ED_TAN_OBD_B1.INC_VOR_EINTRAG "Filtererhoehung vorm Fehlerspeichereintrag | EN: Fault code TAN_OBD_B1 - debounce filter increment before fault-memory entry" VALUE 0x71540 TKW_VV_VV_UB 100.0 FORMULA_0003 0.0 255.0000 /end CHARACTERISTIC
/begin CHARACTERISTIC K_ED_INDEX_88_IGN.INC_VOR_EINTRAG "Filtererhoehung vorm Fehlerspeichereintrag | EN: Filtererhoehung vorm Fehlerspeichereintrag" VALUE 0x7155A TKW_VV_VV_UB 100.0 FORMULA_0003 0.0 255.0000 /end CHARACTERISTIC
/begin CHARACTERISTIC K_ED_INDEX_89_IGN.INC_VOR_EINTRAG "Filtererhoehung vorm Fehlerspeichereintrag" VALUE 0x71574 TKW_VV_VV_UB 100.0 FORMULA_0003 0.0 255.0000 /end CHARACTERISTIC
/begin CHARACTERISTIC K_ED_SG_IGN.INC_VOR_EINTRAG "Filtererhoehung vorm Fehlerspeichereintrag | EN: Fault code SG_IGN - debounce filter increment before fault-memory entry" VALUE 0x715C2 TKW_VV_VV_UB 100.0 FORMULA_0003 0.0 255.0000 /end CHARACTERISTIC
/begin CHARACTERISTIC K_ED_SK_MANAGER_IGN.INC_VOR_EINTRAG "Filtererhoehung vorm Fehlerspeichereintrag | EN: Fault code SK_MANAGER_IGN - debounce filter increment before fault-memory entry" VALUE 0x71610 TKW_VV_VV_UB 100.0 FORMULA_0003 0.0 255.0000 /end CHARACTERISTIC
/begin CHARACTERISTIC K_ED_LLR_DIAG.INC_VOR_EINTRAG "Filtererhoehung vorm Fehlerspeichereintrag | EN: Fault code LLR_DIAG - debounce filter increment before fault-memory entry" VALUE 0x7162A TKW_VV_VV_UB 100.0 FORMULA_0003 0.0 255.0000 /end CHARACTERISTIC
/begin CHARACTERISTIC K_ED_THERMOSTAT.INC_VOR_EINTRAG "Filtererhoehung vorm Fehlerspeichereintrag | EN: Fault code THERMOSTAT - debounce filter increment before fault-memory entry" VALUE 0x71644 TKW_VV_VV_UB 100.0 FORMULA_0003 0.0 255.0000 /end CHARACTERISTIC
/begin CHARACTERISTIC K_ED_TAN_OBD_B2.INC_VOR_EINTRAG "Filtererhoehung vorm Fehlerspeichereintrag | EN: Fault code TAN_OBD_B2 - debounce filter increment before fault-memory entry" VALUE 0x7165E TKW_VV_VV_UB 100.0 FORMULA_0003 0.0 255.0000 /end CHARACTERISTIC
/begin CHARACTERISTIC K_ED_PWG_BLS.INC_VOR_EINTRAG "Filtererhoehung vorm Fehlerspeichereintrag | EN: Fault code PWG_BLS - debounce filter increment before fault-memory entry" VALUE 0x716C6 TKW_VV_VV_UB 100.0 FORMULA_0003 0.0 255.0000 /end CHARACTERISTIC
/begin CHARACTERISTIC K_ED_START_RL.INC_VOR_EINTRAG "Filtererhoehung vorm Fehlerspeichereintrag | EN: Fault code START_RL - debounce filter increment before fault-memory entry" VALUE 0x716E0 TKW_VV_VV_UB 100.0 FORMULA_0003 0.0 255.0000 /end CHARACTERISTIC
/begin CHARACTERISTIC K_ED_N_GETR_EIN_HS.INC_VOR_EINTRAG "Filtererhoehung vorm Fehlerspeichereintrag | EN: Fault code N_GETR_EIN_HS - debounce filter increment before fault-memory entry" VALUE 0x71714 TKW_VV_VV_UB 100.0 FORMULA_0003 0.0 255.0000 /end CHARACTERISTIC
/begin CHARACTERISTIC K_ED_LLR_DIAG_CSS.INC_VOR_EINTRAG "Filtererhoehung vorm Fehlerspeichereintrag | EN: Fault code LLR_DIAG_CSS - debounce filter increment before fault-memory entry [V912: differs from V452 160E]" VALUE 0x71748 TKW_VV_VV_UB 100.0 FORMULA_0003 0.0 255.0000 /end CHARACTERISTIC
/begin CHARACTERISTIC K_ED_TMOT_OBD_HIGH.INC_VOR_EINTRAG "Filtererhoehung vorm Fehlerspeichereintrag | EN: Fault code TMOT_OBD_HIGH - debounce filter increment before fault-memory entry" VALUE 0x71762 TKW_VV_VV_UB 100.0 FORMULA_0003 0.0 255.0000 /end CHARACTERISTIC
/begin CHARACTERISTIC K_ED_INDEX_122_IGN.INC_VOR_EINTRAG "Filtererhoehung vorm Fehlerspeichereintrag | EN: Fault code INDEX_122_IGN - debounce filter increment before fault-memory entry" VALUE 0x718CE TKW_VV_VV_UB 100.0 FORMULA_0003 0.0 255.0000 /end CHARACTERISTIC
/begin CHARACTERISTIC K_ED_INDEX_123_IGN.INC_VOR_EINTRAG "Filtererhoehung vorm Fehlerspeichereintrag | EN: Fault code INDEX_123_IGN - debounce filter increment before fault-memory entry" VALUE 0x718E8 TKW_VV_VV_UB 100.0 FORMULA_0003 0.0 255.0000 /end CHARACTERISTIC
/begin CHARACTERISTIC K_ED_INDEX_124_IGN.INC_VOR_EINTRAG "Filtererhoehung vorm Fehlerspeichereintrag | EN: Fault code INDEX_124_IGN - debounce filter increment before fault-memory entry" VALUE 0x71902 TKW_VV_VV_UB 100.0 FORMULA_0003 0.0 255.0000 /end CHARACTERISTIC
/begin CHARACTERISTIC K_ED_INDEX_125_IGN.INC_VOR_EINTRAG "Filtererhoehung vorm Fehlerspeichereintrag | EN: Fault code INDEX_125_IGN - debounce filter increment before fault-memory entry" VALUE 0x7191C TKW_VV_VV_UB 100.0 FORMULA_0003 0.0 255.0000 /end CHARACTERISTIC
/begin CHARACTERISTIC K_ED_INDEX_126_IGN.INC_VOR_EINTRAG "Filtererhoehung vorm Fehlerspeichereintrag | EN: Fault code INDEX_126_IGN - debounce filter increment before fault-memory entry" VALUE 0x71936 TKW_VV_VV_UB 100.0 FORMULA_0003 0.0 255.0000 /end CHARACTERISTIC
/begin CHARACTERISTIC K_ED_INDEX_127_IGN.INC_VOR_EINTRAG "Filtererhoehung vorm Fehlerspeichereintrag | EN: Fault code INDEX_127_IGN - debounce filter increment before fault-memory entry" VALUE 0x71950 TKW_VV_VV_UB 100.0 FORMULA_0003 0.0 255.0000 /end CHARACTERISTIC
/begin CHARACTERISTIC K_ED_SK_TR_IGN.DEC_VOR_EINTRAG "Filterverringerung vorm Fehlerspeichereintrag | EN: Filterverringerung vorm Fehlerspeichereintrag" VALUE 0x70C6B TKW_VV_VV_UB 100.0 FORMULA_0003 0.0 255.0000 /end CHARACTERISTIC
/begin CHARACTERISTIC K_ED_TMOT.DEC_VOR_EINTRAG "Filterverringerung vorm Fehlerspeichereintrag | EN: Fault code TMOT - debounce filter decrement before fault-memory entry" VALUE 0x70C85 TKW_VV_VV_UB 100.0 FORMULA_0003 0.0 255.0000 /end CHARACTERISTIC
/begin CHARACTERISTIC K_ED_TMOT_OBD.DEC_VOR_EINTRAG "Filterverringerung vorm Fehlerspeichereintrag | EN: Fault code TMOT_OBD - debounce filter decrement before fault-memory entry" VALUE 0x70C9F TKW_VV_VV_UB 100.0 FORMULA_0003 0.0 255.0000 /end CHARACTERISTIC
/begin CHARACTERISTIC K_ED_TAN1.DEC_VOR_EINTRAG "Filterverringerung vorm Fehlerspeichereintrag | EN: Fault code TAN1 - debounce filter decrement before fault-memory entry" VALUE 0x70CB9 TKW_VV_VV_UB 100.0 FORMULA_0003 0.0 255.0000 /end CHARACTERISTIC
/begin CHARACTERISTIC K_ED_TAN2.DEC_VOR_EINTRAG "Filterverringerung vorm Fehlerspeichereintrag | EN: Fault code TAN2 - debounce filter decrement before fault-memory entry" VALUE 0x70CD3 TKW_VV_VV_UB 100.0 FORMULA_0003 0.0 255.0000 /end CHARACTERISTIC
/begin CHARACTERISTIC K_ED_TIME_REL_OBD.DEC_VOR_EINTRAG "Filterverringerung vorm Fehlerspeichereintrag | EN: Fault code TIME_REL_OBD - debounce filter decrement before fault-memory entry" VALUE 0x70CED TKW_VV_VV_UB 100.0 FORMULA_0003 0.0 255.0000 /end CHARACTERISTIC
/begin CHARACTERISTIC K_ED_TKA.DEC_VOR_EINTRAG "Filterverringerung vorm Fehlerspeichereintrag | EN: Fault code TKA - debounce filter decrement before fault-memory entry" VALUE 0x70D21 TKW_VV_VV_UB 100.0 FORMULA_0003 0.0 255.0000 /end CHARACTERISTIC
/begin CHARACTERISTIC K_ED_TDME.DEC_VOR_EINTRAG "Filterverringerung vorm Fehlerspeichereintrag | EN: Fault code TDME - debounce filter decrement before fault-memory entry" VALUE 0x70D3B TKW_VV_VV_UB 100.0 FORMULA_0003 0.0 255.0000 /end CHARACTERISTIC
/begin CHARACTERISTIC K_ED_TKA_OBD.DEC_VOR_EINTRAG "Filterverringerung vorm Fehlerspeichereintrag | EN: Fault code TKA_OBD - debounce filter decrement before fault-memory entry" VALUE 0x70DA3 TKW_VV_VV_UB 100.0 FORMULA_0003 0.0 255.0000 /end CHARACTERISTIC
/begin CHARACTERISTIC K_ED_PWG1.DEC_VOR_EINTRAG "Filterverringerung vorm Fehlerspeichereintrag | EN: Fault code PWG1 - debounce filter decrement before fault-memory entry" VALUE 0x70DBD TKW_VV_VV_UB 100.0 FORMULA_0003 0.0 255.0000 /end CHARACTERISTIC
/begin CHARACTERISTIC K_ED_PWG2.DEC_VOR_EINTRAG "Filterverringerung vorm Fehlerspeichereintrag | EN: Fault code PWG2 - debounce filter decrement before fault-memory entry" VALUE 0x70DD7 TKW_VV_VV_UB 100.0 FORMULA_0003 0.0 255.0000 /end CHARACTERISTIC
/begin CHARACTERISTIC K_ED_PWG_VGL.DEC_VOR_EINTRAG "Filterverringerung vorm Fehlerspeichereintrag | EN: Fault code PWG_VGL - debounce filter decrement before fault-memory entry" VALUE 0x70DF1 TKW_VV_VV_UB 100.0 FORMULA_0003 0.0 255.0000 /end CHARACTERISTIC
/begin CHARACTERISTIC K_ED_PCTRL_IGN.DEC_VOR_EINTRAG "Filterverringerung vorm Fehlerspeichereintrag | EN: Fault code PCTRL_IGN - debounce filter decrement before fault-memory entry" VALUE 0x70E0B TKW_VV_VV_UB 100.0 FORMULA_0003 0.0 255.0000 /end CHARACTERISTIC
/begin CHARACTERISTIC K_ED_LLS1_CAN.DEC_VOR_EINTRAG "Filterverringerung vorm Fehlerspeichereintrag | EN: Fault code LLS1_CAN - debounce filter decrement before fault-memory entry" VALUE 0x70E25 TKW_VV_VV_UB 100.0 FORMULA_0003 0.0 255.0000 /end CHARACTERISTIC
/begin CHARACTERISTIC K_ED_LLS2_CAN.DEC_VOR_EINTRAG "Filterverringerung vorm Fehlerspeichereintrag | EN: Fault code LLS2_CAN - debounce filter decrement before fault-memory entry" VALUE 0x70E3F TKW_VV_VV_UB 100.0 FORMULA_0003 0.0 255.0000 /end CHARACTERISTIC
/begin CHARACTERISTIC K_ED_LLS1_SK.DEC_VOR_EINTRAG "Filterverringerung vorm Fehlerspeichereintrag | EN: Fault code LLS1_SK - debounce filter decrement before fault-memory entry" VALUE 0x70E8D TKW_VV_VV_UB 100.0 FORMULA_0003 0.0 255.0000 /end CHARACTERISTIC
/begin CHARACTERISTIC K_ED_LLS2_SK.DEC_VOR_EINTRAG "Filterverringerung vorm Fehlerspeichereintrag | EN: Fault code LLS2_SK - debounce filter decrement before fault-memory entry" VALUE 0x70EA7 TKW_VV_VV_UB 100.0 FORMULA_0003 0.0 255.0000 /end CHARACTERISTIC
/begin CHARACTERISTIC K_ED_SMG_SCHALTAB.DEC_VOR_EINTRAG "Filterverringerung vorm Fehlerspeichereintrag | EN: Fault code SMG_SCHALTAB - debounce filter decrement before fault-memory entry" VALUE 0x70EC1 TKW_VV_VV_UB 100.0 FORMULA_0003 0.0 255.0000 /end CHARACTERISTIC
/begin CHARACTERISTIC K_ED_SMG_SK.DEC_VOR_EINTRAG "Filterverringerung vorm Fehlerspeichereintrag | EN: Fault code SMG_SK - debounce filter decrement before fault-memory entry" VALUE 0x70EDB TKW_VV_VV_UB 100.0 FORMULA_0003 0.0 255.0000 /end CHARACTERISTIC
/begin CHARACTERISTIC K_ED_SMG_SK_N.DEC_VOR_EINTRAG "Filterverringerung vorm Fehlerspeichereintrag | EN: Fault code SMG_SK_N - debounce filter decrement before fault-memory entry" VALUE 0x70EF5 TKW_VV_VV_UB 100.0 FORMULA_0003 0.0 255.0000 /end CHARACTERISTIC
/begin CHARACTERISTIC K_ED_IONVERST_B1.DEC_VOR_EINTRAG "Filterverringerung vorm Fehlerspeichereintrag" VALUE 0x70FC5 TKW_VV_VV_UB 100.0 FORMULA_0003 0.0 255.0000 /end CHARACTERISTIC
/begin CHARACTERISTIC K_ED_IONSPG_B1.DEC_VOR_EINTRAG "Filterverringerung vorm Fehlerspeichereintrag" VALUE 0x70FDF TKW_VV_VV_UB 100.0 FORMULA_0003 0.0 255.0000 /end CHARACTERISTIC
/begin CHARACTERISTIC K_ED_IONVERST_B2.DEC_VOR_EINTRAG "Filterverringerung vorm Fehlerspeichereintrag" VALUE 0x70FF9 TKW_VV_VV_UB 100.0 FORMULA_0003 0.0 255.0000 /end CHARACTERISTIC
/begin CHARACTERISTIC K_ED_IONSPG_B2.DEC_VOR_EINTRAG "Filterverringerung vorm Fehlerspeichereintrag" VALUE 0x71013 TKW_VV_VV_UB 100.0 FORMULA_0003 0.0 255.0000 /end CHARACTERISTIC
/begin CHARACTERISTIC K_ED_TABG1.DEC_VOR_EINTRAG "Filterverringerung vorm Fehlerspeichereintrag | EN: Fault code TABG1 - debounce filter decrement before fault-memory entry" VALUE 0x7102D TKW_VV_VV_UB 100.0 FORMULA_0003 0.0 255.0000 /end CHARACTERISTIC
/begin CHARACTERISTIC K_ED_TABG2.DEC_VOR_EINTRAG "Filterverringerung vorm Fehlerspeichereintrag | EN: Fault code TABG2 - debounce filter decrement before fault-memory entry" VALUE 0x71047 TKW_VV_VV_UB 100.0 FORMULA_0003 0.0 255.0000 /end CHARACTERISTIC
/begin CHARACTERISTIC K_ED_LLS1_REGLER.DEC_VOR_EINTRAG "Filterverringerung vorm Fehlerspeichereintrag | EN: Fault code LLS1_REGLER - debounce filter decrement before fault-memory entry" VALUE 0x710C9 TKW_VV_VV_UB 100.0 FORMULA_0003 0.0 255.0000 /end CHARACTERISTIC
/begin CHARACTERISTIC K_ED_LLS2_REGLER.DEC_VOR_EINTRAG "Filterverringerung vorm Fehlerspeichereintrag | EN: Fault code LLS2_REGLER - debounce filter decrement before fault-memory entry" VALUE 0x710E3 TKW_VV_VV_UB 100.0 FORMULA_0003 0.0 255.0000 /end CHARACTERISTIC
/begin CHARACTERISTIC K_ED_MD_SK_ERR.DEC_VOR_EINTRAG "Filterverringerung vorm Fehlerspeichereintrag | EN: Fault code MD_SK_ERR - debounce filter decrement before fault-memory entry" VALUE 0x71165 TKW_VV_VV_UB 100.0 FORMULA_0003 0.0 255.0000 /end CHARACTERISTIC
/begin CHARACTERISTIC K_ED_LLS_INIT.DEC_VOR_EINTRAG "Filterverringerung vorm Fehlerspeichereintrag | EN: Fault code LLS_INIT - debounce filter decrement before fault-memory entry" VALUE 0x7117F TKW_VV_VV_UB 100.0 FORMULA_0003 0.0 255.0000 /end CHARACTERISTIC
/begin CHARACTERISTIC K_ED_LLS1_CMD.DEC_VOR_EINTRAG "Filterverringerung vorm Fehlerspeichereintrag | EN: Fault code LLS1_CMD - debounce filter decrement before fault-memory entry" VALUE 0x711E7 TKW_VV_VV_UB 100.0 FORMULA_0003 0.0 255.0000 /end CHARACTERISTIC
/begin CHARACTERISTIC K_ED_LLS2_CMD.DEC_VOR_EINTRAG "Filterverringerung vorm Fehlerspeichereintrag | EN: Fault code LLS2_CMD - debounce filter decrement before fault-memory entry" VALUE 0x71201 TKW_VV_VV_UB 100.0 FORMULA_0003 0.0 255.0000 /end CHARACTERISTIC
/begin CHARACTERISTIC K_ED_SC_SMG1.DEC_VOR_EINTRAG "Filterverringerung vorm Fehlerspeichereintrag | EN: Fault code SC_SMG1 - debounce filter decrement before fault-memory entry" VALUE 0x7121B TKW_VV_VV_UB 100.0 FORMULA_0003 0.0 255.0000 /end CHARACTERISTIC
/begin CHARACTERISTIC K_ED_SC_SMG2.DEC_VOR_EINTRAG "Filterverringerung vorm Fehlerspeichereintrag | EN: Fault code SC_SMG2 - debounce filter decrement before fault-memory entry" VALUE 0x71235 TKW_VV_VV_UB 100.0 FORMULA_0003 0.0 255.0000 /end CHARACTERISTIC
/begin CHARACTERISTIC K_ED_SC_SMG3.DEC_VOR_EINTRAG "Filterverringerung vorm Fehlerspeichereintrag | EN: Fault code SC_SMG3 - debounce filter decrement before fault-memory entry" VALUE 0x7124F TKW_VV_VV_UB 100.0 FORMULA_0003 0.0 255.0000 /end CHARACTERISTIC
/begin CHARACTERISTIC K_ED_SC_BUSOFF.DEC_VOR_EINTRAG "Filterverringerung vorm Fehlerspeichereintrag | EN: Fault code SC_BUSOFF - debounce filter decrement before fault-memory entry" VALUE 0x71269 TKW_VV_VV_UB 100.0 FORMULA_0003 0.0 255.0000 /end CHARACTERISTIC
/begin CHARACTERISTIC K_ED_ION_SIG_B1.DEC_VOR_EINTRAG "Filterverringerung vorm Fehlerspeichereintrag" VALUE 0x713A1 TKW_VV_VV_UB 100.0 FORMULA_0003 0.0 255.0000 /end CHARACTERISTIC
/begin CHARACTERISTIC K_ED_ION_SIG_B2.DEC_VOR_EINTRAG "Filterverringerung vorm Fehlerspeichereintrag" VALUE 0x713BB TKW_VV_VV_UB 100.0 FORMULA_0003 0.0 255.0000 /end CHARACTERISTIC
/begin CHARACTERISTIC K_ED_ION_SAT_B1.DEC_VOR_EINTRAG "Filterverringerung vorm Fehlerspeichereintrag" VALUE 0x714F3 TKW_VV_VV_UB 100.0 FORMULA_0003 0.0 255.0000 /end CHARACTERISTIC
/begin CHARACTERISTIC K_ED_ION_SAT_B2.DEC_VOR_EINTRAG "Filterverringerung vorm Fehlerspeichereintrag" VALUE 0x7150D TKW_VV_VV_UB 100.0 FORMULA_0003 0.0 255.0000 /end CHARACTERISTIC
/begin CHARACTERISTIC K_ED_TAN_OBD_B1.DEC_VOR_EINTRAG "Filterverringerung vorm Fehlerspeichereintrag | EN: Fault code TAN_OBD_B1 - debounce filter decrement before fault-memory entry" VALUE 0x71541 TKW_VV_VV_UB 100.0 FORMULA_0003 0.0 255.0000 /end CHARACTERISTIC
/begin CHARACTERISTIC K_ED_INDEX_88_IGN.DEC_VOR_EINTRAG "Filterverringerung vorm Fehlerspeichereintrag | EN: Filterverringerung vorm Fehlerspeichereintrag" VALUE 0x7155B TKW_VV_VV_UB 100.0 FORMULA_0003 0.0 255.0000 /end CHARACTERISTIC
/begin CHARACTERISTIC K_ED_INDEX_89_IGN.DEC_VOR_EINTRAG "Filterverringerung vorm Fehlerspeichereintrag" VALUE 0x71575 TKW_VV_VV_UB 100.0 FORMULA_0003 0.0 255.0000 /end CHARACTERISTIC
/begin CHARACTERISTIC K_ED_SG_IGN.DEC_VOR_EINTRAG "Filterverringerung vorm Fehlerspeichereintrag | EN: Fault code SG_IGN - debounce filter decrement before fault-memory entry" VALUE 0x715C3 TKW_VV_VV_UB 100.0 FORMULA_0003 0.0 255.0000 /end CHARACTERISTIC
/begin CHARACTERISTIC K_ED_SK_MANAGER_IGN.DEC_VOR_EINTRAG "Filterverringerung vorm Fehlerspeichereintrag | EN: Fault code SK_MANAGER_IGN - debounce filter decrement before fault-memory entry" VALUE 0x71611 TKW_VV_VV_UB 100.0 FORMULA_0003 0.0 255.0000 /end CHARACTERISTIC
/begin CHARACTERISTIC K_ED_LLR_DIAG.DEC_VOR_EINTRAG "Filterverringerung vorm Fehlerspeichereintrag | EN: Fault code LLR_DIAG - debounce filter decrement before fault-memory entry" VALUE 0x7162B TKW_VV_VV_UB 100.0 FORMULA_0003 0.0 255.0000 /end CHARACTERISTIC
/begin CHARACTERISTIC K_ED_THERMOSTAT.DEC_VOR_EINTRAG "Filterverringerung vorm Fehlerspeichereintrag | EN: Fault code THERMOSTAT - debounce filter decrement before fault-memory entry" VALUE 0x71645 TKW_VV_VV_UB 100.0 FORMULA_0003 0.0 255.0000 /end CHARACTERISTIC
/begin CHARACTERISTIC K_ED_TAN_OBD_B2.DEC_VOR_EINTRAG "Filterverringerung vorm Fehlerspeichereintrag | EN: Fault code TAN_OBD_B2 - debounce filter decrement before fault-memory entry" VALUE 0x7165F TKW_VV_VV_UB 100.0 FORMULA_0003 0.0 255.0000 /end CHARACTERISTIC
/begin CHARACTERISTIC K_ED_PWG_BLS.DEC_VOR_EINTRAG "Filterverringerung vorm Fehlerspeichereintrag | EN: Fault code PWG_BLS - debounce filter decrement before fault-memory entry" VALUE 0x716C7 TKW_VV_VV_UB 100.0 FORMULA_0003 0.0 255.0000 /end CHARACTERISTIC
/begin CHARACTERISTIC K_ED_START_RL.DEC_VOR_EINTRAG "Filterverringerung vorm Fehlerspeichereintrag | EN: Fault code START_RL - debounce filter decrement before fault-memory entry" VALUE 0x716E1 TKW_VV_VV_UB 100.0 FORMULA_0003 0.0 255.0000 /end CHARACTERISTIC
/begin CHARACTERISTIC K_ED_N_GETR_EIN_HS.DEC_VOR_EINTRAG "Filterverringerung vorm Fehlerspeichereintrag | EN: Fault code N_GETR_EIN_HS - debounce filter decrement before fault-memory entry" VALUE 0x71715 TKW_VV_VV_UB 100.0 FORMULA_0003 0.0 255.0000 /end CHARACTERISTIC
/begin CHARACTERISTIC K_ED_LLR_DIAG_CSS.DEC_VOR_EINTRAG "Filterverringerung vorm Fehlerspeichereintrag | EN: Fault code LLR_DIAG_CSS - debounce filter decrement before fault-memory entry" VALUE 0x71749 TKW_VV_VV_UB 100.0 FORMULA_0003 0.0 255.0000 /end CHARACTERISTIC
/begin CHARACTERISTIC K_ED_TMOT_OBD_HIGH.DEC_VOR_EINTRAG "Filterverringerung vorm Fehlerspeichereintrag | EN: Fault code TMOT_OBD_HIGH - debounce filter decrement before fault-memory entry" VALUE 0x71763 TKW_VV_VV_UB 100.0 FORMULA_0003 0.0 255.0000 /end CHARACTERISTIC
/begin CHARACTERISTIC K_ED_INDEX_122_IGN.DEC_VOR_EINTRAG "Filterverringerung vorm Fehlerspeichereintrag | EN: Fault code INDEX_122_IGN - debounce filter decrement before fault-memory entry" VALUE 0x718CF TKW_VV_VV_UB 100.0 FORMULA_0003 0.0 255.0000 /end CHARACTERISTIC
/begin CHARACTERISTIC K_ED_INDEX_123_IGN.DEC_VOR_EINTRAG "Filterverringerung vorm Fehlerspeichereintrag | EN: Fault code INDEX_123_IGN - debounce filter decrement before fault-memory entry" VALUE 0x718E9 TKW_VV_VV_UB 100.0 FORMULA_0003 0.0 255.0000 /end CHARACTERISTIC
/begin CHARACTERISTIC K_ED_INDEX_124_IGN.DEC_VOR_EINTRAG "Filterverringerung vorm Fehlerspeichereintrag | EN: Fault code INDEX_124_IGN - debounce filter decrement before fault-memory entry" VALUE 0x71903 TKW_VV_VV_UB 100.0 FORMULA_0003 0.0 255.0000 /end CHARACTERISTIC
/begin CHARACTERISTIC K_ED_INDEX_125_IGN.DEC_VOR_EINTRAG "Filterverringerung vorm Fehlerspeichereintrag | EN: Fault code INDEX_125_IGN - debounce filter decrement before fault-memory entry" VALUE 0x7191D TKW_VV_VV_UB 100.0 FORMULA_0003 0.0 255.0000 /end CHARACTERISTIC
/begin CHARACTERISTIC K_ED_INDEX_126_IGN.DEC_VOR_EINTRAG "Filterverringerung vorm Fehlerspeichereintrag | EN: Fault code INDEX_126_IGN - debounce filter decrement before fault-memory entry" VALUE 0x71937 TKW_VV_VV_UB 100.0 FORMULA_0003 0.0 255.0000 /end CHARACTERISTIC
/begin CHARACTERISTIC K_ED_INDEX_127_IGN.DEC_VOR_EINTRAG "Filterverringerung vorm Fehlerspeichereintrag | EN: Fault code INDEX_127_IGN - debounce filter decrement before fault-memory entry" VALUE 0x71951 TKW_VV_VV_UB 100.0 FORMULA_0003 0.0 255.0000 /end CHARACTERISTIC
/begin CHARACTERISTIC K_ED_SK_TR_IGN.INC_NACH_EINTRAG "Filtererhoehung nach Fehlerspeichereintrag | EN: Filtererhoehung nach Fehlerspeichereintrag" VALUE 0x70C6C TKW_VV_VV_UB 100.0 FORMULA_0003 0.0 255.0000 /end CHARACTERISTIC
/begin CHARACTERISTIC K_ED_TMOT.INC_NACH_EINTRAG "Filtererhoehung nach Fehlerspeichereintrag | EN: Fault code TMOT - debounce filter increment after fault-memory entry" VALUE 0x70C86 TKW_VV_VV_UB 100.0 FORMULA_0003 0.0 255.0000 /end CHARACTERISTIC
/begin CHARACTERISTIC K_ED_TMOT_OBD.INC_NACH_EINTRAG "Filtererhoehung nach Fehlerspeichereintrag | EN: Fault code TMOT_OBD - debounce filter increment after fault-memory entry" VALUE 0x70CA0 TKW_VV_VV_UB 100.0 FORMULA_0003 0.0 255.0000 /end CHARACTERISTIC
/begin CHARACTERISTIC K_ED_TAN1.INC_NACH_EINTRAG "Filtererhoehung nach Fehlerspeichereintrag | EN: Fault code TAN1 - debounce filter increment after fault-memory entry" VALUE 0x70CBA TKW_VV_VV_UB 100.0 FORMULA_0003 0.0 255.0000 /end CHARACTERISTIC
/begin CHARACTERISTIC K_ED_TAN2.INC_NACH_EINTRAG "Filtererhoehung nach Fehlerspeichereintrag | EN: Fault code TAN2 - debounce filter increment after fault-memory entry" VALUE 0x70CD4 TKW_VV_VV_UB 100.0 FORMULA_0003 0.0 255.0000 /end CHARACTERISTIC
/begin CHARACTERISTIC K_ED_TIME_REL_OBD.INC_NACH_EINTRAG "Filtererhoehung nach Fehlerspeichereintrag | EN: Fault code TIME_REL_OBD - debounce filter increment after fault-memory entry" VALUE 0x70CEE TKW_VV_VV_UB 100.0 FORMULA_0003 0.0 255.0000 /end CHARACTERISTIC
/begin CHARACTERISTIC K_ED_TKA.INC_NACH_EINTRAG "Filtererhoehung nach Fehlerspeichereintrag | EN: Fault code TKA - debounce filter increment after fault-memory entry" VALUE 0x70D22 TKW_VV_VV_UB 100.0 FORMULA_0003 0.0 255.0000 /end CHARACTERISTIC
/begin CHARACTERISTIC K_ED_TDME.INC_NACH_EINTRAG "Filtererhoehung nach Fehlerspeichereintrag | EN: Fault code TDME - debounce filter increment after fault-memory entry" VALUE 0x70D3C TKW_VV_VV_UB 100.0 FORMULA_0003 0.0 255.0000 /end CHARACTERISTIC
/begin CHARACTERISTIC K_ED_TKA_OBD.INC_NACH_EINTRAG "Filtererhoehung nach Fehlerspeichereintrag | EN: Fault code TKA_OBD - debounce filter increment after fault-memory entry" VALUE 0x70DA4 TKW_VV_VV_UB 100.0 FORMULA_0003 0.0 255.0000 /end CHARACTERISTIC
/begin CHARACTERISTIC K_ED_PWG1.INC_NACH_EINTRAG "Filtererhoehung nach Fehlerspeichereintrag | EN: Fault code PWG1 - debounce filter increment after fault-memory entry" VALUE 0x70DBE TKW_VV_VV_UB 100.0 FORMULA_0003 0.0 255.0000 /end CHARACTERISTIC
/begin CHARACTERISTIC K_ED_PWG2.INC_NACH_EINTRAG "Filtererhoehung nach Fehlerspeichereintrag | EN: Fault code PWG2 - debounce filter increment after fault-memory entry" VALUE 0x70DD8 TKW_VV_VV_UB 100.0 FORMULA_0003 0.0 255.0000 /end CHARACTERISTIC
/begin CHARACTERISTIC K_ED_PWG_VGL.INC_NACH_EINTRAG "Filtererhoehung nach Fehlerspeichereintrag | EN: Fault code PWG_VGL - debounce filter increment after fault-memory entry" VALUE 0x70DF2 TKW_VV_VV_UB 100.0 FORMULA_0003 0.0 255.0000 /end CHARACTERISTIC
/begin CHARACTERISTIC K_ED_PCTRL_IGN.INC_NACH_EINTRAG "Filtererhoehung nach Fehlerspeichereintrag | EN: Fault code PCTRL_IGN - debounce filter increment after fault-memory entry" VALUE 0x70E0C TKW_VV_VV_UB 100.0 FORMULA_0003 0.0 255.0000 /end CHARACTERISTIC
/begin CHARACTERISTIC K_ED_LLS1_CAN.INC_NACH_EINTRAG "Filtererhoehung nach Fehlerspeichereintrag | EN: Fault code LLS1_CAN - debounce filter increment after fault-memory entry" VALUE 0x70E26 TKW_VV_VV_UB 100.0 FORMULA_0003 0.0 255.0000 /end CHARACTERISTIC
/begin CHARACTERISTIC K_ED_LLS2_CAN.INC_NACH_EINTRAG "Filtererhoehung nach Fehlerspeichereintrag | EN: Fault code LLS2_CAN - debounce filter increment after fault-memory entry" VALUE 0x70E40 TKW_VV_VV_UB 100.0 FORMULA_0003 0.0 255.0000 /end CHARACTERISTIC
/begin CHARACTERISTIC K_ED_LLS1_SK.INC_NACH_EINTRAG "Filtererhoehung nach Fehlerspeichereintrag | EN: Fault code LLS1_SK - debounce filter increment after fault-memory entry" VALUE 0x70E8E TKW_VV_VV_UB 100.0 FORMULA_0003 0.0 255.0000 /end CHARACTERISTIC
/begin CHARACTERISTIC K_ED_LLS2_SK.INC_NACH_EINTRAG "Filtererhoehung nach Fehlerspeichereintrag | EN: Fault code LLS2_SK - debounce filter increment after fault-memory entry" VALUE 0x70EA8 TKW_VV_VV_UB 100.0 FORMULA_0003 0.0 255.0000 /end CHARACTERISTIC
/begin CHARACTERISTIC K_ED_SMG_SCHALTAB.INC_NACH_EINTRAG "Filtererhoehung nach Fehlerspeichereintrag | EN: Fault code SMG_SCHALTAB - debounce filter increment after fault-memory entry" VALUE 0x70EC2 TKW_VV_VV_UB 100.0 FORMULA_0003 0.0 255.0000 /end CHARACTERISTIC
/begin CHARACTERISTIC K_ED_SMG_SK.INC_NACH_EINTRAG "Filtererhoehung nach Fehlerspeichereintrag | EN: Fault code SMG_SK - debounce filter increment after fault-memory entry" VALUE 0x70EDC TKW_VV_VV_UB 100.0 FORMULA_0003 0.0 255.0000 /end CHARACTERISTIC
/begin CHARACTERISTIC K_ED_SMG_SK_N.INC_NACH_EINTRAG "Filtererhoehung nach Fehlerspeichereintrag | EN: Fault code SMG_SK_N - debounce filter increment after fault-memory entry" VALUE 0x70EF6 TKW_VV_VV_UB 100.0 FORMULA_0003 0.0 255.0000 /end CHARACTERISTIC
/begin CHARACTERISTIC K_ED_IONVERST_B1.INC_NACH_EINTRAG "Filtererhoehung nach Fehlerspeichereintrag" VALUE 0x70FC6 TKW_VV_VV_UB 100.0 FORMULA_0003 0.0 255.0000 /end CHARACTERISTIC
/begin CHARACTERISTIC K_ED_IONSPG_B1.INC_NACH_EINTRAG "Filtererhoehung nach Fehlerspeichereintrag" VALUE 0x70FE0 TKW_VV_VV_UB 100.0 FORMULA_0003 0.0 255.0000 /end CHARACTERISTIC
/begin CHARACTERISTIC K_ED_IONVERST_B2.INC_NACH_EINTRAG "Filtererhoehung nach Fehlerspeichereintrag" VALUE 0x70FFA TKW_VV_VV_UB 100.0 FORMULA_0003 0.0 255.0000 /end CHARACTERISTIC
/begin CHARACTERISTIC K_ED_IONSPG_B2.INC_NACH_EINTRAG "Filtererhoehung nach Fehlerspeichereintrag" VALUE 0x71014 TKW_VV_VV_UB 100.0 FORMULA_0003 0.0 255.0000 /end CHARACTERISTIC
/begin CHARACTERISTIC K_ED_TABG1.INC_NACH_EINTRAG "Filtererhoehung nach Fehlerspeichereintrag | EN: Fault code TABG1 - debounce filter increment after fault-memory entry" VALUE 0x7102E TKW_VV_VV_UB 100.0 FORMULA_0003 0.0 255.0000 /end CHARACTERISTIC
/begin CHARACTERISTIC K_ED_TABG2.INC_NACH_EINTRAG "Filtererhoehung nach Fehlerspeichereintrag | EN: Fault code TABG2 - debounce filter increment after fault-memory entry" VALUE 0x71048 TKW_VV_VV_UB 100.0 FORMULA_0003 0.0 255.0000 /end CHARACTERISTIC
/begin CHARACTERISTIC K_ED_LLS1_REGLER.INC_NACH_EINTRAG "Filtererhoehung nach Fehlerspeichereintrag | EN: Fault code LLS1_REGLER - debounce filter increment after fault-memory entry" VALUE 0x710CA TKW_VV_VV_UB 100.0 FORMULA_0003 0.0 255.0000 /end CHARACTERISTIC
/begin CHARACTERISTIC K_ED_LLS2_REGLER.INC_NACH_EINTRAG "Filtererhoehung nach Fehlerspeichereintrag | EN: Fault code LLS2_REGLER - debounce filter increment after fault-memory entry" VALUE 0x710E4 TKW_VV_VV_UB 100.0 FORMULA_0003 0.0 255.0000 /end CHARACTERISTIC
/begin CHARACTERISTIC K_ED_MD_SK_ERR.INC_NACH_EINTRAG "Filtererhoehung nach Fehlerspeichereintrag | EN: Fault code MD_SK_ERR - debounce filter increment after fault-memory entry" VALUE 0x71166 TKW_VV_VV_UB 100.0 FORMULA_0003 0.0 255.0000 /end CHARACTERISTIC
/begin CHARACTERISTIC K_ED_LLS_INIT.INC_NACH_EINTRAG "Filtererhoehung nach Fehlerspeichereintrag | EN: Fault code LLS_INIT - debounce filter increment after fault-memory entry" VALUE 0x71180 TKW_VV_VV_UB 100.0 FORMULA_0003 0.0 255.0000 /end CHARACTERISTIC
/begin CHARACTERISTIC K_ED_LLS1_CMD.INC_NACH_EINTRAG "Filtererhoehung nach Fehlerspeichereintrag | EN: Fault code LLS1_CMD - debounce filter increment after fault-memory entry" VALUE 0x711E8 TKW_VV_VV_UB 100.0 FORMULA_0003 0.0 255.0000 /end CHARACTERISTIC
/begin CHARACTERISTIC K_ED_LLS2_CMD.INC_NACH_EINTRAG "Filtererhoehung nach Fehlerspeichereintrag | EN: Fault code LLS2_CMD - debounce filter increment after fault-memory entry" VALUE 0x71202 TKW_VV_VV_UB 100.0 FORMULA_0003 0.0 255.0000 /end CHARACTERISTIC
/begin CHARACTERISTIC K_ED_SC_SMG1.INC_NACH_EINTRAG "Filtererhoehung nach Fehlerspeichereintrag | EN: Fault code SC_SMG1 - debounce filter increment after fault-memory entry" VALUE 0x7121C TKW_VV_VV_UB 100.0 FORMULA_0003 0.0 255.0000 /end CHARACTERISTIC
/begin CHARACTERISTIC K_ED_SC_SMG2.INC_NACH_EINTRAG "Filtererhoehung nach Fehlerspeichereintrag | EN: Fault code SC_SMG2 - debounce filter increment after fault-memory entry" VALUE 0x71236 TKW_VV_VV_UB 100.0 FORMULA_0003 0.0 255.0000 /end CHARACTERISTIC
/begin CHARACTERISTIC K_ED_SC_SMG3.INC_NACH_EINTRAG "Filtererhoehung nach Fehlerspeichereintrag | EN: Fault code SC_SMG3 - debounce filter increment after fault-memory entry" VALUE 0x71250 TKW_VV_VV_UB 100.0 FORMULA_0003 0.0 255.0000 /end CHARACTERISTIC
/begin CHARACTERISTIC K_ED_SC_BUSOFF.INC_NACH_EINTRAG "Filtererhoehung nach Fehlerspeichereintrag | EN: Fault code SC_BUSOFF - debounce filter increment after fault-memory entry" VALUE 0x7126A TKW_VV_VV_UB 100.0 FORMULA_0003 0.0 255.0000 /end CHARACTERISTIC
/begin CHARACTERISTIC K_ED_ION_SIG_B1.INC_NACH_EINTRAG "Filtererhoehung nach Fehlerspeichereintrag" VALUE 0x713A2 TKW_VV_VV_UB 100.0 FORMULA_0003 0.0 255.0000 /end CHARACTERISTIC
/begin CHARACTERISTIC K_ED_ION_SIG_B2.INC_NACH_EINTRAG "Filtererhoehung nach Fehlerspeichereintrag" VALUE 0x713BC TKW_VV_VV_UB 100.0 FORMULA_0003 0.0 255.0000 /end CHARACTERISTIC
/begin CHARACTERISTIC K_ED_ION_SAT_B1.INC_NACH_EINTRAG "Filtererhoehung nach Fehlerspeichereintrag" VALUE 0x714F4 TKW_VV_VV_UB 100.0 FORMULA_0003 0.0 255.0000 /end CHARACTERISTIC
/begin CHARACTERISTIC K_ED_ION_SAT_B2.INC_NACH_EINTRAG "Filtererhoehung nach Fehlerspeichereintrag" VALUE 0x7150E TKW_VV_VV_UB 100.0 FORMULA_0003 0.0 255.0000 /end CHARACTERISTIC
/begin CHARACTERISTIC K_ED_TAN_OBD_B1.INC_NACH_EINTRAG "Filtererhoehung nach Fehlerspeichereintrag | EN: Fault code TAN_OBD_B1 - debounce filter increment after fault-memory entry" VALUE 0x71542 TKW_VV_VV_UB 100.0 FORMULA_0003 0.0 255.0000 /end CHARACTERISTIC
/begin CHARACTERISTIC K_ED_INDEX_88_IGN.INC_NACH_EINTRAG "Filtererhoehung nach Fehlerspeichereintrag | EN: Filtererhoehung nach Fehlerspeichereintrag" VALUE 0x7155C TKW_VV_VV_UB 100.0 FORMULA_0003 0.0 255.0000 /end CHARACTERISTIC
/begin CHARACTERISTIC K_ED_INDEX_89_IGN.INC_NACH_EINTRAG "Filtererhoehung nach Fehlerspeichereintrag" VALUE 0x71576 TKW_VV_VV_UB 100.0 FORMULA_0003 0.0 255.0000 /end CHARACTERISTIC
/begin CHARACTERISTIC K_ED_SG_IGN.INC_NACH_EINTRAG "Filtererhoehung nach Fehlerspeichereintrag | EN: Fault code SG_IGN - debounce filter increment after fault-memory entry" VALUE 0x715C4 TKW_VV_VV_UB 100.0 FORMULA_0003 0.0 255.0000 /end CHARACTERISTIC
/begin CHARACTERISTIC K_ED_SK_MANAGER_IGN.INC_NACH_EINTRAG "Filtererhoehung nach Fehlerspeichereintrag | EN: Fault code SK_MANAGER_IGN - debounce filter increment after fault-memory entry" VALUE 0x71612 TKW_VV_VV_UB 100.0 FORMULA_0003 0.0 255.0000 /end CHARACTERISTIC
/begin CHARACTERISTIC K_ED_LLR_DIAG.INC_NACH_EINTRAG "Filtererhoehung nach Fehlerspeichereintrag | EN: Fault code LLR_DIAG - debounce filter increment after fault-memory entry" VALUE 0x7162C TKW_VV_VV_UB 100.0 FORMULA_0003 0.0 255.0000 /end CHARACTERISTIC
/begin CHARACTERISTIC K_ED_THERMOSTAT.INC_NACH_EINTRAG "Filtererhoehung nach Fehlerspeichereintrag | EN: Fault code THERMOSTAT - debounce filter increment after fault-memory entry" VALUE 0x71646 TKW_VV_VV_UB 100.0 FORMULA_0003 0.0 255.0000 /end CHARACTERISTIC
/begin CHARACTERISTIC K_ED_TAN_OBD_B2.INC_NACH_EINTRAG "Filtererhoehung nach Fehlerspeichereintrag | EN: Fault code TAN_OBD_B2 - debounce filter increment after fault-memory entry" VALUE 0x71660 TKW_VV_VV_UB 100.0 FORMULA_0003 0.0 255.0000 /end CHARACTERISTIC
/begin CHARACTERISTIC K_ED_PWG_BLS.INC_NACH_EINTRAG "Filtererhoehung nach Fehlerspeichereintrag | EN: Fault code PWG_BLS - debounce filter increment after fault-memory entry" VALUE 0x716C8 TKW_VV_VV_UB 100.0 FORMULA_0003 0.0 255.0000 /end CHARACTERISTIC
/begin CHARACTERISTIC K_ED_START_RL.INC_NACH_EINTRAG "Filtererhoehung nach Fehlerspeichereintrag | EN: Fault code START_RL - debounce filter increment after fault-memory entry" VALUE 0x716E2 TKW_VV_VV_UB 100.0 FORMULA_0003 0.0 255.0000 /end CHARACTERISTIC
/begin CHARACTERISTIC K_ED_N_GETR_EIN_HS.INC_NACH_EINTRAG "Filtererhoehung nach Fehlerspeichereintrag | EN: Fault code N_GETR_EIN_HS - debounce filter increment after fault-memory entry" VALUE 0x71716 TKW_VV_VV_UB 100.0 FORMULA_0003 0.0 255.0000 /end CHARACTERISTIC
/begin CHARACTERISTIC K_ED_LLR_DIAG_CSS.INC_NACH_EINTRAG "Filtererhoehung nach Fehlerspeichereintrag | EN: Fault code LLR_DIAG_CSS - debounce filter increment after fault-memory entry" VALUE 0x7174A TKW_VV_VV_UB 100.0 FORMULA_0003 0.0 255.0000 /end CHARACTERISTIC
/begin CHARACTERISTIC K_ED_TMOT_OBD_HIGH.INC_NACH_EINTRAG "Filtererhoehung nach Fehlerspeichereintrag | EN: Fault code TMOT_OBD_HIGH - debounce filter increment after fault-memory entry" VALUE 0x71764 TKW_VV_VV_UB 100.0 FORMULA_0003 0.0 255.0000 /end CHARACTERISTIC
/begin CHARACTERISTIC K_ED_INDEX_122_IGN.INC_NACH_EINTRAG "Filtererhoehung nach Fehlerspeichereintrag | EN: Fault code INDEX_122_IGN - debounce filter increment after fault-memory entry" VALUE 0x718D0 TKW_VV_VV_UB 100.0 FORMULA_0003 0.0 255.0000 /end CHARACTERISTIC
/begin CHARACTERISTIC K_ED_INDEX_123_IGN.INC_NACH_EINTRAG "Filtererhoehung nach Fehlerspeichereintrag | EN: Fault code INDEX_123_IGN - debounce filter increment after fault-memory entry" VALUE 0x718EA TKW_VV_VV_UB 100.0 FORMULA_0003 0.0 255.0000 /end CHARACTERISTIC
/begin CHARACTERISTIC K_ED_INDEX_124_IGN.INC_NACH_EINTRAG "Filtererhoehung nach Fehlerspeichereintrag | EN: Fault code INDEX_124_IGN - debounce filter increment after fault-memory entry" VALUE 0x71904 TKW_VV_VV_UB 100.0 FORMULA_0003 0.0 255.0000 /end CHARACTERISTIC
/begin CHARACTERISTIC K_ED_INDEX_125_IGN.INC_NACH_EINTRAG "Filtererhoehung nach Fehlerspeichereintrag | EN: Fault code INDEX_125_IGN - debounce filter increment after fault-memory entry" VALUE 0x7191E TKW_VV_VV_UB 100.0 FORMULA_0003 0.0 255.0000 /end CHARACTERISTIC
/begin CHARACTERISTIC K_ED_INDEX_126_IGN.INC_NACH_EINTRAG "Filtererhoehung nach Fehlerspeichereintrag | EN: Fault code INDEX_126_IGN - debounce filter increment after fault-memory entry" VALUE 0x71938 TKW_VV_VV_UB 100.0 FORMULA_0003 0.0 255.0000 /end CHARACTERISTIC
/begin CHARACTERISTIC K_ED_INDEX_127_IGN.INC_NACH_EINTRAG "Filtererhoehung nach Fehlerspeichereintrag | EN: Fault code INDEX_127_IGN - debounce filter increment after fault-memory entry" VALUE 0x71952 TKW_VV_VV_UB 100.0 FORMULA_0003 0.0 255.0000 /end CHARACTERISTIC
/begin CHARACTERISTIC K_ED_SK_TR_IGN.DEC_NACH_EINTRAG "Filterverringerung nach Fehlerspeichereintrag | EN: Filterverringerung nach Fehlerspeichereintrag" VALUE 0x70C6D TKW_VV_VV_UB 100.0 FORMULA_0003 0.0 255.0000 /end CHARACTERISTIC
/begin CHARACTERISTIC K_ED_TMOT.DEC_NACH_EINTRAG "Filterverringerung nach Fehlerspeichereintrag | EN: Fault code TMOT - debounce filter decrement after fault-memory entry" VALUE 0x70C87 TKW_VV_VV_UB 100.0 FORMULA_0003 0.0 255.0000 /end CHARACTERISTIC
/begin CHARACTERISTIC K_ED_TMOT_OBD.DEC_NACH_EINTRAG "Filterverringerung nach Fehlerspeichereintrag | EN: Fault code TMOT_OBD - debounce filter decrement after fault-memory entry" VALUE 0x70CA1 TKW_VV_VV_UB 100.0 FORMULA_0003 0.0 255.0000 /end CHARACTERISTIC
/begin CHARACTERISTIC K_ED_TAN1.DEC_NACH_EINTRAG "Filterverringerung nach Fehlerspeichereintrag | EN: Fault code TAN1 - debounce filter decrement after fault-memory entry" VALUE 0x70CBB TKW_VV_VV_UB 100.0 FORMULA_0003 0.0 255.0000 /end CHARACTERISTIC
/begin CHARACTERISTIC K_ED_TAN2.DEC_NACH_EINTRAG "Filterverringerung nach Fehlerspeichereintrag | EN: Fault code TAN2 - debounce filter decrement after fault-memory entry" VALUE 0x70CD5 TKW_VV_VV_UB 100.0 FORMULA_0003 0.0 255.0000 /end CHARACTERISTIC
/begin CHARACTERISTIC K_ED_TIME_REL_OBD.DEC_NACH_EINTRAG "Filterverringerung nach Fehlerspeichereintrag | EN: Fault code TIME_REL_OBD - debounce filter decrement after fault-memory entry" VALUE 0x70CEF TKW_VV_VV_UB 100.0 FORMULA_0003 0.0 255.0000 /end CHARACTERISTIC
/begin CHARACTERISTIC K_ED_TKA.DEC_NACH_EINTRAG "Filterverringerung nach Fehlerspeichereintrag | EN: Fault code TKA - debounce filter decrement after fault-memory entry" VALUE 0x70D23 TKW_VV_VV_UB 100.0 FORMULA_0003 0.0 255.0000 /end CHARACTERISTIC
/begin CHARACTERISTIC K_ED_TDME.DEC_NACH_EINTRAG "Filterverringerung nach Fehlerspeichereintrag | EN: Fault code TDME - debounce filter decrement after fault-memory entry" VALUE 0x70D3D TKW_VV_VV_UB 100.0 FORMULA_0003 0.0 255.0000 /end CHARACTERISTIC
/begin CHARACTERISTIC K_ED_TKA_OBD.DEC_NACH_EINTRAG "Filterverringerung nach Fehlerspeichereintrag | EN: Fault code TKA_OBD - debounce filter decrement after fault-memory entry" VALUE 0x70DA5 TKW_VV_VV_UB 100.0 FORMULA_0003 0.0 255.0000 /end CHARACTERISTIC
/begin CHARACTERISTIC K_ED_PWG1.DEC_NACH_EINTRAG "Filterverringerung nach Fehlerspeichereintrag | EN: Fault code PWG1 - debounce filter decrement after fault-memory entry" VALUE 0x70DBF TKW_VV_VV_UB 100.0 FORMULA_0003 0.0 255.0000 /end CHARACTERISTIC
/begin CHARACTERISTIC K_ED_PWG2.DEC_NACH_EINTRAG "Filterverringerung nach Fehlerspeichereintrag | EN: Fault code PWG2 - debounce filter decrement after fault-memory entry" VALUE 0x70DD9 TKW_VV_VV_UB 100.0 FORMULA_0003 0.0 255.0000 /end CHARACTERISTIC
/begin CHARACTERISTIC K_ED_PWG_VGL.DEC_NACH_EINTRAG "Filterverringerung nach Fehlerspeichereintrag | EN: Fault code PWG_VGL - debounce filter decrement after fault-memory entry" VALUE 0x70DF3 TKW_VV_VV_UB 100.0 FORMULA_0003 0.0 255.0000 /end CHARACTERISTIC
/begin CHARACTERISTIC K_ED_PCTRL_IGN.DEC_NACH_EINTRAG "Filterverringerung nach Fehlerspeichereintrag | EN: Fault code PCTRL_IGN - debounce filter decrement after fault-memory entry" VALUE 0x70E0D TKW_VV_VV_UB 100.0 FORMULA_0003 0.0 255.0000 /end CHARACTERISTIC
/begin CHARACTERISTIC K_ED_LLS1_CAN.DEC_NACH_EINTRAG "Filterverringerung nach Fehlerspeichereintrag | EN: Fault code LLS1_CAN - debounce filter decrement after fault-memory entry" VALUE 0x70E27 TKW_VV_VV_UB 100.0 FORMULA_0003 0.0 255.0000 /end CHARACTERISTIC
/begin CHARACTERISTIC K_ED_LLS2_CAN.DEC_NACH_EINTRAG "Filterverringerung nach Fehlerspeichereintrag | EN: Fault code LLS2_CAN - debounce filter decrement after fault-memory entry" VALUE 0x70E41 TKW_VV_VV_UB 100.0 FORMULA_0003 0.0 255.0000 /end CHARACTERISTIC
/begin CHARACTERISTIC K_ED_LLS1_SK.DEC_NACH_EINTRAG "Filterverringerung nach Fehlerspeichereintrag | EN: Fault code LLS1_SK - debounce filter decrement after fault-memory entry" VALUE 0x70E8F TKW_VV_VV_UB 100.0 FORMULA_0003 0.0 255.0000 /end CHARACTERISTIC
/begin CHARACTERISTIC K_ED_LLS2_SK.DEC_NACH_EINTRAG "Filterverringerung nach Fehlerspeichereintrag | EN: Fault code LLS2_SK - debounce filter decrement after fault-memory entry" VALUE 0x70EA9 TKW_VV_VV_UB 100.0 FORMULA_0003 0.0 255.0000 /end CHARACTERISTIC
/begin CHARACTERISTIC K_ED_SMG_SCHALTAB.DEC_NACH_EINTRAG "Filterverringerung nach Fehlerspeichereintrag | EN: Fault code SMG_SCHALTAB - debounce filter decrement after fault-memory entry" VALUE 0x70EC3 TKW_VV_VV_UB 100.0 FORMULA_0003 0.0 255.0000 /end CHARACTERISTIC
/begin CHARACTERISTIC K_ED_SMG_SK.DEC_NACH_EINTRAG "Filterverringerung nach Fehlerspeichereintrag | EN: Fault code SMG_SK - debounce filter decrement after fault-memory entry" VALUE 0x70EDD TKW_VV_VV_UB 100.0 FORMULA_0003 0.0 255.0000 /end CHARACTERISTIC
/begin CHARACTERISTIC K_ED_SMG_SK_N.DEC_NACH_EINTRAG "Filterverringerung nach Fehlerspeichereintrag | EN: Fault code SMG_SK_N - debounce filter decrement after fault-memory entry" VALUE 0x70EF7 TKW_VV_VV_UB 100.0 FORMULA_0003 0.0 255.0000 /end CHARACTERISTIC
/begin CHARACTERISTIC K_ED_IONVERST_B1.DEC_NACH_EINTRAG "Filterverringerung nach Fehlerspeichereintrag" VALUE 0x70FC7 TKW_VV_VV_UB 100.0 FORMULA_0003 0.0 255.0000 /end CHARACTERISTIC
/begin CHARACTERISTIC K_ED_IONSPG_B1.DEC_NACH_EINTRAG "Filterverringerung nach Fehlerspeichereintrag" VALUE 0x70FE1 TKW_VV_VV_UB 100.0 FORMULA_0003 0.0 255.0000 /end CHARACTERISTIC
/begin CHARACTERISTIC K_ED_IONVERST_B2.DEC_NACH_EINTRAG "Filterverringerung nach Fehlerspeichereintrag" VALUE 0x70FFB TKW_VV_VV_UB 100.0 FORMULA_0003 0.0 255.0000 /end CHARACTERISTIC
/begin CHARACTERISTIC K_ED_IONSPG_B2.DEC_NACH_EINTRAG "Filterverringerung nach Fehlerspeichereintrag" VALUE 0x71015 TKW_VV_VV_UB 100.0 FORMULA_0003 0.0 255.0000 /end CHARACTERISTIC
/begin CHARACTERISTIC K_ED_TABG1.DEC_NACH_EINTRAG "Filterverringerung nach Fehlerspeichereintrag | EN: Fault code TABG1 - debounce filter decrement after fault-memory entry" VALUE 0x7102F TKW_VV_VV_UB 100.0 FORMULA_0003 0.0 255.0000 /end CHARACTERISTIC
/begin CHARACTERISTIC K_ED_TABG2.DEC_NACH_EINTRAG "Filterverringerung nach Fehlerspeichereintrag | EN: Fault code TABG2 - debounce filter decrement after fault-memory entry" VALUE 0x71049 TKW_VV_VV_UB 100.0 FORMULA_0003 0.0 255.0000 /end CHARACTERISTIC
/begin CHARACTERISTIC K_ED_LLS1_REGLER.DEC_NACH_EINTRAG "Filterverringerung nach Fehlerspeichereintrag | EN: Fault code LLS1_REGLER - debounce filter decrement after fault-memory entry" VALUE 0x710CB TKW_VV_VV_UB 100.0 FORMULA_0003 0.0 255.0000 /end CHARACTERISTIC
/begin CHARACTERISTIC K_ED_LLS2_REGLER.DEC_NACH_EINTRAG "Filterverringerung nach Fehlerspeichereintrag | EN: Fault code LLS2_REGLER - debounce filter decrement after fault-memory entry" VALUE 0x710E5 TKW_VV_VV_UB 100.0 FORMULA_0003 0.0 255.0000 /end CHARACTERISTIC
/begin CHARACTERISTIC K_ED_MD_SK_ERR.DEC_NACH_EINTRAG "Filterverringerung nach Fehlerspeichereintrag | EN: Fault code MD_SK_ERR - debounce filter decrement after fault-memory entry" VALUE 0x71167 TKW_VV_VV_UB 100.0 FORMULA_0003 0.0 255.0000 /end CHARACTERISTIC
/begin CHARACTERISTIC K_ED_LLS_INIT.DEC_NACH_EINTRAG "Filterverringerung nach Fehlerspeichereintrag | EN: Fault code LLS_INIT - debounce filter decrement after fault-memory entry" VALUE 0x71181 TKW_VV_VV_UB 100.0 FORMULA_0003 0.0 255.0000 /end CHARACTERISTIC
/begin CHARACTERISTIC K_ED_LLS1_CMD.DEC_NACH_EINTRAG "Filterverringerung nach Fehlerspeichereintrag | EN: Fault code LLS1_CMD - debounce filter decrement after fault-memory entry" VALUE 0x711E9 TKW_VV_VV_UB 100.0 FORMULA_0003 0.0 255.0000 /end CHARACTERISTIC
/begin CHARACTERISTIC K_ED_LLS2_CMD.DEC_NACH_EINTRAG "Filterverringerung nach Fehlerspeichereintrag | EN: Fault code LLS2_CMD - debounce filter decrement after fault-memory entry" VALUE 0x71203 TKW_VV_VV_UB 100.0 FORMULA_0003 0.0 255.0000 /end CHARACTERISTIC
/begin CHARACTERISTIC K_ED_SC_SMG1.DEC_NACH_EINTRAG "Filterverringerung nach Fehlerspeichereintrag | EN: Fault code SC_SMG1 - debounce filter decrement after fault-memory entry" VALUE 0x7121D TKW_VV_VV_UB 100.0 FORMULA_0003 0.0 255.0000 /end CHARACTERISTIC
/begin CHARACTERISTIC K_ED_SC_SMG2.DEC_NACH_EINTRAG "Filterverringerung nach Fehlerspeichereintrag | EN: Fault code SC_SMG2 - debounce filter decrement after fault-memory entry" VALUE 0x71237 TKW_VV_VV_UB 100.0 FORMULA_0003 0.0 255.0000 /end CHARACTERISTIC
/begin CHARACTERISTIC K_ED_SC_SMG3.DEC_NACH_EINTRAG "Filterverringerung nach Fehlerspeichereintrag | EN: Fault code SC_SMG3 - debounce filter decrement after fault-memory entry" VALUE 0x71251 TKW_VV_VV_UB 100.0 FORMULA_0003 0.0 255.0000 /end CHARACTERISTIC
/begin CHARACTERISTIC K_ED_SC_BUSOFF.DEC_NACH_EINTRAG "Filterverringerung nach Fehlerspeichereintrag | EN: Fault code SC_BUSOFF - debounce filter decrement after fault-memory entry" VALUE 0x7126B TKW_VV_VV_UB 100.0 FORMULA_0003 0.0 255.0000 /end CHARACTERISTIC
/begin CHARACTERISTIC K_ED_ION_SIG_B1.DEC_NACH_EINTRAG "Filterverringerung nach Fehlerspeichereintrag" VALUE 0x713A3 TKW_VV_VV_UB 100.0 FORMULA_0003 0.0 255.0000 /end CHARACTERISTIC
/begin CHARACTERISTIC K_ED_ION_SIG_B2.DEC_NACH_EINTRAG "Filterverringerung nach Fehlerspeichereintrag" VALUE 0x713BD TKW_VV_VV_UB 100.0 FORMULA_0003 0.0 255.0000 /end CHARACTERISTIC
/begin CHARACTERISTIC K_ED_ION_SAT_B1.DEC_NACH_EINTRAG "Filterverringerung nach Fehlerspeichereintrag" VALUE 0x714F5 TKW_VV_VV_UB 100.0 FORMULA_0003 0.0 255.0000 /end CHARACTERISTIC
/begin CHARACTERISTIC K_ED_ION_SAT_B2.DEC_NACH_EINTRAG "Filterverringerung nach Fehlerspeichereintrag" VALUE 0x7150F TKW_VV_VV_UB 100.0 FORMULA_0003 0.0 255.0000 /end CHARACTERISTIC
/begin CHARACTERISTIC K_ED_TAN_OBD_B1.DEC_NACH_EINTRAG "Filterverringerung nach Fehlerspeichereintrag | EN: Fault code TAN_OBD_B1 - debounce filter decrement after fault-memory entry" VALUE 0x71543 TKW_VV_VV_UB 100.0 FORMULA_0003 0.0 255.0000 /end CHARACTERISTIC
/begin CHARACTERISTIC K_ED_INDEX_88_IGN.DEC_NACH_EINTRAG "Filterverringerung nach Fehlerspeichereintrag | EN: Filterverringerung nach Fehlerspeichereintrag" VALUE 0x7155D TKW_VV_VV_UB 100.0 FORMULA_0003 0.0 255.0000 /end CHARACTERISTIC
/begin CHARACTERISTIC K_ED_INDEX_89_IGN.DEC_NACH_EINTRAG "Filterverringerung nach Fehlerspeichereintrag" VALUE 0x71577 TKW_VV_VV_UB 100.0 FORMULA_0003 0.0 255.0000 /end CHARACTERISTIC
/begin CHARACTERISTIC K_ED_SG_IGN.DEC_NACH_EINTRAG "Filterverringerung nach Fehlerspeichereintrag | EN: Fault code SG_IGN - debounce filter decrement after fault-memory entry" VALUE 0x715C5 TKW_VV_VV_UB 100.0 FORMULA_0003 0.0 255.0000 /end CHARACTERISTIC
/begin CHARACTERISTIC K_ED_SK_MANAGER_IGN.DEC_NACH_EINTRAG "Filterverringerung nach Fehlerspeichereintrag | EN: Fault code SK_MANAGER_IGN - debounce filter decrement after fault-memory entry" VALUE 0x71613 TKW_VV_VV_UB 100.0 FORMULA_0003 0.0 255.0000 /end CHARACTERISTIC
/begin CHARACTERISTIC K_ED_LLR_DIAG.DEC_NACH_EINTRAG "Filterverringerung nach Fehlerspeichereintrag | EN: Fault code LLR_DIAG - debounce filter decrement after fault-memory entry" VALUE 0x7162D TKW_VV_VV_UB 100.0 FORMULA_0003 0.0 255.0000 /end CHARACTERISTIC
/begin CHARACTERISTIC K_ED_THERMOSTAT.DEC_NACH_EINTRAG "Filterverringerung nach Fehlerspeichereintrag | EN: Fault code THERMOSTAT - debounce filter decrement after fault-memory entry" VALUE 0x71647 TKW_VV_VV_UB 100.0 FORMULA_0003 0.0 255.0000 /end CHARACTERISTIC
/begin CHARACTERISTIC K_ED_TAN_OBD_B2.DEC_NACH_EINTRAG "Filterverringerung nach Fehlerspeichereintrag | EN: Fault code TAN_OBD_B2 - debounce filter decrement after fault-memory entry" VALUE 0x71661 TKW_VV_VV_UB 100.0 FORMULA_0003 0.0 255.0000 /end CHARACTERISTIC
/begin CHARACTERISTIC K_ED_PWG_BLS.DEC_NACH_EINTRAG "Filterverringerung nach Fehlerspeichereintrag | EN: Fault code PWG_BLS - debounce filter decrement after fault-memory entry" VALUE 0x716C9 TKW_VV_VV_UB 100.0 FORMULA_0003 0.0 255.0000 /end CHARACTERISTIC
/begin CHARACTERISTIC K_ED_START_RL.DEC_NACH_EINTRAG "Filterverringerung nach Fehlerspeichereintrag | EN: Fault code START_RL - debounce filter decrement after fault-memory entry" VALUE 0x716E3 TKW_VV_VV_UB 100.0 FORMULA_0003 0.0 255.0000 /end CHARACTERISTIC
/begin CHARACTERISTIC K_ED_N_GETR_EIN_HS.DEC_NACH_EINTRAG "Filterverringerung nach Fehlerspeichereintrag | EN: Fault code N_GETR_EIN_HS - debounce filter decrement after fault-memory entry" VALUE 0x71717 TKW_VV_VV_UB 100.0 FORMULA_0003 0.0 255.0000 /end CHARACTERISTIC
/begin CHARACTERISTIC K_ED_TUMG.DEC_NACH_EINTRAG "Filterverringerung nach Fehlerspeichereintrag | EN: Fault code TUMG - debounce filter decrement after fault-memory entry" VALUE 0x71731 TKW_VV_VV_UB 100.0 FORMULA_0003 0.0 255.0000 /end CHARACTERISTIC
/begin CHARACTERISTIC K_ED_LLR_DIAG_CSS.DEC_NACH_EINTRAG "Filterverringerung nach Fehlerspeichereintrag | EN: Fault code LLR_DIAG_CSS - debounce filter decrement after fault-memory entry" VALUE 0x7174B TKW_VV_VV_UB 100.0 FORMULA_0003 0.0 255.0000 /end CHARACTERISTIC
/begin CHARACTERISTIC K_ED_TMOT_OBD_HIGH.DEC_NACH_EINTRAG "Filterverringerung nach Fehlerspeichereintrag | EN: Fault code TMOT_OBD_HIGH - debounce filter decrement after fault-memory entry" VALUE 0x71765 TKW_VV_VV_UB 100.0 FORMULA_0003 0.0 255.0000 /end CHARACTERISTIC
/begin CHARACTERISTIC K_ED_INDEX_122_IGN.DEC_NACH_EINTRAG "Filterverringerung nach Fehlerspeichereintrag | EN: Fault code INDEX_122_IGN - debounce filter decrement after fault-memory entry" VALUE 0x718D1 TKW_VV_VV_UB 100.0 FORMULA_0003 0.0 255.0000 /end CHARACTERISTIC
/begin CHARACTERISTIC K_ED_INDEX_123_IGN.DEC_NACH_EINTRAG "Filterverringerung nach Fehlerspeichereintrag | EN: Fault code INDEX_123_IGN - debounce filter decrement after fault-memory entry" VALUE 0x718EB TKW_VV_VV_UB 100.0 FORMULA_0003 0.0 255.0000 /end CHARACTERISTIC
/begin CHARACTERISTIC K_ED_INDEX_124_IGN.DEC_NACH_EINTRAG "Filterverringerung nach Fehlerspeichereintrag | EN: Fault code INDEX_124_IGN - debounce filter decrement after fault-memory entry" VALUE 0x71905 TKW_VV_VV_UB 100.0 FORMULA_0003 0.0 255.0000 /end CHARACTERISTIC
/begin CHARACTERISTIC K_ED_INDEX_125_IGN.DEC_NACH_EINTRAG "Filterverringerung nach Fehlerspeichereintrag | EN: Fault code INDEX_125_IGN - debounce filter decrement after fault-memory entry" VALUE 0x7191F TKW_VV_VV_UB 100.0 FORMULA_0003 0.0 255.0000 /end CHARACTERISTIC
/begin CHARACTERISTIC K_ED_INDEX_126_IGN.DEC_NACH_EINTRAG "Filterverringerung nach Fehlerspeichereintrag | EN: Fault code INDEX_126_IGN - debounce filter decrement after fault-memory entry" VALUE 0x71939 TKW_VV_VV_UB 100.0 FORMULA_0003 0.0 255.0000 /end CHARACTERISTIC
/begin CHARACTERISTIC K_ED_INDEX_127_IGN.DEC_NACH_EINTRAG "Filterverringerung nach Fehlerspeichereintrag | EN: Fault code INDEX_127_IGN - debounce filter decrement after fault-memory entry" VALUE 0x71953 TKW_VV_VV_UB 100.0 FORMULA_0003 0.0 255.0000 /end CHARACTERISTIC
/begin CHARACTERISTIC K_ED_SK_TR_IGN.KLASSENINDEX "Auswahl der Fehlerklasse | EN: Fault code SK_TR_IGN - fault class selection (lamp / warning behaviour)" VALUE 0x70C6E TKW_VV_VV_UB 100.0 FORMULA_0003 0.0 8.0000 /end CHARACTERISTIC
/begin CHARACTERISTIC K_ED_TMOT.KLASSENINDEX "Auswahl der Fehlerklasse | EN: Fault code TMOT - fault class selection (lamp / warning behaviour)" VALUE 0x70C88 TKW_VV_VV_UB 100.0 FORMULA_0003 0.0 8.0000 /end CHARACTERISTIC
/begin CHARACTERISTIC K_ED_TMOT_OBD.KLASSENINDEX "Auswahl der Fehlerklasse | EN: Fault code TMOT_OBD - fault class selection (lamp / warning behaviour) [V912: differs from V452 160E]" VALUE 0x70CA2 TKW_VV_VV_UB 100.0 FORMULA_0003 0.0 8.0000 /end CHARACTERISTIC
/begin CHARACTERISTIC K_ED_TAN1.KLASSENINDEX "Auswahl der Fehlerklasse | EN: Fault code TAN1 - fault class selection (lamp / warning behaviour)" VALUE 0x70CBC TKW_VV_VV_UB 100.0 FORMULA_0003 0.0 8.0000 /end CHARACTERISTIC
/begin CHARACTERISTIC K_ED_TAN2.KLASSENINDEX "Auswahl der Fehlerklasse | EN: Fault code TAN2 - fault class selection (lamp / warning behaviour)" VALUE 0x70CD6 TKW_VV_VV_UB 100.0 FORMULA_0003 0.0 8.0000 /end CHARACTERISTIC
/begin CHARACTERISTIC K_ED_TIME_REL_OBD.KLASSENINDEX "Auswahl der Fehlerklasse | EN: Fault code TIME_REL_OBD - fault class selection (lamp / warning behaviour) [V912: differs from V452 160E]" VALUE 0x70CF0 TKW_VV_VV_UB 100.0 FORMULA_0003 0.0 8.0000 /end CHARACTERISTIC
/begin CHARACTERISTIC K_ED_TKA.KLASSENINDEX "Auswahl der Fehlerklasse | EN: Fault code TKA - fault class selection (lamp / warning behaviour)" VALUE 0x70D24 TKW_VV_VV_UB 100.0 FORMULA_0003 0.0 8.0000 /end CHARACTERISTIC
/begin CHARACTERISTIC K_ED_TDME.KLASSENINDEX "Auswahl der Fehlerklasse | EN: Fault code TDME - fault class selection (lamp / warning behaviour)" VALUE 0x70D3E TKW_VV_VV_UB 100.0 FORMULA_0003 0.0 8.0000 /end CHARACTERISTIC
/begin CHARACTERISTIC K_ED_TKA_OBD.KLASSENINDEX "Auswahl der Fehlerklasse | EN: Fault code TKA_OBD - fault class selection (lamp / warning behaviour)" VALUE 0x70DA6 TKW_VV_VV_UB 100.0 FORMULA_0003 0.0 8.0000 /end CHARACTERISTIC
/begin CHARACTERISTIC K_ED_PWG1.KLASSENINDEX "Auswahl der Fehlerklasse | EN: Fault code PWG1 - fault class selection (lamp / warning behaviour)" VALUE 0x70DC0 TKW_VV_VV_UB 100.0 FORMULA_0003 0.0 8.0000 /end CHARACTERISTIC
/begin CHARACTERISTIC K_ED_PWG2.KLASSENINDEX "Auswahl der Fehlerklasse | EN: Fault code PWG2 - fault class selection (lamp / warning behaviour)" VALUE 0x70DDA TKW_VV_VV_UB 100.0 FORMULA_0003 0.0 8.0000 /end CHARACTERISTIC
/begin CHARACTERISTIC K_ED_PWG_VGL.KLASSENINDEX "Auswahl der Fehlerklasse | EN: Fault code PWG_VGL - fault class selection (lamp / warning behaviour)" VALUE 0x70DF4 TKW_VV_VV_UB 100.0 FORMULA_0003 0.0 8.0000 /end CHARACTERISTIC
/begin CHARACTERISTIC K_ED_PCTRL_IGN.KLASSENINDEX "Auswahl der Fehlerklasse | EN: Fault code PCTRL_IGN - fault class selection (lamp / warning behaviour) [V912: differs from V452 160E]" VALUE 0x70E0E TKW_VV_VV_UB 100.0 FORMULA_0003 0.0 8.0000 /end CHARACTERISTIC
/begin CHARACTERISTIC K_ED_LLS1_CAN.KLASSENINDEX "Auswahl der Fehlerklasse | EN: Fault code LLS1_CAN - fault class selection (lamp / warning behaviour)" VALUE 0x70E28 TKW_VV_VV_UB 100.0 FORMULA_0003 0.0 8.0000 /end CHARACTERISTIC
/begin CHARACTERISTIC K_ED_LLS2_CAN.KLASSENINDEX "Auswahl der Fehlerklasse | EN: Fault code LLS2_CAN - fault class selection (lamp / warning behaviour)" VALUE 0x70E42 TKW_VV_VV_UB 100.0 FORMULA_0003 0.0 8.0000 /end CHARACTERISTIC
/begin CHARACTERISTIC K_ED_LLS1_SK.KLASSENINDEX "Auswahl der Fehlerklasse | EN: Fault code LLS1_SK - fault class selection (lamp / warning behaviour)" VALUE 0x70E90 TKW_VV_VV_UB 100.0 FORMULA_0003 0.0 8.0000 /end CHARACTERISTIC
/begin CHARACTERISTIC K_ED_LLS2_SK.KLASSENINDEX "Auswahl der Fehlerklasse | EN: Fault code LLS2_SK - fault class selection (lamp / warning behaviour)" VALUE 0x70EAA TKW_VV_VV_UB 100.0 FORMULA_0003 0.0 8.0000 /end CHARACTERISTIC
/begin CHARACTERISTIC K_ED_SMG_SCHALTAB.KLASSENINDEX "Auswahl der Fehlerklasse | EN: Fault code SMG_SCHALTAB - fault class selection (lamp / warning behaviour) [V912: differs from V452 160E]" VALUE 0x70EC4 TKW_VV_VV_UB 100.0 FORMULA_0003 0.0 8.0000 /end CHARACTERISTIC
/begin CHARACTERISTIC K_ED_SMG_SK.KLASSENINDEX "Auswahl der Fehlerklasse | EN: Fault code SMG_SK - fault class selection (lamp / warning behaviour) [V912: differs from V452 160E]" VALUE 0x70EDE TKW_VV_VV_UB 100.0 FORMULA_0003 0.0 8.0000 /end CHARACTERISTIC
/begin CHARACTERISTIC K_ED_SMG_SK_N.KLASSENINDEX "Auswahl der Fehlerklasse | EN: Fault code SMG_SK_N - fault class selection (lamp / warning behaviour) [V912: differs from V452 160E]" VALUE 0x70EF8 TKW_VV_VV_UB 100.0 FORMULA_0003 0.0 8.0000 /end CHARACTERISTIC
/begin CHARACTERISTIC K_ED_IONVERST_B1.KLASSENINDEX "Auswahl der Fehlerklasse" VALUE 0x70FC8 TKW_VV_VV_UB 100.0 FORMULA_0003 0.0 8.0000 /end CHARACTERISTIC
/begin CHARACTERISTIC K_ED_IONSPG_B1.KLASSENINDEX "Auswahl der Fehlerklasse" VALUE 0x70FE2 TKW_VV_VV_UB 100.0 FORMULA_0003 0.0 8.0000 /end CHARACTERISTIC
/begin CHARACTERISTIC K_ED_IONVERST_B2.KLASSENINDEX "Auswahl der Fehlerklasse" VALUE 0x70FFC TKW_VV_VV_UB 100.0 FORMULA_0003 0.0 8.0000 /end CHARACTERISTIC
/begin CHARACTERISTIC K_ED_IONSPG_B2.KLASSENINDEX "Auswahl der Fehlerklasse" VALUE 0x71016 TKW_VV_VV_UB 100.0 FORMULA_0003 0.0 8.0000 /end CHARACTERISTIC
/begin CHARACTERISTIC K_ED_TABG1.KLASSENINDEX "Auswahl der Fehlerklasse | EN: Fault code TABG1 - fault class selection (lamp / warning behaviour)" VALUE 0x71030 TKW_VV_VV_UB 100.0 FORMULA_0003 0.0 8.0000 /end CHARACTERISTIC
/begin CHARACTERISTIC K_ED_TABG2.KLASSENINDEX "Auswahl der Fehlerklasse | EN: Fault code TABG2 - fault class selection (lamp / warning behaviour)" VALUE 0x7104A TKW_VV_VV_UB 100.0 FORMULA_0003 0.0 8.0000 /end CHARACTERISTIC
/begin CHARACTERISTIC K_ED_LLS1_REGLER.KLASSENINDEX "Auswahl der Fehlerklasse | EN: Fault code LLS1_REGLER - fault class selection (lamp / warning behaviour)" VALUE 0x710CC TKW_VV_VV_UB 100.0 FORMULA_0003 0.0 8.0000 /end CHARACTERISTIC
/begin CHARACTERISTIC K_ED_LLS2_REGLER.KLASSENINDEX "Auswahl der Fehlerklasse | EN: Fault code LLS2_REGLER - fault class selection (lamp / warning behaviour)" VALUE 0x710E6 TKW_VV_VV_UB 100.0 FORMULA_0003 0.0 8.0000 /end CHARACTERISTIC
/begin CHARACTERISTIC K_ED_MD_SK_ERR.KLASSENINDEX "Auswahl der Fehlerklasse | EN: Fault code MD_SK_ERR - fault class selection (lamp / warning behaviour)" VALUE 0x71168 TKW_VV_VV_UB 100.0 FORMULA_0003 0.0 8.0000 /end CHARACTERISTIC
/begin CHARACTERISTIC K_ED_LLS_INIT.KLASSENINDEX "Auswahl der Fehlerklasse | EN: Fault code LLS_INIT - fault class selection (lamp / warning behaviour)" VALUE 0x71182 TKW_VV_VV_UB 100.0 FORMULA_0003 0.0 8.0000 /end CHARACTERISTIC
/begin CHARACTERISTIC K_ED_LLS1_CMD.KLASSENINDEX "Auswahl der Fehlerklasse | EN: Fault code LLS1_CMD - fault class selection (lamp / warning behaviour)" VALUE 0x711EA TKW_VV_VV_UB 100.0 FORMULA_0003 0.0 8.0000 /end CHARACTERISTIC
/begin CHARACTERISTIC K_ED_LLS2_CMD.KLASSENINDEX "Auswahl der Fehlerklasse | EN: Fault code LLS2_CMD - fault class selection (lamp / warning behaviour)" VALUE 0x71204 TKW_VV_VV_UB 100.0 FORMULA_0003 0.0 8.0000 /end CHARACTERISTIC
/begin CHARACTERISTIC K_ED_SC_SMG1.KLASSENINDEX "Auswahl der Fehlerklasse | EN: Fault code SC_SMG1 - fault class selection (lamp / warning behaviour) [V912: differs from V452 160E]" VALUE 0x7121E TKW_VV_VV_UB 100.0 FORMULA_0003 0.0 8.0000 /end CHARACTERISTIC
/begin CHARACTERISTIC K_ED_SC_SMG2.KLASSENINDEX "Auswahl der Fehlerklasse | EN: Fault code SC_SMG2 - fault class selection (lamp / warning behaviour) [V912: differs from V452 160E]" VALUE 0x71238 TKW_VV_VV_UB 100.0 FORMULA_0003 0.0 8.0000 /end CHARACTERISTIC
/begin CHARACTERISTIC K_ED_SC_SMG3.KLASSENINDEX "Auswahl der Fehlerklasse | EN: Fault code SC_SMG3 - fault class selection (lamp / warning behaviour) [V912: differs from V452 160E]" VALUE 0x71252 TKW_VV_VV_UB 100.0 FORMULA_0003 0.0 8.0000 /end CHARACTERISTIC
/begin CHARACTERISTIC K_ED_SC_BUSOFF.KLASSENINDEX "Auswahl der Fehlerklasse | EN: Fault code SC_BUSOFF - fault class selection (lamp / warning behaviour)" VALUE 0x7126C TKW_VV_VV_UB 100.0 FORMULA_0003 0.0 8.0000 /end CHARACTERISTIC
/begin CHARACTERISTIC K_ED_ION_SIG_B1.KLASSENINDEX "Auswahl der Fehlerklasse" VALUE 0x713A4 TKW_VV_VV_UB 100.0 FORMULA_0003 0.0 8.0000 /end CHARACTERISTIC
/begin CHARACTERISTIC K_ED_ION_SIG_B2.KLASSENINDEX "Auswahl der Fehlerklasse" VALUE 0x713BE TKW_VV_VV_UB 100.0 FORMULA_0003 0.0 8.0000 /end CHARACTERISTIC
/begin CHARACTERISTIC K_ED_ION_SAT_B1.KLASSENINDEX "Auswahl der Fehlerklasse" VALUE 0x714F6 TKW_VV_VV_UB 100.0 FORMULA_0003 0.0 8.0000 /end CHARACTERISTIC
/begin CHARACTERISTIC K_ED_ION_SAT_B2.KLASSENINDEX "Auswahl der Fehlerklasse" VALUE 0x71510 TKW_VV_VV_UB 100.0 FORMULA_0003 0.0 8.0000 /end CHARACTERISTIC
/begin CHARACTERISTIC K_ED_TAN_OBD_B1.KLASSENINDEX "Auswahl der Fehlerklasse | EN: Fault code TAN_OBD_B1 - fault class selection (lamp / warning behaviour) [V912: differs from V452 160E]" VALUE 0x71544 TKW_VV_VV_UB 100.0 FORMULA_0003 0.0 8.0000 /end CHARACTERISTIC
/begin CHARACTERISTIC K_ED_INDEX_88_IGN.KLASSENINDEX "Auswahl der Fehlerklasse | EN: Auswahl der Fehlerklasse" VALUE 0x7155E TKW_VV_VV_UB 100.0 FORMULA_0003 0.0 8.0000 /end CHARACTERISTIC
/begin CHARACTERISTIC K_ED_INDEX_89_IGN.KLASSENINDEX "Auswahl der Fehlerklasse" VALUE 0x71578 TKW_VV_VV_UB 100.0 FORMULA_0003 0.0 8.0000 /end CHARACTERISTIC
/begin CHARACTERISTIC K_ED_SG_IGN.KLASSENINDEX "Auswahl der Fehlerklasse | EN: Fault code SG_IGN - fault class selection (lamp / warning behaviour)" VALUE 0x715C6 TKW_VV_VV_UB 100.0 FORMULA_0003 0.0 8.0000 /end CHARACTERISTIC
/begin CHARACTERISTIC K_ED_SK_MANAGER_IGN.KLASSENINDEX "Auswahl der Fehlerklasse | EN: Fault code SK_MANAGER_IGN - fault class selection (lamp / warning behaviour)" VALUE 0x71614 TKW_VV_VV_UB 100.0 FORMULA_0003 0.0 8.0000 /end CHARACTERISTIC
/begin CHARACTERISTIC K_ED_LLR_DIAG.KLASSENINDEX "Auswahl der Fehlerklasse | EN: Fault code LLR_DIAG - fault class selection (lamp / warning behaviour)" VALUE 0x7162E TKW_VV_VV_UB 100.0 FORMULA_0003 0.0 8.0000 /end CHARACTERISTIC
/begin CHARACTERISTIC K_ED_THERMOSTAT.KLASSENINDEX "Auswahl der Fehlerklasse | EN: Fault code THERMOSTAT - fault class selection (lamp / warning behaviour) [V912: differs from V452 160E]" VALUE 0x71648 TKW_VV_VV_UB 100.0 FORMULA_0003 0.0 8.0000 /end CHARACTERISTIC
/begin CHARACTERISTIC K_ED_TAN_OBD_B2.KLASSENINDEX "Auswahl der Fehlerklasse | EN: Fault code TAN_OBD_B2 - fault class selection (lamp / warning behaviour) [V912: differs from V452 160E]" VALUE 0x71662 TKW_VV_VV_UB 100.0 FORMULA_0003 0.0 8.0000 /end CHARACTERISTIC
/begin CHARACTERISTIC K_ED_PWG_BLS.KLASSENINDEX "Auswahl der Fehlerklasse | EN: Fault code PWG_BLS - fault class selection (lamp / warning behaviour)" VALUE 0x716CA TKW_VV_VV_UB 100.0 FORMULA_0003 0.0 8.0000 /end CHARACTERISTIC
/begin CHARACTERISTIC K_ED_START_RL.KLASSENINDEX "Auswahl der Fehlerklasse | EN: Fault code START_RL - fault class selection (lamp / warning behaviour)" VALUE 0x716E4 TKW_VV_VV_UB 100.0 FORMULA_0003 0.0 8.0000 /end CHARACTERISTIC
/begin CHARACTERISTIC K_ED_N_GETR_EIN_HS.KLASSENINDEX "Auswahl der Fehlerklasse | EN: Fault code N_GETR_EIN_HS - fault class selection (lamp / warning behaviour)" VALUE 0x71718 TKW_VV_VV_UB 100.0 FORMULA_0003 0.0 8.0000 /end CHARACTERISTIC
/begin CHARACTERISTIC K_ED_LLR_DIAG_CSS.KLASSENINDEX "Auswahl der Fehlerklasse | EN: Fault code LLR_DIAG_CSS - fault class selection (lamp / warning behaviour) [V912: differs from V452 160E]" VALUE 0x7174C TKW_VV_VV_UB 100.0 FORMULA_0003 0.0 8.0000 /end CHARACTERISTIC
/begin CHARACTERISTIC K_ED_TMOT_OBD_HIGH.KLASSENINDEX "Auswahl der Fehlerklasse | EN: Fault code TMOT_OBD_HIGH - fault class selection (lamp / warning behaviour) [V912: differs from V452 160E]" VALUE 0x71766 TKW_VV_VV_UB 100.0 FORMULA_0003 0.0 8.0000 /end CHARACTERISTIC
/begin CHARACTERISTIC K_ED_INDEX_122_IGN.KLASSENINDEX "Auswahl der Fehlerklasse | EN: Fault code INDEX_122_IGN - fault class selection (lamp / warning behaviour)" VALUE 0x718D2 TKW_VV_VV_UB 100.0 FORMULA_0003 0.0 8.0000 /end CHARACTERISTIC
/begin CHARACTERISTIC K_ED_INDEX_123_IGN.KLASSENINDEX "Auswahl der Fehlerklasse | EN: Fault code INDEX_123_IGN - fault class selection (lamp / warning behaviour)" VALUE 0x718EC TKW_VV_VV_UB 100.0 FORMULA_0003 0.0 8.0000 /end CHARACTERISTIC
/begin CHARACTERISTIC K_ED_INDEX_124_IGN.KLASSENINDEX "Auswahl der Fehlerklasse | EN: Fault code INDEX_124_IGN - fault class selection (lamp / warning behaviour)" VALUE 0x71906 TKW_VV_VV_UB 100.0 FORMULA_0003 0.0 8.0000 /end CHARACTERISTIC
/begin CHARACTERISTIC K_ED_INDEX_125_IGN.KLASSENINDEX "Auswahl der Fehlerklasse | EN: Fault code INDEX_125_IGN - fault class selection (lamp / warning behaviour)" VALUE 0x71920 TKW_VV_VV_UB 100.0 FORMULA_0003 0.0 8.0000 /end CHARACTERISTIC
/begin CHARACTERISTIC K_ED_INDEX_126_IGN.KLASSENINDEX "Auswahl der Fehlerklasse | EN: Fault code INDEX_126_IGN - fault class selection (lamp / warning behaviour)" VALUE 0x7193A TKW_VV_VV_UB 100.0 FORMULA_0003 0.0 8.0000 /end CHARACTERISTIC
/begin CHARACTERISTIC K_ED_INDEX_127_IGN.KLASSENINDEX "Auswahl der Fehlerklasse | EN: Fault code INDEX_127_IGN - fault class selection (lamp / warning behaviour)" VALUE 0x71954 TKW_VV_VV_UB 100.0 FORMULA_0003 0.0 8.0000 /end CHARACTERISTIC
/begin FUNCTION Eigendiagnose ""
 /begin DEF_CHARACTERISTIC K_ED_INDEX_121_IGN.OK_SCHWELLE K_ED_INDEX_121_IGN.P_CODE_OPENLOAD K_ED_INDEX_121_IGN.P_CODE_SH_TO_GND K_ED_INDEX_121_IGN.P_CODE_SH_TO_UB K_ED_INDEX_121_IGN.P_CODE_UNPLAUSIBEL K_ED_INDEX_122_IGN.DEC_NACH_EINTRAG K_ED_INDEX_122_IGN.DEC_VOR_EINTRAG K_ED_INDEX_122_IGN.FEHLERSCHWELLE K_ED_INDEX_122_IGN.INC_NACH_EINTRAG K_ED_INDEX_122_IGN.INC_VOR_EINTRAG K_ED_INDEX_122_IGN.KLASSENINDEX K_ED_INDEX_122_IGN.OK_SCHWELLE K_ED_INDEX_122_IGN.P_CODE_OPENLOAD K_ED_INDEX_122_IGN.P_CODE_SH_TO_GND K_ED_INDEX_122_IGN.P_CODE_SH_TO_UB K_ED_INDEX_122_IGN.P_CODE_UNPLAUSIBEL K_ED_INDEX_123_IGN.DEC_NACH_EINTRAG K_ED_INDEX_123_IGN.DEC_VOR_EINTRAG K_ED_INDEX_123_IGN.FEHLERSCHWELLE K_ED_INDEX_123_IGN.INC_NACH_EINTRAG K_ED_INDEX_123_IGN.INC_VOR_EINTRAG K_ED_INDEX_123_IGN.KLASSENINDEX K_ED_INDEX_123_IGN.OK_SCHWELLE K_ED_INDEX_123_IGN.P_CODE_OPENLOAD K_ED_INDEX_123_IGN.P_CODE_SH_TO_GND K_ED_INDEX_123_IGN.P_CODE_SH_TO_UB K_ED_INDEX_123_IGN.P_CODE_UNPLAUSIBEL K_ED_INDEX_124_IGN.DEC_NACH_EINTRAG K_ED_INDEX_124_IGN.DEC_VOR_EINTRAG K_ED_INDEX_124_IGN.FEHLERSCHWELLE K_ED_INDEX_124_IGN.INC_NACH_EINTRAG K_ED_INDEX_124_IGN.INC_VOR_EINTRAG K_ED_INDEX_124_IGN.KLASSENINDEX K_ED_INDEX_124_IGN.OK_SCHWELLE K_ED_INDEX_124_IGN.P_CODE_OPENLOAD K_ED_INDEX_124_IGN.P_CODE_SH_TO_GND K_ED_INDEX_124_IGN.P_CODE_SH_TO_UB K_ED_INDEX_124_IGN.P_CODE_UNPLAUSIBEL K_ED_INDEX_125_IGN.DEC_NACH_EINTRAG K_ED_INDEX_125_IGN.DEC_VOR_EINTRAG K_ED_INDEX_125_IGN.FEHLERSCHWELLE K_ED_INDEX_125_IGN.INC_NACH_EINTRAG K_ED_INDEX_125_IGN.INC_VOR_EINTRAG K_ED_INDEX_125_IGN.KLASSENINDEX K_ED_INDEX_125_IGN.OK_SCHWELLE K_ED_INDEX_125_IGN.P_CODE_OPENLOAD K_ED_INDEX_125_IGN.P_CODE_SH_TO_GND K_ED_INDEX_125_IGN.P_CODE_SH_TO_UB K_ED_INDEX_125_IGN.P_CODE_UNPLAUSIBEL K_ED_INDEX_126_IGN.DEC_NACH_EINTRAG K_ED_INDEX_126_IGN.DEC_VOR_EINTRAG K_ED_INDEX_126_IGN.FEHLERSCHWELLE K_ED_INDEX_126_IGN.INC_NACH_EINTRAG K_ED_INDEX_126_IGN.INC_VOR_EINTRAG K_ED_INDEX_126_IGN.KLASSENINDEX K_ED_INDEX_126_IGN.OK_SCHWELLE K_ED_INDEX_126_IGN.P_CODE_OPENLOAD K_ED_INDEX_126_IGN.P_CODE_SH_TO_GND K_ED_INDEX_126_IGN.P_CODE_SH_TO_UB K_ED_INDEX_126_IGN.P_CODE_UNPLAUSIBEL K_ED_INDEX_127_IGN.DEC_NACH_EINTRAG K_ED_INDEX_127_IGN.DEC_VOR_EINTRAG K_ED_INDEX_127_IGN.FEHLERSCHWELLE K_ED_INDEX_127_IGN.INC_NACH_EINTRAG K_ED_INDEX_127_IGN.INC_VOR_EINTRAG K_ED_INDEX_127_IGN.KLASSENINDEX K_ED_INDEX_127_IGN.OK_SCHWELLE K_ED_INDEX_127_IGN.P_CODE_OPENLOAD K_ED_INDEX_127_IGN.P_CODE_SH_TO_GND K_ED_INDEX_127_IGN.P_CODE_SH_TO_UB K_ED_INDEX_127_IGN.P_CODE_UNPLAUSIBEL K_ED_INDEX_88_IGN.DEC_NACH_EINTRAG K_ED_INDEX_88_IGN.DEC_VOR_EINTRAG K_ED_INDEX_88_IGN.FEHLERSCHWELLE K_ED_INDEX_88_IGN.INC_NACH_EINTRAG K_ED_INDEX_88_IGN.INC_VOR_EINTRAG K_ED_INDEX_88_IGN.KLASSENINDEX K_ED_INDEX_88_IGN.OK_SCHWELLE K_ED_INDEX_88_IGN.P_CODE_OPENLOAD K_ED_INDEX_88_IGN.P_CODE_SH_TO_GND K_ED_INDEX_88_IGN.P_CODE_SH_TO_UB K_ED_INDEX_88_IGN.P_CODE_UNPLAUSIBEL K_ED_INDEX_89_IGN.DEC_NACH_EINTRAG K_ED_INDEX_89_IGN.DEC_VOR_EINTRAG K_ED_INDEX_89_IGN.FEHLERSCHWELLE K_ED_INDEX_89_IGN.INC_NACH_EINTRAG K_ED_INDEX_89_IGN.INC_VOR_EINTRAG K_ED_INDEX_89_IGN.KLASSENINDEX K_ED_INDEX_89_IGN.OK_SCHWELLE K_ED_INDEX_89_IGN.P_CODE_OPENLOAD K_ED_INDEX_89_IGN.P_CODE_SH_TO_GND K_ED_INDEX_89_IGN.P_CODE_SH_TO_UB K_ED_INDEX_89_IGN.P_CODE_UNPLAUSIBEL K_ED_IONSPG_B1.DEC_NACH_EINTRAG K_ED_IONSPG_B1.DEC_VOR_EINTRAG K_ED_IONSPG_B1.FEHLERSCHWELLE K_ED_IONSPG_B1.INC_NACH_EINTRAG K_ED_IONSPG_B1.INC_VOR_EINTRAG K_ED_IONSPG_B1.KLASSENINDEX K_ED_IONSPG_B1.OK_SCHWELLE K_ED_IONSPG_B1.P_CODE_OPENLOAD K_ED_IONSPG_B1.P_CODE_SH_TO_GND K_ED_IONSPG_B1.P_CODE_SH_TO_UB K_ED_IONSPG_B1.P_CODE_UNPLAUSIBEL K_ED_IONSPG_B2.DEC_NACH_EINTRAG K_ED_IONSPG_B2.DEC_VOR_EINTRAG K_ED_IONSPG_B2.FEHLERSCHWELLE K_ED_IONSPG_B2.INC_NACH_EINTRAG K_ED_IONSPG_B2.INC_VOR_EINTRAG K_ED_IONSPG_B2.KLASSENINDEX K_ED_IONSPG_B2.OK_SCHWELLE K_ED_IONSPG_B2.P_CODE_OPENLOAD K_ED_IONSPG_B2.P_CODE_SH_TO_GND K_ED_IONSPG_B2.P_CODE_SH_TO_UB K_ED_IONSPG_B2.P_CODE_UNPLAUSIBEL K_ED_IONVERST_B1.DEC_NACH_EINTRAG K_ED_IONVERST_B1.DEC_VOR_EINTRAG K_ED_IONVERST_B1.FEHLERSCHWELLE K_ED_IONVERST_B1.INC_NACH_EINTRAG K_ED_IONVERST_B1.INC_VOR_EINTRAG K_ED_IONVERST_B1.KLASSENINDEX K_ED_IONVERST_B1.OK_SCHWELLE K_ED_IONVERST_B1.P_CODE_OPENLOAD K_ED_IONVERST_B1.P_CODE_SH_TO_GND K_ED_IONVERST_B1.P_CODE_SH_TO_UB K_ED_IONVERST_B1.P_CODE_UNPLAUSIBEL K_ED_IONVERST_B2.DEC_NACH_EINTRAG K_ED_IONVERST_B2.DEC_VOR_EINTRAG K_ED_IONVERST_B2.FEHLERSCHWELLE K_ED_IONVERST_B2.INC_NACH_EINTRAG K_ED_IONVERST_B2.INC_VOR_EINTRAG K_ED_IONVERST_B2.KLASSENINDEX K_ED_IONVERST_B2.OK_SCHWELLE K_ED_IONVERST_B2.P_CODE_OPENLOAD K_ED_IONVERST_B2.P_CODE_SH_TO_GND K_ED_IONVERST_B2.P_CODE_SH_TO_UB K_ED_IONVERST_B2.P_CODE_UNPLAUSIBEL K_ED_ION_SAT_B1.DEC_NACH_EINTRAG K_ED_ION_SAT_B1.DEC_VOR_EINTRAG K_ED_ION_SAT_B1.FEHLERSCHWELLE K_ED_ION_SAT_B1.INC_NACH_EINTRAG K_ED_ION_SAT_B1.INC_VOR_EINTRAG K_ED_ION_SAT_B1.KLASSENINDEX K_ED_ION_SAT_B1.OK_SCHWELLE K_ED_ION_SAT_B1.P_CODE_OPENLOAD K_ED_ION_SAT_B1.P_CODE_SH_TO_GND K_ED_ION_SAT_B1.P_CODE_SH_TO_UB K_ED_ION_SAT_B1.P_CODE_UNPLAUSIBEL K_ED_ION_SAT_B2.DEC_NACH_EINTRAG K_ED_ION_SAT_B2.DEC_VOR_EINTRAG K_ED_ION_SAT_B2.FEHLERSCHWELLE K_ED_ION_SAT_B2.INC_NACH_EINTRAG K_ED_ION_SAT_B2.INC_VOR_EINTRAG K_ED_ION_SAT_B2.KLASSENINDEX K_ED_ION_SAT_B2.OK_SCHWELLE K_ED_ION_SAT_B2.P_CODE_OPENLOAD K_ED_ION_SAT_B2.P_CODE_SH_TO_GND K_ED_ION_SAT_B2.P_CODE_SH_TO_UB K_ED_ION_SAT_B2.P_CODE_UNPLAUSIBEL K_ED_ION_SIG_B1.DEC_NACH_EINTRAG K_ED_ION_SIG_B1.DEC_VOR_EINTRAG K_ED_ION_SIG_B1.FEHLERSCHWELLE K_ED_ION_SIG_B1.INC_NACH_EINTRAG K_ED_ION_SIG_B1.INC_VOR_EINTRAG K_ED_ION_SIG_B1.KLASSENINDEX K_ED_ION_SIG_B1.OK_SCHWELLE K_ED_ION_SIG_B1.P_CODE_OPENLOAD K_ED_ION_SIG_B1.P_CODE_SH_TO_GND K_ED_ION_SIG_B1.P_CODE_SH_TO_UB K_ED_ION_SIG_B1.P_CODE_UNPLAUSIBEL K_ED_ION_SIG_B2.DEC_NACH_EINTRAG K_ED_ION_SIG_B2.DEC_VOR_EINTRAG K_ED_ION_SIG_B2.FEHLERSCHWELLE K_ED_ION_SIG_B2.INC_NACH_EINTRAG K_ED_ION_SIG_B2.INC_VOR_EINTRAG K_ED_ION_SIG_B2.KLASSENINDEX K_ED_ION_SIG_B2.OK_SCHWELLE K_ED_ION_SIG_B2.P_CODE_OPENLOAD K_ED_ION_SIG_B2.P_CODE_SH_TO_GND K_ED_ION_SIG_B2.P_CODE_SH_TO_UB K_ED_ION_SIG_B2.P_CODE_UNPLAUSIBEL K_ED_LLR_DIAG.DEC_NACH_EINTRAG K_ED_LLR_DIAG.DEC_VOR_EINTRAG K_ED_LLR_DIAG.FEHLERSCHWELLE K_ED_LLR_DIAG.INC_NACH_EINTRAG K_ED_LLR_DIAG.INC_VOR_EINTRAG K_ED_LLR_DIAG.KLASSENINDEX K_ED_LLR_DIAG.OK_SCHWELLE K_ED_LLR_DIAG.P_CODE_OPENLOAD K_ED_LLR_DIAG.P_CODE_SH_TO_GND K_ED_LLR_DIAG.P_CODE_SH_TO_UB K_ED_LLR_DIAG.P_CODE_UNPLAUSIBEL K_ED_LLR_DIAG_CSS.DEC_NACH_EINTRAG K_ED_LLR_DIAG_CSS.DEC_VOR_EINTRAG K_ED_LLR_DIAG_CSS.FEHLERSCHWELLE K_ED_LLR_DIAG_CSS.INC_NACH_EINTRAG K_ED_LLR_DIAG_CSS.INC_VOR_EINTRAG K_ED_LLR_DIAG_CSS.KLASSENINDEX K_ED_LLR_DIAG_CSS.OK_SCHWELLE K_ED_LLR_DIAG_CSS.P_CODE_OPENLOAD K_ED_LLR_DIAG_CSS.P_CODE_SH_TO_GND K_ED_LLR_DIAG_CSS.P_CODE_SH_TO_UB K_ED_LLR_DIAG_CSS.P_CODE_UNPLAUSIBEL K_ED_LLS1_CAN.DEC_NACH_EINTRAG K_ED_LLS1_CAN.DEC_VOR_EINTRAG K_ED_LLS1_CAN.FEHLERSCHWELLE K_ED_LLS1_CAN.INC_NACH_EINTRAG K_ED_LLS1_CAN.INC_VOR_EINTRAG K_ED_LLS1_CAN.KLASSENINDEX K_ED_LLS1_CAN.OK_SCHWELLE K_ED_LLS1_CAN.P_CODE_OPENLOAD K_ED_LLS1_CAN.P_CODE_SH_TO_GND K_ED_LLS1_CAN.P_CODE_SH_TO_UB K_ED_LLS1_CAN.P_CODE_UNPLAUSIBEL K_ED_LLS1_CMD.DEC_NACH_EINTRAG K_ED_LLS1_CMD.DEC_VOR_EINTRAG K_ED_LLS1_CMD.FEHLERSCHWELLE K_ED_LLS1_CMD.INC_NACH_EINTRAG K_ED_LLS1_CMD.INC_VOR_EINTRAG K_ED_LLS1_CMD.KLASSENINDEX K_ED_LLS1_CMD.OK_SCHWELLE K_ED_LLS1_CMD.P_CODE_OPENLOAD K_ED_LLS1_CMD.P_CODE_SH_TO_GND K_ED_LLS1_CMD.P_CODE_SH_TO_UB K_ED_LLS1_CMD.P_CODE_UNPLAUSIBEL K_ED_LLS1_REGLER.DEC_NACH_EINTRAG K_ED_LLS1_REGLER.DEC_VOR_EINTRAG K_ED_LLS1_REGLER.FEHLERSCHWELLE K_ED_LLS1_REGLER.INC_NACH_EINTRAG K_ED_LLS1_REGLER.INC_VOR_EINTRAG K_ED_LLS1_REGLER.KLASSENINDEX K_ED_LLS1_REGLER.OK_SCHWELLE K_ED_LLS1_REGLER.P_CODE_OPENLOAD K_ED_LLS1_REGLER.P_CODE_SH_TO_GND K_ED_LLS1_REGLER.P_CODE_SH_TO_UB K_ED_LLS1_REGLER.P_CODE_UNPLAUSIBEL K_ED_LLS1_SK.DEC_NACH_EINTRAG K_ED_LLS1_SK.DEC_VOR_EINTRAG K_ED_LLS1_SK.FEHLERSCHWELLE K_ED_LLS1_SK.INC_NACH_EINTRAG K_ED_LLS1_SK.INC_VOR_EINTRAG K_ED_LLS1_SK.KLASSENINDEX K_ED_LLS1_SK.OK_SCHWELLE K_ED_LLS1_SK.P_CODE_OPENLOAD K_ED_LLS1_SK.P_CODE_SH_TO_GND K_ED_LLS1_SK.P_CODE_SH_TO_UB K_ED_LLS1_SK.P_CODE_UNPLAUSIBEL K_ED_LLS2_CAN.DEC_NACH_EINTRAG K_ED_LLS2_CAN.DEC_VOR_EINTRAG K_ED_LLS2_CAN.FEHLERSCHWELLE K_ED_LLS2_CAN.INC_NACH_EINTRAG K_ED_LLS2_CAN.INC_VOR_EINTRAG K_ED_LLS2_CAN.KLASSENINDEX K_ED_LLS2_CAN.OK_SCHWELLE K_ED_LLS2_CAN.P_CODE_OPENLOAD K_ED_LLS2_CAN.P_CODE_SH_TO_GND K_ED_LLS2_CAN.P_CODE_SH_TO_UB K_ED_LLS2_CAN.P_CODE_UNPLAUSIBEL K_ED_LLS2_CMD.DEC_NACH_EINTRAG K_ED_LLS2_CMD.DEC_VOR_EINTRAG K_ED_LLS2_CMD.FEHLERSCHWELLE K_ED_LLS2_CMD.INC_NACH_EINTRAG K_ED_LLS2_CMD.INC_VOR_EINTRAG K_ED_LLS2_CMD.KLASSENINDEX K_ED_LLS2_CMD.OK_SCHWELLE K_ED_LLS2_CMD.P_CODE_OPENLOAD K_ED_LLS2_CMD.P_CODE_SH_TO_GND K_ED_LLS2_CMD.P_CODE_SH_TO_UB K_ED_LLS2_CMD.P_CODE_UNPLAUSIBEL K_ED_LLS2_REGLER.DEC_NACH_EINTRAG K_ED_LLS2_REGLER.DEC_VOR_EINTRAG K_ED_LLS2_REGLER.FEHLERSCHWELLE K_ED_LLS2_REGLER.INC_NACH_EINTRAG K_ED_LLS2_REGLER.INC_VOR_EINTRAG K_ED_LLS2_REGLER.KLASSENINDEX K_ED_LLS2_REGLER.OK_SCHWELLE K_ED_LLS2_REGLER.P_CODE_OPENLOAD K_ED_LLS2_REGLER.P_CODE_SH_TO_GND K_ED_LLS2_REGLER.P_CODE_SH_TO_UB K_ED_LLS2_REGLER.P_CODE_UNPLAUSIBEL K_ED_LLS2_SK.DEC_NACH_EINTRAG K_ED_LLS2_SK.DEC_VOR_EINTRAG K_ED_LLS2_SK.FEHLERSCHWELLE K_ED_LLS2_SK.INC_NACH_EINTRAG K_ED_LLS2_SK.INC_VOR_EINTRAG K_ED_LLS2_SK.KLASSENINDEX K_ED_LLS2_SK.OK_SCHWELLE K_ED_LLS2_SK.P_CODE_OPENLOAD K_ED_LLS2_SK.P_CODE_SH_TO_GND K_ED_LLS2_SK.P_CODE_SH_TO_UB K_ED_LLS2_SK.P_CODE_UNPLAUSIBEL K_ED_LLS_INIT.DEC_NACH_EINTRAG K_ED_LLS_INIT.DEC_VOR_EINTRAG K_ED_LLS_INIT.FEHLERSCHWELLE K_ED_LLS_INIT.INC_NACH_EINTRAG K_ED_LLS_INIT.INC_VOR_EINTRAG K_ED_LLS_INIT.KLASSENINDEX K_ED_LLS_INIT.OK_SCHWELLE K_ED_LLS_INIT.P_CODE_OPENLOAD K_ED_LLS_INIT.P_CODE_SH_TO_GND K_ED_LLS_INIT.P_CODE_SH_TO_UB K_ED_LLS_INIT.P_CODE_UNPLAUSIBEL K_ED_MD_SK_ERR.DEC_NACH_EINTRAG K_ED_MD_SK_ERR.DEC_VOR_EINTRAG K_ED_MD_SK_ERR.FEHLERSCHWELLE K_ED_MD_SK_ERR.INC_NACH_EINTRAG K_ED_MD_SK_ERR.INC_VOR_EINTRAG K_ED_MD_SK_ERR.KLASSENINDEX K_ED_MD_SK_ERR.OK_SCHWELLE K_ED_MD_SK_ERR.P_CODE_OPENLOAD K_ED_MD_SK_ERR.P_CODE_SH_TO_GND K_ED_MD_SK_ERR.P_CODE_SH_TO_UB K_ED_MD_SK_ERR.P_CODE_UNPLAUSIBEL K_ED_N_GETR_EIN_HS.DEC_NACH_EINTRAG K_ED_N_GETR_EIN_HS.DEC_VOR_EINTRAG K_ED_N_GETR_EIN_HS.FEHLERSCHWELLE K_ED_N_GETR_EIN_HS.INC_NACH_EINTRAG K_ED_N_GETR_EIN_HS.INC_VOR_EINTRAG K_ED_N_GETR_EIN_HS.KLASSENINDEX K_ED_N_GETR_EIN_HS.OK_SCHWELLE K_ED_N_GETR_EIN_HS.P_CODE_OPENLOAD K_ED_N_GETR_EIN_HS.P_CODE_SH_TO_GND K_ED_N_GETR_EIN_HS.P_CODE_SH_TO_UB K_ED_N_GETR_EIN_HS.P_CODE_UNPLAUSIBEL K_ED_PCTRL_IGN.DEC_NACH_EINTRAG K_ED_PCTRL_IGN.DEC_VOR_EINTRAG K_ED_PCTRL_IGN.FEHLERSCHWELLE K_ED_PCTRL_IGN.INC_NACH_EINTRAG K_ED_PCTRL_IGN.INC_VOR_EINTRAG K_ED_PCTRL_IGN.KLASSENINDEX K_ED_PCTRL_IGN.OK_SCHWELLE K_ED_PCTRL_IGN.P_CODE_OPENLOAD K_ED_PCTRL_IGN.P_CODE_SH_TO_GND K_ED_PCTRL_IGN.P_CODE_SH_TO_UB K_ED_PCTRL_IGN.P_CODE_UNPLAUSIBEL K_ED_PWG1.DEC_NACH_EINTRAG K_ED_PWG1.DEC_VOR_EINTRAG K_ED_PWG1.FEHLERSCHWELLE K_ED_PWG1.INC_NACH_EINTRAG K_ED_PWG1.INC_VOR_EINTRAG K_ED_PWG1.KLASSENINDEX K_ED_PWG1.OK_SCHWELLE K_ED_PWG1.P_CODE_OPENLOAD K_ED_PWG1.P_CODE_SH_TO_GND K_ED_PWG1.P_CODE_SH_TO_UB K_ED_PWG1.P_CODE_UNPLAUSIBEL K_ED_PWG2.DEC_NACH_EINTRAG K_ED_PWG2.DEC_VOR_EINTRAG K_ED_PWG2.FEHLERSCHWELLE K_ED_PWG2.INC_NACH_EINTRAG K_ED_PWG2.INC_VOR_EINTRAG K_ED_PWG2.KLASSENINDEX K_ED_PWG2.OK_SCHWELLE K_ED_PWG2.P_CODE_OPENLOAD K_ED_PWG2.P_CODE_SH_TO_GND K_ED_PWG2.P_CODE_SH_TO_UB K_ED_PWG2.P_CODE_UNPLAUSIBEL K_ED_PWG_BLS.DEC_NACH_EINTRAG K_ED_PWG_BLS.DEC_VOR_EINTRAG K_ED_PWG_BLS.FEHLERSCHWELLE K_ED_PWG_BLS.INC_NACH_EINTRAG K_ED_PWG_BLS.INC_VOR_EINTRAG K_ED_PWG_BLS.KLASSENINDEX K_ED_PWG_BLS.OK_SCHWELLE K_ED_PWG_BLS.P_CODE_OPENLOAD K_ED_PWG_BLS.P_CODE_SH_TO_GND K_ED_PWG_BLS.P_CODE_SH_TO_UB K_ED_PWG_BLS.P_CODE_UNPLAUSIBEL K_ED_PWG_VGL.DEC_NACH_EINTRAG K_ED_PWG_VGL.DEC_VOR_EINTRAG K_ED_PWG_VGL.FEHLERSCHWELLE K_ED_PWG_VGL.INC_NACH_EINTRAG K_ED_PWG_VGL.INC_VOR_EINTRAG K_ED_PWG_VGL.KLASSENINDEX K_ED_PWG_VGL.OK_SCHWELLE K_ED_PWG_VGL.P_CODE_OPENLOAD K_ED_PWG_VGL.P_CODE_SH_TO_GND K_ED_PWG_VGL.P_CODE_SH_TO_UB K_ED_PWG_VGL.P_CODE_UNPLAUSIBEL K_ED_RBM_EVAP_MAX K_ED_RBM_EVAP_MIN K_ED_RBM_EVAP_TEMP_DELTA K_ED_RBM_PUMG_MIN K_ED_RBM_TIME K_ED_RBM_TIME_LL K_ED_RBM_TIME_V K_ED_RBM_TUMG_MIN K_ED_RBM_V_MIN K_ED_SCDN_ABDECKUNG_AUSTRAG K_ED_SCDN_ABDECKUNG_EINTRAG K_ED_SC_BUSOFF.DEC_NACH_EINTRAG K_ED_SC_BUSOFF.DEC_VOR_EINTRAG K_ED_SC_BUSOFF.FEHLERSCHWELLE K_ED_SC_BUSOFF.INC_NACH_EINTRAG K_ED_SC_BUSOFF.INC_VOR_EINTRAG K_ED_SC_BUSOFF.KLASSENINDEX K_ED_SC_BUSOFF.OK_SCHWELLE K_ED_SC_BUSOFF.P_CODE_OPENLOAD K_ED_SC_BUSOFF.P_CODE_SH_TO_GND K_ED_SC_BUSOFF.P_CODE_SH_TO_UB K_ED_SC_BUSOFF.P_CODE_UNPLAUSIBEL K_ED_SC_SMG1.DEC_NACH_EINTRAG K_ED_SC_SMG1.DEC_VOR_EINTRAG K_ED_SC_SMG1.FEHLERSCHWELLE K_ED_SC_SMG1.INC_NACH_EINTRAG K_ED_SC_SMG1.INC_VOR_EINTRAG K_ED_SC_SMG1.KLASSENINDEX K_ED_SC_SMG1.OK_SCHWELLE K_ED_SC_SMG1.P_CODE_OPENLOAD K_ED_SC_SMG1.P_CODE_SH_TO_GND K_ED_SC_SMG1.P_CODE_SH_TO_UB K_ED_SC_SMG1.P_CODE_UNPLAUSIBEL K_ED_SC_SMG2.DEC_NACH_EINTRAG K_ED_SC_SMG2.DEC_VOR_EINTRAG K_ED_SC_SMG2.FEHLERSCHWELLE K_ED_SC_SMG2.INC_NACH_EINTRAG K_ED_SC_SMG2.INC_VOR_EINTRAG K_ED_SC_SMG2.KLASSENINDEX K_ED_SC_SMG2.OK_SCHWELLE K_ED_SC_SMG2.P_CODE_OPENLOAD K_ED_SC_SMG2.P_CODE_SH_TO_GND K_ED_SC_SMG2.P_CODE_SH_TO_UB K_ED_SC_SMG2.P_CODE_UNPLAUSIBEL K_ED_SC_SMG3.DEC_NACH_EINTRAG K_ED_SC_SMG3.DEC_VOR_EINTRAG K_ED_SC_SMG3.FEHLERSCHWELLE K_ED_SC_SMG3.INC_NACH_EINTRAG K_ED_SC_SMG3.INC_VOR_EINTRAG K_ED_SC_SMG3.KLASSENINDEX K_ED_SC_SMG3.OK_SCHWELLE K_ED_SC_SMG3.P_CODE_OPENLOAD K_ED_SC_SMG3.P_CODE_SH_TO_GND K_ED_SC_SMG3.P_CODE_SH_TO_UB K_ED_SC_SMG3.P_CODE_UNPLAUSIBEL K_ED_SG_IGN.DEC_NACH_EINTRAG K_ED_SG_IGN.DEC_VOR_EINTRAG K_ED_SG_IGN.FEHLERSCHWELLE K_ED_SG_IGN.INC_NACH_EINTRAG K_ED_SG_IGN.INC_VOR_EINTRAG K_ED_SG_IGN.KLASSENINDEX K_ED_SG_IGN.OK_SCHWELLE K_ED_SG_IGN.P_CODE_OPENLOAD K_ED_SG_IGN.P_CODE_SH_TO_GND K_ED_SG_IGN.P_CODE_SH_TO_UB K_ED_SG_IGN.P_CODE_UNPLAUSIBEL K_ED_SK_MANAGER_IGN.DEC_NACH_EINTRAG K_ED_SK_MANAGER_IGN.DEC_VOR_EINTRAG K_ED_SK_MANAGER_IGN.FEHLERSCHWELLE K_ED_SK_MANAGER_IGN.INC_NACH_EINTRAG K_ED_SK_MANAGER_IGN.INC_VOR_EINTRAG K_ED_SK_MANAGER_IGN.KLASSENINDEX K_ED_SK_MANAGER_IGN.OK_SCHWELLE K_ED_SK_MANAGER_IGN.P_CODE_OPENLOAD K_ED_SK_MANAGER_IGN.P_CODE_SH_TO_GND K_ED_SK_MANAGER_IGN.P_CODE_SH_TO_UB K_ED_SK_MANAGER_IGN.P_CODE_UNPLAUSIBEL K_ED_SK_TR_IGN.DEC_NACH_EINTRAG K_ED_SK_TR_IGN.DEC_VOR_EINTRAG K_ED_SK_TR_IGN.FEHLERSCHWELLE K_ED_SK_TR_IGN.INC_NACH_EINTRAG K_ED_SK_TR_IGN.INC_VOR_EINTRAG K_ED_SK_TR_IGN.KLASSENINDEX K_ED_SK_TR_IGN.OK_SCHWELLE K_ED_SK_TR_IGN.P_CODE_OPENLOAD K_ED_SK_TR_IGN.P_CODE_SH_TO_GND K_ED_SK_TR_IGN.P_CODE_SH_TO_UB K_ED_SK_TR_IGN.P_CODE_UNPLAUSIBEL K_ED_SMG_SCHALTAB.DEC_NACH_EINTRAG K_ED_SMG_SCHALTAB.DEC_VOR_EINTRAG K_ED_SMG_SCHALTAB.FEHLERSCHWELLE K_ED_SMG_SCHALTAB.INC_NACH_EINTRAG K_ED_SMG_SCHALTAB.INC_VOR_EINTRAG K_ED_SMG_SCHALTAB.KLASSENINDEX K_ED_SMG_SCHALTAB.OK_SCHWELLE K_ED_SMG_SCHALTAB.P_CODE_OPENLOAD K_ED_SMG_SCHALTAB.P_CODE_SH_TO_GND K_ED_SMG_SCHALTAB.P_CODE_SH_TO_UB K_ED_SMG_SCHALTAB.P_CODE_UNPLAUSIBEL K_ED_SMG_SK.DEC_NACH_EINTRAG K_ED_SMG_SK.DEC_VOR_EINTRAG K_ED_SMG_SK.FEHLERSCHWELLE K_ED_SMG_SK.INC_NACH_EINTRAG K_ED_SMG_SK.INC_VOR_EINTRAG K_ED_SMG_SK.KLASSENINDEX K_ED_SMG_SK.OK_SCHWELLE K_ED_SMG_SK.P_CODE_OPENLOAD K_ED_SMG_SK.P_CODE_SH_TO_GND K_ED_SMG_SK.P_CODE_SH_TO_UB K_ED_SMG_SK.P_CODE_UNPLAUSIBEL K_ED_SMG_SK_N.DEC_NACH_EINTRAG K_ED_SMG_SK_N.DEC_VOR_EINTRAG K_ED_SMG_SK_N.FEHLERSCHWELLE K_ED_SMG_SK_N.INC_NACH_EINTRAG K_ED_SMG_SK_N.INC_VOR_EINTRAG K_ED_SMG_SK_N.KLASSENINDEX K_ED_SMG_SK_N.OK_SCHWELLE K_ED_SMG_SK_N.P_CODE_OPENLOAD K_ED_SMG_SK_N.P_CODE_SH_TO_GND K_ED_SMG_SK_N.P_CODE_SH_TO_UB K_ED_SMG_SK_N.P_CODE_UNPLAUSIBEL K_ED_START_RL.DEC_NACH_EINTRAG K_ED_START_RL.DEC_VOR_EINTRAG K_ED_START_RL.FEHLERSCHWELLE K_ED_START_RL.INC_NACH_EINTRAG K_ED_START_RL.INC_VOR_EINTRAG K_ED_START_RL.KLASSENINDEX K_ED_START_RL.OK_SCHWELLE K_ED_START_RL.P_CODE_OPENLOAD K_ED_START_RL.P_CODE_SH_TO_GND K_ED_START_RL.P_CODE_SH_TO_UB K_ED_START_RL.P_CODE_UNPLAUSIBEL K_ED_TABG1.DEC_NACH_EINTRAG K_ED_TABG1.DEC_VOR_EINTRAG K_ED_TABG1.FEHLERSCHWELLE K_ED_TABG1.INC_NACH_EINTRAG K_ED_TABG1.INC_VOR_EINTRAG K_ED_TABG1.KLASSENINDEX K_ED_TABG1.OK_SCHWELLE K_ED_TABG1.P_CODE_OPENLOAD K_ED_TABG1.P_CODE_SH_TO_GND K_ED_TABG1.P_CODE_SH_TO_UB K_ED_TABG1.P_CODE_UNPLAUSIBEL K_ED_TABG2.DEC_NACH_EINTRAG K_ED_TABG2.DEC_VOR_EINTRAG K_ED_TABG2.FEHLERSCHWELLE K_ED_TABG2.INC_NACH_EINTRAG K_ED_TABG2.INC_VOR_EINTRAG K_ED_TABG2.KLASSENINDEX K_ED_TABG2.OK_SCHWELLE K_ED_TABG2.P_CODE_OPENLOAD K_ED_TABG2.P_CODE_SH_TO_GND K_ED_TABG2.P_CODE_SH_TO_UB K_ED_TABG2.P_CODE_UNPLAUSIBEL K_ED_TAN1.DEC_NACH_EINTRAG K_ED_TAN1.DEC_VOR_EINTRAG K_ED_TAN1.FEHLERSCHWELLE K_ED_TAN1.INC_NACH_EINTRAG K_ED_TAN1.INC_VOR_EINTRAG K_ED_TAN1.KLASSENINDEX K_ED_TAN1.OK_SCHWELLE K_ED_TAN1.P_CODE_OPENLOAD K_ED_TAN1.P_CODE_SH_TO_GND K_ED_TAN1.P_CODE_SH_TO_UB K_ED_TAN1.P_CODE_UNPLAUSIBEL K_ED_TAN2.DEC_NACH_EINTRAG K_ED_TAN2.DEC_VOR_EINTRAG K_ED_TAN2.FEHLERSCHWELLE K_ED_TAN2.INC_NACH_EINTRAG K_ED_TAN2.INC_VOR_EINTRAG K_ED_TAN2.KLASSENINDEX K_ED_TAN2.OK_SCHWELLE K_ED_TAN2.P_CODE_OPENLOAD K_ED_TAN2.P_CODE_SH_TO_GND K_ED_TAN2.P_CODE_SH_TO_UB K_ED_TAN2.P_CODE_UNPLAUSIBEL K_ED_TAN_OBD_B1.DEC_NACH_EINTRAG K_ED_TAN_OBD_B1.DEC_VOR_EINTRAG K_ED_TAN_OBD_B1.FEHLERSCHWELLE K_ED_TAN_OBD_B1.INC_NACH_EINTRAG K_ED_TAN_OBD_B1.INC_VOR_EINTRAG K_ED_TAN_OBD_B1.KLASSENINDEX K_ED_TAN_OBD_B1.OK_SCHWELLE K_ED_TAN_OBD_B1.P_CODE_OPENLOAD K_ED_TAN_OBD_B1.P_CODE_SH_TO_GND K_ED_TAN_OBD_B1.P_CODE_SH_TO_UB K_ED_TAN_OBD_B1.P_CODE_UNPLAUSIBEL K_ED_TAN_OBD_B2.DEC_NACH_EINTRAG K_ED_TAN_OBD_B2.DEC_VOR_EINTRAG K_ED_TAN_OBD_B2.FEHLERSCHWELLE K_ED_TAN_OBD_B2.INC_NACH_EINTRAG K_ED_TAN_OBD_B2.INC_VOR_EINTRAG K_ED_TAN_OBD_B2.KLASSENINDEX K_ED_TAN_OBD_B2.OK_SCHWELLE K_ED_TAN_OBD_B2.P_CODE_OPENLOAD K_ED_TAN_OBD_B2.P_CODE_SH_TO_GND K_ED_TAN_OBD_B2.P_CODE_SH_TO_UB K_ED_TAN_OBD_B2.P_CODE_UNPLAUSIBEL K_ED_TDME.DEC_NACH_EINTRAG K_ED_TDME.DEC_VOR_EINTRAG K_ED_TDME.FEHLERSCHWELLE K_ED_TDME.INC_NACH_EINTRAG K_ED_TDME.INC_VOR_EINTRAG K_ED_TDME.KLASSENINDEX K_ED_TDME.OK_SCHWELLE K_ED_TDME.P_CODE_OPENLOAD K_ED_TDME.P_CODE_SH_TO_GND K_ED_TDME.P_CODE_SH_TO_UB K_ED_TDME.P_CODE_UNPLAUSIBEL K_ED_THERMOSTAT.DEC_NACH_EINTRAG K_ED_THERMOSTAT.DEC_VOR_EINTRAG K_ED_THERMOSTAT.FEHLERSCHWELLE K_ED_THERMOSTAT.INC_NACH_EINTRAG K_ED_THERMOSTAT.INC_VOR_EINTRAG K_ED_THERMOSTAT.KLASSENINDEX K_ED_THERMOSTAT.OK_SCHWELLE K_ED_THERMOSTAT.P_CODE_OPENLOAD K_ED_THERMOSTAT.P_CODE_SH_TO_GND K_ED_THERMOSTAT.P_CODE_SH_TO_UB K_ED_THERMOSTAT.P_CODE_UNPLAUSIBEL K_ED_TIME_REL_OBD.DEC_NACH_EINTRAG K_ED_TIME_REL_OBD.DEC_VOR_EINTRAG K_ED_TIME_REL_OBD.FEHLERSCHWELLE K_ED_TIME_REL_OBD.INC_NACH_EINTRAG K_ED_TIME_REL_OBD.INC_VOR_EINTRAG K_ED_TIME_REL_OBD.KLASSENINDEX K_ED_TIME_REL_OBD.OK_SCHWELLE K_ED_TIME_REL_OBD.P_CODE_OPENLOAD K_ED_TIME_REL_OBD.P_CODE_SH_TO_GND K_ED_TIME_REL_OBD.P_CODE_SH_TO_UB K_ED_TIME_REL_OBD.P_CODE_UNPLAUSIBEL K_ED_TKA.DEC_NACH_EINTRAG K_ED_TKA.DEC_VOR_EINTRAG K_ED_TKA.FEHLERSCHWELLE K_ED_TKA.INC_NACH_EINTRAG K_ED_TKA.INC_VOR_EINTRAG K_ED_TKA.KLASSENINDEX K_ED_TKA.OK_SCHWELLE K_ED_TKA.P_CODE_OPENLOAD K_ED_TKA.P_CODE_SH_TO_GND K_ED_TKA.P_CODE_SH_TO_UB K_ED_TKA.P_CODE_UNPLAUSIBEL K_ED_TKA_OBD.DEC_NACH_EINTRAG K_ED_TKA_OBD.DEC_VOR_EINTRAG K_ED_TKA_OBD.FEHLERSCHWELLE K_ED_TKA_OBD.INC_NACH_EINTRAG K_ED_TKA_OBD.INC_VOR_EINTRAG K_ED_TKA_OBD.KLASSENINDEX K_ED_TKA_OBD.OK_SCHWELLE K_ED_TKA_OBD.P_CODE_OPENLOAD K_ED_TKA_OBD.P_CODE_SH_TO_GND K_ED_TKA_OBD.P_CODE_SH_TO_UB K_ED_TKA_OBD.P_CODE_UNPLAUSIBEL K_ED_TMOT.DEC_NACH_EINTRAG K_ED_TMOT.DEC_VOR_EINTRAG K_ED_TMOT.FEHLERSCHWELLE K_ED_TMOT.INC_NACH_EINTRAG K_ED_TMOT.INC_VOR_EINTRAG K_ED_TMOT.KLASSENINDEX K_ED_TMOT.OK_SCHWELLE K_ED_TMOT.P_CODE_OPENLOAD K_ED_TMOT.P_CODE_SH_TO_GND K_ED_TMOT.P_CODE_SH_TO_UB K_ED_TMOT.P_CODE_UNPLAUSIBEL K_ED_TMOT_OBD.DEC_NACH_EINTRAG K_ED_TMOT_OBD.DEC_VOR_EINTRAG K_ED_TMOT_OBD.FEHLERSCHWELLE K_ED_TMOT_OBD.INC_NACH_EINTRAG K_ED_TMOT_OBD.INC_VOR_EINTRAG K_ED_TMOT_OBD.KLASSENINDEX K_ED_TMOT_OBD.OK_SCHWELLE K_ED_TMOT_OBD.P_CODE_OPENLOAD K_ED_TMOT_OBD.P_CODE_SH_TO_GND K_ED_TMOT_OBD.P_CODE_SH_TO_UB K_ED_TMOT_OBD.P_CODE_UNPLAUSIBEL K_ED_TMOT_OBD_HIGH.DEC_NACH_EINTRAG K_ED_TMOT_OBD_HIGH.DEC_VOR_EINTRAG K_ED_TMOT_OBD_HIGH.FEHLERSCHWELLE K_ED_TMOT_OBD_HIGH.INC_NACH_EINTRAG K_ED_TMOT_OBD_HIGH.INC_VOR_EINTRAG K_ED_TMOT_OBD_HIGH.KLASSENINDEX K_ED_TMOT_OBD_HIGH.OK_SCHWELLE K_ED_TMOT_OBD_HIGH.P_CODE_OPENLOAD K_ED_TMOT_OBD_HIGH.P_CODE_SH_TO_GND K_ED_TMOT_OBD_HIGH.P_CODE_SH_TO_UB K_ED_TMOT_OBD_HIGH.P_CODE_UNPLAUSIBEL K_ED_TUMG.DEC_NACH_EINTRAG /end DEF_CHARACTERISTIC
/end FUNCTION
/begin RECORD_LAYOUT TKW_VV_VV_UB FNC_VALUES 1 UBYTE COLUMN_DIR DIRECT /end RECORD_LAYOUT
/begin RECORD_LAYOUT TKW_VV_VV_UW FNC_VALUES 1 UWORD COLUMN_DIR DIRECT /end RECORD_LAYOUT
/begin RECORD_LAYOUT TKW_VV_VV_SW FNC_VALUES 1 SWORD COLUMN_DIR DIRECT /end RECORD_LAYOUT
/end MODULE
/end PROJECT
