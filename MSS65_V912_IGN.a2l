/begin PROJECT MSS65-ign-V912 "MSS65 IGN - V912.00-B204.00, data set 0569Q60Z520E"
/begin HEADER "" VERSION "V912.00-B204.00" /end HEADER
/begin MODULE _MSS65-ign "MSS65 IGN - V912.00-B204.00, data 7842800"
/begin MOD_COMMON "" BYTE_ORDER MSB_FIRST /* Default byteorder (Motorola) */ /end MOD_COMMON
/begin COMPU_METHOD FORMULA_0001 "FORMULA_0001" RAT_FUNC "%6.1" "%" COEFFS 0 10 0 0 0 1 /end COMPU_METHOD
/begin COMPU_METHOD FORMULA_0003 "FORMULA_0003" RAT_FUNC "%3.0" "-" COEFFS 0 1 0 0 0 1 /end COMPU_METHOD
/begin COMPU_METHOD FORMULA_0006 "FORMULA_0006" RAT_FUNC "%5.0" "Upm" COEFFS 0 1 0 0 0 1 /end COMPU_METHOD
/begin COMPU_METHOD FORMULA_0007 "FORMULA_0007" RAT_FUNC "%8.3" "-" COEFFS 0 10000 0 0 0 1 /end COMPU_METHOD
/begin COMPU_METHOD FORMULA_0009 "FORMULA_0009" RAT_FUNC "%6.1" "Nm" COEFFS 0 10 0 0 0 1 /end COMPU_METHOD
/begin COMPU_METHOD FORMULA_0010 "FORMULA_0010" RAT_FUNC "%5.0" "-" COEFFS 0 1 0 0 0 1 /end COMPU_METHOD
/begin COMPU_METHOD FORMULA_0021 "FORMULA_0021" RAT_FUNC "%7.2" "s" COEFFS 0 100 0 0 0 1 /end COMPU_METHOD
/* ------------------ Abschnitt erzeugt aus adapt_glob.dat ------------------ */
/begin COMPU_METHOD FORMULA_0023 "FORMULA_0023" RAT_FUNC "%6.1" "�C" COEFFS 0 10 2732 0 0 1 /end COMPU_METHOD
/begin COMPU_METHOD FORMULA_0025 "FORMULA_0025" RAT_FUNC "%8.3" "-" COEFFS 0 16384 0 0 0 1 /end COMPU_METHOD
/begin COMPU_METHOD FORMULA_0073 "FORMULA_0073" RAT_FUNC "%6.1" "s" COEFFS 0 10 0 0 0 1 /end COMPU_METHOD
/begin COMPU_METHOD FORMULA_0075 "FORMULA_0075" RAT_FUNC "%8.3" "-" COEFFS 0 1024 0 0 0 1 /end COMPU_METHOD
/begin COMPU_METHOD FORMULA_0076 "FORMULA_0076" RAT_FUNC "%6.1" "Kelvin" COEFFS 0 10 0 0 0 1 /end COMPU_METHOD
/begin COMPU_METHOD FORMULA_0078 "FORMULA_0078" RAT_FUNC "%6.1" "km/h" COEFFS 0 16 0 0 0 1 /end COMPU_METHOD
/begin COMPU_METHOD FORMULA_0111 "FORMULA_0111" RAT_FUNC "%6.1" "�KW" COEFFS 0 10 0 0 0 1 /end COMPU_METHOD
/begin COMPU_METHOD FORMULA_0112 "FORMULA_0112" RAT_FUNC "%6.1" "kg/h" COEFFS 0 10 0 0 0 1 /end COMPU_METHOD
/begin COMPU_METHOD FORMULA_0114 "FORMULA_0114" RAT_FUNC "%5.0" "Upm/s" COEFFS 0 1 0 0 0 1 /end COMPU_METHOD
/begin COMPU_METHOD FORMULA_0117 "FORMULA_0117" RAT_FUNC "%7.2" "s" COEFFS 0 200 0 0 0 1 /end COMPU_METHOD
/begin COMPU_METHOD FORMULA_0123 "FORMULA_0123" RAT_FUNC "%5.0" "digit" COEFFS 0 1 0 0 0 1 /end COMPU_METHOD
/begin COMPU_METHOD FORMULA_0132 "FORMULA_0132" RAT_FUNC "%7.2" "m/(s*s)" COEFFS 0 40 0 0 0 1 /end COMPU_METHOD
/begin COMPU_METHOD FORMULA_0138 "FORMULA_0138" RAT_FUNC "%3.0" "bar" COEFFS 0 1 0 0 0 1 /end COMPU_METHOD
/begin COMPU_METHOD FORMULA_0141 "FORMULA_0141" RAT_FUNC "%7.2" "Grad" COEFFS 0 1 0 0 0 0.04395 /end COMPU_METHOD
/begin COMPU_METHOD FORMULA_0142 "FORMULA_0142" RAT_FUNC "%7.2" "Grad/s" COEFFS 0 1 0 0 0 0.04395 /end COMPU_METHOD
/begin COMPU_METHOD FORMULA_0268 "FORMULA_0268" TAB_VERB "%3.0" "-" COMPU_TAB_REF FORMULA_0268_VTAB /end COMPU_METHOD
/begin COMPU_VTAB FORMULA_0268_VTAB "FORMULA_0268_VTAB" TAB_VERB 5 0 "unbegrenzt" 1 "TZ-Begr" 2 "DK-Begr" 3 "TZ-DK-Begr" 15 "ungueltig" /end COMPU_VTAB
/begin COMPU_METHOD FORMULA_0295 "FORMULA_0295" RAT_FUNC "%9.4" "-" COEFFS 0 16384 0 0 0 1 /end COMPU_METHOD
/begin COMPU_METHOD FORMULA_0318 "FORMULA_0318" RAT_FUNC "%3.0" ".Gang" COEFFS 0 1 0 0 0 1 /end COMPU_METHOD
/begin COMPU_METHOD FORMULA_0333 "FORMULA_0333" RAT_FUNC "%7.2" "�C" COEFFS 0 20 5463 0 0 1 /end COMPU_METHOD
/* ------------------ Abschnitt erzeugt aus pctrl.dat ------------------ */
/begin COMPU_METHOD FORMULA_0352 "FORMULA_0352" RAT_FUNC "%5.2" "s" COEFFS 0 200 0 0 0 1 /end COMPU_METHOD
/begin COMPU_METHOD FORMULA_0353 "FORMULA_0353" RAT_FUNC "%3.0" "ms" COEFFS 0 1 0 0 0 10 /end COMPU_METHOD
/begin COMPU_METHOD FORMULA_0363 "FORMULA_0363" TAB_VERB "%5.2" "-" COMPU_TAB_REF FORMULA_0363_VTAB /end COMPU_METHOD
/begin COMPU_VTAB FORMULA_0363_VTAB "FORMULA_0363_VTAB" TAB_VERB 2 0 "SK aus" 1 "SK aktiv" /end COMPU_VTAB
/begin COMPU_METHOD FORMULA_0389 "FORMULA_0389" TAB_VERB "%7.2" "-" COMPU_TAB_REF FORMULA_0389_VTAB /end COMPU_METHOD
/begin COMPU_VTAB FORMULA_0389_VTAB "FORMULA_0389_VTAB" TAB_VERB 1 0 "no" DEFAULT_VALUE "ja" /end COMPU_VTAB
/begin COMPU_METHOD FORMULA_0390 "FORMULA_0390" TAB_VERB "%7.2" "-" COMPU_TAB_REF FORMULA_0390_VTAB /end COMPU_METHOD
/begin COMPU_VTAB FORMULA_0390_VTAB "FORMULA_0390_VTAB" TAB_VERB 1 0 "no" DEFAULT_VALUE "ja" /end COMPU_VTAB
/begin COMPU_METHOD FORMULA_0391 "FORMULA_0391" TAB_VERB "%7.2" "-" COMPU_TAB_REF FORMULA_0391_VTAB /end COMPU_METHOD
/begin COMPU_VTAB FORMULA_0391_VTAB "FORMULA_0391_VTAB" TAB_VERB 1 0 "no" DEFAULT_VALUE "ja" /end COMPU_VTAB
/begin COMPU_METHOD FORMULA_0392 "FORMULA_0392" TAB_VERB "%7.2" "-" COMPU_TAB_REF FORMULA_0392_VTAB /end COMPU_METHOD
/begin COMPU_VTAB FORMULA_0392_VTAB "FORMULA_0392_VTAB" TAB_VERB 1 0 "no" DEFAULT_VALUE "ja" /end COMPU_VTAB
/begin COMPU_METHOD FORMULA_0393 "FORMULA_0393" TAB_VERB "%7.2" "-" COMPU_TAB_REF FORMULA_0393_VTAB /end COMPU_METHOD
/begin COMPU_VTAB FORMULA_0393_VTAB "FORMULA_0393_VTAB" TAB_VERB 1 0 "no" DEFAULT_VALUE "ja" /end COMPU_VTAB
/begin COMPU_METHOD FORMULA_0394 "FORMULA_0394" TAB_VERB "%7.2" "-" COMPU_TAB_REF FORMULA_0394_VTAB /end COMPU_METHOD
/begin COMPU_VTAB FORMULA_0394_VTAB "FORMULA_0394_VTAB" TAB_VERB 1 0 "no" DEFAULT_VALUE "ja" /end COMPU_VTAB
/begin COMPU_METHOD FORMULA_0395 "FORMULA_0395" TAB_VERB "%7.2" "-" COMPU_TAB_REF FORMULA_0395_VTAB /end COMPU_METHOD
/begin COMPU_VTAB FORMULA_0395_VTAB "FORMULA_0395_VTAB" TAB_VERB 1 0 "no" DEFAULT_VALUE "ja" /end COMPU_VTAB
/begin COMPU_METHOD FORMULA_0396 "FORMULA_0396" TAB_VERB "%7.2" "-" COMPU_TAB_REF FORMULA_0396_VTAB /end COMPU_METHOD
/begin COMPU_VTAB FORMULA_0396_VTAB "FORMULA_0396_VTAB" TAB_VERB 1 0 "no" DEFAULT_VALUE "ja" /end COMPU_VTAB
/begin COMPU_METHOD FORMULA_0397 "FORMULA_0397" TAB_VERB "%7.2" "-" COMPU_TAB_REF FORMULA_0397_VTAB /end COMPU_METHOD
/begin COMPU_VTAB FORMULA_0397_VTAB "FORMULA_0397_VTAB" TAB_VERB 1 0 "no" DEFAULT_VALUE "ja" /end COMPU_VTAB
/begin COMPU_METHOD FORMULA_0398 "FORMULA_0398" TAB_VERB "%7.2" "-" COMPU_TAB_REF FORMULA_0398_VTAB /end COMPU_METHOD
/begin COMPU_VTAB FORMULA_0398_VTAB "FORMULA_0398_VTAB" TAB_VERB 1 0 "no" DEFAULT_VALUE "ja" /end COMPU_VTAB
/begin COMPU_METHOD FORMULA_0399 "FORMULA_0399" RAT_FUNC "%8.3" "ms" COEFFS 0 1000 0 0 0 1 /end COMPU_METHOD
/begin COMPU_METHOD FORMULA_0400 "FORMULA_0400" TAB_VERB "%3.0" "-" COMPU_TAB_REF FORMULA_0400_VTAB /end COMPU_METHOD
/begin COMPU_VTAB FORMULA_0400_VTAB "FORMULA_0400_VTAB" TAB_VERB 59 0 "kein Fehler" 1 "Adaptionsdaten CRC32" 2 "Programm CRC32" 3 "Daten CRC32" 4 "undef" 5 "undef" 6 "Watchdog-Reset" 7 "Reset" 8 "CRC Boot" 9 "Reset-MCI" 10 "Reset-Data" 11 "Reset-Instr" 13 "Reset-Align" 14 "Reset-Prog" 15 "Reset-NoFp" 19 "Reset-System" 20 "Reset-Trace" 21 "Reset-FpAss" 22 "Reset-Perform" 23 "Reset-SwEmu" 26 "Reset-InstrProt" 27 "Reset-DataProt" 35 "Reset-DataBrk" 36 "Reset-InstrBrk" 37 "Reset-MaskBrk" 38 "Reset-NMIBrk" 39 "Reset-NMI" 40 "Reset-Reserve" 41 "HW_INDEX zu klein" 42 "ADAPT Loeschen" 43 "ADAPT Schreiben" 44 "ADAPT Hochlauf" 50 "SK-Resetausloesung" 51 "ADC" 52 "TZ-TPU Pin" 53 "TZ-TREIBER Pin" 54 "DSP-Bus" 55 "DSP-Stack" 56 "DSP-Watchdog" 57 "DSP-Programm" 58 "DSP-Daten" 59 "DSP-CRC" 60 "ZUST_NL IGN Timeout" 61 "DSP-Zylinder" 62 "FPGA Init Pin NHigh1" 63 "FPGA Init Pin NHigh2" 64 "FPGA Done Pin NHigh" 65 "FPGA Kennung-CRC32" 66 "RAM" 67 "Register" 68 "TPU RAM" 69 "QADC0 CCW" 70 "QADC1 CCW" 71 "SPI-ATIC39 Chain" 72 "SPI-ATIC35 Chain" 73 "SPI-ATIC29 Chain" 74 "Interne Spannung" 75 "OS-Tasksystem" 76 "OS-Stack" DEFAULT_VALUE "undef" /end COMPU_VTAB
/begin COMPU_METHOD FORMULA_0401 "FORMULA_0401" RAT_FUNC "%6.1" "ms" COEFFS 0 1 0 0 0 0.255 /end COMPU_METHOD
/* ------------------ Abschnitt erzeugt aus tpu_kw.dat ------------------ */
/begin COMPU_METHOD FORMULA_0402 "FORMULA_0402" TAB_VERB "%3.0" "-" COMPU_TAB_REF FORMULA_0402_VTAB /end COMPU_METHOD
/begin COMPU_VTAB FORMULA_0402_VTAB "FORMULA_0402_VTAB" TAB_VERB 5 0 "sync - 720� Mode" 1 "sync - 360� Mode" 129 "suche Luecke" 161 "Zahnentprellung laeuft" 225 "nicht sync." /end COMPU_VTAB
/begin COMPU_METHOD FORMULA_0403 "FORMULA_0403" RAT_FUNC "%3.0" "-" COEFFS 0 -1 1 0 0 -1 /end COMPU_METHOD
/begin COMPU_METHOD FORMULA_0404 "FORMULA_0404" TAB_VERB "%3.0" "-" COMPU_TAB_REF FORMULA_0404_VTAB /end COMPU_METHOD
/begin COMPU_VTAB FORMULA_0404_VTAB "FORMULA_0404_VTAB" TAB_VERB 1 0 "Kein Interrupt." DEFAULT_VALUE "Mind. Einfachinterrupt." /end COMPU_VTAB
/begin COMPU_METHOD FORMULA_0405 "FORMULA_0405" TAB_VERB "%3.0" "-" COMPU_TAB_REF FORMULA_0405_VTAB /end COMPU_METHOD
/begin COMPU_VTAB FORMULA_0405_VTAB "FORMULA_0405_VTAB" TAB_VERB 1 0 "nein." DEFAULT_VALUE "aktiv." /end COMPU_VTAB
/begin COMPU_METHOD FORMULA_0406 "FORMULA_0406" TAB_VERB "%3.0" "-" COMPU_TAB_REF FORMULA_0406_VTAB /end COMPU_METHOD
/begin COMPU_VTAB FORMULA_0406_VTAB "FORMULA_0406_VTAB" TAB_VERB 1 0 "nein." DEFAULT_VALUE "aktiv." /end COMPU_VTAB
/begin COMPU_METHOD FORMULA_0407 "FORMULA_0407" TAB_VERB "%3.0" "-" COMPU_TAB_REF FORMULA_0407_VTAB /end COMPU_METHOD
/begin COMPU_VTAB FORMULA_0407_VTAB "FORMULA_0407_VTAB" TAB_VERB 1 0 "nein." DEFAULT_VALUE "aktiv." /end COMPU_VTAB
/begin COMPU_METHOD FORMULA_0408 "FORMULA_0408" TAB_VERB "%3.0" "-" COMPU_TAB_REF FORMULA_0408_VTAB /end COMPU_METHOD
/begin COMPU_VTAB FORMULA_0408_VTAB "FORMULA_0408_VTAB" TAB_VERB 1 0 "nein." DEFAULT_VALUE "aktiv." /end COMPU_VTAB
/begin COMPU_METHOD FORMULA_0409 "FORMULA_0409" TAB_VERB "%3.0" "-" COMPU_TAB_REF FORMULA_0409_VTAB /end COMPU_METHOD
/begin COMPU_VTAB FORMULA_0409_VTAB "FORMULA_0409_VTAB" TAB_VERB 1 0 "nein." DEFAULT_VALUE "aktiv." /end COMPU_VTAB
/begin COMPU_METHOD FORMULA_0410 "FORMULA_0410" TAB_VERB "%3.0" "-" COMPU_TAB_REF FORMULA_0410_VTAB /end COMPU_METHOD
/begin COMPU_VTAB FORMULA_0410_VTAB "FORMULA_0410_VTAB" TAB_VERB 1 0 "nein." DEFAULT_VALUE "aktiv." /end COMPU_VTAB
/begin COMPU_METHOD FORMULA_0411 "FORMULA_0411" TAB_VERB "%3.0" "-" COMPU_TAB_REF FORMULA_0411_VTAB /end COMPU_METHOD
/begin COMPU_VTAB FORMULA_0411_VTAB "FORMULA_0411_VTAB" TAB_VERB 1 0 "nein." DEFAULT_VALUE "aktiv." /end COMPU_VTAB
/begin COMPU_METHOD FORMULA_0412 "FORMULA_0412" TAB_VERB "%3.0" "-" COMPU_TAB_REF FORMULA_0412_VTAB /end COMPU_METHOD
/begin COMPU_VTAB FORMULA_0412_VTAB "FORMULA_0412_VTAB" TAB_VERB 1 0 "nein." DEFAULT_VALUE "aktiv." /end COMPU_VTAB
/begin COMPU_METHOD FORMULA_0416 "FORMULA_0416" TAB_VERB "%5.2" "-" COMPU_TAB_REF FORMULA_0416_VTAB /end COMPU_METHOD
/begin COMPU_VTAB FORMULA_0416_VTAB "FORMULA_0416_VTAB" TAB_VERB 6 177 "B1-Muster" 178 "B2-Muster" 179 "B3-Muster" 193 "C1-Muster" 194 "C2-Muster" 255 "ohne Kennung" /end COMPU_VTAB
/begin COMPU_METHOD FORMULA_0419 "FORMULA_0419" RAT_FUNC "%8.3" "V" COEFFS 0 2048 0 0 0 5 /end COMPU_METHOD
/begin COMPU_METHOD FORMULA_0421 "FORMULA_0421" TAB_VERB "%3.0" "-" COMPU_TAB_REF FORMULA_0421_VTAB /end COMPU_METHOD
/begin COMPU_VTAB FORMULA_0421_VTAB "FORMULA_0421_VTAB" TAB_VERB 1 0 "Kein Testwert 1" DEFAULT_VALUE "Testwert ermittelt" /end COMPU_VTAB
/begin COMPU_METHOD FORMULA_0422 "FORMULA_0422" RAT_FUNC "%7.2" "qmm" COEFFS 0 100 0 0 0 1 /end COMPU_METHOD
/begin COMPU_METHOD FORMULA_0423 "FORMULA_0423" RAT_FUNC "%3.0" "Bit" COEFFS 0 1 0 0 0 4 /end COMPU_METHOD
/begin COMPU_METHOD FORMULA_0424 "FORMULA_0424" TAB_VERB "%5.2" "-" COMPU_TAB_REF FORMULA_0424_VTAB /end COMPU_METHOD
/begin COMPU_VTAB FORMULA_0424_VTAB "FORMULA_0424_VTAB" TAB_VERB 5 0 "offen" 1 "geschlossen" 2 "oeffnet" 3 "schliesst" 7 "Fehler" /end COMPU_VTAB
/begin COMPU_METHOD FORMULA_0425 "FORMULA_0425" TAB_VERB "%5.2" "-" COMPU_TAB_REF FORMULA_0425_VTAB /end COMPU_METHOD
/begin COMPU_VTAB FORMULA_0425_VTAB "FORMULA_0425_VTAB" TAB_VERB 11 0 "Geschaltet" 1 "Aktiv" 2 "ZWK aktiv" 3 "synchronisiert" 4 "SW Neutral" 5 "vorspannen" 6 "Init" 7 "Synchron fertig" 8 "vor Synchron" 9 "vor Synchron aktiv" 15 "Fehler" /end COMPU_VTAB
/begin COMPU_METHOD FORMULA_0426 "FORMULA_0426" TAB_VERB "%3.0" "-" COMPU_TAB_REF FORMULA_0426_VTAB /end COMPU_METHOD
/begin COMPU_VTAB FORMULA_0426_VTAB "FORMULA_0426_VTAB" TAB_VERB 11 0 "undef" 1 "Anfahren" 2 "Anfahren-KD" 3 "Wait-RS" 4 "Anfahren-RS" 5 "Schalten" 6 "Einkuppeln" 7 "Anhalten" 8 "Abwuergen" 9 "Radabriss" 15 "Fehler" /end COMPU_VTAB
/begin COMPU_METHOD FORMULA_0427 "FORMULA_0427" TAB_VERB "%5.2" "-" COMPU_TAB_REF FORMULA_0427_VTAB /end COMPU_METHOD
/begin COMPU_VTAB FORMULA_0427_VTAB "FORMULA_0427_VTAB" TAB_VERB 2 0 "offen" 1 "geschlossen" DEFAULT_VALUE "undef" /end COMPU_VTAB
/begin COMPU_METHOD FORMULA_0428 "FORMULA_0428" TAB_VERB "%5.2" "-" COMPU_TAB_REF FORMULA_0428_VTAB /end COMPU_METHOD
/begin COMPU_VTAB FORMULA_0428_VTAB "FORMULA_0428_VTAB" TAB_VERB 4 0 "kein Abbruch" 1 "Ablauf-Timeout" 2 "CAN-Timeout" 16 "Doppelschaltung" DEFAULT_VALUE "undef" /end COMPU_VTAB
/begin COMPU_METHOD FORMULA_0429 "FORMULA_0429" TAB_VERB "%5.0" "-" COMPU_TAB_REF FORMULA_0429_VTAB /end COMPU_METHOD
/begin COMPU_VTAB FORMULA_0429_VTAB "FORMULA_0429_VTAB" TAB_VERB 8 0 "kein Fehler" 1 "R-Mode" 2 "Diagnose" 8 "CAN-Fehler" 16 "NP-Err" 32 "SK-Fehler" 12 "Alive" 64 "Startup" DEFAULT_VALUE "Mehrfachfehler" /end COMPU_VTAB
/begin COMPU_METHOD FORMULA_0430 "FORMULA_0430" TAB_VERB "%7.2" "-" COMPU_TAB_REF FORMULA_0430_VTAB /end COMPU_METHOD
/begin COMPU_VTAB FORMULA_0430_VTAB "FORMULA_0430_VTAB" TAB_VERB 9 0 "kein Fehler" 1 "Soll-Vgl" 2 "Soll-Ist-Vgl" 4 "Mode-Vgl" 8 "CAN-Wert" 16 "Spalt offen" 32 "Klemmen offen" 64 "CAN-Istwert" 128 "WDK-CAN-Vgl" DEFAULT_VALUE "Mehrfachfehler" /end COMPU_VTAB
/begin COMPU_METHOD FORMULA_0431 "FORMULA_0431" TAB_VERB "%5.0" "-" COMPU_TAB_REF FORMULA_0431_VTAB /end COMPU_METHOD
/begin COMPU_VTAB FORMULA_0431_VTAB "FORMULA_0431_VTAB" TAB_VERB 17 0 "kein Fehler" 1 "RAM-Fehler" 2 "ROM-Fehler" 4 "A/D Wandler-Fehler" 8 "Software Reset" 16 "CAN-Bus Fehler" 32 "CAN-Timeout" 64 "CAN-Fehler Chksum" 128 "CAN-Fehler Alive" 256 "Zylinderbankzuordnung" 512 "Bereichsueberwachung" 1024 "Gradientenueberwachung" 2048 "Lagereglerueberwachung" 4096 "therm. Ueberlast" 8192 "Motorschutz" 16384 "NP-Fehler" 32768 "NP-Abbruch" DEFAULT_VALUE "Mehrfachfehler" /end COMPU_VTAB
/begin COMPU_METHOD FORMULA_0432 "FORMULA_0432" TAB_VERB "%3.0" "-" COMPU_TAB_REF FORMULA_0432_VTAB /end COMPU_METHOD
/begin COMPU_VTAB FORMULA_0432_VTAB "FORMULA_0432_VTAB" TAB_VERB 6 1 "oA aus" 2 "oA aktiv" 4 "oA erfolgreich" 9 "oA abgelehnt" 10 "oA abgebrochen" 12 "oA fehlerhaft" DEFAULT_VALUE "undef" /end COMPU_VTAB
/begin COMPU_METHOD FORMULA_0433 "FORMULA_0433" TAB_VERB "%3.0" "-" COMPU_TAB_REF FORMULA_0433_VTAB /end COMPU_METHOD
/begin COMPU_VTAB FORMULA_0433_VTAB "FORMULA_0433_VTAB" TAB_VERB 7 0 "Init" 1 "Inaktiv" 2 "NP-Adapt" 4 "Aktiv" 8 "Zust bb" 10 "Federtest" 15 "Failsafe" /end COMPU_VTAB
/begin COMPU_METHOD FORMULA_0434 "FORMULA_0434" TAB_VERB "%5.2" "-" COMPU_TAB_REF FORMULA_0434_VTAB /end COMPU_METHOD
/begin COMPU_VTAB FORMULA_0434_VTAB "FORMULA_0434_VTAB" TAB_VERB 5 0 "Wait" 1 "Inaktiv" 2 "Aktiv" 3 "Aktiv/Adapt" 255 "Failsafe" /end COMPU_VTAB
/begin COMPU_METHOD FORMULA_0435 "FORMULA_0435" RAT_FUNC "%6.1" "%" COEFFS 0 32768 0 0 0 100 /end COMPU_METHOD
/begin COMPU_METHOD FORMULA_0436 "FORMULA_0436" TAB_VERB "%3.0" "-" COMPU_TAB_REF FORMULA_0436_VTAB /end COMPU_METHOD
/begin COMPU_VTAB FORMULA_0436_VTAB "FORMULA_0436_VTAB" TAB_VERB 7 0 "kein Fehler" 1 "Md-Chk0" 2 "Md-Chk" 4 "MDmin-Chk" 8 "Rf-Chk" 16 "Eta-Chk" 32 "LLR-Chk" DEFAULT_VALUE "Mehrfach" /end COMPU_VTAB
/begin COMPU_METHOD FORMULA_0437 "FORMULA_0437" TAB_VERB "%3.0" "-" COMPU_TAB_REF FORMULA_0437_VTAB /end COMPU_METHOD
/begin COMPU_VTAB FORMULA_0437_VTAB "FORMULA_0437_VTAB" TAB_VERB 1 0 "nein" DEFAULT_VALUE "ja" /end COMPU_VTAB
/begin COMPU_METHOD FORMULA_0438 "FORMULA_0438" TAB_VERB "%3.0" "-" COMPU_TAB_REF FORMULA_0438_VTAB /end COMPU_METHOD
/begin COMPU_VTAB FORMULA_0438_VTAB "FORMULA_0438_VTAB" TAB_VERB 22 0 "Fahrer" 1 "Getr" 2 "ASC" 3 "MSR" 4 "Schub" 5 "MCS" 16 "Fahrer+LLR" 17 "Getr+LLR" 18 "ASC+LLR" 19 "MSR+LLR" 32 "Fahrer+AR" 33 "Getr+AR" 34 "ASC+AR" 35 "MSR+AR" 64 "Fahrer+Begr" 65 "Getr+Begr" 66 "ASC+Begr" 67 "MSR+Begr" 128 "Fahrer+SK" 129 "Getr+SK" 130 "ASC+SK" 131 "MSR+SK" DEFAULT_VALUE "Mehrfach" /end COMPU_VTAB
/begin COMPU_METHOD FORMULA_0439 "FORMULA_0439" RAT_FUNC "%8.3" "0/oo" COEFFS 0 4194.304 0 0 0 1 /end COMPU_METHOD
/begin COMPU_METHOD FORMULA_0440 "FORMULA_0440" RAT_FUNC "%7.0" "U*2" COEFFS 0 1 0 0 0 1 /end COMPU_METHOD
/begin COMPU_METHOD FORMULA_0441 "FORMULA_0441" TAB_VERB "%3.0" "-" COMPU_TAB_REF FORMULA_0441_VTAB /end COMPU_METHOD
/begin COMPU_VTAB FORMULA_0441_VTAB "FORMULA_0441_VTAB" TAB_VERB 4 0 "aus" 2 "FF" 4 "MIL" 6 "FF+MIL" /end COMPU_VTAB
/begin COMPU_METHOD FORMULA_0442 "FORMULA_0442" RAT_FUNC "%11.4" "m/(s*s)" COEFFS 0 2867200000 0 0 0 19613 /end COMPU_METHOD
/begin COMPU_METHOD FORMULA_0444 "FORMULA_0444" RAT_FUNC "%7.2" "mg" COEFFS 0 64 0 0 0 1 /end COMPU_METHOD
/begin COMPU_METHOD FORMULA_0445 "FORMULA_0445" RAT_FUNC "%3.0" "-" COEFFS 0 1 0 0 0 4 /end COMPU_METHOD
/begin COMPU_METHOD FORMULA_0446 "FORMULA_0446" TAB_VERB "%5.0" "-" COMPU_TAB_REF FORMULA_0446_VTAB /end COMPU_METHOD
/begin COMPU_VTAB FORMULA_0446_VTAB "FORMULA_0446_VTAB" TAB_VERB 2 0 "leer" 1 "gespeichert" DEFAULT_VALUE "eingefroren" /end COMPU_VTAB
/begin COMPU_METHOD FORMULA_0451 "FORMULA_0451" RAT_FUNC "%9.2" "s" COEFFS 0 200 0 0 0 1 /end COMPU_METHOD
/* ------------------ Abschnitt erzeugt aus adapt_wichtig.dat ------------------ */
/begin COMPU_METHOD FORMULA_0453 "FORMULA_0453" RAT_FUNC "%7.0" "mal" COEFFS 0 1 0 0 0 1 /end COMPU_METHOD
/begin COMPU_METHOD FORMULA_0454 "FORMULA_0454" RAT_FUNC "%5.0" "bytes" COEFFS 0 1 0 0 0 4 /end COMPU_METHOD
/begin COMPU_METHOD FORMULA_0455 "FORMULA_0455" RAT_FUNC "%5.0" "VERS" COEFFS 0 1 0 0 0 1 /end COMPU_METHOD
/begin COMPU_METHOD FORMULA_0456 "FORMULA_0456" RAT_FUNC "%8.1" "s" COEFFS 0 10 0 0 0 1 /end COMPU_METHOD
/begin COMPU_METHOD FORMULA_0457 "FORMULA_0457" RAT_FUNC "%5.0" "zyklen" COEFFS 0 1 0 0 0 1 /end COMPU_METHOD
/* ------------------ Abschnitt erzeugt aus afz.dat ------------------ */
/begin COMPU_METHOD FORMULA_0459 "FORMULA_0459" RAT_FUNC "%7.2" "m/(s*s)" COEFFS 0 4587520 0 0 0 19613 /end COMPU_METHOD
/begin COMPU_METHOD FORMULA_0461 "FORMULA_0461" RAT_FUNC "%7.2" "m/(s*s)" COEFFS 0 640 0 0 0 1 /end COMPU_METHOD
/begin COMPU_METHOD FORMULA_0462 "FORMULA_0462" RAT_FUNC "%5.2" "s" COEFFS 0 0 2.56 0 1 0 /end COMPU_METHOD
/* ------------------ Abschnitt erzeugt aus ag_tz.dat ------------------ */
/begin COMPU_METHOD FORMULA_0464 "FORMULA_0464" TAB_VERB "%3.0" "-" COMPU_TAB_REF FORMULA_0464_VTAB /end COMPU_METHOD
/begin COMPU_VTAB FORMULA_0464_VTAB "FORMULA_0464_VTAB" TAB_VERB 5 0 "Inaktiv" 1 "Key" 5 "Aktiv" 8 "Fehler" 9 "Beendet" DEFAULT_VALUE "undefined" /end COMPU_VTAB
/begin COMPU_METHOD FORMULA_0466 "FORMULA_0466" TAB_VERB "%5.0" "-" COMPU_TAB_REF FORMULA_0466_VTAB /end COMPU_METHOD
/begin COMPU_VTAB FORMULA_0466_VTAB "FORMULA_0466_VTAB" TAB_VERB 1 0 "keine Ausblendung." DEFAULT_VALUE "Ausblendungen aktiv." /end COMPU_VTAB
/begin COMPU_METHOD FORMULA_0467 "FORMULA_0467" TAB_VERB "%5.0" "-" COMPU_TAB_REF FORMULA_0467_VTAB /end COMPU_METHOD
/begin COMPU_VTAB FORMULA_0467_VTAB "FORMULA_0467_VTAB" TAB_VERB 1 0 "Zyl. 1 an." DEFAULT_VALUE "Zyl. 1 aus." /end COMPU_VTAB
/begin COMPU_METHOD FORMULA_0468 "FORMULA_0468" TAB_VERB "%5.0" "-" COMPU_TAB_REF FORMULA_0468_VTAB /end COMPU_METHOD
/begin COMPU_VTAB FORMULA_0468_VTAB "FORMULA_0468_VTAB" TAB_VERB 1 0 "Zyl. 2 an." DEFAULT_VALUE "Zyl. 2 aus." /end COMPU_VTAB
/begin COMPU_METHOD FORMULA_0469 "FORMULA_0469" TAB_VERB "%5.0" "-" COMPU_TAB_REF FORMULA_0469_VTAB /end COMPU_METHOD
/begin COMPU_VTAB FORMULA_0469_VTAB "FORMULA_0469_VTAB" TAB_VERB 1 0 "Zyl. 3 an." DEFAULT_VALUE "Zyl. 3 aus." /end COMPU_VTAB
/begin COMPU_METHOD FORMULA_0470 "FORMULA_0470" TAB_VERB "%5.0" "-" COMPU_TAB_REF FORMULA_0470_VTAB /end COMPU_METHOD
/begin COMPU_VTAB FORMULA_0470_VTAB "FORMULA_0470_VTAB" TAB_VERB 1 0 "Zyl. 4 an." DEFAULT_VALUE "Zyl. 4 aus." /end COMPU_VTAB
/begin COMPU_METHOD FORMULA_0471 "FORMULA_0471" TAB_VERB "%5.0" "-" COMPU_TAB_REF FORMULA_0471_VTAB /end COMPU_METHOD
/begin COMPU_VTAB FORMULA_0471_VTAB "FORMULA_0471_VTAB" TAB_VERB 1 0 "Zyl. 5 an." DEFAULT_VALUE "Zyl. 5 aus." /end COMPU_VTAB
/begin COMPU_METHOD FORMULA_0472 "FORMULA_0472" TAB_VERB "%5.0" "-" COMPU_TAB_REF FORMULA_0472_VTAB /end COMPU_METHOD
/begin COMPU_VTAB FORMULA_0472_VTAB "FORMULA_0472_VTAB" TAB_VERB 1 0 "Zyl. 6 an." DEFAULT_VALUE "Zyl. 6 aus." /end COMPU_VTAB
/begin COMPU_METHOD FORMULA_0473 "FORMULA_0473" TAB_VERB "%5.0" "-" COMPU_TAB_REF FORMULA_0473_VTAB /end COMPU_METHOD
/begin COMPU_VTAB FORMULA_0473_VTAB "FORMULA_0473_VTAB" TAB_VERB 1 0 "Zyl. 7 an." DEFAULT_VALUE "Zyl. 7 aus." /end COMPU_VTAB
/begin COMPU_METHOD FORMULA_0474 "FORMULA_0474" TAB_VERB "%5.0" "-" COMPU_TAB_REF FORMULA_0474_VTAB /end COMPU_METHOD
/begin COMPU_VTAB FORMULA_0474_VTAB "FORMULA_0474_VTAB" TAB_VERB 1 0 "Zyl. 8 an." DEFAULT_VALUE "Zyl. 8 aus." /end COMPU_VTAB
/begin COMPU_METHOD FORMULA_0475 "FORMULA_0475" TAB_VERB "%5.0" "-" COMPU_TAB_REF FORMULA_0475_VTAB /end COMPU_METHOD
/begin COMPU_VTAB FORMULA_0475_VTAB "FORMULA_0475_VTAB" TAB_VERB 1 0 "Zyl. 9 an." DEFAULT_VALUE "Zyl. 9 aus." /end COMPU_VTAB
/begin COMPU_METHOD FORMULA_0476 "FORMULA_0476" TAB_VERB "%5.0" "-" COMPU_TAB_REF FORMULA_0476_VTAB /end COMPU_METHOD
/begin COMPU_VTAB FORMULA_0476_VTAB "FORMULA_0476_VTAB" TAB_VERB 1 0 "Zyl. 10 an." DEFAULT_VALUE "Zyl. 10 aus." /end COMPU_VTAB
/* ------------------ Abschnitt erzeugt aus aq.dat ------------------ */
/begin COMPU_METHOD FORMULA_0477 "FORMULA_0477" RAT_FUNC "%7.2" "s" COEFFS 0 0 327.67 0 1 0 /end COMPU_METHOD
/begin COMPU_METHOD FORMULA_0478 "FORMULA_0478" RAT_FUNC "%6.3" "s" COEFFS 0 0 1.28 0 1 0 /end COMPU_METHOD
/begin COMPU_METHOD FORMULA_0479 "FORMULA_0479" RAT_FUNC "%4.1" "%" COEFFS 0 10 0 0 0 1 /end COMPU_METHOD
/* ------------------ Abschnitt erzeugt aus ar.dat ------------------ */
/begin COMPU_METHOD FORMULA_0480 "FORMULA_0480" TAB_VERB "%3.0" "-" COMPU_TAB_REF FORMULA_0480_VTAB /end COMPU_METHOD
/begin COMPU_VTAB FORMULA_0480_VTAB "FORMULA_0480_VTAB" TAB_VERB 7 0 "Warten" 1 "Init" 2 "Gesperrt" 3 "Init+Gesperrt" 4 "Frei" 8 "Aktiv" 12 "Frei+Aktiv" /end COMPU_VTAB
/begin COMPU_METHOD FORMULA_0481 "FORMULA_0481" TAB_VERB "%3.0" "-" COMPU_TAB_REF FORMULA_0481_VTAB /end COMPU_METHOD
/begin COMPU_VTAB FORMULA_0481_VTAB "FORMULA_0481_VTAB" TAB_VERB 4 0 "Erwarte_1" 1 "Aktiv" 2 "Erwarte_2B" 3 "Erwarte_2V" /end COMPU_VTAB
/begin COMPU_METHOD FORMULA_0482 "FORMULA_0482" RAT_FUNC "%5.0" "Upm/s" COEFFS 0 1 0 0 0 200 /end COMPU_METHOD
/begin COMPU_METHOD FORMULA_0486 "FORMULA_0486" RAT_FUNC "%5.0" ".Gang" COEFFS 0 1 0 0 0 1 /end COMPU_METHOD
/* ------------------ Abschnitt erzeugt aus at.dat ------------------ */
/begin COMPU_METHOD FORMULA_0487 "FORMULA_0487" TAB_VERB "%5.2" "-" COMPU_TAB_REF FORMULA_0487_VTAB /end COMPU_METHOD
/begin COMPU_VTAB FORMULA_0487_VTAB "FORMULA_0487_VTAB" TAB_VERB 2 0 "AT gesperrt" 1 "AT freigegeben" /end COMPU_VTAB
/begin COMPU_METHOD FORMULA_0488 "FORMULA_0488" TAB_VERB "%5.2" "-" COMPU_TAB_REF FORMULA_0488_VTAB /end COMPU_METHOD
/begin COMPU_VTAB FORMULA_0488_VTAB "FORMULA_0488_VTAB" TAB_VERB 2 0 "AT kein Eingriff" 1 "AT Eingriff" /end COMPU_VTAB
/begin COMPU_METHOD FORMULA_0489 "FORMULA_0489" TAB_VERB "%5.2" "-" COMPU_TAB_REF FORMULA_0489_VTAB /end COMPU_METHOD
/begin COMPU_VTAB FORMULA_0489_VTAB "FORMULA_0489_VTAB" TAB_VERB 2 0 "AT kein Eingriff Zug" 1 "AT Eingriff Zug" /end COMPU_VTAB
/begin COMPU_METHOD FORMULA_0490 "FORMULA_0490" TAB_VERB "%5.2" "-" COMPU_TAB_REF FORMULA_0490_VTAB /end COMPU_METHOD
/begin COMPU_VTAB FORMULA_0490_VTAB "FORMULA_0490_VTAB" TAB_VERB 2 0 "AT kein Eingriff Schub" 1 "AT Eingriff Schub" /end COMPU_VTAB
/begin COMPU_METHOD FORMULA_0492 "FORMULA_0492" RAT_FUNC "%10.3" "Nm/trmp" COEFFS 0 1000 0 0 0 1 /end COMPU_METHOD
/begin COMPU_METHOD FORMULA_0493 "FORMULA_0493" TAB_VERB "%3.0" "-" COMPU_TAB_REF FORMULA_0493_VTAB /end COMPU_METHOD
/begin COMPU_VTAB FORMULA_0493_VTAB "FORMULA_0493_VTAB" TAB_VERB 2 0 "inaktiv" 1 "aktiv" /end COMPU_VTAB
/begin COMPU_METHOD FORMULA_0494 "FORMULA_0494" RAT_FUNC "%8.1" "trmp" COEFFS 0 16 0 0 0 1 /end COMPU_METHOD
/begin COMPU_METHOD FORMULA_0497 "FORMULA_0497" RAT_FUNC "%7.2" "-" COEFFS 0 100 0 0 0 1 /end COMPU_METHOD
/begin COMPU_METHOD FORMULA_0499 "FORMULA_0499" RAT_FUNC "%8.3" "s" COEFFS 0 1000 0 0 0 1 /end COMPU_METHOD
/* ------------------ Abschnitt erzeugt aus auss.dat ------------------ */
/begin COMPU_METHOD FORMULA_0500 "FORMULA_0500" TAB_VERB "%3.0" "-" COMPU_TAB_REF FORMULA_0500_VTAB /end COMPU_METHOD
/begin COMPU_VTAB FORMULA_0500_VTAB "FORMULA_0500_VTAB" TAB_VERB 1 0 "Erster Intervall 1" DEFAULT_VALUE "Folge Intervalle" /end COMPU_VTAB
/begin COMPU_METHOD FORMULA_0501 "FORMULA_0501" RAT_FUNC "%4.1" "s" COEFFS 0 10 0 0 0 1 /end COMPU_METHOD
/begin COMPU_METHOD FORMULA_0503 "FORMULA_0503" TAB_VERB "%5.0" "-" COMPU_TAB_REF FORMULA_0503_VTAB /end COMPU_METHOD
/begin COMPU_VTAB FORMULA_0503_VTAB "FORMULA_0503_VTAB" TAB_VERB 1 0 "Ausschwingen ok." DEFAULT_VALUE "Fehler Ausschwingen." /end COMPU_VTAB
/begin COMPU_METHOD FORMULA_0504 "FORMULA_0504" TAB_VERB "%5.0" "-" COMPU_TAB_REF FORMULA_0504_VTAB /end COMPU_METHOD
/begin COMPU_VTAB FORMULA_0504_VTAB "FORMULA_0504_VTAB" TAB_VERB 1 0 "Zyl. 1 ok." DEFAULT_VALUE "Fehler Ausschw. Zyl. 1." /end COMPU_VTAB
/begin COMPU_METHOD FORMULA_0505 "FORMULA_0505" TAB_VERB "%5.0" "-" COMPU_TAB_REF FORMULA_0505_VTAB /end COMPU_METHOD
/begin COMPU_VTAB FORMULA_0505_VTAB "FORMULA_0505_VTAB" TAB_VERB 1 0 "Zyl. 2 ok." DEFAULT_VALUE "Fehler Ausschw. Zyl. 2." /end COMPU_VTAB
/begin COMPU_METHOD FORMULA_0506 "FORMULA_0506" TAB_VERB "%5.0" "-" COMPU_TAB_REF FORMULA_0506_VTAB /end COMPU_METHOD
/begin COMPU_VTAB FORMULA_0506_VTAB "FORMULA_0506_VTAB" TAB_VERB 1 0 "Zyl. 3 ok." DEFAULT_VALUE "Fehler Ausschw. Zyl. 3." /end COMPU_VTAB
/begin COMPU_METHOD FORMULA_0507 "FORMULA_0507" TAB_VERB "%5.0" "-" COMPU_TAB_REF FORMULA_0507_VTAB /end COMPU_METHOD
/begin COMPU_VTAB FORMULA_0507_VTAB "FORMULA_0507_VTAB" TAB_VERB 1 0 "Zyl. 4 ok." DEFAULT_VALUE "Fehler Ausschw. Zyl. 4." /end COMPU_VTAB
/begin COMPU_METHOD FORMULA_0508 "FORMULA_0508" TAB_VERB "%5.0" "-" COMPU_TAB_REF FORMULA_0508_VTAB /end COMPU_METHOD
/begin COMPU_VTAB FORMULA_0508_VTAB "FORMULA_0508_VTAB" TAB_VERB 1 0 "Zyl. 5 ok." DEFAULT_VALUE "Fehler Ausschw. Zyl. 5." /end COMPU_VTAB
/begin COMPU_METHOD FORMULA_0509 "FORMULA_0509" TAB_VERB "%5.0" "-" COMPU_TAB_REF FORMULA_0509_VTAB /end COMPU_METHOD
/begin COMPU_VTAB FORMULA_0509_VTAB "FORMULA_0509_VTAB" TAB_VERB 1 0 "Zyl. 6 ok." DEFAULT_VALUE "Fehler Ausschw. Zyl. 6." /end COMPU_VTAB
/begin COMPU_METHOD FORMULA_0510 "FORMULA_0510" TAB_VERB "%5.0" "-" COMPU_TAB_REF FORMULA_0510_VTAB /end COMPU_METHOD
/begin COMPU_VTAB FORMULA_0510_VTAB "FORMULA_0510_VTAB" TAB_VERB 1 0 "Zyl. 7 ok." DEFAULT_VALUE "Fehler Ausschw. Zyl. 7." /end COMPU_VTAB
/begin COMPU_METHOD FORMULA_0511 "FORMULA_0511" TAB_VERB "%5.0" "-" COMPU_TAB_REF FORMULA_0511_VTAB /end COMPU_METHOD
/begin COMPU_VTAB FORMULA_0511_VTAB "FORMULA_0511_VTAB" TAB_VERB 1 0 "Zyl. 8 ok." DEFAULT_VALUE "Fehler Ausschw. Zyl. 8." /end COMPU_VTAB
/begin COMPU_METHOD FORMULA_0512 "FORMULA_0512" TAB_VERB "%5.0" "-" COMPU_TAB_REF FORMULA_0512_VTAB /end COMPU_METHOD
/begin COMPU_VTAB FORMULA_0512_VTAB "FORMULA_0512_VTAB" TAB_VERB 1 0 "Zyl. 9 ok." DEFAULT_VALUE "Fehler Ausschw. Zyl. 9." /end COMPU_VTAB
/begin COMPU_METHOD FORMULA_0571 "FORMULA_0571" RAT_FUNC "%5.0" "Nm/s" COEFFS 0 1 0 0 0 20 /end COMPU_METHOD
/begin COMPU_METHOD FORMULA_0679 "FORMULA_0679" RAT_FUNC "%5.2" "s" COEFFS 0 0 25.6 0 1 0 /end COMPU_METHOD
/begin COMPU_METHOD FORMULA_0704 "FORMULA_0704" RAT_FUNC "%5.2" "-" COEFFS 0 128 0 0 0 1 /end COMPU_METHOD
/begin COMPU_METHOD FORMULA_0737 "FORMULA_0737" TAB_VERB "%3.0" "-" COMPU_TAB_REF FORMULA_0737_VTAB /end COMPU_METHOD
/begin COMPU_VTAB FORMULA_0737_VTAB "FORMULA_0737_VTAB" TAB_VERB 2 0 "Aus" 1 "Aktiv" /end COMPU_VTAB
/begin COMPU_METHOD FORMULA_0738 "FORMULA_0738" RAT_FUNC "%7.2" "Upm/s" COEFFS 0 1 0 0 0 200 /end COMPU_METHOD
/begin COMPU_METHOD FORMULA_0744 "FORMULA_0744" TAB_VERB "%5.2" "-" COMPU_TAB_REF FORMULA_0744_VTAB /end COMPU_METHOD
/begin COMPU_VTAB FORMULA_0744_VTAB "FORMULA_0744_VTAB" TAB_VERB 4 0 "nie" 1 "MKS" 2 "OKS" 3 "beide" /end COMPU_VTAB
/begin COMPU_METHOD FORMULA_0745 "FORMULA_0745" TAB_VERB "%5.2" "-" COMPU_TAB_REF FORMULA_0745_VTAB /end COMPU_METHOD
/begin COMPU_VTAB FORMULA_0745_VTAB "FORMULA_0745_VTAB" TAB_VERB 4 0 "Keiner" 1 "Reib" 2 "Start" 3 "Reib+Start" /end COMPU_VTAB
/begin COMPU_METHOD FORMULA_0746 "FORMULA_0746" RAT_FUNC "%3.0" "Upm" COEFFS 0 1 0 0 0 1 /end COMPU_METHOD
/begin COMPU_METHOD FORMULA_0747 "FORMULA_0747" RAT_FUNC "%5.0" "Upm/s" COEFFS 0 1 0 0 0 10 /end COMPU_METHOD
/begin COMPU_METHOD FORMULA_0748 "FORMULA_0748" RAT_FUNC "%3.0" "Nm/s" COEFFS 0 1 0 0 0 1 /end COMPU_METHOD
/begin COMPU_METHOD FORMULA_0749 "FORMULA_0749" RAT_FUNC "%4.1" "Nm" COEFFS 0 10 0 0 0 1 /end COMPU_METHOD
/begin COMPU_METHOD FORMULA_0750 "FORMULA_0750" RAT_FUNC "%9.4" "Nm/s" COEFFS 0 2000 0 0 0 1 /end COMPU_METHOD
/begin COMPU_METHOD FORMULA_0751 "FORMULA_0751" RAT_FUNC "%6.1" "Nm/s" COEFFS 0 5 0 0 0 1 /end COMPU_METHOD
/begin COMPU_METHOD FORMULA_0753 "FORMULA_0753" TAB_VERB "%5.2" "-" COMPU_TAB_REF FORMULA_0753_VTAB /end COMPU_METHOD
/begin COMPU_VTAB FORMULA_0753_VTAB "FORMULA_0753_VTAB" TAB_VERB 4 0 "Aus" 1 "Ein" 2 "Ein o.TE" 255 "Init" /end COMPU_VTAB
/begin COMPU_METHOD FORMULA_0754 "FORMULA_0754" RAT_FUNC "%5.2" "s" COEFFS 0 0 256 0 1 0 /end COMPU_METHOD
/begin COMPU_METHOD FORMULA_0755 "FORMULA_0755" RAT_FUNC "%6.1" "Nm/s" COEFFS 0 10 0 0 0 1 /end COMPU_METHOD
/* ------------------ Abschnitt erzeugt aus lu.dat ------------------ */
/begin COMPU_METHOD FORMULA_0756 "FORMULA_0756" RAT_FUNC "%7.2" "0/oo" COEFFS 0 65.536 0 0 0 1 /end COMPU_METHOD
/begin COMPU_METHOD FORMULA_0773 "FORMULA_0773" RAT_FUNC "%6.1" "Nm/Segm" COEFFS 0 10 0 0 0 1 /end COMPU_METHOD
/begin COMPU_METHOD FORMULA_0774 "FORMULA_0774" RAT_FUNC "%3.0" "Segm" COEFFS 0 1 0 0 0 1 /end COMPU_METHOD
/begin COMPU_METHOD FORMULA_0777 "FORMULA_0777" RAT_FUNC "%3.0" "KW-Zahn" COEFFS 0 1 0 0 0 1 /end COMPU_METHOD
/begin COMPU_METHOD FORMULA_0778 "FORMULA_0778" RAT_FUNC "%5.0" "2*U" COEFFS 0 1 0 0 0 1 /end COMPU_METHOD
/begin COMPU_METHOD FORMULA_0779 "FORMULA_0779" TAB_VERB "%5.2" "-" COMPU_TAB_REF FORMULA_0779_VTAB /end COMPU_METHOD
/begin COMPU_VTAB FORMULA_0779_VTAB "FORMULA_0779_VTAB" TAB_VERB 2 0 "OHNE LU" 1 "MIT LU" DEFAULT_VALUE "undef." /end COMPU_VTAB
/begin COMPU_METHOD FORMULA_0780 "FORMULA_0780" RAT_FUNC "%5.2" "-" COEFFS 0 32 0 0 0 1 /end COMPU_METHOD
/begin COMPU_METHOD FORMULA_0781 "FORMULA_0781" RAT_FUNC "%6.1" "�/Segm" COEFFS 0 10 0 0 0 1 /end COMPU_METHOD
/begin COMPU_METHOD FORMULA_0782 "FORMULA_0782" RAT_FUNC "%9.4" "1/2U" COEFFS 0 4048 0 0 0 1 /end COMPU_METHOD
/begin COMPU_METHOD FORMULA_0783 "FORMULA_0783" RAT_FUNC "%5.0" "Segm." COEFFS 0 1 0 0 0 1 /end COMPU_METHOD
/* ------------------ Abschnitt erzeugt aus md_basis.dat ------------------ */
/begin COMPU_METHOD FORMULA_0784 "FORMULA_0784" RAT_FUNC "%6.1" "Nm" COEFFS 0 100 0 0 0 1 /end COMPU_METHOD
/begin COMPU_METHOD FORMULA_0785 "FORMULA_0785" RAT_FUNC "%7.2" "Nm/s" COEFFS 0 10 0 0 0 1 /end COMPU_METHOD
/begin COMPU_METHOD FORMULA_0786 "FORMULA_0786" RAT_FUNC "%7.2" "10E-4" COEFFS 0 100 0 0 0 1 /end COMPU_METHOD
/begin COMPU_METHOD FORMULA_0787 "FORMULA_0787" TAB_VERB "%5.2" "-" COMPU_TAB_REF FORMULA_0787_VTAB /end COMPU_METHOD
/begin COMPU_VTAB FORMULA_0787_VTAB "FORMULA_0787_VTAB" TAB_VERB 2 0 "ohne KR" 1 "mit KR" /end COMPU_VTAB
/begin COMPU_METHOD FORMULA_0788 "FORMULA_0788" TAB_VERB "%3.0" "-" COMPU_TAB_REF FORMULA_0788_VTAB /end COMPU_METHOD
/begin COMPU_VTAB FORMULA_0788_VTAB "FORMULA_0788_VTAB" TAB_VERB 7 0 "ohne Korr" 1 "TZ bei KH" 2 "RF bei KH" 3 "bei KH" 4 "TZ immer" 8 "RF immer" 12 "immer" /end COMPU_VTAB
/begin COMPU_METHOD FORMULA_0789 "FORMULA_0789" RAT_FUNC "%5.2" "1/sec" COEFFS 0 1024 0 0 0 200 /end COMPU_METHOD
/begin COMPU_METHOD FORMULA_0790 "FORMULA_0790" TAB_VERB "%3.0" "-" COMPU_TAB_REF FORMULA_0790_VTAB /end COMPU_METHOD
/begin COMPU_VTAB FORMULA_0790_VTAB "FORMULA_0790_VTAB" TAB_VERB 2 0 "aus" 1 "ein" /end COMPU_VTAB
/begin COMPU_METHOD FORMULA_0791 "FORMULA_0791" RAT_FUNC "%5.0" "�/sec" COEFFS 0 1 0 0 0 20 /end COMPU_METHOD
/begin COMPU_METHOD FORMULA_0792 "FORMULA_0792" RAT_FUNC "%7.2" "-" COEFFS 0 128 0 0 0 1 /end COMPU_METHOD
/begin COMPU_METHOD FORMULA_0793 "FORMULA_0793" RAT_FUNC "%6.1" "ms" COEFFS 0 10 0 0 0 1 /end COMPU_METHOD
/begin COMPU_METHOD FORMULA_0798 "FORMULA_0798" TAB_VERB "%3.0" "-" COMPU_TAB_REF FORMULA_0798_VTAB /end COMPU_METHOD
/begin COMPU_VTAB FORMULA_0798_VTAB "FORMULA_0798_VTAB" TAB_VERB 2 0 "gesperrt" 1 "frei" DEFAULT_VALUE "ungueltig" /end COMPU_VTAB
/begin COMPU_METHOD FORMULA_0799 "FORMULA_0799" RAT_FUNC "%3.0" "Nm/s" COEFFS 0 1 0 0 0 10 /end COMPU_METHOD
/begin COMPU_METHOD FORMULA_0800 "FORMULA_0800" RAT_FUNC "%3.0" "Nm/s" COEFFS 0 -1 0 0 0 10 /end COMPU_METHOD
/begin COMPU_METHOD FORMULA_0803 "FORMULA_0803" RAT_FUNC "%5.0" "Nm" COEFFS 0 10 0 0 0 1 /end COMPU_METHOD
/begin COMPU_METHOD FORMULA_0811 "FORMULA_0811" RAT_FUNC "%5.0" "Nm/s" COEFFS 0 1 0 0 0 1 /end COMPU_METHOD
/begin COMPU_METHOD FORMULA_0813 "FORMULA_0813" TAB_VERB "%3.0" "-" COMPU_TAB_REF FORMULA_0813_VTAB /end COMPU_METHOD
/begin COMPU_VTAB FORMULA_0813_VTAB "FORMULA_0813_VTAB" TAB_VERB 3 0 "aus" 1 "bei KS" 2 "immer" /end COMPU_VTAB
/begin COMPU_METHOD FORMULA_0814 "FORMULA_0814" RAT_FUNC "%5.0" "-" COEFFS 0 -1 1 0 0 -1 /end COMPU_METHOD
/begin COMPU_METHOD FORMULA_0816 "FORMULA_0816" RAT_FUNC "%7.2" "Nm/Upm" COEFFS 0 100 0 0 0 1 /end COMPU_METHOD
/begin COMPU_METHOD FORMULA_0818 "FORMULA_0818" TAB_VERB "%5.2" "-" COMPU_TAB_REF FORMULA_0818_VTAB /end COMPU_METHOD
/begin COMPU_VTAB FORMULA_0818_VTAB "FORMULA_0818_VTAB" TAB_VERB 2 0 "Bezug=Sollmoment" 1 "Bezug=Istmoment" /end COMPU_VTAB
/begin COMPU_METHOD FORMULA_0823 "FORMULA_0823" TAB_VERB "%5.2" "-" COMPU_TAB_REF FORMULA_0823_VTAB /end COMPU_METHOD
/begin COMPU_VTAB FORMULA_0823_VTAB "FORMULA_0823_VTAB" TAB_VERB 4 0 "Inaktiv" 1 "md_rf_soll" 2 "md_tz_soll" 4 "md_ind_wunsch_tz" /end COMPU_VTAB
/begin COMPU_METHOD FORMULA_0824 "FORMULA_0824" TAB_VERB "%5.2" "-" COMPU_TAB_REF FORMULA_0824_VTAB /end COMPU_METHOD
/begin COMPU_VTAB FORMULA_0824_VTAB "FORMULA_0824_VTAB" TAB_VERB 4 0 "immer aus" 1 "Eingr, LL, nicht LL-KH" 2 "immer ein" 3 "Eingr, LL, LL-KH" /end COMPU_VTAB
/begin COMPU_METHOD FORMULA_0825 "FORMULA_0825" TAB_VERB "%5.2" "-" COMPU_TAB_REF FORMULA_0825_VTAB /end COMPU_METHOD
/begin COMPU_VTAB FORMULA_0825_VTAB "FORMULA_0825_VTAB" TAB_VERB 7 0 "Inaktiv" 1 "EtaStat" 2 "EtaKh" 3 "EtaKr" 4 "EtaKrKh" 5 "EtaStat+ResKh" 6 "EtaKr+ResKh" /end COMPU_VTAB
/begin COMPU_METHOD FORMULA_0826 "FORMULA_0826" TAB_VERB "%5.2" "-" COMPU_TAB_REF FORMULA_0826_VTAB /end COMPU_METHOD
/begin COMPU_VTAB FORMULA_0826_VTAB "FORMULA_0826_VTAB" TAB_VERB 2 0 "Inaktiv" 1 "Aktiv" DEFAULT_VALUE "undef" /end COMPU_VTAB
/begin COMPU_METHOD FORMULA_0827 "FORMULA_0827" RAT_FUNC "%3.0" "Nm/s" COEFFS 0 1 0 0 0 20 /end COMPU_METHOD
/begin COMPU_METHOD FORMULA_0828 "FORMULA_0828" RAT_FUNC "%5.2" "Upm/s" COEFFS 0 1 0 0 0 200 /end COMPU_METHOD
/begin COMPU_METHOD FORMULA_0829 "FORMULA_0829" RAT_FUNC "%3.0" "Gang" COEFFS 0 1 0 0 0 1 /end COMPU_METHOD
/begin COMPU_METHOD FORMULA_0830 "FORMULA_0830" TAB_VERB "%5.2" "-" COMPU_TAB_REF FORMULA_0830_VTAB /end COMPU_METHOD
/begin COMPU_VTAB FORMULA_0830_VTAB "FORMULA_0830_VTAB" TAB_VERB 4 0 "Inaktiv" 1 "mit TE" 2 "mit MVAC" 3 "mit TE+MVAC" /end COMPU_VTAB
/begin COMPU_METHOD FORMULA_0831 "FORMULA_0831" RAT_FUNC "%7.2" "Upm/s" COEFFS 0 16 0 0 0 200 /end COMPU_METHOD
/begin COMPU_METHOD FORMULA_0832 "FORMULA_0832" RAT_FUNC "%6.1" "�/ASP" COEFFS 0 10 0 0 0 1 /end COMPU_METHOD
/begin COMPU_METHOD FORMULA_0833 "FORMULA_0833" RAT_FUNC "%8.3" "sec" COEFFS 0 1000 0 0 0 1 /end COMPU_METHOD
/begin COMPU_METHOD FORMULA_0834 "FORMULA_0834" RAT_FUNC "%7.2" "Nm/kmh" COEFFS 0 100 0 0 0 1 /end COMPU_METHOD
/begin COMPU_METHOD FORMULA_0980 "FORMULA_0980" RAT_FUNC "%7.2" "Kelvin" COEFFS 0 20 0 0 0 1 /end COMPU_METHOD
/begin COMPU_METHOD FORMULA_0986 "FORMULA_0986" RAT_FUNC "%7.2" "min" COEFFS 0 60 0 0 0 1 /end COMPU_METHOD
/* ------------------ Abschnitt erzeugt aus tan.dat ------------------ */
/begin COMPU_METHOD FORMULA_0987 "FORMULA_0987" RAT_FUNC "%8.3" "�C" COEFFS 0 40 10926 0 0 1 /end COMPU_METHOD
/begin COMPU_METHOD FORMULA_0997 "FORMULA_0997" RAT_FUNC "%5.0" "Kelvin/s" COEFFS 0 1 0 0 0 1 /end COMPU_METHOD
/begin COMPU_METHOD FORMULA_1015 "FORMULA_1015" RAT_FUNC "%7.2" "Kelvin" COEFFS 0 40 0 0 0 1 /end COMPU_METHOD
/begin COMPU_METHOD FORMULA_1016 "FORMULA_1016" RAT_FUNC "%7.2" "Kelvin/s" COEFFS 0 4 0 0 0 1 /end COMPU_METHOD
/begin COMPU_METHOD FORMULA_1017 "FORMULA_1017" RAT_FUNC "%7.2" "K/100ms" COEFFS 0 40 0 0 0 1 /end COMPU_METHOD
/begin COMPU_METHOD FORMULA_1018 "FORMULA_1018" TAB_VERB "%3.0" "-" COMPU_TAB_REF FORMULA_1018_VTAB /end COMPU_METHOD
/begin COMPU_VTAB FORMULA_1018_VTAB "FORMULA_1018_VTAB" TAB_VERB 2 0 "OBD aus" 1 "OBD ein" /end COMPU_VTAB
/begin COMPU_METHOD FORMULA_1019 "FORMULA_1019" RAT_FUNC "%6.1" "s" COEFFS 0 100 0 0 0 1 /end COMPU_METHOD
/begin COMPU_METHOD FORMULA_1020 "FORMULA_1020" TAB_VERB "%5.2" "-" COMPU_TAB_REF FORMULA_1020_VTAB /end COMPU_METHOD
/begin COMPU_VTAB FORMULA_1020_VTAB "FORMULA_1020_VTAB" TAB_VERB 2 0 "toel" 1 "Oz_tempr" /end COMPU_VTAB
/begin COMPU_METHOD FORMULA_1021 "FORMULA_1021" RAT_FUNC "%4.1" "Kelvin" COEFFS 0 10 0 0 0 1 /end COMPU_METHOD
/begin COMPU_METHOD FORMULA_1023 "FORMULA_1023" RAT_FUNC "%9.4" "Kelvin" COEFFS 0 10000 0 0 0 1 /end COMPU_METHOD
/begin COMPU_METHOD FORMULA_1024 "FORMULA_1024" RAT_FUNC "%7.2" "min" COEFFS 0 1 0 0 0 1 /end COMPU_METHOD
/begin COMPU_METHOD FORMULA_1025 "FORMULA_1025" RAT_FUNC "%7.2" "Anteil [0..1]" COEFFS 0 100 0 0 0 1 /end COMPU_METHOD
/* ------------------ Abschnitt erzeugt aus os.dat ------------------ */ /* ------------------ Abschnitt erzeugt aus pctrl.dat ------------------ */
/begin CHARACTERISTIC K_PCTRL_TIMEOUT "Timeout der Prozessorueberwachung | EN: Timeout der Prozessorueberwachung" VALUE 0x786AC TKW_VV_VV_UB 100.0 FORMULA_0353 0.0 2550.0000 /end CHARACTERISTIC
/begin CHARACTERISTIC K_PCTRL_TASK_ZYKL "Task-Ueberwachungszyklus | EN: Task-Ueberwachungszyklus" VALUE 0x786AD TKW_VV_VV_UB 100.0 FORMULA_0352 0.0 1.2750 /end CHARACTERISTIC
/begin CHARACTERISTIC K_PCTRL_PROZ_ZYKL "Prozess-Ueberwachungszyklus | EN: Prozess-Ueberwachungszyklus" VALUE 0x786AE TKW_VV_VV_UB 100.0 FORMULA_0352 0.0 1.2750 /end CHARACTERISTIC
/* ------------------ Abschnitt erzeugt aus kus.dat ------------------ */
/begin CHARACTERISTIC K_KUS_CFG "Schalter Konfiguration Kupplungsschlupfregelung | EN: Schalter Konfiguration Kupplungsschlupfregelung" VALUE 0x748FE TKW_VV_VV_UB 100.0 FORMULA_0737 0.0 255.0 /end CHARACTERISTIC
/begin CHARACTERISTIC K_KUS_STUFE "Eingriffsstufe Kupplungsschlupfregelung | EN: Eingriffsstufe Kupplungsschlupfregelung" VALUE 0x748FF TKW_VV_VV_UB 100.0 FORMULA_0003 0.0 255.0000 /end CHARACTERISTIC
/begin CHARACTERISTIC K_KUS_N_DELTA_EIN "Begrenzung Abregelrampe Motordrehzahl | EN: Begrenzung Abregelrampe Motordrehzahl" VALUE 0x74900 TKW_VV_VV_UW 100.0 FORMULA_0738 0.0 20000.0000 FORMAT "%5.2" /end CHARACTERISTIC
/begin CHARACTERISTIC K_KUS_N_DELTA_AUS "Begrenzung Abregelrampe Motordrehzahl | EN: Begrenzung Abregelrampe Motordrehzahl" VALUE 0x74902 TKW_VV_VV_UW 100.0 FORMULA_0738 0.0 20000.0000 FORMAT "%5.2" /end CHARACTERISTIC
/begin CHARACTERISTIC K_KUS_GANG_MAX "maximaler Gang, bei dem noch eine Freigabe erfolgt | EN: maximaler Gang, bei dem noch eine Freigabe erfolgt" VALUE 0x74904 TKW_VV_VV_SB 100.0 FORMULA_0318 -1.0000 10.0000 /end CHARACTERISTIC
/begin CHARACTERISTIC K_KUS_N_GETR_EIN_MIN "minimale Getriebeeingangsdrehzahl KUS Timer | EN: minimale Getriebeeingangsdrehzahl KUS Timer" VALUE 0x74906 TKW_VV_VV_SW 100.0 FORMULA_0006 0.0 10000.0000 /end CHARACTERISTIC
/begin CHARACTERISTIC K_KUS_N_GETR_EIN_HYS "Hysterese minimale Getriebeeingangsdrehzahl KUS Timer | EN: Hysterese minimale Getriebeeingangsdrehzahl KUS Timer" VALUE 0x74908 TKW_VV_VV_SW 100.0 FORMULA_0006 0.0 10000.0000 /end CHARACTERISTIC
/begin CHARACTERISTIC K_KUS_N_MIN "minimale Motordrehzahl KUS Timer | EN: minimale Motordrehzahl KUS Timer" VALUE 0x7490A TKW_VV_VV_SW 100.0 FORMULA_0006 0.0 10000.0000 /end CHARACTERISTIC
/begin CHARACTERISTIC K_KUS_N_HYS "Hysterese minimale Motordrehzahl KUS Timer | EN: Hysterese minimale Motordrehzahl KUS Timer" VALUE 0x7490C TKW_VV_VV_SW 100.0 FORMULA_0006 0.0 10000.0000 /end CHARACTERISTIC
/begin CHARACTERISTIC K_KUS_V_VORNE_MAX "maximale Geschwindigkeit, bei der noch Freigabe | EN: maximale Geschwindigkeit, bei der noch Freigabe" VALUE 0x7490E TKW_VV_VV_SW 100.0 FORMULA_0078 -80.0000 360.0000 FORMAT "%4.1" /end CHARACTERISTIC
/begin CHARACTERISTIC K_KUS_V_VORNE_HYS "Hysterese maximale Geschwindigkeit, bei der noch Freigabe | EN: Hysterese maximale Geschwindigkeit, bei der noch Freigabe" VALUE 0x74910 TKW_VV_VV_SW 100.0 FORMULA_0078 -80.0000 360.0000 FORMAT "%4.1" /end CHARACTERISTIC
/begin CHARACTERISTIC KL_KUS_SCHLUPF_MAX "zulaessiger Kupplungsschlupf | EN: Permitted clutch slip" CURVE 0x74912 TKL_UB_VV_SW 100.0 FORMULA_0006 0.0 10000.0000 /begin AXIS_DESCR STD_AXIS Kusstufe FORMULA_0003 6 0.0 255.0000 /end AXIS_DESCR /end CHARACTERISTIC
/begin CHARACTERISTIC KL_KUS_GANG_FAK "Ganganteil abh. vom Schlupf | EN: Gear share depending on slip" CURVE 0x74926 TKL_SW_VV_SW 100.0 FORMULA_0075 -1.0000 10.0000 /begin AXIS_DESCR STD_AXIS Schlupf FORMULA_0006 4 0.0 10000.0000 /end AXIS_DESCR FORMAT "%6.3" /end CHARACTERISTIC
/begin CHARACTERISTIC KL_KUS_N_MIN_AFZ "untere Motordrehzahl abh. von der Steigung | EN: Lower engine speed depending on gradient (incline)" CURVE 0x74938 TKL_SW_VV_SW 100.0 FORMULA_0006 0.0 10000.0000
 /begin AXIS_DESCR STD_AXIS Laengsbeschleunigung FORMULA_0132 4 -50.0000 50.0000 FORMAT "%5.2" /end AXIS_DESCR
/end CHARACTERISTIC
/begin CHARACTERISTIC KF_KUS_N_MIN "untere Begrenzung maximale Motordrehzahl | EN: Lower limit of maximum engine speed" MAP 0x7494A TKF_SW_SW_SW 100.0 FORMULA_0006 0.0 10000.0000 /begin AXIS_DESCR STD_AXIS Timer FORMULA_0117 4 0.0 160.0000 FORMAT "%5.2" /end AXIS_DESCR /begin AXIS_DESCR STD_AXIS FORMULA_0006 4 -10000.0000 10000.0000 /end AXIS_DESCR /end CHARACTERISTIC
/* ------------------ Abschnitt erzeugt aus llr.dat ------------------ */
/begin CHARACTERISTIC K_LLR_CFG_N_NACHF "Konfiguration nachgef. nSoll" VALUE 0x7497C TKW_VV_VV_UB 100.0 FORMULA_0744 0.0 255.0 /end CHARACTERISTIC
/begin CHARACTERISTIC K_LLR_CFG_MIN "Konfiguration Begr Min-Moment" VALUE 0x7497D TKW_VV_VV_UB 100.0 FORMULA_0745 0.0 255.0 /end CHARACTERISTIC
/begin CHARACTERISTIC K_LLR_N_EINGEREGELT "Schwelle fuer n eingeregelt | EN: Schwelle fuer n eingeregelt" VALUE 0x7497E TKW_VV_VV_UB 100.0 FORMULA_0746 0.0 100.0000 /end CHARACTERISTIC
/begin CHARACTERISTIC K_LLR_N_SOLL_TAU "Filter Solldrehzahl | EN: Filter Solldrehzahl" VALUE 0x7497F TKW_VV_VV_UB 100.0 FORMULA_0679 0.1004 25.6000 /end CHARACTERISTIC
/begin CHARACTERISTIC K_LLR_N_OFFSET_B1 "Offset fuer Start IA_B1 | EN: Offset fuer Start IA_B1" VALUE 0x74980 TKW_VV_VV_SW 100.0 FORMULA_0006 0.0 10000.0000 /end CHARACTERISTIC
/begin CHARACTERISTIC K_LLR_N_OFFSET_B2 "Offset fuer Start IA_B2 | EN: Offset fuer Start IA_B2" VALUE 0x74982 TKW_VV_VV_SW 100.0 FORMULA_0006 0.0 10000.0000 /end CHARACTERISTIC
/begin CHARACTERISTIC K_LLR_PWG_ANFAHR "PWG-Schwelle" VALUE 0x74984 TKW_VV_VV_SW 100.0 FORMULA_0001 -10.0000 120.0000 FORMAT "%4.1" /end CHARACTERISTIC
/begin CHARACTERISTIC K_LLR_N_KATH_AUFR "Kath-Aufregelrampe" VALUE 0x74986 TKW_VV_VV_UW 100.0 FORMULA_0747 0.0 655350.0000 /end CHARACTERISTIC
/begin CHARACTERISTIC K_LLR_N_KATH_ABR "Kath-Abregelrampe" VALUE 0x74988 TKW_VV_VV_UW 100.0 FORMULA_0747 0.0 655350.0000 /end CHARACTERISTIC
/begin CHARACTERISTIC K_LLR_N_SOLL_AC_OFFSET "Offset durch Klima | EN: Offset durch Klima" VALUE 0x7498A TKW_VV_VV_SW 100.0 FORMULA_0006 0.0 10000.0000 /end CHARACTERISTIC
/begin CHARACTERISTIC K_LLR_N_SOLL_ZH_OFFSET "Offset durch Zusatzheizung | EN: Offset durch Zusatzheizung" VALUE 0x7498C TKW_VV_VV_SW 100.0 FORMULA_0006 0.0 10000.0000 /end CHARACTERISTIC
/begin CHARACTERISTIC K_LLR_N_SOLL_MIN "min. Solldrehzahl | EN: min. Solldrehzahl" VALUE 0x7498E TKW_VV_VV_SW 100.0 FORMULA_0006 0.0 10000.0000 /end CHARACTERISTIC
/begin CHARACTERISTIC K_LLR_N_SOLL_MAX "max. Solldrehzahl | EN: max. Solldrehzahl" VALUE 0x74990 TKW_VV_VV_SW 100.0 FORMULA_0006 0.0 10000.0000 /end CHARACTERISTIC
/begin CHARACTERISTIC K_LLR_N_SOLL_NF_FAKTOR "Faktor Nachf�hrsolldrehzahl | EN: Faktor Nachführsolldrehzahl" VALUE 0x74992 TKW_VV_VV_UW 100.0 FORMULA_0075 0.0 4.0000 FORMAT "%6.3" /end CHARACTERISTIC
/begin CHARACTERISTIC K_LLR_N_SOLL_NF_MAX "max. Nachf�hrsolldrehzahl | EN: max. Nachführsolldrehzahl" VALUE 0x74994 TKW_VV_VV_SW 100.0 FORMULA_0006 0.0 10000.0000 /end CHARACTERISTIC
/begin CHARACTERISTIC K_LLR_IA_B1_ABR "Absteuerrampe B1 | EN: Absteuerrampe B1" VALUE 0x74996 TKW_VV_VV_UB 100.0 FORMULA_0748 0.0 255.0000 /end CHARACTERISTIC
/begin CHARACTERISTIC K_LLR_IA_B2_ABR "Absteuerrampe B2 | EN: Absteuerrampe B2" VALUE 0x74997 TKW_VV_VV_UB 100.0 FORMULA_0748 0.0 255.0000 /end CHARACTERISTIC
/begin CHARACTERISTIC K_LLR_MD_OKS_MIN "min. I-Anteil oKS | EN: min. I-Anteil oKS" VALUE 0x74998 TKW_VV_VV_SW 100.0 FORMULA_0009 -150.0000 0.0 FORMAT "%4.1" /end CHARACTERISTIC
/begin CHARACTERISTIC K_LLR_MD_OKS_MAX "max. I-Anteil oKS | EN: max. I-Anteil oKS" VALUE 0x7499A TKW_VV_VV_SW 100.0 FORMULA_0009 0.0 150.0000 FORMAT "%4.1" /end CHARACTERISTIC
/begin CHARACTERISTIC K_LLR_MD_MKS_MIN "min. I-Anteil mKS | EN: min. I-Anteil mKS" VALUE 0x7499C TKW_VV_VV_SW 100.0 FORMULA_0009 -150.0000 0.0 FORMAT "%4.1" /end CHARACTERISTIC
/begin CHARACTERISTIC K_LLR_MD_MKS_MAX "max. I-Anteil mKS | EN: max. I-Anteil mKS" VALUE 0x7499E TKW_VV_VV_SW 100.0 FORMULA_0009 0.0 150.0000 FORMAT "%4.1" /end CHARACTERISTIC
/begin CHARACTERISTIC K_LLR_D_GRAD "Aktivieren D-Anteil | EN: Activate derivative share [Upm/s]" VALUE 0x749A0 TKW_VV_VV_SW 100.0 FORMULA_0114 -10000.0000 10000.0000 /end CHARACTERISTIC
/begin CHARACTERISTIC K_LLR_D_OFFSET "Aktivieren D-Anteil | EN: Activate derivative share [Upm]" VALUE 0x749A2 TKW_VV_VV_SW 100.0 FORMULA_0006 0.0 10000.0000 /end CHARACTERISTIC
/begin CHARACTERISTIC K_LLR_N_RESET "Resetschwelle | EN: Resetschwelle" VALUE 0x749A4 TKW_VV_VV_SW 100.0 FORMULA_0006 0.0 10000.0000 /end CHARACTERISTIC
/begin CHARACTERISTIC K_LLR_MD_D_MIN "min. D-Anteil | EN: Minimum derivative share [Nm]" VALUE 0x749A6 TKW_VV_VV_SW 100.0 FORMULA_0009 -100.0000 1000.0000 FORMAT "%4.1" /end CHARACTERISTIC
/begin CHARACTERISTIC K_LLR_MD_D_MAX "max. D-Anteil oKS | EN: Maximum derivative share, clutch open [Nm]" VALUE 0x749A8 TKW_VV_VV_SW 100.0 FORMULA_0009 -100.0000 1000.0000 FORMAT "%4.1" /end CHARACTERISTIC
/begin CHARACTERISTIC K_LLR_N_KATH_HYS "n-Sollsprung ohne Rampe beim KH" VALUE 0x749AA TKW_VV_VV_SW 100.0 FORMULA_0006 0.0 10000.0000 /end CHARACTERISTIC
/begin CHARACTERISTIC K_LLR_OMEGA_TAU "Omega-Tau | EN: Omega-Tau" VALUE 0x749AC TKW_VV_VV_UB 100.0 FORMULA_0478 0.0051 1.2800 /end CHARACTERISTIC
/begin CHARACTERISTIC K_LLR_MD_RES_AUFR "Rampe fuer Reserve | EN: Rampe fuer Reserve" VALUE 0x749AD TKW_VV_VV_UB 100.0 FORMULA_0748 0.0 255.0000 /end CHARACTERISTIC
/begin CHARACTERISTIC K_LLR_MD_RES_WAIT "Wartezeit fuer Reserve | EN: Wartezeit fuer Reserve" VALUE 0x749AE TKW_VV_VV_UW 100.0 FORMULA_0021 0.0 655.0000 FORMAT "%5.2" /end CHARACTERISTIC
/begin CHARACTERISTIC K_LLR_MD_TZ_TAU "Filter LLR TZ-Eingriff | EN: Filter LLR TZ-Eingriff" VALUE 0x749B0 TKW_VV_VV_UB 100.0 FORMULA_0679 0.1004 25.6000 /end CHARACTERISTIC
/begin CHARACTERISTIC K_LLR_MD_TZ_RUECK_HYS "Hysterese TZ-Rueckfuehrung | EN: Hysterese TZ-Rueckfuehrung" VALUE 0x749B1 TKW_VV_VV_UB 100.0 FORMULA_0749 0.1000 20.0000 /end CHARACTERISTIC
/begin CHARACTERISTIC K_LLR_MD_TZ_RUECK_POS "Positive TZ-Rueckfuehrung | EN: Positive TZ-Rueckfuehrung" VALUE 0x749B2 TKW_VV_VV_SW 100.0 FORMULA_0750 0.0 15.0000 FORMAT "%7.4" /end CHARACTERISTIC
/begin CHARACTERISTIC K_LLR_MD_TZ_RUECK_NEG "Negative TZ-Rueckfuehrung | EN: Negative TZ-Rueckfuehrung" VALUE 0x749B4 TKW_VV_VV_SW 100.0 FORMULA_0750 0.0 15.0000 FORMAT "%7.4" /end CHARACTERISTIC
/begin CHARACTERISTIC K_LLR_TIME_FILOFF "Sperrzeit fuer KH-Filter" VALUE 0x749B6 TKW_VV_VV_UW 100.0 FORMULA_0021 0.0 655.0000 FORMAT "%5.2" /end CHARACTERISTIC
/begin CHARACTERISTIC K_LLR_DIAG_TMOT "Tmot-Schwelle | EN: Tmot-Schwelle" VALUE 0x749B8 TKW_VV_VV_SW 100.0 FORMULA_0023 -50.0000 170.0000 FORMAT "%4.1" /end CHARACTERISTIC
/begin CHARACTERISTIC K_LLR_DIAG_TOEL "Toel-Schwelle | EN: Toel-Schwelle" VALUE 0x749BA TKW_VV_VV_SW 100.0 FORMULA_0023 -50.0000 170.0000 FORMAT "%4.1" /end CHARACTERISTIC
/begin CHARACTERISTIC K_LLR_DIAG_FRA_MIN "min. Leckluftadaption" VALUE 0x749BC TKW_VV_VV_SW 100.0 FORMULA_0422 -50.0000 0.0 FORMAT "%5.2" /end CHARACTERISTIC
/begin CHARACTERISTIC K_LLR_DIAG_FRA_MAX "max. Leckluftadaption" VALUE 0x749BE TKW_VV_VV_SW 100.0 FORMULA_0422 0.0 50.0000 FORMAT "%5.2" /end CHARACTERISTIC
/begin CHARACTERISTIC K_LLR_DIAG_MD_FAK "Faktor auf min. Moment" VALUE 0x749C0 TKW_VV_VV_UW 100.0 FORMULA_0075 0.0 4.0000 FORMAT "%6.3" /end CHARACTERISTIC
/begin CHARACTERISTIC K_LLR_DIAG_MD_ERR_ABR "Absteuerrampe Fehlerfall | EN: Absteuerrampe Fehlerfall" VALUE 0x749C2 TKW_VV_VV_UB 100.0 FORMULA_0748 0.0 255.0000 /end CHARACTERISTIC
/begin CHARACTERISTIC K_LLR_DIAG_T "Diagnosezeit | EN: Diagnosezeit" VALUE 0x749C3 TKW_VV_VV_UB 100.0 FORMULA_0501 0.0 25.5000 /end CHARACTERISTIC
/begin CHARACTERISTIC K_LLR_DIAG_T_IO "Diagnosezeit iO" VALUE 0x749C4 TKW_VV_VV_UB 100.0 FORMULA_0501 0.0 25.5000 /end CHARACTERISTIC
/begin CHARACTERISTIC K_LLR_DIAG_N_ZU_GROSS "Schwelle fuer n zu gross | EN: Schwelle fuer n zu gross" VALUE 0x749C5 TKW_VV_VV_UB 100.0 FORMULA_0746 0.0 250.0000 /end CHARACTERISTIC
/begin CHARACTERISTIC K_LLR_DIAG_N_ZU_KLEIN "Schwelle fuer n zu klein | EN: Schwelle fuer n zu klein" VALUE 0x749C6 TKW_VV_VV_UB 100.0 FORMULA_0746 0.0 250.0000 /end CHARACTERISTIC
/begin CHARACTERISTIC K_LLR_DIAG_CSS_TMOT "Tmot-Schwelle | EN: Tmot-Schwelle" VALUE 0x749C8 TKW_VV_VV_SW 100.0 FORMULA_0023 -50.0000 170.0000 FORMAT "%4.1" /end CHARACTERISTIC
/begin CHARACTERISTIC K_LLR_DIAG_CSS_TOEL "Toel-Schwelle | EN: Toel-Schwelle" VALUE 0x749CA TKW_VV_VV_SW 100.0 FORMULA_0023 -50.0000 170.0000 FORMAT "%4.1" /end CHARACTERISTIC
/begin CHARACTERISTIC K_LLR_DIAG_CSS_N_ZU_GROSS "Schwelle fuer n zu gross | EN: Schwelle fuer n zu gross" VALUE 0x749CC TKW_VV_VV_UB 100.0 FORMULA_0746 0.0 250.0000 /end CHARACTERISTIC
/begin CHARACTERISTIC K_LLR_DIAG_CSS_N_ZU_KLEIN "Schwelle fuer n zu klein | EN: Schwelle fuer n zu klein" VALUE 0x749CD TKW_VV_VV_UB 100.0 FORMULA_0746 0.0 250.0000 /end CHARACTERISTIC
/begin CHARACTERISTIC K_LLR_DIAG_CSS_T "Diagnosezeit | EN: Diagnosezeit" VALUE 0x749CE TKW_VV_VV_UB 100.0 FORMULA_0501 0.0 25.5000 /end CHARACTERISTIC
/begin CHARACTERISTIC K_LLR_DIAG_CSS_T_IO "Diagnosezeit iO" VALUE 0x749CF TKW_VV_VV_UB 100.0 FORMULA_0501 0.0 25.5000 /end CHARACTERISTIC
/begin CHARACTERISTIC KL_LLR_N_SOLL_TMOT "Leerlaufdrehzahl ueber Tmot | EN: Idle speed over engine temperature [V912: differs from V452 160E]" CURVE 0x749D0 TKL_SW_VV_SW 100.0 FORMULA_0006 0.0 10000.0000 /begin AXIS_DESCR STD_AXIS FORMULA_0023 8 -50.0000 170.0000 FORMAT "%4.1" /end AXIS_DESCR /end CHARACTERISTIC
/begin CHARACTERISTIC KL_LLR_N_SOLL_TOEL_OFF "Offset ueber Toel | EN: Offset over oil temperature" CURVE 0x749F2 TKL_SW_VV_SW 100.0 FORMULA_0006 0.0 10000.0000 /begin AXIS_DESCR STD_AXIS FORMULA_0023 8 -50.0000 170.0000 FORMAT "%4.1" /end AXIS_DESCR /end CHARACTERISTIC
/begin CHARACTERISTIC KL_LLR_D_FAK_TOEL "D-Anteil | EN: Derivative share" CURVE 0x74A14 TKL_SW_VV_UW 100.0 FORMULA_0075 0.0 4.0000 /begin AXIS_DESCR STD_AXIS FORMULA_0023 8 -50.0000 170.0000 FORMAT "%4.1" /end AXIS_DESCR FORMAT "%6.3" /end CHARACTERISTIC
/begin CHARACTERISTIC KL_LLR_MD_RES_TMOT "Reserve ueber Tmot | EN: Reserve over engine temperature" CURVE 0x74A36 TKL_SW_VV_SW 100.0 FORMULA_0009 0.0 100.0000 /begin AXIS_DESCR STD_AXIS FORMULA_0023 8 -50.0000 170.0000 FORMAT "%4.1" /end AXIS_DESCR FORMAT "%4.1" /end CHARACTERISTIC
/begin CHARACTERISTIC KL_LLR_MD_TZ_OKS "LLR TZ-Eingriff | EN: Idle controller ignition intervention" CURVE 0x74A58 TKL_SW_VV_SW 100.0 FORMULA_0009 -40.0000 40.0000 /begin AXIS_DESCR STD_AXIS FORMULA_0006 9 -500.0000 500.0000 /end AXIS_DESCR FORMAT "%4.1" /end CHARACTERISTIC
/begin CHARACTERISTIC KL_LLR_MD_TZ_MKS "LLR TZ-Eingriff | EN: LLR TZ-Eingriff" CURVE 0x74A7E TKL_SW_VV_SW 100.0 FORMULA_0009 -40.0000 40.0000 /begin AXIS_DESCR STD_AXIS FORMULA_0006 9 -500.0000 500.0000 /end AXIS_DESCR FORMAT "%4.1" /end CHARACTERISTIC
/begin CHARACTERISTIC KL_LLR_MD_TZ_OKS_KH "LLR TZ-Eingriff bei KH | EN: LLR TZ-Eingriff bei KH" CURVE 0x74AA4 TKL_SW_VV_SW 100.0 FORMULA_0009 -40.0000 40.0000 /begin AXIS_DESCR STD_AXIS FORMULA_0006 9 -500.0000 500.0000 /end AXIS_DESCR FORMAT "%4.1" /end CHARACTERISTIC
/begin CHARACTERISTIC KL_LLR_MD_TZ_MKS_KH "LLR TZ-Eingriff bei KH | EN: Idle controller ignition intervention during catalyst heating" CURVE 0x74ACA TKL_SW_VV_SW 100.0 FORMULA_0009 -40.0000 40.0000 /begin AXIS_DESCR STD_AXIS FORMULA_0006 9 -500.0000 500.0000 /end AXIS_DESCR FORMAT "%4.1" /end CHARACTERISTIC
/begin CHARACTERISTIC KF_LLR_MD_I_POS_OKS "I-Anteil bei pos. Abweichung | EN: Integral share for positive deviation" MAP 0x74AF0 TKF_SW_SW_SW 100.0 FORMULA_0751 -50.0000 50.0000 /begin AXIS_DESCR STD_AXIS FORMULA_0006 8 0.0 5000.0000 /end AXIS_DESCR /begin AXIS_DESCR STD_AXIS FORMULA_0114 12 -10000.0000 10000.0000 /end AXIS_DESCR FORMAT "%4.1" /end CHARACTERISTIC
/begin CHARACTERISTIC KF_LLR_MD_I_NEG_OKS "I-Anteil bei neg. Abweichung | EN: Integral share for negative deviation" MAP 0x74BDA TKF_SW_SW_SW 100.0 FORMULA_0751 -50.0000 50.0000 /begin AXIS_DESCR STD_AXIS FORMULA_0006 8 -5000.0000 0.0 /end AXIS_DESCR /begin AXIS_DESCR STD_AXIS FORMULA_0114 12 -10000.0000 10000.0000 /end AXIS_DESCR FORMAT "%4.1" /end CHARACTERISTIC
/begin CHARACTERISTIC KF_LLR_MD_I_POS_MKS "I-Anteil bei pos. Abweichung | EN: Integral share for positive deviation" MAP 0x74CC4 TKF_SW_SW_SW 100.0 FORMULA_0751 -50.0000 50.0000 /begin AXIS_DESCR STD_AXIS FORMULA_0006 8 0.0 5000.0000 /end AXIS_DESCR /begin AXIS_DESCR STD_AXIS FORMULA_0114 12 -10000.0000 10000.0000 /end AXIS_DESCR FORMAT "%4.1" /end CHARACTERISTIC
/begin CHARACTERISTIC KF_LLR_MD_I_NEG_MKS "I-Anteil bei neg. Abweichung | EN: Integral share for negative deviation" MAP 0x74DAE TKF_SW_SW_SW 100.0 FORMULA_0751 -50.0000 50.0000 /begin AXIS_DESCR STD_AXIS FORMULA_0006 8 -5000.0000 0.0 /end AXIS_DESCR /begin AXIS_DESCR STD_AXIS FORMULA_0114 12 -10000.0000 10000.0000 /end AXIS_DESCR FORMAT "%4.1" /end CHARACTERISTIC
/begin CHARACTERISTIC KF_LLR_N_SOLL_KH_OFF "Offset ueber Katheizen und Kat | EN: I-Anteil bei neg. Abweichung [V912: differs from V452 160E]" MAP 0x74E98 TKF_SW_SW_SW 100.0 FORMULA_0006 0.0 10000.0000 /begin AXIS_DESCR STD_AXIS FORMULA_0023 6 -50.0000 170.0000 FORMAT "%4.1" /end AXIS_DESCR
 /begin AXIS_DESCR STD_AXIS kat_obd_wert_nv FORMULA_0025 4 0.0 1.9000 FORMAT "%6.3" /end AXIS_DESCR
/end CHARACTERISTIC
/begin CHARACTERISTIC K_LLR_ERR_MAX_E2 "max. Fehler LLR Ebene 2 | EN: max. Fehler LLR Ebene 2" VALUE 0x7A53E TKW_VV_VV_UB 100.0 FORMULA_0003 0.0 255.0000 /end CHARACTERISTIC
/begin CHARACTERISTIC K_LLR_DMD_MAX_E2 "Rampe max. I-Anteil Ebene 2 | EN: Rampe max. I-Anteil Ebene 2" VALUE 0x7A53F TKW_VV_VV_UB 100.0 FORMULA_0748 0.0 255.0000 /end CHARACTERISTIC
/begin CHARACTERISTIC K_LLR_MD_MIN_E2 "min. I-Anteil Ebene 2 | EN: min. I-Anteil Ebene 2" VALUE 0x7A540 TKW_VV_VV_SW 100.0 FORMULA_0009 -150.0000 0.0 FORMAT "%4.1" /end CHARACTERISTIC
/begin CHARACTERISTIC K_LLR_MD_MAX_E2 "max. I-Anteil Ebene 2 | EN: Maximum integral share, level 2 [Nm]" VALUE 0x7A542 TKW_VV_VV_SW 100.0 FORMULA_0009 0.0 1000.0000 FORMAT "%4.1" /end CHARACTERISTIC
/begin CHARACTERISTIC K_LLR_N_DIFF_MAX_E2 "Schwelle Max-Rampe Ebene 2 | EN: Threshold for maximum ramp, level 2 [Upm]" VALUE 0x7A544 TKW_VV_VV_SW 100.0 FORMULA_0006 -5000.0000 5000.0000 /end CHARACTERISTIC
/begin CHARACTERISTIC K_LLR_N_SOLL_NF_FAKTOR_E2 "Faktor Nachf�hrsolldrehzahl Ebene 2 | EN: Factor for tracking target speed, level 2" VALUE 0x7A546 TKW_VV_VV_UW 100.0 FORMULA_0075 0.0 4.0000 FORMAT "%6.3" /end CHARACTERISTIC
/begin CHARACTERISTIC K_LLR_N_SOLL_NF_MAX_E2 "max. Nachf�hrsolldrehzahl Ebene 2 | EN: Maximum tracking target speed, level 2 [Upm]" VALUE 0x7A548 TKW_VV_VV_SW 100.0 FORMULA_0006 0.0 10000.0000 /end CHARACTERISTIC
/begin CHARACTERISTIC KL_LLR_N_SOLL_TMOT_E2 "Leerlaufdrehzahl Ebene 2 | EN: Idle speed, level 2 (monitoring)" CURVE 0x7A54A TKL_SW_VV_SW 100.0 FORMULA_0006 0.0 10000.0000 /begin AXIS_DESCR STD_AXIS FORMULA_0023 4 -50.0000 170.0000 FORMAT "%4.1" /end AXIS_DESCR /end CHARACTERISTIC
/* ------------------ Abschnitt erzeugt aus llr_ad.dat ------------------ */
/begin CHARACTERISTIC K_LLR_AD_CFG "Konfiguration | EN: 0x0 Aus 0x1 Ein 0x2 Ein o.TE 0xff Init Konfiguration" VALUE 0x74EDE TKW_VV_VV_UB 100.0 FORMULA_0753 0.0 255.0 /end CHARACTERISTIC
/begin CHARACTERISTIC K_LLR_AD_I_TAU "Filterzeit | EN: Filterzeit" VALUE 0x74EDF TKW_VV_VV_UB 100.0 FORMULA_0754 1.0040 256.0000 /end CHARACTERISTIC
/begin CHARACTERISTIC K_LLR_AD_TMOT "Tmot-Schwelle | EN: Tmot-Schwelle" VALUE 0x74EE0 TKW_VV_VV_SW 100.0 FORMULA_0023 -50.0000 170.0000 FORMAT "%4.1" /end CHARACTERISTIC
/begin CHARACTERISTIC K_LLR_AD_TOEL "Toel-Schwelle | EN: Toel-Schwelle" VALUE 0x74EE2 TKW_VV_VV_SW 100.0 FORMULA_0023 -50.0000 170.0000 FORMAT "%4.1" /end CHARACTERISTIC
/begin CHARACTERISTIC K_LLR_AD_N_HYS_POS "positiver Offset | EN: positiver Offset" VALUE 0x74EE4 TKW_VV_VV_SW 100.0 FORMULA_0006 0.0 500.0000 /end CHARACTERISTIC
/begin CHARACTERISTIC K_LLR_AD_N_HYS_NEG "negativer Offset | EN: negativer Offset" VALUE 0x74EE6 TKW_VV_VV_SW 100.0 FORMULA_0006 -500.0000 0.0 /end CHARACTERISTIC
/begin CHARACTERISTIC K_LLR_AD_TIME_STABIL "Stabilisierzeit | EN: Stabilisierzeit" VALUE 0x74EE8 TKW_VV_VV_UW 100.0 FORMULA_0073 0.0 6553.5000 FORMAT "%4.1" /end CHARACTERISTIC
/begin CHARACTERISTIC K_LLR_AD_UMSCHALT_RAMPE "Umschaltrampe | EN: Umschaltrampe" VALUE 0x74EEA TKW_VV_VV_SW 100.0 FORMULA_0755 -3000.0000 25.0000 FORMAT "%4.1" /end CHARACTERISTIC
/begin CHARACTERISTIC K_LLR_AD_NORM_MIN "Minwert normal | EN: Minwert normal" VALUE 0x74EEC TKW_VV_VV_SW 100.0 FORMULA_0009 -25.0000 0.0 FORMAT "%4.1" /end CHARACTERISTIC
/begin CHARACTERISTIC K_LLR_AD_NORM_MAX "Maxwert normal | EN: Maxwert normal" VALUE 0x74EEE TKW_VV_VV_SW 100.0 FORMULA_0009 0.0 25.0000 FORMAT "%4.1" /end CHARACTERISTIC
/begin CHARACTERISTIC K_LLR_AD_AC_MIN "Minwert Klima | EN: Minwert Klima" VALUE 0x74EF0 TKW_VV_VV_SW 100.0 FORMULA_0009 -25.0000 0.0 FORMAT "%4.1" /end CHARACTERISTIC
/begin CHARACTERISTIC K_LLR_AD_AC_MAX "Maxwert Klima | EN: Maxwert Klima" VALUE 0x74EF2 TKW_VV_VV_SW 100.0 FORMULA_0009 0.0 25.0000 FORMAT "%4.1" /end CHARACTERISTIC
/begin CHARACTERISTIC K_LLR_AD_MD_GRAD "�nderungsbegrenzung | EN: Änderungsbegrenzung" VALUE 0x74EF4 TKW_VV_VV_SW 100.0 FORMULA_0755 -3000.0000 25.0000 FORMAT "%4.1" /end CHARACTERISTIC
/begin CHARACTERISTIC K_LLR_AD_I_ANTEIL_OFF "Restwert I-Anteil | EN: Restwert I-Anteil" VALUE 0x74EF6 TKW_VV_VV_SW 100.0 FORMULA_0009 -25.0000 0.0 FORMAT "%4.1" /end CHARACTERISTIC
/begin CHARACTERISTIC K_LLR_AD_MD_ZYKLUS_MAX "max. �nderung pro Zyklus | EN: max. Änderung pro Zyklus" VALUE 0x74EF8 TKW_VV_VV_SW 100.0 FORMULA_0009 0.0 25.0000 FORMAT "%4.1" /end CHARACTERISTIC
/begin CHARACTERISTIC K_LLR_AD_MD_NEUZUSTAND "Werte Neuzustand | EN: Werte Neuzustand" VALUE 0x74EFA TKW_VV_VV_SW 100.0 FORMULA_0009 -50.0000 50.0000 FORMAT "%4.1" /end CHARACTERISTIC
/* ------------------ Abschnitt erzeugt aus lu.dat ------------------ */
/begin CHARACTERISTIC K_LU_WIN_START_B1 "Start Messfenster." VALUE 0x74EFC TKW_VV_VV_UB 100.0 FORMULA_0777 0.0 34.0000 /end CHARACTERISTIC
/begin CHARACTERISTIC K_LU_WIN_START_B2 "Start Messfenster." VALUE 0x74EFD TKW_VV_VV_UB 100.0 FORMULA_0777 0.0 34.0000 /end CHARACTERISTIC
/begin CHARACTERISTIC K_LU_WIN_LEN_B1 "Messfensterlaenge" VALUE 0x74EFE TKW_VV_VV_UB 100.0 FORMULA_0777 1.0000 24.0000 /end CHARACTERISTIC
/begin CHARACTERISTIC K_LU_WIN_LEN_B2 "Messfensterlaenge" VALUE 0x74EFF TKW_VV_VV_UB 100.0 FORMULA_0777 1.0000 24.0000 /end CHARACTERISTIC
/begin CHARACTERISTIC K_LU_WIN_PERIOD_B1 "Zykluswiederholung Messfenster." VALUE 0x74F00 TKW_VV_VV_UB 100.0 FORMULA_0777 1.0000 24.0000 /end CHARACTERISTIC
/begin CHARACTERISTIC K_LU_WIN_PERIOD_B2 "Zykluswiederholung Messfenster." VALUE 0x74F01 TKW_VV_VV_UB 100.0 FORMULA_0777 1.0000 24.0000 /end CHARACTERISTIC
/begin CHARACTERISTIC K_LU_ACT_N_MIN "Minimaldrehzahl LU-Aktiv" VALUE 0x74F02 TKW_VV_VV_SW 100.0 FORMULA_0006 0.0 10000.0000 /end CHARACTERISTIC
/begin CHARACTERISTIC K_LU_ACT_N_MAX "Maximaldrehzahl LU-Aktiv" VALUE 0x74F04 TKW_VV_VV_SW 100.0 FORMULA_0006 0.0 10000.0000 /end CHARACTERISTIC
/begin CHARACTERISTIC K_LU_ADAP_ENDE "Ende der Adaptionsschwellwert-Anhebung" VALUE 0x74F06 TKW_VV_VV_UW 100.0 FORMULA_0778 0.0 65535.0000 /end CHARACTERISTIC
/begin CHARACTERISTIC K_LU_ADAP_DELAY "Verzoegerung Adaptionsstart" VALUE 0x74F08 TKW_VV_VV_UB 100.0 FORMULA_0501 0.0 25.5000 /end CHARACTERISTIC
/begin CHARACTERISTIC K_LU_ADAP_GANG_MIN "Minimaler Gang LU-Adaption" VALUE 0x74F09 TKW_VV_VV_SB 100.0 FORMULA_0318 -1.0000 10.0000 /end CHARACTERISTIC
/begin CHARACTERISTIC K_LU_ADAP_LIMIT "Obere Grenze fuer LU-Adaptionswerte" VALUE 0x74F0A TKW_VV_VV_SW 100.0 FORMULA_0439 0.0 7.8000 FORMAT "%6.3" /end CHARACTERISTIC
/begin CHARACTERISTIC K_LU_ADAP_N_MAX "Maximaldrehzahl LU-Adaption" VALUE 0x74F0C TKW_VV_VV_SW 100.0 FORMULA_0006 0.0 10000.0000 /end CHARACTERISTIC
/begin CHARACTERISTIC K_LU_ADAP_N_MIN "Minimaldrehzahl LU-Adaption" VALUE 0x74F0E TKW_VV_VV_SW 100.0 FORMULA_0006 0.0 10000.0000 /end CHARACTERISTIC
/begin CHARACTERISTIC K_LU_ADAP_OFFS_B2 "Offset Geberrad-Adaption Bank2" VALUE 0x74F10 TKW_VV_VV_SW 100.0 FORMULA_0439 -7.8000 7.8000 FORMAT "%6.3" /end CHARACTERISTIC
/begin CHARACTERISTIC K_LU_AUSKUPPL_DELAY "Ausblendung nach Auskuppeln" VALUE 0x74F12 TKW_VV_VV_UB 100.0 FORMULA_0501 0.0 25.5000 /end CHARACTERISTIC
/begin CHARACTERISTIC K_LU_CFG "Konfiguration Laufunruhe" VALUE 0x74F13 TKW_VV_VV_UB 100.0 FORMULA_0779 0.0 255.0 /end CHARACTERISTIC
/begin CHARACTERISTIC K_LU_DSC_DELAY "Ausblendung nach DSC-Eingriff" VALUE 0x74F14 TKW_VV_VV_UB 100.0 FORMULA_0501 0.0 25.5000 /end CHARACTERISTIC
/begin CHARACTERISTIC K_LU_KKOS_DELAY "Ausblendung nach Schaltvorgang Klimakompressor" VALUE 0x74F15 TKW_VV_VV_UB 100.0 FORMULA_0501 0.0 25.5000 /end CHARACTERISTIC
/begin CHARACTERISTIC K_LU_KUPPL_DELAY "Ausblendung nach Einkuppeln" VALUE 0x74F16 TKW_VV_VV_UB 100.0 FORMULA_0501 0.0 25.5000 /end CHARACTERISTIC
/begin CHARACTERISTIC K_LU_MD_DELAY "Ausblendung bei MD-Delta" VALUE 0x74F17 TKW_VV_VV_UB 100.0 FORMULA_0501 0.0 25.5000 /end CHARACTERISTIC
/begin CHARACTERISTIC K_LU_N_MIN "Minimaldrehzahl LU-Modulstart" VALUE 0x74F18 TKW_VV_VV_SW 100.0 FORMULA_0006 0.0 10000.0000 /end CHARACTERISTIC
/begin CHARACTERISTIC K_LU_SA_DELAY "Ausblendung nach Zustand Schubabschaltung" VALUE 0x74F1A TKW_VV_VV_UB 100.0 FORMULA_0501 0.0 25.5000 /end CHARACTERISTIC
/begin CHARACTERISTIC K_LU_SCHW_EV_ERR "Kompensation LU-Schwelle EV-FEHLER" VALUE 0x74F1C TKW_VV_VV_UB 100.0 FORMULA_0780 0.0 7.9687 /end CHARACTERISTIC
/begin CHARACTERISTIC K_LU_START_DELAY "Motorlaufzeit Freigabe LU" VALUE 0x74F1E TKW_VV_VV_UW 100.0 FORMULA_0021 0.0 655.0000 FORMAT "%5.2" /end CHARACTERISTIC
/begin CHARACTERISTIC K_LU_TZ_DELAY "Ausblendung bei TZ-Delta" VALUE 0x74F20 TKW_VV_VV_UB 100.0 FORMULA_0774 0.0 255.0000 /end CHARACTERISTIC
/begin CHARACTERISTIC K_LU_TZ_DELTA "max. Zul. TZ-Delta" VALUE 0x74F22 TKW_VV_VV_SW 100.0 FORMULA_0781 0.0 60.0000 FORMAT "%4.1" /end CHARACTERISTIC
/begin CHARACTERISTIC KL_LU_ADAP_FILT "Adaptionsfilterkonstante Geberrad" CURVE 0x74F24 TKL_UW_VV_UW 100.0 FORMULA_0782 0.0 1.0000 /begin AXIS_DESCR STD_AXIS FORMULA_0778 3 0.0 65535.0000 /end AXIS_DESCR FORMAT "%7.4" /end CHARACTERISTIC
/begin CHARACTERISTIC KL_LU_MD_DELTA_POS "Max. zul. positives WDK-DELTA" CURVE 0x74F32 TKL_SW_VV_SW 100.0 FORMULA_0773 -100.0000 250.0000
 /begin AXIS_DESCR STD_AXIS md FORMULA_0009 8 -100.0000 1000.0000 FORMAT "%4.1" /end AXIS_DESCR
 FORMAT "%4.1" /end CHARACTERISTIC
/begin CHARACTERISTIC KL_LU_MD_DELTA_NEG "Max. zul. negatives WDK-DELTA" CURVE 0x74F54 TKL_SW_VV_SW 100.0 FORMULA_0773 -100.0000 100.0000
 /begin AXIS_DESCR STD_AXIS md FORMULA_0009 8 -100.0000 1000.0000 FORMAT "%4.1" /end AXIS_DESCR
 FORMAT "%4.1" /end CHARACTERISTIC
/begin CHARACTERISTIC KL_LU_RF_MIN "LU-RF-Schwelle" CURVE 0x74F76 TKL_SW_VV_SW 100.0 FORMULA_0007 0.0 2.0000 /begin AXIS_DESCR STD_AXIS FORMULA_0006 8 0.0 10000.0000 /end AXIS_DESCR FORMAT "%6.3" /end CHARACTERISTIC
/begin CHARACTERISTIC KL_LU_SCHW_KATH "Katheizanpassung LU-Schwelle" CURVE 0x74F98 TKL_SW_VV_UW 100.0 FORMULA_0075 0.0 4.0000 /begin AXIS_DESCR STD_AXIS FORMULA_0006 3 0.0 10000.0000 /end AXIS_DESCR FORMAT "%6.3" /end CHARACTERISTIC
/begin CHARACTERISTIC KL_LU_SCHW_TMOT "Temperaturkompensation LU-Schwelle" CURVE 0x74FA6 TKL_SW_VV_UW 100.0 FORMULA_0075 0.0 4.0000 /begin AXIS_DESCR STD_AXIS FORMULA_0023 4 -50.0000 170.0000 FORMAT "%4.1" /end AXIS_DESCR FORMAT "%6.3" /end CHARACTERISTIC
/begin CHARACTERISTIC KL_LU_START_DLY "Segment Verzoegerung nach Verlassen von OFF" CURVE 0x74FB8 TKL_SW_VV_SW 100.0 FORMULA_0783 0.0 32767.0000 /begin AXIS_DESCR STD_AXIS FORMULA_0023 3 -50.0000 170.0000 FORMAT "%4.1" /end AXIS_DESCR /end CHARACTERISTIC
/begin CHARACTERISTIC KL_LU_START_TRIG_OFF "Ausblenden von md/tz-delta nach Start" CURVE 0x74FC6 TKL_SW_VV_UW 100.0 FORMULA_0021 0.0 655.0000 /begin AXIS_DESCR STD_AXIS FORMULA_0023 3 -50.0000 170.0000 FORMAT "%4.1" /end AXIS_DESCR FORMAT "%5.2" /end CHARACTERISTIC
/begin CHARACTERISTIC KF_LU_FAKTOR_B2 "LU-Faktor Bank2" MAP 0x74FD4 TKF_SW_SW_UW 100.0 FORMULA_0295 0.0 2.0000 /begin AXIS_DESCR STD_AXIS FORMULA_0006 6 0.0 10000.0000 /end AXIS_DESCR /begin AXIS_DESCR STD_AXIS rf FORMULA_0007 6 0.0 2.0000 FORMAT "%6.3" /end AXIS_DESCR FORMAT "%7.4" /end CHARACTERISTIC
/begin CHARACTERISTIC KF_LU_OFFSET_ZYL1 "LU-Offset Zyl 1" MAP 0x75036 TKF_SW_SW_SW 100.0 FORMULA_0756 -500.0000 499.9847 /begin AXIS_DESCR STD_AXIS FORMULA_0006 16 0.0 10000.0000 /end AXIS_DESCR /begin AXIS_DESCR STD_AXIS rf FORMULA_0007 8 0.0 2.0000 FORMAT "%6.3" /end AXIS_DESCR FORMAT "%5.2" /end CHARACTERISTIC
/begin CHARACTERISTIC KF_LU_OFFSET_ZYL2 "LU-Offset Zyl 2" MAP 0x75168 TKF_SW_SW_SW 100.0 FORMULA_0756 -500.0000 499.9847 /begin AXIS_DESCR STD_AXIS FORMULA_0006 16 0.0 10000.0000 /end AXIS_DESCR /begin AXIS_DESCR STD_AXIS rf FORMULA_0007 8 0.0 2.0000 FORMAT "%6.3" /end AXIS_DESCR FORMAT "%5.2" /end CHARACTERISTIC
/begin CHARACTERISTIC KF_LU_OFFSET_ZYL3 "LU-Offset Zyl 3" MAP 0x7529A TKF_SW_SW_SW 100.0 FORMULA_0756 -500.0000 499.9847 /begin AXIS_DESCR STD_AXIS FORMULA_0006 16 0.0 10000.0000 /end AXIS_DESCR /begin AXIS_DESCR STD_AXIS rf FORMULA_0007 8 0.0 2.0000 FORMAT "%6.3" /end AXIS_DESCR FORMAT "%5.2" /end CHARACTERISTIC
/begin CHARACTERISTIC KF_LU_OFFSET_ZYL4 "LU-Offset Zyl 4" MAP 0x753CC TKF_SW_SW_SW 100.0 FORMULA_0756 -500.0000 499.9847 /begin AXIS_DESCR STD_AXIS FORMULA_0006 16 0.0 10000.0000 /end AXIS_DESCR /begin AXIS_DESCR STD_AXIS rf FORMULA_0007 8 0.0 2.0000 FORMAT "%6.3" /end AXIS_DESCR FORMAT "%5.2" /end CHARACTERISTIC
/begin CHARACTERISTIC KF_LU_OFFSET_ZYL5 "LU-Offset Zyl 5" MAP 0x754FE TKF_SW_SW_SW 100.0 FORMULA_0756 -500.0000 499.9847 /begin AXIS_DESCR STD_AXIS FORMULA_0006 16 0.0 10000.0000 /end AXIS_DESCR /begin AXIS_DESCR STD_AXIS rf FORMULA_0007 8 0.0 2.0000 FORMAT "%6.3" /end AXIS_DESCR FORMAT "%5.2" /end CHARACTERISTIC
/begin CHARACTERISTIC KF_LU_OFFSET_ZYL6 "LU-Offset Zyl 6" MAP 0x75630 TKF_SW_SW_SW 100.0 FORMULA_0756 -500.0000 499.9847 /begin AXIS_DESCR STD_AXIS FORMULA_0006 16 0.0 10000.0000 /end AXIS_DESCR /begin AXIS_DESCR STD_AXIS rf FORMULA_0007 8 0.0 2.0000 FORMAT "%6.3" /end AXIS_DESCR FORMAT "%5.2" /end CHARACTERISTIC
/begin CHARACTERISTIC KF_LU_OFFSET_ZYL7 "LU-Offset Zyl 7" MAP 0x75762 TKF_SW_SW_SW 100.0 FORMULA_0756 -500.0000 499.9847 /begin AXIS_DESCR STD_AXIS FORMULA_0006 16 0.0 10000.0000 /end AXIS_DESCR /begin AXIS_DESCR STD_AXIS rf FORMULA_0007 8 0.0 2.0000 FORMAT "%6.3" /end AXIS_DESCR FORMAT "%5.2" /end CHARACTERISTIC
/begin CHARACTERISTIC KF_LU_OFFSET_ZYL8 "LU-Offset Zyl 8" MAP 0x75894 TKF_SW_SW_SW 100.0 FORMULA_0756 -500.0000 499.9847 /begin AXIS_DESCR STD_AXIS FORMULA_0006 16 0.0 10000.0000 /end AXIS_DESCR /begin AXIS_DESCR STD_AXIS rf FORMULA_0007 8 0.0 2.0000 FORMAT "%6.3" /end AXIS_DESCR FORMAT "%5.2" /end CHARACTERISTIC
/begin CHARACTERISTIC KF_LU_OFFSET_ZYL9 "LU-Offset Zyl 9" MAP 0x759C6 TKF_SW_SW_SW 100.0 FORMULA_0756 -500.0000 499.9847 /begin AXIS_DESCR STD_AXIS FORMULA_0006 16 0.0 10000.0000 /end AXIS_DESCR /begin AXIS_DESCR STD_AXIS rf FORMULA_0007 8 0.0 2.0000 FORMAT "%6.3" /end AXIS_DESCR FORMAT "%5.2" /end CHARACTERISTIC
/begin CHARACTERISTIC KF_LU_OFFSET_ZYL10 "LU-Offset Zyl 10" MAP 0x75AF8 TKF_SW_SW_SW 100.0 FORMULA_0756 -500.0000 499.9847 /begin AXIS_DESCR STD_AXIS FORMULA_0006 16 0.0 10000.0000 /end AXIS_DESCR /begin AXIS_DESCR STD_AXIS rf FORMULA_0007 8 0.0 2.0000 FORMAT "%6.3" /end AXIS_DESCR FORMAT "%5.2" /end CHARACTERISTIC
/begin CHARACTERISTIC KF_LU_SCHWELLE "LU-Schwelle" MAP 0x75C2A TKF_SW_SW_SW 100.0 FORMULA_0756 0.0 499.9847 /begin AXIS_DESCR STD_AXIS FORMULA_0006 10 0.0 10000.0000 /end AXIS_DESCR /begin AXIS_DESCR STD_AXIS rf FORMULA_0007 8 0.0 2.0000 FORMAT "%6.3" /end AXIS_DESCR FORMAT "%5.2" /end CHARACTERISTIC
/* ------------------ Abschnitt erzeugt aus md_basis.dat ------------------ */
/begin CHARACTERISTIC K_MD_HYP_VERH_START "Begrenzung Hyperbel ausserhalb Motor laeuft | EN: Begrenzung Hyperbel ausserhalb Motor laeuft" VALUE 0x75CF0 TKW_VV_VV_UB 100.0 FORMULA_0704 0.0 1.9921 /end CHARACTERISTIC
/begin CHARACTERISTIC K_MD_HYP_VERH_NO_KRAFTS "Best. Schnittpunkt Brenngrenze mit Hyp.bei NO_Krafts. | EN: Best. Schnittpunkt Brenngrenze mit Hyp.bei NO_Krafts." VALUE 0x75CF1 TKW_VV_VV_UB 100.0 FORMULA_0704 0.0 1.9921 /end CHARACTERISTIC
/begin CHARACTERISTIC K_MD_ETA_KR_KOMP "ETA-Kr mit/ohne KR" VALUE 0x75CF2 TKW_VV_VV_UB 100.0 FORMULA_0787 0.0 255.0 /end CHARACTERISTIC
/begin CHARACTERISTIC K_MD_CFG_RG_KORR "Cfg fuer RG-Korrektur | EN: Cfg fuer RG-Korrektur" VALUE 0x75CF3 TKW_VV_VV_UB 100.0 FORMULA_0788 0.0 255.0 /end CHARACTERISTIC
/begin CHARACTERISTIC K_MD_MAX_FAK "VL-Korrektur von Rf_max | EN: Full-load correction of rf_max" VALUE 0x75CF4 TKW_VV_VV_UW 100.0 FORMULA_0075 0.0 4.0000 FORMAT "%6.3" /end CHARACTERISTIC
/begin CHARACTERISTIC K_MD_ETA_ZW_MIN "minimales ETA | EN: Minimum efficiency [%]" VALUE 0x75CF6 TKW_VV_VV_UW 100.0 FORMULA_0435 0.0 150.0000 FORMAT "%4.1" /end CHARACTERISTIC
/begin CHARACTERISTIC K_MD_ETA_SK_MIN "minimales ETA bei SK-Ausblendern | EN: Minimum efficiency during safety-concept suppression [%]" VALUE 0x75CF8 TKW_VV_VV_UW 100.0 FORMULA_0435 0.0 150.0000 FORMAT "%4.1" /end CHARACTERISTIC
/begin CHARACTERISTIC K_MD_MAX_POWER_POS "Begrenzung Powerfaktor | EN: Power factor limit [1/sec]" VALUE 0x75CFA TKW_VV_VV_UB 100.0 FORMULA_0789 0.0 49.8046 /end CHARACTERISTIC
/begin CHARACTERISTIC K_MD_MAX_POWER_NEG "Begrenzung Powerfaktor | EN: Power factor limit [1/sec]" VALUE 0x75CFB TKW_VV_VV_UB 100.0 FORMULA_0789 0.0 49.8046 /end CHARACTERISTIC
/begin CHARACTERISTIC K_MD_PULS_EIN "Generator-Schalter" VALUE 0x75CFC TKW_VV_VV_UB 100.0 FORMULA_0790 0.0 255.0 /end CHARACTERISTIC
/begin CHARACTERISTIC K_MD_PULS_T "Generator-Periodendauer | EN: Generator period [s]" VALUE 0x75CFE TKW_VV_VV_UW 100.0 FORMULA_0117 0.0 325.0000 FORMAT "%5.2" /end CHARACTERISTIC
/begin CHARACTERISTIC K_MD_PULS_AMP "Generator-Amplitude | EN: Generator amplitude [Nm]" VALUE 0x75D00 TKW_VV_VV_SW 100.0 FORMULA_0009 -100.0000 100.0000 FORMAT "%4.1" /end CHARACTERISTIC
/begin CHARACTERISTIC K_MD_PULS_OFFS "Generator-Offset | EN: Generator offset [Nm]" VALUE 0x75D02 TKW_VV_VV_SW 100.0 FORMULA_0009 -100.0000 100.0000 FORMAT "%4.1" /end CHARACTERISTIC
/begin CHARACTERISTIC K_MD_PULS_RAMPE "Generator-Rampe | EN: Generator ramp [Nm/s]" VALUE 0x75D04 TKW_VV_VV_SW 100.0 FORMULA_0571 -20000.0000 20000.0000 /end CHARACTERISTIC
/begin CHARACTERISTIC K_MD_VERBR_MAX "max. Verbrauchermoment | EN: Maximum consumer torque [Nm]" VALUE 0x75D06 TKW_VV_VV_SW 100.0 FORMULA_0009 0.0 200.0000 FORMAT "%4.1" /end CHARACTERISTIC
/begin CHARACTERISTIC KL_MD_RF_MAX_ROH "maximale rel. F�llung | EN: Maximum relative charge" CURVE 0x75D08 TKL_SW_VV_SW 100.0 FORMULA_0007 0.0 2.0000 /begin AXIS_DESCR STD_AXIS FORMULA_0006 20 0.0 10000.0000 /end AXIS_DESCR FORMAT "%6.3" /end CHARACTERISTIC
/begin CHARACTERISTIC KL_MD_MAX_N_OFFS "Drehzahloffset fuer rf_max | EN: Engine-speed offset for rf_max" CURVE 0x75D5A TKL_SW_VV_SW 100.0 FORMULA_0006 0.0 10000.0000
 /begin AXIS_DESCR STD_AXIS tan FORMULA_0023 6 -50.0000 170.0000 FORMAT "%4.1" /end AXIS_DESCR
/end CHARACTERISTIC
/begin CHARACTERISTIC KL_MD_MAX_TMOT "tmot-Korrektur fuer rf_max | EN: Engine-temperature correction for rf_max" CURVE 0x75D74 TKL_SW_VV_UW 100.0 FORMULA_0075 0.0 4.0000 /begin AXIS_DESCR STD_AXIS FORMULA_0023 6 -50.0000 170.0000 FORMAT "%4.1" /end AXIS_DESCR FORMAT "%6.3" /end CHARACTERISTIC
/begin CHARACTERISTIC KL_MD_MAX_FAK_POWER "maximale rel. F�llung | EN: Maximum relative charge" CURVE 0x75D8E TKL_SW_VV_UW 100.0 FORMULA_0075 0.0 4.0000 /begin AXIS_DESCR STD_AXIS FORMULA_0006 18 0.0 10000.0000 /end AXIS_DESCR FORMAT "%6.3" /end CHARACTERISTIC
/begin CHARACTERISTIC KL_MD_KUPP_MAX_CAN "Popelfaktor fuer CAN-Ausgabe | EN: Scaling factor for CAN output" CURVE 0x75DD8 TKL_SW_VV_UW 100.0 FORMULA_0075 0.0 2.0000 /begin AXIS_DESCR STD_AXIS FORMULA_0006 6 0.0 10000.0000 /end AXIS_DESCR FORMAT "%6.3" /end CHARACTERISTIC
/begin CHARACTERISTIC KL_MD_HYP_DN "Drehzahloffset fuer MD_MIN-Hyperbelast | EN: Engine-speed offset for MD_MIN hyperbola load" CURVE 0x75DF2 TKL_SW_VV_SW 100.0 FORMULA_0006 0.0 10000.0000 /begin AXIS_DESCR STD_AXIS FORMULA_0023 3 -50.0000 170.0000 FORMAT "%4.1" /end AXIS_DESCR /end CHARACTERISTIC
/begin CHARACTERISTIC KL_MD_ETA_LA "LA-Wirkungsgrad | EN: Lambda efficiency" CURVE 0x75E00 TKL_UW_VV_UW 100.0 FORMULA_0435 0.0 150.0000 /begin AXIS_DESCR STD_AXIS la FORMULA_0025 8 0.0 3.9990 FORMAT "%6.3" /end AXIS_DESCR FORMAT "%4.1" /end CHARACTERISTIC
/begin CHARACTERISTIC KL_MD_ZW_LA "ZW-Einfluss durch Lambda | EN: Ignition-angle influence from lambda" CURVE 0x75E22 TKL_SW_VV_SW 100.0 FORMULA_0111 -50.0000 60.0000 /begin AXIS_DESCR STD_AXIS Lambda FORMULA_0025 6 0.0 1.9990 FORMAT "%6.3" /end AXIS_DESCR FORMAT "%4.1" /end CHARACTERISTIC
/begin CHARACTERISTIC KL_MD_ZW_TMOT_FAK "ZW-Korrektur ueber Tmot" CURVE 0x75E3C TKL_SW_VV_UW 100.0 FORMULA_0075 0.0 4.0000 /begin AXIS_DESCR STD_AXIS FORMULA_0023 6 -50.0000 170.0000 FORMAT "%4.1" /end AXIS_DESCR FORMAT "%6.3" /end CHARACTERISTIC
/begin CHARACTERISTIC KL_MD_IND_REIB_OFFSET "Offset fuer Reibmoment nach Start | EN: Offset for friction torque after start" CURVE 0x75E56 TKL_SW_VV_SW 100.0 FORMULA_0784 0.0 320.0000 /begin AXIS_DESCR STD_AXIS FORMULA_0023 4 -50.0000 170.0000 FORMAT "%4.1" /end AXIS_DESCR FORMAT "%4.1" /end CHARACTERISTIC
/begin CHARACTERISTIC KL_MD_IND_REIB_ABREG "Abregelrampe fuer Reibmoment nach Start | EN: Ramp-down for friction torque after start" CURVE 0x75E68 TKL_SW_VV_SW 100.0 FORMULA_0785 -100.0000 1000.0000 /begin AXIS_DESCR STD_AXIS FORMULA_0023 4 -50.0000 170.0000 FORMAT "%4.1" /end AXIS_DESCR FORMAT "%5.2" /end CHARACTERISTIC
/begin CHARACTERISTIC KL_MD_TAU_START_OFF "Filter fuer Startoffset | EN: Filter for start offset" CURVE 0x75E7A TKL_SW_VV_UW 100.0 FORMULA_0477 0.0050 327.6700 /begin AXIS_DESCR STD_AXIS FORMULA_0023 5 -50.0000 170.0000 FORMAT "%4.1" /end AXIS_DESCR FORMAT "%5.2" /end CHARACTERISTIC
/begin CHARACTERISTIC KL_MD_KR_DTZ_UP "KR-Begr up | EN: Knock-control limit, up" CURVE 0x75E90 TKL_SW_VV_SW 100.0 FORMULA_0791 0.0 5000.0000 /begin AXIS_DESCR STD_AXIS FORMULA_0006 5 0.0 10000.0000 /end AXIS_DESCR /end CHARACTERISTIC
/begin CHARACTERISTIC KL_MD_KR_DTZ_DOWN "KR-Begr down | EN: Knock-control limit, down" CURVE 0x75EA6 TKL_SW_VV_SW 100.0 FORMULA_0791 0.0 5000.0000 /begin AXIS_DESCR STD_AXIS FORMULA_0006 5 0.0 10000.0000 /end AXIS_DESCR /end CHARACTERISTIC
/begin CHARACTERISTIC KL_MD_IND_RF_MIN_OFFS "Rfmin-Offset | EN: Minimum relative charge offset" CURVE 0x75EBC TKL_SW_VV_SW 100.0 FORMULA_0009 -100.0000 1000.0000 /begin AXIS_DESCR STD_AXIS FORMULA_0006 8 0.0 10000.0000 /end AXIS_DESCR FORMAT "%4.1" /end CHARACTERISTIC
/begin CHARACTERISTIC KL_MD_SCHW_TAU "Filterkonstante Md_Schw | EN: Filter constant Md_Schw" CURVE 0x75EDE TKL_UB_VV_UB 100.0 FORMULA_0478 0.0051 1.2800 /begin AXIS_DESCR STD_AXIS FORMULA_0318 8 0.0 10.0000 /end AXIS_DESCR /end CHARACTERISTIC
/begin CHARACTERISTIC KL_MD_HYP_VERH_KRAFTS "Best. Schnittpunkt Brenngrenze mit Hyp.bei Krafts." CURVE 0x75EF0 TKL_UW_VV_UW 100.0 FORMULA_0792 0.0 1.9921 /begin AXIS_DESCR STD_AXIS t FORMULA_0021 4 0.0 655.0000 FORMAT "%5.2" /end AXIS_DESCR FORMAT "%5.2" /end CHARACTERISTIC
/begin CHARACTERISTIC KF_MD_IND_OPT "optimales Moment bei LA 1 | EN: Optimum torque at lambda 1" MAP 0x75F02 TKF_SW_SW_SW 100.0 FORMULA_0009 -100.0000 1000.0000 /begin AXIS_DESCR STD_AXIS FORMULA_0006 18 0.0 10000.0000 /end AXIS_DESCR /begin AXIS_DESCR STD_AXIS FORMULA_0007 12 0.0 2.0000 FORMAT "%6.3" /end AXIS_DESCR FORMAT "%4.1" /end CHARACTERISTIC
/begin CHARACTERISTIC KF_MD_IND_MIN_SCHUB "min. Schubmoment | EN: Minimum overrun torque" MAP 0x760F0 TKF_SW_SW_SW 100.0 FORMULA_0009 -100.0000 1000.0000 /begin AXIS_DESCR STD_AXIS FORMULA_0006 8 0.0 10000.0000 /end AXIS_DESCR /begin AXIS_DESCR STD_AXIS FORMULA_0023 6 -50.0000 170.0000 FORMAT "%4.1" /end AXIS_DESCR FORMAT "%4.1" /end CHARACTERISTIC
/begin CHARACTERISTIC KF_MD_IND_REIB "Reibmoment | EN: Friction torque" MAP 0x7616E TKF_SW_SW_SW 100.0 FORMULA_0009 -100.0000 1000.0000 /begin AXIS_DESCR STD_AXIS FORMULA_0023 8 -50.0000 170.0000 FORMAT "%4.1" /end AXIS_DESCR /begin AXIS_DESCR STD_AXIS FORMULA_0023 8 -50.0000 170.0000 FORMAT "%4.1" /end AXIS_DESCR FORMAT "%4.1" /end CHARACTERISTIC
/begin CHARACTERISTIC KF_MD_IND_LW_VERLUSTE "Ladungswechselverluste | EN: Gas-exchange (pumping) losses" MAP 0x76210 TKF_SW_SW_SW 100.0 FORMULA_0009 -100.0000 1000.0000 /begin AXIS_DESCR STD_AXIS FORMULA_0006 10 0.0 10000.0000 /end AXIS_DESCR /begin AXIS_DESCR STD_AXIS FORMULA_0007 8 0.0 2.0000 FORMAT "%6.3" /end AXIS_DESCR FORMAT "%4.1" /end CHARACTERISTIC
/begin CHARACTERISTIC KF_MD_ZW_OPT "Optimaler Z�ndhaken | EN: Optimum ignition hook" MAP 0x762D6 TKF_SW_SW_SW 100.0 FORMULA_0111 -50.0000 60.0000 /begin AXIS_DESCR STD_AXIS FORMULA_0006 18 0.0 10000.0000 /end AXIS_DESCR /begin AXIS_DESCR STD_AXIS FORMULA_0007 12 0.0 2.0000 FORMAT "%6.3" /end AXIS_DESCR FORMAT "%4.1" /end CHARACTERISTIC
/begin CHARACTERISTIC KF_MD_ZW_RG "Restgaseinfluss auf opt. Z�ndwinkel" MAP 0x764C4 TKF_SW_SW_SW 100.0 FORMULA_0793 0.0 100.0000 /begin AXIS_DESCR STD_AXIS FORMULA_0006 8 0.0 10000.0000 /end AXIS_DESCR /begin AXIS_DESCR STD_AXIS FORMULA_0007 6 0.0 2.0000 FORMAT "%6.3" /end AXIS_DESCR FORMAT "%4.1" /end CHARACTERISTIC
/begin CHARACTERISTIC KF_MD_ZW_OFFSET "ZW-Offset ueber n und rf | EN: Ignition-angle offset over engine speed and charge" MAP 0x76542 TKF_SW_SW_SW 100.0 FORMULA_0111 -50.0000 60.0000 /begin AXIS_DESCR STD_AXIS FORMULA_0006 4 0.0 10000.0000 /end AXIS_DESCR /begin AXIS_DESCR STD_AXIS FORMULA_0007 5 0.0 2.0000 FORMAT "%6.3" /end AXIS_DESCR FORMAT "%4.1" /end CHARACTERISTIC
/begin CHARACTERISTIC KF_MD_POLYNOM_A "A-Paramter Polynom f�r Z�ndhaken | EN: A parameter of polynomial for ignition hook (torque vs spark)" MAP 0x7657E TKF_SW_SW_SW 100.0 FORMULA_0786 -320.0000 320.0000 /begin AXIS_DESCR STD_AXIS FORMULA_0006 18 0.0 10000.0000 /end AXIS_DESCR /begin AXIS_DESCR STD_AXIS FORMULA_0007 12 0.0 2.0000 FORMAT "%6.3" /end AXIS_DESCR FORMAT "%5.2" /end CHARACTERISTIC
/begin CHARACTERISTIC KF_MD_POLYNOM_A_KH "A-Paramter Polynom f�r Z�ndhaken im KH | EN: Polynomial A parameter for ignition-efficiency hook during cat heating" MAP 0x7676C TKF_SW_SW_SW 100.0 FORMULA_0786 -320.0000 320.0000 /begin AXIS_DESCR STD_AXIS FORMULA_0006 18 0.0 10000.0000 /end AXIS_DESCR /begin AXIS_DESCR STD_AXIS FORMULA_0007 12 0.0 2.0000 FORMAT "%6.3" /end AXIS_DESCR FORMAT "%5.2" /end CHARACTERISTIC
/begin CHARACTERISTIC KF_MD_POLYNOM_B "B-Paramter Polynom f�r Z�ndhaken | EN: B parameter of polynomial for ignition hook" MAP 0x7695A TKF_SW_SW_SW 100.0 FORMULA_0786 -320.0000 320.0000 /begin AXIS_DESCR STD_AXIS FORMULA_0006 6 0.0 10000.0000 /end AXIS_DESCR /begin AXIS_DESCR STD_AXIS FORMULA_0007 4 0.0 2.0000 FORMAT "%6.3" /end AXIS_DESCR FORMAT "%5.2" /end CHARACTERISTIC
/begin CHARACTERISTIC KF_MD_START_OFFSET "Vorsteuerung f�r Start | EN: Torque feed-forward for start" MAP 0x769A0 TKF_SW_SW_SW 100.0 FORMULA_0009 -100.0000 1000.0000 /begin AXIS_DESCR STD_AXIS FORMULA_0006 8 0.0 10000.0000 /end AXIS_DESCR /begin AXIS_DESCR STD_AXIS FORMULA_0023 6 -50.0000 170.0000 FORMAT "%4.1" /end AXIS_DESCR FORMAT "%4.1" /end CHARACTERISTIC
/begin CHARACTERISTIC KF_MD_VERBR_FZG "Verbraucheroffset Fzg | EN: Vehicle consumer (accessory) offset" MAP 0x76A1E TKF_SW_SW_SW 100.0 FORMULA_0009 -100.0000 1000.0000 /begin AXIS_DESCR STD_AXIS FORMULA_0006 6 0.0 10000.0000 /end AXIS_DESCR /begin AXIS_DESCR STD_AXIS FORMULA_0023 5 -50.0000 170.0000 FORMAT "%4.1" /end AXIS_DESCR FORMAT "%4.1" /end CHARACTERISTIC
/begin CHARACTERISTIC KF_MD_ETA_LA "LA-Wirkungsgrad | EN: Lambda efficiency" MAP 0x76A72 TKF_SW_SW_UW 100.0 FORMULA_0435 0.0 150.0000
 /begin AXIS_DESCR STD_AXIS tz_soll FORMULA_0111 8 -50.0000 60.0000 FORMAT "%4.1" /end AXIS_DESCR
 /begin AXIS_DESCR STD_AXIS la_soll FORMULA_0025 8 0.0 1.9999 FORMAT "%6.3" /end AXIS_DESCR
 FORMAT "%4.1" /end CHARACTERISTIC
/* ------------------ Abschnitt erzeugt aus md_can.dat ------------------ */
/begin CHARACTERISTIC K_MD_ASC_ENABLE "ASC-Freigabe | EN: ASC enable" VALUE 0x76B14 TKW_VV_VV_UB 100.0 FORMULA_0798 0.0 255.0 /end CHARACTERISTIC
/begin CHARACTERISTIC K_MD_MSR_ENABLE "MSR-Freigabe" VALUE 0x76B15 TKW_VV_VV_UB 100.0 FORMULA_0798 0.0 255.0 /end CHARACTERISTIC
/begin CHARACTERISTIC K_MD_MSR_MAX "max. MSR-Vorgabe | EN: Maximum MSR (engine drag control) request [Nm]" VALUE 0x76B16 TKW_VV_VV_SW 100.0 FORMULA_0009 -100.0000 1000.0000 FORMAT "%4.1" /end CHARACTERISTIC
/begin CHARACTERISTIC K_MD_MSR_T_WAIT "Wartezeit vor MSR-Rampe | EN: Wait time before MSR ramp [s]" VALUE 0x76B18 TKW_VV_VV_UW 100.0 FORMULA_0117 0.0 10.0000 FORMAT "%5.2" /end CHARACTERISTIC
/begin CHARACTERISTIC K_MD_MSR_M_RAMPE "Steigung MSR-Rampe | EN: Slope of MSR ramp [Nm/s]" VALUE 0x76B1A TKW_VV_VV_SW 100.0 FORMULA_0571 -5000.0000 5000.0000 /end CHARACTERISTIC
/begin CHARACTERISTIC K_MD_ASC_AUSBLEND_HYS "Hysterese �ber Schleppmoment | EN: Hysteresis over drag torque [Nm]" VALUE 0x76B1C TKW_VV_VV_SW 100.0 FORMULA_0009 -100.0000 1000.0000 FORMAT "%4.1" /end CHARACTERISTIC
/begin CHARACTERISTIC K_MD_ASC_T_WAIT "Wartezeit vor ASC-Rampe | EN: Wait time before ASC ramp [s]" VALUE 0x76B1E TKW_VV_VV_UW 100.0 FORMULA_0117 0.0 10.0000 FORMAT "%5.2" /end CHARACTERISTIC
/begin CHARACTERISTIC K_MD_ASC_M_RAMPE "Steigung ASC-Rampe | EN: Slope of ASC ramp [Nm/s]" VALUE 0x76B20 TKW_VV_VV_SW 100.0 FORMULA_0571 -5000.0000 5000.0000 /end CHARACTERISTIC
/begin CHARACTERISTIC K_MD_ASC_M_AEBEGR "Aenderungsbegrenzung nach ASC-Eingr | EN: Rate limit after ASC intervention [Nm/s]" VALUE 0x76B22 TKW_VV_VV_SW 100.0 FORMULA_0571 -5000.0000 20000.0000 /end CHARACTERISTIC
/begin CHARACTERISTIC K_MD_CAN_ETA_ZW_OFF "ASC-Freigabe | EN: ASC enable [%]" VALUE 0x76B24 TKW_VV_VV_UW 100.0 FORMULA_0435 0.0 150.0000 FORMAT "%4.1" /end CHARACTERISTIC
/begin CHARACTERISTIC K_MD_CAN_BEGR_ST "MD-Begrenzungen default" VALUE 0x76B26 TKW_VV_VV_UB 100.0 FORMULA_0268 0.0 255.0 /end CHARACTERISTIC
/begin CHARACTERISTIC K_MD_KKOS_DYN_ST "Triggerschwelle fuer BA | EN: Trigger threshold for BA" VALUE 0x76B27 TKW_VV_VV_UB 100.0 FORMULA_0003 0.0 255.0000 /end CHARACTERISTIC
/begin CHARACTERISTIC K_MD_KKOS_TMOT_MAX "tmot fuer KKOS | EN: Engine temperature for A/C compressor [°C]" VALUE 0x76B28 TKW_VV_VV_SW 100.0 FORMULA_0023 -50.0000 170.0000 FORMAT "%4.1" /end CHARACTERISTIC
/begin CHARACTERISTIC K_MD_KKOS_TMOT_MAX_HYS "tmot fuer KKOS - Hys | EN: Engine temperature for A/C compressor - hysteresis" VALUE 0x76B2A TKW_VV_VV_SW 100.0 FORMULA_0076 -1000.0000 1000.0000 FORMAT "%4.1" /end CHARACTERISTIC
/begin CHARACTERISTIC K_MD_KKOS_ELU_TMOT_MAX "tmot fuer KKOS bei def. ELU | EN: Engine temperature for A/C cut with defective electric fan [°C]" VALUE 0x76B2C TKW_VV_VV_SW 100.0 FORMULA_0023 -50.0000 170.0000 FORMAT "%4.1" /end CHARACTERISTIC
/begin CHARACTERISTIC K_MD_KKOS_ELU_TMOT_MAX_HYS "tmot fuer KKOS bei def. ELU - Hys | EN: Engine temperature for A/C cut with defective electric fan - hysteresis" VALUE 0x76B2E TKW_VV_VV_SW 100.0 FORMULA_0076 -1000.0000 1000.0000 FORMAT "%4.1" /end CHARACTERISTIC
/begin CHARACTERISTIC K_MD_KKOS_N_MAX "nmax fuer KKOS | EN: Maximum engine speed for A/C compressor [Upm]" VALUE 0x76B30 TKW_VV_VV_SW 100.0 FORMULA_0006 0.0 10000.0000 /end CHARACTERISTIC
/begin CHARACTERISTIC K_MD_KKOS_N_MAX_HYS "nmax fuer KKOS - Hys | EN: Maximum engine speed for A/C compressor - hysteresis [Upm]" VALUE 0x76B32 TKW_VV_VV_SW 100.0 FORMULA_0006 0.0 10000.0000 /end CHARACTERISTIC
/begin CHARACTERISTIC K_MD_KKOS_N "Schwelle fuer BA-/VL | EN: Threshold for BA/full load [Upm]" VALUE 0x76B34 TKW_VV_VV_SW 100.0 FORMULA_0006 0.0 10000.0000 /end CHARACTERISTIC
/begin CHARACTERISTIC K_MD_KKOS_V_VL "Schwelle fuer VL | EN: Schwelle fuer VL" VALUE 0x76B36 TKW_VV_VV_SW 100.0 FORMULA_0078 -80.0000 360.0000 FORMAT "%4.1" /end CHARACTERISTIC
/begin CHARACTERISTIC K_MD_KKOS_V_VL_AUS "Schwelle fuer VL aus | EN: Schwelle fuer VL aus" VALUE 0x76B38 TKW_VV_VV_SW 100.0 FORMULA_0078 -80.0000 360.0000 FORMAT "%4.1" /end CHARACTERISTIC
/begin CHARACTERISTIC K_MD_KKOS_V_BA "Schwelle fuer Beschl. | EN: Schwelle fuer Beschl." VALUE 0x76B3A TKW_VV_VV_SW 100.0 FORMULA_0078 -80.0000 360.0000 FORMAT "%4.1" /end CHARACTERISTIC
/begin CHARACTERISTIC K_MD_KKOS_TIME_START "Schwelle Startfreigabe | EN: Schwelle Startfreigabe" VALUE 0x76B3C TKW_VV_VV_UW 100.0 FORMULA_0021 0.0 655.0000 FORMAT "%5.2" /end CHARACTERISTIC
/begin CHARACTERISTIC K_MD_KKOS_TIME_BA_VL "Schwelle BA-/VL-Freigabe | EN: Schwelle BA-/VL-Freigabe" VALUE 0x76B3E TKW_VV_VV_UW 100.0 FORMULA_0021 0.0 655.0000 FORMAT "%5.2" /end CHARACTERISTIC
/begin CHARACTERISTIC K_MD_KKOS_TIME_WH "Schwelle WH-Freigabe | EN: Schwelle WH-Freigabe" VALUE 0x76B40 TKW_VV_VV_UW 100.0 FORMULA_0021 0.0 655.0000 FORMAT "%5.2" /end CHARACTERISTIC
/begin CHARACTERISTIC K_MD_KKOS_START "Faktor Startoffset | EN: Faktor Startoffset" VALUE 0x76B42 TKW_VV_VV_UW 100.0 FORMULA_0075 0.0 4.0000 FORMAT "%6.3" /end CHARACTERISTIC
/begin CHARACTERISTIC K_MD_KKOS_TAU_ON "TAU KKOS-Aufregel | EN: TAU KKOS-Aufregel" VALUE 0x76B44 TKW_VV_VV_UB 100.0 FORMULA_0478 0.0051 1.2800 /end CHARACTERISTIC
/begin CHARACTERISTIC K_MD_KKOS_TAU_OFF "TAU KKOS-Aufregel | EN: TAU KKOS-Aufregel" VALUE 0x76B45 TKW_VV_VV_UB 100.0 FORMULA_0478 0.0051 1.2800 /end CHARACTERISTIC
/begin CHARACTERISTIC K_MD_KKOS_MIN "Einschaltschwelle | EN: Einschaltschwelle" VALUE 0x76B46 TKW_VV_VV_SW 100.0 FORMULA_0009 -100.0000 1000.0000 FORMAT "%4.1" /end CHARACTERISTIC
/begin CHARACTERISTIC K_MD_KKOS_MAX "KKOS-Begrenzung | EN: KKOS-Begrenzung" VALUE 0x76B48 TKW_VV_VV_SW 100.0 FORMULA_0009 -100.0000 1000.0000 FORMAT "%4.1" /end CHARACTERISTIC
/begin CHARACTERISTIC K_MD_KKOS_RES_RAMPE_ON "Steigung Res-Rampe an | EN: Steigung Res-Rampe an" VALUE 0x76B4A TKW_VV_VV_UB 100.0 FORMULA_0799 0.0 2550.0000 /end CHARACTERISTIC
/begin CHARACTERISTIC K_MD_KKOS_RES_RAMPE_OFF "Steigung Res-Rampe aus | EN: Nm/s  0p 0 -x*10 Steigung Res-Rampe aus" VALUE 0x76B4B TKW_VV_VV_UB 100.0 FORMULA_0800 0.0 -2550.0000 /end CHARACTERISTIC
/begin CHARACTERISTIC K_MD_KKOS_RES_T_MAX "Maxzeit fuer Reserve | EN: Maxzeit fuer Reserve" VALUE 0x76B4C TKW_VV_VV_UW 100.0 FORMULA_0021 0.0 655.0000 FORMAT "%5.2" /end CHARACTERISTIC
/begin CHARACTERISTIC K_MD_KKOS_ZH_TMOT "Motortemp. fuer ZH-Reserve | EN: Motortemp. fuer ZH-Reserve" VALUE 0x76B4E TKW_VV_VV_SW 100.0 FORMULA_0023 -50.0000 170.0000 FORMAT "%4.1" /end CHARACTERISTIC
/begin CHARACTERISTIC K_MD_KKOS_ZH_TUMG "Umgebungstemp. fuer ZH-Reserve | EN: Umgebungstemp. fuer ZH-Reserve" VALUE 0x76B50 TKW_VV_VV_SW 100.0 FORMULA_0023 -50.0000 170.0000 FORMAT "%4.1" /end CHARACTERISTIC
/begin CHARACTERISTIC K_MD_KKOS_ZH_RES_T_MAX "Maxzeit fuer ZH-Reserve | EN: Maxzeit fuer ZH-Reserve" VALUE 0x76B52 TKW_VV_VV_UW 100.0 FORMULA_0021 0.0 655.0000 FORMAT "%5.2" /end CHARACTERISTIC
/begin CHARACTERISTIC K_MD_KKOS_CAN_MAX "KKOS-Begrenzung | EN: KKOS-Begrenzung" VALUE 0x76B54 TKW_VV_VV_SW 100.0 FORMULA_0009 -100.0000 1000.0000 FORMAT "%4.1" /end CHARACTERISTIC
/begin CHARACTERISTIC K_MD_KKOS_ZH_RES_RAMPE "Steigung ZH-Reserve-Rampe | EN: Steigung ZH-Reserve-Rampe" VALUE 0x76B56 TKW_VV_VV_UB 100.0 FORMULA_0799 0.0 2550.0000 /end CHARACTERISTIC
/begin CHARACTERISTIC K_MD_LRW_TAU "TAU KKOS-Aufregel | EN: TAU KKOS-Aufregel" VALUE 0x76B57 TKW_VV_VV_UB 100.0 FORMULA_0462 0.0101 2.5600 /end CHARACTERISTIC
/begin CHARACTERISTIC K_MD_LRW_RES_DELTA "LRW-Begrenzung | EN: LRW-Begrenzung" VALUE 0x76B58 TKW_VV_VV_UB 100.0 FORMULA_0799 0.0 2550.0000 /end CHARACTERISTIC
/begin CHARACTERISTIC K_MD_GEN_FREISCHALT "Genarator-Freigabe | EN: 0 gesperrt 1 frei ELSE ungueltig Genarator-Freigabe" VALUE 0x76B59 TKW_VV_VV_UB 100.0 FORMULA_0798 0.0 255.0 /end CHARACTERISTIC
/begin CHARACTERISTIC K_MD_LRW_RES_V "LRW-v-Schwelle | EN: LRW-v-Schwelle" VALUE 0x76B5A TKW_VV_VV_SW 100.0 FORMULA_0078 -80.0000 360.0000 FORMAT "%4.1" /end CHARACTERISTIC
/begin CHARACTERISTIC K_MD_LRW_RES_V_HYS "LRW-v-Schwelle Hys | EN: LRW-v-Schwelle Hys" VALUE 0x76B5C TKW_VV_VV_SW 100.0 FORMULA_0078 -80.0000 360.0000 FORMAT "%4.1" /end CHARACTERISTIC
/begin CHARACTERISTIC K_MD_GEN_MAX "max. Generatormoment | EN: max. Generatormoment" VALUE 0x76B5E TKW_VV_VV_SW 100.0 FORMULA_0009 -100.0000 1000.0000 FORMAT "%4.1" /end CHARACTERISTIC
/begin CHARACTERISTIC KL_MD_KKOS_DELAY_ON "KKOS-Delay beim Einschalten | EN: A/C compressor delay on switch-on" CURVE 0x76B60 TKL_SW_VV_SW 100.0 FORMULA_0021 0.0 10.0000 /begin AXIS_DESCR STD_AXIS FORMULA_0006 4 0.0 10000.0000 /end AXIS_DESCR FORMAT "%5.2" /end CHARACTERISTIC
/begin CHARACTERISTIC KL_MD_KKOS_DELAY_OFF "KKOS-Delay beim Ausschalten | EN: A/C compressor delay on switch-off" CURVE 0x76B72 TKL_SW_VV_SW 100.0 FORMULA_0021 0.0 10.0000 /begin AXIS_DESCR STD_AXIS FORMULA_0006 4 0.0 10000.0000 /end AXIS_DESCR FORMAT "%5.2" /end CHARACTERISTIC
/begin CHARACTERISTIC KL_MD_KKOS_RES_MAX "KKOS-Reserve | EN: A/C compressor reserve" CURVE 0x76B84 TKL_SW_VV_SW 100.0 FORMULA_0009 -100.0000 1000.0000 /begin AXIS_DESCR STD_AXIS FORMULA_0006 4 0.0 10000.0000 /end AXIS_DESCR FORMAT "%4.1" /end CHARACTERISTIC
/begin CHARACTERISTIC KL_MD_KKOS_ZH_RES_MAX "KKOS-Reserve | EN: A/C compressor reserve" CURVE 0x76B96 TKL_SW_VV_SW 100.0 FORMULA_0009 -100.0000 1000.0000 /begin AXIS_DESCR STD_AXIS FORMULA_0006 4 0.0 10000.0000 /end AXIS_DESCR FORMAT "%4.1" /end CHARACTERISTIC
/begin CHARACTERISTIC KL_MD_LRW_FAK "Faktor auf LRW-Moment | EN: Factor on steering-angle torque" CURVE 0x76BA8 TKL_SW_VV_UW 100.0 FORMULA_0075 0.0 4.0000 /begin AXIS_DESCR STD_AXIS FORMULA_0006 6 0.0 10000.0000 /end AXIS_DESCR FORMAT "%6.3" /end CHARACTERISTIC
/begin CHARACTERISTIC KL_MD_LRW_RES "LRW-Reserve | EN: LRW-Reserve" CURVE 0x76BC2 TKL_SW_VV_SW 100.0 FORMULA_0009 -100.0000 1000.0000 /begin AXIS_DESCR STD_AXIS FORMULA_0141 4 -1440.1536 1440.1096 FORMAT "%5.2" /end AXIS_DESCR FORMAT "%4.1" /end CHARACTERISTIC
/begin CHARACTERISTIC KF_MD_KKOS_KORR "Korrigiertes KKOS-Moment | EN: Corrected A/C compressor torque" MAP 0x76BD4 TKF_SW_SW_SW 100.0 FORMULA_0009 -100.0000 1000.0000 /begin AXIS_DESCR STD_AXIS FORMULA_0006 5 0.0 10000.0000 /end AXIS_DESCR
 /begin AXIS_DESCR STD_AXIS kkos_in FORMULA_0009 5 -100.0000 1000.0000 FORMAT "%4.1" /end AXIS_DESCR
 FORMAT "%4.1" /end CHARACTERISTIC
/begin CHARACTERISTIC KF_MD_LRW "LRW-Moment | EN: LRW-Moment" MAP 0x76C1C TKF_SW_SW_SW 100.0 FORMULA_0009 -100.0000 1000.0000 /begin AXIS_DESCR STD_AXIS FORMULA_0141 6 -1440.1536 1440.1096 FORMAT "%5.2" /end AXIS_DESCR /begin AXIS_DESCR STD_AXIS FORMULA_0142 6 -1440.1536 1440.1096 FORMAT "%5.2" /end AXIS_DESCR FORMAT "%4.1" /end CHARACTERISTIC
/* ------------------ Abschnitt erzeugt aus md_e2.dat ------------------ */
/begin CHARACTERISTIC K_MD_E2_ERR_MAX "max. Zeit fuer Vergleichsfehler | EN: Max. Zeit für Vergleichsfehler" VALUE 0x7A55C TKW_VV_VV_UB 100.0 FORMULA_0501 0.0 25.5000 /end CHARACTERISTIC
/begin CHARACTERISTIC K_MD_E2_TAU_SOLL "Filter Sollmoment Ebene 2 | EN: s 0.1p  25.6*x Filter Sollmoment Ebene2" VALUE 0x7A55D TKW_VV_VV_UB 100.0 FORMULA_0679 0.1004 25.6000 /end CHARACTERISTIC
/begin CHARACTERISTIC K_MD_E2_FW_REL_SCHW "max. Abweichung rel. Fahrerwunsch | EN: Max. Abweichung rel- Fahrerwunsch" VALUE 0x7A55E TKW_VV_VV_SW 100.0 FORMULA_0001 -10.0000 120.0000 FORMAT "%4.1" /end CHARACTERISTIC
/begin CHARACTERISTIC K_MD_VERBR_MAX_E2 "max. Verbrauchermoment | EN: max. Verbrauchermoment Ebene2" VALUE 0x7A560 TKW_VV_VV_SW 100.0 FORMULA_0009 -100.0000 1000.0000 FORMAT "%4.1" /end CHARACTERISTIC
/begin CHARACTERISTIC K_MD_LLR_AD_MAX_E2 "max. Leerlaufadaption | EN: Max. Leerlaufadaption" VALUE 0x7A562 TKW_VV_VV_SW 100.0 FORMULA_0009 -100.0000 1000.0000 FORMAT "%4.1" /end CHARACTERISTIC
/begin CHARACTERISTIC K_MD_E2_MIN_SCHW "max. Abweichung Minmoment | EN: Max. Abweichung Minmoment" VALUE 0x7A564 TKW_VV_VV_SW 100.0 FORMULA_0009 -100.0000 1000.0000 FORMAT "%4.1" /end CHARACTERISTIC
/begin CHARACTERISTIC K_MD_E2_MAX_SCHW "max. Abweichung Maxmoment | EN: Max. Abweichung Maxmoment" VALUE 0x7A566 TKW_VV_VV_SW 100.0 FORMULA_0009 -100.0000 1000.0000 FORMAT "%4.1" /end CHARACTERISTIC
/begin CHARACTERISTIC K_MD_E2_IST_SCHW "max. Abweichung Istmoment | EN: Max. Abweichung Istmoment" VALUE 0x7A568 TKW_VV_VV_SW 100.0 FORMULA_0009 -100.0000 1000.0000 FORMAT "%4.1" /end CHARACTERISTIC
/begin CHARACTERISTIC K_MD_E2_SCHLEPP_SCHW "max. Abweichung Schleppmoment | EN: Max. Abweichung Schleppmoment" VALUE 0x7A56A TKW_VV_VV_SW 100.0 FORMULA_0009 -100.0000 1000.0000 FORMAT "%4.1" /end CHARACTERISTIC
/begin CHARACTERISTIC K_MD_HYP_DN_E2 "Offset auf Leerlaufdrehzahl | EN: Offset auf Leerlaufdrehzahl" VALUE 0x7A56C TKW_VV_VV_SW 100.0 FORMULA_0006 0.0 10000.0000 /end CHARACTERISTIC
/begin CHARACTERISTIC K_MD_HYP_VERH_E2 "Hyperbelfaktor | EN: Hyperbelfaktor" VALUE 0x7A56E TKW_VV_VV_UB 100.0 FORMULA_0704 0.0 1.9921 /end CHARACTERISTIC
/begin CHARACTERISTIC K_MD_TAU_START_OFF_E2 "Filter Startoffset | EN: Filter Startoffset" VALUE 0x7A56F TKW_VV_VV_UB 100.0 FORMULA_0679 0.1004 25.6000 /end CHARACTERISTIC
/begin CHARACTERISTIC K_MD_START_OFF_E2 "Startoffset | EN: Startoffset" VALUE 0x7A570 TKW_VV_VV_SW 100.0 FORMULA_0009 -100.0000 1000.0000 FORMAT "%4.1" /end CHARACTERISTIC
/begin CHARACTERISTIC K_MD_MSR_MAX_E2 "max. MSR-Moment Ebene 2 | EN: max. MSR-Moment Ebene2" VALUE 0x7A572 TKW_VV_VV_SW 100.0 FORMULA_0009 -100.0000 1000.0000 FORMAT "%4.1" /end CHARACTERISTIC
/begin CHARACTERISTIC K_MD_ETA_LA_E2 "LA-Faktor | EN: LA-Faktor" VALUE 0x7A574 TKW_VV_VV_UW 100.0 FORMULA_0075 0.0 4.0000 FORMAT "%6.3" /end CHARACTERISTIC
/begin CHARACTERISTIC K_MD_ZYL_ANZ_E2 "Zylinderanzahl Ebene 2 | EN: Zylinderanzahl Ebene2" VALUE 0x7A576 TKW_VV_VV_UB 100.0 FORMULA_0003 0.0 255.0000 /end CHARACTERISTIC
/begin CHARACTERISTIC K_MD_ZYL_MASK_B1 "Zylindermaske Bank 1 - Ebene 2 | EN: Zylindermaske Bank1 Ebene2" VALUE 0x7A578 TKW_VV_VV_UW 100.0 FORMULA_0010 0.0 65535.0000 /end CHARACTERISTIC
/begin CHARACTERISTIC K_MD_ZYL_MASK_B2 "Zylindermaske Bank 2 - Ebene 2 | EN: Zylindermaske Bank2 Ebene2" VALUE 0x7A57A TKW_VV_VV_UW 100.0 FORMULA_0010 0.0 65535.0000 /end CHARACTERISTIC
/begin CHARACTERISTIC K_MD_ETA_ZW_MIN_E2 "minimales ETA Ebene 2 | EN: minimales ETA Ebene2" VALUE 0x7A57C TKW_VV_VV_UW 100.0 FORMULA_0435 0.0 150.0000 FORMAT "%4.1" /end CHARACTERISTIC
/begin CHARACTERISTIC K_MD_POLYNOM_A_E2 "Polynom A Ebene 2 | EN: Polynom A Ebene2" VALUE 0x7A57E TKW_VV_VV_SW 100.0 FORMULA_0786 -320.0000 320.0000 FORMAT "%5.2" /end CHARACTERISTIC
/begin CHARACTERISTIC K_MD_POLYNOM_B_E2 "Polynom B Ebene 2 | EN: Polynom B Ebene2" VALUE 0x7A580 TKW_VV_VV_SW 100.0 FORMULA_0786 -320.0000 320.0000 FORMAT "%5.2" /end CHARACTERISTIC
/begin CHARACTERISTIC K_MD_E2_N_MIN "min. Drehzahlschwelle | EN: Min. Drehzahlschwelle" VALUE 0x7A582 TKW_VV_VV_SW 100.0 FORMULA_0006 0.0 10000.0000 /end CHARACTERISTIC
/begin CHARACTERISTIC K_MD_IND_REIB_ABREG_E2 "Abregelrampe fuer Reibmoment nach Start - Ebene 2 | EN: Abregelrampre für Reibmoment nach Start- Ebene2" VALUE 0x7A584 TKW_VV_VV_SW 100.0 FORMULA_0755 -100.0000 1000.0000 FORMAT "%4.1" /end CHARACTERISTIC
/begin CHARACTERISTIC KL_MD_RF_MAX_E2 "maximale rel. F�llung | EN: Maximum relative charge" CURVE 0x7A586 TKL_SW_VV_SW 100.0 FORMULA_0007 0.0 2.0000 /begin AXIS_DESCR STD_AXIS FORMULA_0006 10 0.0 10000.0000 /end AXIS_DESCR FORMAT "%6.3" /end CHARACTERISTIC
/begin CHARACTERISTIC KL_MD_IND_REIB_OFFSET_E2 "Offset fuer Reibmoment nach Start - Ebene 2 | EN: Offset for friction torque after start - level 2" CURVE 0x7A5B0 TKL_SW_VV_SW 100.0 FORMULA_0784 0.0 320.0000 /begin AXIS_DESCR STD_AXIS FORMULA_0023 2 -50.0000 170.0000 FORMAT "%4.1" /end AXIS_DESCR FORMAT "%4.1" /end CHARACTERISTIC
/begin CHARACTERISTIC KL_MD_FAHRER_FAK_E2 "v-Progression - Ebene 2 | EN: v-Progression - Ebene 2" CURVE 0x7A5BA TKL_SW_VV_SW 100.0 FORMULA_0075 0.0 3.0000 /begin AXIS_DESCR STD_AXIS FORMULA_0078 4 -80.0000 360.0000 FORMAT "%4.1" /end AXIS_DESCR FORMAT "%6.3" /end CHARACTERISTIC
/begin CHARACTERISTIC KF_MD_IND_OPT_E2 "optimales Moment bei LA 1 | EN: Optimum torque at lambda 1, level 2" MAP 0x7A5CC TKF_SW_SW_SW 100.0 FORMULA_0009 -100.0000 1000.0000 /begin AXIS_DESCR STD_AXIS FORMULA_0006 10 0.0 10000.0000 /end AXIS_DESCR /begin AXIS_DESCR STD_AXIS rf_e2 FORMULA_0007 10 0.0 2.0000 FORMAT "%6.3" /end AXIS_DESCR FORMAT "%4.1" /end CHARACTERISTIC
/begin CHARACTERISTIC KF_MD_IND_LW_VERLUSTE_E2 "Ladungswechselverluste | EN: Gas-exchange losses, level 2" MAP 0x7A6BE TKF_SW_SW_SW 100.0 FORMULA_0009 -100.0000 1000.0000 /begin AXIS_DESCR STD_AXIS FORMULA_0006 4 0.0 10000.0000 /end AXIS_DESCR /begin AXIS_DESCR STD_AXIS FORMULA_0007 4 0.0 2.0000 FORMAT "%6.3" /end AXIS_DESCR FORMAT "%4.1" /end CHARACTERISTIC
/begin CHARACTERISTIC KF_MD_IND_MIN_SCHUB_E2 "min. Schubmoment | EN: Friction torque, level 2" MAP 0x7A6F0 TKF_SW_SW_SW 100.0 FORMULA_0009 -100.0000 1000.0000 /begin AXIS_DESCR STD_AXIS FORMULA_0006 4 0.0 10000.0000 /end AXIS_DESCR /begin AXIS_DESCR STD_AXIS FORMULA_0023 4 -50.0000 170.0000 FORMAT "%4.1" /end AXIS_DESCR FORMAT "%4.1" /end CHARACTERISTIC
/begin CHARACTERISTIC KF_MD_IND_REIB_E2 "Reibverluste Ebene 2 | EN: Reibmoment Ebene2" MAP 0x7A722 TKF_SW_SW_SW 100.0 FORMULA_0009 -100.0000 1000.0000 /begin AXIS_DESCR STD_AXIS FORMULA_0023 4 -50.0000 170.0000 FORMAT "%4.1" /end AXIS_DESCR /begin AXIS_DESCR STD_AXIS FORMULA_0023 4 -50.0000 170.0000 FORMAT "%4.1" /end AXIS_DESCR FORMAT "%4.1" /end CHARACTERISTIC
/begin CHARACTERISTIC KF_MD_ZW_OPT_E2 "Optimaler Z�ndhaken | EN: Optimum ignition angle, level 2 [degKW x/10]" MAP 0x7A754 TKF_SW_SW_SW 100.0 FORMULA_0111 -50.0000 60.0000 /begin AXIS_DESCR STD_AXIS FORMULA_0006 10 0.0 10000.0000 /end AXIS_DESCR /begin AXIS_DESCR STD_AXIS FORMULA_0007 6 0.0 2.0000 FORMAT "%6.3" /end AXIS_DESCR FORMAT "%4.1" /end CHARACTERISTIC
/begin CHARACTERISTIC KF_MD_KUPP_OFF_E2 "Abweichung Istmoment Ebene 2 | EN: Deviation of actual torque, level 2" MAP 0x7A7EE TKF_SW_SW_SW 100.0 FORMULA_0009 -100.0000 1000.0000 /begin AXIS_DESCR STD_AXIS FORMULA_0006 6 0.0 10000.0000 /end AXIS_DESCR /begin AXIS_DESCR STD_AXIS FORMULA_0009 6 -100.0000 1000.0000 FORMAT "%4.1" /end AXIS_DESCR FORMAT "%4.1" /end CHARACTERISTIC
/begin CHARACTERISTIC KF_MD_SMG_BEGR_OFF_E2 "max. Offset auf FW Ebene 2 | EN: Maximum offset on driver demand, level 2" MAP 0x7A850 TKF_SW_SW_SW 100.0 FORMULA_0803 -100.0000 1000.0000 /begin AXIS_DESCR STD_AXIS FORMULA_0803 3 -100.0000 1000.0000 /end AXIS_DESCR /begin AXIS_DESCR STD_AXIS n_diff FORMULA_0006 3 0.0 10000.0000 /end AXIS_DESCR /end CHARACTERISTIC
/begin CHARACTERISTIC KF_MD_FAHRER_KOMFORT_E2 "Fahrerwunsch - Komfort Ebene 2 | EN: Driver demand - Komfort, level 2 (monitoring copy) [rel. torque %]" MAP 0x7A870 TKF_SW_SW_SW 100.0 FORMULA_0001 0.0 100.0000 /begin AXIS_DESCR STD_AXIS FORMULA_0006 6 0.0 10000.0000 /end AXIS_DESCR /begin AXIS_DESCR STD_AXIS FORMULA_0001 6 -10.0000 120.0000 FORMAT "%4.1" /end AXIS_DESCR FORMAT "%4.1" /end CHARACTERISTIC
/begin CHARACTERISTIC KF_MD_FAHRER_NORMAL_E2 "Fahrerwunsch - Normal Ebene 2 | EN: Driver demand - Normal, level 2 (monitoring copy) [rel. torque %]" MAP 0x7A8D2 TKF_SW_SW_SW 100.0 FORMULA_0001 0.0 100.0000 /begin AXIS_DESCR STD_AXIS FORMULA_0006 6 0.0 10000.0000 /end AXIS_DESCR /begin AXIS_DESCR STD_AXIS FORMULA_0001 6 -10.0000 120.0000 FORMAT "%4.1" /end AXIS_DESCR FORMAT "%4.1" /end CHARACTERISTIC
/begin CHARACTERISTIC KF_MD_FAHRER_SPORT_E2 "Fahrerwunsch - Sport Ebene 2 | EN: Driver demand - Sport, level 2 (monitoring copy) [rel. torque %]" MAP 0x7A934 TKF_SW_SW_SW 100.0 FORMULA_0001 0.0 100.0000 /begin AXIS_DESCR STD_AXIS FORMULA_0006 6 0.0 10000.0000 /end AXIS_DESCR /begin AXIS_DESCR STD_AXIS FORMULA_0001 6 -10.0000 120.0000 FORMAT "%4.1" /end AXIS_DESCR FORMAT "%4.1" /end CHARACTERISTIC
/* ------------------ Abschnitt erzeugt aus md_filter.dat ------------------ */
/begin CHARACTERISTIC K_MD_CFG_DYN_FIL "Filterkonfiguration" VALUE 0x76C7E TKW_VV_VV_UB 100.0 FORMULA_0813 0.0 255.0 /end CHARACTERISTIC
/begin CHARACTERISTIC K_MD_HYS_RICHTUNG "Hysterese fuer Richtungserkennung | EN: Hysteresis for direction detection [Nm/s]" VALUE 0x76C7F TKW_VV_VV_UB 100.0 FORMULA_0748 0.0 255.0000 /end CHARACTERISTIC
/begin CHARACTERISTIC K_MD_HYS_SA "Offset auf Schleppmoment inkl. EtaMin | EN: Offset on drag torque incl. EtaMin [Nm]" VALUE 0x76C80 TKW_VV_VV_SW 100.0 FORMULA_0009 -100.0000 1000.0000 FORMAT "%4.1" /end CHARACTERISTIC
/begin CHARACTERISTIC K_MD_HYS_SA_TZ "Offset auf tz_min | EN: Offset on tz_min (latest ignition) [°KW]" VALUE 0x76C82 TKW_VV_VV_SW 100.0 FORMULA_0111 -50.0000 60.0000 FORMAT "%4.1" /end CHARACTERISTIC
/begin CHARACTERISTIC K_MD_GRAD_SA "SaWe-Schrittweite fuer TZmin erreicht | EN: Switching step size when TZmin reached [Nm/s]" VALUE 0x76C84 TKW_VV_VV_SW 100.0 FORMULA_0571 -5000.0000 5000.0000 /end CHARACTERISTIC
/begin CHARACTERISTIC K_MD_GRAD_SA_CUF "SaWe-Schrittweite bei CUF | EN: Switching step size during fuel cut-off [Nm/s]" VALUE 0x76C86 TKW_VV_VV_SW 100.0 FORMULA_0571 -100000.0000 -1.0000 /end CHARACTERISTIC
/begin CHARACTERISTIC K_MD_GRAD_SA_VMA "SaWe-Schrittweite bei VMA | EN: Switching step size during VMA [Nm/s]" VALUE 0x76C88 TKW_VV_VV_SW 100.0 FORMULA_0571 1.0000 100000.0000 /end CHARACTERISTIC
/begin CHARACTERISTIC K_MD_GRAD_LSD_OKS "Gradient ohne Kraftschluss | EN: Gradient without drivetrain engaged [Nm/s]" VALUE 0x76C8A TKW_VV_VV_SW 100.0 FORMULA_0811 0.0 5000.0000 /end CHARACTERISTIC
/begin CHARACTERISTIC K_MD_GRAD_DP_OKS "Gradient ohne Kraftschluss | EN: Gradient without drivetrain engaged [Nm/s]" VALUE 0x76C8C TKW_VV_VV_SW 100.0 FORMULA_0811 -5000.0000 0.0 /end CHARACTERISTIC
/begin CHARACTERISTIC K_MD_DYN_FIL_RES_TAU "Tau der Momentenreserve | EN: Time constant of torque reserve [s]" VALUE 0x76C8E TKW_VV_VV_UB 100.0 FORMULA_0478 0.0051 1.2800 /end CHARACTERISTIC
/begin CHARACTERISTIC K_MD_TAU_FW_DPFIL "Filter fuer DP-Wichtung | EN: Filter for dashpot weighting [s]" VALUE 0x76C8F TKW_VV_VV_UB 100.0 FORMULA_0478 0.0051 1.2800 /end CHARACTERISTIC
/begin CHARACTERISTIC K_MD_ANFF_V_SCHW "Anfahrfilter v-Schwelle" VALUE 0x76C90 TKW_VV_VV_SW 100.0 FORMULA_0078 -80.0000 360.0000 FORMAT "%4.1" /end CHARACTERISTIC
/begin CHARACTERISTIC K_MD_ANFF_PWG_ON "Anfahrfilter Pwg-Schwelle On | EN: Anfahrfilter Pwg-Schwelle On" VALUE 0x76C92 TKW_VV_VV_SW 100.0 FORMULA_0001 -10.0000 120.0000 FORMAT "%4.1" /end CHARACTERISTIC
/begin CHARACTERISTIC K_MD_ANFF_PWG_OFF "Anfahrfilter Pwg-Schwelle Off | EN: Anfahrfilter Pwg-Schwelle Off" VALUE 0x76C94 TKW_VV_VV_SW 100.0 FORMULA_0001 -10.0000 120.0000 FORMAT "%4.1" /end CHARACTERISTIC
/begin CHARACTERISTIC KL_MD_FAK_LSD_B1 "LSD-Faktor Bereich 1 und LLMKS | EN: LSD-Faktor Bereich 1 und LLMKS" CURVE 0x76C96 TKL_SW_VV_UW 100.0 FORMULA_0075 0.0 20.0000 /begin AXIS_DESCR STD_AXIS FORMULA_0009 6 -100.0000 1000.0000 FORMAT "%4.1" /end AXIS_DESCR FORMAT "%6.3" /end CHARACTERISTIC
/begin CHARACTERISTIC KL_MD_FAK_LSD_B2 "LSD-Faktor Bereich 2 | EN: LSD factor, range 2" CURVE 0x76CB0 TKL_SW_VV_UW 100.0 FORMULA_0075 0.0 20.0000 /begin AXIS_DESCR STD_AXIS FORMULA_0009 6 -100.0000 1000.0000 FORMAT "%4.1" /end AXIS_DESCR FORMAT "%6.3" /end CHARACTERISTIC
/begin CHARACTERISTIC KL_MD_FAK_LSD_B3 "LSD-Faktor Bereich 3 | EN: LSD factor, range 3" CURVE 0x76CCA TKL_SW_VV_UW 100.0 FORMULA_0075 0.0 20.0000 /begin AXIS_DESCR STD_AXIS FORMULA_0009 6 -100.0000 1000.0000 FORMAT "%4.1" /end AXIS_DESCR FORMAT "%6.3" /end CHARACTERISTIC
/begin CHARACTERISTIC KL_MD_FAK_DP_B1 "DP-Faktor Bereich 1 und LLMKS | EN: Dashpot factor, range 1 and idle with clutch closed" CURVE 0x76CE4 TKL_SW_VV_UW 100.0 FORMULA_0075 0.0 20.0000 /begin AXIS_DESCR STD_AXIS FORMULA_0009 6 -100.0000 1000.0000 FORMAT "%4.1" /end AXIS_DESCR FORMAT "%6.3" /end CHARACTERISTIC
/begin CHARACTERISTIC KL_MD_FAK_DP_B2 "DP-Faktor Bereich 2 | EN: DP-Faktor Bereich 2" CURVE 0x76CFE TKL_SW_VV_UW 100.0 FORMULA_0075 0.0 20.0000 /begin AXIS_DESCR STD_AXIS FORMULA_0009 6 -100.0000 1000.0000 FORMAT "%4.1" /end AXIS_DESCR FORMAT "%6.3" /end CHARACTERISTIC
/begin CHARACTERISTIC KL_MD_FAK_DP_B3 "DP-Faktor Bereich 3 | EN: Dashpot factor, range 3" CURVE 0x76D18 TKL_SW_VV_UW 100.0 FORMULA_0075 0.0 20.0000 /begin AXIS_DESCR STD_AXIS FORMULA_0009 6 -100.0000 1000.0000 FORMAT "%4.1" /end AXIS_DESCR FORMAT "%6.3" /end CHARACTERISTIC
/begin CHARACTERISTIC KL_MD_FAK_LSD_ANFF "LSD-Faktor Anfahrfilter | EN: LSD factor, pull-away filter" CURVE 0x76D32 TKL_SW_VV_UW 100.0 FORMULA_0075 0.0 20.0000 /begin AXIS_DESCR STD_AXIS FORMULA_0486 4 -1.0000 10.0000 /end AXIS_DESCR FORMAT "%6.3" /end CHARACTERISTIC
/begin CHARACTERISTIC KF_MD_KUPP_GRENZ_LSD_U_OFFS "�bergang Bereich 1 nach 2 | EN: Übergang Bereich 1 nach 2" MAP 0x76D44 TKF_SW_SW_SW 100.0 FORMULA_0009 -100.0000 100.0000 /begin AXIS_DESCR STD_AXIS FORMULA_0486 7 -1.0000 10.0000 /end AXIS_DESCR /begin AXIS_DESCR STD_AXIS FORMULA_0006 9 0.0 10000.0000 /end AXIS_DESCR FORMAT "%4.1" /end CHARACTERISTIC
/begin CHARACTERISTIC KF_MD_KUPP_GRENZ_LSD_O "�bergang Bereich 2 nach 3 | EN: Übergang Bereich 2 nach 3" MAP 0x76DE4 TKF_SW_SW_SW 100.0 FORMULA_0009 0.0 1000.0000 /begin AXIS_DESCR STD_AXIS FORMULA_0486 7 -1.0000 10.0000 /end AXIS_DESCR /begin AXIS_DESCR STD_AXIS FORMULA_0006 9 0.0 10000.0000 /end AXIS_DESCR FORMAT "%4.1" /end CHARACTERISTIC
/begin CHARACTERISTIC KF_MD_GRAD_LSD_B1 "Gradient Bereich 1 | EN: Gradient, range 1" MAP 0x76E84 TKF_SW_SW_SW 100.0 FORMULA_0811 0.0 5000.0000 /begin AXIS_DESCR STD_AXIS FORMULA_0486 7 -1.0000 10.0000 /end AXIS_DESCR /begin AXIS_DESCR STD_AXIS FORMULA_0006 9 0.0 10000.0000 /end AXIS_DESCR /end CHARACTERISTIC
/begin CHARACTERISTIC KF_MD_GRAD_LSD_B2 "Gradient Bereich 2 | EN: Gradient, range 2" MAP 0x76F24 TKF_SW_SW_SW 100.0 FORMULA_0811 0.0 5000.0000 /begin AXIS_DESCR STD_AXIS FORMULA_0486 7 -1.0000 10.0000 /end AXIS_DESCR /begin AXIS_DESCR STD_AXIS FORMULA_0006 9 0.0 10000.0000 /end AXIS_DESCR /end CHARACTERISTIC
/begin CHARACTERISTIC KF_MD_GRAD_LSD_B3 "Gradient Bereich 3 | EN: Gradient, range 3" MAP 0x76FC4 TKF_SW_SW_SW 100.0 FORMULA_0811 0.0 5000.0000 /begin AXIS_DESCR STD_AXIS FORMULA_0486 7 -1.0000 10.0000 /end AXIS_DESCR /begin AXIS_DESCR STD_AXIS FORMULA_0006 9 0.0 10000.0000 /end AXIS_DESCR /end CHARACTERISTIC
/begin CHARACTERISTIC KF_MD_GRAD_LSD_LLMKS "Gradient bei LLMKS | EN: Gradient at idle with clutch closed" MAP 0x77064 TKF_SW_SW_SW 100.0 FORMULA_0811 0.0 5000.0000 /begin AXIS_DESCR STD_AXIS FORMULA_0486 7 -1.0000 10.0000 /end AXIS_DESCR /begin AXIS_DESCR STD_AXIS FORMULA_0006 9 0.0 10000.0000 /end AXIS_DESCR /end CHARACTERISTIC
/begin CHARACTERISTIC KF_MD_DELTA_DP_ON "Aktivierungsschwelle | EN: Activation threshold" MAP 0x77104 TKF_SW_SW_SW 100.0 FORMULA_0009 -100.0000 0.0 /begin AXIS_DESCR STD_AXIS FORMULA_0486 7 -1.0000 10.0000 /end AXIS_DESCR /begin AXIS_DESCR STD_AXIS FORMULA_0009 9 -100.0000 1000.0000 FORMAT "%4.1" /end AXIS_DESCR FORMAT "%4.1" /end CHARACTERISTIC
/begin CHARACTERISTIC KF_MD_KUPP_GRENZ_DP_U_OFFS "�bergang Bereich 1 nach 2 | EN: Transition range 1 to 2" MAP 0x771A4 TKF_SW_SW_SW 100.0 FORMULA_0009 -100.0000 100.0000 /begin AXIS_DESCR STD_AXIS FORMULA_0486 7 -1.0000 10.0000 /end AXIS_DESCR /begin AXIS_DESCR STD_AXIS FORMULA_0006 9 0.0 10000.0000 /end AXIS_DESCR FORMAT "%4.1" /end CHARACTERISTIC
/begin CHARACTERISTIC KF_MD_KUPP_GRENZ_DP_O "�bergang Bereich 2 nach 3 | EN: Transition range 2 to 3" MAP 0x77244 TKF_SW_SW_SW 100.0 FORMULA_0009 0.0 1000.0000 /begin AXIS_DESCR STD_AXIS FORMULA_0486 7 -1.0000 10.0000 /end AXIS_DESCR /begin AXIS_DESCR STD_AXIS FORMULA_0006 9 0.0 10000.0000 /end AXIS_DESCR FORMAT "%4.1" /end CHARACTERISTIC
/begin CHARACTERISTIC KF_MD_GRAD_DP_B1 "Gradient Bereich 1 | EN: Gradient, range 1" MAP 0x772E4 TKF_SW_SW_SW 100.0 FORMULA_0811 -5000.0000 0.0 /begin AXIS_DESCR STD_AXIS FORMULA_0486 7 -1.0000 10.0000 /end AXIS_DESCR /begin AXIS_DESCR STD_AXIS FORMULA_0006 9 0.0 10000.0000 /end AXIS_DESCR /end CHARACTERISTIC
/begin CHARACTERISTIC KF_MD_GRAD_DP_B2 "Gradient Bereich 2 | EN: Gradient, range 2" MAP 0x77384 TKF_SW_SW_SW 100.0 FORMULA_0811 -5000.0000 0.0 /begin AXIS_DESCR STD_AXIS FORMULA_0486 7 -1.0000 10.0000 /end AXIS_DESCR /begin AXIS_DESCR STD_AXIS FORMULA_0006 9 0.0 10000.0000 /end AXIS_DESCR /end CHARACTERISTIC
/begin CHARACTERISTIC KF_MD_GRAD_DP_B3 "Gradient Bereich 3 | EN: Gradient, range 3" MAP 0x77424 TKF_SW_SW_SW 100.0 FORMULA_0811 -5000.0000 0.0 /begin AXIS_DESCR STD_AXIS FORMULA_0486 7 -1.0000 10.0000 /end AXIS_DESCR /begin AXIS_DESCR STD_AXIS FORMULA_0006 9 0.0 10000.0000 /end AXIS_DESCR /end CHARACTERISTIC
/begin CHARACTERISTIC KF_MD_GRAD_DP_LLMKS "Gradient bei LLMKS | EN: Gradient at idle with clutch closed" MAP 0x774C4 TKF_SW_SW_SW 100.0 FORMULA_0811 -5000.0000 0.0 /begin AXIS_DESCR STD_AXIS FORMULA_0486 7 -1.0000 10.0000 /end AXIS_DESCR /begin AXIS_DESCR STD_AXIS FORMULA_0006 9 0.0 10000.0000 /end AXIS_DESCR /end CHARACTERISTIC
/begin CHARACTERISTIC KF_MD_FAK_GRAD_DP_B1 "DP-Wichtung Bereich 1 | EN: DP-Wichtung Bereich 1" MAP 0x77564 TKF_SW_SW_UW 100.0 FORMULA_0075 0.0 20.0000 /begin AXIS_DESCR STD_AXIS FORMULA_0571 4 -5000.0000 5000.0000 /end AXIS_DESCR /begin AXIS_DESCR STD_AXIS FORMULA_0009 4 -100.0000 1000.0000 FORMAT "%4.1" /end AXIS_DESCR FORMAT "%6.3" /end CHARACTERISTIC
/begin CHARACTERISTIC KF_MD_FAK_GRAD_DP_B2 "DP-Wichtung Bereich 2 | EN: Dashpot weighting, range 2" MAP 0x77596 TKF_SW_SW_UW 100.0 FORMULA_0075 0.0 20.0000 /begin AXIS_DESCR STD_AXIS FORMULA_0571 4 -5000.0000 5000.0000 /end AXIS_DESCR /begin AXIS_DESCR STD_AXIS FORMULA_0009 4 -100.0000 1000.0000 FORMAT "%4.1" /end AXIS_DESCR FORMAT "%6.3" /end CHARACTERISTIC
/begin CHARACTERISTIC KF_MD_FAK_GRAD_DP_B3 "DP-Wichtung Bereich 3 | EN: Dashpot weighting, range 3" MAP 0x775C8 TKF_SW_SW_UW 100.0 FORMULA_0075 0.0 20.0000 /begin AXIS_DESCR STD_AXIS FORMULA_0571 4 -5000.0000 5000.0000 /end AXIS_DESCR /begin AXIS_DESCR STD_AXIS FORMULA_0009 4 -100.0000 1000.0000 FORMAT "%4.1" /end AXIS_DESCR FORMAT "%6.3" /end CHARACTERISTIC
/begin CHARACTERISTIC KF_MD_DYN_FIL_RES "Momentenreserve | EN: Torque reserve" MAP 0x775FA TKF_SW_SW_SW 100.0 FORMULA_0009 0.0 1000.0000 /begin AXIS_DESCR STD_AXIS FORMULA_0486 7 -1.0000 10.0000 /end AXIS_DESCR /begin AXIS_DESCR STD_AXIS FORMULA_0009 9 -100.0000 1000.0000 FORMAT "%4.1" /end AXIS_DESCR FORMAT "%4.1" /end CHARACTERISTIC
/begin CHARACTERISTIC KF_MD_DYN_FIL_RES_FAK "Momentenreserve | EN: Torque reserve" MAP 0x7769A TKF_SW_SW_UW 100.0 FORMULA_0075 0.0 4.0000 /begin AXIS_DESCR STD_AXIS FORMULA_0001 7 -10.0000 120.0000 FORMAT "%4.1" /end AXIS_DESCR /begin AXIS_DESCR STD_AXIS FORMULA_0009 7 -100.0000 1000.0000 FORMAT "%4.1" /end AXIS_DESCR FORMAT "%6.3" /end CHARACTERISTIC
/begin CHARACTERISTIC KF_MD_TAU_LSD_B3 "LSD-Filter Bereich 3 | EN: LSD-Filter Bereich 3" MAP 0x7771A TKF_SW_SW_UW 100.0 FORMULA_0075 0.0 4.0000 /begin AXIS_DESCR STD_AXIS FORMULA_0486 7 -1.0000 10.0000 /end AXIS_DESCR /begin AXIS_DESCR STD_AXIS FORMULA_0009 9 -100.0000 1000.0000 FORMAT "%4.1" /end AXIS_DESCR FORMAT "%6.3" /end CHARACTERISTIC
/begin CHARACTERISTIC KF_MD_SPORT_LSD "Wichtungsfaktor Sport | EN: Wichtungsfaktor Sport" MAP 0x777BA TKF_SW_SW_UW 100.0 FORMULA_0075 0.0 4.0000 /begin AXIS_DESCR STD_AXIS FORMULA_0814 3 -32767.0000 32768.0000 /end AXIS_DESCR /begin AXIS_DESCR STD_AXIS FORMULA_0486 7 -1.0000 10.0000 /end AXIS_DESCR FORMAT "%6.3" /end CHARACTERISTIC
/begin CHARACTERISTIC KF_MD_SPORT_DP "Wichtungsfaktor Sport | EN: Weighting factor, Sport" MAP 0x777FA TKF_SW_SW_UW 100.0 FORMULA_0075 0.0 4.0000 /begin AXIS_DESCR STD_AXIS FORMULA_0814 3 -32767.0000 32768.0000 /end AXIS_DESCR /begin AXIS_DESCR STD_AXIS FORMULA_0486 7 -1.0000 10.0000 /end AXIS_DESCR FORMAT "%6.3" /end CHARACTERISTIC
/begin CHARACTERISTIC KF_MD_KOMFORT_LSD "Wichtungsfaktor Komfort | EN: Weighting factor, Comfort" MAP 0x7783A TKF_SW_SW_UW 100.0 FORMULA_0075 0.0 4.0000 /begin AXIS_DESCR STD_AXIS FORMULA_0814 3 -32767.0000 32768.0000 /end AXIS_DESCR /begin AXIS_DESCR STD_AXIS FORMULA_0486 7 -1.0000 10.0000 /end AXIS_DESCR FORMAT "%6.3" /end CHARACTERISTIC
/begin CHARACTERISTIC KF_MD_KOMFORT_DP "Wichtungsfaktor Komfort | EN: Weighting factor, Comfort" MAP 0x7787A TKF_SW_SW_UW 100.0 FORMULA_0075 0.0 4.0000 /begin AXIS_DESCR STD_AXIS FORMULA_0814 3 -32767.0000 32768.0000 /end AXIS_DESCR /begin AXIS_DESCR STD_AXIS FORMULA_0486 7 -1.0000 10.0000 /end AXIS_DESCR FORMAT "%6.3" /end CHARACTERISTIC
/* ------------------ Abschnitt erzeugt aus md_kus.dat ------------------ */
/begin CHARACTERISTIC K_MD_KUS_PID_A1 "Koeffizient a1, PID-Regler | EN: Coefficient a1, PID controller" VALUE 0x778BA TKW_VV_VV_SW 100.0 FORMULA_0497 -10.0000 10.0000 FORMAT "%5.2" /end CHARACTERISTIC
/begin CHARACTERISTIC K_MD_KUS_BEGR_TAU1_EIN "Zeitkonstante weiches Aufsteuern ein | EN: Time constant soft ramp-up, on [s]" VALUE 0x778BC TKW_VV_VV_UB 100.0 FORMULA_0478 0.0051 1.2800 /end CHARACTERISTIC
/begin CHARACTERISTIC K_MD_KUS_BEGR_TAU1_AUS "Zeitkonstante weiches Aufsteuern ein | EN: Time constant soft ramp-up, off [s]" VALUE 0x778BD TKW_VV_VV_UB 100.0 FORMULA_0478 0.0051 1.2800 /end CHARACTERISTIC
/begin CHARACTERISTIC K_MD_KUS_BEGR_TAU_EIN "Zeitkonstante weiches Aufsteuern ein | EN: Time constant soft ramp-up, on [s]" VALUE 0x778BE TKW_VV_VV_UB 100.0 FORMULA_0478 0.0051 1.2800 /end CHARACTERISTIC
/begin CHARACTERISTIC K_MD_KUS_BEGR_TAU_AUS "Zeitkonstante weiches Aufsteuern ein | EN: Time constant soft ramp-up, off [s]" VALUE 0x778BF TKW_VV_VV_UB 100.0 FORMULA_0478 0.0051 1.2800 /end CHARACTERISTIC
/begin CHARACTERISTIC KL_MD_KUS_KR_FAK "Faktor auf KR | EN: Factor on KR (gain)" CURVE 0x778C0 TKL_SW_VV_UW 100.0 FORMULA_0075 0.0 10.0000
 /begin AXIS_DESCR STD_AXIS Regelabweichung FORMULA_0006 6 -10000.0000 10000.0000 /end AXIS_DESCR
 FORMAT "%6.3" /end CHARACTERISTIC
/begin CHARACTERISTIC KL_MD_KUS_KUPP_MIN "Minimalmoment fuer Regler | EN: Maximum IPM clutch torque" CURVE 0x778DA TKL_SW_VV_SW 100.0 FORMULA_0009 -100.0000 1000.0000
 /begin AXIS_DESCR STD_AXIS Kupplungsschlupf FORMULA_0006 4 -10000.0000 10000.0000 /end AXIS_DESCR
 FORMAT "%4.1" /end CHARACTERISTIC
/begin CHARACTERISTIC KL_MD_KUS_TN_FAK "Faktor auf TN | EN: Factor on TN (integral time)" CURVE 0x778EC TKL_SW_VV_UW 100.0 FORMULA_0075 0.0 10.0000
 /begin AXIS_DESCR STD_AXIS Regelabweichung FORMULA_0006 6 -10000.0000 10000.0000 /end AXIS_DESCR
 FORMAT "%6.3" /end CHARACTERISTIC
/begin CHARACTERISTIC KL_MD_KUS_TV_FAK "Faktor auf TV | EN: Factor on TV (derivative time)" CURVE 0x77906 TKL_SW_VV_UW 100.0 FORMULA_0075 0.0 10.0000
 /begin AXIS_DESCR STD_AXIS Regelabweichung FORMULA_0006 6 -10000.0000 10000.0000 /end AXIS_DESCR
 FORMAT "%6.3" /end CHARACTERISTIC
/begin CHARACTERISTIC KF_MD_KUS_KR "Regelparameter KR | EN: Control parameter KR (gain)" MAP 0x77920 TKF_SW_SW_SW 100.0 FORMULA_0816 0.0 2.0000 /begin AXIS_DESCR STD_AXIS Gang FORMULA_0075 7 -1.0000 10.0000 FORMAT "%6.3" /end AXIS_DESCR /begin AXIS_DESCR STD_AXIS FORMULA_0006 6 0.0 10000.0000 /end AXIS_DESCR FORMAT "%5.2" /end CHARACTERISTIC
/begin CHARACTERISTIC KF_MD_KUS_TN "Regelparameter TN | EN: Control parameter TN (integral time)" MAP 0x77990 TKF_SW_SW_SW 100.0 FORMULA_0499 0.0030 30.0000 /begin AXIS_DESCR STD_AXIS Gang FORMULA_0075 7 -1.0000 10.0000 FORMAT "%6.3" /end AXIS_DESCR /begin AXIS_DESCR STD_AXIS FORMULA_0006 6 0.0 10000.0000 /end AXIS_DESCR FORMAT "%6.3" /end CHARACTERISTIC
/begin CHARACTERISTIC KF_MD_KUS_TV "Regelparameter TV | EN: Control parameter TV (derivative time)" MAP 0x77A00 TKF_SW_SW_SW 100.0 FORMULA_0499 0.0 20.0000 /begin AXIS_DESCR STD_AXIS Gang FORMULA_0075 7 -1.0000 10.0000 FORMAT "%6.3" /end AXIS_DESCR /begin AXIS_DESCR STD_AXIS FORMULA_0006 6 0.0 10000.0000 /end AXIS_DESCR FORMAT "%6.3" /end CHARACTERISTIC
/* ------------------ Abschnitt erzeugt aus md_sk.dat ------------------ */
/begin CHARACTERISTIC K_MD_SK_CFG "SK-Cfg" VALUE 0x77A70 TKW_VV_VV_UB 100.0 FORMULA_0363 0.0 255.0 /end CHARACTERISTIC
/begin CHARACTERISTIC K_MD_SK_TAU_PWG "Filter Pwg0-Ueberwachung | EN: Filter, pedal=0 monitoring [s]" VALUE 0x77A71 TKW_VV_VV_UB 100.0 FORMULA_0462 0.0101 2.5600 /end CHARACTERISTIC
/begin CHARACTERISTIC K_MD_SK_TAU_VERGL "Filter Vergleichsmoment | EN: Filter, comparison torque [s]" VALUE 0x77A72 TKW_VV_VV_UB 100.0 FORMULA_0462 0.0101 2.5600 /end CHARACTERISTIC
/begin CHARACTERISTIC K_MD_SK_PWGMIN "PWG-Schwelle fuer pwg=0 | EN: Pedal threshold for pedal=0 [%]" VALUE 0x77A73 TKW_VV_VV_UB 100.0 FORMULA_0479 0.0 25.0000 /end CHARACTERISTIC
/begin CHARACTERISTIC K_MD_SK_N_MIN "Drehzahlschwelle fuer Momentenueberwachung | EN: Engine-speed threshold for torque monitoring [Upm]" VALUE 0x77A74 TKW_VV_VV_SW 100.0 FORMULA_0006 0.0 10000.0000 /end CHARACTERISTIC
/begin CHARACTERISTIC K_MD_SK_NHYS "n_llr-Offset bei pwg=0 | EN: Idle speed offset at pedal=0 [Upm]" VALUE 0x77A76 TKW_VV_VV_SW 100.0 FORMULA_0006 0.0 10000.0000 /end CHARACTERISTIC
/begin CHARACTERISTIC K_MD_SK_FWMAX "max. Moment bei pwg=0 | EN: Maximum torque at pedal=0 [Nm]" VALUE 0x77A78 TKW_VV_VV_SW 100.0 FORMULA_0009 -100.0000 1000.0000 FORMAT "%4.1" /end CHARACTERISTIC
/begin CHARACTERISTIC K_MD_SK_TIMER_0 "max. Timer fuer pwg=0 | EN: Maximum timer for pedal=0 [s]" VALUE 0x77A7A TKW_VV_VV_UW 100.0 FORMULA_0021 0.0 655.0000 FORMAT "%5.2" /end CHARACTERISTIC
/begin CHARACTERISTIC K_MD_SK_TIMER_1 "max. Timer fuer pwg>0 | EN: Maximum timer for pedal>0 [s]" VALUE 0x77A7C TKW_VV_VV_UW 100.0 FORMULA_0021 0.0 655.0000 FORMAT "%5.2" /end CHARACTERISTIC
/begin CHARACTERISTIC K_MD_SK_N_MDMIN "Drehzahlschwelle fuer Momentenueberwachung MDmin | EN: Engine-speed threshold for torque monitoring MDmin [Upm]" VALUE 0x77A7E TKW_VV_VV_SW 100.0 FORMULA_0006 0.0 10000.0000 /end CHARACTERISTIC
/begin CHARACTERISTIC K_MD_SK_MAX_MDMIN "maximal zulaessiges MDmin | EN: Maximum permitted MDmin [Nm]" VALUE 0x77A80 TKW_VV_VV_SW 100.0 FORMULA_0009 -100.0000 1000.0000 FORMAT "%4.1" /end CHARACTERISTIC
/begin CHARACTERISTIC K_MD_SK_RF_MAX "max. rf zur Absicherung Momentenberechnung | EN: Maximum relative charge to secure torque calculation" VALUE 0x77A82 TKW_VV_VV_SW 100.0 FORMULA_0007 0.0 2.0000 FORMAT "%6.3" /end CHARACTERISTIC
/begin CHARACTERISTIC K_MD_SK_ETA_MIN "minimales ETA zur Absicherung Momentenberechnung | EN: Minimum efficiency to secure torque calculation [%]" VALUE 0x77A84 TKW_VV_VV_UW 100.0 FORMULA_0435 0.0 150.0000 FORMAT "%4.1" /end CHARACTERISTIC
/begin CHARACTERISTIC K_MD_SK_IND_MAX "max. indiziertes TZ-/DK-Moment | EN: Maximum indicated ignition/throttle torque [Nm]" VALUE 0x77A86 TKW_VV_VV_SW 100.0 FORMULA_0009 0.0 1000.0000 FORMAT "%4.1" /end CHARACTERISTIC
/begin CHARACTERISTIC K_MD_SK_LLR_MAX "maximaler LLR-Anteil | EN: Maximum idle controller share [Nm]" VALUE 0x77A88 TKW_VV_VV_SW 100.0 FORMULA_0009 -100.0000 1000.0000 FORMAT "%4.1" /end CHARACTERISTIC
/begin CHARACTERISTIC K_MD_SK_TIRED_MIN "Minimalwert fuer Einspritzausblendungen | EN: Minimum value for injection suppressions" VALUE 0x77A8A TKW_VV_VV_UB 100.0 FORMULA_0003 0.0 8.0000 /end CHARACTERISTIC
/begin CHARACTERISTIC K_MD_SK_TIRED_HYS "Hysterese fuer Hinzunahme eines Zylinders | EN: Hysteresis for re-enabling a cylinder" VALUE 0x77A8C TKW_VV_VV_UW 100.0 FORMULA_0075 0.0 4.0000 FORMAT "%6.3" /end CHARACTERISTIC
/begin CHARACTERISTIC K_MD_SK_BEGR_RAMPE "Rampenbegrentzer f�r MD-Begrentzung SK | EN: Ramp limiter for torque limitation, safety concept [Nm/s]" VALUE 0x77A8E TKW_VV_VV_SW 100.0 FORMULA_0755 0.0 3000.0000 FORMAT "%4.1" /end CHARACTERISTIC
/begin CHARACTERISTIC K_MD_SK_TIRED_ZYL_1of11_ "Ausblendmasken | EN: Ausblendmasken" VALUE 0x77A90 TKW_VV_VV_UW 100.0 FORMULA_0010 0.0 65535.0000 /end CHARACTERISTIC
/begin CHARACTERISTIC K_MD_SK_TIRED_ZYL_2of11_ "Ausblendmasken | EN: Ausblendmasken" VALUE 0x77A92 TKW_VV_VV_UW 100.0 FORMULA_0010 0.0 65535.0000 /end CHARACTERISTIC
/begin CHARACTERISTIC K_MD_SK_TIRED_ZYL_3of11_ "Ausblendmasken | EN: Ausblendmasken" VALUE 0x77A94 TKW_VV_VV_UW 100.0 FORMULA_0010 0.0 65535.0000 /end CHARACTERISTIC
/begin CHARACTERISTIC K_MD_SK_TIRED_ZYL_4of11_ "Ausblendmasken | EN: Ausblendmasken" VALUE 0x77A96 TKW_VV_VV_UW 100.0 FORMULA_0010 0.0 65535.0000 /end CHARACTERISTIC
/begin CHARACTERISTIC K_MD_SK_TIRED_ZYL_5of11_ "Ausblendmasken | EN: Ausblendmasken" VALUE 0x77A98 TKW_VV_VV_UW 100.0 FORMULA_0010 0.0 65535.0000 /end CHARACTERISTIC
/begin CHARACTERISTIC K_MD_SK_TIRED_ZYL_6of11_ "Ausblendmasken | EN: Ausblendmasken" VALUE 0x77A9A TKW_VV_VV_UW 100.0 FORMULA_0010 0.0 65535.0000 /end CHARACTERISTIC
/begin CHARACTERISTIC K_MD_SK_TIRED_ZYL_7of11_ "Ausblendmasken | EN: Ausblendmasken" VALUE 0x77A9C TKW_VV_VV_UW 100.0 FORMULA_0010 0.0 65535.0000 /end CHARACTERISTIC
/begin CHARACTERISTIC K_MD_SK_TIRED_ZYL_8of11_ "Ausblendmasken | EN: Ausblendmasken" VALUE 0x77A9E TKW_VV_VV_UW 100.0 FORMULA_0010 0.0 65535.0000 /end CHARACTERISTIC
/begin CHARACTERISTIC K_MD_SK_TIRED_ZYL_9of11_ "Ausblendmasken | EN: Ausblendmasken" VALUE 0x77AA0 TKW_VV_VV_UW 100.0 FORMULA_0010 0.0 65535.0000 /end CHARACTERISTIC
/begin CHARACTERISTIC K_MD_SK_TIRED_ZYL_10of11_ "Ausblendmasken | EN: Ausblendmasken" VALUE 0x77AA2 TKW_VV_VV_UW 100.0 FORMULA_0010 0.0 65535.0000 /end CHARACTERISTIC
/begin CHARACTERISTIC K_MD_SK_TIRED_ZYL_11of11_ "Ausblendmasken | EN: Ausblendmasken" VALUE 0x77AA4 TKW_VV_VV_UW 100.0 FORMULA_0010 0.0 65535.0000 /end CHARACTERISTIC
/begin CHARACTERISTIC K_MD_SK_WDK_KH_OFFS "Offset auf KL_MD_SK_WDK im KH | EN: Offset on KL_MD_SK_WDK during catalyst heating [%]" VALUE 0x77AA6 TKW_VV_VV_SW 100.0 FORMULA_0001 -10.0000 120.0000 FORMAT "%4.1" /end CHARACTERISTIC
/begin CHARACTERISTIC K_MD_SK_WDK_LLSFAIL_OFFS "Offset auf KL_MD_SK_WDK bei LLS-Off | EN: Offset auf KL_MD_SK_WDK bei LLS-Off" VALUE 0x77AA8 TKW_VV_VV_SW 100.0 FORMULA_0001 -10.0000 120.0000 FORMAT "%4.1" /end CHARACTERISTIC
/begin CHARACTERISTIC KL_MD_SK_WDK "Max. WDK-Position bei PWG=0 | EN: With idle air valve" CURVE 0x77AAA TKL_SW_VV_SW 100.0 FORMULA_0001 -10.0000 120.0000 /begin AXIS_DESCR STD_AXIS FORMULA_0006 3 0.0 10000.0000 /end AXIS_DESCR FORMAT "%4.1" /end CHARACTERISTIC
/begin CHARACTERISTIC KL_MD_SK_WDK_TI_OFFS "Max. WDK-Position bei PWG=0 und TIoff | EN: Maximum throttle position at pedal=0 and injection off" CURVE 0x77AB8 TKL_UB_VV_SW 100.0 FORMULA_0001 -10.0000 120.0000 /begin AXIS_DESCR STD_AXIS ti_off FORMULA_0003 10 0.0 255.0000 /end AXIS_DESCR FORMAT "%4.1" /end CHARACTERISTIC
/begin CHARACTERISTIC KL_MD_SK_MD_BEGR "Momentenbegrenzung durch SK-Stufe | EN: Torque limit from safety-concept stage" CURVE 0x77AD8 TKL_UB_VV_SW 100.0 FORMULA_0009 -100.0000 1000.0000 /begin AXIS_DESCR STD_AXIS Stufe FORMULA_0003 6 0.0 255.0000 /end AXIS_DESCR FORMAT "%4.1" /end CHARACTERISTIC
/begin CHARACTERISTIC KL_MD_SK_GRAD_MAX "Momentenbegrenzung durch SK-Stufe | EN: Torque limit from safety-concept stage" CURVE 0x77AEC TKL_UB_VV_SW 100.0 FORMULA_0571 -5000.0000 5000.0000 /begin AXIS_DESCR STD_AXIS Stufe FORMULA_0003 6 0.0 255.0000 /end AXIS_DESCR /end CHARACTERISTIC
/begin CHARACTERISTIC KF_MD_SK_DIFF_MAX "Abweichung Istmoment | EN: Deviation of actual torque" MAP 0x77B00 TKF_SW_SW_SW 100.0 FORMULA_0009 -100.0000 1000.0000 /begin AXIS_DESCR STD_AXIS FORMULA_0006 6 0.0 10000.0000 /end AXIS_DESCR /begin AXIS_DESCR STD_AXIS FORMULA_0009 6 -100.0000 1000.0000 FORMAT "%4.1" /end AXIS_DESCR FORMAT "%4.1" /end CHARACTERISTIC
/* ------------------ Abschnitt erzeugt aus md_soll.dat ------------------ */
/begin CHARACTERISTIC K_MD_CFG_MCS "Vorgaben per MCS" VALUE 0x77B62 TKW_VV_VV_UB 100.0 FORMULA_0823 0.0 255.0 /end CHARACTERISTIC
/begin CHARACTERISTIC K_MD_CFG_ZW_BEZUG "ZW-Bezug" VALUE 0x77B63 TKW_VV_VV_UB 100.0 FORMULA_0818 0.0 255.0 /end CHARACTERISTIC
/begin CHARACTERISTIC K_MD_CFG_TZ_EINGR "Freigabe Zuendwinkeleingriff | [Code V452 IGN 0x667F4] >= 2 (3 here): retard = min(DBGR offset, knock adaptation). < 2: cat-heating ignition offset kh_tz_offs also included in the min()." VALUE 0x77B64 TKW_VV_VV_UB 100.0 FORMULA_0824 0.0 255.0 /end CHARACTERISTIC
/begin CHARACTERISTIC K_MD_CFG_ETA_KOMP "Eta-Kompensation" VALUE 0x77B65 TKW_VV_VV_UB 100.0 FORMULA_0825 0.0 255.0 /end CHARACTERISTIC
/begin CHARACTERISTIC K_MD_CFG_FW_BLS "Einfluss Bremse auf Fahrerwunsch" VALUE 0x77B66 TKW_VV_VV_UB 100.0 FORMULA_0826 0.0 255.0 /end CHARACTERISTIC
/begin CHARACTERISTIC K_MD_BLS_BRP "Schwelle Bremsdruck | EN: Schwelle Bremsdruck" VALUE 0x77B67 TKW_VV_VV_UB 100.0 FORMULA_0138 0.0 255.0000 /end CHARACTERISTIC
/begin CHARACTERISTIC K_MD_BLS_N "Schwelle Bremsdruck | EN: Schwelle Bremsdruck" VALUE 0x77B68 TKW_VV_VV_SW 100.0 FORMULA_0006 0.0 10000.0000 /end CHARACTERISTIC
/begin CHARACTERISTIC K_MD_BLS_FW_REL "Schwelle Bremsdruck | EN: Schwelle Bremsdruck" VALUE 0x77B6A TKW_VV_VV_SW 100.0 FORMULA_0001 0.0 100.0000 FORMAT "%4.1" /end CHARACTERISTIC
/begin CHARACTERISTIC K_MD_BLS_N_VMA "Schwelle Drehzahl | EN: Schwelle Drehzahl" VALUE 0x77B6C TKW_VV_VV_SW 100.0 FORMULA_0006 0.0 10000.0000 /end CHARACTERISTIC
/begin CHARACTERISTIC K_MD_BLS_DN_VMA "Schwelle Drehzahlgradient | EN: Schwelle Drehzahlgradient" VALUE 0x77B6E TKW_VV_VV_SW 100.0 FORMULA_0114 -10000.0000 10000.0000 /end CHARACTERISTIC
/begin CHARACTERISTIC K_MD_BLS_GANG_VMA "Schwelle Gang | EN: Schwelle Gang" VALUE 0x77B70 TKW_VV_VV_SB 100.0 FORMULA_0318 -1.0000 10.0000 /end CHARACTERISTIC
/begin CHARACTERISTIC K_MD_BLS_BRP_VMA "Schwelle Bremsdruck | EN: Schwelle Bremsdruck" VALUE 0x77B71 TKW_VV_VV_UB 100.0 FORMULA_0138 0.0 255.0000 /end CHARACTERISTIC
/begin CHARACTERISTIC K_MD_ETA_EINGRIFF "ETA-Grenze | EN: ETA-Grenze" VALUE 0x77B72 TKW_VV_VV_UW 100.0 FORMULA_0435 0.0 150.0000 FORMAT "%4.1" /end CHARACTERISTIC
/begin CHARACTERISTIC K_MD_ETA_LA_KOMP_MAX "ETA-Grenze | EN: ETA-Grenze" VALUE 0x77B74 TKW_VV_VV_UW 100.0 FORMULA_0435 0.0 150.0000 FORMAT "%4.1" /end CHARACTERISTIC
/begin CHARACTERISTIC K_MD_RESERVE_TST "Test-Reserve | EN: Test-Reserve" VALUE 0x77B76 TKW_VV_VV_SW 100.0 FORMULA_0009 -100.0000 1000.0000 FORMAT "%4.1" /end CHARACTERISTIC
/begin CHARACTERISTIC K_MD_IND_WUNSCH_TZ_MCS "TZ-Vorgabe per MCS | EN: TZ-Vorgabe per MCS" VALUE 0x77B78 TKW_VV_VV_SW 100.0 FORMULA_0009 -100.0000 1000.0000 FORMAT "%4.1" /end CHARACTERISTIC
/begin CHARACTERISTIC K_MD_RF_SOLL_MCS "RF-Sollvorgabe" VALUE 0x77B7A TKW_VV_VV_SW 100.0 FORMULA_0007 0.0 2.0000 FORMAT "%6.3" /end CHARACTERISTIC
/begin CHARACTERISTIC K_MD_TZ_SOLL_MCS "TZ-Sollvorgabe | EN: TZ-Sollvorgabe" VALUE 0x77B7C TKW_VV_VV_SW 100.0 FORMULA_0111 -50.0000 60.0000 FORMAT "%4.1" /end CHARACTERISTIC
/begin CHARACTERISTIC K_MD_RES_KATH_FAK "Faktor Katheitzreserve | EN: Faktor Katheitzreserve" VALUE 0x77B7E TKW_VV_VV_UW 100.0 FORMULA_0075 0.0 4.0000 FORMAT "%6.3" /end CHARACTERISTIC
/begin CHARACTERISTIC K_MD_RES_KATH_TAU "TAU Katheitzreserve" VALUE 0x77B80 TKW_VV_VV_UB 100.0 FORMULA_0478 0.0051 1.2800 /end CHARACTERISTIC
/begin CHARACTERISTIC K_MD_TAU_IND_TZ_GRAD "TAU Sollmoment | EN: TAU Sollmoment" VALUE 0x77B81 TKW_VV_VV_UB 100.0 FORMULA_0478 0.0051 1.2800 /end CHARACTERISTIC
/begin CHARACTERISTIC K_MD_RES_MIN "Reserveschwelle | EN: Reserveschwelle" VALUE 0x77B82 TKW_VV_VV_UB 100.0 FORMULA_0749 0.0 25.0000 /end CHARACTERISTIC
/begin CHARACTERISTIC K_MD_RES_MIN_HYS "Reserveschwelle Hystherse | EN: Reserveschwelle Hystherse" VALUE 0x77B83 TKW_VV_VV_UB 100.0 FORMULA_0749 0.0 25.0000 /end CHARACTERISTIC
/begin CHARACTERISTIC K_MD_TAU_FW_GRAD "Filter fuer Fahrerwunsch | EN: Filter fuer Fahrerwunsch" VALUE 0x77B84 TKW_VV_VV_UB 100.0 FORMULA_0478 0.0051 1.2800 /end CHARACTERISTIC
/begin CHARACTERISTIC K_MD_RG_RF_FAKTOR "Faktor fuer Rf-Rg-Korrektur | EN: Faktor fuer Rf-Rg-Korrektur" VALUE 0x77B86 TKW_VV_VV_UW 100.0 FORMULA_0075 0.0 4.0000 FORMAT "%6.3" /end CHARACTERISTIC
/begin CHARACTERISTIC K_MD_KUPP_BEGR_MCS "Wochenendfzg-Momentenbegrenzung | EN: Wochenendfzg-Momentenbegrenzung" VALUE 0x77B88 TKW_VV_VV_SW 100.0 FORMULA_0009 -100.0000 1000.0000 FORMAT "%4.1" /end CHARACTERISTIC
/begin CHARACTERISTIC K_MD_BEZUG_HYS "Abschaltung der Eta-Bezugsrampe | EN: Abschaltung der Eta-Bezugsrampe" VALUE 0x77B8A TKW_VV_VV_UB 100.0 FORMULA_0749 0.0 10.0000 /end CHARACTERISTIC
/begin CHARACTERISTIC K_MD_BEZUG_RAMPE "Eta-Bezugsrampe | EN: Eta-Bezugsrampe" VALUE 0x77B8B TKW_VV_VV_UB 100.0 FORMULA_0827 0.0 5100.0000 /end CHARACTERISTIC
/begin CHARACTERISTIC K_MD_ETA_STAT_TAU "TAU stat. TZ | EN: TAU stat. TZ" VALUE 0x77B8C TKW_VV_VV_UB 100.0 FORMULA_0478 0.0051 1.2800 /end CHARACTERISTIC
/begin CHARACTERISTIC K_MD_ETA_KH_TAU "TAU KH-TZ" VALUE 0x77B8D TKW_VV_VV_UB 100.0 FORMULA_0478 0.0051 1.2800 /end CHARACTERISTIC
/begin CHARACTERISTIC K_MD_ETA_KH_TAU_LL "TAU KH-TZ | EN: TAU KH-TZ" VALUE 0x77B8E TKW_VV_VV_UB 100.0 FORMULA_0478 0.0051 1.2800 /end CHARACTERISTIC
/begin CHARACTERISTIC K_MD_ETA_STAT_TAU_LL "TAU md_tz_stat_mw | EN: TAU md_tz_stat_mw" VALUE 0x77B8F TKW_VV_VV_UB 100.0 FORMULA_0478 0.0051 1.2800 /end CHARACTERISTIC
/begin CHARACTERISTIC K_MD_ETA_LA_TAU "TAU LA | EN: TAU LA" VALUE 0x77B90 TKW_VV_VV_UB 100.0 FORMULA_0478 0.0051 1.2800 /end CHARACTERISTIC
/begin CHARACTERISTIC K_MD_VBEGR_HYS_AUS "n-Abschalthysterese | EN: n-Abschalthysterese" VALUE 0x77B92 TKW_VV_VV_SW 100.0 FORMULA_0078 -80.0000 360.0000 FORMAT "%4.1" /end CHARACTERISTIC
/begin CHARACTERISTIC K_MD_VBEGR_MD_HYS "Md-Abschalthysterese | EN: Md-Abschalthysterese" VALUE 0x77B94 TKW_VV_VV_SW 100.0 FORMULA_0009 -100.0000 1000.0000 FORMAT "%4.1" /end CHARACTERISTIC
/begin CHARACTERISTIC K_MD_NBEGR_HYS_AUS "n-Hysteres fuer Deaktivierung N-Begrenzung" VALUE 0x77B96 TKW_VV_VV_SW 100.0 FORMULA_0006 0.0 2000.0000 /end CHARACTERISTIC
/begin CHARACTERISTIC K_MD_NBEGR_MD_HYS "Aktivierhysterese | EN: Aktivierhysterese" VALUE 0x77B98 TKW_VV_VV_SW 100.0 FORMULA_0009 -100.0000 1000.0000 FORMAT "%4.1" /end CHARACTERISTIC
/begin CHARACTERISTIC K_MD_NBEGR_AKTIV "Schwelle fuer Nmax-Reduktion" VALUE 0x77B9A TKW_VV_VV_SW 100.0 FORMULA_0006 0.0 10000.0000 /end CHARACTERISTIC
/begin CHARACTERISTIC K_MD_NBEGR_N_DELTA "Begrenzung Abregelrampe | EN: Begrenzung Abregelrampe" VALUE 0x77B9C TKW_VV_VV_UB 100.0 FORMULA_0828 0.0 20000.0000 /end CHARACTERISTIC
/begin CHARACTERISTIC K_MD_NOISE_CFG "Noise-Cfg | EN: Noise configuration" VALUE 0x77B9D TKW_VV_VV_UB 100.0 FORMULA_0829 0.0 255.0000 /end CHARACTERISTIC
/begin CHARACTERISTIC K_MD_NOISE_T "Noisezeit | EN: Noise time [s]" VALUE 0x77B9E TKW_VV_VV_UW 100.0 FORMULA_0073 0.0 6553.5000 FORMAT "%4.1" /end CHARACTERISTIC
/begin CHARACTERISTIC K_MD_NOISE_V_MIN1 "Eintrittsbedingung | EN: Entry condition [km/h]" VALUE 0x77BA0 TKW_VV_VV_SW 100.0 FORMULA_0078 -80.0000 360.0000 FORMAT "%4.1" /end CHARACTERISTIC
/begin CHARACTERISTIC K_MD_NOISE_V_MAX1 "Eintrittsbedingung | EN: Entry condition [km/h]" VALUE 0x77BA2 TKW_VV_VV_SW 100.0 FORMULA_0078 -80.0000 360.0000 FORMAT "%4.1" /end CHARACTERISTIC
/begin CHARACTERISTIC K_MD_NOISE_V_MIN2 "Austrittsbedingung | EN: Exit condition [km/h]" VALUE 0x77BA4 TKW_VV_VV_SW 100.0 FORMULA_0078 -80.0000 360.0000 FORMAT "%4.1" /end CHARACTERISTIC
/begin CHARACTERISTIC K_MD_NOISE_V_MAX2 "Austrittsbedingung | EN: Exit condition [km/h]" VALUE 0x77BA6 TKW_VV_VV_SW 100.0 FORMULA_0078 -80.0000 360.0000 FORMAT "%4.1" /end CHARACTERISTIC
/begin CHARACTERISTIC K_MD_NOISE_V_MIN3 "Profilerkennung | EN: Profile detection [km/h]" VALUE 0x77BA8 TKW_VV_VV_SW 100.0 FORMULA_0078 -80.0000 360.0000 FORMAT "%4.1" /end CHARACTERISTIC
/begin CHARACTERISTIC K_MD_NOISE_V_MAX3 "Profilerkennung | EN: Profile detection [km/h]" VALUE 0x77BAA TKW_VV_VV_SW 100.0 FORMULA_0078 -80.0000 360.0000 FORMAT "%4.1" /end CHARACTERISTIC
/begin CHARACTERISTIC K_MD_NOISE_PWG_SOLL "Noiseschwelle PWG | EN: Noise threshold, pedal [%]" VALUE 0x77BAC TKW_VV_VV_SW 100.0 FORMULA_0001 -10.0000 120.0000 FORMAT "%4.1" /end CHARACTERISTIC
/begin CHARACTERISTIC K_MD_NOISE_RAMPE "Noiseschwelle PWG | EN: Noise threshold, pedal [Nm/s]" VALUE 0x77BAE TKW_VV_VV_SW 100.0 FORMULA_0811 -5000.0000 5000.0000 /end CHARACTERISTIC
/begin CHARACTERISTIC K_MD_NBEGR_A1 "Reglerfaktor A1 | EN: Reglerfaktor A1" VALUE 0x77BB0 TKW_VV_VV_SW 100.0 FORMULA_0497 -10.0000 10.0000 FORMAT "%5.2" /end CHARACTERISTIC
/begin CHARACTERISTIC K_MD_VBEGR_A1 "Reglerfaktor A1 | EN: Reglerfaktor A1" VALUE 0x77BB2 TKW_VV_VV_SW 100.0 FORMULA_0497 -10.0000 10.0000 FORMAT "%5.2" /end CHARACTERISTIC
/begin CHARACTERISTIC K_MD_RF_SOLL_SEK_CFG "Konfig uber Einrechnung sek. Fuellungseinfluss | EN: 0x0 Inaktiv 0x1 mit TE 0x2 mit MVAC 0x3 mit TE+MVAC Konfig uber Einrechnung sek. Fuellungseinfluss" VALUE 0x77BB4 TKW_VV_VV_UB 100.0 FORMULA_0830 0.0 255.0 /end CHARACTERISTIC
/begin CHARACTERISTIC K_MD_KUPP_GANG_RAMPE "Eta-Bezugsrampe | EN: Eta-Bezugsrampe" VALUE 0x77BB6 TKW_VV_VV_SW 100.0 FORMULA_0571 -5000.0000 5000.0000 /end CHARACTERISTIC
/begin CHARACTERISTIC KL_MD_RG_TAU "Filterkonstante RG-Komp" CURVE 0x77BB8 TKL_SW_VV_UB 100.0 FORMULA_0478 0.0051 1.2800 /begin AXIS_DESCR STD_AXIS FORMULA_0006 4 0.0 10000.0000 /end AXIS_DESCR /end CHARACTERISTIC
/begin CHARACTERISTIC KL_MD_KUPP_MIN_ASC "min. Moment bei ASC-Eingriff | EN: Minimum torque during ASC intervention" CURVE 0x77BC6 TKL_SW_VV_SW 100.0 FORMULA_0009 -100.0000 1000.0000 /begin AXIS_DESCR STD_AXIS FORMULA_0006 6 0.0 10000.0000 /end AXIS_DESCR FORMAT "%4.1" /end CHARACTERISTIC
/begin CHARACTERISTIC KL_MD_NBEGR_N_OFFSET "Abregelung Begrenzerdrehzahl" CURVE 0x77BE0 TKL_UW_VV_SW 100.0 FORMULA_0006 0.0 1000.0000 /begin AXIS_DESCR STD_AXIS FORMULA_0117 4 0.0 325.0000 FORMAT "%5.2" /end AXIS_DESCR /end CHARACTERISTIC
/begin CHARACTERISTIC KL_MD_BEGR_NOISE "Maximalmoment | EN: Maximum torque" CURVE 0x77BF2 TKL_SW_VV_SW 100.0 FORMULA_0009 -100.0000 1000.0000 /begin AXIS_DESCR STD_AXIS FORMULA_0078 3 0.0 360.0000 FORMAT "%4.1" /end AXIS_DESCR FORMAT "%4.1" /end CHARACTERISTIC
/begin CHARACTERISTIC KL_MD_NBEGR_GANG "Einfluss ueber Gradient | EN: Influence over gradient" CURVE 0x77C00 TKL_SW_VV_UB 100.0 FORMULA_0318 0.0 10.0000 /begin AXIS_DESCR STD_AXIS dn FORMULA_0114 5 -10000.0000 10000.0000 /end AXIS_DESCR /end CHARACTERISTIC
/begin CHARACTERISTIC KL_MD_NBEGR_ABSTAND "n-Differenz fuer Aktivierung N-Begrenzung" CURVE 0x77C12 TKL_UB_VV_SW 100.0 FORMULA_0006 0.0 4000.0000 /begin AXIS_DESCR STD_AXIS FORMULA_0318 8 0.0 10.0000 /end AXIS_DESCR /end CHARACTERISTIC
/begin CHARACTERISTIC KL_MD_NBEGR_N_MAX "Begrenzung Abregeldrehzahl | EN: Limit of cut-off engine speed" CURVE 0x77C2C TKL_UB_VV_SW 100.0 FORMULA_0831 0.0 20000.0000 /begin AXIS_DESCR STD_AXIS FORMULA_0318 8 0.0 10.0000 /end AXIS_DESCR FORMAT "%5.2" /end CHARACTERISTIC
/begin CHARACTERISTIC KL_MD_NBEGR_RAMPE "Aenderungsbegrenzung | EN: Rate limit" CURVE 0x77C46 TKL_UB_VV_SW 100.0 FORMULA_0571 -5000.0000 10000.0000 /begin AXIS_DESCR STD_AXIS FORMULA_0318 8 0.0 10.0000 /end AXIS_DESCR /end CHARACTERISTIC
/begin CHARACTERISTIC KL_MD_NBEGR_KR_FAK "Faktor auf KR | EN: Factor on KR (gain)" CURVE 0x77C60 TKL_SW_VV_UW 100.0 FORMULA_0075 0.0 10.0000 /begin AXIS_DESCR STD_AXIS FORMULA_0006 6 -4000.0000 4000.0000 /end AXIS_DESCR FORMAT "%6.3" /end CHARACTERISTIC
/begin CHARACTERISTIC KL_MD_NBEGR_TN_FAK "Faktor auf TN | EN: Factor on TN (integral time)" CURVE 0x77C7A TKL_SW_VV_UW 100.0 FORMULA_0075 0.0 4.0000 /begin AXIS_DESCR STD_AXIS FORMULA_0006 6 -4000.0000 4000.0000 /end AXIS_DESCR FORMAT "%6.3" /end CHARACTERISTIC
/begin CHARACTERISTIC KL_MD_NBEGR_TV_FAK "Faktor auf TV | EN: Factor on TV (derivative time)" CURVE 0x77C94 TKL_SW_VV_UW 100.0 FORMULA_0075 0.0 4.0000 /begin AXIS_DESCR STD_AXIS FORMULA_0006 6 -4000.0000 4000.0000 /end AXIS_DESCR FORMAT "%6.3" /end CHARACTERISTIC
/begin CHARACTERISTIC KL_MD_VBEGR_KR_FAK "Faktor auf KR | EN: Faktor auf KR" CURVE 0x77CAE TKL_SW_VV_UW 100.0 FORMULA_0075 0.0 10.0000 /begin AXIS_DESCR STD_AXIS FORMULA_0078 5 -250.0000 250.0000 FORMAT "%4.1" /end AXIS_DESCR FORMAT "%6.3" /end CHARACTERISTIC
/begin CHARACTERISTIC KL_MD_VBEGR_TN_FAK "Faktor auf TN | EN: Factor on TN (integral time)" CURVE 0x77CC4 TKL_SW_VV_UW 100.0 FORMULA_0075 0.0 10.0000 /begin AXIS_DESCR STD_AXIS FORMULA_0078 5 -250.0000 250.0000 FORMAT "%4.1" /end AXIS_DESCR FORMAT "%6.3" /end CHARACTERISTIC
/begin CHARACTERISTIC KL_MD_VBEGR_TV_FAK "Faktor auf TV | EN: Factor on TV (derivative time)" CURVE 0x77CDA TKL_SW_VV_UW 100.0 FORMULA_0075 0.0 10.0000 /begin AXIS_DESCR STD_AXIS FORMULA_0078 5 -250.0000 250.0000 FORMAT "%4.1" /end AXIS_DESCR FORMAT "%6.3" /end CHARACTERISTIC
/begin CHARACTERISTIC KL_MD_VBEGR_ABSTAND "Abstand | EN: Distance" CURVE 0x77CF0 TKL_SW_VV_SW 100.0 FORMULA_0078 -80.0000 360.0000 /begin AXIS_DESCR STD_AXIS FORMULA_0486 4 0.0 10.0000 /end AXIS_DESCR FORMAT "%4.1" /end CHARACTERISTIC
/begin CHARACTERISTIC KL_MD_VBEGR_RAMPE "Aenderungsbegrenzung | EN: Rate limit" CURVE 0x77D02 TKL_SW_VV_SW 100.0 FORMULA_0571 -5000.0000 100000.0000 /begin AXIS_DESCR STD_AXIS FORMULA_0486 4 0.0 10.0000 /end AXIS_DESCR /end CHARACTERISTIC
/begin CHARACTERISTIC KL_MD_VBEGR_TAU "Aenderungsbegrenzung | EN: Rate limit" CURVE 0x77D14 TKL_SW_VV_UB 100.0 FORMULA_0478 0.0051 1.2800 /begin AXIS_DESCR STD_AXIS t FORMULA_0117 3 0.0 150.0000 FORMAT "%5.2" /end AXIS_DESCR /end CHARACTERISTIC
/begin CHARACTERISTIC KL_MD_VBEGR_KR_FAK_SK "Faktor bei Ausblender | EN: Vmax limiter factor vs number of cylinders shut off" CURVE 0x77D20 TKL_UB_VV_SW 100.0 FORMULA_0075 0.0 20.0000 /begin AXIS_DESCR STD_AXIS FORMULA_0003 4 0.0 12.0000 /end AXIS_DESCR FORMAT "%6.3" /end CHARACTERISTIC
/begin CHARACTERISTIC KL_MD_VBEGR_TN_FAK_SK "Faktor bei Ausblender | EN: Factor during cylinder suppression" CURVE 0x77D2E TKL_UB_VV_SW 100.0 FORMULA_0075 0.0 20.0000 /begin AXIS_DESCR STD_AXIS FORMULA_0003 4 0.0 12.0000 /end AXIS_DESCR FORMAT "%6.3" /end CHARACTERISTIC
/begin CHARACTERISTIC KL_MD_NBEGR_KR_FAK_SK "Faktor bei Ausblender | EN: Factor during cylinder suppression" CURVE 0x77D3C TKL_UB_VV_SW 100.0 FORMULA_0075 0.0 20.0000 /begin AXIS_DESCR STD_AXIS FORMULA_0003 4 0.0 12.0000 /end AXIS_DESCR FORMAT "%6.3" /end CHARACTERISTIC
/begin CHARACTERISTIC KL_MD_NBEGR_TN_FAK_SK "Faktor bei Ausblender | EN: Factor during cylinder suppression" CURVE 0x77D4A TKL_UB_VV_SW 100.0 FORMULA_0075 0.0 20.0000 /begin AXIS_DESCR STD_AXIS FORMULA_0003 4 0.0 12.0000 /end AXIS_DESCR FORMAT "%6.3" /end CHARACTERISTIC
/begin CHARACTERISTIC KL_MD_FAHRER_FAK_KOMFORT "v-Progression - Komfort | EN: Speed progression factor on pedal map - Komfort" CURVE 0x77D58 TKL_SW_VV_UW 100.0 FORMULA_0075 0.0 3.0000 /begin AXIS_DESCR STD_AXIS FORMULA_0078 8 -80.0000 360.0000 FORMAT "%4.1" /end AXIS_DESCR FORMAT "%6.3" /end CHARACTERISTIC
/begin CHARACTERISTIC KL_MD_FAHRER_FAK_NORMAL "v-Progression - Normal | EN: Speed progression factor on pedal map - Normal" CURVE 0x77D7A TKL_SW_VV_UW 100.0 FORMULA_0075 0.0 3.0000 /begin AXIS_DESCR STD_AXIS FORMULA_0078 8 -80.0000 360.0000 FORMAT "%4.1" /end AXIS_DESCR FORMAT "%6.3" /end CHARACTERISTIC
/begin CHARACTERISTIC KL_MD_FAHRER_FAK_SPORT "v-Progression - Sport | EN: Speed progression factor on pedal map - Sport" CURVE 0x77D9C TKL_SW_VV_UW 100.0 FORMULA_0075 0.0 3.0000 /begin AXIS_DESCR STD_AXIS FORMULA_0078 8 -80.0000 360.0000 FORMAT "%4.1" /end AXIS_DESCR FORMAT "%6.3" /end CHARACTERISTIC
/begin CHARACTERISTIC KL_MD_TZ_AEBG_AUF "Aenderungsbegrenzung im KH" CURVE 0x77DBE TKL_SW_VV_SW 100.0 FORMULA_0832 0.0 100.0000 /begin AXIS_DESCR STD_AXIS FORMULA_0006 8 0.0 10000.0000 /end AXIS_DESCR FORMAT "%4.1" /end CHARACTERISTIC
/begin CHARACTERISTIC KL_MD_TZ_AEBG_AB "Aenderungsbegrenzung im KH" CURVE 0x77DE0 TKL_SW_VV_SW 100.0 FORMULA_0832 0.0 100.0000 /begin AXIS_DESCR STD_AXIS FORMULA_0006 8 0.0 10000.0000 /end AXIS_DESCR FORMAT "%4.1" /end CHARACTERISTIC
/begin CHARACTERISTIC KL_MD_RES_MIN "min. Momentenreserve fuer OBD | EN: Minimum torque reserve for OBD" CURVE 0x77E02 TKL_SW_VV_SW 100.0 FORMULA_0009 -100.0000 1000.0000 /begin AXIS_DESCR STD_AXIS FORMULA_0009 4 -100.0000 1000.0000 FORMAT "%4.1" /end AXIS_DESCR FORMAT "%4.1" /end CHARACTERISTIC
/begin CHARACTERISTIC KL_MD_KUPP_MAX_GANG "Gangbegrenzung | EN: Torque limit per gear" CURVE 0x77E14 TKL_SW_VV_SW 100.0 FORMULA_0009 -100.0000 1000.0000 /begin AXIS_DESCR STD_AXIS FORMULA_0486 9 -1.0000 10.0000 /end AXIS_DESCR FORMAT "%4.1" /end CHARACTERISTIC
/begin CHARACTERISTIC KF_MD_FAHRER_KOMFORT "Fahrerwunsch - Komfort | EN: Driver demand (pedal map) - Komfort (with M-Drive option), SMG/manual" MAP 0x77E3A TKF_SW_SW_SW 100.0 FORMULA_0001 0.0 100.0000 /begin AXIS_DESCR STD_AXIS FORMULA_0006 12 0.0 10000.0000 /end AXIS_DESCR /begin AXIS_DESCR STD_AXIS FORMULA_0001 12 -10.0000 120.0000 FORMAT "%4.1" /end AXIS_DESCR FORMAT "%4.1" /end CHARACTERISTIC
/begin CHARACTERISTIC KF_MD_FAHRER_NORMAL "Fahrerwunsch - Normal | EN: Driver demand (pedal map) - Normal (with M-Drive option)" MAP 0x77F8C TKF_SW_SW_SW 100.0 FORMULA_0001 0.0 100.0000 /begin AXIS_DESCR STD_AXIS FORMULA_0006 12 0.0 10000.0000 /end AXIS_DESCR /begin AXIS_DESCR STD_AXIS FORMULA_0001 12 -10.0000 120.0000 FORMAT "%4.1" /end AXIS_DESCR FORMAT "%4.1" /end CHARACTERISTIC
/begin CHARACTERISTIC KF_MD_FAHRER_SPORT "Fahrerwunsch - Sport | EN: Driver demand (pedal map) - Sport (with M-Drive option)" MAP 0x780DE TKF_SW_SW_SW 100.0 FORMULA_0001 0.0 100.0000 /begin AXIS_DESCR STD_AXIS FORMULA_0006 12 0.0 10000.0000 /end AXIS_DESCR /begin AXIS_DESCR STD_AXIS FORMULA_0001 12 -10.0000 120.0000 FORMAT "%4.1" /end AXIS_DESCR FORMAT "%4.1" /end CHARACTERISTIC
/begin CHARACTERISTIC KF_MD_FAHRER_PST "Fahrerwunsch - Pruefstand | EN: Driver demand - test bench" MAP 0x78230 TKF_SW_SW_SW 100.0 FORMULA_0001 0.0 100.0000 /begin AXIS_DESCR STD_AXIS FORMULA_0006 12 0.0 10000.0000 /end AXIS_DESCR /begin AXIS_DESCR STD_AXIS FORMULA_0001 12 -10.0000 120.0000 FORMAT "%4.1" /end AXIS_DESCR FORMAT "%4.1" /end CHARACTERISTIC
/begin CHARACTERISTIC KF_MD_SMG_BEGR_OFF "max. Offset auf Fahrerwunsch | EN: Maximum offset on driver demand" MAP 0x78382 TKF_SW_SW_SW 100.0 FORMULA_0803 0.0 1000.0000 /begin AXIS_DESCR STD_AXIS FORMULA_0803 5 -100.0000 1000.0000 /end AXIS_DESCR /begin AXIS_DESCR STD_AXIS n_diff FORMULA_0006 5 0.0 10000.0000 /end AXIS_DESCR /end CHARACTERISTIC
/begin CHARACTERISTIC KF_MD_NBEGR_KR "Regelparameter KR | EN: Control parameter KR (gain)" MAP 0x783CA TKF_SW_SW_UW 100.0 FORMULA_0816 0.0 2.0000 /begin AXIS_DESCR STD_AXIS FORMULA_0486 8 -1.0000 10.0000 /end AXIS_DESCR /begin AXIS_DESCR STD_AXIS FORMULA_0006 6 0.0 10000.0000 /end AXIS_DESCR FORMAT "%5.2" /end CHARACTERISTIC
/begin CHARACTERISTIC KF_MD_NBEGR_TN "Regelparameter TN | EN: Control parameter TN (integral time)" MAP 0x78448 TKF_SW_SW_UW 100.0 FORMULA_0833 0.0030 60.0000 /begin AXIS_DESCR STD_AXIS FORMULA_0486 8 -1.0000 10.0000 /end AXIS_DESCR /begin AXIS_DESCR STD_AXIS FORMULA_0006 6 0.0 10000.0000 /end AXIS_DESCR FORMAT "%6.3" /end CHARACTERISTIC
/begin CHARACTERISTIC KF_MD_NBEGR_TV "Regelparameter TV | EN: Control parameter TV (derivative time)" MAP 0x784C6 TKF_SW_SW_UW 100.0 FORMULA_0833 0.0 20.0000 /begin AXIS_DESCR STD_AXIS FORMULA_0486 8 -1.0000 10.0000 /end AXIS_DESCR /begin AXIS_DESCR STD_AXIS FORMULA_0006 6 0.0 10000.0000 /end AXIS_DESCR FORMAT "%6.3" /end CHARACTERISTIC
/begin CHARACTERISTIC KF_MD_VBEGR_KR "Regelparameter KR | EN: Control parameter KR (gain)" MAP 0x78544 TKF_SW_SW_UW 100.0 FORMULA_0834 0.0 40.0000 /begin AXIS_DESCR STD_AXIS FORMULA_0486 4 -1.0000 10.0000 /end AXIS_DESCR /begin AXIS_DESCR STD_AXIS FORMULA_0078 6 -80.0000 360.0000 FORMAT "%4.1" /end AXIS_DESCR FORMAT "%5.2" /end CHARACTERISTIC
/begin CHARACTERISTIC KF_MD_VBEGR_TN "Regelparameter TN | EN: Control parameter TN (integral time)" MAP 0x7858A TKF_SW_SW_UW 100.0 FORMULA_0833 0.0030 60.0000 /begin AXIS_DESCR STD_AXIS FORMULA_0486 4 -1.0000 10.0000 /end AXIS_DESCR /begin AXIS_DESCR STD_AXIS FORMULA_0078 6 -80.0000 360.0000 FORMAT "%4.1" /end AXIS_DESCR FORMAT "%6.3" /end CHARACTERISTIC
/begin CHARACTERISTIC KF_MD_VBEGR_TV "Regelparameter TV | EN: Control parameter TV (derivative time)" MAP 0x785D0 TKF_SW_SW_UW 100.0 FORMULA_0833 0.0 20.0000 /begin AXIS_DESCR STD_AXIS FORMULA_0486 4 -1.0000 10.0000 /end AXIS_DESCR /begin AXIS_DESCR STD_AXIS FORMULA_0078 6 -80.0000 360.0000 FORMAT "%4.1" /end AXIS_DESCR FORMAT "%6.3" /end CHARACTERISTIC
/* ------------------ Abschnitt erzeugt aus tka.dat ------------------ */
/begin CHARACTERISTIC K_TKA_DIAG_MIN "Unter Grenze Kuehlwasseraustrittstemperatur" VALUE 0x796F0 TKW_VV_VV_SW 100.0 FORMULA_0987 -50.0000 170.0000 FORMAT "%6.3" /end CHARACTERISTIC
/begin CHARACTERISTIC K_TKA_DIAG_MAX "Obere Grenze Kuehlwasseraustrittstemperatur" VALUE 0x796F2 TKW_VV_VV_SW 100.0 FORMULA_0987 -50.0000 170.0000 FORMAT "%6.3" /end CHARACTERISTIC
/begin CHARACTERISTIC K_TKA_TAU "Filterkonstante fuer die Kuehlwasseraustrittstemperatur" VALUE 0x796F4 TKW_VV_VV_UB 100.0 FORMULA_0679 0.1004 25.6000 /end CHARACTERISTIC
/begin CHARACTERISTIC K_TKA_OBD_DELTA_HIGH "Maximale Ueberhoehung von tka gegenueber tmot" VALUE 0x796F6 TKW_VV_VV_SW 100.0 FORMULA_0076 -1000.0000 1000.0000 FORMAT "%4.1" /end CHARACTERISTIC
/begin CHARACTERISTIC K_TKA_OBD_DELTA_NORM "Erwartete Temperaturerhoehung von tka" VALUE 0x796F8 TKW_VV_VV_SW 100.0 FORMULA_0076 -1000.0000 1000.0000 FORMAT "%4.1" /end CHARACTERISTIC
/begin CHARACTERISTIC K_TKA_OBD_TMOT_MIN "Temperaturschwelle fuer TKA-Diagnose" VALUE 0x796FA TKW_VV_VV_SW 100.0 FORMULA_0023 -50.0000 170.0000 FORMAT "%4.1" /end CHARACTERISTIC
/begin CHARACTERISTIC KL_TKA_NTC "Kennlinie Kuehleraustrittstemperatur" CURVE 0x796FC TKL_SW_VV_SW 100.0 FORMULA_0987 -50.0000 170.0000 /begin AXIS_DESCR STD_AXIS FORMULA_0123 8 0.0 1023.0000 /end AXIS_DESCR FORMAT "%6.3" /end CHARACTERISTIC
/begin CHARACTERISTIC KL_TKA_OBD_TMOT_T "Kennlinie Diagnosezeit [V912: differs from V452 160E]" CURVE 0x7971E TKL_SW_VV_UW 100.0 FORMULA_0073 0.0 6553.5000 /begin AXIS_DESCR STD_AXIS FORMULA_0023 8 -50.0000 170.0000 FORMAT "%4.1" /end AXIS_DESCR FORMAT "%4.1" /end CHARACTERISTIC
/* ------------------ Abschnitt erzeugt aus tmot.dat ------------------ */
/begin CHARACTERISTIC K_TMOT_ERR_MAX_E2 "max. Fehler fuer Vergleich | EN: max. Fehler fuer Vergleich" VALUE 0x7A9B8 TKW_VV_VV_UB 100.0 FORMULA_0003 0.0 255.0000 /end CHARACTERISTIC
/begin CHARACTERISTIC K_TMOT_MIN_E2 "min. Kuehlmitteltemperatur | EN: min. Kuehlmitteltemperatur" VALUE 0x7A9BA TKW_VV_VV_SW 100.0 FORMULA_0023 -50.0000 170.0000 FORMAT "%4.1" /end CHARACTERISTIC
/begin CHARACTERISTIC K_TMOT_MAX_E2 "max. Kuehlmitteltemperatur | EN: max. Kuehlmitteltemperatur" VALUE 0x7A9BC TKW_VV_VV_SW 100.0 FORMULA_0023 -50.0000 170.0000 FORMAT "%4.1" /end CHARACTERISTIC
/begin CHARACTERISTIC K_TMOT_MAX_NEG_GRAD_E2 "Gradientenschwelle Ebene 2 | EN: Neg. Gradientenschwelle Ebene2" VALUE 0x7A9BE TKW_VV_VV_SW 100.0 FORMULA_0997 -32768.0000 0.0 /end CHARACTERISTIC
/begin CHARACTERISTIC K_TMOT_MAX_POS_GRAD_E2 "Gradientenschwelle Ebene 2 | EN: Pos. Gradientenschwelle Ebene2" VALUE 0x7A9C0 TKW_VV_VV_SW 100.0 FORMULA_0997 0.0 32767.0000 /end CHARACTERISTIC
/begin CHARACTERISTIC K_TMOT_DIAG_MIN "Unter Grenze Motortemperatur | EN: Unter Grenze Motortemperatur" VALUE 0x79740 TKW_VV_VV_SW 100.0 FORMULA_0987 -50.0000 170.0000 FORMAT "%6.3" /end CHARACTERISTIC
/begin CHARACTERISTIC K_TMOT_DIAG_MAX "Obere Grenze Motortemperatur | EN: Obere Grenze Motortemperatur" VALUE 0x79742 TKW_VV_VV_SW 100.0 FORMULA_0987 -50.0000 170.0000 FORMAT "%6.3" /end CHARACTERISTIC
/begin CHARACTERISTIC K_TMOT_DIAG_TAN "TAN-Schwelle zur Plausibilitaetsueberpruefung | EN: TAN-Schwelle zur Plausibilitaetsu e-berpruefung" VALUE 0x79744 TKW_VV_VV_SW 100.0 FORMULA_0023 -50.0000 170.0000 FORMAT "%4.1" /end CHARACTERISTIC
/begin CHARACTERISTIC K_TMOT_DIAG_TKA "TKA-Schwelle zur Plausibilitaetsueberpruefung | EN: TKA-Schwelle zur Plausibilitaetsueberpruefung" VALUE 0x79746 TKW_VV_VV_SW 100.0 FORMULA_0023 -50.0000 170.0000 FORMAT "%4.1" /end CHARACTERISTIC
/begin CHARACTERISTIC K_TMOT_SK_DELTA "Sicherheitskritische Differenz zu tka und toel" VALUE 0x79748 TKW_VV_VV_SW 100.0 FORMULA_1015 -819.2000 819.1750 FORMAT "%5.2" /end CHARACTERISTIC
/begin CHARACTERISTIC K_TMOT_MAX_NEG_GRADIENT "Gradientenschwelle bei laufendem Motor | EN: Neg. Gradientenschwelle bei laufen-dem Motor" VALUE 0x7974A TKW_VV_VV_SW 100.0 FORMULA_1016 -8192.0000 0.0 FORMAT "%5.2" /end CHARACTERISTIC
/begin CHARACTERISTIC K_TMOT_DIAG_GRAD_MAX "Max. Gradient ueber 100ms | EN: Max. Gradient über 100ms" VALUE 0x7974C TKW_VV_VV_SW 100.0 FORMULA_1017 0.0 819.1750 FORMAT "%5.2" /end CHARACTERISTIC
/begin CHARACTERISTIC K_TMOT_DIAG_TIME "Ansprechzeit der Plausibilitaet gegenueber Masse | EN: Ansprechzeit der Plausibilitaet geg e-nueber Masse" VALUE 0x7974E TKW_VV_VV_UW 100.0 FORMULA_0021 0.0 655.3500 FORMAT "%5.2" /end CHARACTERISTIC
/begin CHARACTERISTIC K_TMOT_TAU "Filterkonstante fuer die Kuehlwassererfassung | EN: Filterkonstante fuer die Kuehlwasse r-erfassung" VALUE 0x79750 TKW_VV_VV_UB 100.0 FORMULA_0679 0.1004 25.6000 /end CHARACTERISTIC
/begin CHARACTERISTIC K_TMOT_DIAG_GRAD_TAU "Filterkonstante fuer die Gradientenberechnung | EN: Filterkonstante fü r die  Gradientenberechnung" VALUE 0x79751 TKW_VV_VV_UB 100.0 FORMULA_0679 0.1004 25.6000 /end CHARACTERISTIC
/begin CHARACTERISTIC K_TMOT_MODELL_TAU_KRAFT "Filterkonstante Kraftstoffenergieeintrag | EN: Filterkonstante Kraftstoffenergieei n-trag" VALUE 0x79752 TKW_VV_VV_UB 100.0 FORMULA_0679 0.1004 25.6000 /end CHARACTERISTIC
/begin CHARACTERISTIC K_TMOT_MODELL_TAU_UMG "Filterkonstante Umgebungswaermeabfuhr | EN: Filterkonstante Umgebungswaermeabfuhr" VALUE 0x79753 TKW_VV_VV_UB 100.0 FORMULA_0679 0.1004 25.6000 /end CHARACTERISTIC
/begin CHARACTERISTIC K_TMOT_MODELL_TAU_KUEHLER "Filterkonstante Kuehlerwaermeabfuhr" VALUE 0x79754 TKW_VV_VV_UB 100.0 FORMULA_0679 0.1004 25.6000 /end CHARACTERISTIC
/begin CHARACTERISTIC K_TMOT_MODELL_SA_ML_F "ML-Reduzierung bei SA" VALUE 0x79756 TKW_VV_VV_UW 100.0 FORMULA_0075 0.0 1.0000 FORMAT "%6.3" /end CHARACTERISTIC
/begin CHARACTERISTIC K_TMOT_MODELL_TI_F "Kraftstoffenergieeintragsfaktor | EN: Kraftstoffenergieeintragsfaktor" VALUE 0x79758 TKW_VV_VV_UW 100.0 FORMULA_0075 0.0010 63.9990 FORMAT "%6.3" /end CHARACTERISTIC
/begin CHARACTERISTIC K_TMOT_MODELL_F_MOTOR "Faktor fuer Motorabwaerme | EN: Faktor fuer Motorabwaerme" VALUE 0x7975A TKW_VV_VV_UW 100.0 FORMULA_0075 0.0 1.0000 FORMAT "%6.3" /end CHARACTERISTIC
/begin CHARACTERISTIC K_TMOT_MODELL_C_MOTOR "Waermekapazitaet Motor | EN: Waermekapazitaet Motor" VALUE 0x7975C TKW_VV_VV_UW 100.0 FORMULA_0075 0.0010 4.0000 FORMAT "%6.3" /end CHARACTERISTIC
/begin CHARACTERISTIC K_TMOT_MODELL_F_KW "Faktor Kuehlwasserabwaerme" VALUE 0x7975E TKW_VV_VV_UW 100.0 FORMULA_0075 0.0 4.0000 FORMAT "%6.3" /end CHARACTERISTIC
/begin CHARACTERISTIC K_TMOT_MODELL_GAIN "Integratorkonstante | EN: Integratorkonstante" VALUE 0x79760 TKW_VV_VV_UW 100.0 FORMULA_0075 0.0 1.0000 FORMAT "%6.3" /end CHARACTERISTIC
/begin CHARACTERISTIC K_TMOT_MODELL_LAM_MIN "Min. Lambdabegrenzung | EN: Min. Lambdabegrenzung" VALUE 0x79762 TKW_VV_VV_UW 100.0 FORMULA_0025 0.5000 1.5000 FORMAT "%6.3" /end CHARACTERISTIC
/begin CHARACTERISTIC K_TMOT_MODELL_LAM_MAX "Max. Lambdabegrenzung" VALUE 0x79764 TKW_VV_VV_UW 100.0 FORMULA_0025 0.5000 1.5000 FORMAT "%6.3" /end CHARACTERISTIC
/begin CHARACTERISTIC K_TMOT_MODELL_THERM_MIN "Thermostat oeffnet" VALUE 0x79766 TKW_VV_VV_SW 100.0 FORMULA_0333 -50.0000 170.0000 FORMAT "%5.2" /end CHARACTERISTIC
/begin CHARACTERISTIC K_TMOT_MODELL_THERM_DELTA "Thermostatregelbereich" VALUE 0x79768 TKW_VV_VV_SW 100.0 FORMULA_0980 0.0500 1000.0000 FORMAT "%5.2" /end CHARACTERISTIC
/begin CHARACTERISTIC K_TMOT_MODELL_START_MIN "Kaltstarterkennung" VALUE 0x7976A TKW_VV_VV_SW 100.0 FORMULA_0023 -50.0000 170.0000 FORMAT "%4.1" /end CHARACTERISTIC
/begin CHARACTERISTIC K_TMOT_MODELL_TMOT_MODELL_ML "Umschaltschwelle auf tmot | EN: Umschaltschwelle auf tmot" VALUE 0x7976C TKW_VV_VV_SW 100.0 FORMULA_0023 -50.0000 170.0000 FORMAT "%4.1" /end CHARACTERISTIC
/begin CHARACTERISTIC K_TMOT_OBD_CFG "Einschalten der Diagnose | EN: Einschalten der Diagnose" VALUE 0x7976E TKW_VV_VV_UB 100.0 FORMULA_1018 0.0 255.0 /end CHARACTERISTIC
/begin CHARACTERISTIC K_TMOT_OBD_T_SA_MAX "Maximale Zeit im Schub | EN: Maximale Zeit im Schub" VALUE 0x79770 TKW_VV_VV_UW 100.0 FORMULA_1019 0.0 655.3500 FORMAT "%4.1" /end CHARACTERISTIC
/begin CHARACTERISTIC K_TMOT_OBD_TMOT_MIN "Min. Temperatur fuer OBD-Diagnose" VALUE 0x79772 TKW_VV_VV_SW 100.0 FORMULA_0023 -50.0000 170.0000 FORMAT "%4.1" /end CHARACTERISTIC
/begin CHARACTERISTIC K_TMOT_OBD_T_ML_MIN "Der Motor muss fuer gewisse Zeit laufen" VALUE 0x79774 TKW_VV_VV_UW 100.0 FORMULA_0021 0.0 655.3500 FORMAT "%5.2" /end CHARACTERISTIC
/begin CHARACTERISTIC K_TMOT_OBD_TMOT_MODELL_MAX "Max. Modelltemperatur fuer OBD-Diagnose" VALUE 0x79776 TKW_VV_VV_SW 100.0 FORMULA_0023 -50.0000 170.0000 FORMAT "%4.1" /end CHARACTERISTIC
/begin CHARACTERISTIC K_TMOT_OBD_BLOCKHEATER_DIFF "Erkennung eines Blockheaters | EN: Erkennung eines Blockheaters" VALUE 0x79778 TKW_VV_VV_SW 100.0 FORMULA_0076 -1000.0000 1000.0000 FORMAT "%4.1" /end CHARACTERISTIC
/begin CHARACTERISTIC K_TMOT_OBD_DIFF_MAX "Maximale zulaessige Differenz Messwert-Modell | EN: Maximale zulaessige Differenz Messwert-Modell" VALUE 0x7977A TKW_VV_VV_SW 100.0 FORMULA_0076 -1000.0000 1000.0000 FORMAT "%4.1" /end CHARACTERISTIC
/begin CHARACTERISTIC K_TMOT_OBD_DIFF_HIGH "Maximale zulaessige Differenz Messwert-Modell" VALUE 0x7977C TKW_VV_VV_SW 100.0 FORMULA_0076 -1000.0000 1000.0000 FORMAT "%4.1" /end CHARACTERISTIC
/begin CHARACTERISTIC K_TMOT_OBD_TKA_THERM_1_DELTA "Kuehlererwaermung seit Start bei Sensorfehler" VALUE 0x7977E TKW_VV_VV_SW 100.0 FORMULA_0076 -1000.0000 1000.0000 FORMAT "%4.1" /end CHARACTERISTIC
/begin CHARACTERISTIC K_TMOT_OBD_THERM_2_START "Max. Starttemperatur fuer Thermostatdiagnose" VALUE 0x79780 TKW_VV_VV_SW 100.0 FORMULA_0023 -50.0000 170.0000 FORMAT "%4.1" /end CHARACTERISTIC
/begin CHARACTERISTIC K_TMOT_OBD_TKA_THERM_2_DELTA "Kuehlererwaermung seit Start bei Thermostatoeffnung" VALUE 0x79782 TKW_VV_VV_SW 100.0 FORMULA_0076 -1000.0000 1000.0000 FORMAT "%4.1" /end CHARACTERISTIC
/begin CHARACTERISTIC K_TMOT_OBD_THERM_2 "Zu erreichende Motortemperatur bei Thermostatoeffnung" VALUE 0x79784 TKW_VV_VV_SW 100.0 FORMULA_0023 -50.0000 170.0000 FORMAT "%4.1" /end CHARACTERISTIC
/begin CHARACTERISTIC K_TMOT_MODELL_ERSATZ "Obergrenze Ersatzwert | EN: Obergrenze Ersatzwert" VALUE 0x79786 TKW_VV_VV_SW 100.0 FORMULA_0023 -50.0000 170.0000 FORMAT "%4.1" /end CHARACTERISTIC
/begin CHARACTERISTIC K_TMOT_MODELL_TKA_ERSATZ_DELTA "Obergrenzendelta zum Kuehleraustritt bei heissem tka | EN: Obergrenzendelta zum Kuehleraustritt bei heissem tka" VALUE 0x79788 TKW_VV_VV_SW 100.0 FORMULA_0076 -1000.0000 1000.0000 FORMAT "%4.1" /end CHARACTERISTIC
/begin CHARACTERISTIC K_TMOT_CFG_TOEL "CC-Toel Konfig | EN: Check-control oil-temperature configuration" VALUE 0x7978A TKW_VV_VV_UB 100.0 FORMULA_1020 0.0 255.0 /end CHARACTERISTIC
/begin CHARACTERISTIC K_TMOT_ELU_ERR_CC_HIGH_TMOT_1 "CC-Meldung gelb ueber Tmot und Elu-Fehler | EN: Yellow check-control message over coolant temp and electric-fan fault" VALUE 0x7978C TKW_VV_VV_SW 100.0 FORMULA_0023 -50.0000 170.0000 FORMAT "%4.1" /end CHARACTERISTIC
/begin CHARACTERISTIC K_TMOT_CC_HIGH_TMOT_2 "CC-Meldung rot ueber Tmot | EN: Red check-control message over coolant temperature" VALUE 0x7978E TKW_VV_VV_SW 100.0 FORMULA_0023 -50.0000 170.0000 FORMAT "%4.1" /end CHARACTERISTIC
/begin CHARACTERISTIC K_TMOT_CC_HIGH_TOEL_1 "CC-Meldung gelb ueber Toel | EN: Yellow check-control message over oil temperature" VALUE 0x79790 TKW_VV_VV_SW 100.0 FORMULA_0023 -50.0000 180.0000 FORMAT "%4.1" /end CHARACTERISTIC
/begin CHARACTERISTIC K_TMOT_CC_HIGH_TOEL_2 "CC-Meldung rot ueber Toel | EN: Red check-control message over oil temperature" VALUE 0x79792 TKW_VV_VV_SW 100.0 FORMULA_0023 -50.0000 180.0000 FORMAT "%4.1" /end CHARACTERISTIC
/begin CHARACTERISTIC K_TMOT_CC_HIGH_HYS "Hysterese fuer CC-Meldungen | EN: Hysteresis for check-control messages" VALUE 0x79794 TKW_VV_VV_UB 100.0 FORMULA_1021 0.0 25.5000 /end CHARACTERISTIC
/begin CHARACTERISTIC K_TMOT_CC_HIGH_ZWS_OFF "Offset fuer Zwangsschaltung | EN: Offset for forced (gear) shift" VALUE 0x79795 TKW_VV_VV_UB 100.0 FORMULA_1021 0.0 25.5000 /end CHARACTERISTIC
/begin CHARACTERISTIC K_TMOT_OBD_HIGH "Maximale Motortemperatur nach Standzeit" VALUE 0x79796 TKW_VV_VV_SW 100.0 FORMULA_0987 -50.0000 170.0000 FORMAT "%6.3" /end CHARACTERISTIC
/begin CHARACTERISTIC K_TMOT_OBD_HIGH_TIME "Standzeit fuer high-Diagnose | EN: Standzeit fuer high-Diagnose" VALUE 0x79798 TKW_VV_VV_UW 100.0 FORMULA_0986 0.0 1092.2500 FORMAT "%5.2" /end CHARACTERISTIC
/begin CHARACTERISTIC KL_TMOT_NTC "Kennlinie Motortemperatur | EN: Engine temperature curve" CURVE 0x7979A TKL_SW_VV_SW 100.0 FORMULA_0987 -50.0000 170.0000 /begin AXIS_DESCR STD_AXIS FORMULA_0123 10 0.0 1023.0000 /end AXIS_DESCR FORMAT "%6.3" /end CHARACTERISTIC
/begin CHARACTERISTIC KL_TMOT_OBD_MODELL_DELTA "Schwankung der Modelltemperatur | EN: Fluctuation of model temperature" CURVE 0x797C4 TKL_SW_VV_SW 100.0 FORMULA_0076 -1000.0000 1000.0000 /begin AXIS_DESCR STD_AXIS FORMULA_0023 8 -50.0000 170.0000 FORMAT "%4.1" /end AXIS_DESCR FORMAT "%4.1" /end CHARACTERISTIC
/begin CHARACTERISTIC KL_TMOT_OBD_DELTA "Schwankung der Motortemperatur | EN: Fluctuation of engine temperature" CURVE 0x797E6 TKL_SW_VV_SW 100.0 FORMULA_0076 -1000.0000 1000.0000 /begin AXIS_DESCR STD_AXIS FORMULA_0023 8 -50.0000 170.0000 FORMAT "%4.1" /end AXIS_DESCR FORMAT "%4.1" /end CHARACTERISTIC
/begin CHARACTERISTIC KL_TMOT_CC_HIGH_TMOT_1 "Schwelle fuer gelbe CC-Msg | EN: Threshold for yellow check-control message" CURVE 0x79808 TKL_UW_VV_SW 100.0 FORMULA_0023 -50.0000 170.0000 /begin AXIS_DESCR STD_AXIS FORMULA_0021 4 0.0 655.0000 FORMAT "%5.2" /end AXIS_DESCR FORMAT "%4.1" /end CHARACTERISTIC
/begin CHARACTERISTIC KL_TMOT_OBD_DIFF_T_DELTA "Max. Zeit in der maximale Messwert-Modell-Differenz ueberschritten" CURVE 0x7981A TKL_SW_VV_UW 100.0 FORMULA_0073 0.0 6553.5000 /begin AXIS_DESCR STD_AXIS FORMULA_0023 4 -50.0000 170.0000 FORMAT "%4.1" /end AXIS_DESCR FORMAT "%4.1" /end CHARACTERISTIC
/begin CHARACTERISTIC KF_TMOT_OBD_ML_GES_MW "Mittelwertschwelle der Luftmasse | EN: Mean-value threshold of air mass" MAP 0x7982C TKF_SW_SW_SW 100.0 FORMULA_0112 -100.0000 1400.0000
 /begin AXIS_DESCR STD_AXIS tmot_start FORMULA_0023 8 -50.0000 170.0000 FORMAT "%4.1" /end AXIS_DESCR
 /begin AXIS_DESCR STD_AXIS FORMULA_0023 8 -50.0000 170.0000 FORMAT "%4.1" /end AXIS_DESCR
 FORMAT "%4.1" /end CHARACTERISTIC
/begin CHARACTERISTIC KF_TMOT_MODELL_ML_WICHT "Luftmassenwichtung | EN: Air-mass weighting" MAP 0x798CE TKF_SW_SW_SW 100.0 FORMULA_0112 -100.0000 1400.0000
 /begin AXIS_DESCR STD_AXIS tmot_or_tka FORMULA_0023 7 -50.0000 170.0000 FORMAT "%4.1" /end AXIS_DESCR
 /begin AXIS_DESCR STD_AXIS FORMULA_0112 7 -100.0000 1400.0000 FORMAT "%4.1" /end AXIS_DESCR
 FORMAT "%4.1" /end CHARACTERISTIC
/* ------------------ Abschnitt erzeugt aus toel.dat ------------------ */
/begin CHARACTERISTIC K_TOEL_N_T1 "PT1-Filterzeitkonstante fur toel_n_filt | EN: PT1 filter time constant for toel_n_filt" VALUE 0x7994E TKW_VV_VV_UB 100.0 FORMULA_0003 1.0000 255.0000 /end CHARACTERISTIC
/begin CHARACTERISTIC K_TOEL_AEBEGR "Aenderungsbegrenzung fuer toel | EN: Rate limit for oil temperature" VALUE 0x79950 TKW_VV_VV_SW 100.0 FORMULA_0076 -1000.0000 1000.0000 FORMAT "%4.1" /end CHARACTERISTIC
/begin CHARACTERISTIC K_TOEL_BEGR_OFFS "Temperaturfenster Begrenzung | EN: Temperature window limitation" VALUE 0x79952 TKW_VV_VV_SW 100.0 FORMULA_0076 -1000.0000 1000.0000 FORMAT "%4.1" /end CHARACTERISTIC
/begin CHARACTERISTIC K_TOEL_KOMBI_WSTATE "Wartezeit f. gueltige Zeit von Kombi | EN: Wait time for valid time from instrument cluster [s]" VALUE 0x79954 TKW_VV_VV_UW 100.0 FORMULA_0021 0.0 655.0000 FORMAT "%5.2" /end CHARACTERISTIC
/begin CHARACTERISTIC K_TOEL_T_MS "Motor steht-Schwelle | EN: Engine-stopped threshold [min]" VALUE 0x79956 TKW_VV_VV_UW 100.0 FORMULA_1024 1.0000 65535.0000 FORMAT "%5.2" /end CHARACTERISTIC
/begin CHARACTERISTIC K_TOEL_WANNE_GRD_F "toel-Gradient f(Wannentemp.) | EN: Oil-temperature gradient vs sump temperature" VALUE 0x79958 TKW_VV_VV_SW 100.0 FORMULA_0497 0.0 1.0000 FORMAT "%5.2" /end CHARACTERISTIC
/begin CHARACTERISTIC K_TOEL_TMOT_GRD_F "toel-Gradient f(Kuehlwassertemp.) | EN: Oil-temperature gradient vs coolant temperature" VALUE 0x7995A TKW_VV_VV_SW 100.0 FORMULA_0497 0.0 1.0000 FORMAT "%5.2" /end CHARACTERISTIC
/begin CHARACTERISTIC KL_TOEL_WICHT "Oelwannentemp.-Einfluss | EN: Oil-sump temperature influence" CURVE 0x7995C TKL_SW_VV_SW 100.0 FORMULA_1025 0.0 1.0000 /begin AXIS_DESCR STD_AXIS FORMULA_0023 2 -50.0000 170.0000 FORMAT "%4.1" /end AXIS_DESCR FORMAT "%5.2" /end CHARACTERISTIC
/begin CHARACTERISTIC KL_TOEL_N "n-Einfluss Motorreibung | EN: Engine-speed influence, engine friction" CURVE 0x79966 TKL_SW_VV_SW 100.0 FORMULA_1023 0.0 0.0600 /begin AXIS_DESCR STD_AXIS Motordrehzahl FORMULA_0006 6 0.0 10000.0000 /end AXIS_DESCR FORMAT "%7.4" /end CHARACTERISTIC
/begin CHARACTERISTIC KL_TOEL_DN "gefilterter n-Einfluss Motorreibung | EN: Filtered engine-speed influence, engine friction" CURVE 0x79980 TKL_SW_VV_SW 100.0 FORMULA_1023 -0.0400 0.0400 /begin AXIS_DESCR STD_AXIS FORMULA_0006 6 -10000.0000 10000.0000 /end AXIS_DESCR FORMAT "%7.4" /end CHARACTERISTIC
/begin CHARACTERISTIC KF_TOEL_V_TAN_MW "Oelkuehlungsoffset | EN: Oil cooling offset" MAP 0x7999A TKF_SW_SW_SW 100.0 FORMULA_0076 -50.0000 50.0000 /begin AXIS_DESCR STD_AXIS FORMULA_0078 7 -80.0000 360.0000 FORMAT "%4.1" /end AXIS_DESCR /begin AXIS_DESCR STD_AXIS FORMULA_0023 7 -50.0000 170.0000 FORMAT "%4.1" /end AXIS_DESCR FORMAT "%4.1" /end CHARACTERISTIC
/begin CHARACTERISTIC K_TOEL_ERR_MAX_E2 "max. Fehler fuer Vergleich | EN: Max.Fehler für Vergleich" VALUE 0x7A9C2 TKW_VV_VV_UB 100.0 FORMULA_0003 0.0 255.0000 /end CHARACTERISTIC
/begin CHARACTERISTIC K_TOEL_MIN_E2 "min. Oeltemperatur | EN: Minimum oil temperature [°C]" VALUE 0x7A9C4 TKW_VV_VV_SW 100.0 FORMULA_0023 -50.0000 170.0000 FORMAT "%4.1" /end CHARACTERISTIC
/begin CHARACTERISTIC K_TOEL_MAX_E2 "max. Oeltemperatur | EN: Maximum oil temperature [°C]" VALUE 0x7A9C6 TKW_VV_VV_SW 100.0 FORMULA_0023 -50.0000 210.0000 FORMAT "%4.1" /end CHARACTERISTIC
/begin CHARACTERISTIC K_TOEL_DELTA_E2 "Abweichung zur Motortemperatur | EN: Deviation from engine temperature [°C]" VALUE 0x7A9C8 TKW_VV_VV_SW 100.0 FORMULA_0023 -50.0000 170.0000 FORMAT "%4.1" /end CHARACTERISTIC
/begin CHARACTERISTIC K_TOEL_MAX_NEG_GRAD_E2 "Gradientenschwelle Ebene 2 | EN: Gradient threshold, level 2" VALUE 0x7A9CA TKW_VV_VV_SW 100.0 FORMULA_0997 -32768.0000 0.0 /end CHARACTERISTIC
/begin CHARACTERISTIC K_TOEL_MAX_POS_GRAD_E2 "Gradientenschwelle Ebene 2 | EN: Gradient threshold, level 2" VALUE 0x7A9CC TKW_VV_VV_SW 100.0 FORMULA_0997 0.0 32767.0000 /end CHARACTERISTIC
/begin FUNCTION Kuehleraustrittstemperatur ""
 /begin DEF_CHARACTERISTIC KL_TKA_NTC KL_TKA_OBD_TMOT_T K_TKA_DIAG_MAX K_TKA_DIAG_MIN K_TKA_OBD_DELTA_HIGH K_TKA_OBD_DELTA_NORM K_TKA_OBD_TMOT_MIN K_TKA_TAU /end DEF_CHARACTERISTIC
 /begin REF_CHARACTERISTIC /end REF_CHARACTERISTIC
 /begin IN_MEASUREMENT /end IN_MEASUREMENT
 /begin OUT_MEASUREMENT /end OUT_MEASUREMENT
/end FUNCTION
/begin FUNCTION Kupplungsschlupfregelung ""
 /begin DEF_CHARACTERISTIC KF_KUS_N_MIN KF_MD_KUS_KR KF_MD_KUS_TN KF_MD_KUS_TV KL_KUS_GANG_FAK KL_KUS_N_MIN_AFZ KL_KUS_SCHLUPF_MAX KL_MD_KUS_KR_FAK KL_MD_KUS_KUPP_MIN KL_MD_KUS_TN_FAK KL_MD_KUS_TV_FAK K_KUS_CFG K_KUS_GANG_MAX K_KUS_N_DELTA_AUS K_KUS_N_DELTA_EIN K_KUS_N_GETR_EIN_HYS K_KUS_N_GETR_EIN_MIN K_KUS_N_HYS K_KUS_N_MIN K_KUS_STUFE K_KUS_V_VORNE_HYS K_KUS_V_VORNE_MAX K_MD_KUS_BEGR_TAU1_AUS K_MD_KUS_BEGR_TAU1_EIN K_MD_KUS_BEGR_TAU_AUS K_MD_KUS_BEGR_TAU_EIN K_MD_KUS_PID_A1 /end DEF_CHARACTERISTIC
 /begin REF_CHARACTERISTIC /end REF_CHARACTERISTIC
 /begin IN_MEASUREMENT /end IN_MEASUREMENT
 /begin OUT_MEASUREMENT /end OUT_MEASUREMENT
/end FUNCTION
/begin FUNCTION Laufunruhe ""
 /begin DEF_CHARACTERISTIC KF_LU_FAKTOR_B2 KF_LU_OFFSET_ZYL1 KF_LU_OFFSET_ZYL10 KF_LU_OFFSET_ZYL2 KF_LU_OFFSET_ZYL3 KF_LU_OFFSET_ZYL4 KF_LU_OFFSET_ZYL5 KF_LU_OFFSET_ZYL6 KF_LU_OFFSET_ZYL7 KF_LU_OFFSET_ZYL8 KF_LU_OFFSET_ZYL9 KF_LU_SCHWELLE KL_LU_ADAP_FILT KL_LU_MD_DELTA_NEG KL_LU_MD_DELTA_POS KL_LU_RF_MIN KL_LU_SCHW_KATH KL_LU_SCHW_TMOT KL_LU_START_DLY KL_LU_START_TRIG_OFF K_LU_ACT_N_MAX K_LU_ACT_N_MIN K_LU_ADAP_DELAY K_LU_ADAP_ENDE K_LU_ADAP_GANG_MIN K_LU_ADAP_LIMIT K_LU_ADAP_N_MAX K_LU_ADAP_N_MIN K_LU_ADAP_OFFS_B2 K_LU_AUSKUPPL_DELAY K_LU_CFG K_LU_DSC_DELAY K_LU_KKOS_DELAY K_LU_KUPPL_DELAY K_LU_MD_DELAY K_LU_N_MIN K_LU_SA_DELAY K_LU_SCHW_EV_ERR K_LU_START_DELAY K_LU_TZ_DELAY K_LU_TZ_DELTA K_LU_WIN_LEN_B1 K_LU_WIN_LEN_B2 K_LU_WIN_PERIOD_B1 K_LU_WIN_PERIOD_B2 K_LU_WIN_START_B1 K_LU_WIN_START_B2 /end DEF_CHARACTERISTIC
 /begin REF_CHARACTERISTIC /end REF_CHARACTERISTIC
 /begin IN_MEASUREMENT /end IN_MEASUREMENT
 /begin OUT_MEASUREMENT /end OUT_MEASUREMENT
/end FUNCTION
/begin FUNCTION Leerlaufregler ""
 /begin DEF_CHARACTERISTIC KF_LLR_MD_I_NEG_MKS KF_LLR_MD_I_NEG_OKS KF_LLR_MD_I_POS_MKS KF_LLR_MD_I_POS_OKS KF_LLR_N_SOLL_KH_OFF KL_LLR_D_FAK_TOEL KL_LLR_MD_RES_TMOT KL_LLR_MD_TZ_MKS KL_LLR_MD_TZ_MKS_KH KL_LLR_MD_TZ_OKS KL_LLR_MD_TZ_OKS_KH KL_LLR_N_SOLL_TMOT KL_LLR_N_SOLL_TMOT_E2 KL_LLR_N_SOLL_TOEL_OFF K_LLR_CFG_MIN K_LLR_CFG_N_NACHF K_LLR_DIAG_CSS_N_ZU_GROSS K_LLR_DIAG_CSS_N_ZU_KLEIN K_LLR_DIAG_CSS_T K_LLR_DIAG_CSS_TMOT K_LLR_DIAG_CSS_TOEL K_LLR_DIAG_CSS_T_IO K_LLR_DIAG_FRA_MAX K_LLR_DIAG_FRA_MIN K_LLR_DIAG_MD_ERR_ABR K_LLR_DIAG_MD_FAK K_LLR_DIAG_N_ZU_GROSS K_LLR_DIAG_N_ZU_KLEIN K_LLR_DIAG_T K_LLR_DIAG_TMOT K_LLR_DIAG_TOEL K_LLR_DIAG_T_IO K_LLR_DMD_MAX_E2 K_LLR_D_GRAD K_LLR_D_OFFSET K_LLR_ERR_MAX_E2 K_LLR_IA_B1_ABR K_LLR_IA_B2_ABR K_LLR_MD_D_MAX K_LLR_MD_D_MIN K_LLR_MD_MAX_E2 K_LLR_MD_MIN_E2 K_LLR_MD_MKS_MAX K_LLR_MD_MKS_MIN K_LLR_MD_OKS_MAX K_LLR_MD_OKS_MIN K_LLR_MD_RES_AUFR K_LLR_MD_RES_WAIT K_LLR_MD_TZ_RUECK_HYS K_LLR_MD_TZ_RUECK_NEG K_LLR_MD_TZ_RUECK_POS K_LLR_MD_TZ_TAU K_LLR_N_DIFF_MAX_E2 K_LLR_N_EINGEREGELT K_LLR_N_KATH_ABR K_LLR_N_KATH_AUFR K_LLR_N_KATH_HYS K_LLR_N_OFFSET_B1 K_LLR_N_OFFSET_B2 K_LLR_N_RESET K_LLR_N_SOLL_AC_OFFSET K_LLR_N_SOLL_MAX K_LLR_N_SOLL_MIN K_LLR_N_SOLL_NF_FAKTOR K_LLR_N_SOLL_NF_FAKTOR_E2 K_LLR_N_SOLL_NF_MAX K_LLR_N_SOLL_NF_MAX_E2 K_LLR_N_SOLL_TAU K_LLR_N_SOLL_ZH_OFFSET K_LLR_OMEGA_TAU K_LLR_PWG_ANFAHR K_LLR_TIME_FILOFF /end DEF_CHARACTERISTIC
 /begin REF_CHARACTERISTIC /end REF_CHARACTERISTIC
 /begin IN_MEASUREMENT /end IN_MEASUREMENT
 /begin OUT_MEASUREMENT /end OUT_MEASUREMENT
/end FUNCTION
/begin FUNCTION Leerlaufregleradaption ""
 /begin DEF_CHARACTERISTIC K_LLR_AD_AC_MAX K_LLR_AD_AC_MIN K_LLR_AD_CFG K_LLR_AD_I_ANTEIL_OFF K_LLR_AD_I_TAU K_LLR_AD_MD_GRAD K_LLR_AD_MD_NEUZUSTAND K_LLR_AD_MD_ZYKLUS_MAX K_LLR_AD_NORM_MAX K_LLR_AD_NORM_MIN K_LLR_AD_N_HYS_NEG K_LLR_AD_N_HYS_POS K_LLR_AD_TIME_STABIL K_LLR_AD_TMOT K_LLR_AD_TOEL K_LLR_AD_UMSCHALT_RAMPE /end DEF_CHARACTERISTIC
 /begin REF_CHARACTERISTIC /end REF_CHARACTERISTIC
 /begin IN_MEASUREMENT /end IN_MEASUREMENT
 /begin OUT_MEASUREMENT /end OUT_MEASUREMENT
/end FUNCTION
/begin FUNCTION Momentenmanager ""
 /begin DEF_CHARACTERISTIC KF_MD_DELTA_DP_ON KF_MD_DYN_FIL_RES KF_MD_DYN_FIL_RES_FAK KF_MD_ETA_LA KF_MD_FAHRER_KOMFORT KF_MD_FAHRER_NORMAL KF_MD_FAHRER_PST KF_MD_FAHRER_SPORT KF_MD_FAK_GRAD_DP_B1 KF_MD_FAK_GRAD_DP_B2 KF_MD_FAK_GRAD_DP_B3 KF_MD_GRAD_DP_B1 KF_MD_GRAD_DP_B2 KF_MD_GRAD_DP_B3 KF_MD_GRAD_DP_LLMKS KF_MD_GRAD_LSD_B1 KF_MD_GRAD_LSD_B2 KF_MD_GRAD_LSD_B3 KF_MD_GRAD_LSD_LLMKS KF_MD_IND_LW_VERLUSTE KF_MD_IND_MIN_SCHUB KF_MD_IND_OPT KF_MD_IND_REIB KF_MD_KKOS_KORR KF_MD_KOMFORT_DP KF_MD_KOMFORT_LSD KF_MD_KUPP_GRENZ_DP_O KF_MD_KUPP_GRENZ_DP_U_OFFS KF_MD_KUPP_GRENZ_LSD_O KF_MD_KUPP_GRENZ_LSD_U_OFFS KF_MD_LRW KF_MD_NBEGR_KR KF_MD_NBEGR_TN KF_MD_NBEGR_TV KF_MD_POLYNOM_A KF_MD_POLYNOM_A_KH KF_MD_POLYNOM_B KF_MD_SK_DIFF_MAX KF_MD_SMG_BEGR_OFF KF_MD_SPORT_DP KF_MD_SPORT_LSD KF_MD_START_OFFSET KF_MD_TAU_LSD_B3 KF_MD_VBEGR_KR KF_MD_VBEGR_TN KF_MD_VBEGR_TV KF_MD_VERBR_FZG KF_MD_ZW_OFFSET KF_MD_ZW_OPT KF_MD_ZW_RG KL_MD_BEGR_NOISE KL_MD_ETA_LA KL_MD_FAHRER_FAK_KOMFORT KL_MD_FAHRER_FAK_NORMAL KL_MD_FAHRER_FAK_SPORT KL_MD_FAK_DP_B1 KL_MD_FAK_DP_B2 KL_MD_FAK_DP_B3 KL_MD_FAK_LSD_ANFF KL_MD_FAK_LSD_B1 KL_MD_FAK_LSD_B2 KL_MD_FAK_LSD_B3 KL_MD_HYP_DN KL_MD_HYP_VERH_KRAFTS KL_MD_IND_REIB_ABREG KL_MD_IND_REIB_OFFSET KL_MD_IND_RF_MIN_OFFS KL_MD_KKOS_DELAY_OFF KL_MD_KKOS_DELAY_ON KL_MD_KKOS_RES_MAX KL_MD_KKOS_ZH_RES_MAX KL_MD_KR_DTZ_DOWN KL_MD_KR_DTZ_UP KL_MD_KUPP_MAX_CAN KL_MD_KUPP_MAX_GANG KL_MD_KUPP_MIN_ASC KL_MD_LRW_FAK KL_MD_LRW_RES KL_MD_MAX_FAK_POWER KL_MD_MAX_N_OFFS KL_MD_MAX_TMOT KL_MD_NBEGR_ABSTAND KL_MD_NBEGR_GANG KL_MD_NBEGR_KR_FAK KL_MD_NBEGR_KR_FAK_SK KL_MD_NBEGR_N_MAX KL_MD_NBEGR_N_OFFSET KL_MD_NBEGR_RAMPE KL_MD_NBEGR_TN_FAK KL_MD_NBEGR_TN_FAK_SK KL_MD_NBEGR_TV_FAK KL_MD_RES_MIN KL_MD_RF_MAX_ROH KL_MD_RG_TAU KL_MD_SCHW_TAU KL_MD_SK_GRAD_MAX KL_MD_SK_MD_BEGR KL_MD_SK_WDK KL_MD_SK_WDK_TI_OFFS KL_MD_TAU_START_OFF KL_MD_TZ_AEBG_AB KL_MD_TZ_AEBG_AUF KL_MD_VBEGR_ABSTAND KL_MD_VBEGR_KR_FAK KL_MD_VBEGR_KR_FAK_SK KL_MD_VBEGR_RAMPE KL_MD_VBEGR_TAU KL_MD_VBEGR_TN_FAK KL_MD_VBEGR_TN_FAK_SK KL_MD_VBEGR_TV_FAK KL_MD_ZW_LA KL_MD_ZW_TMOT_FAK K_MD_ANFF_PWG_OFF K_MD_ANFF_PWG_ON K_MD_ANFF_V_SCHW K_MD_ASC_AUSBLEND_HYS K_MD_ASC_ENABLE K_MD_ASC_M_AEBEGR K_MD_ASC_M_RAMPE K_MD_ASC_T_WAIT K_MD_BEZUG_HYS K_MD_BEZUG_RAMPE K_MD_BLS_BRP K_MD_BLS_BRP_VMA K_MD_BLS_DN_VMA K_MD_BLS_FW_REL K_MD_BLS_GANG_VMA K_MD_BLS_N K_MD_BLS_N_VMA K_MD_CAN_BEGR_ST K_MD_CAN_ETA_ZW_OFF K_MD_CFG_DYN_FIL K_MD_CFG_ETA_KOMP K_MD_CFG_FW_BLS K_MD_CFG_MCS K_MD_CFG_RG_KORR K_MD_CFG_TZ_EINGR K_MD_CFG_ZW_BEZUG K_MD_DYN_FIL_RES_TAU K_MD_ETA_EINGRIFF K_MD_ETA_KH_TAU K_MD_ETA_KH_TAU_LL K_MD_ETA_KR_KOMP K_MD_ETA_LA_KOMP_MAX K_MD_ETA_LA_TAU K_MD_ETA_SK_MIN K_MD_ETA_STAT_TAU K_MD_ETA_STAT_TAU_LL K_MD_ETA_ZW_MIN K_MD_GEN_FREISCHALT K_MD_GEN_MAX K_MD_GRAD_DP_OKS K_MD_GRAD_LSD_OKS K_MD_GRAD_SA K_MD_GRAD_SA_CUF K_MD_GRAD_SA_VMA K_MD_HYP_VERH_NO_KRAFTS K_MD_HYP_VERH_START K_MD_HYS_RICHTUNG K_MD_HYS_SA K_MD_HYS_SA_TZ K_MD_IND_WUNSCH_TZ_MCS K_MD_KKOS_CAN_MAX K_MD_KKOS_DYN_ST K_MD_KKOS_ELU_TMOT_MAX K_MD_KKOS_ELU_TMOT_MAX_HYS K_MD_KKOS_MAX K_MD_KKOS_MIN K_MD_KKOS_N K_MD_KKOS_N_MAX K_MD_KKOS_N_MAX_HYS K_MD_KKOS_RES_RAMPE_OFF K_MD_KKOS_RES_RAMPE_ON K_MD_KKOS_RES_T_MAX K_MD_KKOS_START K_MD_KKOS_TAU_OFF K_MD_KKOS_TAU_ON K_MD_KKOS_TIME_BA_VL K_MD_KKOS_TIME_START K_MD_KKOS_TIME_WH K_MD_KKOS_TMOT_MAX K_MD_KKOS_TMOT_MAX_HYS K_MD_KKOS_V_BA K_MD_KKOS_V_VL K_MD_KKOS_V_VL_AUS K_MD_KKOS_ZH_RES_RAMPE K_MD_KKOS_ZH_RES_T_MAX K_MD_KKOS_ZH_TMOT K_MD_KKOS_ZH_TUMG K_MD_KUPP_BEGR_MCS K_MD_KUPP_GANG_RAMPE K_MD_LRW_RES_DELTA K_MD_LRW_RES_V K_MD_LRW_RES_V_HYS K_MD_LRW_TAU K_MD_MAX_FAK K_MD_MAX_POWER_NEG K_MD_MAX_POWER_POS K_MD_MSR_ENABLE K_MD_MSR_MAX K_MD_MSR_M_RAMPE K_MD_MSR_T_WAIT K_MD_NBEGR_A1 K_MD_NBEGR_AKTIV K_MD_NBEGR_HYS_AUS K_MD_NBEGR_MD_HYS K_MD_NBEGR_N_DELTA K_MD_NOISE_CFG K_MD_NOISE_PWG_SOLL K_MD_NOISE_RAMPE K_MD_NOISE_T K_MD_NOISE_V_MAX1 K_MD_NOISE_V_MAX2 K_MD_NOISE_V_MAX3 K_MD_NOISE_V_MIN1 K_MD_NOISE_V_MIN2 K_MD_NOISE_V_MIN3 K_MD_PULS_AMP K_MD_PULS_EIN K_MD_PULS_OFFS K_MD_PULS_RAMPE K_MD_PULS_T K_MD_RESERVE_TST K_MD_RES_KATH_FAK K_MD_RES_KATH_TAU K_MD_RES_MIN K_MD_RES_MIN_HYS K_MD_RF_SOLL_MCS K_MD_RF_SOLL_SEK_CFG K_MD_RG_RF_FAKTOR K_MD_SK_BEGR_RAMPE K_MD_SK_CFG K_MD_SK_ETA_MIN K_MD_SK_FWMAX K_MD_SK_IND_MAX K_MD_SK_LLR_MAX K_MD_SK_MAX_MDMIN K_MD_SK_NHYS K_MD_SK_N_MDMIN K_MD_SK_N_MIN K_MD_SK_PWGMIN K_MD_SK_RF_MAX K_MD_SK_TAU_PWG K_MD_SK_TAU_VERGL K_MD_SK_TIMER_0 K_MD_SK_TIMER_1 K_MD_SK_TIRED_HYS K_MD_SK_TIRED_MIN K_MD_SK_TIRED_ZYL_10of11_ K_MD_SK_TIRED_ZYL_11of11_ K_MD_SK_TIRED_ZYL_1of11_ K_MD_SK_TIRED_ZYL_2of11_ K_MD_SK_TIRED_ZYL_3of11_ K_MD_SK_TIRED_ZYL_4of11_ K_MD_SK_TIRED_ZYL_5of11_ K_MD_SK_TIRED_ZYL_6of11_ K_MD_SK_TIRED_ZYL_7of11_ K_MD_SK_TIRED_ZYL_8of11_ K_MD_SK_TIRED_ZYL_9of11_ K_MD_SK_WDK_KH_OFFS K_MD_SK_WDK_LLSFAIL_OFFS K_MD_TAU_FW_DPFIL K_MD_TAU_FW_GRAD K_MD_TAU_IND_TZ_GRAD K_MD_TZ_SOLL_MCS K_MD_VBEGR_A1 K_MD_VBEGR_HYS_AUS K_MD_VBEGR_MD_HYS K_MD_VERBR_MAX /end DEF_CHARACTERISTIC
 /begin REF_CHARACTERISTIC /end REF_CHARACTERISTIC
 /begin IN_MEASUREMENT /end IN_MEASUREMENT
 /begin OUT_MEASUREMENT /end OUT_MEASUREMENT
/end FUNCTION
/begin FUNCTION Momentenmanager-Ebene_2 ""
 /begin DEF_CHARACTERISTIC KF_MD_FAHRER_KOMFORT_E2 KF_MD_FAHRER_NORMAL_E2 KF_MD_FAHRER_SPORT_E2 KF_MD_IND_LW_VERLUSTE_E2 KF_MD_IND_MIN_SCHUB_E2 KF_MD_IND_OPT_E2 KF_MD_IND_REIB_E2 KF_MD_KUPP_OFF_E2 KF_MD_SMG_BEGR_OFF_E2 KF_MD_ZW_OPT_E2 KL_MD_FAHRER_FAK_E2 KL_MD_IND_REIB_OFFSET_E2 KL_MD_RF_MAX_E2 K_MD_E2_ERR_MAX K_MD_E2_FW_REL_SCHW K_MD_E2_IST_SCHW K_MD_E2_MAX_SCHW K_MD_E2_MIN_SCHW K_MD_E2_N_MIN K_MD_E2_SCHLEPP_SCHW K_MD_E2_TAU_SOLL K_MD_ETA_LA_E2 K_MD_ETA_ZW_MIN_E2 K_MD_HYP_DN_E2 K_MD_HYP_VERH_E2 K_MD_IND_REIB_ABREG_E2 K_MD_LLR_AD_MAX_E2 K_MD_MSR_MAX_E2 K_MD_POLYNOM_A_E2 K_MD_POLYNOM_B_E2 K_MD_START_OFF_E2 K_MD_TAU_START_OFF_E2 K_MD_VERBR_MAX_E2 K_MD_ZYL_ANZ_E2 K_MD_ZYL_MASK_B1 K_MD_ZYL_MASK_B2 /end DEF_CHARACTERISTIC
 /begin REF_CHARACTERISTIC /end REF_CHARACTERISTIC
 /begin IN_MEASUREMENT /end IN_MEASUREMENT
 /begin OUT_MEASUREMENT /end OUT_MEASUREMENT
/end FUNCTION
/begin FUNCTION Motoroeltemperatur ""
 /begin DEF_CHARACTERISTIC KF_TOEL_V_TAN_MW KL_TOEL_DN KL_TOEL_N KL_TOEL_WICHT K_TOEL_AEBEGR K_TOEL_BEGR_OFFS K_TOEL_DELTA_E2 K_TOEL_ERR_MAX_E2 K_TOEL_KOMBI_WSTATE K_TOEL_MAX_E2 K_TOEL_MAX_NEG_GRAD_E2 K_TOEL_MAX_POS_GRAD_E2 K_TOEL_MIN_E2 K_TOEL_N_T1 K_TOEL_TMOT_GRD_F K_TOEL_T_MS K_TOEL_WANNE_GRD_F /end DEF_CHARACTERISTIC
 /begin REF_CHARACTERISTIC /end REF_CHARACTERISTIC
 /begin IN_MEASUREMENT /end IN_MEASUREMENT
 /begin OUT_MEASUREMENT /end OUT_MEASUREMENT
/end FUNCTION
/begin FUNCTION Motortemperatur ""
 /begin DEF_CHARACTERISTIC KF_TMOT_MODELL_ML_WICHT KF_TMOT_OBD_ML_GES_MW KL_TMOT_CC_HIGH_TMOT_1 KL_TMOT_NTC KL_TMOT_OBD_DELTA KL_TMOT_OBD_DIFF_T_DELTA KL_TMOT_OBD_MODELL_DELTA K_TMOT_CC_HIGH_HYS K_TMOT_CC_HIGH_TMOT_2 K_TMOT_CC_HIGH_TOEL_1 K_TMOT_CC_HIGH_TOEL_2 K_TMOT_CC_HIGH_ZWS_OFF K_TMOT_CFG_TOEL K_TMOT_DIAG_GRAD_MAX K_TMOT_DIAG_GRAD_TAU K_TMOT_DIAG_MAX K_TMOT_DIAG_MIN K_TMOT_DIAG_TAN K_TMOT_DIAG_TIME K_TMOT_DIAG_TKA K_TMOT_ELU_ERR_CC_HIGH_TMOT_1 K_TMOT_ERR_MAX_E2 K_TMOT_MAX_E2 K_TMOT_MAX_NEG_GRADIENT K_TMOT_MAX_NEG_GRAD_E2 K_TMOT_MAX_POS_GRAD_E2 K_TMOT_MIN_E2 K_TMOT_MODELL_C_MOTOR K_TMOT_MODELL_ERSATZ K_TMOT_MODELL_F_KW K_TMOT_MODELL_F_MOTOR K_TMOT_MODELL_GAIN K_TMOT_MODELL_LAM_MAX K_TMOT_MODELL_LAM_MIN K_TMOT_MODELL_SA_ML_F K_TMOT_MODELL_START_MIN K_TMOT_MODELL_TAU_KRAFT K_TMOT_MODELL_TAU_KUEHLER K_TMOT_MODELL_TAU_UMG K_TMOT_MODELL_THERM_DELTA K_TMOT_MODELL_THERM_MIN K_TMOT_MODELL_TI_F K_TMOT_MODELL_TKA_ERSATZ_DELTA K_TMOT_MODELL_TMOT_MODELL_ML K_TMOT_OBD_BLOCKHEATER_DIFF K_TMOT_OBD_CFG K_TMOT_OBD_DIFF_HIGH K_TMOT_OBD_DIFF_MAX K_TMOT_OBD_HIGH K_TMOT_OBD_HIGH_TIME K_TMOT_OBD_THERM_2 K_TMOT_OBD_THERM_2_START K_TMOT_OBD_TKA_THERM_1_DELTA K_TMOT_OBD_TKA_THERM_2_DELTA K_TMOT_OBD_TMOT_MIN K_TMOT_OBD_TMOT_MODELL_MAX K_TMOT_OBD_T_ML_MIN K_TMOT_OBD_T_SA_MAX K_TMOT_SK_DELTA K_TMOT_TAU /end DEF_CHARACTERISTIC
 /begin REF_CHARACTERISTIC /end REF_CHARACTERISTIC
 /begin IN_MEASUREMENT /end IN_MEASUREMENT
 /begin OUT_MEASUREMENT /end OUT_MEASUREMENT
/end FUNCTION
/begin FUNCTION PCTRL "" /begin DEF_CHARACTERISTIC K_PCTRL_PROZ_ZYKL K_PCTRL_TASK_ZYKL K_PCTRL_TIMEOUT /end DEF_CHARACTERISTIC /begin REF_CHARACTERISTIC /end REF_CHARACTERISTIC /begin IN_MEASUREMENT /end IN_MEASUREMENT /begin OUT_MEASUREMENT /end OUT_MEASUREMENT /end FUNCTION
/begin RECORD_LAYOUT TKW_VV_VV_UB FNC_VALUES 1 UBYTE COLUMN_DIR DIRECT /end RECORD_LAYOUT
/begin RECORD_LAYOUT TKW_VV_VV_SB FNC_VALUES 1 SBYTE COLUMN_DIR DIRECT /end RECORD_LAYOUT
/begin RECORD_LAYOUT TKW_VV_VV_UW FNC_VALUES 1 UWORD COLUMN_DIR DIRECT /end RECORD_LAYOUT
/begin RECORD_LAYOUT TKW_VV_VV_SW FNC_VALUES 1 SWORD COLUMN_DIR DIRECT /end RECORD_LAYOUT
/begin RECORD_LAYOUT TKL_UB_VV_UB NO_AXIS_PTS_X 1 UBYTE RESERVED 2 BYTE AXIS_PTS_X 3 UBYTE INDEX_INCR DIRECT FNC_VALUES 4 UBYTE COLUMN_DIR DIRECT /end RECORD_LAYOUT
/begin RECORD_LAYOUT TKL_UB_VV_SW NO_AXIS_PTS_X 1 UBYTE RESERVED 2 BYTE AXIS_PTS_X 3 UBYTE INDEX_INCR DIRECT FNC_VALUES 4 SWORD COLUMN_DIR DIRECT /end RECORD_LAYOUT
/begin RECORD_LAYOUT TKL_UW_VV_UW NO_AXIS_PTS_X 1 UBYTE RESERVED 2 BYTE AXIS_PTS_X 3 UWORD INDEX_INCR DIRECT FNC_VALUES 4 UWORD COLUMN_DIR DIRECT /end RECORD_LAYOUT
/begin RECORD_LAYOUT TKL_UW_VV_SW NO_AXIS_PTS_X 1 UBYTE RESERVED 2 BYTE AXIS_PTS_X 3 UWORD INDEX_INCR DIRECT FNC_VALUES 4 SWORD COLUMN_DIR DIRECT /end RECORD_LAYOUT
/begin RECORD_LAYOUT TKL_SW_VV_UB NO_AXIS_PTS_X 1 UBYTE RESERVED 2 BYTE AXIS_PTS_X 3 SWORD INDEX_INCR DIRECT FNC_VALUES 4 UBYTE COLUMN_DIR DIRECT /end RECORD_LAYOUT
/begin RECORD_LAYOUT TKL_SW_VV_UW NO_AXIS_PTS_X 1 UBYTE RESERVED 2 BYTE AXIS_PTS_X 3 SWORD INDEX_INCR DIRECT FNC_VALUES 4 UWORD COLUMN_DIR DIRECT /end RECORD_LAYOUT
/begin RECORD_LAYOUT TKL_SW_VV_SW NO_AXIS_PTS_X 1 UBYTE RESERVED 2 BYTE AXIS_PTS_X 3 SWORD INDEX_INCR DIRECT FNC_VALUES 4 SWORD COLUMN_DIR DIRECT /end RECORD_LAYOUT
/begin RECORD_LAYOUT TKF_SW_SW_UW NO_AXIS_PTS_X 1 UBYTE NO_AXIS_PTS_Y 2 UBYTE AXIS_PTS_X 3 SWORD INDEX_INCR DIRECT AXIS_PTS_Y 4 SWORD INDEX_INCR DIRECT FNC_VALUES 5 UWORD COLUMN_DIR DIRECT /end RECORD_LAYOUT
/begin RECORD_LAYOUT TKF_SW_SW_SW NO_AXIS_PTS_X 1 UBYTE NO_AXIS_PTS_Y 2 UBYTE AXIS_PTS_X 3 SWORD INDEX_INCR DIRECT AXIS_PTS_Y 4 SWORD INDEX_INCR DIRECT FNC_VALUES 5 SWORD COLUMN_DIR DIRECT /end RECORD_LAYOUT
/end MODULE
/end PROJECT
