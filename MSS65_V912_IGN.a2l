/begin PROJECT MSS65-ign-V912 "MSS65 IGN - V912.00-B204.00, data set 0569Q60Z520E"
/begin HEADER "" VERSION "V912.00-B204.00" /end HEADER
/begin MODULE _MSS65-ign "MSS65 IGN - V912.00-B204.00, data 7842800"
/begin MOD_COMMON "" BYTE_ORDER MSB_FIRST /* Default byteorder (Motorola) */ /end MOD_COMMON
/begin COMPU_METHOD FORMULA_0003 "FORMULA_0003" RAT_FUNC "%3.0" "-" COEFFS 0 1 0 0 0 1 /end COMPU_METHOD
/begin COMPU_METHOD FORMULA_0010 "FORMULA_0010" RAT_FUNC "%5.0" "-" COEFFS 0 1 0 0 0 1 /end COMPU_METHOD
/begin COMPU_METHOD FORMULA_0079 "FORMULA_0079" RAT_FUNC "%6.1" "l" COEFFS 0 2 0 0 0 1 /end COMPU_METHOD
/begin COMPU_METHOD FORMULA_0172 "FORMULA_0172" TAB_VERB "%3.0" "-" COMPU_TAB_REF FORMULA_0172_VTAB /end COMPU_METHOD
/begin COMPU_VTAB FORMULA_0172_VTAB "FORMULA_0172_VTAB" TAB_VERB 1 0 "kein Fehler" /end COMPU_VTAB
/begin COMPU_METHOD FORMULA_0173 "FORMULA_0173" TAB_VERB "%3.0" "-" COMPU_TAB_REF FORMULA_0173_VTAB /end COMPU_METHOD
/begin COMPU_VTAB FORMULA_0173_VTAB "FORMULA_0173_VTAB" TAB_VERB 2 0 "inaktiv" 1 "aktiv" /end COMPU_VTAB
/begin COMPU_METHOD FORMULA_0174 "FORMULA_0174" TAB_VERB "%3.0" "-" COMPU_TAB_REF FORMULA_0174_VTAB /end COMPU_METHOD
/begin COMPU_VTAB FORMULA_0174_VTAB "FORMULA_0174_VTAB" TAB_VERB 2 0 "inaktiv" 1 "aktiv" /end COMPU_VTAB
/begin COMPU_METHOD FORMULA_0175 "FORMULA_0175" TAB_VERB "%3.0" "-" COMPU_TAB_REF FORMULA_0175_VTAB /end COMPU_METHOD
/begin COMPU_VTAB FORMULA_0175_VTAB "FORMULA_0175_VTAB" TAB_VERB 8 0 "iO" 1 "LA" 4 "LAA" 5 "LA+LAA" 16 "Mager" 17 "LA+Mager" 20 "LAA+Mager" 21 "LA+LAA+Mager" /end COMPU_VTAB
/begin COMPU_METHOD FORMULA_0176 "FORMULA_0176" TAB_VERB "%3.0" "-" COMPU_TAB_REF FORMULA_0176_VTAB /end COMPU_METHOD
/begin COMPU_VTAB FORMULA_0176_VTAB "FORMULA_0176_VTAB" TAB_VERB 8 0 "iO" 2 "LA" 8 "LAA" 10 "LA+LAA" 32 "Mager" 34 "LA+Mager" 40 "LAA+Mager" 42 "LA+LAA+Mager" /end COMPU_VTAB
/begin COMPU_METHOD FORMULA_0177 "FORMULA_0177" TAB_VERB "%3.0" "-" COMPU_TAB_REF FORMULA_0177_VTAB /end COMPU_METHOD
/begin COMPU_VTAB FORMULA_0177_VTAB "FORMULA_0177_VTAB" TAB_VERB 4 0 "iO" 1 "B1-Notl" 2 "B2-Notl" 3 "B1+B2-Notl" /end COMPU_VTAB
/begin COMPU_METHOD FORMULA_0178 "FORMULA_0178" TAB_VERB "%3.0" "-" COMPU_TAB_REF FORMULA_0178_VTAB /end COMPU_METHOD
/begin COMPU_VTAB FORMULA_0178_VTAB "FORMULA_0178_VTAB" TAB_VERB 2 0 "iO" 1 "PKS-Notlauf" /end COMPU_VTAB
/begin COMPU_METHOD FORMULA_0179 "FORMULA_0179" TAB_VERB "%3.0" "-" COMPU_TAB_REF FORMULA_0179_VTAB /end COMPU_METHOD
/begin COMPU_VTAB FORMULA_0179_VTAB "FORMULA_0179_VTAB" TAB_VERB 2 0 "iO" 1 "LLRA-Sperre" /end COMPU_VTAB
/begin COMPU_METHOD FORMULA_0180 "FORMULA_0180" TAB_VERB "%3.0" "-" COMPU_TAB_REF FORMULA_0180_VTAB /end COMPU_METHOD
/begin COMPU_VTAB FORMULA_0180_VTAB "FORMULA_0180_VTAB" TAB_VERB 2 0 "iO" 1 "FRA-Sperre" /end COMPU_VTAB
/begin CHARACTERISTIC K_ED_FST_MAX "Maximaler Tankfuellstand" VALUE 0x71978 TKW_VV_VV_UW 100.0 FORMULA_0079 0.0 32767.5000 FORMAT "%4.1" /end CHARACTERISTIC
/begin CHARACTERISTIC K_ED_APPL_DATA_IGN.P_CODE_SH_TO_UB "P-Code fuer die Art SH_TO_UB | EN: Fault code APPL_DATA_IGN - OBD P-code reported for short to battery voltage" VALUE 0x70D7E TKW_VV_VV_UW 100.0 FORMULA_0010 0.0 65535.0000 /end CHARACTERISTIC
/begin CHARACTERISTIC K_ED_DK1_CAN.P_CODE_SH_TO_UB "P-Code fuer die Art SH_TO_UB | EN: Fault code DK1_CAN - OBD P-code reported for short to battery voltage" VALUE 0x70E4E TKW_VV_VV_UW 100.0 FORMULA_0010 0.0 65535.0000 /end CHARACTERISTIC
/begin CHARACTERISTIC K_ED_DK2_CAN.P_CODE_SH_TO_UB "P-Code fuer die Art SH_TO_UB | EN: Fault code DK2_CAN - OBD P-code reported for short to battery voltage" VALUE 0x70E68 TKW_VV_VV_UW 100.0 FORMULA_0010 0.0 65535.0000 /end CHARACTERISTIC
/begin CHARACTERISTIC K_ED_DK_INIT.P_CODE_SH_TO_UB "P-Code fuer die Art SH_TO_UB | EN: Fault code DK_INIT - OBD P-code reported for short to battery voltage" VALUE 0x70F38 TKW_VV_VV_UW 100.0 FORMULA_0010 0.0 65535.0000 /end CHARACTERISTIC
/begin CHARACTERISTIC K_ED_DK1_REGLER.P_CODE_SH_TO_UB "P-Code fuer die Art SH_TO_UB | EN: Fault code DK1_REGLER - OBD P-code reported for short to battery voltage" VALUE 0x70F52 TKW_VV_VV_UW 100.0 FORMULA_0010 0.0 65535.0000 /end CHARACTERISTIC
/begin CHARACTERISTIC K_ED_DK2_REGLER.P_CODE_SH_TO_UB "P-Code fuer die Art SH_TO_UB | EN: Fault code DK2_REGLER - OBD P-code reported for short to battery voltage" VALUE 0x70F6C TKW_VV_VV_UW 100.0 FORMULA_0010 0.0 65535.0000 /end CHARACTERISTIC
/begin CHARACTERISTIC K_ED_DK1_ADAPT.P_CODE_SH_TO_UB "P-Code fuer die Art SH_TO_UB | EN: Fault code DK1_ADAPT - OBD P-code reported for short to battery voltage" VALUE 0x70F86 TKW_VV_VV_UW 100.0 FORMULA_0010 0.0 65535.0000 /end CHARACTERISTIC
/begin CHARACTERISTIC K_ED_DK2_ADAPT.P_CODE_SH_TO_UB "P-Code fuer die Art SH_TO_UB | EN: Fault code DK2_ADAPT - OBD P-code reported for short to battery voltage" VALUE 0x70FA0 TKW_VV_VV_UW 100.0 FORMULA_0010 0.0 65535.0000 /end CHARACTERISTIC
/begin CHARACTERISTIC K_ED_DK1_WDK.P_CODE_SH_TO_UB "P-Code fuer die Art SH_TO_UB | EN: Fault code DK1_WDK - OBD P-code reported for short to battery voltage" VALUE 0x71056 TKW_VV_VV_UW 100.0 FORMULA_0010 0.0 65535.0000 /end CHARACTERISTIC
/begin CHARACTERISTIC K_ED_DK2_WDK.P_CODE_SH_TO_UB "P-Code fuer die Art SH_TO_UB | EN: Fault code DK2_WDK - OBD P-code reported for short to battery voltage" VALUE 0x71070 TKW_VV_VV_UW 100.0 FORMULA_0010 0.0 65535.0000 /end CHARACTERISTIC
/begin CHARACTERISTIC K_ED_DK1_PDR.P_CODE_SH_TO_UB "P-Code fuer die Art SH_TO_UB | EN: Fault code DK1_PDR - OBD P-code reported for short to battery voltage" VALUE 0x7108A TKW_VV_VV_UW 100.0 FORMULA_0010 0.0 65535.0000 /end CHARACTERISTIC
/begin CHARACTERISTIC K_ED_DK2_PDR.P_CODE_SH_TO_UB "P-Code fuer die Art SH_TO_UB | EN: Fault code DK2_PDR - OBD P-code reported for short to battery voltage" VALUE 0x710A4 TKW_VV_VV_UW 100.0 FORMULA_0010 0.0 65535.0000 /end CHARACTERISTIC
/begin CHARACTERISTIC K_ED_DK1_SK_ERR.P_CODE_SH_TO_UB "P-Code fuer die Art SH_TO_UB | EN: Fault code DK1_SK_ERR - OBD P-code reported for short to battery voltage" VALUE 0x710F2 TKW_VV_VV_UW 100.0 FORMULA_0010 0.0 65535.0000 /end CHARACTERISTIC
/begin CHARACTERISTIC K_ED_DK2_SK_ERR.P_CODE_SH_TO_UB "P-Code fuer die Art SH_TO_UB | EN: Fault code DK2_SK_ERR - OBD P-code reported for short to battery voltage" VALUE 0x7110C TKW_VV_VV_UW 100.0 FORMULA_0010 0.0 65535.0000 /end CHARACTERISTIC
/begin CHARACTERISTIC K_ED_DK1_FEDERN.P_CODE_SH_TO_UB "P-Code fuer die Art SH_TO_UB | EN: Fault code DK1_FEDERN - OBD P-code reported for short to battery voltage" VALUE 0x71126 TKW_VV_VV_UW 100.0 FORMULA_0010 0.0 65535.0000 /end CHARACTERISTIC
/begin CHARACTERISTIC K_ED_DK2_FEDERN.P_CODE_SH_TO_UB "P-Code fuer die Art SH_TO_UB | EN: Fault code DK2_FEDERN - OBD P-code reported for short to battery voltage" VALUE 0x71140 TKW_VV_VV_UW 100.0 FORMULA_0010 0.0 65535.0000 /end CHARACTERISTIC
/begin CHARACTERISTIC K_ED_DSC_EINGR.P_CODE_SH_TO_UB "P-Code fuer die Art SH_TO_UB | EN: Fault code DSC_EINGR - OBD P-code reported for short to battery voltage" VALUE 0x7118E TKW_VV_VV_UW 100.0 FORMULA_0010 0.0 65535.0000 /end CHARACTERISTIC
/begin CHARACTERISTIC K_ED_DK1_CMD.P_CODE_SH_TO_UB "P-Code fuer die Art SH_TO_UB | EN: Fault code DK1_CMD - OBD P-code reported for short to battery voltage" VALUE 0x711A8 TKW_VV_VV_UW 100.0 FORMULA_0010 0.0 65535.0000 /end CHARACTERISTIC
/begin CHARACTERISTIC K_ED_DK2_CMD.P_CODE_SH_TO_UB "P-Code fuer die Art SH_TO_UB | EN: Fault code DK2_CMD - OBD P-code reported for short to battery voltage" VALUE 0x711C2 TKW_VV_VV_UW 100.0 FORMULA_0010 0.0 65535.0000 /end CHARACTERISTIC
/begin CHARACTERISTIC K_ED_EC_BUSOFF.P_CODE_SH_TO_UB "P-Code fuer die Art SH_TO_UB | EN: Fault code EC_BUSOFF - OBD P-code reported for short to battery voltage" VALUE 0x71278 TKW_VV_VV_UW 100.0 FORMULA_0010 0.0 65535.0000 /end CHARACTERISTIC
/begin CHARACTERISTIC K_ED_AUSS_KAT_Z1.P_CODE_SH_TO_UB "P-Code fuer die Art SH_TO_UB | EN: Fault code AUSS_KAT_Z1 - OBD P-code reported for short to battery voltage" VALUE 0x71292 TKW_VV_VV_UW 100.0 FORMULA_0010 0.0 65535.0000 /end CHARACTERISTIC
/begin CHARACTERISTIC K_ED_AUSS_KAT_Z2.P_CODE_SH_TO_UB "P-Code fuer die Art SH_TO_UB | EN: Fault code AUSS_KAT_Z2 - OBD P-code reported for short to battery voltage" VALUE 0x712AC TKW_VV_VV_UW 100.0 FORMULA_0010 0.0 65535.0000 /end CHARACTERISTIC
/begin CHARACTERISTIC K_ED_AUSS_KAT_Z3.P_CODE_SH_TO_UB "P-Code fuer die Art SH_TO_UB | EN: Fault code AUSS_KAT_Z3 - OBD P-code reported for short to battery voltage" VALUE 0x712C6 TKW_VV_VV_UW 100.0 FORMULA_0010 0.0 65535.0000 /end CHARACTERISTIC
/begin CHARACTERISTIC K_ED_AUSS_KAT_Z4.P_CODE_SH_TO_UB "P-Code fuer die Art SH_TO_UB | EN: Fault code AUSS_KAT_Z4 - OBD P-code reported for short to battery voltage" VALUE 0x712E0 TKW_VV_VV_UW 100.0 FORMULA_0010 0.0 65535.0000 /end CHARACTERISTIC
/begin CHARACTERISTIC K_ED_AUSS_KAT_Z5.P_CODE_SH_TO_UB "P-Code fuer die Art SH_TO_UB | EN: Fault code AUSS_KAT_Z5 - OBD P-code reported for short to battery voltage" VALUE 0x712FA TKW_VV_VV_UW 100.0 FORMULA_0010 0.0 65535.0000 /end CHARACTERISTIC
/begin CHARACTERISTIC K_ED_AUSS_KAT_Z6.P_CODE_SH_TO_UB "P-Code fuer die Art SH_TO_UB | EN: Fault code AUSS_KAT_Z6 - OBD P-code reported for short to battery voltage" VALUE 0x71314 TKW_VV_VV_UW 100.0 FORMULA_0010 0.0 65535.0000 /end CHARACTERISTIC
/begin CHARACTERISTIC K_ED_AUSS_KAT_Z7.P_CODE_SH_TO_UB "P-Code fuer die Art SH_TO_UB | EN: Fault code AUSS_KAT_Z7 - OBD P-code reported for short to battery voltage" VALUE 0x7132E TKW_VV_VV_UW 100.0 FORMULA_0010 0.0 65535.0000 /end CHARACTERISTIC
/begin CHARACTERISTIC K_ED_AUSS_KAT_Z8.P_CODE_SH_TO_UB "P-Code fuer die Art SH_TO_UB | EN: Fault code AUSS_KAT_Z8 - OBD P-code reported for short to battery voltage" VALUE 0x71348 TKW_VV_VV_UW 100.0 FORMULA_0010 0.0 65535.0000 /end CHARACTERISTIC
/begin CHARACTERISTIC K_ED_AUSS_KAT_Z9.P_CODE_SH_TO_UB "P-Code fuer die Art SH_TO_UB | EN: Fault code AUSS_KAT_Z9 - OBD P-code reported for short to battery voltage" VALUE 0x71362 TKW_VV_VV_UW 100.0 FORMULA_0010 0.0 65535.0000 /end CHARACTERISTIC
/begin CHARACTERISTIC K_ED_AUSS_KAT_Z10.P_CODE_SH_TO_UB "P-Code fuer die Art SH_TO_UB | EN: Fault code AUSS_KAT_Z10 - OBD P-code reported for short to battery voltage" VALUE 0x7137C TKW_VV_VV_UW 100.0 FORMULA_0010 0.0 65535.0000 /end CHARACTERISTIC
/begin CHARACTERISTIC K_ED_AUSS_KAT_MULT.P_CODE_SH_TO_UB "P-Code fuer die Art SH_TO_UB | EN: Fault code AUSS_KAT_MULT - OBD P-code reported for short to battery voltage" VALUE 0x713CA TKW_VV_VV_UW 100.0 FORMULA_0010 0.0 65535.0000 /end CHARACTERISTIC
/begin CHARACTERISTIC K_ED_AUSS_ABG_Z1.P_CODE_SH_TO_UB "P-Code fuer die Art SH_TO_UB | EN: Fault code AUSS_ABG_Z1 - OBD P-code reported for short to battery voltage" VALUE 0x713E4 TKW_VV_VV_UW 100.0 FORMULA_0010 0.0 65535.0000 /end CHARACTERISTIC
/begin CHARACTERISTIC K_ED_AUSS_ABG_Z2.P_CODE_SH_TO_UB "P-Code fuer die Art SH_TO_UB | EN: Fault code AUSS_ABG_Z2 - OBD P-code reported for short to battery voltage" VALUE 0x713FE TKW_VV_VV_UW 100.0 FORMULA_0010 0.0 65535.0000 /end CHARACTERISTIC
/begin CHARACTERISTIC K_ED_AUSS_ABG_Z3.P_CODE_SH_TO_UB "P-Code fuer die Art SH_TO_UB | EN: Fault code AUSS_ABG_Z3 - OBD P-code reported for short to battery voltage" VALUE 0x71418 TKW_VV_VV_UW 100.0 FORMULA_0010 0.0 65535.0000 /end CHARACTERISTIC
/begin CHARACTERISTIC K_ED_AUSS_ABG_Z4.P_CODE_SH_TO_UB "P-Code fuer die Art SH_TO_UB | EN: Fault code AUSS_ABG_Z4 - OBD P-code reported for short to battery voltage" VALUE 0x71432 TKW_VV_VV_UW 100.0 FORMULA_0010 0.0 65535.0000 /end CHARACTERISTIC
/begin CHARACTERISTIC K_ED_AUSS_ABG_Z5.P_CODE_SH_TO_UB "P-Code fuer die Art SH_TO_UB | EN: Fault code AUSS_ABG_Z5 - OBD P-code reported for short to battery voltage" VALUE 0x7144C TKW_VV_VV_UW 100.0 FORMULA_0010 0.0 65535.0000 /end CHARACTERISTIC
/begin CHARACTERISTIC K_ED_AUSS_ABG_Z6.P_CODE_SH_TO_UB "P-Code fuer die Art SH_TO_UB | EN: Fault code AUSS_ABG_Z6 - OBD P-code reported for short to battery voltage" VALUE 0x71466 TKW_VV_VV_UW 100.0 FORMULA_0010 0.0 65535.0000 /end CHARACTERISTIC
/begin CHARACTERISTIC K_ED_AUSS_ABG_Z7.P_CODE_SH_TO_UB "P-Code fuer die Art SH_TO_UB | EN: Fault code AUSS_ABG_Z7 - OBD P-code reported for short to battery voltage" VALUE 0x71480 TKW_VV_VV_UW 100.0 FORMULA_0010 0.0 65535.0000 /end CHARACTERISTIC
/begin CHARACTERISTIC K_ED_AUSS_ABG_Z8.P_CODE_SH_TO_UB "P-Code fuer die Art SH_TO_UB | EN: Fault code AUSS_ABG_Z8 - OBD P-code reported for short to battery voltage" VALUE 0x7149A TKW_VV_VV_UW 100.0 FORMULA_0010 0.0 65535.0000 /end CHARACTERISTIC
/begin CHARACTERISTIC K_ED_AUSS_ABG_Z9.P_CODE_SH_TO_UB "P-Code fuer die Art SH_TO_UB" VALUE 0x714B4 TKW_VV_VV_UW 100.0 FORMULA_0010 0.0 65535.0000 /end CHARACTERISTIC
/begin CHARACTERISTIC K_ED_AUSS_ABG_Z10.P_CODE_SH_TO_UB "P-Code fuer die Art SH_TO_UB" VALUE 0x714CE TKW_VV_VV_UW 100.0 FORMULA_0010 0.0 65535.0000 /end CHARACTERISTIC
/begin CHARACTERISTIC K_ED_AUSS_ABG_MULT.P_CODE_SH_TO_UB "P-Code fuer die Art SH_TO_UB" VALUE 0x7151C TKW_VV_VV_UW 100.0 FORMULA_0010 0.0 65535.0000 /end CHARACTERISTIC
/begin CHARACTERISTIC K_ED_E2_IGN.P_CODE_SH_TO_UB "P-Code fuer die Art SH_TO_UB | EN: Fault code E2_IGN - OBD P-code reported for short to battery voltage" VALUE 0x715D2 TKW_VV_VV_UW 100.0 FORMULA_0010 0.0 65535.0000 /end CHARACTERISTIC
/begin CHARACTERISTIC K_ED_BLS_PLAU.P_CODE_SH_TO_UB "P-Code fuer die Art SH_TO_UB | EN: Fault code BLS_PLAU - OBD P-code reported for short to battery voltage" VALUE 0x715EC TKW_VV_VV_UW 100.0 FORMULA_0010 0.0 65535.0000 /end CHARACTERISTIC
/begin CHARACTERISTIC K_ED_DK1_ZUST.P_CODE_SH_TO_UB "P-Code fuer die Art SH_TO_UB | EN: Fault code DK1_ZUST - OBD P-code reported for short to battery voltage" VALUE 0x7166E TKW_VV_VV_UW 100.0 FORMULA_0010 0.0 65535.0000 /end CHARACTERISTIC
/begin CHARACTERISTIC K_ED_DK2_ZUST.P_CODE_SH_TO_UB "P-Code fuer die Art SH_TO_UB | EN: Fault code DK2_ZUST - OBD P-code reported for short to battery voltage" VALUE 0x71688 TKW_VV_VV_UW 100.0 FORMULA_0010 0.0 65535.0000 /end CHARACTERISTIC
/begin CHARACTERISTIC K_ED_FGR_ABWURF.P_CODE_SH_TO_UB "P-Code fuer die Art SH_TO_UB | EN: Fault code FGR_ABWURF - OBD P-code reported for short to battery voltage" VALUE 0x716A2 TKW_VV_VV_UW 100.0 FORMULA_0010 0.0 65535.0000 /end CHARACTERISTIC
/begin CHARACTERISTIC K_ED_AFZ_HS.P_CODE_SH_TO_UB "P-Code fuer die Art SH_TO_UB | EN: Fault code AFZ_HS - OBD P-code reported for short to battery voltage" VALUE 0x716F0 TKW_VV_VV_UW 100.0 FORMULA_0010 0.0 65535.0000 /end CHARACTERISTIC
/begin CHARACTERISTIC K_ED_AFZ_HS_NA.P_CODE_SH_TO_UB "P-Code fuer die Art SH_TO_UB" VALUE 0x71772 TKW_VV_VV_UW 100.0 FORMULA_0010 0.0 65535.0000 /end CHARACTERISTIC
/begin CHARACTERISTIC K_ED_INDEX_110_IGN.P_CODE_SH_TO_UB "P-Code fuer die Art SH_TO_UB" VALUE 0x7178C TKW_VV_VV_UW 100.0 FORMULA_0010 0.0 65535.0000 /end CHARACTERISTIC
/begin CHARACTERISTIC K_ED_INDEX_111_IGN.P_CODE_SH_TO_UB "P-Code fuer die Art SH_TO_UB" VALUE 0x717A6 TKW_VV_VV_UW 100.0 FORMULA_0010 0.0 65535.0000 /end CHARACTERISTIC
/begin CHARACTERISTIC K_ED_INDEX_112_IGN.P_CODE_SH_TO_UB "P-Code fuer die Art SH_TO_UB" VALUE 0x717C0 TKW_VV_VV_UW 100.0 FORMULA_0010 0.0 65535.0000 /end CHARACTERISTIC
/begin CHARACTERISTIC K_ED_INDEX_113_IGN.P_CODE_SH_TO_UB "P-Code fuer die Art SH_TO_UB" VALUE 0x717DA TKW_VV_VV_UW 100.0 FORMULA_0010 0.0 65535.0000 /end CHARACTERISTIC
/begin CHARACTERISTIC K_ED_INDEX_114_IGN.P_CODE_SH_TO_UB "P-Code fuer die Art SH_TO_UB" VALUE 0x717F4 TKW_VV_VV_UW 100.0 FORMULA_0010 0.0 65535.0000 /end CHARACTERISTIC
/begin CHARACTERISTIC K_ED_INDEX_115_IGN.P_CODE_SH_TO_UB "P-Code fuer die Art SH_TO_UB" VALUE 0x7180E TKW_VV_VV_UW 100.0 FORMULA_0010 0.0 65535.0000 /end CHARACTERISTIC
/begin CHARACTERISTIC K_ED_INDEX_116_IGN.P_CODE_SH_TO_UB "P-Code fuer die Art SH_TO_UB" VALUE 0x71828 TKW_VV_VV_UW 100.0 FORMULA_0010 0.0 65535.0000 /end CHARACTERISTIC
/begin CHARACTERISTIC K_ED_INDEX_117_IGN.P_CODE_SH_TO_UB "P-Code fuer die Art SH_TO_UB" VALUE 0x71842 TKW_VV_VV_UW 100.0 FORMULA_0010 0.0 65535.0000 /end CHARACTERISTIC
/begin CHARACTERISTIC K_ED_INDEX_118_IGN.P_CODE_SH_TO_UB "P-Code fuer die Art SH_TO_UB" VALUE 0x7185C TKW_VV_VV_UW 100.0 FORMULA_0010 0.0 65535.0000 /end CHARACTERISTIC
/begin CHARACTERISTIC K_ED_INDEX_119_IGN.P_CODE_SH_TO_UB "P-Code fuer die Art SH_TO_UB" VALUE 0x71876 TKW_VV_VV_UW 100.0 FORMULA_0010 0.0 65535.0000 /end CHARACTERISTIC
/begin CHARACTERISTIC K_ED_INDEX_120_IGN.P_CODE_SH_TO_UB "P-Code fuer die Art SH_TO_UB" VALUE 0x71890 TKW_VV_VV_UW 100.0 FORMULA_0010 0.0 65535.0000 /end CHARACTERISTIC
/begin CHARACTERISTIC K_ED_APPL_DATA_IGN.P_CODE_SH_TO_GND "P-Code fuer die Art SH_TO_GND | EN: Fault code APPL_DATA_IGN - OBD P-code reported for short to ground" VALUE 0x70D80 TKW_VV_VV_UW 100.0 FORMULA_0010 0.0 65535.0000 /end CHARACTERISTIC
/begin CHARACTERISTIC K_ED_DK1_CAN.P_CODE_SH_TO_GND "P-Code fuer die Art SH_TO_GND | EN: Fault code DK1_CAN - OBD P-code reported for short to ground" VALUE 0x70E50 TKW_VV_VV_UW 100.0 FORMULA_0010 0.0 65535.0000 /end CHARACTERISTIC
/begin CHARACTERISTIC K_ED_DK2_CAN.P_CODE_SH_TO_GND "P-Code fuer die Art SH_TO_GND | EN: Fault code DK2_CAN - OBD P-code reported for short to ground" VALUE 0x70E6A TKW_VV_VV_UW 100.0 FORMULA_0010 0.0 65535.0000 /end CHARACTERISTIC
/begin CHARACTERISTIC K_ED_DK_INIT.P_CODE_SH_TO_GND "P-Code fuer die Art SH_TO_GND | EN: Fault code DK_INIT - OBD P-code reported for short to ground" VALUE 0x70F3A TKW_VV_VV_UW 100.0 FORMULA_0010 0.0 65535.0000 /end CHARACTERISTIC
/begin CHARACTERISTIC K_ED_DK1_REGLER.P_CODE_SH_TO_GND "P-Code fuer die Art SH_TO_GND | EN: Fault code DK1_REGLER - OBD P-code reported for short to ground" VALUE 0x70F54 TKW_VV_VV_UW 100.0 FORMULA_0010 0.0 65535.0000 /end CHARACTERISTIC
/begin CHARACTERISTIC K_ED_DK2_REGLER.P_CODE_SH_TO_GND "P-Code fuer die Art SH_TO_GND | EN: Fault code DK2_REGLER - OBD P-code reported for short to ground" VALUE 0x70F6E TKW_VV_VV_UW 100.0 FORMULA_0010 0.0 65535.0000 /end CHARACTERISTIC
/begin CHARACTERISTIC K_ED_DK1_ADAPT.P_CODE_SH_TO_GND "P-Code fuer die Art SH_TO_GND | EN: Fault code DK1_ADAPT - OBD P-code reported for short to ground" VALUE 0x70F88 TKW_VV_VV_UW 100.0 FORMULA_0010 0.0 65535.0000 /end CHARACTERISTIC
/begin CHARACTERISTIC K_ED_DK2_ADAPT.P_CODE_SH_TO_GND "P-Code fuer die Art SH_TO_GND | EN: Fault code DK2_ADAPT - OBD P-code reported for short to ground" VALUE 0x70FA2 TKW_VV_VV_UW 100.0 FORMULA_0010 0.0 65535.0000 /end CHARACTERISTIC
/begin CHARACTERISTIC K_ED_DK1_WDK.P_CODE_SH_TO_GND "P-Code fuer die Art SH_TO_GND | EN: Fault code DK1_WDK - OBD P-code reported for short to ground" VALUE 0x71058 TKW_VV_VV_UW 100.0 FORMULA_0010 0.0 65535.0000 /end CHARACTERISTIC
/begin CHARACTERISTIC K_ED_DK2_WDK.P_CODE_SH_TO_GND "P-Code fuer die Art SH_TO_GND | EN: Fault code DK2_WDK - OBD P-code reported for short to ground" VALUE 0x71072 TKW_VV_VV_UW 100.0 FORMULA_0010 0.0 65535.0000 /end CHARACTERISTIC
/begin CHARACTERISTIC K_ED_DK1_PDR.P_CODE_SH_TO_GND "P-Code fuer die Art SH_TO_GND | EN: Fault code DK1_PDR - OBD P-code reported for short to ground" VALUE 0x7108C TKW_VV_VV_UW 100.0 FORMULA_0010 0.0 65535.0000 /end CHARACTERISTIC
/begin CHARACTERISTIC K_ED_DK2_PDR.P_CODE_SH_TO_GND "P-Code fuer die Art SH_TO_GND | EN: Fault code DK2_PDR - OBD P-code reported for short to ground" VALUE 0x710A6 TKW_VV_VV_UW 100.0 FORMULA_0010 0.0 65535.0000 /end CHARACTERISTIC
/begin CHARACTERISTIC K_ED_DK1_SK_ERR.P_CODE_SH_TO_GND "P-Code fuer die Art SH_TO_GND | EN: Fault code DK1_SK_ERR - OBD P-code reported for short to ground" VALUE 0x710F4 TKW_VV_VV_UW 100.0 FORMULA_0010 0.0 65535.0000 /end CHARACTERISTIC
/begin CHARACTERISTIC K_ED_DK2_SK_ERR.P_CODE_SH_TO_GND "P-Code fuer die Art SH_TO_GND | EN: Fault code DK2_SK_ERR - OBD P-code reported for short to ground" VALUE 0x7110E TKW_VV_VV_UW 100.0 FORMULA_0010 0.0 65535.0000 /end CHARACTERISTIC
/begin CHARACTERISTIC K_ED_DK1_FEDERN.P_CODE_SH_TO_GND "P-Code fuer die Art SH_TO_GND | EN: Fault code DK1_FEDERN - OBD P-code reported for short to ground" VALUE 0x71128 TKW_VV_VV_UW 100.0 FORMULA_0010 0.0 65535.0000 /end CHARACTERISTIC
/begin CHARACTERISTIC K_ED_DK2_FEDERN.P_CODE_SH_TO_GND "P-Code fuer die Art SH_TO_GND | EN: Fault code DK2_FEDERN - OBD P-code reported for short to ground" VALUE 0x71142 TKW_VV_VV_UW 100.0 FORMULA_0010 0.0 65535.0000 /end CHARACTERISTIC
/begin CHARACTERISTIC K_ED_DSC_EINGR.P_CODE_SH_TO_GND "P-Code fuer die Art SH_TO_GND | EN: Fault code DSC_EINGR - OBD P-code reported for short to ground" VALUE 0x71190 TKW_VV_VV_UW 100.0 FORMULA_0010 0.0 65535.0000 /end CHARACTERISTIC
/begin CHARACTERISTIC K_ED_DK1_CMD.P_CODE_SH_TO_GND "P-Code fuer die Art SH_TO_GND | EN: Fault code DK1_CMD - OBD P-code reported for short to ground" VALUE 0x711AA TKW_VV_VV_UW 100.0 FORMULA_0010 0.0 65535.0000 /end CHARACTERISTIC
/begin CHARACTERISTIC K_ED_DK2_CMD.P_CODE_SH_TO_GND "P-Code fuer die Art SH_TO_GND | EN: Fault code DK2_CMD - OBD P-code reported for short to ground" VALUE 0x711C4 TKW_VV_VV_UW 100.0 FORMULA_0010 0.0 65535.0000 /end CHARACTERISTIC
/begin CHARACTERISTIC K_ED_EC_BUSOFF.P_CODE_SH_TO_GND "P-Code fuer die Art SH_TO_GND | EN: Fault code EC_BUSOFF - OBD P-code reported for short to ground" VALUE 0x7127A TKW_VV_VV_UW 100.0 FORMULA_0010 0.0 65535.0000 /end CHARACTERISTIC
/begin CHARACTERISTIC K_ED_AUSS_KAT_Z1.P_CODE_SH_TO_GND "P-Code fuer die Art SH_TO_GND | EN: Fault code AUSS_KAT_Z1 - OBD P-code reported for short to ground" VALUE 0x71294 TKW_VV_VV_UW 100.0 FORMULA_0010 0.0 65535.0000 /end CHARACTERISTIC
/begin CHARACTERISTIC K_ED_AUSS_KAT_Z2.P_CODE_SH_TO_GND "P-Code fuer die Art SH_TO_GND | EN: Fault code AUSS_KAT_Z2 - OBD P-code reported for short to ground" VALUE 0x712AE TKW_VV_VV_UW 100.0 FORMULA_0010 0.0 65535.0000 /end CHARACTERISTIC
/begin CHARACTERISTIC K_ED_AUSS_KAT_Z3.P_CODE_SH_TO_GND "P-Code fuer die Art SH_TO_GND | EN: Fault code AUSS_KAT_Z3 - OBD P-code reported for short to ground" VALUE 0x712C8 TKW_VV_VV_UW 100.0 FORMULA_0010 0.0 65535.0000 /end CHARACTERISTIC
/begin CHARACTERISTIC K_ED_AUSS_KAT_Z4.P_CODE_SH_TO_GND "P-Code fuer die Art SH_TO_GND | EN: Fault code AUSS_KAT_Z4 - OBD P-code reported for short to ground" VALUE 0x712E2 TKW_VV_VV_UW 100.0 FORMULA_0010 0.0 65535.0000 /end CHARACTERISTIC
/begin CHARACTERISTIC K_ED_AUSS_KAT_Z5.P_CODE_SH_TO_GND "P-Code fuer die Art SH_TO_GND | EN: Fault code AUSS_KAT_Z5 - OBD P-code reported for short to ground" VALUE 0x712FC TKW_VV_VV_UW 100.0 FORMULA_0010 0.0 65535.0000 /end CHARACTERISTIC
/begin CHARACTERISTIC K_ED_AUSS_KAT_Z6.P_CODE_SH_TO_GND "P-Code fuer die Art SH_TO_GND | EN: Fault code AUSS_KAT_Z6 - OBD P-code reported for short to ground" VALUE 0x71316 TKW_VV_VV_UW 100.0 FORMULA_0010 0.0 65535.0000 /end CHARACTERISTIC
/begin CHARACTERISTIC K_ED_AUSS_KAT_Z7.P_CODE_SH_TO_GND "P-Code fuer die Art SH_TO_GND | EN: Fault code AUSS_KAT_Z7 - OBD P-code reported for short to ground" VALUE 0x71330 TKW_VV_VV_UW 100.0 FORMULA_0010 0.0 65535.0000 /end CHARACTERISTIC
/begin CHARACTERISTIC K_ED_AUSS_KAT_Z8.P_CODE_SH_TO_GND "P-Code fuer die Art SH_TO_GND | EN: Fault code AUSS_KAT_Z8 - OBD P-code reported for short to ground" VALUE 0x7134A TKW_VV_VV_UW 100.0 FORMULA_0010 0.0 65535.0000 /end CHARACTERISTIC
/begin CHARACTERISTIC K_ED_AUSS_KAT_Z9.P_CODE_SH_TO_GND "P-Code fuer die Art SH_TO_GND | EN: Fault code AUSS_KAT_Z9 - OBD P-code reported for short to ground" VALUE 0x71364 TKW_VV_VV_UW 100.0 FORMULA_0010 0.0 65535.0000 /end CHARACTERISTIC
/begin CHARACTERISTIC K_ED_AUSS_KAT_Z10.P_CODE_SH_TO_GND "P-Code fuer die Art SH_TO_GND | EN: Fault code AUSS_KAT_Z10 - OBD P-code reported for short to ground" VALUE 0x7137E TKW_VV_VV_UW 100.0 FORMULA_0010 0.0 65535.0000 /end CHARACTERISTIC
/begin CHARACTERISTIC K_ED_AUSS_KAT_MULT.P_CODE_SH_TO_GND "P-Code fuer die Art SH_TO_GND | EN: Fault code AUSS_KAT_MULT - OBD P-code reported for short to ground" VALUE 0x713CC TKW_VV_VV_UW 100.0 FORMULA_0010 0.0 65535.0000 /end CHARACTERISTIC
/begin CHARACTERISTIC K_ED_AUSS_ABG_Z1.P_CODE_SH_TO_GND "P-Code fuer die Art SH_TO_GND | EN: Fault code AUSS_ABG_Z1 - OBD P-code reported for short to ground" VALUE 0x713E6 TKW_VV_VV_UW 100.0 FORMULA_0010 0.0 65535.0000 /end CHARACTERISTIC
/begin CHARACTERISTIC K_ED_AUSS_ABG_Z2.P_CODE_SH_TO_GND "P-Code fuer die Art SH_TO_GND | EN: Fault code AUSS_ABG_Z2 - OBD P-code reported for short to ground" VALUE 0x71400 TKW_VV_VV_UW 100.0 FORMULA_0010 0.0 65535.0000 /end CHARACTERISTIC
/begin CHARACTERISTIC K_ED_AUSS_ABG_Z3.P_CODE_SH_TO_GND "P-Code fuer die Art SH_TO_GND | EN: Fault code AUSS_ABG_Z3 - OBD P-code reported for short to ground" VALUE 0x7141A TKW_VV_VV_UW 100.0 FORMULA_0010 0.0 65535.0000 /end CHARACTERISTIC
/begin CHARACTERISTIC K_ED_AUSS_ABG_Z4.P_CODE_SH_TO_GND "P-Code fuer die Art SH_TO_GND | EN: Fault code AUSS_ABG_Z4 - OBD P-code reported for short to ground" VALUE 0x71434 TKW_VV_VV_UW 100.0 FORMULA_0010 0.0 65535.0000 /end CHARACTERISTIC
/begin CHARACTERISTIC K_ED_AUSS_ABG_Z5.P_CODE_SH_TO_GND "P-Code fuer die Art SH_TO_GND | EN: Fault code AUSS_ABG_Z5 - OBD P-code reported for short to ground" VALUE 0x7144E TKW_VV_VV_UW 100.0 FORMULA_0010 0.0 65535.0000 /end CHARACTERISTIC
/begin CHARACTERISTIC K_ED_AUSS_ABG_Z6.P_CODE_SH_TO_GND "P-Code fuer die Art SH_TO_GND | EN: Fault code AUSS_ABG_Z6 - OBD P-code reported for short to ground" VALUE 0x71468 TKW_VV_VV_UW 100.0 FORMULA_0010 0.0 65535.0000 /end CHARACTERISTIC
/begin CHARACTERISTIC K_ED_AUSS_ABG_Z7.P_CODE_SH_TO_GND "P-Code fuer die Art SH_TO_GND | EN: Fault code AUSS_ABG_Z7 - OBD P-code reported for short to ground" VALUE 0x71482 TKW_VV_VV_UW 100.0 FORMULA_0010 0.0 65535.0000 /end CHARACTERISTIC
/begin CHARACTERISTIC K_ED_AUSS_ABG_Z8.P_CODE_SH_TO_GND "P-Code fuer die Art SH_TO_GND | EN: Fault code AUSS_ABG_Z8 - OBD P-code reported for short to ground" VALUE 0x7149C TKW_VV_VV_UW 100.0 FORMULA_0010 0.0 65535.0000 /end CHARACTERISTIC
/begin CHARACTERISTIC K_ED_AUSS_ABG_Z9.P_CODE_SH_TO_GND "P-Code fuer die Art SH_TO_GND" VALUE 0x714B6 TKW_VV_VV_UW 100.0 FORMULA_0010 0.0 65535.0000 /end CHARACTERISTIC
/begin CHARACTERISTIC K_ED_AUSS_ABG_Z10.P_CODE_SH_TO_GND "P-Code fuer die Art SH_TO_GND" VALUE 0x714D0 TKW_VV_VV_UW 100.0 FORMULA_0010 0.0 65535.0000 /end CHARACTERISTIC
/begin CHARACTERISTIC K_ED_AUSS_ABG_MULT.P_CODE_SH_TO_GND "P-Code fuer die Art SH_TO_GND" VALUE 0x7151E TKW_VV_VV_UW 100.0 FORMULA_0010 0.0 65535.0000 /end CHARACTERISTIC
/begin CHARACTERISTIC K_ED_E2_IGN.P_CODE_SH_TO_GND "P-Code fuer die Art SH_TO_GND | EN: Fault code E2_IGN - OBD P-code reported for short to ground" VALUE 0x715D4 TKW_VV_VV_UW 100.0 FORMULA_0010 0.0 65535.0000 /end CHARACTERISTIC
/begin CHARACTERISTIC K_ED_BLS_PLAU.P_CODE_SH_TO_GND "P-Code fuer die Art SH_TO_GND | EN: Fault code BLS_PLAU - OBD P-code reported for short to ground" VALUE 0x715EE TKW_VV_VV_UW 100.0 FORMULA_0010 0.0 65535.0000 /end CHARACTERISTIC
/begin CHARACTERISTIC K_ED_DK1_ZUST.P_CODE_SH_TO_GND "P-Code fuer die Art SH_TO_GND | EN: Fault code DK1_ZUST - OBD P-code reported for short to ground" VALUE 0x71670 TKW_VV_VV_UW 100.0 FORMULA_0010 0.0 65535.0000 /end CHARACTERISTIC
/begin CHARACTERISTIC K_ED_DK2_ZUST.P_CODE_SH_TO_GND "P-Code fuer die Art SH_TO_GND | EN: Fault code DK2_ZUST - OBD P-code reported for short to ground" VALUE 0x7168A TKW_VV_VV_UW 100.0 FORMULA_0010 0.0 65535.0000 /end CHARACTERISTIC
/begin CHARACTERISTIC K_ED_FGR_ABWURF.P_CODE_SH_TO_GND "P-Code fuer die Art SH_TO_GND | EN: Fault code FGR_ABWURF - OBD P-code reported for short to ground" VALUE 0x716A4 TKW_VV_VV_UW 100.0 FORMULA_0010 0.0 65535.0000 /end CHARACTERISTIC
/begin CHARACTERISTIC K_ED_AFZ_HS.P_CODE_SH_TO_GND "P-Code fuer die Art SH_TO_GND | EN: Fault code AFZ_HS - OBD P-code reported for short to ground" VALUE 0x716F2 TKW_VV_VV_UW 100.0 FORMULA_0010 0.0 65535.0000 /end CHARACTERISTIC
/begin CHARACTERISTIC K_ED_AFZ_HS_NA.P_CODE_SH_TO_GND "P-Code fuer die Art SH_TO_GND" VALUE 0x71774 TKW_VV_VV_UW 100.0 FORMULA_0010 0.0 65535.0000 /end CHARACTERISTIC
/begin CHARACTERISTIC K_ED_INDEX_110_IGN.P_CODE_SH_TO_GND "P-Code fuer die Art SH_TO_GND" VALUE 0x7178E TKW_VV_VV_UW 100.0 FORMULA_0010 0.0 65535.0000 /end CHARACTERISTIC
/begin CHARACTERISTIC K_ED_INDEX_111_IGN.P_CODE_SH_TO_GND "P-Code fuer die Art SH_TO_GND" VALUE 0x717A8 TKW_VV_VV_UW 100.0 FORMULA_0010 0.0 65535.0000 /end CHARACTERISTIC
/begin CHARACTERISTIC K_ED_INDEX_112_IGN.P_CODE_SH_TO_GND "P-Code fuer die Art SH_TO_GND" VALUE 0x717C2 TKW_VV_VV_UW 100.0 FORMULA_0010 0.0 65535.0000 /end CHARACTERISTIC
/begin CHARACTERISTIC K_ED_INDEX_113_IGN.P_CODE_SH_TO_GND "P-Code fuer die Art SH_TO_GND" VALUE 0x717DC TKW_VV_VV_UW 100.0 FORMULA_0010 0.0 65535.0000 /end CHARACTERISTIC
/begin CHARACTERISTIC K_ED_INDEX_114_IGN.P_CODE_SH_TO_GND "P-Code fuer die Art SH_TO_GND" VALUE 0x717F6 TKW_VV_VV_UW 100.0 FORMULA_0010 0.0 65535.0000 /end CHARACTERISTIC
/begin CHARACTERISTIC K_ED_INDEX_115_IGN.P_CODE_SH_TO_GND "P-Code fuer die Art SH_TO_GND" VALUE 0x71810 TKW_VV_VV_UW 100.0 FORMULA_0010 0.0 65535.0000 /end CHARACTERISTIC
/begin CHARACTERISTIC K_ED_INDEX_116_IGN.P_CODE_SH_TO_GND "P-Code fuer die Art SH_TO_GND" VALUE 0x7182A TKW_VV_VV_UW 100.0 FORMULA_0010 0.0 65535.0000 /end CHARACTERISTIC
/begin CHARACTERISTIC K_ED_INDEX_117_IGN.P_CODE_SH_TO_GND "P-Code fuer die Art SH_TO_GND" VALUE 0x71844 TKW_VV_VV_UW 100.0 FORMULA_0010 0.0 65535.0000 /end CHARACTERISTIC
/begin CHARACTERISTIC K_ED_INDEX_118_IGN.P_CODE_SH_TO_GND "P-Code fuer die Art SH_TO_GND" VALUE 0x7185E TKW_VV_VV_UW 100.0 FORMULA_0010 0.0 65535.0000 /end CHARACTERISTIC
/begin CHARACTERISTIC K_ED_INDEX_119_IGN.P_CODE_SH_TO_GND "P-Code fuer die Art SH_TO_GND" VALUE 0x71878 TKW_VV_VV_UW 100.0 FORMULA_0010 0.0 65535.0000 /end CHARACTERISTIC
/begin CHARACTERISTIC K_ED_INDEX_120_IGN.P_CODE_SH_TO_GND "P-Code fuer die Art SH_TO_GND" VALUE 0x71892 TKW_VV_VV_UW 100.0 FORMULA_0010 0.0 65535.0000 /end CHARACTERISTIC
/begin CHARACTERISTIC K_ED_APPL_DATA_IGN.P_CODE_OPENLOAD "P-Code fuer die Art OPENLOAD | EN: Fault code APPL_DATA_IGN - OBD P-code reported for open circuit" VALUE 0x70D82 TKW_VV_VV_UW 100.0 FORMULA_0010 0.0 65535.0000 /end CHARACTERISTIC
/begin CHARACTERISTIC K_ED_DK1_CAN.P_CODE_OPENLOAD "P-Code fuer die Art OPENLOAD | EN: Fault code DK1_CAN - OBD P-code reported for open circuit" VALUE 0x70E52 TKW_VV_VV_UW 100.0 FORMULA_0010 0.0 65535.0000 /end CHARACTERISTIC
/begin CHARACTERISTIC K_ED_DK2_CAN.P_CODE_OPENLOAD "P-Code fuer die Art OPENLOAD | EN: Fault code DK2_CAN - OBD P-code reported for open circuit" VALUE 0x70E6C TKW_VV_VV_UW 100.0 FORMULA_0010 0.0 65535.0000 /end CHARACTERISTIC
/begin CHARACTERISTIC K_ED_DK_INIT.P_CODE_OPENLOAD "P-Code fuer die Art OPENLOAD | EN: Fault code DK_INIT - OBD P-code reported for open circuit" VALUE 0x70F3C TKW_VV_VV_UW 100.0 FORMULA_0010 0.0 65535.0000 /end CHARACTERISTIC
/begin CHARACTERISTIC K_ED_DK1_REGLER.P_CODE_OPENLOAD "P-Code fuer die Art OPENLOAD | EN: Fault code DK1_REGLER - OBD P-code reported for open circuit" VALUE 0x70F56 TKW_VV_VV_UW 100.0 FORMULA_0010 0.0 65535.0000 /end CHARACTERISTIC
/begin CHARACTERISTIC K_ED_DK2_REGLER.P_CODE_OPENLOAD "P-Code fuer die Art OPENLOAD | EN: Fault code DK2_REGLER - OBD P-code reported for open circuit" VALUE 0x70F70 TKW_VV_VV_UW 100.0 FORMULA_0010 0.0 65535.0000 /end CHARACTERISTIC
/begin CHARACTERISTIC K_ED_DK1_ADAPT.P_CODE_OPENLOAD "P-Code fuer die Art OPENLOAD | EN: Fault code DK1_ADAPT - OBD P-code reported for open circuit" VALUE 0x70F8A TKW_VV_VV_UW 100.0 FORMULA_0010 0.0 65535.0000 /end CHARACTERISTIC
/begin CHARACTERISTIC K_ED_DK2_ADAPT.P_CODE_OPENLOAD "P-Code fuer die Art OPENLOAD | EN: Fault code DK2_ADAPT - OBD P-code reported for open circuit" VALUE 0x70FA4 TKW_VV_VV_UW 100.0 FORMULA_0010 0.0 65535.0000 /end CHARACTERISTIC
/begin CHARACTERISTIC K_ED_DK1_WDK.P_CODE_OPENLOAD "P-Code fuer die Art OPENLOAD | EN: Fault code DK1_WDK - OBD P-code reported for open circuit" VALUE 0x7105A TKW_VV_VV_UW 100.0 FORMULA_0010 0.0 65535.0000 /end CHARACTERISTIC
/begin CHARACTERISTIC K_ED_DK2_WDK.P_CODE_OPENLOAD "P-Code fuer die Art OPENLOAD | EN: Fault code DK2_WDK - OBD P-code reported for open circuit" VALUE 0x71074 TKW_VV_VV_UW 100.0 FORMULA_0010 0.0 65535.0000 /end CHARACTERISTIC
/begin CHARACTERISTIC K_ED_DK1_PDR.P_CODE_OPENLOAD "P-Code fuer die Art OPENLOAD | EN: Fault code DK1_PDR - OBD P-code reported for open circuit" VALUE 0x7108E TKW_VV_VV_UW 100.0 FORMULA_0010 0.0 65535.0000 /end CHARACTERISTIC
/begin CHARACTERISTIC K_ED_DK2_PDR.P_CODE_OPENLOAD "P-Code fuer die Art OPENLOAD | EN: Fault code DK2_PDR - OBD P-code reported for open circuit" VALUE 0x710A8 TKW_VV_VV_UW 100.0 FORMULA_0010 0.0 65535.0000 /end CHARACTERISTIC
/begin CHARACTERISTIC K_ED_DK1_SK_ERR.P_CODE_OPENLOAD "P-Code fuer die Art OPENLOAD | EN: Fault code DK1_SK_ERR - OBD P-code reported for open circuit" VALUE 0x710F6 TKW_VV_VV_UW 100.0 FORMULA_0010 0.0 65535.0000 /end CHARACTERISTIC
/begin CHARACTERISTIC K_ED_DK2_SK_ERR.P_CODE_OPENLOAD "P-Code fuer die Art OPENLOAD | EN: Fault code DK2_SK_ERR - OBD P-code reported for open circuit" VALUE 0x71110 TKW_VV_VV_UW 100.0 FORMULA_0010 0.0 65535.0000 /end CHARACTERISTIC
/begin CHARACTERISTIC K_ED_DK1_FEDERN.P_CODE_OPENLOAD "P-Code fuer die Art OPENLOAD | EN: Fault code DK1_FEDERN - OBD P-code reported for open circuit" VALUE 0x7112A TKW_VV_VV_UW 100.0 FORMULA_0010 0.0 65535.0000 /end CHARACTERISTIC
/begin CHARACTERISTIC K_ED_DK2_FEDERN.P_CODE_OPENLOAD "P-Code fuer die Art OPENLOAD | EN: Fault code DK2_FEDERN - OBD P-code reported for open circuit" VALUE 0x71144 TKW_VV_VV_UW 100.0 FORMULA_0010 0.0 65535.0000 /end CHARACTERISTIC
/begin CHARACTERISTIC K_ED_DSC_EINGR.P_CODE_OPENLOAD "P-Code fuer die Art OPENLOAD | EN: Fault code DSC_EINGR - OBD P-code reported for open circuit" VALUE 0x71192 TKW_VV_VV_UW 100.0 FORMULA_0010 0.0 65535.0000 /end CHARACTERISTIC
/begin CHARACTERISTIC K_ED_DK1_CMD.P_CODE_OPENLOAD "P-Code fuer die Art OPENLOAD | EN: Fault code DK1_CMD - OBD P-code reported for open circuit" VALUE 0x711AC TKW_VV_VV_UW 100.0 FORMULA_0010 0.0 65535.0000 /end CHARACTERISTIC
/begin CHARACTERISTIC K_ED_DK2_CMD.P_CODE_OPENLOAD "P-Code fuer die Art OPENLOAD | EN: Fault code DK2_CMD - OBD P-code reported for open circuit" VALUE 0x711C6 TKW_VV_VV_UW 100.0 FORMULA_0010 0.0 65535.0000 /end CHARACTERISTIC
/begin CHARACTERISTIC K_ED_EC_BUSOFF.P_CODE_OPENLOAD "P-Code fuer die Art OPENLOAD | EN: Fault code EC_BUSOFF - OBD P-code reported for open circuit" VALUE 0x7127C TKW_VV_VV_UW 100.0 FORMULA_0010 0.0 65535.0000 /end CHARACTERISTIC
/begin CHARACTERISTIC K_ED_AUSS_KAT_Z1.P_CODE_OPENLOAD "P-Code fuer die Art OPENLOAD | EN: Fault code AUSS_KAT_Z1 - OBD P-code reported for open circuit" VALUE 0x71296 TKW_VV_VV_UW 100.0 FORMULA_0010 0.0 65535.0000 /end CHARACTERISTIC
/begin CHARACTERISTIC K_ED_AUSS_KAT_Z2.P_CODE_OPENLOAD "P-Code fuer die Art OPENLOAD | EN: Fault code AUSS_KAT_Z2 - OBD P-code reported for open circuit" VALUE 0x712B0 TKW_VV_VV_UW 100.0 FORMULA_0010 0.0 65535.0000 /end CHARACTERISTIC
/begin CHARACTERISTIC K_ED_AUSS_KAT_Z3.P_CODE_OPENLOAD "P-Code fuer die Art OPENLOAD | EN: Fault code AUSS_KAT_Z3 - OBD P-code reported for open circuit" VALUE 0x712CA TKW_VV_VV_UW 100.0 FORMULA_0010 0.0 65535.0000 /end CHARACTERISTIC
/begin CHARACTERISTIC K_ED_AUSS_KAT_Z4.P_CODE_OPENLOAD "P-Code fuer die Art OPENLOAD | EN: Fault code AUSS_KAT_Z4 - OBD P-code reported for open circuit" VALUE 0x712E4 TKW_VV_VV_UW 100.0 FORMULA_0010 0.0 65535.0000 /end CHARACTERISTIC
/begin CHARACTERISTIC K_ED_AUSS_KAT_Z5.P_CODE_OPENLOAD "P-Code fuer die Art OPENLOAD | EN: Fault code AUSS_KAT_Z5 - OBD P-code reported for open circuit" VALUE 0x712FE TKW_VV_VV_UW 100.0 FORMULA_0010 0.0 65535.0000 /end CHARACTERISTIC
/begin CHARACTERISTIC K_ED_AUSS_KAT_Z6.P_CODE_OPENLOAD "P-Code fuer die Art OPENLOAD | EN: Fault code AUSS_KAT_Z6 - OBD P-code reported for open circuit" VALUE 0x71318 TKW_VV_VV_UW 100.0 FORMULA_0010 0.0 65535.0000 /end CHARACTERISTIC
/begin CHARACTERISTIC K_ED_AUSS_KAT_Z7.P_CODE_OPENLOAD "P-Code fuer die Art OPENLOAD | EN: Fault code AUSS_KAT_Z7 - OBD P-code reported for open circuit" VALUE 0x71332 TKW_VV_VV_UW 100.0 FORMULA_0010 0.0 65535.0000 /end CHARACTERISTIC
/begin CHARACTERISTIC K_ED_AUSS_KAT_Z8.P_CODE_OPENLOAD "P-Code fuer die Art OPENLOAD | EN: Fault code AUSS_KAT_Z8 - OBD P-code reported for open circuit" VALUE 0x7134C TKW_VV_VV_UW 100.0 FORMULA_0010 0.0 65535.0000 /end CHARACTERISTIC
/begin CHARACTERISTIC K_ED_AUSS_KAT_Z9.P_CODE_OPENLOAD "P-Code fuer die Art OPENLOAD | EN: Fault code AUSS_KAT_Z9 - OBD P-code reported for open circuit" VALUE 0x71366 TKW_VV_VV_UW 100.0 FORMULA_0010 0.0 65535.0000 /end CHARACTERISTIC
/begin CHARACTERISTIC K_ED_AUSS_KAT_Z10.P_CODE_OPENLOAD "P-Code fuer die Art OPENLOAD | EN: Fault code AUSS_KAT_Z10 - OBD P-code reported for open circuit" VALUE 0x71380 TKW_VV_VV_UW 100.0 FORMULA_0010 0.0 65535.0000 /end CHARACTERISTIC
/begin CHARACTERISTIC K_ED_AUSS_KAT_MULT.P_CODE_OPENLOAD "P-Code fuer die Art OPENLOAD | EN: Fault code AUSS_KAT_MULT - OBD P-code reported for open circuit" VALUE 0x713CE TKW_VV_VV_UW 100.0 FORMULA_0010 0.0 65535.0000 /end CHARACTERISTIC
/begin CHARACTERISTIC K_ED_AUSS_ABG_Z1.P_CODE_OPENLOAD "P-Code fuer die Art OPENLOAD | EN: Fault code AUSS_ABG_Z1 - OBD P-code reported for open circuit" VALUE 0x713E8 TKW_VV_VV_UW 100.0 FORMULA_0010 0.0 65535.0000 /end CHARACTERISTIC
/begin CHARACTERISTIC K_ED_AUSS_ABG_Z2.P_CODE_OPENLOAD "P-Code fuer die Art OPENLOAD | EN: Fault code AUSS_ABG_Z2 - OBD P-code reported for open circuit" VALUE 0x71402 TKW_VV_VV_UW 100.0 FORMULA_0010 0.0 65535.0000 /end CHARACTERISTIC
/begin CHARACTERISTIC K_ED_AUSS_ABG_Z3.P_CODE_OPENLOAD "P-Code fuer die Art OPENLOAD | EN: Fault code AUSS_ABG_Z3 - OBD P-code reported for open circuit" VALUE 0x7141C TKW_VV_VV_UW 100.0 FORMULA_0010 0.0 65535.0000 /end CHARACTERISTIC
/begin CHARACTERISTIC K_ED_AUSS_ABG_Z4.P_CODE_OPENLOAD "P-Code fuer die Art OPENLOAD | EN: Fault code AUSS_ABG_Z4 - OBD P-code reported for open circuit" VALUE 0x71436 TKW_VV_VV_UW 100.0 FORMULA_0010 0.0 65535.0000 /end CHARACTERISTIC
/begin CHARACTERISTIC K_ED_AUSS_ABG_Z5.P_CODE_OPENLOAD "P-Code fuer die Art OPENLOAD | EN: Fault code AUSS_ABG_Z5 - OBD P-code reported for open circuit" VALUE 0x71450 TKW_VV_VV_UW 100.0 FORMULA_0010 0.0 65535.0000 /end CHARACTERISTIC
/begin CHARACTERISTIC K_ED_AUSS_ABG_Z6.P_CODE_OPENLOAD "P-Code fuer die Art OPENLOAD | EN: Fault code AUSS_ABG_Z6 - OBD P-code reported for open circuit" VALUE 0x7146A TKW_VV_VV_UW 100.0 FORMULA_0010 0.0 65535.0000 /end CHARACTERISTIC
/begin CHARACTERISTIC K_ED_AUSS_ABG_Z7.P_CODE_OPENLOAD "P-Code fuer die Art OPENLOAD | EN: Fault code AUSS_ABG_Z7 - OBD P-code reported for open circuit" VALUE 0x71484 TKW_VV_VV_UW 100.0 FORMULA_0010 0.0 65535.0000 /end CHARACTERISTIC
/begin CHARACTERISTIC K_ED_AUSS_ABG_Z8.P_CODE_OPENLOAD "P-Code fuer die Art OPENLOAD | EN: Fault code AUSS_ABG_Z8 - OBD P-code reported for open circuit" VALUE 0x7149E TKW_VV_VV_UW 100.0 FORMULA_0010 0.0 65535.0000 /end CHARACTERISTIC
/begin CHARACTERISTIC K_ED_AUSS_ABG_Z9.P_CODE_OPENLOAD "P-Code fuer die Art OPENLOAD" VALUE 0x714B8 TKW_VV_VV_UW 100.0 FORMULA_0010 0.0 65535.0000 /end CHARACTERISTIC
/begin CHARACTERISTIC K_ED_AUSS_ABG_Z10.P_CODE_OPENLOAD "P-Code fuer die Art OPENLOAD" VALUE 0x714D2 TKW_VV_VV_UW 100.0 FORMULA_0010 0.0 65535.0000 /end CHARACTERISTIC
/begin CHARACTERISTIC K_ED_AUSS_ABG_MULT.P_CODE_OPENLOAD "P-Code fuer die Art OPENLOAD" VALUE 0x71520 TKW_VV_VV_UW 100.0 FORMULA_0010 0.0 65535.0000 /end CHARACTERISTIC
/begin CHARACTERISTIC K_ED_E2_IGN.P_CODE_OPENLOAD "P-Code fuer die Art OPENLOAD | EN: Fault code E2_IGN - OBD P-code reported for open circuit" VALUE 0x715D6 TKW_VV_VV_UW 100.0 FORMULA_0010 0.0 65535.0000 /end CHARACTERISTIC
/begin CHARACTERISTIC K_ED_BLS_PLAU.P_CODE_OPENLOAD "P-Code fuer die Art OPENLOAD | EN: Fault code BLS_PLAU - OBD P-code reported for open circuit" VALUE 0x715F0 TKW_VV_VV_UW 100.0 FORMULA_0010 0.0 65535.0000 /end CHARACTERISTIC
/begin CHARACTERISTIC K_ED_DK1_ZUST.P_CODE_OPENLOAD "P-Code fuer die Art OPENLOAD | EN: Fault code DK1_ZUST - OBD P-code reported for open circuit" VALUE 0x71672 TKW_VV_VV_UW 100.0 FORMULA_0010 0.0 65535.0000 /end CHARACTERISTIC
/begin CHARACTERISTIC K_ED_DK2_ZUST.P_CODE_OPENLOAD "P-Code fuer die Art OPENLOAD | EN: Fault code DK2_ZUST - OBD P-code reported for open circuit" VALUE 0x7168C TKW_VV_VV_UW 100.0 FORMULA_0010 0.0 65535.0000 /end CHARACTERISTIC
/begin CHARACTERISTIC K_ED_FGR_ABWURF.P_CODE_OPENLOAD "P-Code fuer die Art OPENLOAD | EN: Fault code FGR_ABWURF - OBD P-code reported for open circuit" VALUE 0x716A6 TKW_VV_VV_UW 100.0 FORMULA_0010 0.0 65535.0000 /end CHARACTERISTIC
/begin CHARACTERISTIC K_ED_AFZ_HS.P_CODE_OPENLOAD "P-Code fuer die Art OPENLOAD | EN: Fault code AFZ_HS - OBD P-code reported for open circuit" VALUE 0x716F4 TKW_VV_VV_UW 100.0 FORMULA_0010 0.0 65535.0000 /end CHARACTERISTIC
/begin CHARACTERISTIC K_ED_AFZ_HS_NA.P_CODE_OPENLOAD "P-Code fuer die Art OPENLOAD" VALUE 0x71776 TKW_VV_VV_UW 100.0 FORMULA_0010 0.0 65535.0000 /end CHARACTERISTIC
/begin CHARACTERISTIC K_ED_INDEX_110_IGN.P_CODE_OPENLOAD "P-Code fuer die Art OPENLOAD" VALUE 0x71790 TKW_VV_VV_UW 100.0 FORMULA_0010 0.0 65535.0000 /end CHARACTERISTIC
/begin CHARACTERISTIC K_ED_INDEX_111_IGN.P_CODE_OPENLOAD "P-Code fuer die Art OPENLOAD" VALUE 0x717AA TKW_VV_VV_UW 100.0 FORMULA_0010 0.0 65535.0000 /end CHARACTERISTIC
/begin CHARACTERISTIC K_ED_INDEX_112_IGN.P_CODE_OPENLOAD "P-Code fuer die Art OPENLOAD" VALUE 0x717C4 TKW_VV_VV_UW 100.0 FORMULA_0010 0.0 65535.0000 /end CHARACTERISTIC
/begin CHARACTERISTIC K_ED_INDEX_113_IGN.P_CODE_OPENLOAD "P-Code fuer die Art OPENLOAD" VALUE 0x717DE TKW_VV_VV_UW 100.0 FORMULA_0010 0.0 65535.0000 /end CHARACTERISTIC
/begin CHARACTERISTIC K_ED_INDEX_114_IGN.P_CODE_OPENLOAD "P-Code fuer die Art OPENLOAD" VALUE 0x717F8 TKW_VV_VV_UW 100.0 FORMULA_0010 0.0 65535.0000 /end CHARACTERISTIC
/begin CHARACTERISTIC K_ED_INDEX_115_IGN.P_CODE_OPENLOAD "P-Code fuer die Art OPENLOAD" VALUE 0x71812 TKW_VV_VV_UW 100.0 FORMULA_0010 0.0 65535.0000 /end CHARACTERISTIC
/begin CHARACTERISTIC K_ED_INDEX_116_IGN.P_CODE_OPENLOAD "P-Code fuer die Art OPENLOAD" VALUE 0x7182C TKW_VV_VV_UW 100.0 FORMULA_0010 0.0 65535.0000 /end CHARACTERISTIC
/begin CHARACTERISTIC K_ED_INDEX_117_IGN.P_CODE_OPENLOAD "P-Code fuer die Art OPENLOAD" VALUE 0x71846 TKW_VV_VV_UW 100.0 FORMULA_0010 0.0 65535.0000 /end CHARACTERISTIC
/begin CHARACTERISTIC K_ED_INDEX_118_IGN.P_CODE_OPENLOAD "P-Code fuer die Art OPENLOAD" VALUE 0x71860 TKW_VV_VV_UW 100.0 FORMULA_0010 0.0 65535.0000 /end CHARACTERISTIC
/begin CHARACTERISTIC K_ED_INDEX_119_IGN.P_CODE_OPENLOAD "P-Code fuer die Art OPENLOAD" VALUE 0x7187A TKW_VV_VV_UW 100.0 FORMULA_0010 0.0 65535.0000 /end CHARACTERISTIC
/begin CHARACTERISTIC K_ED_INDEX_120_IGN.P_CODE_OPENLOAD "P-Code fuer die Art OPENLOAD" VALUE 0x71894 TKW_VV_VV_UW 100.0 FORMULA_0010 0.0 65535.0000 /end CHARACTERISTIC
/begin CHARACTERISTIC K_ED_APPL_DATA_IGN.P_CODE_UNPLAUSIBEL "P-Code fuer die Art UNPLAUSIBEL | EN: Fault code APPL_DATA_IGN - OBD P-code reported for implausible signal" VALUE 0x70D84 TKW_VV_VV_UW 100.0 FORMULA_0010 0.0 65535.0000 /end CHARACTERISTIC
/begin CHARACTERISTIC K_ED_DK1_CAN.P_CODE_UNPLAUSIBEL "P-Code fuer die Art UNPLAUSIBEL | EN: Fault code DK1_CAN - OBD P-code reported for implausible signal" VALUE 0x70E54 TKW_VV_VV_UW 100.0 FORMULA_0010 0.0 65535.0000 /end CHARACTERISTIC
/begin CHARACTERISTIC K_ED_DK2_CAN.P_CODE_UNPLAUSIBEL "P-Code fuer die Art UNPLAUSIBEL | EN: Fault code DK2_CAN - OBD P-code reported for implausible signal" VALUE 0x70E6E TKW_VV_VV_UW 100.0 FORMULA_0010 0.0 65535.0000 /end CHARACTERISTIC
/begin CHARACTERISTIC K_ED_DK_INIT.P_CODE_UNPLAUSIBEL "P-Code fuer die Art UNPLAUSIBEL | EN: Fault code DK_INIT - OBD P-code reported for implausible signal" VALUE 0x70F3E TKW_VV_VV_UW 100.0 FORMULA_0010 0.0 65535.0000 /end CHARACTERISTIC
/begin CHARACTERISTIC K_ED_DK1_REGLER.P_CODE_UNPLAUSIBEL "P-Code fuer die Art UNPLAUSIBEL | EN: Fault code DK1_REGLER - OBD P-code reported for implausible signal" VALUE 0x70F58 TKW_VV_VV_UW 100.0 FORMULA_0010 0.0 65535.0000 /end CHARACTERISTIC
/begin CHARACTERISTIC K_ED_DK2_REGLER.P_CODE_UNPLAUSIBEL "P-Code fuer die Art UNPLAUSIBEL | EN: Fault code DK2_REGLER - OBD P-code reported for implausible signal" VALUE 0x70F72 TKW_VV_VV_UW 100.0 FORMULA_0010 0.0 65535.0000 /end CHARACTERISTIC
/begin CHARACTERISTIC K_ED_DK1_ADAPT.P_CODE_UNPLAUSIBEL "P-Code fuer die Art UNPLAUSIBEL | EN: Fault code DK1_ADAPT - OBD P-code reported for implausible signal" VALUE 0x70F8C TKW_VV_VV_UW 100.0 FORMULA_0010 0.0 65535.0000 /end CHARACTERISTIC
/begin CHARACTERISTIC K_ED_DK2_ADAPT.P_CODE_UNPLAUSIBEL "P-Code fuer die Art UNPLAUSIBEL | EN: Fault code DK2_ADAPT - OBD P-code reported for implausible signal" VALUE 0x70FA6 TKW_VV_VV_UW 100.0 FORMULA_0010 0.0 65535.0000 /end CHARACTERISTIC
/begin CHARACTERISTIC K_ED_DK1_WDK.P_CODE_UNPLAUSIBEL "P-Code fuer die Art UNPLAUSIBEL | EN: Fault code DK1_WDK - OBD P-code reported for implausible signal" VALUE 0x7105C TKW_VV_VV_UW 100.0 FORMULA_0010 0.0 65535.0000 /end CHARACTERISTIC
/begin CHARACTERISTIC K_ED_DK2_WDK.P_CODE_UNPLAUSIBEL "P-Code fuer die Art UNPLAUSIBEL | EN: Fault code DK2_WDK - OBD P-code reported for implausible signal" VALUE 0x71076 TKW_VV_VV_UW 100.0 FORMULA_0010 0.0 65535.0000 /end CHARACTERISTIC
/begin CHARACTERISTIC K_ED_DK1_PDR.P_CODE_UNPLAUSIBEL "P-Code fuer die Art UNPLAUSIBEL | EN: Fault code DK1_PDR - OBD P-code reported for implausible signal" VALUE 0x71090 TKW_VV_VV_UW 100.0 FORMULA_0010 0.0 65535.0000 /end CHARACTERISTIC
/begin CHARACTERISTIC K_ED_DK2_PDR.P_CODE_UNPLAUSIBEL "P-Code fuer die Art UNPLAUSIBEL | EN: Fault code DK2_PDR - OBD P-code reported for implausible signal" VALUE 0x710AA TKW_VV_VV_UW 100.0 FORMULA_0010 0.0 65535.0000 /end CHARACTERISTIC
/begin CHARACTERISTIC K_ED_DK1_SK_ERR.P_CODE_UNPLAUSIBEL "P-Code fuer die Art UNPLAUSIBEL | EN: Fault code DK1_SK_ERR - OBD P-code reported for implausible signal" VALUE 0x710F8 TKW_VV_VV_UW 100.0 FORMULA_0010 0.0 65535.0000 /end CHARACTERISTIC
/begin CHARACTERISTIC K_ED_DK2_SK_ERR.P_CODE_UNPLAUSIBEL "P-Code fuer die Art UNPLAUSIBEL | EN: Fault code DK2_SK_ERR - OBD P-code reported for implausible signal" VALUE 0x71112 TKW_VV_VV_UW 100.0 FORMULA_0010 0.0 65535.0000 /end CHARACTERISTIC
/begin CHARACTERISTIC K_ED_DK1_FEDERN.P_CODE_UNPLAUSIBEL "P-Code fuer die Art UNPLAUSIBEL | EN: Fault code DK1_FEDERN - OBD P-code reported for implausible signal" VALUE 0x7112C TKW_VV_VV_UW 100.0 FORMULA_0010 0.0 65535.0000 /end CHARACTERISTIC
/begin CHARACTERISTIC K_ED_DK2_FEDERN.P_CODE_UNPLAUSIBEL "P-Code fuer die Art UNPLAUSIBEL | EN: Fault code DK2_FEDERN - OBD P-code reported for implausible signal" VALUE 0x71146 TKW_VV_VV_UW 100.0 FORMULA_0010 0.0 65535.0000 /end CHARACTERISTIC
/begin CHARACTERISTIC K_ED_DSC_EINGR.P_CODE_UNPLAUSIBEL "P-Code fuer die Art UNPLAUSIBEL | EN: Fault code DSC_EINGR - OBD P-code reported for implausible signal" VALUE 0x71194 TKW_VV_VV_UW 100.0 FORMULA_0010 0.0 65535.0000 /end CHARACTERISTIC
/begin CHARACTERISTIC K_ED_DK1_CMD.P_CODE_UNPLAUSIBEL "P-Code fuer die Art UNPLAUSIBEL | EN: Fault code DK1_CMD - OBD P-code reported for implausible signal" VALUE 0x711AE TKW_VV_VV_UW 100.0 FORMULA_0010 0.0 65535.0000 /end CHARACTERISTIC
/begin CHARACTERISTIC K_ED_DK2_CMD.P_CODE_UNPLAUSIBEL "P-Code fuer die Art UNPLAUSIBEL | EN: Fault code DK2_CMD - OBD P-code reported for implausible signal" VALUE 0x711C8 TKW_VV_VV_UW 100.0 FORMULA_0010 0.0 65535.0000 /end CHARACTERISTIC
/begin CHARACTERISTIC K_ED_EC_BUSOFF.P_CODE_UNPLAUSIBEL "P-Code fuer die Art UNPLAUSIBEL | EN: Fault code EC_BUSOFF - OBD P-code reported for implausible signal" VALUE 0x7127E TKW_VV_VV_UW 100.0 FORMULA_0010 0.0 65535.0000 /end CHARACTERISTIC
/begin CHARACTERISTIC K_ED_AUSS_KAT_Z1.P_CODE_UNPLAUSIBEL "P-Code fuer die Art UNPLAUSIBEL | EN: Fault code AUSS_KAT_Z1 - OBD P-code reported for implausible signal" VALUE 0x71298 TKW_VV_VV_UW 100.0 FORMULA_0010 0.0 65535.0000 /end CHARACTERISTIC
/begin CHARACTERISTIC K_ED_AUSS_KAT_Z2.P_CODE_UNPLAUSIBEL "P-Code fuer die Art UNPLAUSIBEL | EN: Fault code AUSS_KAT_Z2 - OBD P-code reported for implausible signal" VALUE 0x712B2 TKW_VV_VV_UW 100.0 FORMULA_0010 0.0 65535.0000 /end CHARACTERISTIC
/begin CHARACTERISTIC K_ED_AUSS_KAT_Z3.P_CODE_UNPLAUSIBEL "P-Code fuer die Art UNPLAUSIBEL | EN: Fault code AUSS_KAT_Z3 - OBD P-code reported for implausible signal" VALUE 0x712CC TKW_VV_VV_UW 100.0 FORMULA_0010 0.0 65535.0000 /end CHARACTERISTIC
/begin CHARACTERISTIC K_ED_AUSS_KAT_Z4.P_CODE_UNPLAUSIBEL "P-Code fuer die Art UNPLAUSIBEL | EN: Fault code AUSS_KAT_Z4 - OBD P-code reported for implausible signal" VALUE 0x712E6 TKW_VV_VV_UW 100.0 FORMULA_0010 0.0 65535.0000 /end CHARACTERISTIC
/begin CHARACTERISTIC K_ED_AUSS_KAT_Z5.P_CODE_UNPLAUSIBEL "P-Code fuer die Art UNPLAUSIBEL | EN: Fault code AUSS_KAT_Z5 - OBD P-code reported for implausible signal" VALUE 0x71300 TKW_VV_VV_UW 100.0 FORMULA_0010 0.0 65535.0000 /end CHARACTERISTIC
/begin CHARACTERISTIC K_ED_AUSS_KAT_Z6.P_CODE_UNPLAUSIBEL "P-Code fuer die Art UNPLAUSIBEL | EN: Fault code AUSS_KAT_Z6 - OBD P-code reported for implausible signal" VALUE 0x7131A TKW_VV_VV_UW 100.0 FORMULA_0010 0.0 65535.0000 /end CHARACTERISTIC
/begin CHARACTERISTIC K_ED_AUSS_KAT_Z7.P_CODE_UNPLAUSIBEL "P-Code fuer die Art UNPLAUSIBEL | EN: Fault code AUSS_KAT_Z7 - OBD P-code reported for implausible signal" VALUE 0x71334 TKW_VV_VV_UW 100.0 FORMULA_0010 0.0 65535.0000 /end CHARACTERISTIC
/begin CHARACTERISTIC K_ED_AUSS_KAT_Z8.P_CODE_UNPLAUSIBEL "P-Code fuer die Art UNPLAUSIBEL | EN: Fault code AUSS_KAT_Z8 - OBD P-code reported for implausible signal" VALUE 0x7134E TKW_VV_VV_UW 100.0 FORMULA_0010 0.0 65535.0000 /end CHARACTERISTIC
/begin CHARACTERISTIC K_ED_AUSS_KAT_Z9.P_CODE_UNPLAUSIBEL "P-Code fuer die Art UNPLAUSIBEL | EN: Fault code AUSS_KAT_Z9 - OBD P-code reported for implausible signal" VALUE 0x71368 TKW_VV_VV_UW 100.0 FORMULA_0010 0.0 65535.0000 /end CHARACTERISTIC
/begin CHARACTERISTIC K_ED_AUSS_KAT_Z10.P_CODE_UNPLAUSIBEL "P-Code fuer die Art UNPLAUSIBEL | EN: Fault code AUSS_KAT_Z10 - OBD P-code reported for implausible signal" VALUE 0x71382 TKW_VV_VV_UW 100.0 FORMULA_0010 0.0 65535.0000 /end CHARACTERISTIC
/begin CHARACTERISTIC K_ED_AUSS_KAT_MULT.P_CODE_UNPLAUSIBEL "P-Code fuer die Art UNPLAUSIBEL | EN: Fault code AUSS_KAT_MULT - OBD P-code reported for implausible signal" VALUE 0x713D0 TKW_VV_VV_UW 100.0 FORMULA_0010 0.0 65535.0000 /end CHARACTERISTIC
/begin CHARACTERISTIC K_ED_AUSS_ABG_Z1.P_CODE_UNPLAUSIBEL "P-Code fuer die Art UNPLAUSIBEL | EN: Fault code AUSS_ABG_Z1 - OBD P-code reported for implausible signal" VALUE 0x713EA TKW_VV_VV_UW 100.0 FORMULA_0010 0.0 65535.0000 /end CHARACTERISTIC
/begin CHARACTERISTIC K_ED_AUSS_ABG_Z2.P_CODE_UNPLAUSIBEL "P-Code fuer die Art UNPLAUSIBEL | EN: Fault code AUSS_ABG_Z2 - OBD P-code reported for implausible signal" VALUE 0x71404 TKW_VV_VV_UW 100.0 FORMULA_0010 0.0 65535.0000 /end CHARACTERISTIC
/begin CHARACTERISTIC K_ED_AUSS_ABG_Z3.P_CODE_UNPLAUSIBEL "P-Code fuer die Art UNPLAUSIBEL | EN: Fault code AUSS_ABG_Z3 - OBD P-code reported for implausible signal" VALUE 0x7141E TKW_VV_VV_UW 100.0 FORMULA_0010 0.0 65535.0000 /end CHARACTERISTIC
/begin CHARACTERISTIC K_ED_AUSS_ABG_Z4.P_CODE_UNPLAUSIBEL "P-Code fuer die Art UNPLAUSIBEL | EN: Fault code AUSS_ABG_Z4 - OBD P-code reported for implausible signal" VALUE 0x71438 TKW_VV_VV_UW 100.0 FORMULA_0010 0.0 65535.0000 /end CHARACTERISTIC
/begin CHARACTERISTIC K_ED_AUSS_ABG_Z5.P_CODE_UNPLAUSIBEL "P-Code fuer die Art UNPLAUSIBEL | EN: Fault code AUSS_ABG_Z5 - OBD P-code reported for implausible signal" VALUE 0x71452 TKW_VV_VV_UW 100.0 FORMULA_0010 0.0 65535.0000 /end CHARACTERISTIC
/begin CHARACTERISTIC K_ED_AUSS_ABG_Z6.P_CODE_UNPLAUSIBEL "P-Code fuer die Art UNPLAUSIBEL | EN: Fault code AUSS_ABG_Z6 - OBD P-code reported for implausible signal" VALUE 0x7146C TKW_VV_VV_UW 100.0 FORMULA_0010 0.0 65535.0000 /end CHARACTERISTIC
/begin CHARACTERISTIC K_ED_AUSS_ABG_Z7.P_CODE_UNPLAUSIBEL "P-Code fuer die Art UNPLAUSIBEL | EN: Fault code AUSS_ABG_Z7 - OBD P-code reported for implausible signal" VALUE 0x71486 TKW_VV_VV_UW 100.0 FORMULA_0010 0.0 65535.0000 /end CHARACTERISTIC
/begin CHARACTERISTIC K_ED_AUSS_ABG_Z8.P_CODE_UNPLAUSIBEL "P-Code fuer die Art UNPLAUSIBEL | EN: Fault code AUSS_ABG_Z8 - OBD P-code reported for implausible signal" VALUE 0x714A0 TKW_VV_VV_UW 100.0 FORMULA_0010 0.0 65535.0000 /end CHARACTERISTIC
/begin CHARACTERISTIC K_ED_AUSS_ABG_Z9.P_CODE_UNPLAUSIBEL "P-Code fuer die Art UNPLAUSIBEL" VALUE 0x714BA TKW_VV_VV_UW 100.0 FORMULA_0010 0.0 65535.0000 /end CHARACTERISTIC
/begin CHARACTERISTIC K_ED_AUSS_ABG_Z10.P_CODE_UNPLAUSIBEL "P-Code fuer die Art UNPLAUSIBEL" VALUE 0x714D4 TKW_VV_VV_UW 100.0 FORMULA_0010 0.0 65535.0000 /end CHARACTERISTIC
/begin CHARACTERISTIC K_ED_AUSS_ABG_MULT.P_CODE_UNPLAUSIBEL "P-Code fuer die Art UNPLAUSIBEL" VALUE 0x71522 TKW_VV_VV_UW 100.0 FORMULA_0010 0.0 65535.0000 /end CHARACTERISTIC
/begin CHARACTERISTIC K_ED_E2_IGN.P_CODE_UNPLAUSIBEL "P-Code fuer die Art UNPLAUSIBEL | EN: Fault code E2_IGN - OBD P-code reported for implausible signal" VALUE 0x715D8 TKW_VV_VV_UW 100.0 FORMULA_0010 0.0 65535.0000 /end CHARACTERISTIC
/begin CHARACTERISTIC K_ED_BLS_PLAU.P_CODE_UNPLAUSIBEL "P-Code fuer die Art UNPLAUSIBEL | EN: Fault code BLS_PLAU - OBD P-code reported for implausible signal" VALUE 0x715F2 TKW_VV_VV_UW 100.0 FORMULA_0010 0.0 65535.0000 /end CHARACTERISTIC
/begin CHARACTERISTIC K_ED_DK1_ZUST.P_CODE_UNPLAUSIBEL "P-Code fuer die Art UNPLAUSIBEL | EN: Fault code DK1_ZUST - OBD P-code reported for implausible signal" VALUE 0x71674 TKW_VV_VV_UW 100.0 FORMULA_0010 0.0 65535.0000 /end CHARACTERISTIC
/begin CHARACTERISTIC K_ED_DK2_ZUST.P_CODE_UNPLAUSIBEL "P-Code fuer die Art UNPLAUSIBEL | EN: Fault code DK2_ZUST - OBD P-code reported for implausible signal" VALUE 0x7168E TKW_VV_VV_UW 100.0 FORMULA_0010 0.0 65535.0000 /end CHARACTERISTIC
/begin CHARACTERISTIC K_ED_FGR_ABWURF.P_CODE_UNPLAUSIBEL "P-Code fuer die Art UNPLAUSIBEL | EN: Fault code FGR_ABWURF - OBD P-code reported for implausible signal" VALUE 0x716A8 TKW_VV_VV_UW 100.0 FORMULA_0010 0.0 65535.0000 /end CHARACTERISTIC
/begin CHARACTERISTIC K_ED_AFZ_HS.P_CODE_UNPLAUSIBEL "P-Code fuer die Art UNPLAUSIBEL | EN: Fault code AFZ_HS - OBD P-code reported for implausible signal" VALUE 0x716F6 TKW_VV_VV_UW 100.0 FORMULA_0010 0.0 65535.0000 /end CHARACTERISTIC
/begin CHARACTERISTIC K_ED_AFZ_HS_NA.P_CODE_UNPLAUSIBEL "P-Code fuer die Art UNPLAUSIBEL" VALUE 0x71778 TKW_VV_VV_UW 100.0 FORMULA_0010 0.0 65535.0000 /end CHARACTERISTIC
/begin CHARACTERISTIC K_ED_INDEX_110_IGN.P_CODE_UNPLAUSIBEL "P-Code fuer die Art UNPLAUSIBEL" VALUE 0x71792 TKW_VV_VV_UW 100.0 FORMULA_0010 0.0 65535.0000 /end CHARACTERISTIC
/begin CHARACTERISTIC K_ED_INDEX_111_IGN.P_CODE_UNPLAUSIBEL "P-Code fuer die Art UNPLAUSIBEL" VALUE 0x717AC TKW_VV_VV_UW 100.0 FORMULA_0010 0.0 65535.0000 /end CHARACTERISTIC
/begin CHARACTERISTIC K_ED_INDEX_112_IGN.P_CODE_UNPLAUSIBEL "P-Code fuer die Art UNPLAUSIBEL" VALUE 0x717C6 TKW_VV_VV_UW 100.0 FORMULA_0010 0.0 65535.0000 /end CHARACTERISTIC
/begin CHARACTERISTIC K_ED_INDEX_113_IGN.P_CODE_UNPLAUSIBEL "P-Code fuer die Art UNPLAUSIBEL" VALUE 0x717E0 TKW_VV_VV_UW 100.0 FORMULA_0010 0.0 65535.0000 /end CHARACTERISTIC
/begin CHARACTERISTIC K_ED_INDEX_114_IGN.P_CODE_UNPLAUSIBEL "P-Code fuer die Art UNPLAUSIBEL" VALUE 0x717FA TKW_VV_VV_UW 100.0 FORMULA_0010 0.0 65535.0000 /end CHARACTERISTIC
/begin CHARACTERISTIC K_ED_INDEX_115_IGN.P_CODE_UNPLAUSIBEL "P-Code fuer die Art UNPLAUSIBEL" VALUE 0x71814 TKW_VV_VV_UW 100.0 FORMULA_0010 0.0 65535.0000 /end CHARACTERISTIC
/begin CHARACTERISTIC K_ED_INDEX_116_IGN.P_CODE_UNPLAUSIBEL "P-Code fuer die Art UNPLAUSIBEL" VALUE 0x7182E TKW_VV_VV_UW 100.0 FORMULA_0010 0.0 65535.0000 /end CHARACTERISTIC
/begin CHARACTERISTIC K_ED_INDEX_117_IGN.P_CODE_UNPLAUSIBEL "P-Code fuer die Art UNPLAUSIBEL" VALUE 0x71848 TKW_VV_VV_UW 100.0 FORMULA_0010 0.0 65535.0000 /end CHARACTERISTIC
/begin CHARACTERISTIC K_ED_INDEX_118_IGN.P_CODE_UNPLAUSIBEL "P-Code fuer die Art UNPLAUSIBEL" VALUE 0x71862 TKW_VV_VV_UW 100.0 FORMULA_0010 0.0 65535.0000 /end CHARACTERISTIC
/begin CHARACTERISTIC K_ED_INDEX_119_IGN.P_CODE_UNPLAUSIBEL "P-Code fuer die Art UNPLAUSIBEL" VALUE 0x7187C TKW_VV_VV_UW 100.0 FORMULA_0010 0.0 65535.0000 /end CHARACTERISTIC
/begin CHARACTERISTIC K_ED_INDEX_120_IGN.P_CODE_UNPLAUSIBEL "P-Code fuer die Art UNPLAUSIBEL" VALUE 0x71896 TKW_VV_VV_UW 100.0 FORMULA_0010 0.0 65535.0000 /end CHARACTERISTIC
/begin CHARACTERISTIC K_ED_APPL_DATA_IGN.FEHLERSCHWELLE "Filterschwelle fuer Fehlereintrag | EN: Fault code APPL_DATA_IGN - debounce filter threshold for setting the fault" VALUE 0x70D86 TKW_VV_VV_UB 100.0 FORMULA_0003 0.0 255.0000 /end CHARACTERISTIC
/begin CHARACTERISTIC K_ED_DK1_CAN.FEHLERSCHWELLE "Filterschwelle fuer Fehlereintrag | EN: Fault code DK1_CAN - debounce filter threshold for setting the fault" VALUE 0x70E56 TKW_VV_VV_UB 100.0 FORMULA_0003 0.0 255.0000 /end CHARACTERISTIC
/begin CHARACTERISTIC K_ED_DK2_CAN.FEHLERSCHWELLE "Filterschwelle fuer Fehlereintrag | EN: Fault code DK2_CAN - debounce filter threshold for setting the fault" VALUE 0x70E70 TKW_VV_VV_UB 100.0 FORMULA_0003 0.0 255.0000 /end CHARACTERISTIC
/begin CHARACTERISTIC K_ED_DK_INIT.FEHLERSCHWELLE "Filterschwelle fuer Fehlereintrag | EN: Fault code DK_INIT - debounce filter threshold for setting the fault" VALUE 0x70F40 TKW_VV_VV_UB 100.0 FORMULA_0003 0.0 255.0000 /end CHARACTERISTIC
/begin CHARACTERISTIC K_ED_DK1_REGLER.FEHLERSCHWELLE "Filterschwelle fuer Fehlereintrag | EN: Fault code DK1_REGLER - debounce filter threshold for setting the fault" VALUE 0x70F5A TKW_VV_VV_UB 100.0 FORMULA_0003 0.0 255.0000 /end CHARACTERISTIC
/begin CHARACTERISTIC K_ED_DK2_REGLER.FEHLERSCHWELLE "Filterschwelle fuer Fehlereintrag | EN: Fault code DK2_REGLER - debounce filter threshold for setting the fault" VALUE 0x70F74 TKW_VV_VV_UB 100.0 FORMULA_0003 0.0 255.0000 /end CHARACTERISTIC
/begin CHARACTERISTIC K_ED_DK1_ADAPT.FEHLERSCHWELLE "Filterschwelle fuer Fehlereintrag | EN: Fault code DK1_ADAPT - debounce filter threshold for setting the fault" VALUE 0x70F8E TKW_VV_VV_UB 100.0 FORMULA_0003 0.0 255.0000 /end CHARACTERISTIC
/begin CHARACTERISTIC K_ED_DK2_ADAPT.FEHLERSCHWELLE "Filterschwelle fuer Fehlereintrag | EN: Fault code DK2_ADAPT - debounce filter threshold for setting the fault" VALUE 0x70FA8 TKW_VV_VV_UB 100.0 FORMULA_0003 0.0 255.0000 /end CHARACTERISTIC
/begin CHARACTERISTIC K_ED_DK1_WDK.FEHLERSCHWELLE "Filterschwelle fuer Fehlereintrag | EN: Fault code DK1_WDK - debounce filter threshold for setting the fault" VALUE 0x7105E TKW_VV_VV_UB 100.0 FORMULA_0003 0.0 255.0000 /end CHARACTERISTIC
/begin CHARACTERISTIC K_ED_DK2_WDK.FEHLERSCHWELLE "Filterschwelle fuer Fehlereintrag | EN: Fault code DK2_WDK - debounce filter threshold for setting the fault" VALUE 0x71078 TKW_VV_VV_UB 100.0 FORMULA_0003 0.0 255.0000 /end CHARACTERISTIC
/begin CHARACTERISTIC K_ED_DK1_PDR.FEHLERSCHWELLE "Filterschwelle fuer Fehlereintrag | EN: Fault code DK1_PDR - debounce filter threshold for setting the fault" VALUE 0x71092 TKW_VV_VV_UB 100.0 FORMULA_0003 0.0 255.0000 /end CHARACTERISTIC
/begin CHARACTERISTIC K_ED_DK2_PDR.FEHLERSCHWELLE "Filterschwelle fuer Fehlereintrag | EN: Fault code DK2_PDR - debounce filter threshold for setting the fault" VALUE 0x710AC TKW_VV_VV_UB 100.0 FORMULA_0003 0.0 255.0000 /end CHARACTERISTIC
/begin CHARACTERISTIC K_ED_DK1_SK_ERR.FEHLERSCHWELLE "Filterschwelle fuer Fehlereintrag | EN: Fault code DK1_SK_ERR - debounce filter threshold for setting the fault" VALUE 0x710FA TKW_VV_VV_UB 100.0 FORMULA_0003 0.0 255.0000 /end CHARACTERISTIC
/begin CHARACTERISTIC K_ED_DK2_SK_ERR.FEHLERSCHWELLE "Filterschwelle fuer Fehlereintrag | EN: Fault code DK2_SK_ERR - debounce filter threshold for setting the fault" VALUE 0x71114 TKW_VV_VV_UB 100.0 FORMULA_0003 0.0 255.0000 /end CHARACTERISTIC
/begin CHARACTERISTIC K_ED_DK1_FEDERN.FEHLERSCHWELLE "Filterschwelle fuer Fehlereintrag | EN: Fault code DK1_FEDERN - debounce filter threshold for setting the fault" VALUE 0x7112E TKW_VV_VV_UB 100.0 FORMULA_0003 0.0 255.0000 /end CHARACTERISTIC
/begin CHARACTERISTIC K_ED_DK2_FEDERN.FEHLERSCHWELLE "Filterschwelle fuer Fehlereintrag | EN: Fault code DK2_FEDERN - debounce filter threshold for setting the fault" VALUE 0x71148 TKW_VV_VV_UB 100.0 FORMULA_0003 0.0 255.0000 /end CHARACTERISTIC
/begin CHARACTERISTIC K_ED_DSC_EINGR.FEHLERSCHWELLE "Filterschwelle fuer Fehlereintrag | EN: Fault code DSC_EINGR - debounce filter threshold for setting the fault" VALUE 0x71196 TKW_VV_VV_UB 100.0 FORMULA_0003 0.0 255.0000 /end CHARACTERISTIC
/begin CHARACTERISTIC K_ED_DK1_CMD.FEHLERSCHWELLE "Filterschwelle fuer Fehlereintrag | EN: Fault code DK1_CMD - debounce filter threshold for setting the fault" VALUE 0x711B0 TKW_VV_VV_UB 100.0 FORMULA_0003 0.0 255.0000 /end CHARACTERISTIC
/begin CHARACTERISTIC K_ED_DK2_CMD.FEHLERSCHWELLE "Filterschwelle fuer Fehlereintrag | EN: Fault code DK2_CMD - debounce filter threshold for setting the fault" VALUE 0x711CA TKW_VV_VV_UB 100.0 FORMULA_0003 0.0 255.0000 /end CHARACTERISTIC
/begin CHARACTERISTIC K_ED_EC_BUSOFF.FEHLERSCHWELLE "Filterschwelle fuer Fehlereintrag | EN: Fault code EC_BUSOFF - debounce filter threshold for setting the fault" VALUE 0x71280 TKW_VV_VV_UB 100.0 FORMULA_0003 0.0 255.0000 /end CHARACTERISTIC
/begin CHARACTERISTIC K_ED_AUSS_KAT_Z1.FEHLERSCHWELLE "Filterschwelle fuer Fehlereintrag | EN: Fault code AUSS_KAT_Z1 - debounce filter threshold for setting the fault" VALUE 0x7129A TKW_VV_VV_UB 100.0 FORMULA_0003 0.0 255.0000 /end CHARACTERISTIC
/begin CHARACTERISTIC K_ED_AUSS_KAT_Z2.FEHLERSCHWELLE "Filterschwelle fuer Fehlereintrag | EN: Fault code AUSS_KAT_Z2 - debounce filter threshold for setting the fault" VALUE 0x712B4 TKW_VV_VV_UB 100.0 FORMULA_0003 0.0 255.0000 /end CHARACTERISTIC
/begin CHARACTERISTIC K_ED_AUSS_KAT_Z3.FEHLERSCHWELLE "Filterschwelle fuer Fehlereintrag | EN: Fault code AUSS_KAT_Z3 - debounce filter threshold for setting the fault" VALUE 0x712CE TKW_VV_VV_UB 100.0 FORMULA_0003 0.0 255.0000 /end CHARACTERISTIC
/begin CHARACTERISTIC K_ED_AUSS_KAT_Z4.FEHLERSCHWELLE "Filterschwelle fuer Fehlereintrag | EN: Fault code AUSS_KAT_Z4 - debounce filter threshold for setting the fault" VALUE 0x712E8 TKW_VV_VV_UB 100.0 FORMULA_0003 0.0 255.0000 /end CHARACTERISTIC
/begin CHARACTERISTIC K_ED_AUSS_KAT_Z5.FEHLERSCHWELLE "Filterschwelle fuer Fehlereintrag | EN: Fault code AUSS_KAT_Z5 - debounce filter threshold for setting the fault" VALUE 0x71302 TKW_VV_VV_UB 100.0 FORMULA_0003 0.0 255.0000 /end CHARACTERISTIC
/begin CHARACTERISTIC K_ED_AUSS_KAT_Z6.FEHLERSCHWELLE "Filterschwelle fuer Fehlereintrag | EN: Fault code AUSS_KAT_Z6 - debounce filter threshold for setting the fault" VALUE 0x7131C TKW_VV_VV_UB 100.0 FORMULA_0003 0.0 255.0000 /end CHARACTERISTIC
/begin CHARACTERISTIC K_ED_AUSS_KAT_Z7.FEHLERSCHWELLE "Filterschwelle fuer Fehlereintrag | EN: Fault code AUSS_KAT_Z7 - debounce filter threshold for setting the fault" VALUE 0x71336 TKW_VV_VV_UB 100.0 FORMULA_0003 0.0 255.0000 /end CHARACTERISTIC
/begin CHARACTERISTIC K_ED_AUSS_KAT_Z8.FEHLERSCHWELLE "Filterschwelle fuer Fehlereintrag | EN: Fault code AUSS_KAT_Z8 - debounce filter threshold for setting the fault" VALUE 0x71350 TKW_VV_VV_UB 100.0 FORMULA_0003 0.0 255.0000 /end CHARACTERISTIC
/begin CHARACTERISTIC K_ED_AUSS_KAT_Z9.FEHLERSCHWELLE "Filterschwelle fuer Fehlereintrag | EN: Fault code AUSS_KAT_Z9 - debounce filter threshold for setting the fault" VALUE 0x7136A TKW_VV_VV_UB 100.0 FORMULA_0003 0.0 255.0000 /end CHARACTERISTIC
/begin CHARACTERISTIC K_ED_AUSS_KAT_Z10.FEHLERSCHWELLE "Filterschwelle fuer Fehlereintrag | EN: Fault code AUSS_KAT_Z10 - debounce filter threshold for setting the fault" VALUE 0x71384 TKW_VV_VV_UB 100.0 FORMULA_0003 0.0 255.0000 /end CHARACTERISTIC
/begin CHARACTERISTIC K_ED_AUSS_KAT_MULT.FEHLERSCHWELLE "Filterschwelle fuer Fehlereintrag | EN: Fault code AUSS_KAT_MULT - debounce filter threshold for setting the fault" VALUE 0x713D2 TKW_VV_VV_UB 100.0 FORMULA_0003 0.0 255.0000 /end CHARACTERISTIC
/begin CHARACTERISTIC K_ED_AUSS_ABG_Z1.FEHLERSCHWELLE "Filterschwelle fuer Fehlereintrag | EN: Fault code AUSS_ABG_Z1 - debounce filter threshold for setting the fault" VALUE 0x713EC TKW_VV_VV_UB 100.0 FORMULA_0003 0.0 255.0000 /end CHARACTERISTIC
/begin CHARACTERISTIC K_ED_AUSS_ABG_Z2.FEHLERSCHWELLE "Filterschwelle fuer Fehlereintrag | EN: Fault code AUSS_ABG_Z2 - debounce filter threshold for setting the fault" VALUE 0x71406 TKW_VV_VV_UB 100.0 FORMULA_0003 0.0 255.0000 /end CHARACTERISTIC
/begin CHARACTERISTIC K_ED_AUSS_ABG_Z3.FEHLERSCHWELLE "Filterschwelle fuer Fehlereintrag | EN: Fault code AUSS_ABG_Z3 - debounce filter threshold for setting the fault" VALUE 0x71420 TKW_VV_VV_UB 100.0 FORMULA_0003 0.0 255.0000 /end CHARACTERISTIC
/begin CHARACTERISTIC K_ED_AUSS_ABG_Z4.FEHLERSCHWELLE "Filterschwelle fuer Fehlereintrag | EN: Fault code AUSS_ABG_Z4 - debounce filter threshold for setting the fault" VALUE 0x7143A TKW_VV_VV_UB 100.0 FORMULA_0003 0.0 255.0000 /end CHARACTERISTIC
/begin CHARACTERISTIC K_ED_AUSS_ABG_Z5.FEHLERSCHWELLE "Filterschwelle fuer Fehlereintrag | EN: Fault code AUSS_ABG_Z5 - debounce filter threshold for setting the fault" VALUE 0x71454 TKW_VV_VV_UB 100.0 FORMULA_0003 0.0 255.0000 /end CHARACTERISTIC
/begin CHARACTERISTIC K_ED_AUSS_ABG_Z6.FEHLERSCHWELLE "Filterschwelle fuer Fehlereintrag | EN: Fault code AUSS_ABG_Z6 - debounce filter threshold for setting the fault" VALUE 0x7146E TKW_VV_VV_UB 100.0 FORMULA_0003 0.0 255.0000 /end CHARACTERISTIC
/begin CHARACTERISTIC K_ED_AUSS_ABG_Z7.FEHLERSCHWELLE "Filterschwelle fuer Fehlereintrag | EN: Fault code AUSS_ABG_Z7 - debounce filter threshold for setting the fault" VALUE 0x71488 TKW_VV_VV_UB 100.0 FORMULA_0003 0.0 255.0000 /end CHARACTERISTIC
/begin CHARACTERISTIC K_ED_AUSS_ABG_Z8.FEHLERSCHWELLE "Filterschwelle fuer Fehlereintrag | EN: Fault code AUSS_ABG_Z8 - debounce filter threshold for setting the fault" VALUE 0x714A2 TKW_VV_VV_UB 100.0 FORMULA_0003 0.0 255.0000 /end CHARACTERISTIC
/begin CHARACTERISTIC K_ED_AUSS_ABG_Z9.FEHLERSCHWELLE "Filterschwelle fuer Fehlereintrag" VALUE 0x714BC TKW_VV_VV_UB 100.0 FORMULA_0003 0.0 255.0000 /end CHARACTERISTIC
/begin CHARACTERISTIC K_ED_AUSS_ABG_Z10.FEHLERSCHWELLE "Filterschwelle fuer Fehlereintrag" VALUE 0x714D6 TKW_VV_VV_UB 100.0 FORMULA_0003 0.0 255.0000 /end CHARACTERISTIC
/begin CHARACTERISTIC K_ED_AUSS_ABG_MULT.FEHLERSCHWELLE "Filterschwelle fuer Fehlereintrag | EN: Filterschwelle fuer Fehlereintrag" VALUE 0x71524 TKW_VV_VV_UB 100.0 FORMULA_0003 0.0 255.0000 /end CHARACTERISTIC
/begin CHARACTERISTIC K_ED_E2_IGN.FEHLERSCHWELLE "Filterschwelle fuer Fehlereintrag | EN: Fault code E2_IGN - debounce filter threshold for setting the fault" VALUE 0x715DA TKW_VV_VV_UB 100.0 FORMULA_0003 0.0 255.0000 /end CHARACTERISTIC
/begin CHARACTERISTIC K_ED_BLS_PLAU.FEHLERSCHWELLE "Filterschwelle fuer Fehlereintrag | EN: Fault code BLS_PLAU - debounce filter threshold for setting the fault" VALUE 0x715F4 TKW_VV_VV_UB 100.0 FORMULA_0003 0.0 255.0000 /end CHARACTERISTIC
/begin CHARACTERISTIC K_ED_DK1_ZUST.FEHLERSCHWELLE "Filterschwelle fuer Fehlereintrag | EN: Fault code DK1_ZUST - debounce filter threshold for setting the fault" VALUE 0x71676 TKW_VV_VV_UB 100.0 FORMULA_0003 0.0 255.0000 /end CHARACTERISTIC
/begin CHARACTERISTIC K_ED_DK2_ZUST.FEHLERSCHWELLE "Filterschwelle fuer Fehlereintrag | EN: Fault code DK2_ZUST - debounce filter threshold for setting the fault" VALUE 0x71690 TKW_VV_VV_UB 100.0 FORMULA_0003 0.0 255.0000 /end CHARACTERISTIC
/begin CHARACTERISTIC K_ED_FGR_ABWURF.FEHLERSCHWELLE "Filterschwelle fuer Fehlereintrag | EN: Fault code FGR_ABWURF - debounce filter threshold for setting the fault" VALUE 0x716AA TKW_VV_VV_UB 100.0 FORMULA_0003 0.0 255.0000 /end CHARACTERISTIC
/begin CHARACTERISTIC K_ED_AFZ_HS.FEHLERSCHWELLE "Filterschwelle fuer Fehlereintrag | EN: Fault code AFZ_HS - debounce filter threshold for setting the fault" VALUE 0x716F8 TKW_VV_VV_UB 100.0 FORMULA_0003 0.0 255.0000 /end CHARACTERISTIC
/begin CHARACTERISTIC K_ED_AFZ_HS_NA.FEHLERSCHWELLE "Filterschwelle fuer Fehlereintrag" VALUE 0x7177A TKW_VV_VV_UB 100.0 FORMULA_0003 0.0 255.0000 /end CHARACTERISTIC
/begin CHARACTERISTIC K_ED_INDEX_110_IGN.FEHLERSCHWELLE "Filterschwelle fuer Fehlereintrag" VALUE 0x71794 TKW_VV_VV_UB 100.0 FORMULA_0003 0.0 255.0000 /end CHARACTERISTIC
/begin CHARACTERISTIC K_ED_INDEX_111_IGN.FEHLERSCHWELLE "Filterschwelle fuer Fehlereintrag" VALUE 0x717AE TKW_VV_VV_UB 100.0 FORMULA_0003 0.0 255.0000 /end CHARACTERISTIC
/begin CHARACTERISTIC K_ED_INDEX_112_IGN.FEHLERSCHWELLE "Filterschwelle fuer Fehlereintrag" VALUE 0x717C8 TKW_VV_VV_UB 100.0 FORMULA_0003 0.0 255.0000 /end CHARACTERISTIC
/begin CHARACTERISTIC K_ED_INDEX_113_IGN.FEHLERSCHWELLE "Filterschwelle fuer Fehlereintrag" VALUE 0x717E2 TKW_VV_VV_UB 100.0 FORMULA_0003 0.0 255.0000 /end CHARACTERISTIC
/begin CHARACTERISTIC K_ED_INDEX_114_IGN.FEHLERSCHWELLE "Filterschwelle fuer Fehlereintrag" VALUE 0x717FC TKW_VV_VV_UB 100.0 FORMULA_0003 0.0 255.0000 /end CHARACTERISTIC
/begin CHARACTERISTIC K_ED_INDEX_115_IGN.FEHLERSCHWELLE "Filterschwelle fuer Fehlereintrag" VALUE 0x71816 TKW_VV_VV_UB 100.0 FORMULA_0003 0.0 255.0000 /end CHARACTERISTIC
/begin CHARACTERISTIC K_ED_INDEX_116_IGN.FEHLERSCHWELLE "Filterschwelle fuer Fehlereintrag" VALUE 0x71830 TKW_VV_VV_UB 100.0 FORMULA_0003 0.0 255.0000 /end CHARACTERISTIC
/begin CHARACTERISTIC K_ED_INDEX_117_IGN.FEHLERSCHWELLE "Filterschwelle fuer Fehlereintrag" VALUE 0x7184A TKW_VV_VV_UB 100.0 FORMULA_0003 0.0 255.0000 /end CHARACTERISTIC
/begin CHARACTERISTIC K_ED_INDEX_118_IGN.FEHLERSCHWELLE "Filterschwelle fuer Fehlereintrag" VALUE 0x71864 TKW_VV_VV_UB 100.0 FORMULA_0003 0.0 255.0000 /end CHARACTERISTIC
/begin CHARACTERISTIC K_ED_INDEX_119_IGN.FEHLERSCHWELLE "Filterschwelle fuer Fehlereintrag" VALUE 0x7187E TKW_VV_VV_UB 100.0 FORMULA_0003 0.0 255.0000 /end CHARACTERISTIC
/begin CHARACTERISTIC K_ED_INDEX_120_IGN.FEHLERSCHWELLE "Filterschwelle fuer Fehlereintrag" VALUE 0x71898 TKW_VV_VV_UB 100.0 FORMULA_0003 0.0 255.0000 /end CHARACTERISTIC
/begin CHARACTERISTIC K_ED_INDEX_121_IGN.FEHLERSCHWELLE "Filterschwelle fuer Fehlereintrag | EN: Fault code INDEX_121_IGN - debounce filter threshold for setting the fault" VALUE 0x718B2 TKW_VV_VV_UB 100.0 FORMULA_0003 0.0 255.0000 /end CHARACTERISTIC
/begin CHARACTERISTIC K_ED_APPL_DATA_IGN.OK_SCHWELLE "Filterschwelle fuer Fehleraustrag | EN: Fault code APPL_DATA_IGN - debounce filter threshold for clearing (healing) the fault" VALUE 0x70D87 TKW_VV_VV_UB 100.0 FORMULA_0003 0.0 255.0000 /end CHARACTERISTIC
/begin CHARACTERISTIC K_ED_DK1_CAN.OK_SCHWELLE "Filterschwelle fuer Fehleraustrag | EN: Fault code DK1_CAN - debounce filter threshold for clearing (healing) the fault" VALUE 0x70E57 TKW_VV_VV_UB 100.0 FORMULA_0003 0.0 255.0000 /end CHARACTERISTIC
/begin CHARACTERISTIC K_ED_DK2_CAN.OK_SCHWELLE "Filterschwelle fuer Fehleraustrag | EN: Fault code DK2_CAN - debounce filter threshold for clearing (healing) the fault" VALUE 0x70E71 TKW_VV_VV_UB 100.0 FORMULA_0003 0.0 255.0000 /end CHARACTERISTIC
/begin CHARACTERISTIC K_ED_DK_INIT.OK_SCHWELLE "Filterschwelle fuer Fehleraustrag | EN: Fault code DK_INIT - debounce filter threshold for clearing (healing) the fault" VALUE 0x70F41 TKW_VV_VV_UB 100.0 FORMULA_0003 0.0 255.0000 /end CHARACTERISTIC
/begin CHARACTERISTIC K_ED_DK1_REGLER.OK_SCHWELLE "Filterschwelle fuer Fehleraustrag | EN: Fault code DK1_REGLER - debounce filter threshold for clearing (healing) the fault" VALUE 0x70F5B TKW_VV_VV_UB 100.0 FORMULA_0003 0.0 255.0000 /end CHARACTERISTIC
/begin CHARACTERISTIC K_ED_DK2_REGLER.OK_SCHWELLE "Filterschwelle fuer Fehleraustrag | EN: Fault code DK2_REGLER - debounce filter threshold for clearing (healing) the fault" VALUE 0x70F75 TKW_VV_VV_UB 100.0 FORMULA_0003 0.0 255.0000 /end CHARACTERISTIC
/begin CHARACTERISTIC K_ED_DK1_ADAPT.OK_SCHWELLE "Filterschwelle fuer Fehleraustrag | EN: Fault code DK1_ADAPT - debounce filter threshold for clearing (healing) the fault" VALUE 0x70F8F TKW_VV_VV_UB 100.0 FORMULA_0003 0.0 255.0000 /end CHARACTERISTIC
/begin CHARACTERISTIC K_ED_DK2_ADAPT.OK_SCHWELLE "Filterschwelle fuer Fehleraustrag | EN: Fault code DK2_ADAPT - debounce filter threshold for clearing (healing) the fault" VALUE 0x70FA9 TKW_VV_VV_UB 100.0 FORMULA_0003 0.0 255.0000 /end CHARACTERISTIC
/begin CHARACTERISTIC K_ED_DK1_WDK.OK_SCHWELLE "Filterschwelle fuer Fehleraustrag | EN: Fault code DK1_WDK - debounce filter threshold for clearing (healing) the fault" VALUE 0x7105F TKW_VV_VV_UB 100.0 FORMULA_0003 0.0 255.0000 /end CHARACTERISTIC
/begin CHARACTERISTIC K_ED_DK2_WDK.OK_SCHWELLE "Filterschwelle fuer Fehleraustrag | EN: Fault code DK2_WDK - debounce filter threshold for clearing (healing) the fault" VALUE 0x71079 TKW_VV_VV_UB 100.0 FORMULA_0003 0.0 255.0000 /end CHARACTERISTIC
/begin CHARACTERISTIC K_ED_DK1_PDR.OK_SCHWELLE "Filterschwelle fuer Fehleraustrag | EN: Fault code DK1_PDR - debounce filter threshold for clearing (healing) the fault" VALUE 0x71093 TKW_VV_VV_UB 100.0 FORMULA_0003 0.0 255.0000 /end CHARACTERISTIC
/begin CHARACTERISTIC K_ED_DK2_PDR.OK_SCHWELLE "Filterschwelle fuer Fehleraustrag | EN: Fault code DK2_PDR - debounce filter threshold for clearing (healing) the fault" VALUE 0x710AD TKW_VV_VV_UB 100.0 FORMULA_0003 0.0 255.0000 /end CHARACTERISTIC
/begin CHARACTERISTIC K_ED_DK1_SK_ERR.OK_SCHWELLE "Filterschwelle fuer Fehleraustrag | EN: Fault code DK1_SK_ERR - debounce filter threshold for clearing (healing) the fault" VALUE 0x710FB TKW_VV_VV_UB 100.0 FORMULA_0003 0.0 255.0000 /end CHARACTERISTIC
/begin CHARACTERISTIC K_ED_DK2_SK_ERR.OK_SCHWELLE "Filterschwelle fuer Fehleraustrag | EN: Fault code DK2_SK_ERR - debounce filter threshold for clearing (healing) the fault" VALUE 0x71115 TKW_VV_VV_UB 100.0 FORMULA_0003 0.0 255.0000 /end CHARACTERISTIC
/begin CHARACTERISTIC K_ED_DK1_FEDERN.OK_SCHWELLE "Filterschwelle fuer Fehleraustrag | EN: Fault code DK1_FEDERN - debounce filter threshold for clearing (healing) the fault" VALUE 0x7112F TKW_VV_VV_UB 100.0 FORMULA_0003 0.0 255.0000 /end CHARACTERISTIC
/begin CHARACTERISTIC K_ED_DK2_FEDERN.OK_SCHWELLE "Filterschwelle fuer Fehleraustrag | EN: Fault code DK2_FEDERN - debounce filter threshold for clearing (healing) the fault" VALUE 0x71149 TKW_VV_VV_UB 100.0 FORMULA_0003 0.0 255.0000 /end CHARACTERISTIC
/begin CHARACTERISTIC K_ED_DSC_EINGR.OK_SCHWELLE "Filterschwelle fuer Fehleraustrag | EN: Fault code DSC_EINGR - debounce filter threshold for clearing (healing) the fault" VALUE 0x71197 TKW_VV_VV_UB 100.0 FORMULA_0003 0.0 255.0000 /end CHARACTERISTIC
/begin CHARACTERISTIC K_ED_DK1_CMD.OK_SCHWELLE "Filterschwelle fuer Fehleraustrag | EN: Fault code DK1_CMD - debounce filter threshold for clearing (healing) the fault" VALUE 0x711B1 TKW_VV_VV_UB 100.0 FORMULA_0003 0.0 255.0000 /end CHARACTERISTIC
/begin CHARACTERISTIC K_ED_DK2_CMD.OK_SCHWELLE "Filterschwelle fuer Fehleraustrag | EN: Fault code DK2_CMD - debounce filter threshold for clearing (healing) the fault" VALUE 0x711CB TKW_VV_VV_UB 100.0 FORMULA_0003 0.0 255.0000 /end CHARACTERISTIC
/begin CHARACTERISTIC K_ED_EC_BUSOFF.OK_SCHWELLE "Filterschwelle fuer Fehleraustrag | EN: Fault code EC_BUSOFF - debounce filter threshold for clearing (healing) the fault" VALUE 0x71281 TKW_VV_VV_UB 100.0 FORMULA_0003 0.0 255.0000 /end CHARACTERISTIC
/begin CHARACTERISTIC K_ED_AUSS_KAT_Z1.OK_SCHWELLE "Filterschwelle fuer Fehleraustrag | EN: Fault code AUSS_KAT_Z1 - debounce filter threshold for clearing (healing) the fault" VALUE 0x7129B TKW_VV_VV_UB 100.0 FORMULA_0003 0.0 255.0000 /end CHARACTERISTIC
/begin CHARACTERISTIC K_ED_AUSS_KAT_Z2.OK_SCHWELLE "Filterschwelle fuer Fehleraustrag | EN: Fault code AUSS_KAT_Z2 - debounce filter threshold for clearing (healing) the fault" VALUE 0x712B5 TKW_VV_VV_UB 100.0 FORMULA_0003 0.0 255.0000 /end CHARACTERISTIC
/begin CHARACTERISTIC K_ED_AUSS_KAT_Z3.OK_SCHWELLE "Filterschwelle fuer Fehleraustrag | EN: Fault code AUSS_KAT_Z3 - debounce filter threshold for clearing (healing) the fault" VALUE 0x712CF TKW_VV_VV_UB 100.0 FORMULA_0003 0.0 255.0000 /end CHARACTERISTIC
/begin CHARACTERISTIC K_ED_AUSS_KAT_Z4.OK_SCHWELLE "Filterschwelle fuer Fehleraustrag | EN: Fault code AUSS_KAT_Z4 - debounce filter threshold for clearing (healing) the fault" VALUE 0x712E9 TKW_VV_VV_UB 100.0 FORMULA_0003 0.0 255.0000 /end CHARACTERISTIC
/begin CHARACTERISTIC K_ED_AUSS_KAT_Z5.OK_SCHWELLE "Filterschwelle fuer Fehleraustrag | EN: Fault code AUSS_KAT_Z5 - debounce filter threshold for clearing (healing) the fault" VALUE 0x71303 TKW_VV_VV_UB 100.0 FORMULA_0003 0.0 255.0000 /end CHARACTERISTIC
/begin CHARACTERISTIC K_ED_AUSS_KAT_Z6.OK_SCHWELLE "Filterschwelle fuer Fehleraustrag | EN: Fault code AUSS_KAT_Z6 - debounce filter threshold for clearing (healing) the fault" VALUE 0x7131D TKW_VV_VV_UB 100.0 FORMULA_0003 0.0 255.0000 /end CHARACTERISTIC
/begin CHARACTERISTIC K_ED_AUSS_KAT_Z7.OK_SCHWELLE "Filterschwelle fuer Fehleraustrag | EN: Fault code AUSS_KAT_Z7 - debounce filter threshold for clearing (healing) the fault" VALUE 0x71337 TKW_VV_VV_UB 100.0 FORMULA_0003 0.0 255.0000 /end CHARACTERISTIC
/begin CHARACTERISTIC K_ED_AUSS_KAT_Z8.OK_SCHWELLE "Filterschwelle fuer Fehleraustrag | EN: Fault code AUSS_KAT_Z8 - debounce filter threshold for clearing (healing) the fault" VALUE 0x71351 TKW_VV_VV_UB 100.0 FORMULA_0003 0.0 255.0000 /end CHARACTERISTIC
/begin CHARACTERISTIC K_ED_AUSS_KAT_Z9.OK_SCHWELLE "Filterschwelle fuer Fehleraustrag | EN: Fault code AUSS_KAT_Z9 - debounce filter threshold for clearing (healing) the fault" VALUE 0x7136B TKW_VV_VV_UB 100.0 FORMULA_0003 0.0 255.0000 /end CHARACTERISTIC
/begin CHARACTERISTIC K_ED_AUSS_KAT_Z10.OK_SCHWELLE "Filterschwelle fuer Fehleraustrag | EN: Fault code AUSS_KAT_Z10 - debounce filter threshold for clearing (healing) the fault" VALUE 0x71385 TKW_VV_VV_UB 100.0 FORMULA_0003 0.0 255.0000 /end CHARACTERISTIC
/begin CHARACTERISTIC K_ED_AUSS_KAT_MULT.OK_SCHWELLE "Filterschwelle fuer Fehleraustrag | EN: Fault code AUSS_KAT_MULT - debounce filter threshold for clearing (healing) the fault" VALUE 0x713D3 TKW_VV_VV_UB 100.0 FORMULA_0003 0.0 255.0000 /end CHARACTERISTIC
/begin CHARACTERISTIC K_ED_AUSS_ABG_Z1.OK_SCHWELLE "Filterschwelle fuer Fehleraustrag | EN: Fault code AUSS_ABG_Z1 - debounce filter threshold for clearing (healing) the fault" VALUE 0x713ED TKW_VV_VV_UB 100.0 FORMULA_0003 0.0 255.0000 /end CHARACTERISTIC
/begin CHARACTERISTIC K_ED_AUSS_ABG_Z2.OK_SCHWELLE "Filterschwelle fuer Fehleraustrag | EN: Fault code AUSS_ABG_Z2 - debounce filter threshold for clearing (healing) the fault" VALUE 0x71407 TKW_VV_VV_UB 100.0 FORMULA_0003 0.0 255.0000 /end CHARACTERISTIC
/begin CHARACTERISTIC K_ED_AUSS_ABG_Z3.OK_SCHWELLE "Filterschwelle fuer Fehleraustrag | EN: Fault code AUSS_ABG_Z3 - debounce filter threshold for clearing (healing) the fault" VALUE 0x71421 TKW_VV_VV_UB 100.0 FORMULA_0003 0.0 255.0000 /end CHARACTERISTIC
/begin CHARACTERISTIC K_ED_AUSS_ABG_Z4.OK_SCHWELLE "Filterschwelle fuer Fehleraustrag | EN: Fault code AUSS_ABG_Z4 - debounce filter threshold for clearing (healing) the fault" VALUE 0x7143B TKW_VV_VV_UB 100.0 FORMULA_0003 0.0 255.0000 /end CHARACTERISTIC
/begin CHARACTERISTIC K_ED_AUSS_ABG_Z5.OK_SCHWELLE "Filterschwelle fuer Fehleraustrag | EN: Fault code AUSS_ABG_Z5 - debounce filter threshold for clearing (healing) the fault" VALUE 0x71455 TKW_VV_VV_UB 100.0 FORMULA_0003 0.0 255.0000 /end CHARACTERISTIC
/begin CHARACTERISTIC K_ED_AUSS_ABG_Z6.OK_SCHWELLE "Filterschwelle fuer Fehleraustrag | EN: Fault code AUSS_ABG_Z6 - debounce filter threshold for clearing (healing) the fault" VALUE 0x7146F TKW_VV_VV_UB 100.0 FORMULA_0003 0.0 255.0000 /end CHARACTERISTIC
/begin CHARACTERISTIC K_ED_AUSS_ABG_Z7.OK_SCHWELLE "Filterschwelle fuer Fehleraustrag | EN: Fault code AUSS_ABG_Z7 - debounce filter threshold for clearing (healing) the fault" VALUE 0x71489 TKW_VV_VV_UB 100.0 FORMULA_0003 0.0 255.0000 /end CHARACTERISTIC
/begin CHARACTERISTIC K_ED_AUSS_ABG_Z8.OK_SCHWELLE "Filterschwelle fuer Fehleraustrag | EN: Fault code AUSS_ABG_Z8 - debounce filter threshold for clearing (healing) the fault" VALUE 0x714A3 TKW_VV_VV_UB 100.0 FORMULA_0003 0.0 255.0000 /end CHARACTERISTIC
/begin CHARACTERISTIC K_ED_AUSS_ABG_Z9.OK_SCHWELLE "Filterschwelle fuer Fehleraustrag" VALUE 0x714BD TKW_VV_VV_UB 100.0 FORMULA_0003 0.0 255.0000 /end CHARACTERISTIC
/begin CHARACTERISTIC K_ED_AUSS_ABG_Z10.OK_SCHWELLE "Filterschwelle fuer Fehleraustrag" VALUE 0x714D7 TKW_VV_VV_UB 100.0 FORMULA_0003 0.0 255.0000 /end CHARACTERISTIC
/begin CHARACTERISTIC K_ED_AUSS_ABG_MULT.OK_SCHWELLE "Filterschwelle fuer Fehleraustrag | EN: Filterschwelle fuer Fehleraustrag" VALUE 0x71525 TKW_VV_VV_UB 100.0 FORMULA_0003 0.0 255.0000 /end CHARACTERISTIC
/begin CHARACTERISTIC K_ED_E2_IGN.OK_SCHWELLE "Filterschwelle fuer Fehleraustrag | EN: Fault code E2_IGN - debounce filter threshold for clearing (healing) the fault" VALUE 0x715DB TKW_VV_VV_UB 100.0 FORMULA_0003 0.0 255.0000 /end CHARACTERISTIC
/begin CHARACTERISTIC K_ED_BLS_PLAU.OK_SCHWELLE "Filterschwelle fuer Fehleraustrag | EN: Fault code BLS_PLAU - debounce filter threshold for clearing (healing) the fault" VALUE 0x715F5 TKW_VV_VV_UB 100.0 FORMULA_0003 0.0 255.0000 /end CHARACTERISTIC
/begin CHARACTERISTIC K_ED_DK1_ZUST.OK_SCHWELLE "Filterschwelle fuer Fehleraustrag | EN: Fault code DK1_ZUST - debounce filter threshold for clearing (healing) the fault" VALUE 0x71677 TKW_VV_VV_UB 100.0 FORMULA_0003 0.0 255.0000 /end CHARACTERISTIC
/begin CHARACTERISTIC K_ED_DK2_ZUST.OK_SCHWELLE "Filterschwelle fuer Fehleraustrag | EN: Fault code DK2_ZUST - debounce filter threshold for clearing (healing) the fault" VALUE 0x71691 TKW_VV_VV_UB 100.0 FORMULA_0003 0.0 255.0000 /end CHARACTERISTIC
/begin CHARACTERISTIC K_ED_FGR_ABWURF.OK_SCHWELLE "Filterschwelle fuer Fehleraustrag | EN: Fault code FGR_ABWURF - debounce filter threshold for clearing (healing) the fault" VALUE 0x716AB TKW_VV_VV_UB 100.0 FORMULA_0003 0.0 255.0000 /end CHARACTERISTIC
/begin CHARACTERISTIC K_ED_AFZ_HS.OK_SCHWELLE "Filterschwelle fuer Fehleraustrag | EN: Fault code AFZ_HS - debounce filter threshold for clearing (healing) the fault" VALUE 0x716F9 TKW_VV_VV_UB 100.0 FORMULA_0003 0.0 255.0000 /end CHARACTERISTIC
/begin CHARACTERISTIC K_ED_AFZ_HS_NA.OK_SCHWELLE "Filterschwelle fuer Fehleraustrag" VALUE 0x7177B TKW_VV_VV_UB 100.0 FORMULA_0003 0.0 255.0000 /end CHARACTERISTIC
/begin CHARACTERISTIC K_ED_INDEX_110_IGN.OK_SCHWELLE "Filterschwelle fuer Fehleraustrag" VALUE 0x71795 TKW_VV_VV_UB 100.0 FORMULA_0003 0.0 255.0000 /end CHARACTERISTIC
/begin CHARACTERISTIC K_ED_INDEX_111_IGN.OK_SCHWELLE "Filterschwelle fuer Fehleraustrag" VALUE 0x717AF TKW_VV_VV_UB 100.0 FORMULA_0003 0.0 255.0000 /end CHARACTERISTIC
/begin CHARACTERISTIC K_ED_INDEX_112_IGN.OK_SCHWELLE "Filterschwelle fuer Fehleraustrag" VALUE 0x717C9 TKW_VV_VV_UB 100.0 FORMULA_0003 0.0 255.0000 /end CHARACTERISTIC
/begin CHARACTERISTIC K_ED_INDEX_113_IGN.OK_SCHWELLE "Filterschwelle fuer Fehleraustrag" VALUE 0x717E3 TKW_VV_VV_UB 100.0 FORMULA_0003 0.0 255.0000 /end CHARACTERISTIC
/begin CHARACTERISTIC K_ED_INDEX_114_IGN.OK_SCHWELLE "Filterschwelle fuer Fehleraustrag" VALUE 0x717FD TKW_VV_VV_UB 100.0 FORMULA_0003 0.0 255.0000 /end CHARACTERISTIC
/begin CHARACTERISTIC K_ED_INDEX_115_IGN.OK_SCHWELLE "Filterschwelle fuer Fehleraustrag" VALUE 0x71817 TKW_VV_VV_UB 100.0 FORMULA_0003 0.0 255.0000 /end CHARACTERISTIC
/begin CHARACTERISTIC K_ED_INDEX_116_IGN.OK_SCHWELLE "Filterschwelle fuer Fehleraustrag" VALUE 0x71831 TKW_VV_VV_UB 100.0 FORMULA_0003 0.0 255.0000 /end CHARACTERISTIC
/begin CHARACTERISTIC K_ED_INDEX_117_IGN.OK_SCHWELLE "Filterschwelle fuer Fehleraustrag" VALUE 0x7184B TKW_VV_VV_UB 100.0 FORMULA_0003 0.0 255.0000 /end CHARACTERISTIC
/begin CHARACTERISTIC K_ED_INDEX_118_IGN.OK_SCHWELLE "Filterschwelle fuer Fehleraustrag" VALUE 0x71865 TKW_VV_VV_UB 100.0 FORMULA_0003 0.0 255.0000 /end CHARACTERISTIC
/begin CHARACTERISTIC K_ED_INDEX_119_IGN.OK_SCHWELLE "Filterschwelle fuer Fehleraustrag" VALUE 0x7187F TKW_VV_VV_UB 100.0 FORMULA_0003 0.0 255.0000 /end CHARACTERISTIC
/begin CHARACTERISTIC K_ED_INDEX_120_IGN.OK_SCHWELLE "Filterschwelle fuer Fehleraustrag" VALUE 0x71899 TKW_VV_VV_UB 100.0 FORMULA_0003 0.0 255.0000 /end CHARACTERISTIC
/begin CHARACTERISTIC K_ED_APPL_DATA_IGN.INC_VOR_EINTRAG "Filtererhoehung vorm Fehlerspeichereintrag | EN: Fault code APPL_DATA_IGN - debounce filter increment before fault-memory entry" VALUE 0x70D88 TKW_VV_VV_UB 100.0 FORMULA_0003 0.0 255.0000 /end CHARACTERISTIC
/begin CHARACTERISTIC K_ED_DK1_CAN.INC_VOR_EINTRAG "Filtererhoehung vorm Fehlerspeichereintrag | EN: Fault code DK1_CAN - debounce filter increment before fault-memory entry" VALUE 0x70E58 TKW_VV_VV_UB 100.0 FORMULA_0003 0.0 255.0000 /end CHARACTERISTIC
/begin CHARACTERISTIC K_ED_DK2_CAN.INC_VOR_EINTRAG "Filtererhoehung vorm Fehlerspeichereintrag | EN: Fault code DK2_CAN - debounce filter increment before fault-memory entry" VALUE 0x70E72 TKW_VV_VV_UB 100.0 FORMULA_0003 0.0 255.0000 /end CHARACTERISTIC
/begin CHARACTERISTIC K_ED_DK_INIT.INC_VOR_EINTRAG "Filtererhoehung vorm Fehlerspeichereintrag | EN: Fault code DK_INIT - debounce filter increment before fault-memory entry" VALUE 0x70F42 TKW_VV_VV_UB 100.0 FORMULA_0003 0.0 255.0000 /end CHARACTERISTIC
/begin CHARACTERISTIC K_ED_DK1_REGLER.INC_VOR_EINTRAG "Filtererhoehung vorm Fehlerspeichereintrag | EN: Fault code DK1_REGLER - debounce filter increment before fault-memory entry" VALUE 0x70F5C TKW_VV_VV_UB 100.0 FORMULA_0003 0.0 255.0000 /end CHARACTERISTIC
/begin CHARACTERISTIC K_ED_DK2_REGLER.INC_VOR_EINTRAG "Filtererhoehung vorm Fehlerspeichereintrag | EN: Fault code DK2_REGLER - debounce filter increment before fault-memory entry" VALUE 0x70F76 TKW_VV_VV_UB 100.0 FORMULA_0003 0.0 255.0000 /end CHARACTERISTIC
/begin CHARACTERISTIC K_ED_DK1_ADAPT.INC_VOR_EINTRAG "Filtererhoehung vorm Fehlerspeichereintrag | EN: Fault code DK1_ADAPT - debounce filter increment before fault-memory entry" VALUE 0x70F90 TKW_VV_VV_UB 100.0 FORMULA_0003 0.0 255.0000 /end CHARACTERISTIC
/begin CHARACTERISTIC K_ED_DK2_ADAPT.INC_VOR_EINTRAG "Filtererhoehung vorm Fehlerspeichereintrag | EN: Fault code DK2_ADAPT - debounce filter increment before fault-memory entry" VALUE 0x70FAA TKW_VV_VV_UB 100.0 FORMULA_0003 0.0 255.0000 /end CHARACTERISTIC
/begin CHARACTERISTIC K_ED_DK1_WDK.INC_VOR_EINTRAG "Filtererhoehung vorm Fehlerspeichereintrag | EN: Fault code DK1_WDK - debounce filter increment before fault-memory entry" VALUE 0x71060 TKW_VV_VV_UB 100.0 FORMULA_0003 0.0 255.0000 /end CHARACTERISTIC
/begin CHARACTERISTIC K_ED_DK2_WDK.INC_VOR_EINTRAG "Filtererhoehung vorm Fehlerspeichereintrag | EN: Fault code DK2_WDK - debounce filter increment before fault-memory entry" VALUE 0x7107A TKW_VV_VV_UB 100.0 FORMULA_0003 0.0 255.0000 /end CHARACTERISTIC
/begin CHARACTERISTIC K_ED_DK1_PDR.INC_VOR_EINTRAG "Filtererhoehung vorm Fehlerspeichereintrag | EN: Fault code DK1_PDR - debounce filter increment before fault-memory entry" VALUE 0x71094 TKW_VV_VV_UB 100.0 FORMULA_0003 0.0 255.0000 /end CHARACTERISTIC
/begin CHARACTERISTIC K_ED_DK2_PDR.INC_VOR_EINTRAG "Filtererhoehung vorm Fehlerspeichereintrag | EN: Fault code DK2_PDR - debounce filter increment before fault-memory entry" VALUE 0x710AE TKW_VV_VV_UB 100.0 FORMULA_0003 0.0 255.0000 /end CHARACTERISTIC
/begin CHARACTERISTIC K_ED_DK1_SK_ERR.INC_VOR_EINTRAG "Filtererhoehung vorm Fehlerspeichereintrag | EN: Fault code DK1_SK_ERR - debounce filter increment before fault-memory entry" VALUE 0x710FC TKW_VV_VV_UB 100.0 FORMULA_0003 0.0 255.0000 /end CHARACTERISTIC
/begin CHARACTERISTIC K_ED_DK2_SK_ERR.INC_VOR_EINTRAG "Filtererhoehung vorm Fehlerspeichereintrag | EN: Fault code DK2_SK_ERR - debounce filter increment before fault-memory entry" VALUE 0x71116 TKW_VV_VV_UB 100.0 FORMULA_0003 0.0 255.0000 /end CHARACTERISTIC
/begin CHARACTERISTIC K_ED_DK1_FEDERN.INC_VOR_EINTRAG "Filtererhoehung vorm Fehlerspeichereintrag | EN: Fault code DK1_FEDERN - debounce filter increment before fault-memory entry" VALUE 0x71130 TKW_VV_VV_UB 100.0 FORMULA_0003 0.0 255.0000 /end CHARACTERISTIC
/begin CHARACTERISTIC K_ED_DK2_FEDERN.INC_VOR_EINTRAG "Filtererhoehung vorm Fehlerspeichereintrag | EN: Fault code DK2_FEDERN - debounce filter increment before fault-memory entry" VALUE 0x7114A TKW_VV_VV_UB 100.0 FORMULA_0003 0.0 255.0000 /end CHARACTERISTIC
/begin CHARACTERISTIC K_ED_DSC_EINGR.INC_VOR_EINTRAG "Filtererhoehung vorm Fehlerspeichereintrag | EN: Fault code DSC_EINGR - debounce filter increment before fault-memory entry" VALUE 0x71198 TKW_VV_VV_UB 100.0 FORMULA_0003 0.0 255.0000 /end CHARACTERISTIC
/begin CHARACTERISTIC K_ED_DK1_CMD.INC_VOR_EINTRAG "Filtererhoehung vorm Fehlerspeichereintrag | EN: Fault code DK1_CMD - debounce filter increment before fault-memory entry" VALUE 0x711B2 TKW_VV_VV_UB 100.0 FORMULA_0003 0.0 255.0000 /end CHARACTERISTIC
/begin CHARACTERISTIC K_ED_DK2_CMD.INC_VOR_EINTRAG "Filtererhoehung vorm Fehlerspeichereintrag | EN: Fault code DK2_CMD - debounce filter increment before fault-memory entry" VALUE 0x711CC TKW_VV_VV_UB 100.0 FORMULA_0003 0.0 255.0000 /end CHARACTERISTIC
/begin CHARACTERISTIC K_ED_EC_BUSOFF.INC_VOR_EINTRAG "Filtererhoehung vorm Fehlerspeichereintrag | EN: Fault code EC_BUSOFF - debounce filter increment before fault-memory entry" VALUE 0x71282 TKW_VV_VV_UB 100.0 FORMULA_0003 0.0 255.0000 /end CHARACTERISTIC
/begin CHARACTERISTIC K_ED_AUSS_KAT_Z1.INC_VOR_EINTRAG "Filtererhoehung vorm Fehlerspeichereintrag | EN: Fault code AUSS_KAT_Z1 - debounce filter increment before fault-memory entry" VALUE 0x7129C TKW_VV_VV_UB 100.0 FORMULA_0003 0.0 255.0000 /end CHARACTERISTIC
/begin CHARACTERISTIC K_ED_AUSS_KAT_Z2.INC_VOR_EINTRAG "Filtererhoehung vorm Fehlerspeichereintrag | EN: Fault code AUSS_KAT_Z2 - debounce filter increment before fault-memory entry" VALUE 0x712B6 TKW_VV_VV_UB 100.0 FORMULA_0003 0.0 255.0000 /end CHARACTERISTIC
/begin CHARACTERISTIC K_ED_AUSS_KAT_Z3.INC_VOR_EINTRAG "Filtererhoehung vorm Fehlerspeichereintrag | EN: Fault code AUSS_KAT_Z3 - debounce filter increment before fault-memory entry" VALUE 0x712D0 TKW_VV_VV_UB 100.0 FORMULA_0003 0.0 255.0000 /end CHARACTERISTIC
/begin CHARACTERISTIC K_ED_AUSS_KAT_Z4.INC_VOR_EINTRAG "Filtererhoehung vorm Fehlerspeichereintrag | EN: Fault code AUSS_KAT_Z4 - debounce filter increment before fault-memory entry" VALUE 0x712EA TKW_VV_VV_UB 100.0 FORMULA_0003 0.0 255.0000 /end CHARACTERISTIC
/begin CHARACTERISTIC K_ED_AUSS_KAT_Z5.INC_VOR_EINTRAG "Filtererhoehung vorm Fehlerspeichereintrag | EN: Fault code AUSS_KAT_Z5 - debounce filter increment before fault-memory entry" VALUE 0x71304 TKW_VV_VV_UB 100.0 FORMULA_0003 0.0 255.0000 /end CHARACTERISTIC
/begin CHARACTERISTIC K_ED_AUSS_KAT_Z6.INC_VOR_EINTRAG "Filtererhoehung vorm Fehlerspeichereintrag | EN: Fault code AUSS_KAT_Z6 - debounce filter increment before fault-memory entry" VALUE 0x7131E TKW_VV_VV_UB 100.0 FORMULA_0003 0.0 255.0000 /end CHARACTERISTIC
/begin CHARACTERISTIC K_ED_AUSS_KAT_Z7.INC_VOR_EINTRAG "Filtererhoehung vorm Fehlerspeichereintrag | EN: Fault code AUSS_KAT_Z7 - debounce filter increment before fault-memory entry" VALUE 0x71338 TKW_VV_VV_UB 100.0 FORMULA_0003 0.0 255.0000 /end CHARACTERISTIC
/begin CHARACTERISTIC K_ED_AUSS_KAT_Z8.INC_VOR_EINTRAG "Filtererhoehung vorm Fehlerspeichereintrag | EN: Fault code AUSS_KAT_Z8 - debounce filter increment before fault-memory entry" VALUE 0x71352 TKW_VV_VV_UB 100.0 FORMULA_0003 0.0 255.0000 /end CHARACTERISTIC
/begin CHARACTERISTIC K_ED_AUSS_KAT_Z9.INC_VOR_EINTRAG "Filtererhoehung vorm Fehlerspeichereintrag | EN: Fault code AUSS_KAT_Z9 - debounce filter increment before fault-memory entry" VALUE 0x7136C TKW_VV_VV_UB 100.0 FORMULA_0003 0.0 255.0000 /end CHARACTERISTIC
/begin CHARACTERISTIC K_ED_AUSS_KAT_Z10.INC_VOR_EINTRAG "Filtererhoehung vorm Fehlerspeichereintrag | EN: Fault code AUSS_KAT_Z10 - debounce filter increment before fault-memory entry" VALUE 0x71386 TKW_VV_VV_UB 100.0 FORMULA_0003 0.0 255.0000 /end CHARACTERISTIC
/begin CHARACTERISTIC K_ED_AUSS_KAT_MULT.INC_VOR_EINTRAG "Filtererhoehung vorm Fehlerspeichereintrag | EN: Fault code AUSS_KAT_MULT - debounce filter increment before fault-memory entry" VALUE 0x713D4 TKW_VV_VV_UB 100.0 FORMULA_0003 0.0 255.0000 /end CHARACTERISTIC
/begin CHARACTERISTIC K_ED_AUSS_ABG_Z1.INC_VOR_EINTRAG "Filtererhoehung vorm Fehlerspeichereintrag | EN: Fault code AUSS_ABG_Z1 - debounce filter increment before fault-memory entry" VALUE 0x713EE TKW_VV_VV_UB 100.0 FORMULA_0003 0.0 255.0000 /end CHARACTERISTIC
/begin CHARACTERISTIC K_ED_AUSS_ABG_Z2.INC_VOR_EINTRAG "Filtererhoehung vorm Fehlerspeichereintrag | EN: Fault code AUSS_ABG_Z2 - debounce filter increment before fault-memory entry" VALUE 0x71408 TKW_VV_VV_UB 100.0 FORMULA_0003 0.0 255.0000 /end CHARACTERISTIC
/begin CHARACTERISTIC K_ED_AUSS_ABG_Z3.INC_VOR_EINTRAG "Filtererhoehung vorm Fehlerspeichereintrag | EN: Fault code AUSS_ABG_Z3 - debounce filter increment before fault-memory entry" VALUE 0x71422 TKW_VV_VV_UB 100.0 FORMULA_0003 0.0 255.0000 /end CHARACTERISTIC
/begin CHARACTERISTIC K_ED_AUSS_ABG_Z4.INC_VOR_EINTRAG "Filtererhoehung vorm Fehlerspeichereintrag | EN: Fault code AUSS_ABG_Z4 - debounce filter increment before fault-memory entry" VALUE 0x7143C TKW_VV_VV_UB 100.0 FORMULA_0003 0.0 255.0000 /end CHARACTERISTIC
/begin CHARACTERISTIC K_ED_AUSS_ABG_Z5.INC_VOR_EINTRAG "Filtererhoehung vorm Fehlerspeichereintrag | EN: Fault code AUSS_ABG_Z5 - debounce filter increment before fault-memory entry" VALUE 0x71456 TKW_VV_VV_UB 100.0 FORMULA_0003 0.0 255.0000 /end CHARACTERISTIC
/begin CHARACTERISTIC K_ED_AUSS_ABG_Z6.INC_VOR_EINTRAG "Filtererhoehung vorm Fehlerspeichereintrag | EN: Fault code AUSS_ABG_Z6 - debounce filter increment before fault-memory entry" VALUE 0x71470 TKW_VV_VV_UB 100.0 FORMULA_0003 0.0 255.0000 /end CHARACTERISTIC
/begin CHARACTERISTIC K_ED_AUSS_ABG_Z7.INC_VOR_EINTRAG "Filtererhoehung vorm Fehlerspeichereintrag | EN: Fault code AUSS_ABG_Z7 - debounce filter increment before fault-memory entry" VALUE 0x7148A TKW_VV_VV_UB 100.0 FORMULA_0003 0.0 255.0000 /end CHARACTERISTIC
/begin CHARACTERISTIC K_ED_AUSS_ABG_Z8.INC_VOR_EINTRAG "Filtererhoehung vorm Fehlerspeichereintrag | EN: Fault code AUSS_ABG_Z8 - debounce filter increment before fault-memory entry" VALUE 0x714A4 TKW_VV_VV_UB 100.0 FORMULA_0003 0.0 255.0000 /end CHARACTERISTIC
/begin CHARACTERISTIC K_ED_AUSS_ABG_Z9.INC_VOR_EINTRAG "Filtererhoehung vorm Fehlerspeichereintrag" VALUE 0x714BE TKW_VV_VV_UB 100.0 FORMULA_0003 0.0 255.0000 /end CHARACTERISTIC
/begin CHARACTERISTIC K_ED_AUSS_ABG_Z10.INC_VOR_EINTRAG "Filtererhoehung vorm Fehlerspeichereintrag" VALUE 0x714D8 TKW_VV_VV_UB 100.0 FORMULA_0003 0.0 255.0000 /end CHARACTERISTIC
/begin CHARACTERISTIC K_ED_AUSS_ABG_MULT.INC_VOR_EINTRAG "Filtererhoehung vorm Fehlerspeichereintrag | EN: Filtererhoehung vorm Fehlerspeichereintrag" VALUE 0x71526 TKW_VV_VV_UB 100.0 FORMULA_0003 0.0 255.0000 /end CHARACTERISTIC
/begin CHARACTERISTIC K_ED_E2_IGN.INC_VOR_EINTRAG "Filtererhoehung vorm Fehlerspeichereintrag | EN: Fault code E2_IGN - debounce filter increment before fault-memory entry" VALUE 0x715DC TKW_VV_VV_UB 100.0 FORMULA_0003 0.0 255.0000 /end CHARACTERISTIC
/begin CHARACTERISTIC K_ED_BLS_PLAU.INC_VOR_EINTRAG "Filtererhoehung vorm Fehlerspeichereintrag | EN: Fault code BLS_PLAU - debounce filter increment before fault-memory entry" VALUE 0x715F6 TKW_VV_VV_UB 100.0 FORMULA_0003 0.0 255.0000 /end CHARACTERISTIC
/begin CHARACTERISTIC K_ED_DK1_ZUST.INC_VOR_EINTRAG "Filtererhoehung vorm Fehlerspeichereintrag | EN: Fault code DK1_ZUST - debounce filter increment before fault-memory entry" VALUE 0x71678 TKW_VV_VV_UB 100.0 FORMULA_0003 0.0 255.0000 /end CHARACTERISTIC
/begin CHARACTERISTIC K_ED_DK2_ZUST.INC_VOR_EINTRAG "Filtererhoehung vorm Fehlerspeichereintrag | EN: Fault code DK2_ZUST - debounce filter increment before fault-memory entry" VALUE 0x71692 TKW_VV_VV_UB 100.0 FORMULA_0003 0.0 255.0000 /end CHARACTERISTIC
/begin CHARACTERISTIC K_ED_FGR_ABWURF.INC_VOR_EINTRAG "Filtererhoehung vorm Fehlerspeichereintrag | EN: Fault code FGR_ABWURF - debounce filter increment before fault-memory entry" VALUE 0x716AC TKW_VV_VV_UB 100.0 FORMULA_0003 0.0 255.0000 /end CHARACTERISTIC
/begin CHARACTERISTIC K_ED_AFZ_HS.INC_VOR_EINTRAG "Filtererhoehung vorm Fehlerspeichereintrag | EN: Fault code AFZ_HS - debounce filter increment before fault-memory entry" VALUE 0x716FA TKW_VV_VV_UB 100.0 FORMULA_0003 0.0 255.0000 /end CHARACTERISTIC
/begin CHARACTERISTIC K_ED_AFZ_HS_NA.INC_VOR_EINTRAG "Filtererhoehung vorm Fehlerspeichereintrag" VALUE 0x7177C TKW_VV_VV_UB 100.0 FORMULA_0003 0.0 255.0000 /end CHARACTERISTIC
/begin CHARACTERISTIC K_ED_INDEX_110_IGN.INC_VOR_EINTRAG "Filtererhoehung vorm Fehlerspeichereintrag" VALUE 0x71796 TKW_VV_VV_UB 100.0 FORMULA_0003 0.0 255.0000 /end CHARACTERISTIC
/begin CHARACTERISTIC K_ED_INDEX_111_IGN.INC_VOR_EINTRAG "Filtererhoehung vorm Fehlerspeichereintrag" VALUE 0x717B0 TKW_VV_VV_UB 100.0 FORMULA_0003 0.0 255.0000 /end CHARACTERISTIC
/begin CHARACTERISTIC K_ED_INDEX_112_IGN.INC_VOR_EINTRAG "Filtererhoehung vorm Fehlerspeichereintrag" VALUE 0x717CA TKW_VV_VV_UB 100.0 FORMULA_0003 0.0 255.0000 /end CHARACTERISTIC
/begin CHARACTERISTIC K_ED_INDEX_113_IGN.INC_VOR_EINTRAG "Filtererhoehung vorm Fehlerspeichereintrag" VALUE 0x717E4 TKW_VV_VV_UB 100.0 FORMULA_0003 0.0 255.0000 /end CHARACTERISTIC
/begin CHARACTERISTIC K_ED_INDEX_114_IGN.INC_VOR_EINTRAG "Filtererhoehung vorm Fehlerspeichereintrag" VALUE 0x717FE TKW_VV_VV_UB 100.0 FORMULA_0003 0.0 255.0000 /end CHARACTERISTIC
/begin CHARACTERISTIC K_ED_INDEX_115_IGN.INC_VOR_EINTRAG "Filtererhoehung vorm Fehlerspeichereintrag" VALUE 0x71818 TKW_VV_VV_UB 100.0 FORMULA_0003 0.0 255.0000 /end CHARACTERISTIC
/begin CHARACTERISTIC K_ED_INDEX_116_IGN.INC_VOR_EINTRAG "Filtererhoehung vorm Fehlerspeichereintrag" VALUE 0x71832 TKW_VV_VV_UB 100.0 FORMULA_0003 0.0 255.0000 /end CHARACTERISTIC
/begin CHARACTERISTIC K_ED_INDEX_117_IGN.INC_VOR_EINTRAG "Filtererhoehung vorm Fehlerspeichereintrag" VALUE 0x7184C TKW_VV_VV_UB 100.0 FORMULA_0003 0.0 255.0000 /end CHARACTERISTIC
/begin CHARACTERISTIC K_ED_INDEX_118_IGN.INC_VOR_EINTRAG "Filtererhoehung vorm Fehlerspeichereintrag" VALUE 0x71866 TKW_VV_VV_UB 100.0 FORMULA_0003 0.0 255.0000 /end CHARACTERISTIC
/begin CHARACTERISTIC K_ED_INDEX_119_IGN.INC_VOR_EINTRAG "Filtererhoehung vorm Fehlerspeichereintrag" VALUE 0x71880 TKW_VV_VV_UB 100.0 FORMULA_0003 0.0 255.0000 /end CHARACTERISTIC
/begin CHARACTERISTIC K_ED_INDEX_120_IGN.INC_VOR_EINTRAG "Filtererhoehung vorm Fehlerspeichereintrag" VALUE 0x7189A TKW_VV_VV_UB 100.0 FORMULA_0003 0.0 255.0000 /end CHARACTERISTIC
/begin CHARACTERISTIC K_ED_INDEX_121_IGN.INC_VOR_EINTRAG "Filtererhoehung vorm Fehlerspeichereintrag | EN: Fault code INDEX_121_IGN - debounce filter increment before fault-memory entry" VALUE 0x718B4 TKW_VV_VV_UB 100.0 FORMULA_0003 0.0 255.0000 /end CHARACTERISTIC
/begin CHARACTERISTIC K_ED_APPL_DATA_IGN.DEC_VOR_EINTRAG "Filterverringerung vorm Fehlerspeichereintrag | EN: Fault code APPL_DATA_IGN - debounce filter decrement before fault-memory entry" VALUE 0x70D89 TKW_VV_VV_UB 100.0 FORMULA_0003 0.0 255.0000 /end CHARACTERISTIC
/begin CHARACTERISTIC K_ED_DK1_CAN.DEC_VOR_EINTRAG "Filterverringerung vorm Fehlerspeichereintrag | EN: Fault code DK1_CAN - debounce filter decrement before fault-memory entry" VALUE 0x70E59 TKW_VV_VV_UB 100.0 FORMULA_0003 0.0 255.0000 /end CHARACTERISTIC
/begin CHARACTERISTIC K_ED_DK2_CAN.DEC_VOR_EINTRAG "Filterverringerung vorm Fehlerspeichereintrag | EN: Fault code DK2_CAN - debounce filter decrement before fault-memory entry" VALUE 0x70E73 TKW_VV_VV_UB 100.0 FORMULA_0003 0.0 255.0000 /end CHARACTERISTIC
/begin CHARACTERISTIC K_ED_DK_INIT.DEC_VOR_EINTRAG "Filterverringerung vorm Fehlerspeichereintrag | EN: Fault code DK_INIT - debounce filter decrement before fault-memory entry" VALUE 0x70F43 TKW_VV_VV_UB 100.0 FORMULA_0003 0.0 255.0000 /end CHARACTERISTIC
/begin CHARACTERISTIC K_ED_DK1_REGLER.DEC_VOR_EINTRAG "Filterverringerung vorm Fehlerspeichereintrag | EN: Fault code DK1_REGLER - debounce filter decrement before fault-memory entry" VALUE 0x70F5D TKW_VV_VV_UB 100.0 FORMULA_0003 0.0 255.0000 /end CHARACTERISTIC
/begin CHARACTERISTIC K_ED_DK2_REGLER.DEC_VOR_EINTRAG "Filterverringerung vorm Fehlerspeichereintrag | EN: Fault code DK2_REGLER - debounce filter decrement before fault-memory entry" VALUE 0x70F77 TKW_VV_VV_UB 100.0 FORMULA_0003 0.0 255.0000 /end CHARACTERISTIC
/begin CHARACTERISTIC K_ED_DK1_ADAPT.DEC_VOR_EINTRAG "Filterverringerung vorm Fehlerspeichereintrag | EN: Fault code DK1_ADAPT - debounce filter decrement before fault-memory entry" VALUE 0x70F91 TKW_VV_VV_UB 100.0 FORMULA_0003 0.0 255.0000 /end CHARACTERISTIC
/begin CHARACTERISTIC K_ED_DK2_ADAPT.DEC_VOR_EINTRAG "Filterverringerung vorm Fehlerspeichereintrag | EN: Fault code DK2_ADAPT - debounce filter decrement before fault-memory entry" VALUE 0x70FAB TKW_VV_VV_UB 100.0 FORMULA_0003 0.0 255.0000 /end CHARACTERISTIC
/begin CHARACTERISTIC K_ED_DK1_WDK.DEC_VOR_EINTRAG "Filterverringerung vorm Fehlerspeichereintrag | EN: Fault code DK1_WDK - debounce filter decrement before fault-memory entry" VALUE 0x71061 TKW_VV_VV_UB 100.0 FORMULA_0003 0.0 255.0000 /end CHARACTERISTIC
/begin CHARACTERISTIC K_ED_DK2_WDK.DEC_VOR_EINTRAG "Filterverringerung vorm Fehlerspeichereintrag | EN: Fault code DK2_WDK - debounce filter decrement before fault-memory entry" VALUE 0x7107B TKW_VV_VV_UB 100.0 FORMULA_0003 0.0 255.0000 /end CHARACTERISTIC
/begin CHARACTERISTIC K_ED_DK1_PDR.DEC_VOR_EINTRAG "Filterverringerung vorm Fehlerspeichereintrag | EN: Fault code DK1_PDR - debounce filter decrement before fault-memory entry" VALUE 0x71095 TKW_VV_VV_UB 100.0 FORMULA_0003 0.0 255.0000 /end CHARACTERISTIC
/begin CHARACTERISTIC K_ED_DK2_PDR.DEC_VOR_EINTRAG "Filterverringerung vorm Fehlerspeichereintrag | EN: Fault code DK2_PDR - debounce filter decrement before fault-memory entry" VALUE 0x710AF TKW_VV_VV_UB 100.0 FORMULA_0003 0.0 255.0000 /end CHARACTERISTIC
/begin CHARACTERISTIC K_ED_DK1_SK_ERR.DEC_VOR_EINTRAG "Filterverringerung vorm Fehlerspeichereintrag | EN: Fault code DK1_SK_ERR - debounce filter decrement before fault-memory entry" VALUE 0x710FD TKW_VV_VV_UB 100.0 FORMULA_0003 0.0 255.0000 /end CHARACTERISTIC
/begin CHARACTERISTIC K_ED_DK2_SK_ERR.DEC_VOR_EINTRAG "Filterverringerung vorm Fehlerspeichereintrag | EN: Fault code DK2_SK_ERR - debounce filter decrement before fault-memory entry" VALUE 0x71117 TKW_VV_VV_UB 100.0 FORMULA_0003 0.0 255.0000 /end CHARACTERISTIC
/begin CHARACTERISTIC K_ED_DK1_FEDERN.DEC_VOR_EINTRAG "Filterverringerung vorm Fehlerspeichereintrag | EN: Fault code DK1_FEDERN - debounce filter decrement before fault-memory entry" VALUE 0x71131 TKW_VV_VV_UB 100.0 FORMULA_0003 0.0 255.0000 /end CHARACTERISTIC
/begin CHARACTERISTIC K_ED_DK2_FEDERN.DEC_VOR_EINTRAG "Filterverringerung vorm Fehlerspeichereintrag | EN: Fault code DK2_FEDERN - debounce filter decrement before fault-memory entry" VALUE 0x7114B TKW_VV_VV_UB 100.0 FORMULA_0003 0.0 255.0000 /end CHARACTERISTIC
/begin CHARACTERISTIC K_ED_DSC_EINGR.DEC_VOR_EINTRAG "Filterverringerung vorm Fehlerspeichereintrag | EN: Fault code DSC_EINGR - debounce filter decrement before fault-memory entry" VALUE 0x71199 TKW_VV_VV_UB 100.0 FORMULA_0003 0.0 255.0000 /end CHARACTERISTIC
/begin CHARACTERISTIC K_ED_DK1_CMD.DEC_VOR_EINTRAG "Filterverringerung vorm Fehlerspeichereintrag | EN: Fault code DK1_CMD - debounce filter decrement before fault-memory entry" VALUE 0x711B3 TKW_VV_VV_UB 100.0 FORMULA_0003 0.0 255.0000 /end CHARACTERISTIC
/begin CHARACTERISTIC K_ED_DK2_CMD.DEC_VOR_EINTRAG "Filterverringerung vorm Fehlerspeichereintrag | EN: Fault code DK2_CMD - debounce filter decrement before fault-memory entry" VALUE 0x711CD TKW_VV_VV_UB 100.0 FORMULA_0003 0.0 255.0000 /end CHARACTERISTIC
/begin CHARACTERISTIC K_ED_EC_BUSOFF.DEC_VOR_EINTRAG "Filterverringerung vorm Fehlerspeichereintrag | EN: Fault code EC_BUSOFF - debounce filter decrement before fault-memory entry" VALUE 0x71283 TKW_VV_VV_UB 100.0 FORMULA_0003 0.0 255.0000 /end CHARACTERISTIC
/begin CHARACTERISTIC K_ED_AUSS_KAT_Z1.DEC_VOR_EINTRAG "Filterverringerung vorm Fehlerspeichereintrag | EN: Fault code AUSS_KAT_Z1 - debounce filter decrement before fault-memory entry" VALUE 0x7129D TKW_VV_VV_UB 100.0 FORMULA_0003 0.0 255.0000 /end CHARACTERISTIC
/begin CHARACTERISTIC K_ED_AUSS_KAT_Z2.DEC_VOR_EINTRAG "Filterverringerung vorm Fehlerspeichereintrag | EN: Fault code AUSS_KAT_Z2 - debounce filter decrement before fault-memory entry" VALUE 0x712B7 TKW_VV_VV_UB 100.0 FORMULA_0003 0.0 255.0000 /end CHARACTERISTIC
/begin CHARACTERISTIC K_ED_AUSS_KAT_Z3.DEC_VOR_EINTRAG "Filterverringerung vorm Fehlerspeichereintrag | EN: Fault code AUSS_KAT_Z3 - debounce filter decrement before fault-memory entry" VALUE 0x712D1 TKW_VV_VV_UB 100.0 FORMULA_0003 0.0 255.0000 /end CHARACTERISTIC
/begin CHARACTERISTIC K_ED_AUSS_KAT_Z4.DEC_VOR_EINTRAG "Filterverringerung vorm Fehlerspeichereintrag | EN: Fault code AUSS_KAT_Z4 - debounce filter decrement before fault-memory entry" VALUE 0x712EB TKW_VV_VV_UB 100.0 FORMULA_0003 0.0 255.0000 /end CHARACTERISTIC
/begin CHARACTERISTIC K_ED_AUSS_KAT_Z5.DEC_VOR_EINTRAG "Filterverringerung vorm Fehlerspeichereintrag | EN: Fault code AUSS_KAT_Z5 - debounce filter decrement before fault-memory entry" VALUE 0x71305 TKW_VV_VV_UB 100.0 FORMULA_0003 0.0 255.0000 /end CHARACTERISTIC
/begin CHARACTERISTIC K_ED_AUSS_KAT_Z6.DEC_VOR_EINTRAG "Filterverringerung vorm Fehlerspeichereintrag | EN: Fault code AUSS_KAT_Z6 - debounce filter decrement before fault-memory entry" VALUE 0x7131F TKW_VV_VV_UB 100.0 FORMULA_0003 0.0 255.0000 /end CHARACTERISTIC
/begin CHARACTERISTIC K_ED_AUSS_KAT_Z7.DEC_VOR_EINTRAG "Filterverringerung vorm Fehlerspeichereintrag | EN: Fault code AUSS_KAT_Z7 - debounce filter decrement before fault-memory entry" VALUE 0x71339 TKW_VV_VV_UB 100.0 FORMULA_0003 0.0 255.0000 /end CHARACTERISTIC
/begin CHARACTERISTIC K_ED_AUSS_KAT_Z8.DEC_VOR_EINTRAG "Filterverringerung vorm Fehlerspeichereintrag | EN: Fault code AUSS_KAT_Z8 - debounce filter decrement before fault-memory entry" VALUE 0x71353 TKW_VV_VV_UB 100.0 FORMULA_0003 0.0 255.0000 /end CHARACTERISTIC
/begin CHARACTERISTIC K_ED_AUSS_KAT_Z9.DEC_VOR_EINTRAG "Filterverringerung vorm Fehlerspeichereintrag | EN: Fault code AUSS_KAT_Z9 - debounce filter decrement before fault-memory entry" VALUE 0x7136D TKW_VV_VV_UB 100.0 FORMULA_0003 0.0 255.0000 /end CHARACTERISTIC
/begin CHARACTERISTIC K_ED_AUSS_KAT_Z10.DEC_VOR_EINTRAG "Filterverringerung vorm Fehlerspeichereintrag | EN: Fault code AUSS_KAT_Z10 - debounce filter decrement before fault-memory entry" VALUE 0x71387 TKW_VV_VV_UB 100.0 FORMULA_0003 0.0 255.0000 /end CHARACTERISTIC
/begin CHARACTERISTIC K_ED_AUSS_KAT_MULT.DEC_VOR_EINTRAG "Filterverringerung vorm Fehlerspeichereintrag | EN: Fault code AUSS_KAT_MULT - debounce filter decrement before fault-memory entry" VALUE 0x713D5 TKW_VV_VV_UB 100.0 FORMULA_0003 0.0 255.0000 /end CHARACTERISTIC
/begin CHARACTERISTIC K_ED_AUSS_ABG_Z1.DEC_VOR_EINTRAG "Filterverringerung vorm Fehlerspeichereintrag | EN: Fault code AUSS_ABG_Z1 - debounce filter decrement before fault-memory entry" VALUE 0x713EF TKW_VV_VV_UB 100.0 FORMULA_0003 0.0 255.0000 /end CHARACTERISTIC
/begin CHARACTERISTIC K_ED_AUSS_ABG_Z2.DEC_VOR_EINTRAG "Filterverringerung vorm Fehlerspeichereintrag | EN: Fault code AUSS_ABG_Z2 - debounce filter decrement before fault-memory entry" VALUE 0x71409 TKW_VV_VV_UB 100.0 FORMULA_0003 0.0 255.0000 /end CHARACTERISTIC
/begin CHARACTERISTIC K_ED_AUSS_ABG_Z3.DEC_VOR_EINTRAG "Filterverringerung vorm Fehlerspeichereintrag | EN: Fault code AUSS_ABG_Z3 - debounce filter decrement before fault-memory entry" VALUE 0x71423 TKW_VV_VV_UB 100.0 FORMULA_0003 0.0 255.0000 /end CHARACTERISTIC
/begin CHARACTERISTIC K_ED_AUSS_ABG_Z4.DEC_VOR_EINTRAG "Filterverringerung vorm Fehlerspeichereintrag | EN: Fault code AUSS_ABG_Z4 - debounce filter decrement before fault-memory entry" VALUE 0x7143D TKW_VV_VV_UB 100.0 FORMULA_0003 0.0 255.0000 /end CHARACTERISTIC
/begin CHARACTERISTIC K_ED_AUSS_ABG_Z5.DEC_VOR_EINTRAG "Filterverringerung vorm Fehlerspeichereintrag | EN: Fault code AUSS_ABG_Z5 - debounce filter decrement before fault-memory entry" VALUE 0x71457 TKW_VV_VV_UB 100.0 FORMULA_0003 0.0 255.0000 /end CHARACTERISTIC
/begin CHARACTERISTIC K_ED_AUSS_ABG_Z6.DEC_VOR_EINTRAG "Filterverringerung vorm Fehlerspeichereintrag | EN: Fault code AUSS_ABG_Z6 - debounce filter decrement before fault-memory entry" VALUE 0x71471 TKW_VV_VV_UB 100.0 FORMULA_0003 0.0 255.0000 /end CHARACTERISTIC
/begin CHARACTERISTIC K_ED_AUSS_ABG_Z7.DEC_VOR_EINTRAG "Filterverringerung vorm Fehlerspeichereintrag | EN: Fault code AUSS_ABG_Z7 - debounce filter decrement before fault-memory entry" VALUE 0x7148B TKW_VV_VV_UB 100.0 FORMULA_0003 0.0 255.0000 /end CHARACTERISTIC
/begin CHARACTERISTIC K_ED_AUSS_ABG_Z8.DEC_VOR_EINTRAG "Filterverringerung vorm Fehlerspeichereintrag | EN: Fault code AUSS_ABG_Z8 - debounce filter decrement before fault-memory entry" VALUE 0x714A5 TKW_VV_VV_UB 100.0 FORMULA_0003 0.0 255.0000 /end CHARACTERISTIC
/begin CHARACTERISTIC K_ED_AUSS_ABG_Z9.DEC_VOR_EINTRAG "Filterverringerung vorm Fehlerspeichereintrag" VALUE 0x714BF TKW_VV_VV_UB 100.0 FORMULA_0003 0.0 255.0000 /end CHARACTERISTIC
/begin CHARACTERISTIC K_ED_AUSS_ABG_Z10.DEC_VOR_EINTRAG "Filterverringerung vorm Fehlerspeichereintrag" VALUE 0x714D9 TKW_VV_VV_UB 100.0 FORMULA_0003 0.0 255.0000 /end CHARACTERISTIC
/begin CHARACTERISTIC K_ED_AUSS_ABG_MULT.DEC_VOR_EINTRAG "Filterverringerung vorm Fehlerspeichereintrag" VALUE 0x71527 TKW_VV_VV_UB 100.0 FORMULA_0003 0.0 255.0000 /end CHARACTERISTIC
/begin CHARACTERISTIC K_ED_E2_IGN.DEC_VOR_EINTRAG "Filterverringerung vorm Fehlerspeichereintrag | EN: Fault code E2_IGN - debounce filter decrement before fault-memory entry" VALUE 0x715DD TKW_VV_VV_UB 100.0 FORMULA_0003 0.0 255.0000 /end CHARACTERISTIC
/begin CHARACTERISTIC K_ED_BLS_PLAU.DEC_VOR_EINTRAG "Filterverringerung vorm Fehlerspeichereintrag | EN: Fault code BLS_PLAU - debounce filter decrement before fault-memory entry" VALUE 0x715F7 TKW_VV_VV_UB 100.0 FORMULA_0003 0.0 255.0000 /end CHARACTERISTIC
/begin CHARACTERISTIC K_ED_DK1_ZUST.DEC_VOR_EINTRAG "Filterverringerung vorm Fehlerspeichereintrag | EN: Fault code DK1_ZUST - debounce filter decrement before fault-memory entry" VALUE 0x71679 TKW_VV_VV_UB 100.0 FORMULA_0003 0.0 255.0000 /end CHARACTERISTIC
/begin CHARACTERISTIC K_ED_DK2_ZUST.DEC_VOR_EINTRAG "Filterverringerung vorm Fehlerspeichereintrag | EN: Fault code DK2_ZUST - debounce filter decrement before fault-memory entry" VALUE 0x71693 TKW_VV_VV_UB 100.0 FORMULA_0003 0.0 255.0000 /end CHARACTERISTIC
/begin CHARACTERISTIC K_ED_FGR_ABWURF.DEC_VOR_EINTRAG "Filterverringerung vorm Fehlerspeichereintrag | EN: Fault code FGR_ABWURF - debounce filter decrement before fault-memory entry" VALUE 0x716AD TKW_VV_VV_UB 100.0 FORMULA_0003 0.0 255.0000 /end CHARACTERISTIC
/begin CHARACTERISTIC K_ED_AFZ_HS.DEC_VOR_EINTRAG "Filterverringerung vorm Fehlerspeichereintrag | EN: Fault code AFZ_HS - debounce filter decrement before fault-memory entry" VALUE 0x716FB TKW_VV_VV_UB 100.0 FORMULA_0003 0.0 255.0000 /end CHARACTERISTIC
/begin CHARACTERISTIC K_ED_AFZ_HS_NA.DEC_VOR_EINTRAG "Filterverringerung vorm Fehlerspeichereintrag" VALUE 0x7177D TKW_VV_VV_UB 100.0 FORMULA_0003 0.0 255.0000 /end CHARACTERISTIC
/begin CHARACTERISTIC K_ED_INDEX_110_IGN.DEC_VOR_EINTRAG "Filterverringerung vorm Fehlerspeichereintrag" VALUE 0x71797 TKW_VV_VV_UB 100.0 FORMULA_0003 0.0 255.0000 /end CHARACTERISTIC
/begin CHARACTERISTIC K_ED_INDEX_111_IGN.DEC_VOR_EINTRAG "Filterverringerung vorm Fehlerspeichereintrag" VALUE 0x717B1 TKW_VV_VV_UB 100.0 FORMULA_0003 0.0 255.0000 /end CHARACTERISTIC
/begin CHARACTERISTIC K_ED_INDEX_112_IGN.DEC_VOR_EINTRAG "Filterverringerung vorm Fehlerspeichereintrag" VALUE 0x717CB TKW_VV_VV_UB 100.0 FORMULA_0003 0.0 255.0000 /end CHARACTERISTIC
/begin CHARACTERISTIC K_ED_INDEX_113_IGN.DEC_VOR_EINTRAG "Filterverringerung vorm Fehlerspeichereintrag" VALUE 0x717E5 TKW_VV_VV_UB 100.0 FORMULA_0003 0.0 255.0000 /end CHARACTERISTIC
/begin CHARACTERISTIC K_ED_INDEX_114_IGN.DEC_VOR_EINTRAG "Filterverringerung vorm Fehlerspeichereintrag" VALUE 0x717FF TKW_VV_VV_UB 100.0 FORMULA_0003 0.0 255.0000 /end CHARACTERISTIC
/begin CHARACTERISTIC K_ED_INDEX_115_IGN.DEC_VOR_EINTRAG "Filterverringerung vorm Fehlerspeichereintrag" VALUE 0x71819 TKW_VV_VV_UB 100.0 FORMULA_0003 0.0 255.0000 /end CHARACTERISTIC
/begin CHARACTERISTIC K_ED_INDEX_116_IGN.DEC_VOR_EINTRAG "Filterverringerung vorm Fehlerspeichereintrag" VALUE 0x71833 TKW_VV_VV_UB 100.0 FORMULA_0003 0.0 255.0000 /end CHARACTERISTIC
/begin CHARACTERISTIC K_ED_INDEX_117_IGN.DEC_VOR_EINTRAG "Filterverringerung vorm Fehlerspeichereintrag" VALUE 0x7184D TKW_VV_VV_UB 100.0 FORMULA_0003 0.0 255.0000 /end CHARACTERISTIC
/begin CHARACTERISTIC K_ED_INDEX_118_IGN.DEC_VOR_EINTRAG "Filterverringerung vorm Fehlerspeichereintrag" VALUE 0x71867 TKW_VV_VV_UB 100.0 FORMULA_0003 0.0 255.0000 /end CHARACTERISTIC
/begin CHARACTERISTIC K_ED_INDEX_119_IGN.DEC_VOR_EINTRAG "Filterverringerung vorm Fehlerspeichereintrag" VALUE 0x71881 TKW_VV_VV_UB 100.0 FORMULA_0003 0.0 255.0000 /end CHARACTERISTIC
/begin CHARACTERISTIC K_ED_INDEX_120_IGN.DEC_VOR_EINTRAG "Filterverringerung vorm Fehlerspeichereintrag" VALUE 0x7189B TKW_VV_VV_UB 100.0 FORMULA_0003 0.0 255.0000 /end CHARACTERISTIC
/begin CHARACTERISTIC K_ED_INDEX_121_IGN.DEC_VOR_EINTRAG "Filterverringerung vorm Fehlerspeichereintrag | EN: Fault code INDEX_121_IGN - debounce filter decrement before fault-memory entry" VALUE 0x718B5 TKW_VV_VV_UB 100.0 FORMULA_0003 0.0 255.0000 /end CHARACTERISTIC
/begin CHARACTERISTIC K_ED_APPL_DATA_IGN.INC_NACH_EINTRAG "Filtererhoehung nach Fehlerspeichereintrag | EN: Fault code APPL_DATA_IGN - debounce filter increment after fault-memory entry" VALUE 0x70D8A TKW_VV_VV_UB 100.0 FORMULA_0003 0.0 255.0000 /end CHARACTERISTIC
/begin CHARACTERISTIC K_ED_DK1_CAN.INC_NACH_EINTRAG "Filtererhoehung nach Fehlerspeichereintrag | EN: Fault code DK1_CAN - debounce filter increment after fault-memory entry" VALUE 0x70E5A TKW_VV_VV_UB 100.0 FORMULA_0003 0.0 255.0000 /end CHARACTERISTIC
/begin CHARACTERISTIC K_ED_DK2_CAN.INC_NACH_EINTRAG "Filtererhoehung nach Fehlerspeichereintrag | EN: Fault code DK2_CAN - debounce filter increment after fault-memory entry" VALUE 0x70E74 TKW_VV_VV_UB 100.0 FORMULA_0003 0.0 255.0000 /end CHARACTERISTIC
/begin CHARACTERISTIC K_ED_DK_INIT.INC_NACH_EINTRAG "Filtererhoehung nach Fehlerspeichereintrag | EN: Fault code DK_INIT - debounce filter increment after fault-memory entry" VALUE 0x70F44 TKW_VV_VV_UB 100.0 FORMULA_0003 0.0 255.0000 /end CHARACTERISTIC
/begin CHARACTERISTIC K_ED_DK1_REGLER.INC_NACH_EINTRAG "Filtererhoehung nach Fehlerspeichereintrag | EN: Fault code DK1_REGLER - debounce filter increment after fault-memory entry" VALUE 0x70F5E TKW_VV_VV_UB 100.0 FORMULA_0003 0.0 255.0000 /end CHARACTERISTIC
/begin CHARACTERISTIC K_ED_DK2_REGLER.INC_NACH_EINTRAG "Filtererhoehung nach Fehlerspeichereintrag | EN: Fault code DK2_REGLER - debounce filter increment after fault-memory entry" VALUE 0x70F78 TKW_VV_VV_UB 100.0 FORMULA_0003 0.0 255.0000 /end CHARACTERISTIC
/begin CHARACTERISTIC K_ED_DK1_ADAPT.INC_NACH_EINTRAG "Filtererhoehung nach Fehlerspeichereintrag | EN: Fault code DK1_ADAPT - debounce filter increment after fault-memory entry" VALUE 0x70F92 TKW_VV_VV_UB 100.0 FORMULA_0003 0.0 255.0000 /end CHARACTERISTIC
/begin CHARACTERISTIC K_ED_DK2_ADAPT.INC_NACH_EINTRAG "Filtererhoehung nach Fehlerspeichereintrag | EN: Fault code DK2_ADAPT - debounce filter increment after fault-memory entry" VALUE 0x70FAC TKW_VV_VV_UB 100.0 FORMULA_0003 0.0 255.0000 /end CHARACTERISTIC
/begin CHARACTERISTIC K_ED_DK1_WDK.INC_NACH_EINTRAG "Filtererhoehung nach Fehlerspeichereintrag | EN: Fault code DK1_WDK - debounce filter increment after fault-memory entry" VALUE 0x71062 TKW_VV_VV_UB 100.0 FORMULA_0003 0.0 255.0000 /end CHARACTERISTIC
/begin CHARACTERISTIC K_ED_DK2_WDK.INC_NACH_EINTRAG "Filtererhoehung nach Fehlerspeichereintrag | EN: Fault code DK2_WDK - debounce filter increment after fault-memory entry" VALUE 0x7107C TKW_VV_VV_UB 100.0 FORMULA_0003 0.0 255.0000 /end CHARACTERISTIC
/begin CHARACTERISTIC K_ED_DK1_PDR.INC_NACH_EINTRAG "Filtererhoehung nach Fehlerspeichereintrag | EN: Fault code DK1_PDR - debounce filter increment after fault-memory entry" VALUE 0x71096 TKW_VV_VV_UB 100.0 FORMULA_0003 0.0 255.0000 /end CHARACTERISTIC
/begin CHARACTERISTIC K_ED_DK2_PDR.INC_NACH_EINTRAG "Filtererhoehung nach Fehlerspeichereintrag | EN: Fault code DK2_PDR - debounce filter increment after fault-memory entry" VALUE 0x710B0 TKW_VV_VV_UB 100.0 FORMULA_0003 0.0 255.0000 /end CHARACTERISTIC
/begin CHARACTERISTIC K_ED_DK1_SK_ERR.INC_NACH_EINTRAG "Filtererhoehung nach Fehlerspeichereintrag | EN: Fault code DK1_SK_ERR - debounce filter increment after fault-memory entry" VALUE 0x710FE TKW_VV_VV_UB 100.0 FORMULA_0003 0.0 255.0000 /end CHARACTERISTIC
/begin CHARACTERISTIC K_ED_DK2_SK_ERR.INC_NACH_EINTRAG "Filtererhoehung nach Fehlerspeichereintrag | EN: Fault code DK2_SK_ERR - debounce filter increment after fault-memory entry" VALUE 0x71118 TKW_VV_VV_UB 100.0 FORMULA_0003 0.0 255.0000 /end CHARACTERISTIC
/begin CHARACTERISTIC K_ED_DK1_FEDERN.INC_NACH_EINTRAG "Filtererhoehung nach Fehlerspeichereintrag | EN: Fault code DK1_FEDERN - debounce filter increment after fault-memory entry" VALUE 0x71132 TKW_VV_VV_UB 100.0 FORMULA_0003 0.0 255.0000 /end CHARACTERISTIC
/begin CHARACTERISTIC K_ED_DK2_FEDERN.INC_NACH_EINTRAG "Filtererhoehung nach Fehlerspeichereintrag | EN: Fault code DK2_FEDERN - debounce filter increment after fault-memory entry" VALUE 0x7114C TKW_VV_VV_UB 100.0 FORMULA_0003 0.0 255.0000 /end CHARACTERISTIC
/begin CHARACTERISTIC K_ED_DSC_EINGR.INC_NACH_EINTRAG "Filtererhoehung nach Fehlerspeichereintrag | EN: Fault code DSC_EINGR - debounce filter increment after fault-memory entry" VALUE 0x7119A TKW_VV_VV_UB 100.0 FORMULA_0003 0.0 255.0000 /end CHARACTERISTIC
/begin CHARACTERISTIC K_ED_DK1_CMD.INC_NACH_EINTRAG "Filtererhoehung nach Fehlerspeichereintrag | EN: Fault code DK1_CMD - debounce filter increment after fault-memory entry" VALUE 0x711B4 TKW_VV_VV_UB 100.0 FORMULA_0003 0.0 255.0000 /end CHARACTERISTIC
/begin CHARACTERISTIC K_ED_DK2_CMD.INC_NACH_EINTRAG "Filtererhoehung nach Fehlerspeichereintrag | EN: Fault code DK2_CMD - debounce filter increment after fault-memory entry" VALUE 0x711CE TKW_VV_VV_UB 100.0 FORMULA_0003 0.0 255.0000 /end CHARACTERISTIC
/begin CHARACTERISTIC K_ED_EC_BUSOFF.INC_NACH_EINTRAG "Filtererhoehung nach Fehlerspeichereintrag | EN: Fault code EC_BUSOFF - debounce filter increment after fault-memory entry" VALUE 0x71284 TKW_VV_VV_UB 100.0 FORMULA_0003 0.0 255.0000 /end CHARACTERISTIC
/begin CHARACTERISTIC K_ED_AUSS_KAT_Z1.INC_NACH_EINTRAG "Filtererhoehung nach Fehlerspeichereintrag | EN: Fault code AUSS_KAT_Z1 - debounce filter increment after fault-memory entry" VALUE 0x7129E TKW_VV_VV_UB 100.0 FORMULA_0003 0.0 255.0000 /end CHARACTERISTIC
/begin CHARACTERISTIC K_ED_AUSS_KAT_Z2.INC_NACH_EINTRAG "Filtererhoehung nach Fehlerspeichereintrag | EN: Fault code AUSS_KAT_Z2 - debounce filter increment after fault-memory entry" VALUE 0x712B8 TKW_VV_VV_UB 100.0 FORMULA_0003 0.0 255.0000 /end CHARACTERISTIC
/begin CHARACTERISTIC K_ED_AUSS_KAT_Z3.INC_NACH_EINTRAG "Filtererhoehung nach Fehlerspeichereintrag | EN: Fault code AUSS_KAT_Z3 - debounce filter increment after fault-memory entry" VALUE 0x712D2 TKW_VV_VV_UB 100.0 FORMULA_0003 0.0 255.0000 /end CHARACTERISTIC
/begin CHARACTERISTIC K_ED_AUSS_KAT_Z4.INC_NACH_EINTRAG "Filtererhoehung nach Fehlerspeichereintrag | EN: Fault code AUSS_KAT_Z4 - debounce filter increment after fault-memory entry" VALUE 0x712EC TKW_VV_VV_UB 100.0 FORMULA_0003 0.0 255.0000 /end CHARACTERISTIC
/begin CHARACTERISTIC K_ED_AUSS_KAT_Z5.INC_NACH_EINTRAG "Filtererhoehung nach Fehlerspeichereintrag | EN: Fault code AUSS_KAT_Z5 - debounce filter increment after fault-memory entry" VALUE 0x71306 TKW_VV_VV_UB 100.0 FORMULA_0003 0.0 255.0000 /end CHARACTERISTIC
/begin CHARACTERISTIC K_ED_AUSS_KAT_Z6.INC_NACH_EINTRAG "Filtererhoehung nach Fehlerspeichereintrag | EN: Fault code AUSS_KAT_Z6 - debounce filter increment after fault-memory entry" VALUE 0x71320 TKW_VV_VV_UB 100.0 FORMULA_0003 0.0 255.0000 /end CHARACTERISTIC
/begin CHARACTERISTIC K_ED_AUSS_KAT_Z7.INC_NACH_EINTRAG "Filtererhoehung nach Fehlerspeichereintrag | EN: Fault code AUSS_KAT_Z7 - debounce filter increment after fault-memory entry" VALUE 0x7133A TKW_VV_VV_UB 100.0 FORMULA_0003 0.0 255.0000 /end CHARACTERISTIC
/begin CHARACTERISTIC K_ED_AUSS_KAT_Z8.INC_NACH_EINTRAG "Filtererhoehung nach Fehlerspeichereintrag | EN: Fault code AUSS_KAT_Z8 - debounce filter increment after fault-memory entry" VALUE 0x71354 TKW_VV_VV_UB 100.0 FORMULA_0003 0.0 255.0000 /end CHARACTERISTIC
/begin CHARACTERISTIC K_ED_AUSS_KAT_Z9.INC_NACH_EINTRAG "Filtererhoehung nach Fehlerspeichereintrag | EN: Fault code AUSS_KAT_Z9 - debounce filter increment after fault-memory entry" VALUE 0x7136E TKW_VV_VV_UB 100.0 FORMULA_0003 0.0 255.0000 /end CHARACTERISTIC
/begin CHARACTERISTIC K_ED_AUSS_KAT_Z10.INC_NACH_EINTRAG "Filtererhoehung nach Fehlerspeichereintrag | EN: Fault code AUSS_KAT_Z10 - debounce filter increment after fault-memory entry" VALUE 0x71388 TKW_VV_VV_UB 100.0 FORMULA_0003 0.0 255.0000 /end CHARACTERISTIC
/begin CHARACTERISTIC K_ED_AUSS_KAT_MULT.INC_NACH_EINTRAG "Filtererhoehung nach Fehlerspeichereintrag | EN: Fault code AUSS_KAT_MULT - debounce filter increment after fault-memory entry" VALUE 0x713D6 TKW_VV_VV_UB 100.0 FORMULA_0003 0.0 255.0000 /end CHARACTERISTIC
/begin CHARACTERISTIC K_ED_AUSS_ABG_Z1.INC_NACH_EINTRAG "Filtererhoehung nach Fehlerspeichereintrag | EN: Fault code AUSS_ABG_Z1 - debounce filter increment after fault-memory entry" VALUE 0x713F0 TKW_VV_VV_UB 100.0 FORMULA_0003 0.0 255.0000 /end CHARACTERISTIC
/begin CHARACTERISTIC K_ED_AUSS_ABG_Z2.INC_NACH_EINTRAG "Filtererhoehung nach Fehlerspeichereintrag | EN: Fault code AUSS_ABG_Z2 - debounce filter increment after fault-memory entry" VALUE 0x7140A TKW_VV_VV_UB 100.0 FORMULA_0003 0.0 255.0000 /end CHARACTERISTIC
/begin CHARACTERISTIC K_ED_AUSS_ABG_Z3.INC_NACH_EINTRAG "Filtererhoehung nach Fehlerspeichereintrag | EN: Fault code AUSS_ABG_Z3 - debounce filter increment after fault-memory entry" VALUE 0x71424 TKW_VV_VV_UB 100.0 FORMULA_0003 0.0 255.0000 /end CHARACTERISTIC
/begin CHARACTERISTIC K_ED_AUSS_ABG_Z4.INC_NACH_EINTRAG "Filtererhoehung nach Fehlerspeichereintrag | EN: Fault code AUSS_ABG_Z4 - debounce filter increment after fault-memory entry" VALUE 0x7143E TKW_VV_VV_UB 100.0 FORMULA_0003 0.0 255.0000 /end CHARACTERISTIC
/begin CHARACTERISTIC K_ED_AUSS_ABG_Z5.INC_NACH_EINTRAG "Filtererhoehung nach Fehlerspeichereintrag | EN: Fault code AUSS_ABG_Z5 - debounce filter increment after fault-memory entry" VALUE 0x71458 TKW_VV_VV_UB 100.0 FORMULA_0003 0.0 255.0000 /end CHARACTERISTIC
/begin CHARACTERISTIC K_ED_AUSS_ABG_Z6.INC_NACH_EINTRAG "Filtererhoehung nach Fehlerspeichereintrag | EN: Fault code AUSS_ABG_Z6 - debounce filter increment after fault-memory entry" VALUE 0x71472 TKW_VV_VV_UB 100.0 FORMULA_0003 0.0 255.0000 /end CHARACTERISTIC
/begin CHARACTERISTIC K_ED_AUSS_ABG_Z7.INC_NACH_EINTRAG "Filtererhoehung nach Fehlerspeichereintrag | EN: Fault code AUSS_ABG_Z7 - debounce filter increment after fault-memory entry" VALUE 0x7148C TKW_VV_VV_UB 100.0 FORMULA_0003 0.0 255.0000 /end CHARACTERISTIC
/begin CHARACTERISTIC K_ED_AUSS_ABG_Z8.INC_NACH_EINTRAG "Filtererhoehung nach Fehlerspeichereintrag | EN: Fault code AUSS_ABG_Z8 - debounce filter increment after fault-memory entry" VALUE 0x714A6 TKW_VV_VV_UB 100.0 FORMULA_0003 0.0 255.0000 /end CHARACTERISTIC
/begin CHARACTERISTIC K_ED_AUSS_ABG_Z9.INC_NACH_EINTRAG "Filtererhoehung nach Fehlerspeichereintrag" VALUE 0x714C0 TKW_VV_VV_UB 100.0 FORMULA_0003 0.0 255.0000 /end CHARACTERISTIC
/begin CHARACTERISTIC K_ED_AUSS_ABG_Z10.INC_NACH_EINTRAG "Filtererhoehung nach Fehlerspeichereintrag" VALUE 0x714DA TKW_VV_VV_UB 100.0 FORMULA_0003 0.0 255.0000 /end CHARACTERISTIC
/begin CHARACTERISTIC K_ED_AUSS_ABG_MULT.INC_NACH_EINTRAG "Filtererhoehung nach Fehlerspeichereintrag" VALUE 0x71528 TKW_VV_VV_UB 100.0 FORMULA_0003 0.0 255.0000 /end CHARACTERISTIC
/begin CHARACTERISTIC K_ED_E2_IGN.INC_NACH_EINTRAG "Filtererhoehung nach Fehlerspeichereintrag | EN: Fault code E2_IGN - debounce filter increment after fault-memory entry" VALUE 0x715DE TKW_VV_VV_UB 100.0 FORMULA_0003 0.0 255.0000 /end CHARACTERISTIC
/begin CHARACTERISTIC K_ED_BLS_PLAU.INC_NACH_EINTRAG "Filtererhoehung nach Fehlerspeichereintrag | EN: Fault code BLS_PLAU - debounce filter increment after fault-memory entry" VALUE 0x715F8 TKW_VV_VV_UB 100.0 FORMULA_0003 0.0 255.0000 /end CHARACTERISTIC
/begin CHARACTERISTIC K_ED_DK1_ZUST.INC_NACH_EINTRAG "Filtererhoehung nach Fehlerspeichereintrag | EN: Fault code DK1_ZUST - debounce filter increment after fault-memory entry" VALUE 0x7167A TKW_VV_VV_UB 100.0 FORMULA_0003 0.0 255.0000 /end CHARACTERISTIC
/begin CHARACTERISTIC K_ED_DK2_ZUST.INC_NACH_EINTRAG "Filtererhoehung nach Fehlerspeichereintrag | EN: Fault code DK2_ZUST - debounce filter increment after fault-memory entry" VALUE 0x71694 TKW_VV_VV_UB 100.0 FORMULA_0003 0.0 255.0000 /end CHARACTERISTIC
/begin CHARACTERISTIC K_ED_FGR_ABWURF.INC_NACH_EINTRAG "Filtererhoehung nach Fehlerspeichereintrag | EN: Fault code FGR_ABWURF - debounce filter increment after fault-memory entry" VALUE 0x716AE TKW_VV_VV_UB 100.0 FORMULA_0003 0.0 255.0000 /end CHARACTERISTIC
/begin CHARACTERISTIC K_ED_AFZ_HS.INC_NACH_EINTRAG "Filtererhoehung nach Fehlerspeichereintrag | EN: Fault code AFZ_HS - debounce filter increment after fault-memory entry" VALUE 0x716FC TKW_VV_VV_UB 100.0 FORMULA_0003 0.0 255.0000 /end CHARACTERISTIC
/begin CHARACTERISTIC K_ED_AFZ_HS_NA.INC_NACH_EINTRAG "Filtererhoehung nach Fehlerspeichereintrag" VALUE 0x7177E TKW_VV_VV_UB 100.0 FORMULA_0003 0.0 255.0000 /end CHARACTERISTIC
/begin CHARACTERISTIC K_ED_INDEX_110_IGN.INC_NACH_EINTRAG "Filtererhoehung nach Fehlerspeichereintrag" VALUE 0x71798 TKW_VV_VV_UB 100.0 FORMULA_0003 0.0 255.0000 /end CHARACTERISTIC
/begin CHARACTERISTIC K_ED_INDEX_111_IGN.INC_NACH_EINTRAG "Filtererhoehung nach Fehlerspeichereintrag" VALUE 0x717B2 TKW_VV_VV_UB 100.0 FORMULA_0003 0.0 255.0000 /end CHARACTERISTIC
/begin CHARACTERISTIC K_ED_INDEX_112_IGN.INC_NACH_EINTRAG "Filtererhoehung nach Fehlerspeichereintrag" VALUE 0x717CC TKW_VV_VV_UB 100.0 FORMULA_0003 0.0 255.0000 /end CHARACTERISTIC
/begin CHARACTERISTIC K_ED_INDEX_113_IGN.INC_NACH_EINTRAG "Filtererhoehung nach Fehlerspeichereintrag" VALUE 0x717E6 TKW_VV_VV_UB 100.0 FORMULA_0003 0.0 255.0000 /end CHARACTERISTIC
/begin CHARACTERISTIC K_ED_INDEX_114_IGN.INC_NACH_EINTRAG "Filtererhoehung nach Fehlerspeichereintrag" VALUE 0x71800 TKW_VV_VV_UB 100.0 FORMULA_0003 0.0 255.0000 /end CHARACTERISTIC
/begin CHARACTERISTIC K_ED_INDEX_115_IGN.INC_NACH_EINTRAG "Filtererhoehung nach Fehlerspeichereintrag" VALUE 0x7181A TKW_VV_VV_UB 100.0 FORMULA_0003 0.0 255.0000 /end CHARACTERISTIC
/begin CHARACTERISTIC K_ED_INDEX_116_IGN.INC_NACH_EINTRAG "Filtererhoehung nach Fehlerspeichereintrag" VALUE 0x71834 TKW_VV_VV_UB 100.0 FORMULA_0003 0.0 255.0000 /end CHARACTERISTIC
/begin CHARACTERISTIC K_ED_INDEX_117_IGN.INC_NACH_EINTRAG "Filtererhoehung nach Fehlerspeichereintrag" VALUE 0x7184E TKW_VV_VV_UB 100.0 FORMULA_0003 0.0 255.0000 /end CHARACTERISTIC
/begin CHARACTERISTIC K_ED_INDEX_118_IGN.INC_NACH_EINTRAG "Filtererhoehung nach Fehlerspeichereintrag" VALUE 0x71868 TKW_VV_VV_UB 100.0 FORMULA_0003 0.0 255.0000 /end CHARACTERISTIC
/begin CHARACTERISTIC K_ED_INDEX_119_IGN.INC_NACH_EINTRAG "Filtererhoehung nach Fehlerspeichereintrag" VALUE 0x71882 TKW_VV_VV_UB 100.0 FORMULA_0003 0.0 255.0000 /end CHARACTERISTIC
/begin CHARACTERISTIC K_ED_INDEX_120_IGN.INC_NACH_EINTRAG "Filtererhoehung nach Fehlerspeichereintrag" VALUE 0x7189C TKW_VV_VV_UB 100.0 FORMULA_0003 0.0 255.0000 /end CHARACTERISTIC
/begin CHARACTERISTIC K_ED_INDEX_121_IGN.INC_NACH_EINTRAG "Filtererhoehung nach Fehlerspeichereintrag | EN: Fault code INDEX_121_IGN - debounce filter increment after fault-memory entry" VALUE 0x718B6 TKW_VV_VV_UB 100.0 FORMULA_0003 0.0 255.0000 /end CHARACTERISTIC
/begin CHARACTERISTIC K_ED_APPL_DATA_IGN.DEC_NACH_EINTRAG "Filterverringerung nach Fehlerspeichereintrag | EN: Fault code APPL_DATA_IGN - debounce filter decrement after fault-memory entry" VALUE 0x70D8B TKW_VV_VV_UB 100.0 FORMULA_0003 0.0 255.0000 /end CHARACTERISTIC
/begin CHARACTERISTIC K_ED_DK1_CAN.DEC_NACH_EINTRAG "Filterverringerung nach Fehlerspeichereintrag | EN: Fault code DK1_CAN - debounce filter decrement after fault-memory entry" VALUE 0x70E5B TKW_VV_VV_UB 100.0 FORMULA_0003 0.0 255.0000 /end CHARACTERISTIC
/begin CHARACTERISTIC K_ED_DK2_CAN.DEC_NACH_EINTRAG "Filterverringerung nach Fehlerspeichereintrag | EN: Fault code DK2_CAN - debounce filter decrement after fault-memory entry" VALUE 0x70E75 TKW_VV_VV_UB 100.0 FORMULA_0003 0.0 255.0000 /end CHARACTERISTIC
/begin CHARACTERISTIC K_ED_DK_INIT.DEC_NACH_EINTRAG "Filterverringerung nach Fehlerspeichereintrag | EN: Fault code DK_INIT - debounce filter decrement after fault-memory entry" VALUE 0x70F45 TKW_VV_VV_UB 100.0 FORMULA_0003 0.0 255.0000 /end CHARACTERISTIC
/begin CHARACTERISTIC K_ED_DK1_REGLER.DEC_NACH_EINTRAG "Filterverringerung nach Fehlerspeichereintrag | EN: Fault code DK1_REGLER - debounce filter decrement after fault-memory entry" VALUE 0x70F5F TKW_VV_VV_UB 100.0 FORMULA_0003 0.0 255.0000 /end CHARACTERISTIC
/begin CHARACTERISTIC K_ED_DK2_REGLER.DEC_NACH_EINTRAG "Filterverringerung nach Fehlerspeichereintrag | EN: Fault code DK2_REGLER - debounce filter decrement after fault-memory entry" VALUE 0x70F79 TKW_VV_VV_UB 100.0 FORMULA_0003 0.0 255.0000 /end CHARACTERISTIC
/begin CHARACTERISTIC K_ED_DK1_ADAPT.DEC_NACH_EINTRAG "Filterverringerung nach Fehlerspeichereintrag | EN: Fault code DK1_ADAPT - debounce filter decrement after fault-memory entry" VALUE 0x70F93 TKW_VV_VV_UB 100.0 FORMULA_0003 0.0 255.0000 /end CHARACTERISTIC
/begin CHARACTERISTIC K_ED_DK2_ADAPT.DEC_NACH_EINTRAG "Filterverringerung nach Fehlerspeichereintrag | EN: Fault code DK2_ADAPT - debounce filter decrement after fault-memory entry" VALUE 0x70FAD TKW_VV_VV_UB 100.0 FORMULA_0003 0.0 255.0000 /end CHARACTERISTIC
/begin CHARACTERISTIC K_ED_DK1_WDK.DEC_NACH_EINTRAG "Filterverringerung nach Fehlerspeichereintrag | EN: Fault code DK1_WDK - debounce filter decrement after fault-memory entry" VALUE 0x71063 TKW_VV_VV_UB 100.0 FORMULA_0003 0.0 255.0000 /end CHARACTERISTIC
/begin CHARACTERISTIC K_ED_DK2_WDK.DEC_NACH_EINTRAG "Filterverringerung nach Fehlerspeichereintrag | EN: Fault code DK2_WDK - debounce filter decrement after fault-memory entry" VALUE 0x7107D TKW_VV_VV_UB 100.0 FORMULA_0003 0.0 255.0000 /end CHARACTERISTIC
/begin CHARACTERISTIC K_ED_DK1_PDR.DEC_NACH_EINTRAG "Filterverringerung nach Fehlerspeichereintrag | EN: Fault code DK1_PDR - debounce filter decrement after fault-memory entry" VALUE 0x71097 TKW_VV_VV_UB 100.0 FORMULA_0003 0.0 255.0000 /end CHARACTERISTIC
/begin CHARACTERISTIC K_ED_DK2_PDR.DEC_NACH_EINTRAG "Filterverringerung nach Fehlerspeichereintrag | EN: Fault code DK2_PDR - debounce filter decrement after fault-memory entry" VALUE 0x710B1 TKW_VV_VV_UB 100.0 FORMULA_0003 0.0 255.0000 /end CHARACTERISTIC
/begin CHARACTERISTIC K_ED_DK1_SK_ERR.DEC_NACH_EINTRAG "Filterverringerung nach Fehlerspeichereintrag | EN: Fault code DK1_SK_ERR - debounce filter decrement after fault-memory entry" VALUE 0x710FF TKW_VV_VV_UB 100.0 FORMULA_0003 0.0 255.0000 /end CHARACTERISTIC
/begin CHARACTERISTIC K_ED_DK2_SK_ERR.DEC_NACH_EINTRAG "Filterverringerung nach Fehlerspeichereintrag | EN: Fault code DK2_SK_ERR - debounce filter decrement after fault-memory entry" VALUE 0x71119 TKW_VV_VV_UB 100.0 FORMULA_0003 0.0 255.0000 /end CHARACTERISTIC
/begin CHARACTERISTIC K_ED_DK1_FEDERN.DEC_NACH_EINTRAG "Filterverringerung nach Fehlerspeichereintrag | EN: Fault code DK1_FEDERN - debounce filter decrement after fault-memory entry" VALUE 0x71133 TKW_VV_VV_UB 100.0 FORMULA_0003 0.0 255.0000 /end CHARACTERISTIC
/begin CHARACTERISTIC K_ED_DK2_FEDERN.DEC_NACH_EINTRAG "Filterverringerung nach Fehlerspeichereintrag | EN: Fault code DK2_FEDERN - debounce filter decrement after fault-memory entry" VALUE 0x7114D TKW_VV_VV_UB 100.0 FORMULA_0003 0.0 255.0000 /end CHARACTERISTIC
/begin CHARACTERISTIC K_ED_DSC_EINGR.DEC_NACH_EINTRAG "Filterverringerung nach Fehlerspeichereintrag | EN: Fault code DSC_EINGR - debounce filter decrement after fault-memory entry" VALUE 0x7119B TKW_VV_VV_UB 100.0 FORMULA_0003 0.0 255.0000 /end CHARACTERISTIC
/begin CHARACTERISTIC K_ED_DK1_CMD.DEC_NACH_EINTRAG "Filterverringerung nach Fehlerspeichereintrag | EN: Fault code DK1_CMD - debounce filter decrement after fault-memory entry" VALUE 0x711B5 TKW_VV_VV_UB 100.0 FORMULA_0003 0.0 255.0000 /end CHARACTERISTIC
/begin CHARACTERISTIC K_ED_DK2_CMD.DEC_NACH_EINTRAG "Filterverringerung nach Fehlerspeichereintrag | EN: Fault code DK2_CMD - debounce filter decrement after fault-memory entry" VALUE 0x711CF TKW_VV_VV_UB 100.0 FORMULA_0003 0.0 255.0000 /end CHARACTERISTIC
/begin CHARACTERISTIC K_ED_EC_BUSOFF.DEC_NACH_EINTRAG "Filterverringerung nach Fehlerspeichereintrag | EN: Fault code EC_BUSOFF - debounce filter decrement after fault-memory entry" VALUE 0x71285 TKW_VV_VV_UB 100.0 FORMULA_0003 0.0 255.0000 /end CHARACTERISTIC
/begin CHARACTERISTIC K_ED_AUSS_KAT_Z1.DEC_NACH_EINTRAG "Filterverringerung nach Fehlerspeichereintrag | EN: Fault code AUSS_KAT_Z1 - debounce filter decrement after fault-memory entry" VALUE 0x7129F TKW_VV_VV_UB 100.0 FORMULA_0003 0.0 255.0000 /end CHARACTERISTIC
/begin CHARACTERISTIC K_ED_AUSS_KAT_Z2.DEC_NACH_EINTRAG "Filterverringerung nach Fehlerspeichereintrag | EN: Fault code AUSS_KAT_Z2 - debounce filter decrement after fault-memory entry" VALUE 0x712B9 TKW_VV_VV_UB 100.0 FORMULA_0003 0.0 255.0000 /end CHARACTERISTIC
/begin CHARACTERISTIC K_ED_AUSS_KAT_Z3.DEC_NACH_EINTRAG "Filterverringerung nach Fehlerspeichereintrag | EN: Fault code AUSS_KAT_Z3 - debounce filter decrement after fault-memory entry" VALUE 0x712D3 TKW_VV_VV_UB 100.0 FORMULA_0003 0.0 255.0000 /end CHARACTERISTIC
/begin CHARACTERISTIC K_ED_AUSS_KAT_Z4.DEC_NACH_EINTRAG "Filterverringerung nach Fehlerspeichereintrag | EN: Fault code AUSS_KAT_Z4 - debounce filter decrement after fault-memory entry" VALUE 0x712ED TKW_VV_VV_UB 100.0 FORMULA_0003 0.0 255.0000 /end CHARACTERISTIC
/begin CHARACTERISTIC K_ED_AUSS_KAT_Z5.DEC_NACH_EINTRAG "Filterverringerung nach Fehlerspeichereintrag | EN: Fault code AUSS_KAT_Z5 - debounce filter decrement after fault-memory entry" VALUE 0x71307 TKW_VV_VV_UB 100.0 FORMULA_0003 0.0 255.0000 /end CHARACTERISTIC
/begin CHARACTERISTIC K_ED_AUSS_KAT_Z6.DEC_NACH_EINTRAG "Filterverringerung nach Fehlerspeichereintrag | EN: Fault code AUSS_KAT_Z6 - debounce filter decrement after fault-memory entry" VALUE 0x71321 TKW_VV_VV_UB 100.0 FORMULA_0003 0.0 255.0000 /end CHARACTERISTIC
/begin CHARACTERISTIC K_ED_AUSS_KAT_Z7.DEC_NACH_EINTRAG "Filterverringerung nach Fehlerspeichereintrag | EN: Fault code AUSS_KAT_Z7 - debounce filter decrement after fault-memory entry" VALUE 0x7133B TKW_VV_VV_UB 100.0 FORMULA_0003 0.0 255.0000 /end CHARACTERISTIC
/begin CHARACTERISTIC K_ED_AUSS_KAT_Z8.DEC_NACH_EINTRAG "Filterverringerung nach Fehlerspeichereintrag | EN: Fault code AUSS_KAT_Z8 - debounce filter decrement after fault-memory entry" VALUE 0x71355 TKW_VV_VV_UB 100.0 FORMULA_0003 0.0 255.0000 /end CHARACTERISTIC
/begin CHARACTERISTIC K_ED_AUSS_KAT_Z9.DEC_NACH_EINTRAG "Filterverringerung nach Fehlerspeichereintrag | EN: Fault code AUSS_KAT_Z9 - debounce filter decrement after fault-memory entry" VALUE 0x7136F TKW_VV_VV_UB 100.0 FORMULA_0003 0.0 255.0000 /end CHARACTERISTIC
/begin CHARACTERISTIC K_ED_AUSS_KAT_Z10.DEC_NACH_EINTRAG "Filterverringerung nach Fehlerspeichereintrag | EN: Fault code AUSS_KAT_Z10 - debounce filter decrement after fault-memory entry" VALUE 0x71389 TKW_VV_VV_UB 100.0 FORMULA_0003 0.0 255.0000 /end CHARACTERISTIC
/begin CHARACTERISTIC K_ED_AUSS_KAT_MULT.DEC_NACH_EINTRAG "Filterverringerung nach Fehlerspeichereintrag | EN: Fault code AUSS_KAT_MULT - debounce filter decrement after fault-memory entry" VALUE 0x713D7 TKW_VV_VV_UB 100.0 FORMULA_0003 0.0 255.0000 /end CHARACTERISTIC
/begin CHARACTERISTIC K_ED_AUSS_ABG_Z1.DEC_NACH_EINTRAG "Filterverringerung nach Fehlerspeichereintrag | EN: Fault code AUSS_ABG_Z1 - debounce filter decrement after fault-memory entry" VALUE 0x713F1 TKW_VV_VV_UB 100.0 FORMULA_0003 0.0 255.0000 /end CHARACTERISTIC
/begin CHARACTERISTIC K_ED_AUSS_ABG_Z2.DEC_NACH_EINTRAG "Filterverringerung nach Fehlerspeichereintrag | EN: Fault code AUSS_ABG_Z2 - debounce filter decrement after fault-memory entry" VALUE 0x7140B TKW_VV_VV_UB 100.0 FORMULA_0003 0.0 255.0000 /end CHARACTERISTIC
/begin CHARACTERISTIC K_ED_AUSS_ABG_Z3.DEC_NACH_EINTRAG "Filterverringerung nach Fehlerspeichereintrag | EN: Fault code AUSS_ABG_Z3 - debounce filter decrement after fault-memory entry" VALUE 0x71425 TKW_VV_VV_UB 100.0 FORMULA_0003 0.0 255.0000 /end CHARACTERISTIC
/begin CHARACTERISTIC K_ED_AUSS_ABG_Z4.DEC_NACH_EINTRAG "Filterverringerung nach Fehlerspeichereintrag | EN: Fault code AUSS_ABG_Z4 - debounce filter decrement after fault-memory entry" VALUE 0x7143F TKW_VV_VV_UB 100.0 FORMULA_0003 0.0 255.0000 /end CHARACTERISTIC
/begin CHARACTERISTIC K_ED_AUSS_ABG_Z5.DEC_NACH_EINTRAG "Filterverringerung nach Fehlerspeichereintrag | EN: Fault code AUSS_ABG_Z5 - debounce filter decrement after fault-memory entry" VALUE 0x71459 TKW_VV_VV_UB 100.0 FORMULA_0003 0.0 255.0000 /end CHARACTERISTIC
/begin CHARACTERISTIC K_ED_AUSS_ABG_Z6.DEC_NACH_EINTRAG "Filterverringerung nach Fehlerspeichereintrag | EN: Fault code AUSS_ABG_Z6 - debounce filter decrement after fault-memory entry" VALUE 0x71473 TKW_VV_VV_UB 100.0 FORMULA_0003 0.0 255.0000 /end CHARACTERISTIC
/begin CHARACTERISTIC K_ED_AUSS_ABG_Z7.DEC_NACH_EINTRAG "Filterverringerung nach Fehlerspeichereintrag | EN: Fault code AUSS_ABG_Z7 - debounce filter decrement after fault-memory entry" VALUE 0x7148D TKW_VV_VV_UB 100.0 FORMULA_0003 0.0 255.0000 /end CHARACTERISTIC
/begin CHARACTERISTIC K_ED_AUSS_ABG_Z8.DEC_NACH_EINTRAG "Filterverringerung nach Fehlerspeichereintrag | EN: Fault code AUSS_ABG_Z8 - debounce filter decrement after fault-memory entry" VALUE 0x714A7 TKW_VV_VV_UB 100.0 FORMULA_0003 0.0 255.0000 /end CHARACTERISTIC
/begin CHARACTERISTIC K_ED_AUSS_ABG_Z9.DEC_NACH_EINTRAG "Filterverringerung nach Fehlerspeichereintrag" VALUE 0x714C1 TKW_VV_VV_UB 100.0 FORMULA_0003 0.0 255.0000 /end CHARACTERISTIC
/begin CHARACTERISTIC K_ED_AUSS_ABG_Z10.DEC_NACH_EINTRAG "Filterverringerung nach Fehlerspeichereintrag" VALUE 0x714DB TKW_VV_VV_UB 100.0 FORMULA_0003 0.0 255.0000 /end CHARACTERISTIC
/begin CHARACTERISTIC K_ED_AUSS_ABG_MULT.DEC_NACH_EINTRAG "Filterverringerung nach Fehlerspeichereintrag" VALUE 0x71529 TKW_VV_VV_UB 100.0 FORMULA_0003 0.0 255.0000 /end CHARACTERISTIC
/begin CHARACTERISTIC K_ED_E2_IGN.DEC_NACH_EINTRAG "Filterverringerung nach Fehlerspeichereintrag | EN: Fault code E2_IGN - debounce filter decrement after fault-memory entry" VALUE 0x715DF TKW_VV_VV_UB 100.0 FORMULA_0003 0.0 255.0000 /end CHARACTERISTIC
/begin CHARACTERISTIC K_ED_BLS_PLAU.DEC_NACH_EINTRAG "Filterverringerung nach Fehlerspeichereintrag | EN: Fault code BLS_PLAU - debounce filter decrement after fault-memory entry" VALUE 0x715F9 TKW_VV_VV_UB 100.0 FORMULA_0003 0.0 255.0000 /end CHARACTERISTIC
/begin CHARACTERISTIC K_ED_DK1_ZUST.DEC_NACH_EINTRAG "Filterverringerung nach Fehlerspeichereintrag | EN: Fault code DK1_ZUST - debounce filter decrement after fault-memory entry" VALUE 0x7167B TKW_VV_VV_UB 100.0 FORMULA_0003 0.0 255.0000 /end CHARACTERISTIC
/begin CHARACTERISTIC K_ED_DK2_ZUST.DEC_NACH_EINTRAG "Filterverringerung nach Fehlerspeichereintrag | EN: Fault code DK2_ZUST - debounce filter decrement after fault-memory entry" VALUE 0x71695 TKW_VV_VV_UB 100.0 FORMULA_0003 0.0 255.0000 /end CHARACTERISTIC
/begin CHARACTERISTIC K_ED_FGR_ABWURF.DEC_NACH_EINTRAG "Filterverringerung nach Fehlerspeichereintrag | EN: Fault code FGR_ABWURF - debounce filter decrement after fault-memory entry" VALUE 0x716AF TKW_VV_VV_UB 100.0 FORMULA_0003 0.0 255.0000 /end CHARACTERISTIC
/begin CHARACTERISTIC K_ED_AFZ_HS.DEC_NACH_EINTRAG "Filterverringerung nach Fehlerspeichereintrag | EN: Fault code AFZ_HS - debounce filter decrement after fault-memory entry" VALUE 0x716FD TKW_VV_VV_UB 100.0 FORMULA_0003 0.0 255.0000 /end CHARACTERISTIC
/begin CHARACTERISTIC K_ED_AFZ_HS_NA.DEC_NACH_EINTRAG "Filterverringerung nach Fehlerspeichereintrag" VALUE 0x7177F TKW_VV_VV_UB 100.0 FORMULA_0003 0.0 255.0000 /end CHARACTERISTIC
/begin CHARACTERISTIC K_ED_INDEX_110_IGN.DEC_NACH_EINTRAG "Filterverringerung nach Fehlerspeichereintrag" VALUE 0x71799 TKW_VV_VV_UB 100.0 FORMULA_0003 0.0 255.0000 /end CHARACTERISTIC
/begin CHARACTERISTIC K_ED_INDEX_111_IGN.DEC_NACH_EINTRAG "Filterverringerung nach Fehlerspeichereintrag" VALUE 0x717B3 TKW_VV_VV_UB 100.0 FORMULA_0003 0.0 255.0000 /end CHARACTERISTIC
/begin CHARACTERISTIC K_ED_INDEX_112_IGN.DEC_NACH_EINTRAG "Filterverringerung nach Fehlerspeichereintrag" VALUE 0x717CD TKW_VV_VV_UB 100.0 FORMULA_0003 0.0 255.0000 /end CHARACTERISTIC
/begin CHARACTERISTIC K_ED_INDEX_113_IGN.DEC_NACH_EINTRAG "Filterverringerung nach Fehlerspeichereintrag" VALUE 0x717E7 TKW_VV_VV_UB 100.0 FORMULA_0003 0.0 255.0000 /end CHARACTERISTIC
/begin CHARACTERISTIC K_ED_INDEX_114_IGN.DEC_NACH_EINTRAG "Filterverringerung nach Fehlerspeichereintrag" VALUE 0x71801 TKW_VV_VV_UB 100.0 FORMULA_0003 0.0 255.0000 /end CHARACTERISTIC
/begin CHARACTERISTIC K_ED_INDEX_115_IGN.DEC_NACH_EINTRAG "Filterverringerung nach Fehlerspeichereintrag" VALUE 0x7181B TKW_VV_VV_UB 100.0 FORMULA_0003 0.0 255.0000 /end CHARACTERISTIC
/begin CHARACTERISTIC K_ED_INDEX_116_IGN.DEC_NACH_EINTRAG "Filterverringerung nach Fehlerspeichereintrag" VALUE 0x71835 TKW_VV_VV_UB 100.0 FORMULA_0003 0.0 255.0000 /end CHARACTERISTIC
/begin CHARACTERISTIC K_ED_INDEX_117_IGN.DEC_NACH_EINTRAG "Filterverringerung nach Fehlerspeichereintrag" VALUE 0x7184F TKW_VV_VV_UB 100.0 FORMULA_0003 0.0 255.0000 /end CHARACTERISTIC
/begin CHARACTERISTIC K_ED_INDEX_118_IGN.DEC_NACH_EINTRAG "Filterverringerung nach Fehlerspeichereintrag" VALUE 0x71869 TKW_VV_VV_UB 100.0 FORMULA_0003 0.0 255.0000 /end CHARACTERISTIC
/begin CHARACTERISTIC K_ED_INDEX_119_IGN.DEC_NACH_EINTRAG "Filterverringerung nach Fehlerspeichereintrag" VALUE 0x71883 TKW_VV_VV_UB 100.0 FORMULA_0003 0.0 255.0000 /end CHARACTERISTIC
/begin CHARACTERISTIC K_ED_INDEX_120_IGN.DEC_NACH_EINTRAG "Filterverringerung nach Fehlerspeichereintrag" VALUE 0x7189D TKW_VV_VV_UB 100.0 FORMULA_0003 0.0 255.0000 /end CHARACTERISTIC
/begin CHARACTERISTIC K_ED_INDEX_121_IGN.DEC_NACH_EINTRAG "Filterverringerung nach Fehlerspeichereintrag | EN: Fault code INDEX_121_IGN - debounce filter decrement after fault-memory entry" VALUE 0x718B7 TKW_VV_VV_UB 100.0 FORMULA_0003 0.0 255.0000 /end CHARACTERISTIC
/begin CHARACTERISTIC K_ED_APPL_DATA_IGN.KLASSENINDEX "Auswahl der Fehlerklasse | EN: Fault code APPL_DATA_IGN - fault class selection (lamp / warning behaviour)" VALUE 0x70D8C TKW_VV_VV_UB 100.0 FORMULA_0003 0.0 8.0000 /end CHARACTERISTIC
/begin CHARACTERISTIC K_ED_DK1_CAN.KLASSENINDEX "Auswahl der Fehlerklasse | EN: Fault code DK1_CAN - fault class selection (lamp / warning behaviour)" VALUE 0x70E5C TKW_VV_VV_UB 100.0 FORMULA_0003 0.0 8.0000 /end CHARACTERISTIC
/begin CHARACTERISTIC K_ED_DK2_CAN.KLASSENINDEX "Auswahl der Fehlerklasse | EN: Fault code DK2_CAN - fault class selection (lamp / warning behaviour)" VALUE 0x70E76 TKW_VV_VV_UB 100.0 FORMULA_0003 0.0 8.0000 /end CHARACTERISTIC
/begin CHARACTERISTIC K_ED_DK_INIT.KLASSENINDEX "Auswahl der Fehlerklasse | EN: Fault code DK_INIT - fault class selection (lamp / warning behaviour)" VALUE 0x70F46 TKW_VV_VV_UB 100.0 FORMULA_0003 0.0 8.0000 /end CHARACTERISTIC
/begin CHARACTERISTIC K_ED_DK1_REGLER.KLASSENINDEX "Auswahl der Fehlerklasse | EN: Fault code DK1_REGLER - fault class selection (lamp / warning behaviour)" VALUE 0x70F60 TKW_VV_VV_UB 100.0 FORMULA_0003 0.0 8.0000 /end CHARACTERISTIC
/begin CHARACTERISTIC K_ED_DK2_REGLER.KLASSENINDEX "Auswahl der Fehlerklasse | EN: Fault code DK2_REGLER - fault class selection (lamp / warning behaviour)" VALUE 0x70F7A TKW_VV_VV_UB 100.0 FORMULA_0003 0.0 8.0000 /end CHARACTERISTIC
/begin CHARACTERISTIC K_ED_DK1_ADAPT.KLASSENINDEX "Auswahl der Fehlerklasse | EN: Fault code DK1_ADAPT - fault class selection (lamp / warning behaviour)" VALUE 0x70F94 TKW_VV_VV_UB 100.0 FORMULA_0003 0.0 8.0000 /end CHARACTERISTIC
/begin CHARACTERISTIC K_ED_DK2_ADAPT.KLASSENINDEX "Auswahl der Fehlerklasse | EN: Fault code DK2_ADAPT - fault class selection (lamp / warning behaviour)" VALUE 0x70FAE TKW_VV_VV_UB 100.0 FORMULA_0003 0.0 8.0000 /end CHARACTERISTIC
/begin CHARACTERISTIC K_ED_DK1_WDK.KLASSENINDEX "Auswahl der Fehlerklasse | EN: Fault code DK1_WDK - fault class selection (lamp / warning behaviour)" VALUE 0x71064 TKW_VV_VV_UB 100.0 FORMULA_0003 0.0 8.0000 /end CHARACTERISTIC
/begin CHARACTERISTIC K_ED_DK2_WDK.KLASSENINDEX "Auswahl der Fehlerklasse | EN: Fault code DK2_WDK - fault class selection (lamp / warning behaviour)" VALUE 0x7107E TKW_VV_VV_UB 100.0 FORMULA_0003 0.0 8.0000 /end CHARACTERISTIC
/begin CHARACTERISTIC K_ED_DK1_PDR.KLASSENINDEX "Auswahl der Fehlerklasse | EN: Fault code DK1_PDR - fault class selection (lamp / warning behaviour)" VALUE 0x71098 TKW_VV_VV_UB 100.0 FORMULA_0003 0.0 8.0000 /end CHARACTERISTIC
/begin CHARACTERISTIC K_ED_DK2_PDR.KLASSENINDEX "Auswahl der Fehlerklasse | EN: Fault code DK2_PDR - fault class selection (lamp / warning behaviour)" VALUE 0x710B2 TKW_VV_VV_UB 100.0 FORMULA_0003 0.0 8.0000 /end CHARACTERISTIC
/begin CHARACTERISTIC K_ED_DK1_SK_ERR.KLASSENINDEX "Auswahl der Fehlerklasse | EN: Fault code DK1_SK_ERR - fault class selection (lamp / warning behaviour)" VALUE 0x71100 TKW_VV_VV_UB 100.0 FORMULA_0003 0.0 8.0000 /end CHARACTERISTIC
/begin CHARACTERISTIC K_ED_DK2_SK_ERR.KLASSENINDEX "Auswahl der Fehlerklasse | EN: Fault code DK2_SK_ERR - fault class selection (lamp / warning behaviour)" VALUE 0x7111A TKW_VV_VV_UB 100.0 FORMULA_0003 0.0 8.0000 /end CHARACTERISTIC
/begin CHARACTERISTIC K_ED_DK1_FEDERN.KLASSENINDEX "Auswahl der Fehlerklasse | EN: Fault code DK1_FEDERN - fault class selection (lamp / warning behaviour)" VALUE 0x71134 TKW_VV_VV_UB 100.0 FORMULA_0003 0.0 8.0000 /end CHARACTERISTIC
/begin CHARACTERISTIC K_ED_DK2_FEDERN.KLASSENINDEX "Auswahl der Fehlerklasse | EN: Fault code DK2_FEDERN - fault class selection (lamp / warning behaviour)" VALUE 0x7114E TKW_VV_VV_UB 100.0 FORMULA_0003 0.0 8.0000 /end CHARACTERISTIC
/begin CHARACTERISTIC K_ED_DSC_EINGR.KLASSENINDEX "Auswahl der Fehlerklasse | EN: Fault code DSC_EINGR - fault class selection (lamp / warning behaviour)" VALUE 0x7119C TKW_VV_VV_UB 100.0 FORMULA_0003 0.0 8.0000 /end CHARACTERISTIC
/begin CHARACTERISTIC K_ED_DK1_CMD.KLASSENINDEX "Auswahl der Fehlerklasse | EN: Fault code DK1_CMD - fault class selection (lamp / warning behaviour)" VALUE 0x711B6 TKW_VV_VV_UB 100.0 FORMULA_0003 0.0 8.0000 /end CHARACTERISTIC
/begin CHARACTERISTIC K_ED_DK2_CMD.KLASSENINDEX "Auswahl der Fehlerklasse | EN: Fault code DK2_CMD - fault class selection (lamp / warning behaviour)" VALUE 0x711D0 TKW_VV_VV_UB 100.0 FORMULA_0003 0.0 8.0000 /end CHARACTERISTIC
/begin CHARACTERISTIC K_ED_EC_BUSOFF.KLASSENINDEX "Auswahl der Fehlerklasse | EN: Fault code EC_BUSOFF - fault class selection (lamp / warning behaviour) [V912: differs from V452 160E]" VALUE 0x71286 TKW_VV_VV_UB 100.0 FORMULA_0003 0.0 8.0000 /end CHARACTERISTIC
/begin CHARACTERISTIC K_ED_AUSS_KAT_Z1.KLASSENINDEX "Auswahl der Fehlerklasse | EN: Fault code AUSS_KAT_Z1 - fault class selection (lamp / warning behaviour)" VALUE 0x712A0 TKW_VV_VV_UB 100.0 FORMULA_0003 0.0 8.0000 /end CHARACTERISTIC
/begin CHARACTERISTIC K_ED_AUSS_KAT_Z2.KLASSENINDEX "Auswahl der Fehlerklasse | EN: Fault code AUSS_KAT_Z2 - fault class selection (lamp / warning behaviour)" VALUE 0x712BA TKW_VV_VV_UB 100.0 FORMULA_0003 0.0 8.0000 /end CHARACTERISTIC
/begin CHARACTERISTIC K_ED_AUSS_KAT_Z3.KLASSENINDEX "Auswahl der Fehlerklasse | EN: Fault code AUSS_KAT_Z3 - fault class selection (lamp / warning behaviour)" VALUE 0x712D4 TKW_VV_VV_UB 100.0 FORMULA_0003 0.0 8.0000 /end CHARACTERISTIC
/begin CHARACTERISTIC K_ED_AUSS_KAT_Z4.KLASSENINDEX "Auswahl der Fehlerklasse | EN: Fault code AUSS_KAT_Z4 - fault class selection (lamp / warning behaviour)" VALUE 0x712EE TKW_VV_VV_UB 100.0 FORMULA_0003 0.0 8.0000 /end CHARACTERISTIC
/begin CHARACTERISTIC K_ED_AUSS_KAT_Z5.KLASSENINDEX "Auswahl der Fehlerklasse | EN: Fault code AUSS_KAT_Z5 - fault class selection (lamp / warning behaviour)" VALUE 0x71308 TKW_VV_VV_UB 100.0 FORMULA_0003 0.0 8.0000 /end CHARACTERISTIC
/begin CHARACTERISTIC K_ED_AUSS_KAT_Z6.KLASSENINDEX "Auswahl der Fehlerklasse | EN: Fault code AUSS_KAT_Z6 - fault class selection (lamp / warning behaviour)" VALUE 0x71322 TKW_VV_VV_UB 100.0 FORMULA_0003 0.0 8.0000 /end CHARACTERISTIC
/begin CHARACTERISTIC K_ED_AUSS_KAT_Z7.KLASSENINDEX "Auswahl der Fehlerklasse | EN: Fault code AUSS_KAT_Z7 - fault class selection (lamp / warning behaviour)" VALUE 0x7133C TKW_VV_VV_UB 100.0 FORMULA_0003 0.0 8.0000 /end CHARACTERISTIC
/begin CHARACTERISTIC K_ED_AUSS_KAT_Z8.KLASSENINDEX "Auswahl der Fehlerklasse | EN: Fault code AUSS_KAT_Z8 - fault class selection (lamp / warning behaviour)" VALUE 0x71356 TKW_VV_VV_UB 100.0 FORMULA_0003 0.0 8.0000 /end CHARACTERISTIC
/begin CHARACTERISTIC K_ED_AUSS_KAT_Z9.KLASSENINDEX "Auswahl der Fehlerklasse | EN: Fault code AUSS_KAT_Z9 - fault class selection (lamp / warning behaviour)" VALUE 0x71370 TKW_VV_VV_UB 100.0 FORMULA_0003 0.0 8.0000 /end CHARACTERISTIC
/begin CHARACTERISTIC K_ED_AUSS_KAT_Z10.KLASSENINDEX "Auswahl der Fehlerklasse | EN: Fault code AUSS_KAT_Z10 - fault class selection (lamp / warning behaviour)" VALUE 0x7138A TKW_VV_VV_UB 100.0 FORMULA_0003 0.0 8.0000 /end CHARACTERISTIC
/begin CHARACTERISTIC K_ED_AUSS_KAT_MULT.KLASSENINDEX "Auswahl der Fehlerklasse | EN: Fault code AUSS_KAT_MULT - fault class selection (lamp / warning behaviour)" VALUE 0x713D8 TKW_VV_VV_UB 100.0 FORMULA_0003 0.0 8.0000 /end CHARACTERISTIC
/begin CHARACTERISTIC K_ED_AUSS_ABG_Z1.KLASSENINDEX "Auswahl der Fehlerklasse | EN: Fault code AUSS_ABG_Z1 - fault class selection (lamp / warning behaviour)" VALUE 0x713F2 TKW_VV_VV_UB 100.0 FORMULA_0003 0.0 8.0000 /end CHARACTERISTIC
/begin CHARACTERISTIC K_ED_AUSS_ABG_Z2.KLASSENINDEX "Auswahl der Fehlerklasse | EN: Fault code AUSS_ABG_Z2 - fault class selection (lamp / warning behaviour)" VALUE 0x7140C TKW_VV_VV_UB 100.0 FORMULA_0003 0.0 8.0000 /end CHARACTERISTIC
/begin CHARACTERISTIC K_ED_AUSS_ABG_Z3.KLASSENINDEX "Auswahl der Fehlerklasse | EN: Fault code AUSS_ABG_Z3 - fault class selection (lamp / warning behaviour)" VALUE 0x71426 TKW_VV_VV_UB 100.0 FORMULA_0003 0.0 8.0000 /end CHARACTERISTIC
/begin CHARACTERISTIC K_ED_AUSS_ABG_Z4.KLASSENINDEX "Auswahl der Fehlerklasse | EN: Fault code AUSS_ABG_Z4 - fault class selection (lamp / warning behaviour)" VALUE 0x71440 TKW_VV_VV_UB 100.0 FORMULA_0003 0.0 8.0000 /end CHARACTERISTIC
/begin CHARACTERISTIC K_ED_AUSS_ABG_Z5.KLASSENINDEX "Auswahl der Fehlerklasse | EN: Fault code AUSS_ABG_Z5 - fault class selection (lamp / warning behaviour)" VALUE 0x7145A TKW_VV_VV_UB 100.0 FORMULA_0003 0.0 8.0000 /end CHARACTERISTIC
/begin CHARACTERISTIC K_ED_AUSS_ABG_Z6.KLASSENINDEX "Auswahl der Fehlerklasse | EN: Fault code AUSS_ABG_Z6 - fault class selection (lamp / warning behaviour)" VALUE 0x71474 TKW_VV_VV_UB 100.0 FORMULA_0003 0.0 8.0000 /end CHARACTERISTIC
/begin CHARACTERISTIC K_ED_AUSS_ABG_Z7.KLASSENINDEX "Auswahl der Fehlerklasse | EN: Fault code AUSS_ABG_Z7 - fault class selection (lamp / warning behaviour)" VALUE 0x7148E TKW_VV_VV_UB 100.0 FORMULA_0003 0.0 8.0000 /end CHARACTERISTIC
/begin CHARACTERISTIC K_ED_AUSS_ABG_Z8.KLASSENINDEX "Auswahl der Fehlerklasse | EN: Fault code AUSS_ABG_Z8 - fault class selection (lamp / warning behaviour)" VALUE 0x714A8 TKW_VV_VV_UB 100.0 FORMULA_0003 0.0 8.0000 /end CHARACTERISTIC
/begin CHARACTERISTIC K_ED_AUSS_ABG_Z9.KLASSENINDEX "Auswahl der Fehlerklasse" VALUE 0x714C2 TKW_VV_VV_UB 100.0 FORMULA_0003 0.0 8.0000 /end CHARACTERISTIC
/begin CHARACTERISTIC K_ED_AUSS_ABG_Z10.KLASSENINDEX "Auswahl der Fehlerklasse" VALUE 0x714DC TKW_VV_VV_UB 100.0 FORMULA_0003 0.0 8.0000 /end CHARACTERISTIC
/begin CHARACTERISTIC K_ED_AUSS_ABG_MULT.KLASSENINDEX "Auswahl der Fehlerklasse" VALUE 0x7152A TKW_VV_VV_UB 100.0 FORMULA_0003 0.0 8.0000 /end CHARACTERISTIC
/begin CHARACTERISTIC K_ED_E2_IGN.KLASSENINDEX "Auswahl der Fehlerklasse | EN: Fault code E2_IGN - fault class selection (lamp / warning behaviour)" VALUE 0x715E0 TKW_VV_VV_UB 100.0 FORMULA_0003 0.0 8.0000 /end CHARACTERISTIC
/begin CHARACTERISTIC K_ED_BLS_PLAU.KLASSENINDEX "Auswahl der Fehlerklasse | EN: Fault code BLS_PLAU - fault class selection (lamp / warning behaviour)" VALUE 0x715FA TKW_VV_VV_UB 100.0 FORMULA_0003 0.0 8.0000 /end CHARACTERISTIC
/begin CHARACTERISTIC K_ED_DK1_ZUST.KLASSENINDEX "Auswahl der Fehlerklasse | EN: Fault code DK1_ZUST - fault class selection (lamp / warning behaviour)" VALUE 0x7167C TKW_VV_VV_UB 100.0 FORMULA_0003 0.0 8.0000 /end CHARACTERISTIC
/begin CHARACTERISTIC K_ED_DK2_ZUST.KLASSENINDEX "Auswahl der Fehlerklasse | EN: Fault code DK2_ZUST - fault class selection (lamp / warning behaviour)" VALUE 0x71696 TKW_VV_VV_UB 100.0 FORMULA_0003 0.0 8.0000 /end CHARACTERISTIC
/begin CHARACTERISTIC K_ED_FGR_ABWURF.KLASSENINDEX "Auswahl der Fehlerklasse | EN: Fault code FGR_ABWURF - fault class selection (lamp / warning behaviour)" VALUE 0x716B0 TKW_VV_VV_UB 100.0 FORMULA_0003 0.0 8.0000 /end CHARACTERISTIC
/begin CHARACTERISTIC K_ED_AFZ_HS.KLASSENINDEX "Auswahl der Fehlerklasse | EN: Fault code AFZ_HS - fault class selection (lamp / warning behaviour)" VALUE 0x716FE TKW_VV_VV_UB 100.0 FORMULA_0003 0.0 8.0000 /end CHARACTERISTIC
/begin CHARACTERISTIC K_ED_AFZ_HS_NA.KLASSENINDEX "Auswahl der Fehlerklasse" VALUE 0x71780 TKW_VV_VV_UB 100.0 FORMULA_0003 0.0 8.0000 /end CHARACTERISTIC
/begin CHARACTERISTIC K_ED_INDEX_110_IGN.KLASSENINDEX "Auswahl der Fehlerklasse" VALUE 0x7179A TKW_VV_VV_UB 100.0 FORMULA_0003 0.0 8.0000 /end CHARACTERISTIC
/begin CHARACTERISTIC K_ED_INDEX_111_IGN.KLASSENINDEX "Auswahl der Fehlerklasse" VALUE 0x717B4 TKW_VV_VV_UB 100.0 FORMULA_0003 0.0 8.0000 /end CHARACTERISTIC
/begin CHARACTERISTIC K_ED_INDEX_112_IGN.KLASSENINDEX "Auswahl der Fehlerklasse" VALUE 0x717CE TKW_VV_VV_UB 100.0 FORMULA_0003 0.0 8.0000 /end CHARACTERISTIC
/begin CHARACTERISTIC K_ED_INDEX_113_IGN.KLASSENINDEX "Auswahl der Fehlerklasse" VALUE 0x717E8 TKW_VV_VV_UB 100.0 FORMULA_0003 0.0 8.0000 /end CHARACTERISTIC
/begin CHARACTERISTIC K_ED_INDEX_114_IGN.KLASSENINDEX "Auswahl der Fehlerklasse" VALUE 0x71802 TKW_VV_VV_UB 100.0 FORMULA_0003 0.0 8.0000 /end CHARACTERISTIC
/begin CHARACTERISTIC K_ED_INDEX_115_IGN.KLASSENINDEX "Auswahl der Fehlerklasse" VALUE 0x7181C TKW_VV_VV_UB 100.0 FORMULA_0003 0.0 8.0000 /end CHARACTERISTIC
/begin CHARACTERISTIC K_ED_INDEX_116_IGN.KLASSENINDEX "Auswahl der Fehlerklasse" VALUE 0x71836 TKW_VV_VV_UB 100.0 FORMULA_0003 0.0 8.0000 /end CHARACTERISTIC
/begin CHARACTERISTIC K_ED_INDEX_117_IGN.KLASSENINDEX "Auswahl der Fehlerklasse" VALUE 0x71850 TKW_VV_VV_UB 100.0 FORMULA_0003 0.0 8.0000 /end CHARACTERISTIC
/begin CHARACTERISTIC K_ED_INDEX_118_IGN.KLASSENINDEX "Auswahl der Fehlerklasse" VALUE 0x7186A TKW_VV_VV_UB 100.0 FORMULA_0003 0.0 8.0000 /end CHARACTERISTIC
/begin CHARACTERISTIC K_ED_INDEX_119_IGN.KLASSENINDEX "Auswahl der Fehlerklasse" VALUE 0x71884 TKW_VV_VV_UB 100.0 FORMULA_0003 0.0 8.0000 /end CHARACTERISTIC
/begin CHARACTERISTIC K_ED_INDEX_120_IGN.KLASSENINDEX "Auswahl der Fehlerklasse" VALUE 0x7189E TKW_VV_VV_UB 100.0 FORMULA_0003 0.0 8.0000 /end CHARACTERISTIC
/begin CHARACTERISTIC K_ED_INDEX_121_IGN.KLASSENINDEX "Auswahl der Fehlerklasse | EN: Fault code INDEX_121_IGN - fault class selection (lamp / warning behaviour)" VALUE 0x718B8 TKW_VV_VV_UB 100.0 FORMULA_0003 0.0 8.0000 /end CHARACTERISTIC
/begin FUNCTION Egas-Ebene_2 "" /begin DEF_CHARACTERISTIC /end DEF_CHARACTERISTIC /begin REF_CHARACTERISTIC /end REF_CHARACTERISTIC /begin IN_MEASUREMENT /end IN_MEASUREMENT /begin OUT_MEASUREMENT /end OUT_MEASUREMENT /end FUNCTION
/begin FUNCTION Eigendiagnose ""
 /begin DEF_CHARACTERISTIC K_ED_AFZ_HS.DEC_NACH_EINTRAG K_ED_AFZ_HS.DEC_VOR_EINTRAG K_ED_AFZ_HS.FEHLERSCHWELLE K_ED_AFZ_HS.INC_NACH_EINTRAG K_ED_AFZ_HS.INC_VOR_EINTRAG K_ED_AFZ_HS.KLASSENINDEX K_ED_AFZ_HS.OK_SCHWELLE K_ED_AFZ_HS.P_CODE_OPENLOAD K_ED_AFZ_HS.P_CODE_SH_TO_GND K_ED_AFZ_HS.P_CODE_SH_TO_UB K_ED_AFZ_HS.P_CODE_UNPLAUSIBEL K_ED_AFZ_HS_NA.DEC_NACH_EINTRAG K_ED_AFZ_HS_NA.DEC_VOR_EINTRAG K_ED_AFZ_HS_NA.FEHLERSCHWELLE K_ED_AFZ_HS_NA.INC_NACH_EINTRAG K_ED_AFZ_HS_NA.INC_VOR_EINTRAG K_ED_AFZ_HS_NA.KLASSENINDEX K_ED_AFZ_HS_NA.OK_SCHWELLE K_ED_AFZ_HS_NA.P_CODE_OPENLOAD K_ED_AFZ_HS_NA.P_CODE_SH_TO_GND K_ED_AFZ_HS_NA.P_CODE_SH_TO_UB K_ED_AFZ_HS_NA.P_CODE_UNPLAUSIBEL K_ED_APPL_DATA_IGN.DEC_NACH_EINTRAG K_ED_APPL_DATA_IGN.DEC_VOR_EINTRAG K_ED_APPL_DATA_IGN.FEHLERSCHWELLE K_ED_APPL_DATA_IGN.INC_NACH_EINTRAG K_ED_APPL_DATA_IGN.INC_VOR_EINTRAG K_ED_APPL_DATA_IGN.KLASSENINDEX K_ED_APPL_DATA_IGN.OK_SCHWELLE K_ED_APPL_DATA_IGN.P_CODE_OPENLOAD K_ED_APPL_DATA_IGN.P_CODE_SH_TO_GND K_ED_APPL_DATA_IGN.P_CODE_SH_TO_UB K_ED_APPL_DATA_IGN.P_CODE_UNPLAUSIBEL K_ED_AUSS_ABG_MULT.DEC_NACH_EINTRAG K_ED_AUSS_ABG_MULT.DEC_VOR_EINTRAG K_ED_AUSS_ABG_MULT.FEHLERSCHWELLE K_ED_AUSS_ABG_MULT.INC_NACH_EINTRAG K_ED_AUSS_ABG_MULT.INC_VOR_EINTRAG K_ED_AUSS_ABG_MULT.KLASSENINDEX K_ED_AUSS_ABG_MULT.OK_SCHWELLE K_ED_AUSS_ABG_MULT.P_CODE_OPENLOAD K_ED_AUSS_ABG_MULT.P_CODE_SH_TO_GND K_ED_AUSS_ABG_MULT.P_CODE_SH_TO_UB K_ED_AUSS_ABG_MULT.P_CODE_UNPLAUSIBEL K_ED_AUSS_ABG_Z1.DEC_NACH_EINTRAG K_ED_AUSS_ABG_Z1.DEC_VOR_EINTRAG K_ED_AUSS_ABG_Z1.FEHLERSCHWELLE K_ED_AUSS_ABG_Z1.INC_NACH_EINTRAG K_ED_AUSS_ABG_Z1.INC_VOR_EINTRAG K_ED_AUSS_ABG_Z1.KLASSENINDEX K_ED_AUSS_ABG_Z1.OK_SCHWELLE K_ED_AUSS_ABG_Z1.P_CODE_OPENLOAD K_ED_AUSS_ABG_Z1.P_CODE_SH_TO_GND K_ED_AUSS_ABG_Z1.P_CODE_SH_TO_UB K_ED_AUSS_ABG_Z1.P_CODE_UNPLAUSIBEL K_ED_AUSS_ABG_Z10.DEC_NACH_EINTRAG K_ED_AUSS_ABG_Z10.DEC_VOR_EINTRAG K_ED_AUSS_ABG_Z10.FEHLERSCHWELLE K_ED_AUSS_ABG_Z10.INC_NACH_EINTRAG K_ED_AUSS_ABG_Z10.INC_VOR_EINTRAG K_ED_AUSS_ABG_Z10.KLASSENINDEX K_ED_AUSS_ABG_Z10.OK_SCHWELLE K_ED_AUSS_ABG_Z10.P_CODE_OPENLOAD K_ED_AUSS_ABG_Z10.P_CODE_SH_TO_GND K_ED_AUSS_ABG_Z10.P_CODE_SH_TO_UB K_ED_AUSS_ABG_Z10.P_CODE_UNPLAUSIBEL K_ED_AUSS_ABG_Z2.DEC_NACH_EINTRAG K_ED_AUSS_ABG_Z2.DEC_VOR_EINTRAG K_ED_AUSS_ABG_Z2.FEHLERSCHWELLE K_ED_AUSS_ABG_Z2.INC_NACH_EINTRAG K_ED_AUSS_ABG_Z2.INC_VOR_EINTRAG K_ED_AUSS_ABG_Z2.KLASSENINDEX K_ED_AUSS_ABG_Z2.OK_SCHWELLE K_ED_AUSS_ABG_Z2.P_CODE_OPENLOAD K_ED_AUSS_ABG_Z2.P_CODE_SH_TO_GND K_ED_AUSS_ABG_Z2.P_CODE_SH_TO_UB K_ED_AUSS_ABG_Z2.P_CODE_UNPLAUSIBEL K_ED_AUSS_ABG_Z3.DEC_NACH_EINTRAG K_ED_AUSS_ABG_Z3.DEC_VOR_EINTRAG K_ED_AUSS_ABG_Z3.FEHLERSCHWELLE K_ED_AUSS_ABG_Z3.INC_NACH_EINTRAG K_ED_AUSS_ABG_Z3.INC_VOR_EINTRAG K_ED_AUSS_ABG_Z3.KLASSENINDEX K_ED_AUSS_ABG_Z3.OK_SCHWELLE K_ED_AUSS_ABG_Z3.P_CODE_OPENLOAD K_ED_AUSS_ABG_Z3.P_CODE_SH_TO_GND K_ED_AUSS_ABG_Z3.P_CODE_SH_TO_UB K_ED_AUSS_ABG_Z3.P_CODE_UNPLAUSIBEL K_ED_AUSS_ABG_Z4.DEC_NACH_EINTRAG K_ED_AUSS_ABG_Z4.DEC_VOR_EINTRAG K_ED_AUSS_ABG_Z4.FEHLERSCHWELLE K_ED_AUSS_ABG_Z4.INC_NACH_EINTRAG K_ED_AUSS_ABG_Z4.INC_VOR_EINTRAG K_ED_AUSS_ABG_Z4.KLASSENINDEX K_ED_AUSS_ABG_Z4.OK_SCHWELLE K_ED_AUSS_ABG_Z4.P_CODE_OPENLOAD K_ED_AUSS_ABG_Z4.P_CODE_SH_TO_GND K_ED_AUSS_ABG_Z4.P_CODE_SH_TO_UB K_ED_AUSS_ABG_Z4.P_CODE_UNPLAUSIBEL K_ED_AUSS_ABG_Z5.DEC_NACH_EINTRAG K_ED_AUSS_ABG_Z5.DEC_VOR_EINTRAG K_ED_AUSS_ABG_Z5.FEHLERSCHWELLE K_ED_AUSS_ABG_Z5.INC_NACH_EINTRAG K_ED_AUSS_ABG_Z5.INC_VOR_EINTRAG K_ED_AUSS_ABG_Z5.KLASSENINDEX K_ED_AUSS_ABG_Z5.OK_SCHWELLE K_ED_AUSS_ABG_Z5.P_CODE_OPENLOAD K_ED_AUSS_ABG_Z5.P_CODE_SH_TO_GND K_ED_AUSS_ABG_Z5.P_CODE_SH_TO_UB K_ED_AUSS_ABG_Z5.P_CODE_UNPLAUSIBEL K_ED_AUSS_ABG_Z6.DEC_NACH_EINTRAG K_ED_AUSS_ABG_Z6.DEC_VOR_EINTRAG K_ED_AUSS_ABG_Z6.FEHLERSCHWELLE K_ED_AUSS_ABG_Z6.INC_NACH_EINTRAG K_ED_AUSS_ABG_Z6.INC_VOR_EINTRAG K_ED_AUSS_ABG_Z6.KLASSENINDEX K_ED_AUSS_ABG_Z6.OK_SCHWELLE K_ED_AUSS_ABG_Z6.P_CODE_OPENLOAD K_ED_AUSS_ABG_Z6.P_CODE_SH_TO_GND K_ED_AUSS_ABG_Z6.P_CODE_SH_TO_UB K_ED_AUSS_ABG_Z6.P_CODE_UNPLAUSIBEL K_ED_AUSS_ABG_Z7.DEC_NACH_EINTRAG K_ED_AUSS_ABG_Z7.DEC_VOR_EINTRAG K_ED_AUSS_ABG_Z7.FEHLERSCHWELLE K_ED_AUSS_ABG_Z7.INC_NACH_EINTRAG K_ED_AUSS_ABG_Z7.INC_VOR_EINTRAG K_ED_AUSS_ABG_Z7.KLASSENINDEX K_ED_AUSS_ABG_Z7.OK_SCHWELLE K_ED_AUSS_ABG_Z7.P_CODE_OPENLOAD K_ED_AUSS_ABG_Z7.P_CODE_SH_TO_GND K_ED_AUSS_ABG_Z7.P_CODE_SH_TO_UB K_ED_AUSS_ABG_Z7.P_CODE_UNPLAUSIBEL K_ED_AUSS_ABG_Z8.DEC_NACH_EINTRAG K_ED_AUSS_ABG_Z8.DEC_VOR_EINTRAG K_ED_AUSS_ABG_Z8.FEHLERSCHWELLE K_ED_AUSS_ABG_Z8.INC_NACH_EINTRAG K_ED_AUSS_ABG_Z8.INC_VOR_EINTRAG K_ED_AUSS_ABG_Z8.KLASSENINDEX K_ED_AUSS_ABG_Z8.OK_SCHWELLE K_ED_AUSS_ABG_Z8.P_CODE_OPENLOAD K_ED_AUSS_ABG_Z8.P_CODE_SH_TO_GND K_ED_AUSS_ABG_Z8.P_CODE_SH_TO_UB K_ED_AUSS_ABG_Z8.P_CODE_UNPLAUSIBEL K_ED_AUSS_ABG_Z9.DEC_NACH_EINTRAG K_ED_AUSS_ABG_Z9.DEC_VOR_EINTRAG K_ED_AUSS_ABG_Z9.FEHLERSCHWELLE K_ED_AUSS_ABG_Z9.INC_NACH_EINTRAG K_ED_AUSS_ABG_Z9.INC_VOR_EINTRAG K_ED_AUSS_ABG_Z9.KLASSENINDEX K_ED_AUSS_ABG_Z9.OK_SCHWELLE K_ED_AUSS_ABG_Z9.P_CODE_OPENLOAD K_ED_AUSS_ABG_Z9.P_CODE_SH_TO_GND K_ED_AUSS_ABG_Z9.P_CODE_SH_TO_UB K_ED_AUSS_ABG_Z9.P_CODE_UNPLAUSIBEL K_ED_AUSS_KAT_MULT.DEC_NACH_EINTRAG K_ED_AUSS_KAT_MULT.DEC_VOR_EINTRAG K_ED_AUSS_KAT_MULT.FEHLERSCHWELLE K_ED_AUSS_KAT_MULT.INC_NACH_EINTRAG K_ED_AUSS_KAT_MULT.INC_VOR_EINTRAG K_ED_AUSS_KAT_MULT.KLASSENINDEX K_ED_AUSS_KAT_MULT.OK_SCHWELLE K_ED_AUSS_KAT_MULT.P_CODE_OPENLOAD K_ED_AUSS_KAT_MULT.P_CODE_SH_TO_GND K_ED_AUSS_KAT_MULT.P_CODE_SH_TO_UB K_ED_AUSS_KAT_MULT.P_CODE_UNPLAUSIBEL K_ED_AUSS_KAT_Z1.DEC_NACH_EINTRAG K_ED_AUSS_KAT_Z1.DEC_VOR_EINTRAG K_ED_AUSS_KAT_Z1.FEHLERSCHWELLE K_ED_AUSS_KAT_Z1.INC_NACH_EINTRAG K_ED_AUSS_KAT_Z1.INC_VOR_EINTRAG K_ED_AUSS_KAT_Z1.KLASSENINDEX K_ED_AUSS_KAT_Z1.OK_SCHWELLE K_ED_AUSS_KAT_Z1.P_CODE_OPENLOAD K_ED_AUSS_KAT_Z1.P_CODE_SH_TO_GND K_ED_AUSS_KAT_Z1.P_CODE_SH_TO_UB K_ED_AUSS_KAT_Z1.P_CODE_UNPLAUSIBEL K_ED_AUSS_KAT_Z10.DEC_NACH_EINTRAG K_ED_AUSS_KAT_Z10.DEC_VOR_EINTRAG K_ED_AUSS_KAT_Z10.FEHLERSCHWELLE K_ED_AUSS_KAT_Z10.INC_NACH_EINTRAG K_ED_AUSS_KAT_Z10.INC_VOR_EINTRAG K_ED_AUSS_KAT_Z10.KLASSENINDEX K_ED_AUSS_KAT_Z10.OK_SCHWELLE K_ED_AUSS_KAT_Z10.P_CODE_OPENLOAD K_ED_AUSS_KAT_Z10.P_CODE_SH_TO_GND K_ED_AUSS_KAT_Z10.P_CODE_SH_TO_UB K_ED_AUSS_KAT_Z10.P_CODE_UNPLAUSIBEL K_ED_AUSS_KAT_Z2.DEC_NACH_EINTRAG K_ED_AUSS_KAT_Z2.DEC_VOR_EINTRAG K_ED_AUSS_KAT_Z2.FEHLERSCHWELLE K_ED_AUSS_KAT_Z2.INC_NACH_EINTRAG K_ED_AUSS_KAT_Z2.INC_VOR_EINTRAG K_ED_AUSS_KAT_Z2.KLASSENINDEX K_ED_AUSS_KAT_Z2.OK_SCHWELLE K_ED_AUSS_KAT_Z2.P_CODE_OPENLOAD K_ED_AUSS_KAT_Z2.P_CODE_SH_TO_GND K_ED_AUSS_KAT_Z2.P_CODE_SH_TO_UB K_ED_AUSS_KAT_Z2.P_CODE_UNPLAUSIBEL K_ED_AUSS_KAT_Z3.DEC_NACH_EINTRAG K_ED_AUSS_KAT_Z3.DEC_VOR_EINTRAG K_ED_AUSS_KAT_Z3.FEHLERSCHWELLE K_ED_AUSS_KAT_Z3.INC_NACH_EINTRAG K_ED_AUSS_KAT_Z3.INC_VOR_EINTRAG K_ED_AUSS_KAT_Z3.KLASSENINDEX K_ED_AUSS_KAT_Z3.OK_SCHWELLE K_ED_AUSS_KAT_Z3.P_CODE_OPENLOAD K_ED_AUSS_KAT_Z3.P_CODE_SH_TO_GND K_ED_AUSS_KAT_Z3.P_CODE_SH_TO_UB K_ED_AUSS_KAT_Z3.P_CODE_UNPLAUSIBEL K_ED_AUSS_KAT_Z4.DEC_NACH_EINTRAG K_ED_AUSS_KAT_Z4.DEC_VOR_EINTRAG K_ED_AUSS_KAT_Z4.FEHLERSCHWELLE K_ED_AUSS_KAT_Z4.INC_NACH_EINTRAG K_ED_AUSS_KAT_Z4.INC_VOR_EINTRAG K_ED_AUSS_KAT_Z4.KLASSENINDEX K_ED_AUSS_KAT_Z4.OK_SCHWELLE K_ED_AUSS_KAT_Z4.P_CODE_OPENLOAD K_ED_AUSS_KAT_Z4.P_CODE_SH_TO_GND K_ED_AUSS_KAT_Z4.P_CODE_SH_TO_UB K_ED_AUSS_KAT_Z4.P_CODE_UNPLAUSIBEL K_ED_AUSS_KAT_Z5.DEC_NACH_EINTRAG K_ED_AUSS_KAT_Z5.DEC_VOR_EINTRAG K_ED_AUSS_KAT_Z5.FEHLERSCHWELLE K_ED_AUSS_KAT_Z5.INC_NACH_EINTRAG K_ED_AUSS_KAT_Z5.INC_VOR_EINTRAG K_ED_AUSS_KAT_Z5.KLASSENINDEX K_ED_AUSS_KAT_Z5.OK_SCHWELLE K_ED_AUSS_KAT_Z5.P_CODE_OPENLOAD K_ED_AUSS_KAT_Z5.P_CODE_SH_TO_GND K_ED_AUSS_KAT_Z5.P_CODE_SH_TO_UB K_ED_AUSS_KAT_Z5.P_CODE_UNPLAUSIBEL K_ED_AUSS_KAT_Z6.DEC_NACH_EINTRAG K_ED_AUSS_KAT_Z6.DEC_VOR_EINTRAG K_ED_AUSS_KAT_Z6.FEHLERSCHWELLE K_ED_AUSS_KAT_Z6.INC_NACH_EINTRAG K_ED_AUSS_KAT_Z6.INC_VOR_EINTRAG K_ED_AUSS_KAT_Z6.KLASSENINDEX K_ED_AUSS_KAT_Z6.OK_SCHWELLE K_ED_AUSS_KAT_Z6.P_CODE_OPENLOAD K_ED_AUSS_KAT_Z6.P_CODE_SH_TO_GND K_ED_AUSS_KAT_Z6.P_CODE_SH_TO_UB K_ED_AUSS_KAT_Z6.P_CODE_UNPLAUSIBEL K_ED_AUSS_KAT_Z7.DEC_NACH_EINTRAG K_ED_AUSS_KAT_Z7.DEC_VOR_EINTRAG K_ED_AUSS_KAT_Z7.FEHLERSCHWELLE K_ED_AUSS_KAT_Z7.INC_NACH_EINTRAG K_ED_AUSS_KAT_Z7.INC_VOR_EINTRAG K_ED_AUSS_KAT_Z7.KLASSENINDEX K_ED_AUSS_KAT_Z7.OK_SCHWELLE K_ED_AUSS_KAT_Z7.P_CODE_OPENLOAD K_ED_AUSS_KAT_Z7.P_CODE_SH_TO_GND K_ED_AUSS_KAT_Z7.P_CODE_SH_TO_UB K_ED_AUSS_KAT_Z7.P_CODE_UNPLAUSIBEL K_ED_AUSS_KAT_Z8.DEC_NACH_EINTRAG K_ED_AUSS_KAT_Z8.DEC_VOR_EINTRAG K_ED_AUSS_KAT_Z8.FEHLERSCHWELLE K_ED_AUSS_KAT_Z8.INC_NACH_EINTRAG K_ED_AUSS_KAT_Z8.INC_VOR_EINTRAG K_ED_AUSS_KAT_Z8.KLASSENINDEX K_ED_AUSS_KAT_Z8.OK_SCHWELLE K_ED_AUSS_KAT_Z8.P_CODE_OPENLOAD K_ED_AUSS_KAT_Z8.P_CODE_SH_TO_GND K_ED_AUSS_KAT_Z8.P_CODE_SH_TO_UB K_ED_AUSS_KAT_Z8.P_CODE_UNPLAUSIBEL K_ED_AUSS_KAT_Z9.DEC_NACH_EINTRAG K_ED_AUSS_KAT_Z9.DEC_VOR_EINTRAG K_ED_AUSS_KAT_Z9.FEHLERSCHWELLE K_ED_AUSS_KAT_Z9.INC_NACH_EINTRAG K_ED_AUSS_KAT_Z9.INC_VOR_EINTRAG K_ED_AUSS_KAT_Z9.KLASSENINDEX K_ED_AUSS_KAT_Z9.OK_SCHWELLE K_ED_AUSS_KAT_Z9.P_CODE_OPENLOAD K_ED_AUSS_KAT_Z9.P_CODE_SH_TO_GND K_ED_AUSS_KAT_Z9.P_CODE_SH_TO_UB K_ED_AUSS_KAT_Z9.P_CODE_UNPLAUSIBEL K_ED_BLS_PLAU.DEC_NACH_EINTRAG K_ED_BLS_PLAU.DEC_VOR_EINTRAG K_ED_BLS_PLAU.FEHLERSCHWELLE K_ED_BLS_PLAU.INC_NACH_EINTRAG K_ED_BLS_PLAU.INC_VOR_EINTRAG K_ED_BLS_PLAU.KLASSENINDEX K_ED_BLS_PLAU.OK_SCHWELLE K_ED_BLS_PLAU.P_CODE_OPENLOAD K_ED_BLS_PLAU.P_CODE_SH_TO_GND K_ED_BLS_PLAU.P_CODE_SH_TO_UB K_ED_BLS_PLAU.P_CODE_UNPLAUSIBEL K_ED_DK1_ADAPT.DEC_NACH_EINTRAG K_ED_DK1_ADAPT.DEC_VOR_EINTRAG K_ED_DK1_ADAPT.FEHLERSCHWELLE K_ED_DK1_ADAPT.INC_NACH_EINTRAG K_ED_DK1_ADAPT.INC_VOR_EINTRAG K_ED_DK1_ADAPT.KLASSENINDEX K_ED_DK1_ADAPT.OK_SCHWELLE K_ED_DK1_ADAPT.P_CODE_OPENLOAD K_ED_DK1_ADAPT.P_CODE_SH_TO_GND K_ED_DK1_ADAPT.P_CODE_SH_TO_UB K_ED_DK1_ADAPT.P_CODE_UNPLAUSIBEL K_ED_DK1_CAN.DEC_NACH_EINTRAG K_ED_DK1_CAN.DEC_VOR_EINTRAG K_ED_DK1_CAN.FEHLERSCHWELLE K_ED_DK1_CAN.INC_NACH_EINTRAG K_ED_DK1_CAN.INC_VOR_EINTRAG K_ED_DK1_CAN.KLASSENINDEX K_ED_DK1_CAN.OK_SCHWELLE K_ED_DK1_CAN.P_CODE_OPENLOAD K_ED_DK1_CAN.P_CODE_SH_TO_GND K_ED_DK1_CAN.P_CODE_SH_TO_UB K_ED_DK1_CAN.P_CODE_UNPLAUSIBEL K_ED_DK1_CMD.DEC_NACH_EINTRAG K_ED_DK1_CMD.DEC_VOR_EINTRAG K_ED_DK1_CMD.FEHLERSCHWELLE K_ED_DK1_CMD.INC_NACH_EINTRAG K_ED_DK1_CMD.INC_VOR_EINTRAG K_ED_DK1_CMD.KLASSENINDEX K_ED_DK1_CMD.OK_SCHWELLE K_ED_DK1_CMD.P_CODE_OPENLOAD K_ED_DK1_CMD.P_CODE_SH_TO_GND K_ED_DK1_CMD.P_CODE_SH_TO_UB K_ED_DK1_CMD.P_CODE_UNPLAUSIBEL K_ED_DK1_FEDERN.DEC_NACH_EINTRAG K_ED_DK1_FEDERN.DEC_VOR_EINTRAG K_ED_DK1_FEDERN.FEHLERSCHWELLE K_ED_DK1_FEDERN.INC_NACH_EINTRAG K_ED_DK1_FEDERN.INC_VOR_EINTRAG K_ED_DK1_FEDERN.KLASSENINDEX K_ED_DK1_FEDERN.OK_SCHWELLE K_ED_DK1_FEDERN.P_CODE_OPENLOAD K_ED_DK1_FEDERN.P_CODE_SH_TO_GND K_ED_DK1_FEDERN.P_CODE_SH_TO_UB K_ED_DK1_FEDERN.P_CODE_UNPLAUSIBEL K_ED_DK1_PDR.DEC_NACH_EINTRAG K_ED_DK1_PDR.DEC_VOR_EINTRAG K_ED_DK1_PDR.FEHLERSCHWELLE K_ED_DK1_PDR.INC_NACH_EINTRAG K_ED_DK1_PDR.INC_VOR_EINTRAG K_ED_DK1_PDR.KLASSENINDEX K_ED_DK1_PDR.OK_SCHWELLE K_ED_DK1_PDR.P_CODE_OPENLOAD K_ED_DK1_PDR.P_CODE_SH_TO_GND K_ED_DK1_PDR.P_CODE_SH_TO_UB K_ED_DK1_PDR.P_CODE_UNPLAUSIBEL K_ED_DK1_REGLER.DEC_NACH_EINTRAG K_ED_DK1_REGLER.DEC_VOR_EINTRAG K_ED_DK1_REGLER.FEHLERSCHWELLE K_ED_DK1_REGLER.INC_NACH_EINTRAG K_ED_DK1_REGLER.INC_VOR_EINTRAG K_ED_DK1_REGLER.KLASSENINDEX K_ED_DK1_REGLER.OK_SCHWELLE K_ED_DK1_REGLER.P_CODE_OPENLOAD K_ED_DK1_REGLER.P_CODE_SH_TO_GND K_ED_DK1_REGLER.P_CODE_SH_TO_UB K_ED_DK1_REGLER.P_CODE_UNPLAUSIBEL K_ED_DK1_SK_ERR.DEC_NACH_EINTRAG K_ED_DK1_SK_ERR.DEC_VOR_EINTRAG K_ED_DK1_SK_ERR.FEHLERSCHWELLE K_ED_DK1_SK_ERR.INC_NACH_EINTRAG K_ED_DK1_SK_ERR.INC_VOR_EINTRAG K_ED_DK1_SK_ERR.KLASSENINDEX K_ED_DK1_SK_ERR.OK_SCHWELLE K_ED_DK1_SK_ERR.P_CODE_OPENLOAD K_ED_DK1_SK_ERR.P_CODE_SH_TO_GND K_ED_DK1_SK_ERR.P_CODE_SH_TO_UB K_ED_DK1_SK_ERR.P_CODE_UNPLAUSIBEL K_ED_DK1_WDK.DEC_NACH_EINTRAG K_ED_DK1_WDK.DEC_VOR_EINTRAG K_ED_DK1_WDK.FEHLERSCHWELLE K_ED_DK1_WDK.INC_NACH_EINTRAG K_ED_DK1_WDK.INC_VOR_EINTRAG K_ED_DK1_WDK.KLASSENINDEX K_ED_DK1_WDK.OK_SCHWELLE K_ED_DK1_WDK.P_CODE_OPENLOAD K_ED_DK1_WDK.P_CODE_SH_TO_GND K_ED_DK1_WDK.P_CODE_SH_TO_UB K_ED_DK1_WDK.P_CODE_UNPLAUSIBEL K_ED_DK1_ZUST.DEC_NACH_EINTRAG K_ED_DK1_ZUST.DEC_VOR_EINTRAG K_ED_DK1_ZUST.FEHLERSCHWELLE K_ED_DK1_ZUST.INC_NACH_EINTRAG K_ED_DK1_ZUST.INC_VOR_EINTRAG K_ED_DK1_ZUST.KLASSENINDEX K_ED_DK1_ZUST.OK_SCHWELLE K_ED_DK1_ZUST.P_CODE_OPENLOAD K_ED_DK1_ZUST.P_CODE_SH_TO_GND K_ED_DK1_ZUST.P_CODE_SH_TO_UB K_ED_DK1_ZUST.P_CODE_UNPLAUSIBEL K_ED_DK2_ADAPT.DEC_NACH_EINTRAG K_ED_DK2_ADAPT.DEC_VOR_EINTRAG K_ED_DK2_ADAPT.FEHLERSCHWELLE K_ED_DK2_ADAPT.INC_NACH_EINTRAG K_ED_DK2_ADAPT.INC_VOR_EINTRAG K_ED_DK2_ADAPT.KLASSENINDEX K_ED_DK2_ADAPT.OK_SCHWELLE K_ED_DK2_ADAPT.P_CODE_OPENLOAD K_ED_DK2_ADAPT.P_CODE_SH_TO_GND K_ED_DK2_ADAPT.P_CODE_SH_TO_UB K_ED_DK2_ADAPT.P_CODE_UNPLAUSIBEL K_ED_DK2_CAN.DEC_NACH_EINTRAG K_ED_DK2_CAN.DEC_VOR_EINTRAG K_ED_DK2_CAN.FEHLERSCHWELLE K_ED_DK2_CAN.INC_NACH_EINTRAG K_ED_DK2_CAN.INC_VOR_EINTRAG K_ED_DK2_CAN.KLASSENINDEX K_ED_DK2_CAN.OK_SCHWELLE K_ED_DK2_CAN.P_CODE_OPENLOAD K_ED_DK2_CAN.P_CODE_SH_TO_GND K_ED_DK2_CAN.P_CODE_SH_TO_UB K_ED_DK2_CAN.P_CODE_UNPLAUSIBEL K_ED_DK2_CMD.DEC_NACH_EINTRAG K_ED_DK2_CMD.DEC_VOR_EINTRAG K_ED_DK2_CMD.FEHLERSCHWELLE K_ED_DK2_CMD.INC_NACH_EINTRAG K_ED_DK2_CMD.INC_VOR_EINTRAG K_ED_DK2_CMD.KLASSENINDEX K_ED_DK2_CMD.OK_SCHWELLE K_ED_DK2_CMD.P_CODE_OPENLOAD K_ED_DK2_CMD.P_CODE_SH_TO_GND K_ED_DK2_CMD.P_CODE_SH_TO_UB K_ED_DK2_CMD.P_CODE_UNPLAUSIBEL K_ED_DK2_FEDERN.DEC_NACH_EINTRAG K_ED_DK2_FEDERN.DEC_VOR_EINTRAG K_ED_DK2_FEDERN.FEHLERSCHWELLE K_ED_DK2_FEDERN.INC_NACH_EINTRAG K_ED_DK2_FEDERN.INC_VOR_EINTRAG K_ED_DK2_FEDERN.KLASSENINDEX K_ED_DK2_FEDERN.OK_SCHWELLE K_ED_DK2_FEDERN.P_CODE_OPENLOAD K_ED_DK2_FEDERN.P_CODE_SH_TO_GND K_ED_DK2_FEDERN.P_CODE_SH_TO_UB K_ED_DK2_FEDERN.P_CODE_UNPLAUSIBEL K_ED_DK2_PDR.DEC_NACH_EINTRAG K_ED_DK2_PDR.DEC_VOR_EINTRAG K_ED_DK2_PDR.FEHLERSCHWELLE K_ED_DK2_PDR.INC_NACH_EINTRAG K_ED_DK2_PDR.INC_VOR_EINTRAG K_ED_DK2_PDR.KLASSENINDEX K_ED_DK2_PDR.OK_SCHWELLE K_ED_DK2_PDR.P_CODE_OPENLOAD K_ED_DK2_PDR.P_CODE_SH_TO_GND K_ED_DK2_PDR.P_CODE_SH_TO_UB K_ED_DK2_PDR.P_CODE_UNPLAUSIBEL K_ED_DK2_REGLER.DEC_NACH_EINTRAG K_ED_DK2_REGLER.DEC_VOR_EINTRAG K_ED_DK2_REGLER.FEHLERSCHWELLE K_ED_DK2_REGLER.INC_NACH_EINTRAG K_ED_DK2_REGLER.INC_VOR_EINTRAG K_ED_DK2_REGLER.KLASSENINDEX K_ED_DK2_REGLER.OK_SCHWELLE K_ED_DK2_REGLER.P_CODE_OPENLOAD K_ED_DK2_REGLER.P_CODE_SH_TO_GND K_ED_DK2_REGLER.P_CODE_SH_TO_UB K_ED_DK2_REGLER.P_CODE_UNPLAUSIBEL K_ED_DK2_SK_ERR.DEC_NACH_EINTRAG K_ED_DK2_SK_ERR.DEC_VOR_EINTRAG K_ED_DK2_SK_ERR.FEHLERSCHWELLE K_ED_DK2_SK_ERR.INC_NACH_EINTRAG K_ED_DK2_SK_ERR.INC_VOR_EINTRAG K_ED_DK2_SK_ERR.KLASSENINDEX K_ED_DK2_SK_ERR.OK_SCHWELLE K_ED_DK2_SK_ERR.P_CODE_OPENLOAD K_ED_DK2_SK_ERR.P_CODE_SH_TO_GND K_ED_DK2_SK_ERR.P_CODE_SH_TO_UB K_ED_DK2_SK_ERR.P_CODE_UNPLAUSIBEL K_ED_DK2_WDK.DEC_NACH_EINTRAG K_ED_DK2_WDK.DEC_VOR_EINTRAG K_ED_DK2_WDK.FEHLERSCHWELLE K_ED_DK2_WDK.INC_NACH_EINTRAG K_ED_DK2_WDK.INC_VOR_EINTRAG K_ED_DK2_WDK.KLASSENINDEX K_ED_DK2_WDK.OK_SCHWELLE K_ED_DK2_WDK.P_CODE_OPENLOAD K_ED_DK2_WDK.P_CODE_SH_TO_GND K_ED_DK2_WDK.P_CODE_SH_TO_UB K_ED_DK2_WDK.P_CODE_UNPLAUSIBEL K_ED_DK2_ZUST.DEC_NACH_EINTRAG K_ED_DK2_ZUST.DEC_VOR_EINTRAG K_ED_DK2_ZUST.FEHLERSCHWELLE K_ED_DK2_ZUST.INC_NACH_EINTRAG K_ED_DK2_ZUST.INC_VOR_EINTRAG K_ED_DK2_ZUST.KLASSENINDEX K_ED_DK2_ZUST.OK_SCHWELLE K_ED_DK2_ZUST.P_CODE_OPENLOAD K_ED_DK2_ZUST.P_CODE_SH_TO_GND K_ED_DK2_ZUST.P_CODE_SH_TO_UB K_ED_DK2_ZUST.P_CODE_UNPLAUSIBEL K_ED_DK_INIT.DEC_NACH_EINTRAG K_ED_DK_INIT.DEC_VOR_EINTRAG K_ED_DK_INIT.FEHLERSCHWELLE K_ED_DK_INIT.INC_NACH_EINTRAG K_ED_DK_INIT.INC_VOR_EINTRAG K_ED_DK_INIT.KLASSENINDEX K_ED_DK_INIT.OK_SCHWELLE K_ED_DK_INIT.P_CODE_OPENLOAD K_ED_DK_INIT.P_CODE_SH_TO_GND K_ED_DK_INIT.P_CODE_SH_TO_UB K_ED_DK_INIT.P_CODE_UNPLAUSIBEL K_ED_DSC_EINGR.DEC_NACH_EINTRAG K_ED_DSC_EINGR.DEC_VOR_EINTRAG K_ED_DSC_EINGR.FEHLERSCHWELLE K_ED_DSC_EINGR.INC_NACH_EINTRAG K_ED_DSC_EINGR.INC_VOR_EINTRAG K_ED_DSC_EINGR.KLASSENINDEX K_ED_DSC_EINGR.OK_SCHWELLE K_ED_DSC_EINGR.P_CODE_OPENLOAD K_ED_DSC_EINGR.P_CODE_SH_TO_GND K_ED_DSC_EINGR.P_CODE_SH_TO_UB K_ED_DSC_EINGR.P_CODE_UNPLAUSIBEL K_ED_E2_IGN.DEC_NACH_EINTRAG K_ED_E2_IGN.DEC_VOR_EINTRAG K_ED_E2_IGN.FEHLERSCHWELLE K_ED_E2_IGN.INC_NACH_EINTRAG K_ED_E2_IGN.INC_VOR_EINTRAG K_ED_E2_IGN.KLASSENINDEX K_ED_E2_IGN.OK_SCHWELLE K_ED_E2_IGN.P_CODE_OPENLOAD K_ED_E2_IGN.P_CODE_SH_TO_GND K_ED_E2_IGN.P_CODE_SH_TO_UB K_ED_E2_IGN.P_CODE_UNPLAUSIBEL K_ED_EC_BUSOFF.DEC_NACH_EINTRAG K_ED_EC_BUSOFF.DEC_VOR_EINTRAG K_ED_EC_BUSOFF.FEHLERSCHWELLE K_ED_EC_BUSOFF.INC_NACH_EINTRAG K_ED_EC_BUSOFF.INC_VOR_EINTRAG K_ED_EC_BUSOFF.KLASSENINDEX K_ED_EC_BUSOFF.OK_SCHWELLE K_ED_EC_BUSOFF.P_CODE_OPENLOAD K_ED_EC_BUSOFF.P_CODE_SH_TO_GND K_ED_EC_BUSOFF.P_CODE_SH_TO_UB K_ED_EC_BUSOFF.P_CODE_UNPLAUSIBEL K_ED_FGR_ABWURF.DEC_NACH_EINTRAG K_ED_FGR_ABWURF.DEC_VOR_EINTRAG K_ED_FGR_ABWURF.FEHLERSCHWELLE K_ED_FGR_ABWURF.INC_NACH_EINTRAG K_ED_FGR_ABWURF.INC_VOR_EINTRAG K_ED_FGR_ABWURF.KLASSENINDEX K_ED_FGR_ABWURF.OK_SCHWELLE K_ED_FGR_ABWURF.P_CODE_OPENLOAD K_ED_FGR_ABWURF.P_CODE_SH_TO_GND K_ED_FGR_ABWURF.P_CODE_SH_TO_UB K_ED_FGR_ABWURF.P_CODE_UNPLAUSIBEL K_ED_FST_MAX K_ED_INDEX_110_IGN.DEC_NACH_EINTRAG K_ED_INDEX_110_IGN.DEC_VOR_EINTRAG K_ED_INDEX_110_IGN.FEHLERSCHWELLE K_ED_INDEX_110_IGN.INC_NACH_EINTRAG K_ED_INDEX_110_IGN.INC_VOR_EINTRAG K_ED_INDEX_110_IGN.KLASSENINDEX K_ED_INDEX_110_IGN.OK_SCHWELLE K_ED_INDEX_110_IGN.P_CODE_OPENLOAD K_ED_INDEX_110_IGN.P_CODE_SH_TO_GND K_ED_INDEX_110_IGN.P_CODE_SH_TO_UB K_ED_INDEX_110_IGN.P_CODE_UNPLAUSIBEL K_ED_INDEX_111_IGN.DEC_NACH_EINTRAG K_ED_INDEX_111_IGN.DEC_VOR_EINTRAG K_ED_INDEX_111_IGN.FEHLERSCHWELLE K_ED_INDEX_111_IGN.INC_NACH_EINTRAG K_ED_INDEX_111_IGN.INC_VOR_EINTRAG K_ED_INDEX_111_IGN.KLASSENINDEX K_ED_INDEX_111_IGN.OK_SCHWELLE K_ED_INDEX_111_IGN.P_CODE_OPENLOAD K_ED_INDEX_111_IGN.P_CODE_SH_TO_GND K_ED_INDEX_111_IGN.P_CODE_SH_TO_UB K_ED_INDEX_111_IGN.P_CODE_UNPLAUSIBEL K_ED_INDEX_112_IGN.DEC_NACH_EINTRAG K_ED_INDEX_112_IGN.DEC_VOR_EINTRAG K_ED_INDEX_112_IGN.FEHLERSCHWELLE K_ED_INDEX_112_IGN.INC_NACH_EINTRAG K_ED_INDEX_112_IGN.INC_VOR_EINTRAG K_ED_INDEX_112_IGN.KLASSENINDEX K_ED_INDEX_112_IGN.OK_SCHWELLE K_ED_INDEX_112_IGN.P_CODE_OPENLOAD K_ED_INDEX_112_IGN.P_CODE_SH_TO_GND K_ED_INDEX_112_IGN.P_CODE_SH_TO_UB K_ED_INDEX_112_IGN.P_CODE_UNPLAUSIBEL K_ED_INDEX_113_IGN.DEC_NACH_EINTRAG K_ED_INDEX_113_IGN.DEC_VOR_EINTRAG K_ED_INDEX_113_IGN.FEHLERSCHWELLE K_ED_INDEX_113_IGN.INC_NACH_EINTRAG K_ED_INDEX_113_IGN.INC_VOR_EINTRAG K_ED_INDEX_113_IGN.KLASSENINDEX K_ED_INDEX_113_IGN.OK_SCHWELLE K_ED_INDEX_113_IGN.P_CODE_OPENLOAD K_ED_INDEX_113_IGN.P_CODE_SH_TO_GND K_ED_INDEX_113_IGN.P_CODE_SH_TO_UB K_ED_INDEX_113_IGN.P_CODE_UNPLAUSIBEL K_ED_INDEX_114_IGN.DEC_NACH_EINTRAG K_ED_INDEX_114_IGN.DEC_VOR_EINTRAG K_ED_INDEX_114_IGN.FEHLERSCHWELLE K_ED_INDEX_114_IGN.INC_NACH_EINTRAG K_ED_INDEX_114_IGN.INC_VOR_EINTRAG K_ED_INDEX_114_IGN.KLASSENINDEX K_ED_INDEX_114_IGN.OK_SCHWELLE K_ED_INDEX_114_IGN.P_CODE_OPENLOAD K_ED_INDEX_114_IGN.P_CODE_SH_TO_GND K_ED_INDEX_114_IGN.P_CODE_SH_TO_UB K_ED_INDEX_114_IGN.P_CODE_UNPLAUSIBEL K_ED_INDEX_115_IGN.DEC_NACH_EINTRAG K_ED_INDEX_115_IGN.DEC_VOR_EINTRAG K_ED_INDEX_115_IGN.FEHLERSCHWELLE K_ED_INDEX_115_IGN.INC_NACH_EINTRAG K_ED_INDEX_115_IGN.INC_VOR_EINTRAG K_ED_INDEX_115_IGN.KLASSENINDEX K_ED_INDEX_115_IGN.OK_SCHWELLE K_ED_INDEX_115_IGN.P_CODE_OPENLOAD K_ED_INDEX_115_IGN.P_CODE_SH_TO_GND K_ED_INDEX_115_IGN.P_CODE_SH_TO_UB K_ED_INDEX_115_IGN.P_CODE_UNPLAUSIBEL K_ED_INDEX_116_IGN.DEC_NACH_EINTRAG K_ED_INDEX_116_IGN.DEC_VOR_EINTRAG K_ED_INDEX_116_IGN.FEHLERSCHWELLE K_ED_INDEX_116_IGN.INC_NACH_EINTRAG K_ED_INDEX_116_IGN.INC_VOR_EINTRAG K_ED_INDEX_116_IGN.KLASSENINDEX K_ED_INDEX_116_IGN.OK_SCHWELLE K_ED_INDEX_116_IGN.P_CODE_OPENLOAD K_ED_INDEX_116_IGN.P_CODE_SH_TO_GND K_ED_INDEX_116_IGN.P_CODE_SH_TO_UB K_ED_INDEX_116_IGN.P_CODE_UNPLAUSIBEL K_ED_INDEX_117_IGN.DEC_NACH_EINTRAG K_ED_INDEX_117_IGN.DEC_VOR_EINTRAG K_ED_INDEX_117_IGN.FEHLERSCHWELLE K_ED_INDEX_117_IGN.INC_NACH_EINTRAG K_ED_INDEX_117_IGN.INC_VOR_EINTRAG K_ED_INDEX_117_IGN.KLASSENINDEX K_ED_INDEX_117_IGN.OK_SCHWELLE K_ED_INDEX_117_IGN.P_CODE_OPENLOAD K_ED_INDEX_117_IGN.P_CODE_SH_TO_GND K_ED_INDEX_117_IGN.P_CODE_SH_TO_UB K_ED_INDEX_117_IGN.P_CODE_UNPLAUSIBEL K_ED_INDEX_118_IGN.DEC_NACH_EINTRAG K_ED_INDEX_118_IGN.DEC_VOR_EINTRAG K_ED_INDEX_118_IGN.FEHLERSCHWELLE K_ED_INDEX_118_IGN.INC_NACH_EINTRAG K_ED_INDEX_118_IGN.INC_VOR_EINTRAG K_ED_INDEX_118_IGN.KLASSENINDEX K_ED_INDEX_118_IGN.OK_SCHWELLE K_ED_INDEX_118_IGN.P_CODE_OPENLOAD K_ED_INDEX_118_IGN.P_CODE_SH_TO_GND K_ED_INDEX_118_IGN.P_CODE_SH_TO_UB K_ED_INDEX_118_IGN.P_CODE_UNPLAUSIBEL K_ED_INDEX_119_IGN.DEC_NACH_EINTRAG K_ED_INDEX_119_IGN.DEC_VOR_EINTRAG K_ED_INDEX_119_IGN.FEHLERSCHWELLE K_ED_INDEX_119_IGN.INC_NACH_EINTRAG K_ED_INDEX_119_IGN.INC_VOR_EINTRAG K_ED_INDEX_119_IGN.KLASSENINDEX K_ED_INDEX_119_IGN.OK_SCHWELLE K_ED_INDEX_119_IGN.P_CODE_OPENLOAD K_ED_INDEX_119_IGN.P_CODE_SH_TO_GND K_ED_INDEX_119_IGN.P_CODE_SH_TO_UB K_ED_INDEX_119_IGN.P_CODE_UNPLAUSIBEL K_ED_INDEX_120_IGN.DEC_NACH_EINTRAG K_ED_INDEX_120_IGN.DEC_VOR_EINTRAG K_ED_INDEX_120_IGN.FEHLERSCHWELLE K_ED_INDEX_120_IGN.INC_NACH_EINTRAG K_ED_INDEX_120_IGN.INC_VOR_EINTRAG K_ED_INDEX_120_IGN.KLASSENINDEX K_ED_INDEX_120_IGN.OK_SCHWELLE K_ED_INDEX_120_IGN.P_CODE_OPENLOAD K_ED_INDEX_120_IGN.P_CODE_SH_TO_GND K_ED_INDEX_120_IGN.P_CODE_SH_TO_UB K_ED_INDEX_120_IGN.P_CODE_UNPLAUSIBEL K_ED_INDEX_121_IGN.DEC_NACH_EINTRAG K_ED_INDEX_121_IGN.DEC_VOR_EINTRAG K_ED_INDEX_121_IGN.FEHLERSCHWELLE K_ED_INDEX_121_IGN.INC_NACH_EINTRAG K_ED_INDEX_121_IGN.INC_VOR_EINTRAG K_ED_INDEX_121_IGN.KLASSENINDEX /end DEF_CHARACTERISTIC
 /begin REF_CHARACTERISTIC /end REF_CHARACTERISTIC
 /begin IN_MEASUREMENT /end IN_MEASUREMENT
 /begin OUT_MEASUREMENT /end OUT_MEASUREMENT
/end FUNCTION
/begin RECORD_LAYOUT TKW_VV_VV_UB FNC_VALUES 1 UBYTE COLUMN_DIR DIRECT /end RECORD_LAYOUT
/begin RECORD_LAYOUT TKW_VV_VV_UW FNC_VALUES 1 UWORD COLUMN_DIR DIRECT /end RECORD_LAYOUT
/end MODULE
/end PROJECT
