/begin PROJECT MSS65-ign-V912 "MSS65 IGN - V912.00-B204.00, data set 0569Q60Z520E"
/begin HEADER "" VERSION "V912.00-B204.00" /end HEADER
/begin MODULE _MSS65-ign "MSS65 IGN - V912.00-B204.00, data 7842800"
/begin MOD_COMMON "" BYTE_ORDER MSB_FIRST /* Default byteorder (Motorola) */ /end MOD_COMMON
/* ------------------ Abschnitt erzeugt aus adapt_common.dat ------------------ */
/begin COMPU_METHOD FORMULA_0000 "FORMULA_0000" RAT_FUNC "%7.0" "-" COEFFS 0 1 0 0 0 1 /end COMPU_METHOD
/begin COMPU_METHOD FORMULA_0001 "FORMULA_0001" RAT_FUNC "%6.1" "%" COEFFS 0 10 0 0 0 1 /end COMPU_METHOD
/begin COMPU_METHOD FORMULA_0003 "FORMULA_0003" RAT_FUNC "%3.0" "-" COEFFS 0 1 0 0 0 1 /end COMPU_METHOD
/begin COMPU_METHOD FORMULA_0006 "FORMULA_0006" RAT_FUNC "%5.0" "Upm" COEFFS 0 1 0 0 0 1 /end COMPU_METHOD
/begin COMPU_METHOD FORMULA_0007 "FORMULA_0007" RAT_FUNC "%8.3" "-" COEFFS 0 10000 0 0 0 1 /end COMPU_METHOD
/begin COMPU_METHOD FORMULA_0008 "FORMULA_0008" RAT_FUNC "%6.1" "V" COEFFS 0 10 0 0 0 1 /end COMPU_METHOD
/begin COMPU_METHOD FORMULA_0009 "FORMULA_0009" RAT_FUNC "%6.1" "Nm" COEFFS 0 10 0 0 0 1 /end COMPU_METHOD
/begin COMPU_METHOD FORMULA_0010 "FORMULA_0010" RAT_FUNC "%5.0" "-" COEFFS 0 1 0 0 0 1 /end COMPU_METHOD
/begin COMPU_METHOD FORMULA_0017 "FORMULA_0017" RAT_FUNC "%9.2" "ms" COEFFS 0 7000 0 0 0 1 /end COMPU_METHOD
/begin COMPU_METHOD FORMULA_0020 "FORMULA_0020" RAT_FUNC "%5.0" "qmm/s" COEFFS 0 1 0 0 0 20 /end COMPU_METHOD
/begin COMPU_METHOD FORMULA_0021 "FORMULA_0021" RAT_FUNC "%7.2" "s" COEFFS 0 100 0 0 0 1 /end COMPU_METHOD
/begin COMPU_METHOD FORMULA_0022 "FORMULA_0022" RAT_FUNC "%7.2" "%" COEFFS 0 100 0 0 0 1 /end COMPU_METHOD
/* ------------------ Abschnitt erzeugt aus adapt_glob.dat ------------------ */
/begin COMPU_METHOD FORMULA_0023 "FORMULA_0023" RAT_FUNC "%6.1" "�C" COEFFS 0 10 2732 0 0 1 /end COMPU_METHOD
/begin COMPU_METHOD FORMULA_0024 "FORMULA_0024" RAT_FUNC "%9.4" "-" COEFFS 0 32768 0 0 0 1 /end COMPU_METHOD
/begin COMPU_METHOD FORMULA_0025 "FORMULA_0025" RAT_FUNC "%8.3" "-" COEFFS 0 16384 0 0 0 1 /end COMPU_METHOD
/begin COMPU_METHOD FORMULA_0062 "FORMULA_0062" RAT_FUNC "%5.0" "s" COEFFS 0 1 0 0 0 1 /end COMPU_METHOD
/begin COMPU_METHOD FORMULA_0073 "FORMULA_0073" RAT_FUNC "%6.1" "s" COEFFS 0 10 0 0 0 1 /end COMPU_METHOD
/begin COMPU_METHOD FORMULA_0075 "FORMULA_0075" RAT_FUNC "%8.3" "-" COEFFS 0 1024 0 0 0 1 /end COMPU_METHOD
/begin COMPU_METHOD FORMULA_0076 "FORMULA_0076" RAT_FUNC "%6.1" "Kelvin" COEFFS 0 10 0 0 0 1 /end COMPU_METHOD
/begin COMPU_METHOD FORMULA_0077 "FORMULA_0077" RAT_FUNC "%6.1" "mbar" COEFFS 0 16 0 0 0 1 /end COMPU_METHOD
/begin COMPU_METHOD FORMULA_0078 "FORMULA_0078" RAT_FUNC "%6.1" "km/h" COEFFS 0 16 0 0 0 1 /end COMPU_METHOD
/begin COMPU_METHOD FORMULA_0109 "FORMULA_0109" RAT_FUNC "%7.2" "-" COEFFS 0 10000 0 0 0 1 /end COMPU_METHOD
/begin COMPU_METHOD FORMULA_0111 "FORMULA_0111" RAT_FUNC "%6.1" "�KW" COEFFS 0 10 0 0 0 1 /end COMPU_METHOD
/begin COMPU_METHOD FORMULA_0112 "FORMULA_0112" RAT_FUNC "%6.1" "kg/h" COEFFS 0 10 0 0 0 1 /end COMPU_METHOD
/begin COMPU_METHOD FORMULA_0114 "FORMULA_0114" RAT_FUNC "%5.0" "Upm/s" COEFFS 0 1 0 0 0 1 /end COMPU_METHOD
/begin COMPU_METHOD FORMULA_0115 "FORMULA_0115" RAT_FUNC "%7.2" "%" COEFFS 0 16384 0 0 0 100 /end COMPU_METHOD
/begin COMPU_METHOD FORMULA_0117 "FORMULA_0117" RAT_FUNC "%7.2" "s" COEFFS 0 200 0 0 0 1 /end COMPU_METHOD
/begin COMPU_METHOD FORMULA_0132 "FORMULA_0132" RAT_FUNC "%7.2" "m/(s*s)" COEFFS 0 40 0 0 0 1 /end COMPU_METHOD
/begin COMPU_METHOD FORMULA_0147 "FORMULA_0147" RAT_FUNC "%6.1" "qmm" COEFFS 0 10 0 0 0 1 /end COMPU_METHOD
/begin COMPU_METHOD FORMULA_0181 "FORMULA_0181" TAB_VERB "%3.0" "-" COMPU_TAB_REF FORMULA_0181_VTAB /end COMPU_METHOD
/begin COMPU_VTAB FORMULA_0181_VTAB "FORMULA_0181_VTAB" TAB_VERB 2 0 "iO" 1 "KH-Sperre" /end COMPU_VTAB
/begin COMPU_METHOD FORMULA_0182 "FORMULA_0182" TAB_VERB "%3.0" "-" COMPU_TAB_REF FORMULA_0182_VTAB /end COMPU_METHOD
/begin COMPU_VTAB FORMULA_0182_VTAB "FORMULA_0182_VTAB" TAB_VERB 3 0 "iO" 1 "HFM" 2 "AQ" /end COMPU_VTAB
/begin COMPU_METHOD FORMULA_0183 "FORMULA_0183" TAB_VERB "%3.0" "-" COMPU_TAB_REF FORMULA_0183_VTAB /end COMPU_METHOD
/begin COMPU_VTAB FORMULA_0183_VTAB "FORMULA_0183_VTAB" TAB_VERB 2 0 "iO" 1 "FR-Sperre" /end COMPU_VTAB
/begin COMPU_METHOD FORMULA_0184 "FORMULA_0184" TAB_VERB "%5.0" "-" COMPU_TAB_REF FORMULA_0184_VTAB /end COMPU_METHOD
/begin COMPU_VTAB FORMULA_0184_VTAB "FORMULA_0184_VTAB" TAB_VERB 1 0 "alle ein" /end COMPU_VTAB
/begin COMPU_METHOD FORMULA_0185 "FORMULA_0185" TAB_VERB "%7.2" "-" COMPU_TAB_REF FORMULA_0185_VTAB /end COMPU_METHOD
/begin COMPU_VTAB FORMULA_0185_VTAB "FORMULA_0185_VTAB" TAB_VERB 2 0 "-" 1 "zulaessig" /end COMPU_VTAB
/begin COMPU_METHOD FORMULA_0186 "FORMULA_0186" TAB_VERB "%7.2" "-" COMPU_TAB_REF FORMULA_0186_VTAB /end COMPU_METHOD
/begin COMPU_VTAB FORMULA_0186_VTAB "FORMULA_0186_VTAB" TAB_VERB 2 0 "-" 1 "aktiv" /end COMPU_VTAB
/begin COMPU_METHOD FORMULA_0187 "FORMULA_0187" TAB_VERB "%7.2" "-" COMPU_TAB_REF FORMULA_0187_VTAB /end COMPU_METHOD
/begin COMPU_VTAB FORMULA_0187_VTAB "FORMULA_0187_VTAB" TAB_VERB 2 0 "-" 1 "Abbruch" /end COMPU_VTAB
/begin COMPU_METHOD FORMULA_0188 "FORMULA_0188" TAB_VERB "%7.2" "-" COMPU_TAB_REF FORMULA_0188_VTAB /end COMPU_METHOD
/begin COMPU_VTAB FORMULA_0188_VTAB "FORMULA_0188_VTAB" TAB_VERB 2 0 "-" 1 "STOP" /end COMPU_VTAB
/begin COMPU_METHOD FORMULA_0189 "FORMULA_0189" TAB_VERB "%7.2" "-" COMPU_TAB_REF FORMULA_0189_VTAB /end COMPU_METHOD
/begin COMPU_VTAB FORMULA_0189_VTAB "FORMULA_0189_VTAB" TAB_VERB 2 0 "-" 1 "DAUER" /end COMPU_VTAB
/begin COMPU_METHOD FORMULA_0190 "FORMULA_0190" TAB_VERB "%7.2" "-" COMPU_TAB_REF FORMULA_0190_VTAB /end COMPU_METHOD
/begin COMPU_VTAB FORMULA_0190_VTAB "FORMULA_0190_VTAB" TAB_VERB 2 0 "no" 1 "yes" /end COMPU_VTAB
/begin COMPU_METHOD FORMULA_0191 "FORMULA_0191" TAB_VERB "%7.2" "-" COMPU_TAB_REF FORMULA_0191_VTAB /end COMPU_METHOD
/begin COMPU_VTAB FORMULA_0191_VTAB "FORMULA_0191_VTAB" TAB_VERB 2 0 "no" 1 "yes" /end COMPU_VTAB
/begin COMPU_METHOD FORMULA_0192 "FORMULA_0192" TAB_VERB "%7.2" "-" COMPU_TAB_REF FORMULA_0192_VTAB /end COMPU_METHOD
/begin COMPU_VTAB FORMULA_0192_VTAB "FORMULA_0192_VTAB" TAB_VERB 2 0 "no" 1 "yes" /end COMPU_VTAB
/begin COMPU_METHOD FORMULA_0193 "FORMULA_0193" TAB_VERB "%7.2" "-" COMPU_TAB_REF FORMULA_0193_VTAB /end COMPU_METHOD
/begin COMPU_VTAB FORMULA_0193_VTAB "FORMULA_0193_VTAB" TAB_VERB 2 0 "no" 1 "yes" /end COMPU_VTAB
/begin COMPU_METHOD FORMULA_0194 "FORMULA_0194" TAB_VERB "%7.2" "-" COMPU_TAB_REF FORMULA_0194_VTAB /end COMPU_METHOD
/begin COMPU_VTAB FORMULA_0194_VTAB "FORMULA_0194_VTAB" TAB_VERB 2 0 "no" 1 "yes" /end COMPU_VTAB
/begin COMPU_METHOD FORMULA_0195 "FORMULA_0195" TAB_VERB "%7.2" "-" COMPU_TAB_REF FORMULA_0195_VTAB /end COMPU_METHOD
/begin COMPU_VTAB FORMULA_0195_VTAB "FORMULA_0195_VTAB" TAB_VERB 2 0 "i.O." 1 "SH_TO_X_SPERREN" /end COMPU_VTAB
/begin COMPU_METHOD FORMULA_0196 "FORMULA_0196" TAB_VERB "%7.2" "-" COMPU_TAB_REF FORMULA_0196_VTAB /end COMPU_METHOD
/begin COMPU_VTAB FORMULA_0196_VTAB "FORMULA_0196_VTAB" TAB_VERB 2 0 "i.O." 1 "SH_TO_X_SPERREN" /end COMPU_VTAB
/begin COMPU_METHOD FORMULA_0197 "FORMULA_0197" TAB_VERB "%7.2" "-" COMPU_TAB_REF FORMULA_0197_VTAB /end COMPU_METHOD
/begin COMPU_VTAB FORMULA_0197_VTAB "FORMULA_0197_VTAB" TAB_VERB 5 1 "SPUELEN-INI" 2 "TE-LAA-INI" 4 "SPUELEN KURZ" 8 "SPUELEN LANG" 16 "TE-LAA" DEFAULT_VALUE "nicht verf." /end COMPU_VTAB
/begin COMPU_METHOD FORMULA_0198 "FORMULA_0198" TAB_VERB "%7.2" "-" COMPU_TAB_REF FORMULA_0198_VTAB /end COMPU_METHOD
/begin COMPU_VTAB FORMULA_0198_VTAB "FORMULA_0198_VTAB" TAB_VERB 14 0 "AUS" 1 "WAIT" 2 "HFM-DIAG" 4 "ML-PLAUS" 8 "MDF-WAIT" 16 "MDF-DIAG" 32 "ZWD-100" 64 "ZWD-0" 128 "ZWD-OFF" 256 "SLV-DIAG" 512 "Abgas Lambda" 8192 "DIAG Ende Abbruch" 16384 "DIAG Ende IO" 32768 "DIAG Ende NIO" DEFAULT_VALUE "Ende mit Fehler" /end COMPU_VTAB
/begin COMPU_METHOD FORMULA_0199 "FORMULA_0199" TAB_VERB "%5.0" "-" COMPU_TAB_REF FORMULA_0199_VTAB /end COMPU_METHOD
/begin COMPU_VTAB FORMULA_0199_VTAB "FORMULA_0199_VTAB" TAB_VERB 13 0 "Motor steht" 1 "Normalbetrieb" 2 "Notlauf" 5 "Normal/Warmlauf" 8 "nBegr" 12 "nBegr/Warmlauf" 16 "vBegr" 20 "vBegr/Warmlauf" 32 "DSC" 36 "DSC/Warmlauf" 64 "Getr" 68 "Getr/Warmlauf" 128 "Rollenbetrieb" DEFAULT_VALUE "undef" /end COMPU_VTAB
/begin COMPU_METHOD FORMULA_0200 "FORMULA_0200" TAB_VERB "%5.2" "-" COMPU_TAB_REF FORMULA_0200_VTAB /end COMPU_METHOD
/begin COMPU_VTAB FORMULA_0200_VTAB "FORMULA_0200_VTAB" TAB_VERB 1 1 "time_ms Ok" DEFAULT_VALUE "aus" /end COMPU_VTAB
/begin COMPU_METHOD FORMULA_0201 "FORMULA_0201" TAB_VERB "%3.0" "-" COMPU_TAB_REF FORMULA_0201_VTAB /end COMPU_METHOD
/begin COMPU_VTAB FORMULA_0201_VTAB "FORMULA_0201_VTAB" TAB_VERB 3 0 "ATIC39-Treiber aus [ELUP aus]" 1 "ATIC39-Treiber an [ELUP an]" 2 "wg. SHT_TO_UB ATIC39-Treiber+ELUP aus" DEFAULT_VALUE "undef" /end COMPU_VTAB
/begin COMPU_METHOD FORMULA_0202 "FORMULA_0202" TAB_VERB "%5.0" "-" COMPU_TAB_REF FORMULA_0202_VTAB /end COMPU_METHOD
/begin COMPU_VTAB FORMULA_0202_VTAB "FORMULA_0202_VTAB" TAB_VERB 10 0 "AUS" 1 "Ger 2.5" 2 "Ger 5.5" 4 "Ger" 8 "Rampe" 16 "TV 100%" 32 "TV 65%" 64 "TV 65% FW 100%" 16384 "Abbruch" 32768 "Ende" /end COMPU_VTAB
/begin COMPU_METHOD FORMULA_0203 "FORMULA_0203" RAT_FUNC "%8.3" "-/10ms" COEFFS 0 10000 0 0 0 1 /end COMPU_METHOD
/begin COMPU_METHOD FORMULA_0204 "FORMULA_0204" RAT_FUNC "%8.3" "100/10ms" COEFFS 0 100 0 0 0 1 /end COMPU_METHOD
/begin COMPU_METHOD FORMULA_0205 "FORMULA_0205" TAB_VERB "%5.2" "-" COMPU_TAB_REF FORMULA_0205_VTAB /end COMPU_METHOD
/begin COMPU_VTAB FORMULA_0205_VTAB "FORMULA_0205_VTAB" TAB_VERB 4 0 "in Ordnung" 1 "kein Wert empf." 128 "Err/TUMG" 129 "Fehler/TAN" /end COMPU_VTAB
/begin COMPU_METHOD FORMULA_0206 "FORMULA_0206" TAB_VERB "%5.2" "-" COMPU_TAB_REF FORMULA_0206_VTAB /end COMPU_METHOD
/begin COMPU_VTAB FORMULA_0206_VTAB "FORMULA_0206_VTAB" TAB_VERB 4 0 "in Ordnung" 1 "Abs-Err" 2 "Rel-Err" 3 "Abs-Rel-Err" /end COMPU_VTAB
/begin COMPU_METHOD FORMULA_0207 "FORMULA_0207" RAT_FUNC "%5.0" "Tage" COEFFS 0 1 0 0 0 1 /end COMPU_METHOD
/begin COMPU_METHOD FORMULA_0208 "FORMULA_0208" TAB_VERB "%5.2" "-" COMPU_TAB_REF FORMULA_0208_VTAB /end COMPU_METHOD
/begin COMPU_VTAB FORMULA_0208_VTAB "FORMULA_0208_VTAB" TAB_VERB 7 0 "in Ordnung" 1 "Range" 2 "Reserve" 4 "Fst links" 8 "Fst rechts" 16 "Fst Summe" 32 "km-Stand" DEFAULT_VALUE "selbstrechnen" /end COMPU_VTAB
/begin COMPU_METHOD FORMULA_0209 "FORMULA_0209" RAT_FUNC "%3.0" "�C" COEFFS 0 1 55.2 0 0 0.9 /end COMPU_METHOD
/begin COMPU_METHOD FORMULA_0210 "FORMULA_0210" TAB_VERB "%7.2" "-" COMPU_TAB_REF FORMULA_0210_VTAB /end COMPU_METHOD
/begin COMPU_VTAB FORMULA_0210_VTAB "FORMULA_0210_VTAB" TAB_VERB 10 0 "init" 1 "an" 2 "Bauteilschutz" 4 "an OBD" 8 "aus ED" 16 "Abbruch" 32 "aus" 64 "aus Restlaufzeit" 128 "an Restlaufzeit" 256 "an Prueflauf" DEFAULT_VALUE "undef" /end COMPU_VTAB
/begin COMPU_METHOD FORMULA_0211 "FORMULA_0211" TAB_VERB "%5.2" "-" COMPU_TAB_REF FORMULA_0211_VTAB /end COMPU_METHOD
/begin COMPU_VTAB FORMULA_0211_VTAB "FORMULA_0211_VTAB" TAB_VERB 4 0 "aus" 1 "an" 2 "an OBD" 4 "aus ED" DEFAULT_VALUE "ungueltig" /end COMPU_VTAB
/begin COMPU_METHOD FORMULA_0212 "FORMULA_0212" TAB_VERB "%3.0" "-" COMPU_TAB_REF FORMULA_0212_VTAB /end COMPU_METHOD
/begin COMPU_VTAB FORMULA_0212_VTAB "FORMULA_0212_VTAB" TAB_VERB 4 0 "iO" 1 "Kombi-Err" 2 "ACC-Err" 4 "FGR-Err" DEFAULT_VALUE "Mehrfach" /end COMPU_VTAB
/begin COMPU_METHOD FORMULA_0213 "FORMULA_0213" TAB_VERB "%3.0" "-" COMPU_TAB_REF FORMULA_0213_VTAB /end COMPU_METHOD
/begin COMPU_VTAB FORMULA_0213_VTAB "FORMULA_0213_VTAB" TAB_VERB 2 0 "Aus" 1 "Ein" /end COMPU_VTAB
/begin COMPU_METHOD FORMULA_0214 "FORMULA_0214" TAB_VERB "%3.0" "-" COMPU_TAB_REF FORMULA_0214_VTAB /end COMPU_METHOD
/begin COMPU_VTAB FORMULA_0214_VTAB "FORMULA_0214_VTAB" TAB_VERB 2 0 "Aus" 1 "Ein" /end COMPU_VTAB
/begin COMPU_METHOD FORMULA_0215 "FORMULA_0215" TAB_VERB "%3.0" "-" COMPU_TAB_REF FORMULA_0215_VTAB /end COMPU_METHOD
/begin COMPU_VTAB FORMULA_0215_VTAB "FORMULA_0215_VTAB" TAB_VERB 2 0 "Nein" 1 "Ja" /end COMPU_VTAB
/begin COMPU_METHOD FORMULA_0216 "FORMULA_0216" TAB_VERB "%5.2" "-" COMPU_TAB_REF FORMULA_0216_VTAB /end COMPU_METHOD
/begin COMPU_VTAB FORMULA_0216_VTAB "FORMULA_0216_VTAB" TAB_VERB 2 0 "nein" 1 "ja" /end COMPU_VTAB
/begin COMPU_METHOD FORMULA_0217 "FORMULA_0217" TAB_VERB "%5.2" "-" COMPU_TAB_REF FORMULA_0217_VTAB /end COMPU_METHOD
/begin COMPU_VTAB FORMULA_0217_VTAB "FORMULA_0217_VTAB" TAB_VERB 2 0 "nein" 1 "ja" /end COMPU_VTAB
/begin COMPU_METHOD FORMULA_0218 "FORMULA_0218" TAB_VERB "%5.2" "-" COMPU_TAB_REF FORMULA_0218_VTAB /end COMPU_METHOD
/begin COMPU_VTAB FORMULA_0218_VTAB "FORMULA_0218_VTAB" TAB_VERB 2 0 "nein" 1 "ja" /end COMPU_VTAB
/begin COMPU_METHOD FORMULA_0219 "FORMULA_0219" TAB_VERB "%5.2" "-" COMPU_TAB_REF FORMULA_0219_VTAB /end COMPU_METHOD
/begin COMPU_VTAB FORMULA_0219_VTAB "FORMULA_0219_VTAB" TAB_VERB 2 0 "nein" 1 "ja" /end COMPU_VTAB
/begin COMPU_METHOD FORMULA_0220 "FORMULA_0220" TAB_VERB "%5.2" "-" COMPU_TAB_REF FORMULA_0220_VTAB /end COMPU_METHOD
/begin COMPU_VTAB FORMULA_0220_VTAB "FORMULA_0220_VTAB" TAB_VERB 2 0 "nein" 1 "ja" /end COMPU_VTAB
/begin COMPU_METHOD FORMULA_0221 "FORMULA_0221" TAB_VERB "%5.2" "-" COMPU_TAB_REF FORMULA_0221_VTAB /end COMPU_METHOD
/begin COMPU_VTAB FORMULA_0221_VTAB "FORMULA_0221_VTAB" TAB_VERB 2 0 "nein" 1 "ja" /end COMPU_VTAB
/begin COMPU_METHOD FORMULA_0222 "FORMULA_0222" TAB_VERB "%5.2" "-" COMPU_TAB_REF FORMULA_0222_VTAB /end COMPU_METHOD
/begin COMPU_VTAB FORMULA_0222_VTAB "FORMULA_0222_VTAB" TAB_VERB 2 0 "nein" 1 "ja" /end COMPU_VTAB
/begin COMPU_METHOD FORMULA_0223 "FORMULA_0223" TAB_VERB "%5.2" "-" COMPU_TAB_REF FORMULA_0223_VTAB /end COMPU_METHOD
/begin COMPU_VTAB FORMULA_0223_VTAB "FORMULA_0223_VTAB" TAB_VERB 2 0 "nein" 1 "ja" /end COMPU_VTAB
/begin COMPU_METHOD FORMULA_0224 "FORMULA_0224" TAB_VERB "%3.0" "-" COMPU_TAB_REF FORMULA_0224_VTAB /end COMPU_METHOD
/begin COMPU_VTAB FORMULA_0224_VTAB "FORMULA_0224_VTAB" TAB_VERB 3 0 "Fahrzeugbetrieb" 1 "Pruefstandbetrieb" 2 "Rollenbetrieb" DEFAULT_VALUE "undef" /end COMPU_VTAB
/begin COMPU_METHOD FORMULA_0225 "FORMULA_0225" TAB_VERB "%3.0" "-" COMPU_TAB_REF FORMULA_0225_VTAB /end COMPU_METHOD
/begin COMPU_VTAB FORMULA_0225_VTAB "FORMULA_0225_VTAB" TAB_VERB 3 0 "Treiber aus [SSP an]" 1 "Treiber an [SSP aus]" 2 "Sperre SH_TO_UB" /end COMPU_VTAB
/begin COMPU_METHOD FORMULA_0226 "FORMULA_0226" TAB_VERB "%3.0" "-" COMPU_TAB_REF FORMULA_0226_VTAB /end COMPU_METHOD
/begin COMPU_VTAB FORMULA_0226_VTAB "FORMULA_0226_VTAB" TAB_VERB 7 0 "-------------------" 1 "SSP-Diag-Freigabe" 2 "SSP-Diag abgelaufen" 4 "SSP-Diag i. O." 8 "SSP-Diag n. i. O." 16 "SSP-Diag Stop exd" 32 "SSP-Diag Start exd" DEFAULT_VALUE "undefiniert" /end COMPU_VTAB
/begin COMPU_METHOD FORMULA_0227 "FORMULA_0227" TAB_VERB "%3.0" "-" COMPU_TAB_REF FORMULA_0227_VTAB /end COMPU_METHOD
/begin COMPU_VTAB FORMULA_0227_VTAB "FORMULA_0227_VTAB" TAB_VERB 2 0 "niO" 1 "ok" /end COMPU_VTAB
/begin COMPU_METHOD FORMULA_0228 "FORMULA_0228" TAB_VERB "%5.2" "-" COMPU_TAB_REF FORMULA_0228_VTAB /end COMPU_METHOD
/begin COMPU_VTAB FORMULA_0228_VTAB "FORMULA_0228_VTAB" TAB_VERB 16 0 "O.K." 1 "SH_TO_UB" 2 "SH_TO_GND" 3 "UB+GND" 4 "OPENLOAD" 5 "UB+OL" 6 "GND+OL" 7 "UB+GND+OL" 8 "UNPLAUSI" 9 "UB+UP" 10 "GND+UP" 11 "UB+GND+UP" 12 "OL+UP" 13 "UB+OL+UP" 14 "GND+OL+UP" 15 "UB+GND+OL+UP" /end COMPU_VTAB
/begin COMPU_METHOD FORMULA_0229 "FORMULA_0229" TAB_VERB "%3.0" "-" COMPU_TAB_REF FORMULA_0229_VTAB /end COMPU_METHOD
/begin COMPU_VTAB FORMULA_0229_VTAB "FORMULA_0229_VTAB" TAB_VERB 1 0 "alles i.O" DEFAULT_VALUE "Fehler oder Ansteuerung" /end COMPU_VTAB
/begin COMPU_METHOD FORMULA_0230 "FORMULA_0230" TAB_VERB "%5.2" "-" COMPU_TAB_REF FORMULA_0230_VTAB /end COMPU_METHOD
/begin COMPU_VTAB FORMULA_0230_VTAB "FORMULA_0230_VTAB" TAB_VERB 2 0 "nein" 1 "ja" /end COMPU_VTAB
/begin COMPU_METHOD FORMULA_0231 "FORMULA_0231" TAB_VERB "%3.0" "-" COMPU_TAB_REF FORMULA_0231_VTAB /end COMPU_METHOD
/begin COMPU_VTAB FORMULA_0231_VTAB "FORMULA_0231_VTAB" TAB_VERB 6 17 "FP im RAM" 51 "FP warten" 119 "FP fertig" 136 "Rueckflashen" 170 "RF warten" 238 "RF fertig" /end COMPU_VTAB
/begin COMPU_METHOD FORMULA_0232 "FORMULA_0232" RAT_FUNC "%3.0" "s" COEFFS 0 1 0 0 0 1 /end COMPU_METHOD
/begin COMPU_METHOD FORMULA_0233 "FORMULA_0233" TAB_VERB "%3.0" "-" COMPU_TAB_REF FORMULA_0233_VTAB /end COMPU_METHOD
/begin COMPU_VTAB FORMULA_0233_VTAB "FORMULA_0233_VTAB" TAB_VERB 4 0 "k. Aenderung" 1 "Aus" 2 "Ein" 4 "Sport" DEFAULT_VALUE "undef" /end COMPU_VTAB
/begin COMPU_METHOD FORMULA_0234 "FORMULA_0234" TAB_VERB "%3.0" "-" COMPU_TAB_REF FORMULA_0234_VTAB /end COMPU_METHOD
/begin COMPU_VTAB FORMULA_0234_VTAB "FORMULA_0234_VTAB" TAB_VERB 3 0 "k. Aenderung" 1 "Automat" 2 "Sequentiell" DEFAULT_VALUE "undef" /end COMPU_VTAB
/begin COMPU_METHOD FORMULA_0235 "FORMULA_0235" TAB_VERB "%3.0" "-" COMPU_TAB_REF FORMULA_0235_VTAB /end COMPU_METHOD
/begin COMPU_VTAB FORMULA_0235_VTAB "FORMULA_0235_VTAB" TAB_VERB 1 0 "k. Aenderung" /end COMPU_VTAB
/begin COMPU_METHOD FORMULA_0236 "FORMULA_0236" TAB_VERB "%3.0" "-" COMPU_TAB_REF FORMULA_0236_VTAB /end COMPU_METHOD
/begin COMPU_VTAB FORMULA_0236_VTAB "FORMULA_0236_VTAB" TAB_VERB 4 0 "k. Aenderung" 1 "Komfort" 2 "Normal" 3 "Sport" DEFAULT_VALUE "undef" /end COMPU_VTAB
/begin COMPU_METHOD FORMULA_0237 "FORMULA_0237" TAB_VERB "%3.0" "-" COMPU_TAB_REF FORMULA_0237_VTAB /end COMPU_METHOD
/begin COMPU_VTAB FORMULA_0237_VTAB "FORMULA_0237_VTAB" TAB_VERB 4 0 "k. Aenderung" 1 "KL1" 2 "KL2" 3 "KL3" DEFAULT_VALUE "undef" /end COMPU_VTAB
/begin COMPU_METHOD FORMULA_0238 "FORMULA_0238" TAB_VERB "%3.0" "-" COMPU_TAB_REF FORMULA_0238_VTAB /end COMPU_METHOD
/begin COMPU_VTAB FORMULA_0238_VTAB "FORMULA_0238_VTAB" TAB_VERB 2 0 "k. Aenderung" 1 "M-Cfg" DEFAULT_VALUE "undef" /end COMPU_VTAB
/begin COMPU_METHOD FORMULA_0239 "FORMULA_0239" TAB_VERB "%3.0" "-" COMPU_TAB_REF FORMULA_0239_VTAB /end COMPU_METHOD
/begin COMPU_VTAB FORMULA_0239_VTAB "FORMULA_0239_VTAB" TAB_VERB 2 0 "nicht angehoben" 1 "angehoben" DEFAULT_VALUE "undef" /end COMPU_VTAB
/begin COMPU_METHOD FORMULA_0240 "FORMULA_0240" TAB_VERB "%3.0" "-" COMPU_TAB_REF FORMULA_0240_VTAB /end COMPU_METHOD
/begin COMPU_VTAB FORMULA_0240_VTAB "FORMULA_0240_VTAB" TAB_VERB 3 0 "kein R" 1 "R" 2 "Fehler" /end COMPU_VTAB
/begin COMPU_METHOD FORMULA_0241 "FORMULA_0241" TAB_VERB "%5.2" "-" COMPU_TAB_REF FORMULA_0241_VTAB /end COMPU_METHOD
/begin COMPU_VTAB FORMULA_0241_VTAB "FORMULA_0241_VTAB" TAB_VERB 2 0 "aus" 1 "ein" /end COMPU_VTAB
/begin COMPU_METHOD FORMULA_0242 "FORMULA_0242" TAB_VERB "%5.2" "-" COMPU_TAB_REF FORMULA_0242_VTAB /end COMPU_METHOD
/begin COMPU_VTAB FORMULA_0242_VTAB "FORMULA_0242_VTAB" TAB_VERB 4 0 "Ok" 1 "SH_TO_GND" 2 "SH_TO_UB" 255 "Init" DEFAULT_VALUE "unused" /end COMPU_VTAB
/begin COMPU_METHOD FORMULA_0243 "FORMULA_0243" RAT_FUNC "%10.3" "�KW" COEFFS 0 81920 0 0 0 1 /end COMPU_METHOD
/begin COMPU_METHOD FORMULA_0244 "FORMULA_0244" RAT_FUNC "%8.1" "�KW" COEFFS 0 10 0 0 0 1 /end COMPU_METHOD
/begin COMPU_METHOD FORMULA_0246 "FORMULA_0246" TAB_VERB "%5.0" "-" COMPU_TAB_REF FORMULA_0246_VTAB /end COMPU_METHOD
/begin COMPU_VTAB FORMULA_0246_VTAB "FORMULA_0246_VTAB" TAB_VERB 13 0 "Aus" 391 "Aktiv" 389 "Einspr. aus" 385 "Zuendung aus" 263 "Doppelzuendung" 261 "Doppelzuendung" 257 "Doppelzuendung" 135 "Fehlerspeicher" 133 "Fehlerspeicher" 129 "Fehlerspeicher" 7 "Fehlerspeicher" 5 "Fehlerspeicher" 1 "Fehlerspeicher" DEFAULT_VALUE "Idle" /end COMPU_VTAB
/begin COMPU_METHOD FORMULA_0247 "FORMULA_0247" TAB_VERB "%5.0" "-" COMPU_TAB_REF FORMULA_0247_VTAB /end COMPU_METHOD
/begin COMPU_VTAB FORMULA_0247_VTAB "FORMULA_0247_VTAB" TAB_VERB 15 0 "Aus" 62975 "Aktiv" 46591 "Lambda" 58877 "Einspr. aus" 62973 "Einspr. aus" 58870 "Zuendung aus" 62966 "Zuendung aus" 58871 "N Schwelle" 58863 "RF Schwelle" 58847 "Pos. Dynamik" 58831 "Neg. Dynamik" 58783 "Dynamik" 62847 "Doppelzuendung" 54783 "TZ Gradient" 30207 "FeTraWe" DEFAULT_VALUE "Idle" /end COMPU_VTAB
/begin COMPU_METHOD FORMULA_0248 "FORMULA_0248" TAB_VERB "%5.0" "-" COMPU_TAB_REF FORMULA_0248_VTAB /end COMPU_METHOD
/begin COMPU_VTAB FORMULA_0248_VTAB "FORMULA_0248_VTAB" TAB_VERB 15 0 "Aus" 48127 "Aktiv" 44029 "Einspr. aus" 48125 "Einspr. aus" 44022 "Zuendung aus" 48118 "Zuendung aus" 44023 "N Schwelle" 44015 "RF Schwelle" 43999 "Pos. Dynamik" 43983 "Neg. Dynamik" 43935 "Dynamik" 47999 "Doppelzuendung" 39935 "TZ Gradient" 46079 "Nach Start" 15359 "FeTraWe" DEFAULT_VALUE "Idle" /end COMPU_VTAB
/begin COMPU_METHOD FORMULA_0250 "FORMULA_0250" TAB_VERB "%5.0" "-" COMPU_TAB_REF FORMULA_0250_VTAB /end COMPU_METHOD
/begin COMPU_VTAB FORMULA_0250_VTAB "FORMULA_0250_VTAB" TAB_VERB 1 0 "Kein Aussetzer" DEFAULT_VALUE "Aussetzer erkannt" /end COMPU_VTAB
/begin COMPU_METHOD FORMULA_0251 "FORMULA_0251" TAB_VERB "%5.0" "-" COMPU_TAB_REF FORMULA_0251_VTAB /end COMPU_METHOD
/begin COMPU_VTAB FORMULA_0251_VTAB "FORMULA_0251_VTAB" TAB_VERB 1 0 "Zyl. 1 ok." DEFAULT_VALUE "Auss. Zyl. 1." /end COMPU_VTAB
/begin COMPU_METHOD FORMULA_0252 "FORMULA_0252" TAB_VERB "%5.0" "-" COMPU_TAB_REF FORMULA_0252_VTAB /end COMPU_METHOD
/begin COMPU_VTAB FORMULA_0252_VTAB "FORMULA_0252_VTAB" TAB_VERB 1 0 "Zyl. 2 ok." DEFAULT_VALUE "Auss. Zyl. 2." /end COMPU_VTAB
/begin COMPU_METHOD FORMULA_0253 "FORMULA_0253" TAB_VERB "%5.0" "-" COMPU_TAB_REF FORMULA_0253_VTAB /end COMPU_METHOD
/begin COMPU_VTAB FORMULA_0253_VTAB "FORMULA_0253_VTAB" TAB_VERB 1 0 "Zyl. 3 ok." DEFAULT_VALUE "Auss. Zyl. 3." /end COMPU_VTAB
/begin COMPU_METHOD FORMULA_0254 "FORMULA_0254" TAB_VERB "%5.0" "-" COMPU_TAB_REF FORMULA_0254_VTAB /end COMPU_METHOD
/begin COMPU_VTAB FORMULA_0254_VTAB "FORMULA_0254_VTAB" TAB_VERB 1 0 "Zyl. 4 ok." DEFAULT_VALUE "Auss. Zyl. 4." /end COMPU_VTAB
/begin COMPU_METHOD FORMULA_0255 "FORMULA_0255" TAB_VERB "%5.0" "-" COMPU_TAB_REF FORMULA_0255_VTAB /end COMPU_METHOD
/begin COMPU_VTAB FORMULA_0255_VTAB "FORMULA_0255_VTAB" TAB_VERB 1 0 "Zyl. 5 ok." DEFAULT_VALUE "Auss. Zyl. 5." /end COMPU_VTAB
/begin COMPU_METHOD FORMULA_0256 "FORMULA_0256" TAB_VERB "%5.0" "-" COMPU_TAB_REF FORMULA_0256_VTAB /end COMPU_METHOD
/begin COMPU_VTAB FORMULA_0256_VTAB "FORMULA_0256_VTAB" TAB_VERB 1 0 "Zyl. 6 ok." DEFAULT_VALUE "Auss. Zyl. 6." /end COMPU_VTAB
/begin COMPU_METHOD FORMULA_0257 "FORMULA_0257" TAB_VERB "%5.0" "-" COMPU_TAB_REF FORMULA_0257_VTAB /end COMPU_METHOD
/begin COMPU_VTAB FORMULA_0257_VTAB "FORMULA_0257_VTAB" TAB_VERB 1 0 "Zyl. 7 ok." DEFAULT_VALUE "Auss. Zyl. 7." /end COMPU_VTAB
/begin COMPU_METHOD FORMULA_0258 "FORMULA_0258" TAB_VERB "%5.0" "-" COMPU_TAB_REF FORMULA_0258_VTAB /end COMPU_METHOD
/begin COMPU_VTAB FORMULA_0258_VTAB "FORMULA_0258_VTAB" TAB_VERB 1 0 "Zyl. 8 ok." DEFAULT_VALUE "Auss. Zyl. 8." /end COMPU_VTAB
/begin COMPU_METHOD FORMULA_0259 "FORMULA_0259" TAB_VERB "%5.0" "-" COMPU_TAB_REF FORMULA_0259_VTAB /end COMPU_METHOD
/begin COMPU_VTAB FORMULA_0259_VTAB "FORMULA_0259_VTAB" TAB_VERB 1 0 "Zyl. 9 ok." DEFAULT_VALUE "Auss. Zyl. 9." /end COMPU_VTAB
/begin COMPU_METHOD FORMULA_0260 "FORMULA_0260" TAB_VERB "%5.0" "-" COMPU_TAB_REF FORMULA_0260_VTAB /end COMPU_METHOD
/begin COMPU_VTAB FORMULA_0260_VTAB "FORMULA_0260_VTAB" TAB_VERB 1 0 "Zyl. 10 ok." DEFAULT_VALUE "Auss. Zyl. 10." /end COMPU_VTAB
/begin COMPU_METHOD FORMULA_0261 "FORMULA_0261" TAB_VERB "%3.0" "-" COMPU_TAB_REF FORMULA_0261_VTAB /end COMPU_METHOD
/begin COMPU_VTAB FORMULA_0261_VTAB "FORMULA_0261_VTAB" TAB_VERB 8 0 "Reset" 1 "Inaktiv" 2 "LLR oKS" 3 "LLR mKS" 4 "Abst. B1" 5 "Abst. B2" 6 "Stop" 7 "Fehler" DEFAULT_VALUE "undef" /end COMPU_VTAB
/begin COMPU_METHOD FORMULA_0262 "FORMULA_0262" TAB_VERB "%5.2" "-" COMPU_TAB_REF FORMULA_0262_VTAB /end COMPU_METHOD
/begin COMPU_VTAB FORMULA_0262_VTAB "FORMULA_0262_VTAB" TAB_VERB 2 0 "Nein" 1 "Ja" /end COMPU_VTAB
/begin COMPU_METHOD FORMULA_0263 "FORMULA_0263" TAB_VERB "%5.2" "-" COMPU_TAB_REF FORMULA_0263_VTAB /end COMPU_METHOD
/begin COMPU_VTAB FORMULA_0263_VTAB "FORMULA_0263_VTAB" TAB_VERB 2 0 "Inaktiv" 1 "Aktiv" /end COMPU_VTAB
/begin COMPU_METHOD FORMULA_0264 "FORMULA_0264" TAB_VERB "%5.2" "-" COMPU_TAB_REF FORMULA_0264_VTAB /end COMPU_METHOD
/begin COMPU_VTAB FORMULA_0264_VTAB "FORMULA_0264_VTAB" TAB_VERB 2 0 "Inaktiv" 1 "Aktiv" /end COMPU_VTAB
/begin COMPU_METHOD FORMULA_0265 "FORMULA_0265" RAT_FUNC "%7.2" "V" COEFFS 0 1966080 0 0 0 200 /end COMPU_METHOD
/begin COMPU_METHOD FORMULA_0266 "FORMULA_0266" TAB_VERB "%5.2" "-" COMPU_TAB_REF FORMULA_0266_VTAB /end COMPU_METHOD
/begin COMPU_VTAB FORMULA_0266_VTAB "FORMULA_0266_VTAB" TAB_VERB 2 0 "kein Kickdown" 1 "Kickdown" /end COMPU_VTAB
/begin COMPU_METHOD FORMULA_0267 "FORMULA_0267" TAB_VERB "%3.0" "-" COMPU_TAB_REF FORMULA_0267_VTAB /end COMPU_METHOD
/begin COMPU_VTAB FORMULA_0267_VTAB "FORMULA_0267_VTAB" TAB_VERB 6 0 "O.K." 1 "Kanalfilter" 2 "Kanalfehler" 3 "PWG2_Fehler" 4 "PWG1_Fehler" 5 "Totalausfall" DEFAULT_VALUE "undefiniert" /end COMPU_VTAB
/begin COMPU_METHOD FORMULA_0269 "FORMULA_0269" TAB_VERB "%3.0" "-" COMPU_TAB_REF FORMULA_0269_VTAB /end COMPU_METHOD
/begin COMPU_VTAB FORMULA_0269_VTAB "FORMULA_0269_VTAB" TAB_VERB 6 0 "frei" 1 "CAN sperrt" 2 "DME sperrt" 3 "CAN/DME" 4 "DSC sperrt" 6 "DME/DSC" DEFAULT_VALUE "Mehrfach" /end COMPU_VTAB
/begin COMPU_METHOD FORMULA_0270 "FORMULA_0270" TAB_VERB "%5.2" "-" COMPU_TAB_REF FORMULA_0270_VTAB /end COMPU_METHOD
/begin COMPU_VTAB FORMULA_0270_VTAB "FORMULA_0270_VTAB" TAB_VERB 4 0 "Inaktiv" 1 "Bereit" 2 "Aktiv" 3 "Aktiv" /end COMPU_VTAB
/begin COMPU_METHOD FORMULA_0271 "FORMULA_0271" TAB_VERB "%5.2" "-" COMPU_TAB_REF FORMULA_0271_VTAB /end COMPU_METHOD
/begin COMPU_VTAB FORMULA_0271_VTAB "FORMULA_0271_VTAB" TAB_VERB 4 0 "Inaktiv" 1 "Trigger" 2 "Aktiv" 3 "Aktiv" /end COMPU_VTAB
/begin COMPU_METHOD FORMULA_0272 "FORMULA_0272" TAB_VERB "%5.2" "-" COMPU_TAB_REF FORMULA_0272_VTAB /end COMPU_METHOD
/begin COMPU_VTAB FORMULA_0272_VTAB "FORMULA_0272_VTAB" TAB_VERB 4 0 "Inaktiv" 1 "CUF" 2 "VMA" 3 "CUF+VMA" DEFAULT_VALUE "undef" /end COMPU_VTAB
/begin COMPU_METHOD FORMULA_0273 "FORMULA_0273" TAB_VERB "%5.2" "-" COMPU_TAB_REF FORMULA_0273_VTAB /end COMPU_METHOD
/begin COMPU_VTAB FORMULA_0273_VTAB "FORMULA_0273_VTAB" TAB_VERB 2 0 "not ready" 1 "ready" /end COMPU_VTAB
/begin COMPU_METHOD FORMULA_0274 "FORMULA_0274" TAB_VERB "%5.2" "-" COMPU_TAB_REF FORMULA_0274_VTAB /end COMPU_METHOD
/begin COMPU_VTAB FORMULA_0274_VTAB "FORMULA_0274_VTAB" TAB_VERB 3 0 "iO" 1 "Spalt" 2 "Klemmen" /end COMPU_VTAB
/begin COMPU_METHOD FORMULA_0275 "FORMULA_0275" TAB_VERB "%5.2" "-" COMPU_TAB_REF FORMULA_0275_VTAB /end COMPU_METHOD
/begin COMPU_VTAB FORMULA_0275_VTAB "FORMULA_0275_VTAB" TAB_VERB 4 0 "Inaktiv" 1 "MSR" 2 "ASC" 130 "ASC+SA" DEFAULT_VALUE "undef" /end COMPU_VTAB
/begin COMPU_METHOD FORMULA_0278 "FORMULA_0278" TAB_VERB "%3.0" "-" COMPU_TAB_REF FORMULA_0278_VTAB /end COMPU_METHOD
/begin COMPU_VTAB FORMULA_0278_VTAB "FORMULA_0278_VTAB" TAB_VERB 9 0 "kein Fehler" 1 "nGetr" 2 "nZiel" 4 "nAnfahr" 8 "mKupp" 16 "axMess" 32 "KuppSt" 64 "GetrSt" 128 "Modul" /end COMPU_VTAB
/begin COMPU_METHOD FORMULA_0280 "FORMULA_0280" TAB_VERB "%5.2" "-" COMPU_TAB_REF FORMULA_0280_VTAB /end COMPU_METHOD
/begin COMPU_VTAB FORMULA_0280_VTAB "FORMULA_0280_VTAB" TAB_VERB 2 0 "KL87 aus" 1 "KL87 ein" /end COMPU_VTAB
/begin COMPU_METHOD FORMULA_0281 "FORMULA_0281" TAB_VERB "%5.2" "-" COMPU_TAB_REF FORMULA_0281_VTAB /end COMPU_METHOD
/begin COMPU_VTAB FORMULA_0281_VTAB "FORMULA_0281_VTAB" TAB_VERB 2 0 "MM aus" 1 "MM ein" /end COMPU_VTAB
/begin COMPU_METHOD FORMULA_0282 "FORMULA_0282" TAB_VERB "%3.0" "-" COMPU_TAB_REF FORMULA_0282_VTAB /end COMPU_METHOD
/begin COMPU_VTAB FORMULA_0282_VTAB "FORMULA_0282_VTAB" TAB_VERB 4 0 "kein Fehler" 1 "SAT-Err" 2 "Differenz" 4 "Bereich" DEFAULT_VALUE "Mehrfach" /end COMPU_VTAB
/begin COMPU_METHOD FORMULA_0283 "FORMULA_0283" TAB_VERB "%5.2" "-" COMPU_TAB_REF FORMULA_0283_VTAB /end COMPU_METHOD
/begin COMPU_VTAB FORMULA_0283_VTAB "FORMULA_0283_VTAB" TAB_VERB 6 0 "Inaktiv" 1 "Aktiv" 3 "Aktiv+SA" 4 "TZ frei" 5 "Aktiv+TZ" 7 "Aktiv+TZ+SA" DEFAULT_VALUE "undef" /end COMPU_VTAB
/begin COMPU_METHOD FORMULA_0284 "FORMULA_0284" TAB_VERB "%5.2" "-" COMPU_TAB_REF FORMULA_0284_VTAB /end COMPU_METHOD
/begin COMPU_VTAB FORMULA_0284_VTAB "FORMULA_0284_VTAB" TAB_VERB 2 0 "Inaktiv" 1 "Aktiv" /end COMPU_VTAB
/begin COMPU_METHOD FORMULA_0285 "FORMULA_0285" TAB_VERB "%5.2" "-" COMPU_TAB_REF FORMULA_0285_VTAB /end COMPU_METHOD
/begin COMPU_VTAB FORMULA_0285_VTAB "FORMULA_0285_VTAB" TAB_VERB 2 0 "LL-Eingr" 1 "TL-Eingr" /end COMPU_VTAB
/begin COMPU_METHOD FORMULA_0286 "FORMULA_0286" TAB_VERB "%5.2" "-" COMPU_TAB_REF FORMULA_0286_VTAB /end COMPU_METHOD
/begin COMPU_VTAB FORMULA_0286_VTAB "FORMULA_0286_VTAB" TAB_VERB 2 0 "Inaktiv" 1 "Aktiv" /end COMPU_VTAB
/begin COMPU_METHOD FORMULA_0287 "FORMULA_0287" TAB_VERB "%3.0" "-" COMPU_TAB_REF FORMULA_0287_VTAB /end COMPU_METHOD
/begin COMPU_VTAB FORMULA_0287_VTAB "FORMULA_0287_VTAB" TAB_VERB 13 0 "undef" 1 "Anfahren" 2 "Anfahren-KD" 3 "Wait-RS" 4 "Anfahren-RS" 5 "Schalten" 6 "Einkuppeln" 7 "Anhalten" 8 "Abwuergen" 9 "Radabriss" 11 "ABS-Eingr" 12 "Trampeln" 15 "Fehler" /end COMPU_VTAB
/begin COMPU_METHOD FORMULA_0288 "FORMULA_0288" TAB_VERB "%5.2" "-" COMPU_TAB_REF FORMULA_0288_VTAB /end COMPU_METHOD
/begin COMPU_VTAB FORMULA_0288_VTAB "FORMULA_0288_VTAB" TAB_VERB 22 0 "Fahrer" 1 "Getr" 2 "ASC" 3 "MSR" 4 "Schub" 5 "MCS" 16 "Fahrer+LLR" 17 "Getr+LLR" 18 "ASC+LLR" 19 "MSR+LLR" 32 "Fahrer+AR" 33 "Getr+AR" 34 "ASC+AR" 35 "MSR+AR" 64 "Fahrer+Begr" 65 "Getr+Begr" 66 "ASC+Begr" 67 "MSR+Begr" 128 "Fahrer+SK" 129 "Getr+SK" 130 "ASC+SK" 131 "MSR+SK" DEFAULT_VALUE "Mehrfach" /end COMPU_VTAB
/begin COMPU_METHOD FORMULA_0289 "FORMULA_0289" TAB_VERB "%3.0" "-" COMPU_TAB_REF FORMULA_0289_VTAB /end COMPU_METHOD
/begin COMPU_VTAB FORMULA_0289_VTAB "FORMULA_0289_VTAB" TAB_VERB 2 0 "Sperre Aus" 1 "Sperre Ein" /end COMPU_VTAB
/begin COMPU_METHOD FORMULA_0291 "FORMULA_0291" TAB_VERB "%7.2" "-" COMPU_TAB_REF FORMULA_0291_VTAB /end COMPU_METHOD
/begin COMPU_VTAB FORMULA_0291_VTAB "FORMULA_0291_VTAB" TAB_VERB 2 0 "BLTS aus" 1 "BLTS ein" /end COMPU_VTAB
/begin COMPU_METHOD FORMULA_0292 "FORMULA_0292" TAB_VERB "%7.2" "-" COMPU_TAB_REF FORMULA_0292_VTAB /end COMPU_METHOD
/begin COMPU_VTAB FORMULA_0292_VTAB "FORMULA_0292_VTAB" TAB_VERB 2 0 "Sleep" 1 "Wakeup" /end COMPU_VTAB
/begin COMPU_METHOD FORMULA_0293 "FORMULA_0293" TAB_VERB "%7.2" "-" COMPU_TAB_REF FORMULA_0293_VTAB /end COMPU_METHOD
/begin COMPU_VTAB FORMULA_0293_VTAB "FORMULA_0293_VTAB" TAB_VERB 2 0 "Kl87 aus" 1 "Kl87 ein" /end COMPU_VTAB
/begin COMPU_METHOD FORMULA_0294 "FORMULA_0294" TAB_VERB "%7.2" "-" COMPU_TAB_REF FORMULA_0294_VTAB /end COMPU_METHOD
/begin COMPU_VTAB FORMULA_0294_VTAB "FORMULA_0294_VTAB" TAB_VERB 2 0 "offen" 1 "Kraftschluss" /end COMPU_VTAB
/begin COMPU_METHOD FORMULA_0295 "FORMULA_0295" RAT_FUNC "%9.4" "-" COEFFS 0 16384 0 0 0 1 /end COMPU_METHOD
/begin COMPU_METHOD FORMULA_0296 "FORMULA_0296" TAB_VERB "%7.2" "-" COMPU_TAB_REF FORMULA_0296_VTAB /end COMPU_METHOD
/begin COMPU_VTAB FORMULA_0296_VTAB "FORMULA_0296_VTAB" TAB_VERB 1 2365 "aktiv" DEFAULT_VALUE "nicht aktiv" /end COMPU_VTAB
/begin COMPU_METHOD FORMULA_0297 "FORMULA_0297" TAB_VERB "%7.2" "-" COMPU_TAB_REF FORMULA_0297_VTAB /end COMPU_METHOD
/begin COMPU_VTAB FORMULA_0297_VTAB "FORMULA_0297_VTAB" TAB_VERB 2 0 "sperrt" 1 "aktiv" /end COMPU_VTAB
/begin COMPU_METHOD FORMULA_0298 "FORMULA_0298" TAB_VERB "%7.2" "-" COMPU_TAB_REF FORMULA_0298_VTAB /end COMPU_METHOD
/begin COMPU_VTAB FORMULA_0298_VTAB "FORMULA_0298_VTAB" TAB_VERB 2 0 "inaktiv" 1 "aktiv" /end COMPU_VTAB
/begin COMPU_METHOD FORMULA_0299 "FORMULA_0299" TAB_VERB "%7.2" "-" COMPU_TAB_REF FORMULA_0299_VTAB /end COMPU_METHOD
/begin COMPU_VTAB FORMULA_0299_VTAB "FORMULA_0299_VTAB" TAB_VERB 2 0 "sperrt" 1 "aktiv" /end COMPU_VTAB
/begin COMPU_METHOD FORMULA_0300 "FORMULA_0300" TAB_VERB "%7.2" "-" COMPU_TAB_REF FORMULA_0300_VTAB /end COMPU_METHOD
/begin COMPU_VTAB FORMULA_0300_VTAB "FORMULA_0300_VTAB" TAB_VERB 2 0 "sperrt" 1 "aktiv" /end COMPU_VTAB
/begin COMPU_METHOD FORMULA_0301 "FORMULA_0301" TAB_VERB "%7.2" "-" COMPU_TAB_REF FORMULA_0301_VTAB /end COMPU_METHOD
/begin COMPU_VTAB FORMULA_0301_VTAB "FORMULA_0301_VTAB" TAB_VERB 2 0 "sperrt" 1 "aktiv" /end COMPU_VTAB
/begin COMPU_METHOD FORMULA_0302 "FORMULA_0302" TAB_VERB "%7.2" "-" COMPU_TAB_REF FORMULA_0302_VTAB /end COMPU_METHOD
/begin COMPU_VTAB FORMULA_0302_VTAB "FORMULA_0302_VTAB" TAB_VERB 2 0 "sperrt" 1 "aktiv" /end COMPU_VTAB
/begin COMPU_METHOD FORMULA_0303 "FORMULA_0303" TAB_VERB "%7.2" "-" COMPU_TAB_REF FORMULA_0303_VTAB /end COMPU_METHOD
/begin COMPU_VTAB FORMULA_0303_VTAB "FORMULA_0303_VTAB" TAB_VERB 2 0 "aus" 1 "aktiv" /end COMPU_VTAB
/begin COMPU_METHOD FORMULA_0304 "FORMULA_0304" TAB_VERB "%7.2" "-" COMPU_TAB_REF FORMULA_0304_VTAB /end COMPU_METHOD
/begin COMPU_VTAB FORMULA_0304_VTAB "FORMULA_0304_VTAB" TAB_VERB 2 0 "aus" 1 "aktiv" /end COMPU_VTAB
/begin COMPU_METHOD FORMULA_0305 "FORMULA_0305" TAB_VERB "%7.2" "-" COMPU_TAB_REF FORMULA_0305_VTAB /end COMPU_METHOD
/begin COMPU_VTAB FORMULA_0305_VTAB "FORMULA_0305_VTAB" TAB_VERB 2 0 "sperrt" 1 "aktiv" /end COMPU_VTAB
/begin COMPU_METHOD FORMULA_0306 "FORMULA_0306" TAB_VERB "%7.2" "-" COMPU_TAB_REF FORMULA_0306_VTAB /end COMPU_METHOD
/begin COMPU_VTAB FORMULA_0306_VTAB "FORMULA_0306_VTAB" TAB_VERB 2 0 "aus" 1 "aktiv" /end COMPU_VTAB
/begin COMPU_METHOD FORMULA_0307 "FORMULA_0307" TAB_VERB "%7.2" "-" COMPU_TAB_REF FORMULA_0307_VTAB /end COMPU_METHOD
/begin COMPU_VTAB FORMULA_0307_VTAB "FORMULA_0307_VTAB" TAB_VERB 2 0 "aus" 1 "aktiv" /end COMPU_VTAB
/begin COMPU_METHOD FORMULA_0308 "FORMULA_0308" TAB_VERB "%7.2" "-" COMPU_TAB_REF FORMULA_0308_VTAB /end COMPU_METHOD
/begin COMPU_VTAB FORMULA_0308_VTAB "FORMULA_0308_VTAB" TAB_VERB 2 0 "aus" 1 "aktiv" /end COMPU_VTAB
/begin COMPU_METHOD FORMULA_0309 "FORMULA_0309" TAB_VERB "%5.2" "-" COMPU_TAB_REF FORMULA_0309_VTAB /end COMPU_METHOD
/begin COMPU_VTAB FORMULA_0309_VTAB "FORMULA_0309_VTAB" TAB_VERB 6 0 "Inaktiv" 1 "Abregeln" 2 "Schalten" 3 "Aufregeln" 4 "Ende" 15 "Error" /end COMPU_VTAB
/begin COMPU_METHOD FORMULA_0310 "FORMULA_0310" TAB_VERB "%7.2" "-" COMPU_TAB_REF FORMULA_0310_VTAB /end COMPU_METHOD
/begin COMPU_VTAB FORMULA_0310_VTAB "FORMULA_0310_VTAB" TAB_VERB 2 0 "Schubbetrieb" 1 "Zugbetrieb" /end COMPU_VTAB
/begin COMPU_METHOD FORMULA_0311 "FORMULA_0311" TAB_VERB "%7.2" "-" COMPU_TAB_REF FORMULA_0311_VTAB /end COMPU_METHOD
/begin COMPU_VTAB FORMULA_0311_VTAB "FORMULA_0311_VTAB" TAB_VERB 3 0 "keine Schaltung" 1 "Hochschaltung" 2 "Rueckschaltung" DEFAULT_VALUE "undef" /end COMPU_VTAB
/begin COMPU_METHOD FORMULA_0312 "FORMULA_0312" TAB_VERB "%7.2" "-" COMPU_TAB_REF FORMULA_0312_VTAB /end COMPU_METHOD
/begin COMPU_VTAB FORMULA_0312_VTAB "FORMULA_0312_VTAB" TAB_VERB 2 0 "Manuell" 1 "Automat" /end COMPU_VTAB
/begin COMPU_METHOD FORMULA_0313 "FORMULA_0313" TAB_VERB "%7.2" "-" COMPU_TAB_REF FORMULA_0313_VTAB /end COMPU_METHOD
/begin COMPU_VTAB FORMULA_0313_VTAB "FORMULA_0313_VTAB" TAB_VERB 2 0 "mit Eingriff" 1 "ohne Eingriff" /end COMPU_VTAB
/begin COMPU_METHOD FORMULA_0314 "FORMULA_0314" TAB_VERB "%7.2" "-" COMPU_TAB_REF FORMULA_0314_VTAB /end COMPU_METHOD
/begin COMPU_VTAB FORMULA_0314_VTAB "FORMULA_0314_VTAB" TAB_VERB 2 0 "nein" 1 "ja" /end COMPU_VTAB
/begin COMPU_METHOD FORMULA_0315 "FORMULA_0315" TAB_VERB "%7.2" "-" COMPU_TAB_REF FORMULA_0315_VTAB /end COMPU_METHOD
/begin COMPU_VTAB FORMULA_0315_VTAB "FORMULA_0315_VTAB" TAB_VERB 2 0 "nein" 1 "ja" /end COMPU_VTAB
/begin COMPU_METHOD FORMULA_0316 "FORMULA_0316" TAB_VERB "%7.2" "-" COMPU_TAB_REF FORMULA_0316_VTAB /end COMPU_METHOD
/begin COMPU_VTAB FORMULA_0316_VTAB "FORMULA_0316_VTAB" TAB_VERB 2 0 "nein" 1 "ja" /end COMPU_VTAB
/begin COMPU_METHOD FORMULA_0317 "FORMULA_0317" RAT_FUNC "%5.2" "s" COEFFS 0 100 0 0 0 1 /end COMPU_METHOD
/begin COMPU_METHOD FORMULA_0318 "FORMULA_0318" RAT_FUNC "%3.0" ".Gang" COEFFS 0 1 0 0 0 1 /end COMPU_METHOD
/begin COMPU_METHOD FORMULA_0319 "FORMULA_0319" TAB_VERB "%7.2" "-" COMPU_TAB_REF FORMULA_0319_VTAB /end COMPU_METHOD
/begin COMPU_VTAB FORMULA_0319_VTAB "FORMULA_0319_VTAB" TAB_VERB 2 0 "bekannt" 1 "unbekannt" /end COMPU_VTAB
/begin COMPU_METHOD FORMULA_0320 "FORMULA_0320" TAB_VERB "%7.2" "-" COMPU_TAB_REF FORMULA_0320_VTAB /end COMPU_METHOD
/begin COMPU_VTAB FORMULA_0320_VTAB "FORMULA_0320_VTAB" TAB_VERB 2 0 "nicht ungerade" 1 "ungerade" /end COMPU_VTAB
/begin COMPU_METHOD FORMULA_0321 "FORMULA_0321" TAB_VERB "%7.2" "-" COMPU_TAB_REF FORMULA_0321_VTAB /end COMPU_METHOD
/begin COMPU_VTAB FORMULA_0321_VTAB "FORMULA_0321_VTAB" TAB_VERB 2 0 "nicht gerade" 1 "gerade" /end COMPU_VTAB
/begin COMPU_METHOD FORMULA_0322 "FORMULA_0322" TAB_VERB "%7.2" "-" COMPU_TAB_REF FORMULA_0322_VTAB /end COMPU_METHOD
/begin COMPU_VTAB FORMULA_0322_VTAB "FORMULA_0322_VTAB" TAB_VERB 2 0 "keine Aktion" 1 "Aktion" /end COMPU_VTAB
/begin COMPU_METHOD FORMULA_0323 "FORMULA_0323" TAB_VERB "%7.2" "-" COMPU_TAB_REF FORMULA_0323_VTAB /end COMPU_METHOD
/begin COMPU_VTAB FORMULA_0323_VTAB "FORMULA_0323_VTAB" TAB_VERB 2 0 "nicht plausibel" 1 "plausibel" /end COMPU_VTAB
/begin COMPU_METHOD FORMULA_0324 "FORMULA_0324" TAB_VERB "%7.2" "-" COMPU_TAB_REF FORMULA_0324_VTAB /end COMPU_METHOD
/begin COMPU_VTAB FORMULA_0324_VTAB "FORMULA_0324_VTAB" TAB_VERB 2 0 "nicht berechnen" 1 "neu berechnen" /end COMPU_VTAB
/begin COMPU_METHOD FORMULA_0325 "FORMULA_0325" TAB_VERB "%7.2" "-" COMPU_TAB_REF FORMULA_0325_VTAB /end COMPU_METHOD
/begin COMPU_VTAB FORMULA_0325_VTAB "FORMULA_0325_VTAB" TAB_VERB 2 0 "Gang halten" 1 "Gang uebernehmen" /end COMPU_VTAB
/begin COMPU_METHOD FORMULA_0326 "FORMULA_0326" TAB_VERB "%3.0" "-" COMPU_TAB_REF FORMULA_0326_VTAB /end COMPU_METHOD
/begin COMPU_VTAB FORMULA_0326_VTAB "FORMULA_0326_VTAB" TAB_VERB 3 0 "aus" 1 "inaktiv" 2 "aktiv" /end COMPU_VTAB
/begin COMPU_METHOD FORMULA_0327 "FORMULA_0327" TAB_VERB "%3.0" "-" COMPU_TAB_REF FORMULA_0327_VTAB /end COMPU_METHOD
/begin COMPU_VTAB FORMULA_0327_VTAB "FORMULA_0327_VTAB" TAB_VERB 2 0 "aus" 1 "ein" /end COMPU_VTAB
/begin COMPU_METHOD FORMULA_0328 "FORMULA_0328" TAB_VERB "%3.0" "-" COMPU_TAB_REF FORMULA_0328_VTAB /end COMPU_METHOD
/begin COMPU_VTAB FORMULA_0328_VTAB "FORMULA_0328_VTAB" TAB_VERB 4 0 "Inaktiv" 1 "HUD ein" 2 "NotAcpt" 3 "Ein+NotAcpt" /end COMPU_VTAB
/begin COMPU_METHOD FORMULA_0329 "FORMULA_0329" RAT_FUNC "%6.1" "km/h" COEFFS 0 10 0 0 0 1 /end COMPU_METHOD
/begin COMPU_METHOD FORMULA_0330 "FORMULA_0330" TAB_VERB "%3.0" "-" COMPU_TAB_REF FORMULA_0330_VTAB /end COMPU_METHOD
/begin COMPU_VTAB FORMULA_0330_VTAB "FORMULA_0330_VTAB" TAB_VERB 13 0 "VERRIEGELT" 1 "AUS" 2 "EIN / AUS" 3 "PASSIV" 4 "ABSCHALT RAMPE" 5 "WIEDERAUFNAME" 6 "SET" 7 "KONSTANT FAHRT" 8 "TIPP PLUS" 9 "TIPP MINUS" 10 "BESCHLEUNIGUNG" 11 "VERZOEGERN" 12 "UEBERHOLEN" DEFAULT_VALUE "undef" /end COMPU_VTAB
/begin COMPU_METHOD FORMULA_0331 "FORMULA_0331" TAB_VERB "%4.1" "-" COMPU_TAB_REF FORMULA_0331_VTAB /end COMPU_METHOD
/begin COMPU_VTAB FORMULA_0331_VTAB "FORMULA_0331_VTAB" TAB_VERB 2 0 "SA freigegeben" 1 "SA gesperrt" /end COMPU_VTAB
/begin COMPU_METHOD FORMULA_0332 "FORMULA_0332" TAB_VERB "%3.0" "-" COMPU_TAB_REF FORMULA_0332_VTAB /end COMPU_METHOD
/begin COMPU_VTAB FORMULA_0332_VTAB "FORMULA_0332_VTAB" TAB_VERB 4 0 "keine" 1 "Bank1" 2 "Bank2" 3 "Bank1+2" /end COMPU_VTAB
/begin COMPU_METHOD FORMULA_0334 "FORMULA_0334" TAB_VERB "%5.2" "-" COMPU_TAB_REF FORMULA_0334_VTAB /end COMPU_METHOD
/begin COMPU_VTAB FORMULA_0334_VTAB "FORMULA_0334_VTAB" TAB_VERB 1 0 "Abregeln_B1" DEFAULT_VALUE "Aufregeln_B1" /end COMPU_VTAB
/begin COMPU_METHOD FORMULA_0335 "FORMULA_0335" TAB_VERB "%5.2" "-" COMPU_TAB_REF FORMULA_0335_VTAB /end COMPU_METHOD
/begin COMPU_VTAB FORMULA_0335_VTAB "FORMULA_0335_VTAB" TAB_VERB 1 0 "Abregeln_B2" DEFAULT_VALUE "Aufregeln_B2" /end COMPU_VTAB
/begin COMPU_METHOD FORMULA_0336 "FORMULA_0336" TAB_VERB "%5.2" "-" COMPU_TAB_REF FORMULA_0336_VTAB /end COMPU_METHOD
/begin COMPU_VTAB FORMULA_0336_VTAB "FORMULA_0336_VTAB" TAB_VERB 1 0 "No_Grad_B1" DEFAULT_VALUE "Gradient_B1" /end COMPU_VTAB
/begin COMPU_METHOD FORMULA_0337 "FORMULA_0337" TAB_VERB "%5.2" "-" COMPU_TAB_REF FORMULA_0337_VTAB /end COMPU_METHOD
/begin COMPU_VTAB FORMULA_0337_VTAB "FORMULA_0337_VTAB" TAB_VERB 1 0 "No_Grad_B2" DEFAULT_VALUE "Gradient_B2" /end COMPU_VTAB
/begin COMPU_METHOD FORMULA_0338 "FORMULA_0338" TAB_VERB "%5.2" "-" COMPU_TAB_REF FORMULA_0338_VTAB /end COMPU_METHOD
/begin COMPU_VTAB FORMULA_0338_VTAB "FORMULA_0338_VTAB" TAB_VERB 1 0 "No_Init_B1" DEFAULT_VALUE "Init_B1" /end COMPU_VTAB
/begin COMPU_METHOD FORMULA_0339 "FORMULA_0339" TAB_VERB "%5.2" "-" COMPU_TAB_REF FORMULA_0339_VTAB /end COMPU_METHOD
/begin COMPU_VTAB FORMULA_0339_VTAB "FORMULA_0339_VTAB" TAB_VERB 1 0 "No_Init_B2" DEFAULT_VALUE "Init_B2" /end COMPU_VTAB
/begin COMPU_METHOD FORMULA_0340 "FORMULA_0340" RAT_FUNC "%11.4" "�C" COEFFS 0 10240 2797056 0 0 1 /end COMPU_METHOD
/begin COMPU_METHOD FORMULA_0341 "FORMULA_0341" TAB_VERB "%3.0" "-" COMPU_TAB_REF FORMULA_0341_VTAB /end COMPU_METHOD
/begin COMPU_VTAB FORMULA_0341_VTAB "FORMULA_0341_VTAB" TAB_VERB 4 0 "Lampe aus" 1 "Lampe gelb" 2 "Lampe rot" 3 "Lampe rot" /end COMPU_VTAB
/begin COMPU_METHOD FORMULA_0342 "FORMULA_0342" TAB_VERB "%3.0" "-" COMPU_TAB_REF FORMULA_0342_VTAB /end COMPU_METHOD
/begin COMPU_VTAB FORMULA_0342_VTAB "FORMULA_0342_VTAB" TAB_VERB 2 0 "Inaktiv" 1 "Aktiv" /end COMPU_VTAB
/begin COMPU_METHOD FORMULA_0343 "FORMULA_0343" TAB_VERB "%4.1" "-" COMPU_TAB_REF FORMULA_0343_VTAB /end COMPU_METHOD
/begin COMPU_VTAB FORMULA_0343_VTAB "FORMULA_0343_VTAB" TAB_VERB 2 0 "gesperrt" 1 "senden" /end COMPU_VTAB
/begin COMPU_METHOD FORMULA_0344 "FORMULA_0344" TAB_VERB "%5.0" "-" COMPU_TAB_REF FORMULA_0344_VTAB /end COMPU_METHOD
/begin COMPU_VTAB FORMULA_0344_VTAB "FORMULA_0344_VTAB" TAB_VERB 1 0 "keine aus" DEFAULT_VALUE "Mind. eine abgesch." /end COMPU_VTAB
/begin COMPU_METHOD FORMULA_0345 "FORMULA_0345" TAB_VERB "%3.0" "-" COMPU_TAB_REF FORMULA_0345_VTAB /end COMPU_METHOD
/begin COMPU_VTAB FORMULA_0345_VTAB "FORMULA_0345_VTAB" TAB_VERB 3 0 "nichts" 1 "postiv" 2 "negativ" /end COMPU_VTAB
/* ------------------ Abschnitt erzeugt aus ipk.dat ------------------ */
/begin COMPU_METHOD FORMULA_0346 "FORMULA_0346" TAB_VERB "%5.2" "-" COMPU_TAB_REF FORMULA_0346_VTAB /end COMPU_METHOD
/begin COMPU_VTAB FORMULA_0346_VTAB "FORMULA_0346_VTAB" TAB_VERB 4 0 "ok" 1 "no send/busy" 2 "csum nok" 4 "Stackbereich" DEFAULT_VALUE "ungueltig" /end COMPU_VTAB
/begin COMPU_METHOD FORMULA_0347 "FORMULA_0347" RAT_FUNC "%8.1" "ms" COEFFS 0 1000 0 0 0 1 /end COMPU_METHOD
/* ------------------ Abschnitt erzeugt aus n.dat ------------------ */
/begin COMPU_METHOD FORMULA_0348 "FORMULA_0348" TAB_VERB "%3.0" "-" COMPU_TAB_REF FORMULA_0348_VTAB /end COMPU_METHOD
/begin COMPU_VTAB FORMULA_0348_VTAB "FORMULA_0348_VTAB" TAB_VERB 6 0 "Initialisierung" 1 "Zahndrehzahl" 3 "noch Zahndrehzahl" 7 "Segmentdrehzahl" 16 "Stoerung" 17 "Stoerung" DEFAULT_VALUE "Eingefroren" /end COMPU_VTAB
/begin COMPU_METHOD FORMULA_0349 "FORMULA_0349" RAT_FUNC "%7.2" "ms" COEFFS 0 625 0 0 0 1 /end COMPU_METHOD
/* ------------------ Abschnitt erzeugt aus os.dat ------------------ */
/begin COMPU_METHOD FORMULA_0350 "FORMULA_0350" TAB_VERB "%3.0" "-" COMPU_TAB_REF FORMULA_0350_VTAB /end COMPU_METHOD
/begin COMPU_VTAB FORMULA_0350_VTAB "FORMULA_0350_VTAB" TAB_VERB 11 0 "Ok" 1 "Sync1" 2 "Sync2" 3 "SyncMS" 4 "1ms-Task" 5 "5ms-Task" 6 "10ms-Task" 7 "100ms-Task" 8 "1s-Task" 9 "Bgnd-Task" 10 "undef" /end COMPU_VTAB
/begin COMPU_METHOD FORMULA_0351 "FORMULA_0351" TAB_VERB "%3.0" "-" COMPU_TAB_REF FORMULA_0351_VTAB /end COMPU_METHOD
/begin COMPU_VTAB FORMULA_0351_VTAB "FORMULA_0351_VTAB" TAB_VERB 13 0 "Ok" 1 "Access" 2 "Level" 3 "ID" 4 "Limit" 5 "NoFnc" 6 "Resource" 7 "State" 8 "Value" 9 "TT missing" 10 "TT active" 11 "Overrun" 14 "Stack" /end COMPU_VTAB
/* ------------------ Abschnitt erzeugt aus qadc.dat ------------------ */
/begin COMPU_METHOD FORMULA_0354 "FORMULA_0354" TAB_VERB "%5.2" "-" COMPU_TAB_REF FORMULA_0354_VTAB /end COMPU_METHOD
/begin COMPU_VTAB FORMULA_0354_VTAB "FORMULA_0354_VTAB" TAB_VERB 3 0 "OK" 1 "QADCA NIO" 2 "QADCB NIO" DEFAULT_VALUE "undef" /end COMPU_VTAB
/* ------------------ Abschnitt erzeugt aus ram_chk.dat ------------------ */
/begin COMPU_METHOD FORMULA_0355 "FORMULA_0355" RAT_FUNC "%7.2" "kHz" COEFFS 0 100 0 0 0 1 /end COMPU_METHOD
/* ------------------ Abschnitt erzeugt aus sc_glob.dat ------------------ */
/begin COMPU_METHOD FORMULA_0358 "FORMULA_0358" RAT_FUNC "%9.2" "ms" COEFFS 0 1000 0 0 0 1 /end COMPU_METHOD
/begin COMPU_METHOD FORMULA_0359 "FORMULA_0359" TAB_VERB "%5.2" "-" COMPU_TAB_REF FORMULA_0359_VTAB /end COMPU_METHOD
/begin COMPU_VTAB FORMULA_0359_VTAB "FORMULA_0359_VTAB" TAB_VERB 2 0 "WorkPage" 16 "RefPage" DEFAULT_VALUE "Err/RefP" /end COMPU_VTAB
/begin COMPU_METHOD FORMULA_0360 "FORMULA_0360" TAB_VERB "%5.2" "-" COMPU_TAB_REF FORMULA_0360_VTAB /end COMPU_METHOD
/begin COMPU_VTAB FORMULA_0360_VTAB "FORMULA_0360_VTAB" TAB_VERB 4 0 "idle" 1 "to WorkPage" 2 "to RefPage" 4 "ready" /end COMPU_VTAB
/begin COMPU_METHOD FORMULA_0361 "FORMULA_0361" TAB_VERB "%5.2" "-" COMPU_TAB_REF FORMULA_0361_VTAB /end COMPU_METHOD
/begin COMPU_VTAB FORMULA_0361_VTAB "FORMULA_0361_VTAB" TAB_VERB 3 0 "idle" 1 "loop" 2 "ready" /end COMPU_VTAB
/* ------------------ Abschnitt erzeugt aus sk.dat ------------------ */
/begin COMPU_METHOD FORMULA_0362 "FORMULA_0362" TAB_VERB "%3.0" "-" COMPU_TAB_REF FORMULA_0362_VTAB /end COMPU_METHOD
/begin COMPU_VTAB FORMULA_0362_VTAB "FORMULA_0362_VTAB" TAB_VERB 1 0 "Inaktiv" DEFAULT_VALUE "Aktiv" /end COMPU_VTAB
/* ------------------ Abschnitt erzeugt aus sk_e2_glob.dat ------------------ */
/begin COMPU_METHOD FORMULA_0369 "FORMULA_0369" TAB_VERB "%5.0" "-" COMPU_TAB_REF FORMULA_0369_VTAB /end COMPU_METHOD
/begin COMPU_VTAB FORMULA_0369_VTAB "FORMULA_0369_VTAB" TAB_VERB 23 0 "kein Fehler" 5 "Motortemperatur" 6 "Oeltemperatur" 10 "SMG-Schaltablauf" 11 "SMG-Eingriff" 12 "SMG-Sollmoment" 13 "SMG-nGetr" 14 "SMG-Gang" 20 "LLR-Plausi" 21 "Minimalmoment" 22 "Maximalmoment" 23 "Istmoment" 24 "Schleppmoment" 25 "Soll-Istvergleich" 26 "rel. Fahrerwunsch" 30 "Luftmasse" 40 "Drehzahl" 50 "Pedalwert" 60 "Bremslichtschalter" 80 "Komplementvergleich" 85 "Fehler Testrechnung" 86 "Timeout Testrechnung" 90 "Maxdrehzahl" /end COMPU_VTAB
/* ------------------ Abschnitt erzeugt aus spi.dat ------------------ */
/begin COMPU_METHOD FORMULA_0370 "FORMULA_0370" TAB_VERB "%3.0" "-" COMPU_TAB_REF FORMULA_0370_VTAB /end COMPU_METHOD
/begin COMPU_VTAB FORMULA_0370_VTAB "FORMULA_0370_VTAB" TAB_VERB 2 0 "frei" 128 "Belegt" DEFAULT_VALUE "undefiniert" /end COMPU_VTAB
/* ------------------ Abschnitt erzeugt aus sys_zust.dat ------------------ */
/begin COMPU_METHOD FORMULA_0383 "FORMULA_0383" TAB_VERB "%7.2" "-" COMPU_TAB_REF FORMULA_0383_VTAB /end COMPU_METHOD
/begin COMPU_VTAB FORMULA_0383_VTAB "FORMULA_0383_VTAB" TAB_VERB 3 0 "Treiberdiagnose" 1 "Dauerbestromung TPU" 2 "Dauerbestromung Treiber" DEFAULT_VALUE "undef" /end COMPU_VTAB
/begin COMPU_METHOD FORMULA_0384 "FORMULA_0384" TAB_VERB "%7.2" "-" COMPU_TAB_REF FORMULA_0384_VTAB /end COMPU_METHOD
/begin COMPU_VTAB FORMULA_0384_VTAB "FORMULA_0384_VTAB" TAB_VERB 5 1 "Boot" 2 "FpFlash/iD" 4 "FpRAM/iD" 10 "FpFlash/eD" 12 "FpRAM/eD" DEFAULT_VALUE "undefiniert" /end COMPU_VTAB
/begin COMPU_METHOD FORMULA_0385 "FORMULA_0385" TAB_VERB "%3.0" "-" COMPU_TAB_REF FORMULA_0385_VTAB /end COMPU_METHOD
/begin COMPU_VTAB FORMULA_0385_VTAB "FORMULA_0385_VTAB" TAB_VERB 3 0 "Prozessor" 1 "Selbst" 2 "Kollege" DEFAULT_VALUE "undef" /end COMPU_VTAB
/begin COMPU_METHOD FORMULA_0386 "FORMULA_0386" TAB_VERB "%7.2" "-" COMPU_TAB_REF FORMULA_0386_VTAB /end COMPU_METHOD
/begin COMPU_VTAB FORMULA_0386_VTAB "FORMULA_0386_VTAB" TAB_VERB 1 0 "no" DEFAULT_VALUE "ja" /end COMPU_VTAB
/begin COMPU_METHOD FORMULA_0387 "FORMULA_0387" TAB_VERB "%7.2" "-" COMPU_TAB_REF FORMULA_0387_VTAB /end COMPU_METHOD
/begin COMPU_VTAB FORMULA_0387_VTAB "FORMULA_0387_VTAB" TAB_VERB 1 0 "no" DEFAULT_VALUE "ja" /end COMPU_VTAB
/begin COMPU_METHOD FORMULA_0388 "FORMULA_0388" TAB_VERB "%7.2" "-" COMPU_TAB_REF FORMULA_0388_VTAB /end COMPU_METHOD
/begin COMPU_VTAB FORMULA_0388_VTAB "FORMULA_0388_VTAB" TAB_VERB 1 0 "no" DEFAULT_VALUE "ja" /end COMPU_VTAB
/begin COMPU_METHOD FORMULA_0422 "FORMULA_0422" RAT_FUNC "%7.2" "qmm" COEFFS 0 100 0 0 0 1 /end COMPU_METHOD
/begin COMPU_METHOD FORMULA_0435 "FORMULA_0435" RAT_FUNC "%6.1" "%" COEFFS 0 32768 0 0 0 100 /end COMPU_METHOD
/begin COMPU_METHOD FORMULA_0443 "FORMULA_0443" RAT_FUNC "%7.2" "V" COEFFS 0 1 0 0 0 0.00080566 /end COMPU_METHOD
/begin COMPU_METHOD FORMULA_0449 "FORMULA_0449" RAT_FUNC "%7.2" "*" COEFFS 0 1024 0 0 0 1 /end COMPU_METHOD
/begin COMPU_METHOD FORMULA_0450 "FORMULA_0450" RAT_FUNC "%8.3" "%" COEFFS 0 640 0 0 0 1 /end COMPU_METHOD
/begin COMPU_METHOD FORMULA_0462 "FORMULA_0462" RAT_FUNC "%5.2" "s" COEFFS 0 0 2.56 0 1 0 /end COMPU_METHOD
/begin COMPU_METHOD FORMULA_0463 "FORMULA_0463" RAT_FUNC "%6.1" "%" COEFFS 0 100 0 0 0 1 /end COMPU_METHOD
/begin COMPU_METHOD FORMULA_0486 "FORMULA_0486" RAT_FUNC "%5.0" ".Gang" COEFFS 0 1 0 0 0 1 /end COMPU_METHOD
/begin COMPU_METHOD FORMULA_0491 "FORMULA_0491" RAT_FUNC "%9.4" "-" COEFFS 0 8192 0 0 0 1 /end COMPU_METHOD
/begin COMPU_METHOD FORMULA_0501 "FORMULA_0501" RAT_FUNC "%4.1" "s" COEFFS 0 10 0 0 0 1 /end COMPU_METHOD
/begin COMPU_METHOD FORMULA_0502 "FORMULA_0502" RAT_FUNC "%5.2" "-" COEFFS 0 255 0 0 0 1 /end COMPU_METHOD
/begin COMPU_METHOD FORMULA_0574 "FORMULA_0574" TAB_VERB "%3.0" "-" COMPU_TAB_REF FORMULA_0574_VTAB /end COMPU_METHOD
/begin COMPU_VTAB FORMULA_0574_VTAB "FORMULA_0574_VTAB" TAB_VERB 2 0 "Aus" 1 "Ein" DEFAULT_VALUE "undefiniert" /end COMPU_VTAB
/begin COMPU_METHOD FORMULA_0578 "FORMULA_0578" RAT_FUNC "%7.2" "%" COEFFS 0 40.95 0 0 0 1 /end COMPU_METHOD
/begin COMPU_METHOD FORMULA_0579 "FORMULA_0579" RAT_FUNC "%11.4" "-" COEFFS 0 1 0 0 0 1 /end COMPU_METHOD
/begin COMPU_METHOD FORMULA_0654 "FORMULA_0654" RAT_FUNC "%6.3" "-" COEFFS 0 255 0 0 0 1 /end COMPU_METHOD
/begin COMPU_METHOD FORMULA_0655 "FORMULA_0655" RAT_FUNC "%6.3" "-" COEFFS 0 128 0 0 0 1 /end COMPU_METHOD
/begin COMPU_METHOD FORMULA_0656 "FORMULA_0656" RAT_FUNC "%8.3" "-" COEFFS 0 100 0 0 0 1 /end COMPU_METHOD
/begin COMPU_METHOD FORMULA_0658 "FORMULA_0658" RAT_FUNC "%9.4" "-" COEFFS 0 262144 0 0 0 1 /end COMPU_METHOD
/begin COMPU_METHOD FORMULA_0660 "FORMULA_0660" TAB_VERB "%3.0" "-" COMPU_TAB_REF FORMULA_0660_VTAB /end COMPU_METHOD
/begin COMPU_VTAB FORMULA_0660_VTAB "FORMULA_0660_VTAB" TAB_VERB 2 0 "nicht sperren" 1 "sperren" /end COMPU_VTAB
/begin COMPU_METHOD FORMULA_0661 "FORMULA_0661" TAB_VERB "%3.0" "-" COMPU_TAB_REF FORMULA_0661_VTAB /end COMPU_METHOD
/begin COMPU_VTAB FORMULA_0661_VTAB "FORMULA_0661_VTAB" TAB_VERB 2 0 "Marke = Sollgeschw." 1 "Marke = Istgeschw." /end COMPU_VTAB
/begin COMPU_METHOD FORMULA_0662 "FORMULA_0662" TAB_VERB "%3.0" "-" COMPU_TAB_REF FORMULA_0662_VTAB /end COMPU_METHOD
/begin COMPU_VTAB FORMULA_0662_VTAB "FORMULA_0662_VTAB" TAB_VERB 2 0 "FGR bis 250Km/h" 1 "FGR bis Vmax" /end COMPU_VTAB
/begin COMPU_METHOD FORMULA_0663 "FORMULA_0663" RAT_FUNC "%5.2" "km/h" COEFFS 0 16 0 0 0 1 /end COMPU_METHOD
/begin COMPU_METHOD FORMULA_0664 "FORMULA_0664" RAT_FUNC "%6.1" "mph" COEFFS 0 16 0 0 0 1 /end COMPU_METHOD
/begin COMPU_METHOD FORMULA_0665 "FORMULA_0665" RAT_FUNC "%5.2" "-" COEFFS 0 100 0 0 0 1 /end COMPU_METHOD
/begin COMPU_METHOD FORMULA_0666 "FORMULA_0666" TAB_VERB "%3.0" "-" COMPU_TAB_REF FORMULA_0666_VTAB /end COMPU_METHOD
/begin COMPU_VTAB FORMULA_0666_VTAB "FORMULA_0666_VTAB" TAB_VERB 2 0 "Fahrzeuggeschw." 1 "Anzeigegeschw." /end COMPU_VTAB
/begin COMPU_METHOD FORMULA_0667 "FORMULA_0667" RAT_FUNC "%9.4" "%/sek" COEFFS 0 10 0 0 0 1 /end COMPU_METHOD
/begin COMPU_METHOD FORMULA_0668 "FORMULA_0668" RAT_FUNC "%5.2" "-" COEFFS 0 10 0 0 0 1 /end COMPU_METHOD
/begin COMPU_METHOD FORMULA_0669 "FORMULA_0669" RAT_FUNC "%7.2" "sek" COEFFS 0 100 0 0 0 1 /end COMPU_METHOD
/begin COMPU_METHOD FORMULA_0670 "FORMULA_0670" RAT_FUNC "%6.3" "sek" COEFFS 0 128 0 0 0 1 /end COMPU_METHOD
/begin COMPU_METHOD FORMULA_0671 "FORMULA_0671" RAT_FUNC "%6.3" "-" COEFFS 0 10 0 0 0 1 /end COMPU_METHOD
/begin COMPU_METHOD FORMULA_0672 "FORMULA_0672" RAT_FUNC "%6.3" "%" COEFFS 0 10 0 0 0 1 /end COMPU_METHOD
/begin COMPU_METHOD FORMULA_0673 "FORMULA_0673" RAT_FUNC "%8.3" "%/km/h" COEFFS 0 640 0 0 0 1 /end COMPU_METHOD
/begin COMPU_METHOD FORMULA_0674 "FORMULA_0674" RAT_FUNC "%8.3" "sek" COEFFS 0 640 0 0 0 1 /end COMPU_METHOD
/begin COMPU_METHOD FORMULA_0676 "FORMULA_0676" RAT_FUNC "%9.4" "-" COEFFS 0 10000 0 0 0 1 /end COMPU_METHOD
/begin COMPU_METHOD FORMULA_0677 "FORMULA_0677" RAT_FUNC "%9.4" "1/s" COEFFS 0 32768 0 0 0 100 /end COMPU_METHOD
/begin COMPU_METHOD FORMULA_0678 "FORMULA_0678" TAB_VERB "%5.2" "-" COMPU_TAB_REF FORMULA_0678_VTAB /end COMPU_METHOD
/begin COMPU_VTAB FORMULA_0678_VTAB "FORMULA_0678_VTAB" TAB_VERB 4 0 "HFM+Aus" 1 "PSAU+Aus" 2 "HFM+Eingr" 3 "PSAU+Eingr" /end COMPU_VTAB
/begin COMPU_METHOD FORMULA_0679 "FORMULA_0679" RAT_FUNC "%5.2" "s" COEFFS 0 0 25.6 0 1 0 /end COMPU_METHOD
/begin COMPU_METHOD FORMULA_0682 "FORMULA_0682" TAB_VERB "%5.2" "-" COMPU_TAB_REF FORMULA_0682_VTAB /end COMPU_METHOD
/begin COMPU_VTAB FORMULA_0682_VTAB "FORMULA_0682_VTAB" TAB_VERB 2 0 "FRA aus" 1 "FRA aktiv" DEFAULT_VALUE "undef" /end COMPU_VTAB
/begin COMPU_METHOD FORMULA_0684 "FORMULA_0684" RAT_FUNC "%5.0" "ms" COEFFS 0 1 0 0 0 10 /end COMPU_METHOD
/begin COMPU_METHOD FORMULA_0690 "FORMULA_0690" RAT_FUNC "%8.3" "m" COEFFS 0 1024 0 0 0 1 /end COMPU_METHOD
/begin COMPU_METHOD FORMULA_0691 "FORMULA_0691" RAT_FUNC "%5.0" "-" COEFFS 0 1024 0 0 0 1 /end COMPU_METHOD
/begin COMPU_METHOD FORMULA_0694 "FORMULA_0694" TAB_VERB "%3.0" "-" COMPU_TAB_REF FORMULA_0694_VTAB /end COMPU_METHOD
/begin COMPU_VTAB FORMULA_0694_VTAB "FORMULA_0694_VTAB" TAB_VERB 2 0 "Klopfschutz Aus" 1 "Klopfschutz Ein" DEFAULT_VALUE "undefiniert" /end COMPU_VTAB
/begin COMPU_METHOD FORMULA_0695 "FORMULA_0695" TAB_VERB "%3.0" "-" COMPU_TAB_REF FORMULA_0695_VTAB /end COMPU_METHOD
/begin COMPU_VTAB FORMULA_0695_VTAB "FORMULA_0695_VTAB" TAB_VERB 2 0 "Aus" 1 "Reset" DEFAULT_VALUE "undefiniert" /end COMPU_VTAB
/begin COMPU_METHOD FORMULA_0696 "FORMULA_0696" RAT_FUNC "%9.4" "s" COEFFS 0 0 6553.6 0 1 0 /end COMPU_METHOD
/begin COMPU_METHOD FORMULA_0697 "FORMULA_0697" RAT_FUNC "%8.3" "�KW/Segm" COEFFS 0 20480 0 0 0 1 /end COMPU_METHOD
/begin COMPU_METHOD FORMULA_0699 "FORMULA_0699" TAB_VERB "%5.2" "-" COMPU_TAB_REF FORMULA_0699_VTAB /end COMPU_METHOD
/begin COMPU_VTAB FORMULA_0699_VTAB "FORMULA_0699_VTAB" TAB_VERB 3 1 "vkat" 2 "nkat" 4 "mess" DEFAULT_VALUE "ungueltig" /end COMPU_VTAB
/begin COMPU_METHOD FORMULA_0700 "FORMULA_0700" TAB_VERB "%5.2" "-" COMPU_TAB_REF FORMULA_0700_VTAB /end COMPU_METHOD
/begin COMPU_VTAB FORMULA_0700_VTAB "FORMULA_0700_VTAB" TAB_VERB 2 0 "absolut" 1 "Eta" DEFAULT_VALUE "undef" /end COMPU_VTAB
/begin COMPU_METHOD FORMULA_0701 "FORMULA_0701" RAT_FUNC "%7.2" "�KW/seg(144�KW)" COEFFS 0 100 0 0 0 1 /end COMPU_METHOD
/begin COMPU_METHOD FORMULA_0702 "FORMULA_0702" RAT_FUNC "%7.2" "s" COEFFS 0 0 164 0 1 0 /end COMPU_METHOD
/begin COMPU_METHOD FORMULA_0703 "FORMULA_0703" TAB_VERB "%5.2" "-" COMPU_TAB_REF FORMULA_0703_VTAB /end COMPU_METHOD
/begin COMPU_VTAB FORMULA_0703_VTAB "FORMULA_0703_VTAB" TAB_VERB 2 0 "Kennfeld" 1 "Restgas" DEFAULT_VALUE "undef." /end COMPU_VTAB
/begin COMPU_METHOD FORMULA_0704 "FORMULA_0704" RAT_FUNC "%5.2" "-" COEFFS 0 128 0 0 0 1 /end COMPU_METHOD
/begin COMPU_METHOD FORMULA_0705 "FORMULA_0705" RAT_FUNC "%9.4" "-/seg(144�KW)" COEFFS 0 16384 0 0 0 1 /end COMPU_METHOD
/begin COMPU_METHOD FORMULA_0706 "FORMULA_0706" RAT_FUNC "%6.1" "�KW/10ms" COEFFS 0 10 0 0 0 1 /end COMPU_METHOD
/begin COMPU_METHOD FORMULA_0707 "FORMULA_0707" RAT_FUNC "%6.1" "%/180�KW" COEFFS 0 32768 0 0 0 100 /end COMPU_METHOD
/begin COMPU_METHOD FORMULA_0709 "FORMULA_0709" TAB_VERB "%5.2" "-" COMPU_TAB_REF FORMULA_0709_VTAB /end COMPU_METHOD
/begin COMPU_VTAB FORMULA_0709_VTAB "FORMULA_0709_VTAB" TAB_VERB 2 0 "Low Active" 1 "High Active" DEFAULT_VALUE "undefiniert" /end COMPU_VTAB
/begin COMPU_METHOD FORMULA_0710 "FORMULA_0710" RAT_FUNC "%6.1" "�KW" COEFFS 0 65536 0 0 0 720 /end COMPU_METHOD
/begin COMPU_METHOD FORMULA_0734 "FORMULA_0734" RAT_FUNC "%7.2" "fS�" COEFFS 0 1 0 0 0 0.0022716 /end COMPU_METHOD
/begin COMPU_METHOD FORMULA_0735 "FORMULA_0735" RAT_FUNC "%6.3" "kHz" COEFFS 0 1 0 0 0 0.12207031 /end COMPU_METHOD
/* ------------------ Abschnitt erzeugt aus n_getr.dat ------------------ */
/begin COMPU_METHOD FORMULA_0839 "FORMULA_0839" RAT_FUNC "%5.0" "us" COEFFS 0 1 0 0 0 6 /end COMPU_METHOD
/begin COMPU_METHOD FORMULA_0840 "FORMULA_0840" TAB_VERB "%4.1" "-" COMPU_TAB_REF FORMULA_0840_VTAB /end COMPU_METHOD
/begin COMPU_VTAB FORMULA_0840_VTAB "FORMULA_0840_VTAB" TAB_VERB 2 0 "Messwert" 1 "Ersatzwert" /end COMPU_VTAB
/begin COMPU_METHOD FORMULA_1057 "FORMULA_1057" RAT_FUNC "%9.4" "*" COEFFS 0 4096 0 0 0 1 /end COMPU_METHOD
/begin COMPU_METHOD FORMULA_1058 "FORMULA_1058" TAB_VERB "%5.2" "-" COMPU_TAB_REF FORMULA_1058_VTAB /end COMPU_METHOD
/begin COMPU_VTAB FORMULA_1058_VTAB "FORMULA_1058_VTAB" TAB_VERB 2 0 "Aus" 1 "Ein" DEFAULT_VALUE "undef." /end COMPU_VTAB
/begin COMPU_METHOD FORMULA_1059 "FORMULA_1059" TAB_VERB "%5.2" "-" COMPU_TAB_REF FORMULA_1059_VTAB /end COMPU_METHOD
/begin COMPU_VTAB FORMULA_1059_VTAB "FORMULA_1059_VTAB" TAB_VERB 2 0 "30V" 1 "60V" DEFAULT_VALUE "undef." /end COMPU_VTAB
/begin COMPU_METHOD FORMULA_1060 "FORMULA_1060" TAB_VERB "%5.2" "-" COMPU_TAB_REF FORMULA_1060_VTAB /end COMPU_METHOD
/begin COMPU_VTAB FORMULA_1060_VTAB "FORMULA_1060_VTAB" TAB_VERB 2 0 "aktiv" 1 "ohne" DEFAULT_VALUE "undef." /end COMPU_VTAB
/* ------------------ Abschnitt erzeugt aus v_direkt.dat ------------------ */
/begin COMPU_METHOD FORMULA_1061 "FORMULA_1061" RAT_FUNC "%6.1" "km/h*10ms" COEFFS 0 16 0 0 0 1 /end COMPU_METHOD
/begin CHARACTERISTIC K_ED_WUC_TMOT_MIN "Min. Temperatur fuer Warmupcycle | EN: Minimum temperature for an OBD warm-up cycle" VALUE 0x71962 TKW_VV_VV_SW 100.0 FORMULA_0023 -50.0000 170.0000 FORMAT "%4.1" /end CHARACTERISTIC
/begin CHARACTERISTIC K_ED_WUC_DELTA_TMOT "Min. Temperaturerhoehung fuer Warmupcycle | EN: Minimum temperature rise for an OBD warm-up cycle" VALUE 0x71964 TKW_VV_VV_SW 100.0 FORMULA_0076 -1000.0000 1000.0000 FORMAT "%4.1" /end CHARACTERISTIC
/begin CHARACTERISTIC K_ED_UBMIN "untere UB-Schwelle fuer elektr. Diagnosen | EN: Lower battery-voltage threshold for electrical diagnoses" VALUE 0x7197A TKW_VV_VV_SW 100.0 FORMULA_0008 0.0 28.0000 FORMAT "%4.1" /end CHARACTERISTIC
/* ------------------ Abschnitt erzeugt aus eeprom.dat ------------------ */ /* ------------------ Abschnitt erzeugt aus glob.dat ------------------ */ /* ------------------ Abschnitt erzeugt aus ipk.dat ------------------ */
/begin CHARACTERISTIC K_IPK_INJ_T_SYNC_MAX "Wartezeit INJ auf IGN" VALUE 0x73474 TKW_VV_VV_UL 100.0 FORMULA_0347 0.0 500.0000 FORMAT "%4.1" /end CHARACTERISTIC
/* ------------------ Abschnitt erzeugt aus sc_glob.dat ------------------ */
/begin CHARACTERISTIC K_DIAGNOSE_INDEX_LO "Diagnoseindex | EN: Diagnoseindex [V912: differs from V452 160E]" VALUE 0x7024C TKW_VV_VV_UB 100.0 FORMULA_0003 0.0 255.0000 /end CHARACTERISTIC
/begin CHARACTERISTIC K_DIAGNOSE_INDEX_HI "Diagnoseindex | EN: Diagnoseindex" VALUE 0x7024B TKW_VV_VV_UB 100.0 FORMULA_0003 0.0 255.0000 /end CHARACTERISTIC
/begin CHARACTERISTIC K_ED_UB.P_CODE_SH_TO_UB "P-Code fuer die Art SH_TO_UB | EN: Fault code UB - OBD P-code reported for short to battery voltage" VALUE 0x70CFC TKW_VV_VV_UW 100.0 FORMULA_0010 0.0 65535.0000 /end CHARACTERISTIC
/begin CHARACTERISTIC K_ED_UEXT_111219514.P_CODE_SH_TO_UB "P-Code fuer die Art SH_TO_UB | EN: Fault code UEXT_111219514 - OBD P-code reported for short to battery voltage" VALUE 0x70D4A TKW_VV_VV_UW 100.0 FORMULA_0010 0.0 65535.0000 /end CHARACTERISTIC
/begin CHARACTERISTIC K_ED_UEXT_124_512.P_CODE_SH_TO_UB "P-Code fuer die Art SH_TO_UB | EN: Fault code UEXT_124_512 - OBD P-code reported for short to battery voltage" VALUE 0x70D64 TKW_VV_VV_UW 100.0 FORMULA_0010 0.0 65535.0000 /end CHARACTERISTIC
/begin CHARACTERISTIC K_ED_TUMG_OBD.P_CODE_SH_TO_UB "P-Code fuer die Art SH_TO_UB | EN: Fault code TUMG_OBD - OBD P-code reported for short to battery voltage" VALUE 0x70F04 TKW_VV_VV_UW 100.0 FORMULA_0010 0.0 65535.0000 /end CHARACTERISTIC
/begin CHARACTERISTIC K_ED_V_DIREKT.P_CODE_SH_TO_UB "P-Code fuer die Art SH_TO_UB | EN: Fault code V_DIREKT - OBD P-code reported for short to battery voltage" VALUE 0x70F1E TKW_VV_VV_UW 100.0 FORMULA_0010 0.0 65535.0000 /end CHARACTERISTIC
/begin CHARACTERISTIC K_ED_ZOELP1.P_CODE_SH_TO_UB "P-Code fuer die Art SH_TO_UB | EN: Fault code ZOELP1 - OBD P-code reported for short to battery voltage" VALUE 0x71584 TKW_VV_VV_UW 100.0 FORMULA_0010 0.0 65535.0000 /end CHARACTERISTIC
/begin CHARACTERISTIC K_ED_ZOELP2.P_CODE_SH_TO_UB "P-Code fuer die Art SH_TO_UB | EN: Fault code ZOELP2 - OBD P-code reported for short to battery voltage" VALUE 0x7159E TKW_VV_VV_UW 100.0 FORMULA_0010 0.0 65535.0000 /end CHARACTERISTIC
/begin CHARACTERISTIC K_ED_TUMG.P_CODE_SH_TO_UB "P-Code fuer die Art SH_TO_UB | EN: Fault code TUMG - OBD P-code reported for short to battery voltage" VALUE 0x71724 TKW_VV_VV_UW 100.0 FORMULA_0010 0.0 65535.0000 /end CHARACTERISTIC
/begin CHARACTERISTIC K_ED_UB.P_CODE_SH_TO_GND "P-Code fuer die Art SH_TO_GND | EN: Fault code UB - OBD P-code reported for short to ground" VALUE 0x70CFE TKW_VV_VV_UW 100.0 FORMULA_0010 0.0 65535.0000 /end CHARACTERISTIC
/begin CHARACTERISTIC K_ED_UEXT_111219514.P_CODE_SH_TO_GND "P-Code fuer die Art SH_TO_GND | EN: Fault code UEXT_111219514 - OBD P-code reported for short to ground" VALUE 0x70D4C TKW_VV_VV_UW 100.0 FORMULA_0010 0.0 65535.0000 /end CHARACTERISTIC
/begin CHARACTERISTIC K_ED_UEXT_124_512.P_CODE_SH_TO_GND "P-Code fuer die Art SH_TO_GND | EN: Fault code UEXT_124_512 - OBD P-code reported for short to ground" VALUE 0x70D66 TKW_VV_VV_UW 100.0 FORMULA_0010 0.0 65535.0000 /end CHARACTERISTIC
/begin CHARACTERISTIC K_ED_TUMG_OBD.P_CODE_SH_TO_GND "P-Code fuer die Art SH_TO_GND | EN: Fault code TUMG_OBD - OBD P-code reported for short to ground" VALUE 0x70F06 TKW_VV_VV_UW 100.0 FORMULA_0010 0.0 65535.0000 /end CHARACTERISTIC
/begin CHARACTERISTIC K_ED_V_DIREKT.P_CODE_SH_TO_GND "P-Code fuer die Art SH_TO_GND | EN: Fault code V_DIREKT - OBD P-code reported for short to ground" VALUE 0x70F20 TKW_VV_VV_UW 100.0 FORMULA_0010 0.0 65535.0000 /end CHARACTERISTIC
/begin CHARACTERISTIC K_ED_ZOELP1.P_CODE_SH_TO_GND "P-Code fuer die Art SH_TO_GND | EN: Fault code ZOELP1 - OBD P-code reported for short to ground" VALUE 0x71586 TKW_VV_VV_UW 100.0 FORMULA_0010 0.0 65535.0000 /end CHARACTERISTIC
/begin CHARACTERISTIC K_ED_ZOELP2.P_CODE_SH_TO_GND "P-Code fuer die Art SH_TO_GND | EN: Fault code ZOELP2 - OBD P-code reported for short to ground" VALUE 0x715A0 TKW_VV_VV_UW 100.0 FORMULA_0010 0.0 65535.0000 /end CHARACTERISTIC
/begin CHARACTERISTIC K_ED_TUMG.P_CODE_SH_TO_GND "P-Code fuer die Art SH_TO_GND | EN: Fault code TUMG - OBD P-code reported for short to ground" VALUE 0x71726 TKW_VV_VV_UW 100.0 FORMULA_0010 0.0 65535.0000 /end CHARACTERISTIC
/begin CHARACTERISTIC K_ED_UB.P_CODE_OPENLOAD "P-Code fuer die Art OPENLOAD | EN: Fault code UB - OBD P-code reported for open circuit" VALUE 0x70D00 TKW_VV_VV_UW 100.0 FORMULA_0010 0.0 65535.0000 /end CHARACTERISTIC
/begin CHARACTERISTIC K_ED_UEXT_111219514.P_CODE_OPENLOAD "P-Code fuer die Art OPENLOAD | EN: Fault code UEXT_111219514 - OBD P-code reported for open circuit" VALUE 0x70D4E TKW_VV_VV_UW 100.0 FORMULA_0010 0.0 65535.0000 /end CHARACTERISTIC
/begin CHARACTERISTIC K_ED_UEXT_124_512.P_CODE_OPENLOAD "P-Code fuer die Art OPENLOAD | EN: Fault code UEXT_124_512 - OBD P-code reported for open circuit" VALUE 0x70D68 TKW_VV_VV_UW 100.0 FORMULA_0010 0.0 65535.0000 /end CHARACTERISTIC
/begin CHARACTERISTIC K_ED_TUMG_OBD.P_CODE_OPENLOAD "P-Code fuer die Art OPENLOAD | EN: Fault code TUMG_OBD - OBD P-code reported for open circuit" VALUE 0x70F08 TKW_VV_VV_UW 100.0 FORMULA_0010 0.0 65535.0000 /end CHARACTERISTIC
/begin CHARACTERISTIC K_ED_V_DIREKT.P_CODE_OPENLOAD "P-Code fuer die Art OPENLOAD | EN: Fault code V_DIREKT - OBD P-code reported for open circuit" VALUE 0x70F22 TKW_VV_VV_UW 100.0 FORMULA_0010 0.0 65535.0000 /end CHARACTERISTIC
/begin CHARACTERISTIC K_ED_ZOELP1.P_CODE_OPENLOAD "P-Code fuer die Art OPENLOAD | EN: Fault code ZOELP1 - OBD P-code reported for open circuit" VALUE 0x71588 TKW_VV_VV_UW 100.0 FORMULA_0010 0.0 65535.0000 /end CHARACTERISTIC
/begin CHARACTERISTIC K_ED_ZOELP2.P_CODE_OPENLOAD "P-Code fuer die Art OPENLOAD | EN: Fault code ZOELP2 - OBD P-code reported for open circuit" VALUE 0x715A2 TKW_VV_VV_UW 100.0 FORMULA_0010 0.0 65535.0000 /end CHARACTERISTIC
/begin CHARACTERISTIC K_ED_TUMG.P_CODE_OPENLOAD "P-Code fuer die Art OPENLOAD | EN: Fault code TUMG - OBD P-code reported for open circuit" VALUE 0x71728 TKW_VV_VV_UW 100.0 FORMULA_0010 0.0 65535.0000 /end CHARACTERISTIC
/begin CHARACTERISTIC K_ED_UB.P_CODE_UNPLAUSIBEL "P-Code fuer die Art UNPLAUSIBEL | EN: Fault code UB - OBD P-code reported for implausible signal" VALUE 0x70D02 TKW_VV_VV_UW 100.0 FORMULA_0010 0.0 65535.0000 /end CHARACTERISTIC
/begin CHARACTERISTIC K_ED_UEXT_111219514.P_CODE_UNPLAUSIBEL "P-Code fuer die Art UNPLAUSIBEL | EN: Fault code UEXT_111219514 - OBD P-code reported for implausible signal" VALUE 0x70D50 TKW_VV_VV_UW 100.0 FORMULA_0010 0.0 65535.0000 /end CHARACTERISTIC
/begin CHARACTERISTIC K_ED_UEXT_124_512.P_CODE_UNPLAUSIBEL "P-Code fuer die Art UNPLAUSIBEL | EN: Fault code UEXT_124_512 - OBD P-code reported for implausible signal" VALUE 0x70D6A TKW_VV_VV_UW 100.0 FORMULA_0010 0.0 65535.0000 /end CHARACTERISTIC
/begin CHARACTERISTIC K_ED_TUMG_OBD.P_CODE_UNPLAUSIBEL "P-Code fuer die Art UNPLAUSIBEL | EN: Fault code TUMG_OBD - OBD P-code reported for implausible signal" VALUE 0x70F0A TKW_VV_VV_UW 100.0 FORMULA_0010 0.0 65535.0000 /end CHARACTERISTIC
/begin CHARACTERISTIC K_ED_V_DIREKT.P_CODE_UNPLAUSIBEL "P-Code fuer die Art UNPLAUSIBEL | EN: Fault code V_DIREKT - OBD P-code reported for implausible signal" VALUE 0x70F24 TKW_VV_VV_UW 100.0 FORMULA_0010 0.0 65535.0000 /end CHARACTERISTIC
/begin CHARACTERISTIC K_ED_ZOELP1.P_CODE_UNPLAUSIBEL "P-Code fuer die Art UNPLAUSIBEL | EN: Fault code ZOELP1 - OBD P-code reported for implausible signal" VALUE 0x7158A TKW_VV_VV_UW 100.0 FORMULA_0010 0.0 65535.0000 /end CHARACTERISTIC
/begin CHARACTERISTIC K_ED_ZOELP2.P_CODE_UNPLAUSIBEL "P-Code fuer die Art UNPLAUSIBEL | EN: Fault code ZOELP2 - OBD P-code reported for implausible signal" VALUE 0x715A4 TKW_VV_VV_UW 100.0 FORMULA_0010 0.0 65535.0000 /end CHARACTERISTIC
/begin CHARACTERISTIC K_ED_TUMG.P_CODE_UNPLAUSIBEL "P-Code fuer die Art UNPLAUSIBEL | EN: Fault code TUMG - OBD P-code reported for implausible signal" VALUE 0x7172A TKW_VV_VV_UW 100.0 FORMULA_0010 0.0 65535.0000 /end CHARACTERISTIC
/begin CHARACTERISTIC K_ED_UB.FEHLERSCHWELLE "Filterschwelle fuer Fehlereintrag | EN: Fault code UB - debounce filter threshold for setting the fault" VALUE 0x70D04 TKW_VV_VV_UB 100.0 FORMULA_0003 0.0 255.0000 /end CHARACTERISTIC
/begin CHARACTERISTIC K_ED_UEXT_111219514.FEHLERSCHWELLE "Filterschwelle fuer Fehlereintrag | EN: Fault code UEXT_111219514 - debounce filter threshold for setting the fault" VALUE 0x70D52 TKW_VV_VV_UB 100.0 FORMULA_0003 0.0 255.0000 /end CHARACTERISTIC
/begin CHARACTERISTIC K_ED_UEXT_124_512.FEHLERSCHWELLE "Filterschwelle fuer Fehlereintrag | EN: Fault code UEXT_124_512 - debounce filter threshold for setting the fault" VALUE 0x70D6C TKW_VV_VV_UB 100.0 FORMULA_0003 0.0 255.0000 /end CHARACTERISTIC
/begin CHARACTERISTIC K_ED_TUMG_OBD.FEHLERSCHWELLE "Filterschwelle fuer Fehlereintrag | EN: Fault code TUMG_OBD - debounce filter threshold for setting the fault" VALUE 0x70F0C TKW_VV_VV_UB 100.0 FORMULA_0003 0.0 255.0000 /end CHARACTERISTIC
/begin CHARACTERISTIC K_ED_V_DIREKT.FEHLERSCHWELLE "Filterschwelle fuer Fehlereintrag | EN: Fault code V_DIREKT - debounce filter threshold for setting the fault" VALUE 0x70F26 TKW_VV_VV_UB 100.0 FORMULA_0003 0.0 255.0000 /end CHARACTERISTIC
/begin CHARACTERISTIC K_ED_ZOELP1.FEHLERSCHWELLE "Filterschwelle fuer Fehlereintrag | EN: Fault code ZOELP1 - debounce filter threshold for setting the fault" VALUE 0x7158C TKW_VV_VV_UB 100.0 FORMULA_0003 0.0 255.0000 /end CHARACTERISTIC
/begin CHARACTERISTIC K_ED_ZOELP2.FEHLERSCHWELLE "Filterschwelle fuer Fehlereintrag | EN: Fault code ZOELP2 - debounce filter threshold for setting the fault" VALUE 0x715A6 TKW_VV_VV_UB 100.0 FORMULA_0003 0.0 255.0000 /end CHARACTERISTIC
/begin CHARACTERISTIC K_ED_TUMG.FEHLERSCHWELLE "Filterschwelle fuer Fehlereintrag | EN: Fault code TUMG - debounce filter threshold for setting the fault" VALUE 0x7172C TKW_VV_VV_UB 100.0 FORMULA_0003 0.0 255.0000 /end CHARACTERISTIC
/begin CHARACTERISTIC K_ED_UB.OK_SCHWELLE "Filterschwelle fuer Fehleraustrag | EN: Fault code UB - debounce filter threshold for clearing (healing) the fault" VALUE 0x70D05 TKW_VV_VV_UB 100.0 FORMULA_0003 0.0 255.0000 /end CHARACTERISTIC
/begin CHARACTERISTIC K_ED_UEXT_111219514.OK_SCHWELLE "Filterschwelle fuer Fehleraustrag | EN: Fault code UEXT_111219514 - debounce filter threshold for clearing (healing) the fault" VALUE 0x70D53 TKW_VV_VV_UB 100.0 FORMULA_0003 0.0 255.0000 /end CHARACTERISTIC
/begin CHARACTERISTIC K_ED_UEXT_124_512.OK_SCHWELLE "Filterschwelle fuer Fehleraustrag | EN: Fault code UEXT_124_512 - debounce filter threshold for clearing (healing) the fault" VALUE 0x70D6D TKW_VV_VV_UB 100.0 FORMULA_0003 0.0 255.0000 /end CHARACTERISTIC
/begin CHARACTERISTIC K_ED_TUMG_OBD.OK_SCHWELLE "Filterschwelle fuer Fehleraustrag | EN: Fault code TUMG_OBD - debounce filter threshold for clearing (healing) the fault" VALUE 0x70F0D TKW_VV_VV_UB 100.0 FORMULA_0003 0.0 255.0000 /end CHARACTERISTIC
/begin CHARACTERISTIC K_ED_V_DIREKT.OK_SCHWELLE "Filterschwelle fuer Fehleraustrag | EN: Fault code V_DIREKT - debounce filter threshold for clearing (healing) the fault" VALUE 0x70F27 TKW_VV_VV_UB 100.0 FORMULA_0003 0.0 255.0000 /end CHARACTERISTIC
/begin CHARACTERISTIC K_ED_ZOELP1.OK_SCHWELLE "Filterschwelle fuer Fehleraustrag | EN: Fault code ZOELP1 - debounce filter threshold for clearing (healing) the fault" VALUE 0x7158D TKW_VV_VV_UB 100.0 FORMULA_0003 0.0 255.0000 /end CHARACTERISTIC
/begin CHARACTERISTIC K_ED_ZOELP2.OK_SCHWELLE "Filterschwelle fuer Fehleraustrag | EN: Fault code ZOELP2 - debounce filter threshold for clearing (healing) the fault" VALUE 0x715A7 TKW_VV_VV_UB 100.0 FORMULA_0003 0.0 255.0000 /end CHARACTERISTIC
/begin CHARACTERISTIC K_ED_TUMG.OK_SCHWELLE "Filterschwelle fuer Fehleraustrag | EN: Fault code TUMG - debounce filter threshold for clearing (healing) the fault" VALUE 0x7172D TKW_VV_VV_UB 100.0 FORMULA_0003 0.0 255.0000 /end CHARACTERISTIC
/begin CHARACTERISTIC K_ED_UB.INC_VOR_EINTRAG "Filtererhoehung vorm Fehlerspeichereintrag | EN: Fault code UB - debounce filter increment before fault-memory entry" VALUE 0x70D06 TKW_VV_VV_UB 100.0 FORMULA_0003 0.0 255.0000 /end CHARACTERISTIC
/begin CHARACTERISTIC K_ED_UEXT_111219514.INC_VOR_EINTRAG "Filtererhoehung vorm Fehlerspeichereintrag | EN: Fault code UEXT_111219514 - debounce filter increment before fault-memory entry" VALUE 0x70D54 TKW_VV_VV_UB 100.0 FORMULA_0003 0.0 255.0000 /end CHARACTERISTIC
/begin CHARACTERISTIC K_ED_UEXT_124_512.INC_VOR_EINTRAG "Filtererhoehung vorm Fehlerspeichereintrag | EN: Fault code UEXT_124_512 - debounce filter increment before fault-memory entry" VALUE 0x70D6E TKW_VV_VV_UB 100.0 FORMULA_0003 0.0 255.0000 /end CHARACTERISTIC
/begin CHARACTERISTIC K_ED_TUMG_OBD.INC_VOR_EINTRAG "Filtererhoehung vorm Fehlerspeichereintrag | EN: Fault code TUMG_OBD - debounce filter increment before fault-memory entry" VALUE 0x70F0E TKW_VV_VV_UB 100.0 FORMULA_0003 0.0 255.0000 /end CHARACTERISTIC
/begin CHARACTERISTIC K_ED_V_DIREKT.INC_VOR_EINTRAG "Filtererhoehung vorm Fehlerspeichereintrag | EN: Fault code V_DIREKT - debounce filter increment before fault-memory entry" VALUE 0x70F28 TKW_VV_VV_UB 100.0 FORMULA_0003 0.0 255.0000 /end CHARACTERISTIC
/begin CHARACTERISTIC K_ED_ZOELP1.INC_VOR_EINTRAG "Filtererhoehung vorm Fehlerspeichereintrag | EN: Fault code ZOELP1 - debounce filter increment before fault-memory entry" VALUE 0x7158E TKW_VV_VV_UB 100.0 FORMULA_0003 0.0 255.0000 /end CHARACTERISTIC
/begin CHARACTERISTIC K_ED_ZOELP2.INC_VOR_EINTRAG "Filtererhoehung vorm Fehlerspeichereintrag | EN: Fault code ZOELP2 - debounce filter increment before fault-memory entry" VALUE 0x715A8 TKW_VV_VV_UB 100.0 FORMULA_0003 0.0 255.0000 /end CHARACTERISTIC
/begin CHARACTERISTIC K_ED_TUMG.INC_VOR_EINTRAG "Filtererhoehung vorm Fehlerspeichereintrag | EN: Fault code TUMG - debounce filter increment before fault-memory entry" VALUE 0x7172E TKW_VV_VV_UB 100.0 FORMULA_0003 0.0 255.0000 /end CHARACTERISTIC
/begin CHARACTERISTIC K_ED_UB.DEC_VOR_EINTRAG "Filterverringerung vorm Fehlerspeichereintrag | EN: Fault code UB - debounce filter decrement before fault-memory entry" VALUE 0x70D07 TKW_VV_VV_UB 100.0 FORMULA_0003 0.0 255.0000 /end CHARACTERISTIC
/begin CHARACTERISTIC K_ED_UEXT_111219514.DEC_VOR_EINTRAG "Filterverringerung vorm Fehlerspeichereintrag | EN: Fault code UEXT_111219514 - debounce filter decrement before fault-memory entry" VALUE 0x70D55 TKW_VV_VV_UB 100.0 FORMULA_0003 0.0 255.0000 /end CHARACTERISTIC
/begin CHARACTERISTIC K_ED_UEXT_124_512.DEC_VOR_EINTRAG "Filterverringerung vorm Fehlerspeichereintrag | EN: Fault code UEXT_124_512 - debounce filter decrement before fault-memory entry" VALUE 0x70D6F TKW_VV_VV_UB 100.0 FORMULA_0003 0.0 255.0000 /end CHARACTERISTIC
/begin CHARACTERISTIC K_ED_TUMG_OBD.DEC_VOR_EINTRAG "Filterverringerung vorm Fehlerspeichereintrag | EN: Fault code TUMG_OBD - debounce filter decrement before fault-memory entry" VALUE 0x70F0F TKW_VV_VV_UB 100.0 FORMULA_0003 0.0 255.0000 /end CHARACTERISTIC
/begin CHARACTERISTIC K_ED_V_DIREKT.DEC_VOR_EINTRAG "Filterverringerung vorm Fehlerspeichereintrag | EN: Fault code V_DIREKT - debounce filter decrement before fault-memory entry" VALUE 0x70F29 TKW_VV_VV_UB 100.0 FORMULA_0003 0.0 255.0000 /end CHARACTERISTIC
/begin CHARACTERISTIC K_ED_ZOELP1.DEC_VOR_EINTRAG "Filterverringerung vorm Fehlerspeichereintrag | EN: Fault code ZOELP1 - debounce filter decrement before fault-memory entry" VALUE 0x7158F TKW_VV_VV_UB 100.0 FORMULA_0003 0.0 255.0000 /end CHARACTERISTIC
/begin CHARACTERISTIC K_ED_ZOELP2.DEC_VOR_EINTRAG "Filterverringerung vorm Fehlerspeichereintrag | EN: Fault code ZOELP2 - debounce filter decrement before fault-memory entry" VALUE 0x715A9 TKW_VV_VV_UB 100.0 FORMULA_0003 0.0 255.0000 /end CHARACTERISTIC
/begin CHARACTERISTIC K_ED_TUMG.DEC_VOR_EINTRAG "Filterverringerung vorm Fehlerspeichereintrag | EN: Fault code TUMG - debounce filter decrement before fault-memory entry" VALUE 0x7172F TKW_VV_VV_UB 100.0 FORMULA_0003 0.0 255.0000 /end CHARACTERISTIC
/begin CHARACTERISTIC K_ED_UB.INC_NACH_EINTRAG "Filtererhoehung nach Fehlerspeichereintrag | EN: Fault code UB - debounce filter increment after fault-memory entry" VALUE 0x70D08 TKW_VV_VV_UB 100.0 FORMULA_0003 0.0 255.0000 /end CHARACTERISTIC
/begin CHARACTERISTIC K_ED_UEXT_111219514.INC_NACH_EINTRAG "Filtererhoehung nach Fehlerspeichereintrag | EN: Fault code UEXT_111219514 - debounce filter increment after fault-memory entry" VALUE 0x70D56 TKW_VV_VV_UB 100.0 FORMULA_0003 0.0 255.0000 /end CHARACTERISTIC
/begin CHARACTERISTIC K_ED_UEXT_124_512.INC_NACH_EINTRAG "Filtererhoehung nach Fehlerspeichereintrag | EN: Fault code UEXT_124_512 - debounce filter increment after fault-memory entry" VALUE 0x70D70 TKW_VV_VV_UB 100.0 FORMULA_0003 0.0 255.0000 /end CHARACTERISTIC
/begin CHARACTERISTIC K_ED_TUMG_OBD.INC_NACH_EINTRAG "Filtererhoehung nach Fehlerspeichereintrag | EN: Fault code TUMG_OBD - debounce filter increment after fault-memory entry" VALUE 0x70F10 TKW_VV_VV_UB 100.0 FORMULA_0003 0.0 255.0000 /end CHARACTERISTIC
/begin CHARACTERISTIC K_ED_V_DIREKT.INC_NACH_EINTRAG "Filtererhoehung nach Fehlerspeichereintrag | EN: Fault code V_DIREKT - debounce filter increment after fault-memory entry" VALUE 0x70F2A TKW_VV_VV_UB 100.0 FORMULA_0003 0.0 255.0000 /end CHARACTERISTIC
/begin CHARACTERISTIC K_ED_ZOELP1.INC_NACH_EINTRAG "Filtererhoehung nach Fehlerspeichereintrag | EN: Fault code ZOELP1 - debounce filter increment after fault-memory entry" VALUE 0x71590 TKW_VV_VV_UB 100.0 FORMULA_0003 0.0 255.0000 /end CHARACTERISTIC
/begin CHARACTERISTIC K_ED_ZOELP2.INC_NACH_EINTRAG "Filtererhoehung nach Fehlerspeichereintrag | EN: Fault code ZOELP2 - debounce filter increment after fault-memory entry" VALUE 0x715AA TKW_VV_VV_UB 100.0 FORMULA_0003 0.0 255.0000 /end CHARACTERISTIC
/begin CHARACTERISTIC K_ED_TUMG.INC_NACH_EINTRAG "Filtererhoehung nach Fehlerspeichereintrag | EN: Fault code TUMG - debounce filter increment after fault-memory entry" VALUE 0x71730 TKW_VV_VV_UB 100.0 FORMULA_0003 0.0 255.0000 /end CHARACTERISTIC
/begin CHARACTERISTIC K_ED_UB.DEC_NACH_EINTRAG "Filterverringerung nach Fehlerspeichereintrag | EN: Fault code UB - debounce filter decrement after fault-memory entry" VALUE 0x70D09 TKW_VV_VV_UB 100.0 FORMULA_0003 0.0 255.0000 /end CHARACTERISTIC
/begin CHARACTERISTIC K_ED_UEXT_111219514.DEC_NACH_EINTRAG "Filterverringerung nach Fehlerspeichereintrag | EN: Fault code UEXT_111219514 - debounce filter decrement after fault-memory entry" VALUE 0x70D57 TKW_VV_VV_UB 100.0 FORMULA_0003 0.0 255.0000 /end CHARACTERISTIC
/begin CHARACTERISTIC K_ED_UEXT_124_512.DEC_NACH_EINTRAG "Filterverringerung nach Fehlerspeichereintrag | EN: Fault code UEXT_124_512 - debounce filter decrement after fault-memory entry" VALUE 0x70D71 TKW_VV_VV_UB 100.0 FORMULA_0003 0.0 255.0000 /end CHARACTERISTIC
/begin CHARACTERISTIC K_ED_TUMG_OBD.DEC_NACH_EINTRAG "Filterverringerung nach Fehlerspeichereintrag | EN: Fault code TUMG_OBD - debounce filter decrement after fault-memory entry" VALUE 0x70F11 TKW_VV_VV_UB 100.0 FORMULA_0003 0.0 255.0000 /end CHARACTERISTIC
/begin CHARACTERISTIC K_ED_V_DIREKT.DEC_NACH_EINTRAG "Filterverringerung nach Fehlerspeichereintrag | EN: Fault code V_DIREKT - debounce filter decrement after fault-memory entry" VALUE 0x70F2B TKW_VV_VV_UB 100.0 FORMULA_0003 0.0 255.0000 /end CHARACTERISTIC
/begin CHARACTERISTIC K_ED_ZOELP1.DEC_NACH_EINTRAG "Filterverringerung nach Fehlerspeichereintrag | EN: Fault code ZOELP1 - debounce filter decrement after fault-memory entry" VALUE 0x71591 TKW_VV_VV_UB 100.0 FORMULA_0003 0.0 255.0000 /end CHARACTERISTIC
/begin CHARACTERISTIC K_ED_ZOELP2.DEC_NACH_EINTRAG "Filterverringerung nach Fehlerspeichereintrag | EN: Fault code ZOELP2 - debounce filter decrement after fault-memory entry" VALUE 0x715AB TKW_VV_VV_UB 100.0 FORMULA_0003 0.0 255.0000 /end CHARACTERISTIC
/begin CHARACTERISTIC K_ED_UB.KLASSENINDEX "Auswahl der Fehlerklasse | EN: Fault code UB - fault class selection (lamp / warning behaviour)" VALUE 0x70D0A TKW_VV_VV_UB 100.0 FORMULA_0003 0.0 8.0000 /end CHARACTERISTIC
/begin CHARACTERISTIC K_ED_UEXT_111219514.KLASSENINDEX "Auswahl der Fehlerklasse | EN: Fault code UEXT_111219514 - fault class selection (lamp / warning behaviour)" VALUE 0x70D58 TKW_VV_VV_UB 100.0 FORMULA_0003 0.0 8.0000 /end CHARACTERISTIC
/begin CHARACTERISTIC K_ED_UEXT_124_512.KLASSENINDEX "Auswahl der Fehlerklasse | EN: Fault code UEXT_124_512 - fault class selection (lamp / warning behaviour)" VALUE 0x70D72 TKW_VV_VV_UB 100.0 FORMULA_0003 0.0 8.0000 /end CHARACTERISTIC
/begin CHARACTERISTIC K_ED_TUMG_OBD.KLASSENINDEX "Auswahl der Fehlerklasse | EN: Fault code TUMG_OBD - fault class selection (lamp / warning behaviour) [V912: differs from V452 160E]" VALUE 0x70F12 TKW_VV_VV_UB 100.0 FORMULA_0003 0.0 8.0000 /end CHARACTERISTIC
/begin CHARACTERISTIC K_ED_V_DIREKT.KLASSENINDEX "Auswahl der Fehlerklasse | EN: Fault code V_DIREKT - fault class selection (lamp / warning behaviour)" VALUE 0x70F2C TKW_VV_VV_UB 100.0 FORMULA_0003 0.0 8.0000 /end CHARACTERISTIC
/begin CHARACTERISTIC K_ED_ZOELP1.KLASSENINDEX "Auswahl der Fehlerklasse | EN: Fault code ZOELP1 - fault class selection (lamp / warning behaviour)" VALUE 0x71592 TKW_VV_VV_UB 100.0 FORMULA_0003 0.0 8.0000 /end CHARACTERISTIC
/begin CHARACTERISTIC K_ED_ZOELP2.KLASSENINDEX "Auswahl der Fehlerklasse | EN: Fault code ZOELP2 - fault class selection (lamp / warning behaviour)" VALUE 0x715AC TKW_VV_VV_UB 100.0 FORMULA_0003 0.0 8.0000 /end CHARACTERISTIC
/begin CHARACTERISTIC K_ED_TUMG.KLASSENINDEX "Auswahl der Fehlerklasse | EN: Fault code TUMG - fault class selection (lamp / warning behaviour) [V912: differs from V452 160E]" VALUE 0x71732 TKW_VV_VV_UB 100.0 FORMULA_0003 0.0 8.0000 /end CHARACTERISTIC
/* ------------------ Abschnitt erzeugt aus fgr.dat ------------------ */
/begin CHARACTERISTIC K_FGR_EIN "FGR Einschalten 1: Ein, 0: Aus " VALUE 0x72964 TKW_VV_VV_UB 100.0 FORMULA_0327 0.0 1.0 /end CHARACTERISTIC
/begin CHARACTERISTIC K_FGR_FSP_EIN "FGR Fehlerspeicher Einschalten 1: Ein, 0: Aus  | EN: 0x0 Aus 0x1 Ein FGR Fehlerspeicher Einschalten 1: Ein, 0: Aus" VALUE 0x72965 TKW_VV_VV_UB 100.0 FORMULA_0327 0.0 1.0 /end CHARACTERISTIC
/begin CHARACTERISTIC K_FGR_STATE_AG "FGR STATE AG 1: Ein, 0: Aus  | EN: FGR STATE AG 1: Ein, 0: Aus 0x0 Aus 0x1 Ein" VALUE 0x72966 TKW_VV_VV_UB 100.0 FORMULA_0327 0.0 1.0 /end CHARACTERISTIC
/begin CHARACTERISTIC K_FGR_CFG_VORST "FGR Vorsteuerung 1: Ein, 0: Aus  | EN: 0x0 Aus 0x1 Ein FGR Vorsteuerung 1: Ein, 0: Aus" VALUE 0x72967 TKW_VV_VV_UB 100.0 FORMULA_0327 0.0 1.0 /end CHARACTERISTIC
/begin CHARACTERISTIC K_FGR_SMG_MCS "FGR Abschaltung durch SMG sperren | EN: 0x0 nicht sperren 0x1 sperren FGR Abschaltung durch SMG sperren" VALUE 0x72968 TKW_VV_VV_UB 100.0 FORMULA_0660 0.0 1.0 /end CHARACTERISTIC
/begin CHARACTERISTIC K_FGR_MARKE_CFG "Konfig Markenanzeige w�hrend Beschleunigung" VALUE 0x72969 TKW_VV_VV_UB 100.0 FORMULA_0661 0.0 1.0 /end CHARACTERISTIC
/begin CHARACTERISTIC K_FGR_CFG_V_MAX "Konfig FGR bis Vmax" VALUE 0x7296A TKW_VV_VV_UB 100.0 FORMULA_0662 0.0 1.0 /end CHARACTERISTIC
/begin CHARACTERISTIC K_FGR_MSW_T_MIN "Wartezeit f�r langes Dr�cken | EN: Wartezeit für langes Drücken" VALUE 0x7296B TKW_VV_VV_UB 100.0 FORMULA_0317 0.0 2.5500 /end CHARACTERISTIC
/begin CHARACTERISTIC K_FGR_TIP_T_MIN "Wartezeit f�r Entprellung Tipp | EN: Wartezeit für Entprellung Tipp" VALUE 0x7296C TKW_VV_VV_UB 100.0 FORMULA_0317 0.0 2.5500 /end CHARACTERISTIC
/begin CHARACTERISTIC K_FGR_STEP_T_MIN "Wartezeit f�r wiederholte Markenspr�nge | EN: Wartezeit für wiederholte Markensprünge" VALUE 0x7296D TKW_VV_VV_UB 100.0 FORMULA_0317 0.0 2.5500 /end CHARACTERISTIC
/begin CHARACTERISTIC K_FGR_T_AUS "Wartezeit bis Erkennung HUD aus | EN: Wait time until HUD-off is detected [s]" VALUE 0x7296E TKW_VV_VV_UB 100.0 FORMULA_0317 0.0 2.5500 /end CHARACTERISTIC
/begin CHARACTERISTIC K_FGR_V_DIF_MAX "Max Schwelle der Soll/Ist Regelabweichung | EN: Maximum threshold of setpoint/actual control error [km/h]" VALUE 0x72970 TKW_VV_VV_SW 100.0 FORMULA_0078 -360.0000 360.0000 FORMAT "%4.1" /end CHARACTERISTIC
/begin CHARACTERISTIC K_FGR_V_DIF_MIN "Min Schwelle der Soll/Ist Regelabweichung | EN: Minimum threshold of setpoint/actual control error [km/h]" VALUE 0x72972 TKW_VV_VV_SW 100.0 FORMULA_0078 -360.0000 360.0000 FORMAT "%4.1" /end CHARACTERISTIC
/begin CHARACTERISTIC K_FGR_T_UEBERHOL_MAX "Max Zeit bei �bertreten des FGR Eingriffs | EN: Maximum time when driver overrides cruise control [s]" VALUE 0x72974 TKW_VV_VV_UW 100.0 FORMULA_0021 0.0 655.0000 FORMAT "%5.2" /end CHARACTERISTIC
/begin CHARACTERISTIC K_FGR_T_STRICH "Zeit f�r HUD Anzeige Strich | EN: Time for HUD dash display [s]" VALUE 0x72976 TKW_VV_VV_UW 100.0 FORMULA_0021 0.0 655.0000 FORMAT "%5.2" /end CHARACTERISTIC
/begin CHARACTERISTIC K_FGR_T_CONSTF_RAMPE "Max Zeit bei �bertreten des FGR Eingriffs | EN: Maximum time when driver overrides cruise control [s]" VALUE 0x72978 TKW_VV_VV_UW 100.0 FORMULA_0021 0.0 655.0000 FORMAT "%5.2" /end CHARACTERISTIC
/begin CHARACTERISTIC K_FGR_V_SOLL_DIF_MAX "Max. Abweichung von Zielgeschw. bei �bertreten | EN: Maximum deviation from target speed when overridden [km/h]" VALUE 0x7297A TKW_VV_VV_SW 100.0 FORMULA_0078 -360.0000 360.0000 FORMAT "%4.1" /end CHARACTERISTIC
/begin CHARACTERISTIC K_FGR_V_SOLL_DIF_MIN "Min. Abweichung von Zielgeschw. bei �bertreten | EN: Minimum deviation from target speed when overridden [km/h]" VALUE 0x7297C TKW_VV_VV_SW 100.0 FORMULA_0078 -360.0000 360.0000 FORMAT "%4.1" /end CHARACTERISTIC
/begin CHARACTERISTIC K_FGR_V_SOLL_DIF_KONST "Konstante Abweichung von Zielgeschw. bei �bertreten | EN: Constant deviation from target speed when overridden [km/h]" VALUE 0x7297E TKW_VV_VV_SW 100.0 FORMULA_0078 -360.0000 360.0000 FORMAT "%4.1" /end CHARACTERISTIC
/begin CHARACTERISTIC K_FGR_V_SOLL_OFFSET "Konstante Abweichung vom Kombi | EN: Constant deviation from instrument cluster [km/h]" VALUE 0x72980 TKW_VV_VV_SB 100.0 FORMULA_0663 -5.0000 5.0000 /end CHARACTERISTIC
/begin CHARACTERISTIC K_FGR_V_SOLL_MAX_T "Max. Zeitdauer �ber max. Sollgeschwindigkeit | EN: Maximum time above maximum set speed [s]" VALUE 0x72982 TKW_VV_VV_UW 100.0 FORMULA_0021 0.0 655.0000 FORMAT "%5.2" /end CHARACTERISTIC
/begin CHARACTERISTIC K_FGR_DSC_MD_T "Max Zeitdauer eines DSC Momenteneingriff | EN: Maximum duration of a DSC torque intervention [s]" VALUE 0x72984 TKW_VV_VV_UW 100.0 FORMULA_0021 0.0 655.0000 FORMAT "%5.2" /end CHARACTERISTIC
/begin CHARACTERISTIC K_FGR_DSC_MD_BLS_T "Max Zeitdauer eines DSC Bremseneingriff | EN: Maximum duration of a DSC brake intervention [s]" VALUE 0x72986 TKW_VV_VV_UW 100.0 FORMULA_0021 0.0 655.0000 FORMAT "%5.2" /end CHARACTERISTIC
/begin CHARACTERISTIC K_FGR_DSC_BLS_T "Max Zeitdauer eines kombinierten DSC-Eingriffs | EN: Maximum duration of a combined DSC intervention [s]" VALUE 0x72988 TKW_VV_VV_UW 100.0 FORMULA_0021 0.0 655.0000 FORMAT "%5.2" /end CHARACTERISTIC
/begin CHARACTERISTIC K_FGR_V_IST_MIN "Min. Fahrzeuggeschwindigkeit | EN: Minimum vehicle speed [km/h]" VALUE 0x7298A TKW_VV_VV_SW 100.0 FORMULA_0078 -360.0000 360.0000 FORMAT "%4.1" /end CHARACTERISTIC
/begin CHARACTERISTIC K_FGR_V_TIP_INC_DEC "Tipp Fahrzeuggeschwindigkeit inc/dec | EN: Tip vehicle speed inc/dec [km/h]" VALUE 0x7298C TKW_VV_VV_SW 100.0 FORMULA_0078 -80.0000 360.0000 FORMAT "%4.1" /end CHARACTERISTIC
/begin CHARACTERISTIC K_FGR_V_SOLL_MAX_KMH "Max. Ziel-/Sollgeschwindigkeit in km/h | EN: Maximum target/set speed in km/h [km/h]" VALUE 0x7298E TKW_VV_VV_SW 100.0 FORMULA_0078 -360.0000 360.0000 FORMAT "%4.1" /end CHARACTERISTIC
/begin CHARACTERISTIC K_FGR_V_SOLL_MIN_KMH "Min. Ziel-/Sollgeschwindigkeit in km/h | EN: Minimum target/set speed in km/h [km/h]" VALUE 0x72990 TKW_VV_VV_SW 100.0 FORMULA_0078 -360.0000 360.0000 FORMAT "%4.1" /end CHARACTERISTIC
/begin CHARACTERISTIC K_FGR_V_SOLL_MAX_MPH "Max. Ziel-/Sollgeschwindigkeit in mph | EN: Maximum target/set speed in mph [mph]" VALUE 0x72992 TKW_VV_VV_SW 100.0 FORMULA_0664 -360.0000 360.0000 FORMAT "%4.1" /end CHARACTERISTIC
/begin CHARACTERISTIC K_FGR_V_SOLL_MIN_MPH "Min. Ziel-/Sollgeschwindigkeit in mph | EN: Minimum target/set speed in mph [mph]" VALUE 0x72994 TKW_VV_VV_SW 100.0 FORMULA_0664 -360.0000 360.0000 FORMAT "%4.1" /end CHARACTERISTIC
/begin CHARACTERISTIC K_FGR_V_DIF_MAX_AUFST "Max. Regelabweichung bevor Rampe wartet | EN: Max. Regelabweichung bevor Rampe wartet" VALUE 0x72996 TKW_VV_VV_SW 100.0 FORMULA_0078 -80.0000 360.0000 FORMAT "%4.1" /end CHARACTERISTIC
/begin CHARACTERISTIC K_FGR_V_DIF_MIN_AUFST "Min. Regelabweichung bevor Rampe wartet | EN: Min. Regelabweichung bevor Rampe wartet" VALUE 0x72998 TKW_VV_VV_SW 100.0 FORMULA_0078 -360.0000 360.0000 FORMAT "%4.1" /end CHARACTERISTIC
/begin CHARACTERISTIC K_FGR_FAK_V_MAX "Schwelle oberer Bereich | EN: Threshold, upper range [km/h]" VALUE 0x7299A TKW_VV_VV_SW 100.0 FORMULA_0078 -80.0000 360.0000 FORMAT "%4.1" /end CHARACTERISTIC
/begin CHARACTERISTIC K_FGR_FAK_V_MIN "Schwelle unterer Bereich | EN: Schwelle unterer Bereich" VALUE 0x7299C TKW_VV_VV_SW 100.0 FORMULA_0078 -80.0000 360.0000 FORMAT "%4.1" /end CHARACTERISTIC
/begin CHARACTERISTIC K_FGR_V_DIF_MIN_LL "Min. Reglerabweichung zur Ausl�sung SA | EN: Min. Reglerabweichung zur Auslösung SA" VALUE 0x7299E TKW_VV_VV_SW 100.0 FORMULA_0078 -360.0000 360.0000 FORMAT "%4.1" /end CHARACTERISTIC
/begin CHARACTERISTIC K_FGR_V_DIF_MAX_LL "Max. Reglerabweichung zur Ausl�sung SA | EN: Max. Reglerabweichung zur Auslösung SA" VALUE 0x729A0 TKW_VV_VV_SW 100.0 FORMULA_0078 -360.0000 360.0000 FORMAT "%4.1" /end CHARACTERISTIC
/begin CHARACTERISTIC K_FGR_FAK_V_SPORT "Wichtung Bereich Sport | EN: Wichtung Bereich Sport" VALUE 0x729A2 TKW_VV_VV_UB 100.0 FORMULA_0502 0.0 1.0000 /end CHARACTERISTIC
/begin CHARACTERISTIC K_FGR_FAK_V_NORMAL "Wichtung Bereich Normal | EN: Wichtung Bereich Normal" VALUE 0x729A3 TKW_VV_VV_UB 100.0 FORMULA_0502 0.0 1.0000 /end CHARACTERISTIC
/begin CHARACTERISTIC K_FGR_FAK_V_KOMFORT "Wichtung Bereich Komfort | EN: Wichtung Bereich Komfort" VALUE 0x729A4 TKW_VV_VV_UB 100.0 FORMULA_0502 0.0 1.0000 /end CHARACTERISTIC
/begin CHARACTERISTIC K_FGR_FAK_V_TIP "Wichtung Tippen | EN: Wichtung Tippen" VALUE 0x729A5 TKW_VV_VV_UB 100.0 FORMULA_0665 0.0 2.5500 /end CHARACTERISTIC
/begin CHARACTERISTIC K_FGR_AX_MAX "Max. Fahrzeugl�ngsbeschleunigung" VALUE 0x729A6 TKW_VV_VV_SW 100.0 FORMULA_0132 -20.0000 20.0000 FORMAT "%5.2" /end CHARACTERISTIC
/begin CHARACTERISTIC K_FGR_V_MAX "Vmax. Begrenzung | EN: Maximum speed limit [km/h]" VALUE 0x729A8 TKW_VV_VV_SW 100.0 FORMULA_0078 -80.0000 360.0000 FORMAT "%4.1" /end CHARACTERISTIC
/begin CHARACTERISTIC K_FGR_N_DIF_MAX "N Dif. max Begrenzung | EN: N Dif. max Begrenzung" VALUE 0x729AA TKW_VV_VV_SW 100.0 FORMULA_0006 0.0 10000.0000 /end CHARACTERISTIC
/begin CHARACTERISTIC K_FGR_N_DIF_DIAG_T "Max Zeitdauer eines DSC Bremseneingriff | EN: Max Zeitdauer eines DSC Bremseneingriff" VALUE 0x729AC TKW_VV_VV_UW 100.0 FORMULA_0021 0.0 655.0000 FORMAT "%5.2" /end CHARACTERISTIC
/begin CHARACTERISTIC K_FGR_V_SOLL_MAX_HYS "Vmax. Hysterese | EN: Maximum speed hysteresis [km/h]" VALUE 0x729AE TKW_VV_VV_SW 100.0 FORMULA_0078 -80.0000 360.0000 FORMAT "%4.1" /end CHARACTERISTIC
/begin CHARACTERISTIC K_FGR_N_MAX "Nmax. Begrenzung | EN: Maximum engine-speed limit [Upm]" VALUE 0x729B0 TKW_VV_VV_SW 100.0 FORMULA_0006 0.0 10000.0000 /end CHARACTERISTIC
/begin CHARACTERISTIC K_FGR_BESCHL_WA_SPORT "Sollbeschl. bei Wiederaufn. im Sportmodus | EN: Target acceleration on resume, Sport mode [m/(s*s)]" VALUE 0x729B2 TKW_VV_VV_SW 100.0 FORMULA_0132 -20.0000 20.0000 FORMAT "%5.2" /end CHARACTERISTIC
/begin CHARACTERISTIC K_FGR_BESCHL_SPORT "Sollbeschl. im Sportmodus | EN: Target acceleration in Sport mode [m/(s*s)]" VALUE 0x729B4 TKW_VV_VV_SW 100.0 FORMULA_0132 -20.0000 20.0000 FORMAT "%5.2" /end CHARACTERISTIC
/begin CHARACTERISTIC K_FGR_BESCHL_WA_KOMFORT "Sollbeschl. bei Wiederaufn. im Komfortmodus | EN: Target acceleration on resume, Comfort mode [m/(s*s)]" VALUE 0x729B6 TKW_VV_VV_SW 100.0 FORMULA_0132 -20.0000 20.0000 FORMAT "%5.2" /end CHARACTERISTIC
/begin CHARACTERISTIC K_FGR_BESCHL_KOMFORT "Sollbeschl. im Komfortmodus | EN: Target acceleration in Comfort mode [m/(s*s)]" VALUE 0x729B8 TKW_VV_VV_SW 100.0 FORMULA_0132 -20.0000 20.0000 FORMAT "%5.2" /end CHARACTERISTIC
/begin CHARACTERISTIC K_FGR_BESCHL_WA_NORMAL "Sollbeschl. bei Wiederaufn. im Normalmodus | EN: Target acceleration on resume, Normal mode [m/(s*s)]" VALUE 0x729BA TKW_VV_VV_SW 100.0 FORMULA_0132 -20.0000 20.0000 FORMAT "%5.2" /end CHARACTERISTIC
/begin CHARACTERISTIC K_FGR_BESCHL_NORMAL "Sollbeschl. im Normalmodus | EN: Target acceleration in Normal mode [m/(s*s)]" VALUE 0x729BC TKW_VV_VV_SW 100.0 FORMULA_0132 -20.0000 20.0000 FORMAT "%5.2" /end CHARACTERISTIC
/begin CHARACTERISTIC K_FGR_BESCHL_TIP "Sollbeschl. bei Tipp | EN: Target acceleration on tip [m/(s*s)]" VALUE 0x729BE TKW_VV_VV_SW 100.0 FORMULA_0132 -20.0000 20.0000 FORMAT "%5.2" /end CHARACTERISTIC
/begin CHARACTERISTIC K_FGR_VERZ "Sollverz�gerung beim Verz�gern | EN: Target deceleration when decelerating [m/(s*s)]" VALUE 0x729C0 TKW_VV_VV_SW 100.0 FORMULA_0132 -20.0000 20.0000 FORMAT "%5.2" /end CHARACTERISTIC
/begin CHARACTERISTIC K_FGR_VERZ_TIP "Sollverz�gerung bei Tipp | EN: Target deceleration on tip [m/(s*s)]" VALUE 0x729C2 TKW_VV_VV_SW 100.0 FORMULA_0132 -20.0000 20.0000 FORMAT "%5.2" /end CHARACTERISTIC
/begin CHARACTERISTIC K_FGR_V_FEHLER_T "Haltezeit f�r Signalfehler vor Abschaltung | EN: Hold time for signal fault before switch-off [s]" VALUE 0x729C4 TKW_VV_VV_UB 100.0 FORMULA_0317 0.0 2.5500 /end CHARACTERISTIC
/begin CHARACTERISTIC K_FGR_V_IST_TAU "Filterkonstante f�r Umschaltung Istgeschw. | EN: Filter constant for switching actual speed source [s]" VALUE 0x729C6 TKW_VV_VV_UW 100.0 FORMULA_0021 0.0 655.0000 FORMAT "%5.2" /end CHARACTERISTIC
/begin CHARACTERISTIC K_FGR_CFG_V_IST "Auswahl V-Ist: Fahrzeuggeschw. oder Anzeigegeschw. " VALUE 0x729C8 TKW_VV_VV_UB 100.0 FORMULA_0666 0.0 1.0 /end CHARACTERISTIC
/begin CHARACTERISTIC K_FGR_AX_TAU "Filterkonstante Beschleunigung | EN: Filter constant, acceleration [s]" VALUE 0x729C9 TKW_VV_VV_UB 100.0 FORMULA_0462 0.0101 2.5600 /end CHARACTERISTIC
/begin CHARACTERISTIC K_FGR_MD_FW_LL_HYS "Hysterese Minimalschwelle  | EN: Hysteresis, minimum threshold [%]" VALUE 0x729CA TKW_VV_VV_SW 100.0 FORMULA_0022 -200.0000 200.0000 FORMAT "%5.2" /end CHARACTERISTIC
/begin CHARACTERISTIC K_FGR_MD_FW_HYS "Hysterese �berholerkennung  | EN: Hysteresis for overtaking detection [%]" VALUE 0x729CC TKW_VV_VV_SW 100.0 FORMULA_0022 -200.0000 200.0000 FORMAT "%5.2" /end CHARACTERISTIC
/begin CHARACTERISTIC K_FGR_MD_DELTA "�nderungsbegrenzung Reglereingriff | EN: Rate limit on controller intervention [%/sek]" VALUE 0x729CE TKW_VV_VV_UW 100.0 FORMULA_0667 0.0 400.0000 FORMAT "%7.4" /end CHARACTERISTIC
/begin CHARACTERISTIC K_FGR_A1 "Reglerkoeffizient a1 | EN: Controller coefficient a1" VALUE 0x729D0 TKW_VV_VV_UB 100.0 FORMULA_0668 0.0 10.0000 /end CHARACTERISTIC
/begin CHARACTERISTIC K_FGR_T_MIN_SA "min. Wartezeit vor SA bei Konstantfahrt | EN: Minimum wait time before switch-off during steady cruising [sek]" VALUE 0x729D2 TKW_VV_VV_UW 100.0 FORMULA_0669 0.0 60.0000 FORMAT "%5.2" /end CHARACTERISTIC
/begin CHARACTERISTIC K_FGR_V_DIF_MIN_UEBERHOL "Schwelle f�r Wegbeschleunigung  | EN: Threshold for pull-away acceleration [km/h]" VALUE 0x729D4 TKW_VV_VV_SW 100.0 FORMULA_0078 -360.0000 360.0000 FORMAT "%4.1" /end CHARACTERISTIC
/begin CHARACTERISTIC K_FGR_STUFE_MPH "Schrittweite Stufe in MPH  | EN: Step size in mph [mph]" VALUE 0x729D6 TKW_VV_VV_SW 100.0 FORMULA_0664 -360.0000 360.0000 FORMAT "%4.1" /end CHARACTERISTIC
/begin CHARACTERISTIC K_FGR_STUFE_KMH "Schrittweite Stufe in KM/H  | EN: Step size in km/h [km/h]" VALUE 0x729D8 TKW_VV_VV_SW 100.0 FORMULA_0078 -360.0000 360.0000 FORMAT "%4.1" /end CHARACTERISTIC
/begin CHARACTERISTIC K_FGR_V_DIAG "Max. Abweichung V_RAD_HR und V_DIREKT  | EN: Maximum deviation V_RAD_HR vs V_DIREKT [km/h]" VALUE 0x729DA TKW_VV_VV_SW 100.0 FORMULA_0078 -360.0000 360.0000 FORMAT "%4.1" /end CHARACTERISTIC
/begin CHARACTERISTIC K_FGR_V_DIAG_T "Wartezeit f�r V_RAD_HR/V_DIREKT Differenz Fehler | EN: Wait time for V_RAD_HR/V_DIREKT difference fault [s]" VALUE 0x729DC TKW_VV_VV_UB 100.0 FORMULA_0317 0.0 2.5500 /end CHARACTERISTIC
/begin CHARACTERISTIC K_FGR_VAHA_DIAG_T "Wartezeit f�r V_VORNE/V_HINTEN Differenz Fehler | EN: Wait time for front/rear speed difference fault [s]" VALUE 0x729DD TKW_VV_VV_UB 100.0 FORMULA_0317 0.0 2.5500 /end CHARACTERISTIC
/begin CHARACTERISTIC KL_FGR_VERZ_WA "Sollverz�gerung bei Wiederaufnahme | EN: Target deceleration on resume" CURVE 0x729DE TKL_SW_VV_SW 100.0 FORMULA_0132 -20.0000 20.0000 /begin AXIS_DESCR STD_AXIS FORMULA_0006 4 0.0 10000.0000 /end AXIS_DESCR FORMAT "%5.2" /end CHARACTERISTIC
/begin CHARACTERISTIC KL_FGR_MD_RAMPE_DELTA "Schrittweite der Absteuerrampe | EN: Step size of the ramp-out" CURVE 0x729F0 TKL_SW_VV_UW 100.0 FORMULA_0667 0.0 4000.0000 /begin AXIS_DESCR STD_AXIS FORMULA_0006 6 0.0 10000.0000 /end AXIS_DESCR FORMAT "%7.4" /end CHARACTERISTIC
/begin CHARACTERISTIC KL_FGR_FAK_V_TIP "Wichtungsfaktor V-Tipp | EN: Weighting factor, speed tip (+/-)" CURVE 0x72A0A TKL_SW_VV_UB 100.0 FORMULA_0654 0.0 1.0000 /begin AXIS_DESCR STD_AXIS v FORMULA_0078 6 -360.0000 360.0000 FORMAT "%4.1" /end AXIS_DESCR /end CHARACTERISTIC
/begin CHARACTERISTIC KL_FGR_FAK_T_WA "Zeitabh�nige Wichtungsfaktoren f�r Wiederaufnahme | EN: Time-dependent weighting factors for resume" CURVE 0x72A1E TKL_UB_VV_UB 100.0 FORMULA_0655 0.0 1.9921 /begin AXIS_DESCR STD_AXIS Zeit FORMULA_0670 6 0.0 1.9921 /end AXIS_DESCR /end CHARACTERISTIC
/begin CHARACTERISTIC KL_FGR_FAK_T_BESCHL "Zeitabh�nige Wichtungsfaktoren f�r Beschleunigung | EN: Time-dependent weighting factors for acceleration" CURVE 0x72A2C TKL_UB_VV_UB 100.0 FORMULA_0655 0.0 1.9921 /begin AXIS_DESCR STD_AXIS Zeit FORMULA_0670 6 0.0 1.9921 /end AXIS_DESCR /end CHARACTERISTIC
/begin CHARACTERISTIC KL_FGR_FAK_T_VERZ "Zeitabh�nige Wichtungsfaktoren f�r Verz�gerung | EN: Time-dependent weighting factors for deceleration" CURVE 0x72A3A TKL_UB_VV_UB 100.0 FORMULA_0655 0.0 1.9921 /begin AXIS_DESCR STD_AXIS Zeit FORMULA_0670 6 0.0 1.9921 /end AXIS_DESCR /end CHARACTERISTIC
/begin CHARACTERISTIC KL_FGR_KR_FAK "Wichtung Regelverst�rkung | EN: Weighting of controller gain" CURVE 0x72A48 TKL_SW_VV_UB 100.0 FORMULA_0671 0.0 25.5000 /begin AXIS_DESCR STD_AXIS v FORMULA_0078 6 -360.0000 360.0000 FORMAT "%4.1" /end AXIS_DESCR /end CHARACTERISTIC
/begin CHARACTERISTIC KL_FGR_TN_FAK "Wichtung Nachstellzeit | EN: Weighting of integral time" CURVE 0x72A5C TKL_SW_VV_UB 100.0 FORMULA_0671 0.0 25.5000 /begin AXIS_DESCR STD_AXIS v FORMULA_0078 6 -360.0000 360.0000 FORMAT "%4.1" /end AXIS_DESCR /end CHARACTERISTIC
/begin CHARACTERISTIC KL_FGR_TV_FAK "Wichtung Vorhaltezeit | EN: Weighting of derivative time" CURVE 0x72A70 TKL_SW_VV_UB 100.0 FORMULA_0671 0.0 25.5000 /begin AXIS_DESCR STD_AXIS v FORMULA_0078 6 -360.0000 360.0000 FORMAT "%4.1" /end AXIS_DESCR /end CHARACTERISTIC
/begin CHARACTERISTIC KL_FGR_MD_FW_LL "Minimalschwelle zur Vermeidung SA-Ausl�sung | EN: Minimum threshold to avoid cruise switch-off" CURVE 0x72A84 TKL_SW_VV_UB 100.0 FORMULA_0672 0.0 25.5000 /begin AXIS_DESCR STD_AXIS FORMULA_0006 6 0.0 10000.0000 /end AXIS_DESCR /end CHARACTERISTIC
/begin CHARACTERISTIC KL_FGR_V_FIL_A1 "Filterkonstante A1 f�r V Filter | EN: Filter constant A1 for speed filter" CURVE 0x72A98 TKL_UW_VV_SW 100.0 FORMULA_0295 -2.0000 1.9999 /begin AXIS_DESCR STD_AXIS t FORMULA_0021 7 0.0 655.3500 FORMAT "%5.2" /end AXIS_DESCR FORMAT "%7.4" /end CHARACTERISTIC
/begin CHARACTERISTIC KL_FGR_V_FIL_B1 "Filterkonstante B1 f�r V Filter | EN: Filter constant B1 for speed filter" CURVE 0x72AB6 TKL_UW_VV_UW 100.0 FORMULA_0658 0.0 0.2499 /begin AXIS_DESCR STD_AXIS t FORMULA_0021 7 0.0 655.3500 FORMAT "%5.2" /end AXIS_DESCR FORMAT "%7.4" /end CHARACTERISTIC
/begin CHARACTERISTIC KL_FGR_V_FIL_B2 "Filterkonstante B2 f�r V Filter | EN: Filter constant B2 for speed filter" CURVE 0x72AD4 TKL_UW_VV_UW 100.0 FORMULA_0658 0.0 0.2499 /begin AXIS_DESCR STD_AXIS t FORMULA_0021 7 0.0 655.3500 FORMAT "%5.2" /end AXIS_DESCR FORMAT "%7.4" /end CHARACTERISTIC
/begin CHARACTERISTIC KL_FGR_KOEFF_WICHT "Regler Koeffizienten Wichtung | EN: Controller coefficient weighting" CURVE 0x72AF2 TKL_UW_VV_UW 100.0 FORMULA_0656 0.0 655.3500 /begin AXIS_DESCR STD_AXIS t FORMULA_0021 4 0.0 655.3500 FORMAT "%5.2" /end AXIS_DESCR FORMAT "%6.3" /end CHARACTERISTIC
/begin CHARACTERISTIC KL_FGR_VAHA_DIAG "Differenz Geschw. VA/HA  | EN: Speed difference front/rear axle" CURVE 0x72B04 TKL_SW_VV_SW 100.0 FORMULA_0078 0.0 360.0000 /begin AXIS_DESCR STD_AXIS v FORMULA_0078 4 -360.0000 360.0000 FORMAT "%4.1" /end AXIS_DESCR FORMAT "%4.1" /end CHARACTERISTIC
/begin CHARACTERISTIC KL_FGR_V_SA_SPERRE "Geschwindigkeitsgrenze f�r SA Sperre | EN: Speed limit for cruise switch-off lock" CURVE 0x72B16 TKL_SW_VV_SW 100.0 FORMULA_0078 -360.0000 360.0000 /begin AXIS_DESCR STD_AXIS FORMULA_0486 8 -1.0000 10.0000 /end AXIS_DESCR FORMAT "%4.1" /end CHARACTERISTIC
/begin CHARACTERISTIC KF_FGR_VORST "PID-Regler | EN: PID controller" MAP 0x72B38 TKF_SW_SW_UW 100.0 FORMULA_0450 0.0 100.0000
 /begin AXIS_DESCR STD_AXIS Geschwindigkeit FORMULA_0078 12 -360.0000 360.0000 FORMAT "%4.1" /end AXIS_DESCR
 /begin AXIS_DESCR STD_AXIS FORMULA_0486 8 -1.0000 10.0000 /end AXIS_DESCR
 FORMAT "%6.3" /end CHARACTERISTIC
/begin CHARACTERISTIC KF_FGR_VORST_UP "PID-Regler | EN: PID controller" MAP 0x72C22 TKF_SW_SW_UW 100.0 FORMULA_0450 0.0 100.0000
 /begin AXIS_DESCR STD_AXIS Geschwindigkeit FORMULA_0078 12 -360.0000 360.0000 FORMAT "%4.1" /end AXIS_DESCR
 /begin AXIS_DESCR STD_AXIS FORMULA_0486 8 -1.0000 10.0000 /end AXIS_DESCR
 FORMAT "%6.3" /end CHARACTERISTIC
/begin CHARACTERISTIC KF_FGR_KR "Reglerverst�rkung | EN: Controller gain" MAP 0x72D0C TKF_SW_SW_UW 100.0 FORMULA_0673 0.0 100.0000
 /begin AXIS_DESCR STD_AXIS Geschwindigkeit FORMULA_0078 12 -360.0000 360.0000 FORMAT "%4.1" /end AXIS_DESCR
 /begin AXIS_DESCR STD_AXIS FORMULA_0486 8 -1.0000 10.0000 /end AXIS_DESCR
 FORMAT "%6.3" /end CHARACTERISTIC
/begin CHARACTERISTIC KF_FGR_KR_CONST "Reglerverst�rkung Konstantfahrt | EN: Controller gain, steady cruising" MAP 0x72DF6 TKF_SW_SW_UW 100.0 FORMULA_0673 0.0 100.0000
 /begin AXIS_DESCR STD_AXIS Geschwindigkeit FORMULA_0078 12 -360.0000 360.0000 FORMAT "%4.1" /end AXIS_DESCR
 /begin AXIS_DESCR STD_AXIS FORMULA_0486 8 -1.0000 10.0000 /end AXIS_DESCR
 FORMAT "%6.3" /end CHARACTERISTIC
/begin CHARACTERISTIC KF_FGR_TN "Nachstellzeit | EN: Integral (reset) time" MAP 0x72EE0 TKF_SW_SW_UW 100.0 FORMULA_0674 0.0 60.0000
 /begin AXIS_DESCR STD_AXIS Geschwindigkeit FORMULA_0078 12 -360.0000 360.0000 FORMAT "%4.1" /end AXIS_DESCR
 /begin AXIS_DESCR STD_AXIS FORMULA_0486 8 -1.0000 10.0000 /end AXIS_DESCR
 FORMAT "%6.3" /end CHARACTERISTIC
/begin CHARACTERISTIC KF_FGR_TN_CONST "Nachstellzeit Konstantfahrt | EN: Integral time, steady cruising" MAP 0x72FCA TKF_SW_SW_UW 100.0 FORMULA_0674 0.0 60.0000
 /begin AXIS_DESCR STD_AXIS Geschwindigkeit FORMULA_0078 12 -360.0000 360.0000 FORMAT "%4.1" /end AXIS_DESCR
 /begin AXIS_DESCR STD_AXIS FORMULA_0486 8 -1.0000 10.0000 /end AXIS_DESCR
 FORMAT "%6.3" /end CHARACTERISTIC
/begin CHARACTERISTIC KF_FGR_TV "Vorhaltezeit | EN: Derivative time" MAP 0x730B4 TKF_SW_SW_UW 100.0 FORMULA_0674 0.0 60.0000
 /begin AXIS_DESCR STD_AXIS Geschwindigkeit FORMULA_0078 12 -360.0000 360.0000 FORMAT "%4.1" /end AXIS_DESCR
 /begin AXIS_DESCR STD_AXIS FORMULA_0486 8 -1.0000 10.0000 /end AXIS_DESCR
 FORMAT "%6.3" /end CHARACTERISTIC
/begin CHARACTERISTIC KF_FGR_TV_CONST "Vorhaltezeit Konstantfahrt | EN: Derivative time, steady cruising" MAP 0x7319E TKF_SW_SW_UW 100.0 FORMULA_0674 0.0 60.0000
 /begin AXIS_DESCR STD_AXIS Geschwindigkeit FORMULA_0078 12 -360.0000 360.0000 FORMAT "%4.1" /end AXIS_DESCR
 /begin AXIS_DESCR STD_AXIS FORMULA_0486 8 -1.0000 10.0000 /end AXIS_DESCR
 FORMAT "%6.3" /end CHARACTERISTIC
/begin CHARACTERISTIC KF_FGR_FAK_V_WA "Wichtungsfaktor V-Wiederaufnahme | EN: Weighting factor, speed on resume" MAP 0x73288 TKF_SW_SW_UB 100.0 FORMULA_0654 0.0 1.0000 /begin AXIS_DESCR STD_AXIS v FORMULA_0078 6 -360.0000 360.0000 FORMAT "%4.1" /end AXIS_DESCR /begin AXIS_DESCR STD_AXIS md_rel FORMULA_0001 6 0.0 100.0000 FORMAT "%4.1" /end AXIS_DESCR /end CHARACTERISTIC
/begin CHARACTERISTIC K_FGR_V_SOLL_MIN_KMH_E2 "E2 Min. Ziel-/Sollgeschwindigkeit in km/h | EN: E2 Min. Ziel-/Sollgeschwindigkeit in km/h" VALUE 0x7A538 TKW_VV_VV_SW 100.0 FORMULA_0078 -360.0000 360.0000 FORMAT "%4.1" /end CHARACTERISTIC
/begin CHARACTERISTIC K_FGR_V_SOLL_MIN_MPH_E2 "E2 Min. Ziel-/Sollgeschwindigkeit in mph | EN: E2 Min. Ziel-/Sollgeschwindigkeit in mph" VALUE 0x7A53A TKW_VV_VV_SW 100.0 FORMULA_0664 -360.0000 360.0000 FORMAT "%4.1" /end CHARACTERISTIC
/begin CHARACTERISTIC K_FGR_T_FEHLER_E2 "Wartezeit f�r Ebene 2 Fehlermeldung | EN: Wartezeit für Ebene 2 Fehlermeldung" VALUE 0x7A53C TKW_VV_VV_UB 100.0 FORMULA_0501 0.0 25.5000 /end CHARACTERISTIC
/* ------------------ Abschnitt erzeugt aus fr.dat ------------------ */
/begin CHARACTERISTIC K_FR_CFG "Konfiguration | EN: Konfiguration" VALUE 0x732C6 TKW_VV_VV_UB 100.0 FORMULA_0678 0.0 255.0 /end CHARACTERISTIC
/begin CHARACTERISTIC K_FR_DI_ENTDR "Schrittweite bei DK entdrosselt" VALUE 0x732C8 TKW_VV_VV_SW 100.0 FORMULA_0677 0.0 0.5000 FORMAT "%7.4" /end CHARACTERISTIC
/begin CHARACTERISTIC K_FR_EDK_DIFF "max. Abweichung WDK Soll/Ist fuer FR-Freigabe | EN: Maximum setpoint/actual difference [%]" VALUE 0x732CA TKW_VV_VV_SW 100.0 FORMULA_0001 -10.0000 120.0000 FORMAT "%4.1" /end CHARACTERISTIC
/begin CHARACTERISTIC K_FR_DRREL_MAX "drrel-Schwelle zum Einfrieren FR-Regler" VALUE 0x732CC TKW_VV_VV_SW 100.0 FORMULA_0115 0.0 199.9938 FORMAT "%5.2" /end CHARACTERISTIC
/begin CHARACTERISTIC K_FR_IMIN "Minimaler I-Anteils | EN: Minimum integral share" VALUE 0x732CE TKW_VV_VV_SW 100.0 FORMULA_0024 -0.5000 0.0 FORMAT "%7.4" /end CHARACTERISTIC
/begin CHARACTERISTIC K_FR_IMAX "Maximaler I-Anteils | EN: Maximum integral share" VALUE 0x732D0 TKW_VV_VV_SW 100.0 FORMULA_0024 0.0 0.5000 FORMAT "%7.4" /end CHARACTERISTIC
/begin CHARACTERISTIC K_FR_ADAPT_SCHW_1of8_ "Adaptionsschwelle" VALUE 0x732D2 TKW_VV_VV_SW 100.0 FORMULA_0112 -100.0000 1400.0000 FORMAT "%4.1" /end CHARACTERISTIC
/begin CHARACTERISTIC K_FR_ADAPT_SCHW_2of8_ "Adaptionsschwelle" VALUE 0x732D4 TKW_VV_VV_SW 100.0 FORMULA_0112 -100.0000 1400.0000 FORMAT "%4.1" /end CHARACTERISTIC
/begin CHARACTERISTIC K_FR_ADAPT_SCHW_3of8_ "Adaptionsschwelle" VALUE 0x732D6 TKW_VV_VV_SW 100.0 FORMULA_0112 -100.0000 1400.0000 FORMAT "%4.1" /end CHARACTERISTIC
/begin CHARACTERISTIC K_FR_ADAPT_SCHW_4of8_ "Adaptionsschwelle" VALUE 0x732D8 TKW_VV_VV_SW 100.0 FORMULA_0112 -100.0000 1400.0000 FORMAT "%4.1" /end CHARACTERISTIC
/begin CHARACTERISTIC K_FR_ADAPT_SCHW_5of8_ "Adaptionsschwelle" VALUE 0x732DA TKW_VV_VV_SW 100.0 FORMULA_0112 -100.0000 1400.0000 FORMAT "%4.1" /end CHARACTERISTIC
/begin CHARACTERISTIC K_FR_ADAPT_SCHW_6of8_ "Adaptionsschwelle" VALUE 0x732DC TKW_VV_VV_SW 100.0 FORMULA_0112 -100.0000 1400.0000 FORMAT "%4.1" /end CHARACTERISTIC
/begin CHARACTERISTIC K_FR_ADAPT_SCHW_7of8_ "Adaptionsschwelle" VALUE 0x732DE TKW_VV_VV_SW 100.0 FORMULA_0112 -100.0000 1400.0000 FORMAT "%4.1" /end CHARACTERISTIC
/begin CHARACTERISTIC K_FR_ADAPT_SCHW_8of8_ "Adaptionsschwelle" VALUE 0x732E0 TKW_VV_VV_SW 100.0 FORMULA_0112 -100.0000 1400.0000 FORMAT "%4.1" /end CHARACTERISTIC
/begin CHARACTERISTIC K_FR_ADAPT_TAU "Adaptions-Tau" VALUE 0x732E2 TKW_VV_VV_UB 100.0 FORMULA_0679 0.1004 25.6000 /end CHARACTERISTIC
/begin CHARACTERISTIC K_FR_START_DELAY "Verzoegerung nach Start | EN: Delay after start [s]" VALUE 0x732E4 TKW_VV_VV_UW 100.0 FORMULA_0021 0.0 655.0000 FORMAT "%5.2" /end CHARACTERISTIC
/begin CHARACTERISTIC K_FR_EINGER_SCHW "Schwelle Eingeregelt | EN: Threshold for settled [%]" VALUE 0x732E6 TKW_VV_VV_SW 100.0 FORMULA_0001 0.0 100.0000 FORMAT "%4.1" /end CHARACTERISTIC
/begin CHARACTERISTIC K_FR_EINGER_HYS "Schwelle Eingeregelt | EN: Threshold for settled [%]" VALUE 0x732E8 TKW_VV_VV_SW 100.0 FORMULA_0001 0.0 100.0000 FORMAT "%4.1" /end CHARACTERISTIC
/begin CHARACTERISTIC KL_FR_IANT "Schrittweite I-Anteil | EN: Integral step size" CURVE 0x732EA TKL_SW_VV_SW 100.0 FORMULA_0677 -0.5000 0.5000
 /begin AXIS_DESCR STD_AXIS rf_delta FORMULA_0676 8 -1.0000 1.0000 FORMAT "%7.4" /end AXIS_DESCR
 FORMAT "%7.4" /end CHARACTERISTIC
/begin CHARACTERISTIC KL_FR_DRREL_MAX_N "drrel-Schwelle zum Einfrieren FR-Regler" CURVE 0x7330C TKL_SW_VV_SW 100.0 FORMULA_0115 0.0 199.9938 /begin AXIS_DESCR STD_AXIS FORMULA_0006 6 0.0 10000.0000 /end AXIS_DESCR FORMAT "%5.2" /end CHARACTERISTIC
/begin CHARACTERISTIC KF_FR_RF_DELTA_REL_HYS "Abschaltschwelle ueber Regeldifferenz | EN: Switch-off threshold on control error" MAP 0x73326 TKF_SW_SW_SW 100.0 FORMULA_0001 0.0 100.0000 /begin AXIS_DESCR STD_AXIS FORMULA_0006 4 0.0 10000.0000 /end AXIS_DESCR /begin AXIS_DESCR STD_AXIS rf FORMULA_0007 4 0.0 2.0000 FORMAT "%6.3" /end AXIS_DESCR FORMAT "%4.1" /end CHARACTERISTIC
/* ------------------ Abschnitt erzeugt aus fra.dat ------------------ */
/begin CHARACTERISTIC K_FRA_CFG "Konfiguration" VALUE 0x73358 TKW_VV_VV_UB 100.0 FORMULA_0682 0.0 255.0 /end CHARACTERISTIC
/begin CHARACTERISTIC K_FRA_WAIT "Wartezeit" VALUE 0x73359 TKW_VV_VV_UB 100.0 FORMULA_0232 1.0000 255.0000 /end CHARACTERISTIC
/begin CHARACTERISTIC K_FRA_TMOT_SCHW "min. Temperaturschwelle" VALUE 0x7335A TKW_VV_VV_SW 100.0 FORMULA_0023 -50.0000 170.0000 FORMAT "%4.1" /end CHARACTERISTIC
/begin CHARACTERISTIC K_FRA_RF_MAX "max. rf-Schwelle" VALUE 0x7335C TKW_VV_VV_SW 100.0 FORMULA_0007 0.0 2.0000 FORMAT "%6.3" /end CHARACTERISTIC
/begin CHARACTERISTIC K_FRA_FR_I_REG_SCHW "Schwelle I-Anteil (FR aktiv)" VALUE 0x7335E TKW_VV_VV_SW 100.0 FORMULA_0024 0.0 0.5000 FORMAT "%7.4" /end CHARACTERISTIC
/begin CHARACTERISTIC K_FRA_RF_DELTA_SCHW "Schwelle Regeldifferenz (FR aus)" VALUE 0x73360 TKW_VV_VV_SW 100.0 FORMULA_0007 0.0 2.0000 FORMAT "%6.3" /end CHARACTERISTIC
/begin CHARACTERISTIC K_FRA_AQ_DELTA_SLOW "Adaptionsschritt - Langsam" VALUE 0x73362 TKW_VV_VV_SW 100.0 FORMULA_0422 0.0 50.0000 FORMAT "%5.2" /end CHARACTERISTIC
/begin CHARACTERISTIC K_FRA_AQ_DELTA_FAST "Adaptionsschritt - Schnell" VALUE 0x73364 TKW_VV_VV_SW 100.0 FORMULA_0422 0.0 50.0000 FORMAT "%5.2" /end CHARACTERISTIC
/begin CHARACTERISTIC K_FRA_AQ_MAX_SLOW "Aenderung pro Adaptionszyklus - Langsam" VALUE 0x73366 TKW_VV_VV_SW 100.0 FORMULA_0422 0.0 50.0000 FORMAT "%5.2" /end CHARACTERISTIC
/begin CHARACTERISTIC K_FRA_AQ_MAX_FAST "Zunahme pro Adaptionszyklus - Schnell" VALUE 0x73368 TKW_VV_VV_SW 100.0 FORMULA_0422 0.0 50.0000 FORMAT "%5.2" /end CHARACTERISTIC
/begin CHARACTERISTIC K_FRA_AQ_ADAPT_MIN "min. Adaptionswert" VALUE 0x7336A TKW_VV_VV_SW 100.0 FORMULA_0422 -50.0000 0.0 FORMAT "%5.2" /end CHARACTERISTIC
/begin CHARACTERISTIC K_FRA_AQ_ADAPT_MAX "max. Adaptionswert" VALUE 0x7336C TKW_VV_VV_SW 100.0 FORMULA_0422 0.0 50.0000 FORMAT "%5.2" /end CHARACTERISTIC
/begin CHARACTERISTIC K_FRA_GRUNDLECKLUFT "Grundleckluft" VALUE 0x7336E TKW_VV_VV_SW 100.0 FORMULA_0147 -100.0000 0.0 FORMAT "%4.1" /end CHARACTERISTIC
/begin CHARACTERISTIC KL_FRA_XSI_PSAU "Korrekturwert fuer Leckluft" CURVE 0x73370 TKL_SW_VV_UW 100.0 FORMULA_0075 0.0 4.0000
 /begin AXIS_DESCR STD_AXIS psau_rel FORMULA_0115 8 0.0 120.0000 FORMAT "%5.2" /end AXIS_DESCR
 FORMAT "%6.3" /end CHARACTERISTIC
/* ------------------ Abschnitt erzeugt aus gang.dat ------------------ */
/begin CHARACTERISTIC K_GANG_N_VERH_MIN "Uebersetzungsverhaeltnis Minimum | EN: Minimum gear ratio" VALUE 0x73392 TKW_VV_VV_SW 100.0 FORMULA_0075 -10.0000 10.0000 FORMAT "%6.3" /end CHARACTERISTIC
/begin CHARACTERISTIC K_GANG_N_VERH_MAX "Uebersetzungsverhaeltnis Maximum | EN: Maximum gear ratio" VALUE 0x73394 TKW_VV_VV_SW 100.0 FORMULA_0075 -10.0000 10.0000 FORMAT "%6.3" /end CHARACTERISTIC
/begin CHARACTERISTIC K_GANG_I_RW_SMG "Uebersetzungsverhaeltnis Rueckwaertsgang SMG | EN: Reverse gear ratio, SMG" VALUE 0x73396 TKW_VV_VV_SW 100.0 FORMULA_0075 -10.0000 10.0000 FORMAT "%6.3" /end CHARACTERISTIC
/begin CHARACTERISTIC K_GANG_I_RW_HS "Uebersetzungsverhaeltnis Rueckwaertsgang Handschalter | EN: Reverse gear ratio, manual gearbox" VALUE 0x73398 TKW_VV_VV_SW 100.0 FORMULA_0075 -10.0000 10.0000 FORMAT "%6.3" /end CHARACTERISTIC
/begin CHARACTERISTIC K_GANG_I_HA_ADAPT_GANG_MIN_HS "minimaler Gang Adaption Hinterachse | EN: minimaler Gang Adaption Hinterachse" VALUE 0x7339A TKW_VV_VV_SB 100.0 FORMULA_0318 -1.0000 10.0000 /end CHARACTERISTIC
/begin CHARACTERISTIC K_GANG_I_HA_ADAPT_GANG_MAX_HS "maximaler Gang Adaption Hinterachse | EN: maximaler Gang Adaption Hinterachse" VALUE 0x7339B TKW_VV_VV_SB 100.0 FORMULA_0318 -1.0000 10.0000 /end CHARACTERISTIC
/begin CHARACTERISTIC K_GANG_I_HA_ADAPT_MD_MIN_HS "minimales Kupplungsmoment Adaption Hinterachse | EN: minimales Kupplungsmo-ment Adaption Hinterachse" VALUE 0x7339C TKW_VV_VV_SW 100.0 FORMULA_0009 -100.0000 1000.0000 FORMAT "%4.1" /end CHARACTERISTIC
/begin CHARACTERISTIC K_GANG_I_HA_ADAPT_MD_MAX_HS "maximales Kupplungsmoment Adaption Hinterachse | EN: maximales Kupplungsm o-ment Adaption Hinterachse" VALUE 0x7339E TKW_VV_VV_SW 100.0 FORMULA_0009 -100.0000 1000.0000 FORMAT "%4.1" /end CHARACTERISTIC
/begin CHARACTERISTIC K_GANG_I_HA_ADAPT_SCHLUPF_MIN_HS "minimaler Schlupf Adaption Hinterachse | EN: minimaler Schlupf Adapt ion Hinterachse" VALUE 0x733A0 TKW_VV_VV_SW 100.0 FORMULA_0463 -300.0000 300.0000 FORMAT "%4.1" /end CHARACTERISTIC
/begin CHARACTERISTIC K_GANG_I_HA_ADAPT_V_MIN_HS "minimale Geschwindigkeit Adaption Hinterachse | EN: minimale Geschwindigkeit Adaption Hinterachse" VALUE 0x733A2 TKW_VV_VV_SW 100.0 FORMULA_0078 -80.0000 360.0000 FORMAT "%4.1" /end CHARACTERISTIC
/begin CHARACTERISTIC K_GANG_I_HA_ADAPT_V_MAX_HS "maximale Geschwindigkeit Adaption Hinterachse | EN: maximale Geschwindig keit Adaption Hinterachse" VALUE 0x733A4 TKW_VV_VV_SW 100.0 FORMULA_0078 -80.0000 360.0000 FORMAT "%4.1" /end CHARACTERISTIC
/begin CHARACTERISTIC K_GANG_I_HA_ADAPT_CNT_MAX "maximale Zahl Messwerte Adaption Hinterachse | EN: maximale Zahl Messwerte Adaption Hinterachse" VALUE 0x733A6 TKW_VV_VV_UW 100.0 FORMULA_0010 0.0 65535.0000 /end CHARACTERISTIC
/begin CHARACTERISTIC K_GANG_I_HA_ADAPT_MIN "minimaler Adaptionswert Hinterachse | EN: minimaler Adaptionswert Hinterachse" VALUE 0x733A8 TKW_VV_VV_SW 100.0 FORMULA_0075 -10.0000 10.0000 FORMAT "%6.3" /end CHARACTERISTIC
/begin CHARACTERISTIC K_GANG_I_HA_ADAPT_MAX "maximaler Adaptionswert Hinterachse | EN: maximaler Adaptionswert Hinterachse" VALUE 0x733AA TKW_VV_VV_SW 100.0 FORMULA_0075 -10.0000 10.0000 FORMAT "%6.3" /end CHARACTERISTIC
/begin CHARACTERISTIC K_GANG_I_HA_SMG "Uebersetzungsverhaeltnis Hinterachse SMG | EN: Uebersetzungsverhaeltnis Hinterachse SMG" VALUE 0x733AC TKW_VV_VV_SW 100.0 FORMULA_0075 -10.0000 10.0000 FORMAT "%6.3" /end CHARACTERISTIC
/begin CHARACTERISTIC K_GANG_I_HA_HS "Uebersetzungsverhaeltnis Hinterachse Handschalter | EN: Uebersetzungsverhaeltnis Hinterachse Handschalter" VALUE 0x733AE TKW_VV_VV_SW 100.0 FORMULA_0075 -10.0000 10.0000 FORMAT "%6.3" /end CHARACTERISTIC
/begin CHARACTERISTIC K_GANG_R_RAD_DYN_NV "Radhalbmesser dynamisch adaptiert, temporaere Konstante | EN: Radhalbmesser dyn amisch adaptiert, temporaere Kon- stante" VALUE 0x733B0 TKW_VV_VV_SW 100.0 FORMULA_0690 -32.0000 31.9990 FORMAT "%6.3" /end CHARACTERISTIC
/begin CHARACTERISTIC K_GANG_GLG_TIMER_MAX "Zeit bis Anzeige Getriebeleergasse | EN: Time until gearbox neutral is displayed [ms]" VALUE 0x733B2 TKW_VV_VV_SW 100.0 FORMULA_0684 -327680.0000 327670.0000 /end CHARACTERISTIC
/begin CHARACTERISTIC K_GANG_1_TIMER_MAX "Zeit bis Anzeige 1.Gang | EN: Zeit bis Anzeige 1.Gang" VALUE 0x733B4 TKW_VV_VV_SW 100.0 FORMULA_0684 -327680.0000 327670.0000 /end CHARACTERISTIC
/begin CHARACTERISTIC KL_GANG_I_SMG "SMG Gang entsprechend Getriebeuebersetzung | EN: SMG gear from gearbox ratio" CURVE 0x733B6 TKL_SW_VV_SW 100.0 FORMULA_0691 -32.0000 31.9990
 /begin AXIS_DESCR STD_AXIS SMG_Getr_I FORMULA_0075 9 -10.0000 10.0000 FORMAT "%6.3" /end AXIS_DESCR
/end CHARACTERISTIC
/begin CHARACTERISTIC KL_GANG_I_HS "HS Gang entsprechend Getriebeuebersetzung | EN: Manual gearbox gear from gearbox ratio" CURVE 0x733DC TKL_SW_VV_SW 100.0 FORMULA_0691 -32.0000 31.9990
 /begin AXIS_DESCR STD_AXIS HS_Getr_I FORMULA_0075 8 -10.0000 10.0000 FORMAT "%6.3" /end AXIS_DESCR
/end CHARACTERISTIC
/* ------------------ Abschnitt erzeugt aus gkl_ipol.dat ------------------ */
/begin AXIS_PTS AXIS_N10 "Stuetzstellen ueber Drehzahl." 0x733FE TAD_UB_VV_SW 10000.0 FORMULA_0006 10 0.0 10000.0000 /end AXIS_PTS
/begin AXIS_PTS AXIS_N12 "Stuetzstellen ueber Drehzahl." 0x73414 TAD_UB_VV_SW 10000.0 FORMULA_0006 12 0.0 10000.0000 /end AXIS_PTS
/begin AXIS_PTS AXIS_N16 "Stuetzstellen ueber Drehzahl." 0x7342E TAD_UB_VV_SW 10000.0 FORMULA_0006 16 0.0 10000.0000 /end AXIS_PTS
/begin AXIS_PTS AXIS_N_GRAD6 "Stuetzstellen ueber Drehzahlgradient pro Arbeitsspiel." 0x73450 TAD_UB_VV_SW 20000.0 FORMULA_0114 6 -10000.0000 10000.0000 /end AXIS_PTS
/begin AXIS_PTS AXIS_RF10 "Stuetzstellen ueber rf." 0x7345E TAD_UB_VV_SW 2.0 FORMULA_0007 10 0.0 2.0000 FORMAT "%6.3" /end AXIS_PTS
/* ------------------ Abschnitt erzeugt aus ioncom.dat ------------------ */ /* ------------------ Abschnitt erzeugt aus iss.dat ------------------ */
/begin CHARACTERISTIC K_ISS_TIME_MS_MIN "Schwelle Aktivierung Offseterkennung bei Motor steht." VALUE 0x73478 TKW_VV_VV_UW 100.0 FORMULA_0062 0.0 65535.0000 /end CHARACTERISTIC
/begin CHARACTERISTIC K_ISS_KLIPPING_MAX "Max zul. mittlere Ionenwert im Klopffenster." VALUE 0x7347A TKW_VV_VV_SW 100.0 FORMULA_0578 -800.1953 800.1709 FORMAT "%5.2" /end CHARACTERISTIC
/begin CHARACTERISTIC K_ISS_ADC_MAX "Schwelle AD-Wert fuer Kurzschluss nach Masse." VALUE 0x7347C TKW_VV_VV_UW 100.0 FORMULA_0443 0.0 3.3000 FORMAT "%5.2" /end CHARACTERISTIC
/begin CHARACTERISTIC K_ISS_ADC_MIN "Schwelle AD-Wert fuer Openload oder Kurzschluss nach Ub." VALUE 0x7347E TKW_VV_VV_UW 100.0 FORMULA_0443 0.0 3.3000 FORMAT "%5.2" /end CHARACTERISTIC
/begin CHARACTERISTIC K_ISS_MAX_DELTA "Max zul. Schwelle fuer Kurzschluss nach Masse zwischen Zylindern. | EN: Max zul. Schwelle fuer Kurzschluss nach Masse zwischen Zylindern." VALUE 0x73480 TKW_VV_VV_UB 100.0 FORMULA_0003 0.0 255.0000 /end CHARACTERISTIC
/* ------------------ Abschnitt erzeugt aus ka.dat ------------------ */
/begin CHARACTERISTIC K_KA_KS_CFG "Freigabe Klopfschutz. | EN: 0 Klopf schutz Aus 0x1 Klopf- schutz Ein ELSE undef i- niert Freigabe Klopfschutz." VALUE 0x734BC TKW_VV_VV_UB 100.0 FORMULA_0694 0.0 1.0 /end CHARACTERISTIC
/begin CHARACTERISTIC K_KA_RESET_CFG "Reset Klopfadaption." VALUE 0x734BD TKW_VV_VV_UB 100.0 FORMULA_0695 0.0 1.0 /end CHARACTERISTIC
/begin CHARACTERISTIC K_KA_DIAG_T "Maximalzeit der Diagnose Bereichsueberwachung. | EN: Maximalzeit der Diagnose Bereichsueberwachung." VALUE 0x734BE TKW_VV_VV_UW 100.0 FORMULA_0073 0.0 6553.5000 FORMAT "%4.1" /end CHARACTERISTIC
/begin CHARACTERISTIC K_KA_TP_TAU "Tau Tiefpassfilter Klopfrueckziehwinkel." VALUE 0x734C0 TKW_VV_VV_UW 100.0 FORMULA_0696 0.1001 6553.6000 FORMAT "%7.4" /end CHARACTERISTIC
/begin CHARACTERISTIC K_KA_TREPP_F "Wichtungsfaktor." VALUE 0x734C2 TKW_VV_VV_UW 100.0 FORMULA_0491 0.0 7.9998 FORMAT "%7.4" /end CHARACTERISTIC
/begin CHARACTERISTIC K_KA_AQ_GRAD_SEGM_CNT "Anzahl Segmente Deaktivierung nach Dynamik. | EN: Anzahl Segmente Deaktivi erung nach Dynamik." VALUE 0x734C4 TKW_VV_VV_UW 100.0 FORMULA_0010 0.0 65535.0000 /end CHARACTERISTIC
/begin CHARACTERISTIC K_KA_AQ_GRAD_MAX "Trigger Dynamik Deaktivierung. | EN: Trigger Dynamik Deaktivierung." VALUE 0x734C6 TKW_VV_VV_SW 100.0 FORMULA_0020 -655360.0000 655340.0000 /end CHARACTERISTIC
/begin CHARACTERISTIC K_KA_TZ_MIN_HYST "tz_min Hysterese. | EN: tz_min Hysterese." VALUE 0x734C8 TKW_VV_VV_SW 100.0 FORMULA_0111 -50.0000 60.0000 FORMAT "%4.1" /end CHARACTERISTIC
/begin CHARACTERISTIC K_KA_ADAPT_MAX "Max KA Zuendwinkeleingriff. | [Code V452 IGN 0x40368] Upper limit of the learned (stored) adaptation value (+5 degKW). A positive learned value only cancels KF_KA_OFFS*; ka_dtz is never > 0." VALUE 0x734CA TKW_VV_VV_SW 100.0 FORMULA_0111 -50.0000 60.0000 FORMAT "%4.1" /end CHARACTERISTIC
/begin CHARACTERISTIC K_KA_DTZ_MAX "Max Klopfadaptionsrueckziehwinkel. | EN: Max Klopfadaptionsrueckzie h-winkel. | [Code V452 IGN 0x40368] Lower limit of the knock-adaptation retard ka_dtz (-15 degKW)." VALUE 0x734CC TKW_VV_VV_SW 100.0 FORMULA_0111 -50.0000 60.0000 FORMAT "%4.1" /end CHARACTERISTIC
/begin CHARACTERISTIC K_KA_FILT_KK_KA "Max Zuendwinkelgradient bei pos. ka_offs. | EN: 3 x/40960 Max Zuendwinkelgradient bei pos. ka_offs." VALUE 0x734CE TKW_VV_VV_SW 100.0 FORMULA_0697 0.0 1.0000 FORMAT "%6.3" /end CHARACTERISTIC
/begin CHARACTERISTIC K_KA_FILT_KK_KKA "Max Zuendwinkelgradient bei neg. ka_offs. | EN: 3 x/40960 Max Zuendwinkelgradient bei neg. ka_offs." VALUE 0x734D0 TKW_VV_VV_SW 100.0 FORMULA_0697 0.0 1.0000 FORMAT "%6.3" /end CHARACTERISTIC
/begin CHARACTERISTIC K_KA_FILT_LK "Max Zuendwinkelgradient bei leichtem Klopfer." VALUE 0x734D2 TKW_VV_VV_SW 100.0 FORMULA_0697 0.0 1.0000 FORMAT "%6.3" /end CHARACTERISTIC
/begin CHARACTERISTIC K_KA_FILT_SK "Max Zuendwinkelgradient bei starkem Klopfer." VALUE 0x734D4 TKW_VV_VV_SW 100.0 FORMULA_0697 0.0 1.0000 FORMAT "%6.3" /end CHARACTERISTIC
/begin CHARACTERISTIC K_KA_TZ_KS "Klopfschutzzuendwinkeloffset. | EN: Klopfschutzzuendwinkeloffset. | [Code V452 IGN 0x40368] Value used instead of the learned adaptation in a special state (branch at 0x40610) [EST: knock-protection mode]." VALUE 0x734D6 TKW_VV_VV_SW 100.0 FORMULA_0111 -50.0000 60.0000 FORMAT "%4.1" /end CHARACTERISTIC
/begin CHARACTERISTIC K_KA_KLIPPING_MAX "Klopfschutzschwelle fuer Klipping im Klopffenster. | EN: Klopfschutzschwelle fuer Klipping im Klopffenster." VALUE 0x734D8 TKW_VV_VV_UB 100.0 FORMULA_0003 0.0 255.0000 /end CHARACTERISTIC
/begin CHARACTERISTIC KL_KA_F_VL "Gewichtungsfaktor | EN: Weighting factor | [Code V452 IGN 0x40158/0x40368] Full-load weighting of the learned knock adaptation: ka_dtz = learned x (KL_KA_F_VL + KF_KA_F_K) + KF_KA_OFFS_VL, clamped to K_KA_DTZ_MAX..0 (can only retard). Setting it to 0 makes the engine ignore its learned knock retard at full load." CURVE 0x734DA TKL_SW_VV_UW 100.0 FORMULA_0075 0.0 63.9990 /begin AXIS_DESCR STD_AXIS FORMULA_0006 18 0.0 10000.0000 /end AXIS_DESCR FORMAT "%6.3" /end CHARACTERISTIC
/begin CHARACTERISTIC KL_KA_PUMG_VL "Zuendwinkeloffset | EN: Ignition angle offset | [Code V452 IGN 0x3FA88/0x40368] Ambient-pressure offset added to the learned value at full load." CURVE 0x73524 TKL_SW_VV_SW 100.0 FORMULA_0111 -50.0000 60.0000 /begin AXIS_DESCR STD_AXIS FORMULA_0077 6 400.0000 1200.0000 FORMAT "%4.1" /end AXIS_DESCR FORMAT "%4.1" /end CHARACTERISTIC
/begin CHARACTERISTIC KL_KA_RF_MIN "Lastschwelle KA | EN: Load threshold 0-1 | [Code V452 IGN 0x40158/0x40368] Load threshold (over n) for knock-adaptation learning." CURVE 0x7353E TKL_SW_VV_SW 100.0 FORMULA_0007 0.0 2.0000 /begin AXIS_DESCR STD_AXIS FORMULA_0006 10 0.0 10000.0000 /end AXIS_DESCR FORMAT "%6.3" /end CHARACTERISTIC
/begin CHARACTERISTIC GKL_KA_ADAPT_MIN "Min KA Zuendwinkeleingriff. | [Code V452 IGN 0x40004/0x40368] Lower limit of the learned (stored) adaptation value over n." CURVE 0x73568 TGL_VV_VV_SW 110.0 FORMULA_0111 -50.0000 60.0000 FORMAT "%4.1"
 /begin AXIS_DESCR COM_AXIS FORMULA_0006 10 0.0 10000.0000 AXIS_PTS_REF AXIS_N10 /end AXIS_DESCR
/end CHARACTERISTIC
/begin CHARACTERISTIC KF_KA_OFFS_VL "Abstand Klopfgrenze | EN: Distance to knock limit | [Code V452 IGN 0x40158/0x40368] Full-load fixed safety retard per cylinder (n x cylinder), added to the weighted learned value. -2 degKW over most of the range here: active at WOT unless the learned value is positive enough to cancel it (result never > 0)." MAP 0x7357C TKF_SW_SW_SW 100.0 FORMULA_0111 -50.0000 60.0000 /begin AXIS_DESCR STD_AXIS FORMULA_0006 18 0.0 10000.0000 /end AXIS_DESCR /begin AXIS_DESCR STD_AXIS Zyl FORMULA_0010 10 1.0000 10.0000 /end AXIS_DESCR FORMAT "%4.1" /end CHARACTERISTIC
/begin CHARACTERISTIC KF_KA_F_K "Korrekturwert vom Gewichtungsfaktor. | [Code V452 IGN 0x40158] Correction added to the weighting factor over n x summed knock retard of the bank (all 0 here)." MAP 0x7371E TKF_SW_SW_UW 100.0 FORMULA_0075 0.0 63.9990 /begin AXIS_DESCR STD_AXIS FORMULA_0006 8 0.0 10000.0000 /end AXIS_DESCR
 /begin AXIS_DESCR STD_AXIS dtz FORMULA_0111 8 -3276.8000 3276.7000 FORMAT "%4.1" /end AXIS_DESCR
 FORMAT "%6.3" /end CHARACTERISTIC
/begin CHARACTERISTIC KF_KA_F "Gewichtungsfaktor | EN: Weighting factor | [Code V452 IGN 0x40158] Part-load weighting of the learned knock adaptation (n x rf), as KL_KA_F_VL." MAP 0x737C0 TKF_SW_SW_UW 100.0 FORMULA_0075 0.0 63.9990 /begin AXIS_DESCR STD_AXIS FORMULA_0006 18 0.0 10000.0000 /end AXIS_DESCR /begin AXIS_DESCR STD_AXIS FORMULA_0007 12 0.0 2.0000 FORMAT "%6.3" /end AXIS_DESCR FORMAT "%6.3" /end CHARACTERISTIC
/begin CHARACTERISTIC KF_KA_OFFS "Abstand Klopfgrenze | EN: Distance to knock limit | [Code V452 IGN 0x40158] Part-load fixed retard offset (n x rf), same for all cylinders." MAP 0x739AE TKF_SW_SW_SW 100.0 FORMULA_0111 -50.0000 60.0000 /begin AXIS_DESCR STD_AXIS FORMULA_0006 18 0.0 10000.0000 /end AXIS_DESCR /begin AXIS_DESCR STD_AXIS FORMULA_0007 12 0.0 2.0000 FORMAT "%6.3" /end AXIS_DESCR FORMAT "%4.1" /end CHARACTERISTIC
/begin CHARACTERISTIC KF_KA_T_KOMP "Temperaturkompensation Klopfadaption | EN: Temperature compensation of knock adaptation | [Code V452 IGN 0x3FA88/0x40368] Temperature compensation added to the learned value." MAP 0x73B9C TKF_SW_SW_SW 100.0 FORMULA_0111 -50.0000 60.0000 /begin AXIS_DESCR STD_AXIS FORMULA_0023 6 -50.0000 170.0000 FORMAT "%4.1" /end AXIS_DESCR
 /begin AXIS_DESCR STD_AXIS tan FORMULA_0023 6 -50.0000 170.0000 FORMAT "%4.1" /end AXIS_DESCR
 FORMAT "%4.1" /end CHARACTERISTIC
/* ------------------ Abschnitt erzeugt aus kh.dat ------------------ */
/begin CHARACTERISTIC K_KH_TKAT_CFG "Konfigbyte zur Kat.Temperaturwahl fuer die Alterung | EN: 0x1 vkat 0x2 nkat 0x8 kat ELSE ungueltig Konfigbyte zur Kat.Temperaturwahl fuer die Alterung" VALUE 0x73BFE TKW_VV_VV_UB 100.0 FORMULA_0699 0.0 255.0 /end CHARACTERISTIC
/begin CHARACTERISTIC K_KH_TZ_CFG "Konfigbyte fuer TZ-Eingriff" VALUE 0x73BFF TKW_VV_VV_UB 100.0 FORMULA_0700 0.0 255.0 /end CHARACTERISTIC
/begin CHARACTERISTIC K_KH_TKAT_ENDE "Temperaturschwelle fuer Katheizende | EN: Temperaturschwelle fuer Katheizende [V912: differs from V452 160E]" VALUE 0x73C00 TKW_VV_VV_SW 100.0 FORMULA_0023 -50.0000 1200.0000 FORMAT "%4.1" /end CHARACTERISTIC
/begin CHARACTERISTIC K_KH_RF_MAX "Lastschwelle fuer Katheizen aus | EN: Lastschwelle fuer Katheizen aus" VALUE 0x73C02 TKW_VV_VV_SW 100.0 FORMULA_0007 0.0 2.0000 FORMAT "%6.3" /end CHARACTERISTIC
/begin CHARACTERISTIC K_KH_RF_MAX_HYS "Lasthysterese fuer Katheizen aus | EN: Lasthysterese fuer Katheizen aus" VALUE 0x73C04 TKW_VV_VV_SW 100.0 FORMULA_0007 0.0 2.0000 FORMAT "%6.3" /end CHARACTERISTIC
/begin CHARACTERISTIC K_KH_N_MAX "Drehzalschwelle fuer Katheizen aus | EN: Drehzahlschwelle fuer Katheizen aus" VALUE 0x73C06 TKW_VV_VV_SW 100.0 FORMULA_0006 0.0 10000.0000 /end CHARACTERISTIC
/begin CHARACTERISTIC K_KH_N_MAX_HYS "Drehzalhysterese fuer Katheizen aus | EN: Drehzahlhysterese fuer Katheizen aus" VALUE 0x73C08 TKW_VV_VV_SW 100.0 FORMULA_0006 0.0 10000.0000 /end CHARACTERISTIC
/begin CHARACTERISTIC K_KH_TZ_AB "tz-Aenderungsbegr. Beginn KH" VALUE 0x73C0A TKW_VV_VV_SW 100.0 FORMULA_0701 -50.0000 50.0000 FORMAT "%5.2" /end CHARACTERISTIC
/begin CHARACTERISTIC K_KH_TZ_AUF "tz-Aenderungsbegr. Ende KH [V912: differs from V452 160E]" VALUE 0x73C0C TKW_VV_VV_SW 100.0 FORMULA_0701 -50.0000 50.0000 FORMAT "%5.2" /end CHARACTERISTIC
/begin CHARACTERISTIC K_KH_TKAT_HYST "Hysterese fuer TKAT-Ende | EN: Temperaturschwelle fuer Katheizende [V912: differs from V452 160E]" VALUE 0x73C0E TKW_VV_VV_SW 100.0 FORMULA_0076 0.0 1000.0000 FORMAT "%4.1" /end CHARACTERISTIC
/begin CHARACTERISTIC K_KH_VAN_TMOT_MAX "Katheizen Obergrenze | EN: Katheizen Obergrenze [V912: differs from V452 160E]" VALUE 0x73C10 TKW_VV_VV_SW 100.0 FORMULA_0023 -50.0000 170.0000 FORMAT "%4.1" /end CHARACTERISTIC
/begin CHARACTERISTIC K_KH_VAN_AB_Einlass "Katheizen Abregelzeit | EN: Catalyst-heating ramp-down time" VALUE 0x73C12 TKW_VV_VV_SW 100.0 FORMULA_0702 164.0000 0.0100 FORMAT "%5.2" /end CHARACTERISTIC
/begin CHARACTERISTIC K_KH_VAN_AB_Auslass "Katheizen Abregelzeit | EN: Katheizen Abregelzeit" VALUE 0x73C14 TKW_VV_VV_SW 100.0 FORMULA_0702 164.0000 0.0100 FORMAT "%5.2" /end CHARACTERISTIC
/begin CHARACTERISTIC K_KH_VAN_CFG "Konfig Vanos Katheizen" VALUE 0x73C16 TKW_VV_VV_UB 100.0 FORMULA_0703 0.0 255.0 /end CHARACTERISTIC
/begin CHARACTERISTIC K_KH_VAN_VO_FAKT "Anteil AVAN an KH RG Ueberschneidung" VALUE 0x73C17 TKW_VV_VV_UB 100.0 FORMULA_0704 0.0 1.9921 /end CHARACTERISTIC
/begin CHARACTERISTIC K_KH_VAN_VO_I_MAX "Max. I-Anteil KH RG-Ueberschneidung" VALUE 0x73C18 TKW_VV_VV_SW 100.0 FORMULA_0111 0.0 80.0000 FORMAT "%4.1" /end CHARACTERISTIC
/begin CHARACTERISTIC K_KH_TZ_ABS_AB "Aenderungsbegr. Faktor Ende KH | EN: Aenderungsbegr. Faktor Ende KH" VALUE 0x73C1A TKW_VV_VV_UW 100.0 FORMULA_0705 0.0 2.0000 FORMAT "%7.4" /end CHARACTERISTIC
/begin CHARACTERISTIC K_KH_SMG_TMOT_MIN "min. Temperaturschwelle fuer SMG-KH | EN: min. Temperaturschwelle fuer SMG-KH" VALUE 0x73C1C TKW_VV_VV_SW 100.0 FORMULA_0023 -50.0000 150.0000 FORMAT "%4.1" /end CHARACTERISTIC
/begin CHARACTERISTIC K_KH_SMG_TMOT_MAX "Temperaturschwelle fuer SMG-KH | EN: Temperaturschwelle fuer SMG-KH [V912: differs from V452 160E]" VALUE 0x73C1E TKW_VV_VV_SW 100.0 FORMULA_0023 -50.0000 150.0000 FORMAT "%4.1" /end CHARACTERISTIC
/begin CHARACTERISTIC K_KH_PKSR_PL_TMOT_MIN "tmot Sperrschwelle fuer Prueflauf | EN: tmot Sperrschwelle fuer Prueflauf" VALUE 0x73C20 TKW_VV_VV_SW 100.0 FORMULA_0023 -50.0000 170.0000 FORMAT "%4.1" /end CHARACTERISTIC
/begin CHARACTERISTIC KL_KH_VAN_DELAY_TMOT "Katheizdelay abhaengig von tmot | EN: Catalyst-heating delay depending on engine temperature" CURVE 0x73C22 TKL_SW_VV_UW 100.0 FORMULA_0021 0.0 655.0000 /begin AXIS_DESCR STD_AXIS FORMULA_0023 6 -50.0000 170.0000 FORMAT "%4.1" /end AXIS_DESCR FORMAT "%5.2" /end CHARACTERISTIC
/begin CHARACTERISTIC KL_KH_TZ_DELAY_TMOT "Katheizdelay TZ abhaengig von tmot" CURVE 0x73C3C TKL_SW_VV_UW 100.0 FORMULA_0021 0.0 655.0000 /begin AXIS_DESCR STD_AXIS FORMULA_0023 6 -50.0000 170.0000 FORMAT "%4.1" /end AXIS_DESCR FORMAT "%5.2" /end CHARACTERISTIC
/begin CHARACTERISTIC KL_KH_VAN_AUF_TMOT_E "Faktor zwischen KF_VAN_E und KF_VAN_KH_E | EN: Factor between KF_VAN_E and KF_VAN_KH_E (intake VANOS normal vs cat heating)" CURVE 0x73C56 TKL_SW_VV_SW 100.0 FORMULA_0702 164.0000 0.0100 /begin AXIS_DESCR STD_AXIS FORMULA_0023 4 -50.0000 170.0000 FORMAT "%4.1" /end AXIS_DESCR FORMAT "%5.2" /end CHARACTERISTIC
/begin CHARACTERISTIC KL_KH_VAN_AUF_TMOT_A "Faktor zwischen KF_VAN_A und KF_VAN_KH_A | EN: Factor between KF_VAN_A and KF_VAN_KH_A (exhaust VANOS normal vs cat heating)" CURVE 0x73C68 TKL_SW_VV_SW 100.0 FORMULA_0702 164.0000 0.0100 /begin AXIS_DESCR STD_AXIS FORMULA_0023 4 -50.0000 170.0000 FORMAT "%4.1" /end AXIS_DESCR FORMAT "%5.2" /end CHARACTERISTIC
/begin CHARACTERISTIC KL_KH_VAN_RG_REG_I "Katheiz Restgas I-Regler" CURVE 0x73C7A TKL_SW_VV_SW 100.0 FORMULA_0706 -80.0000 80.0000
 /begin AXIS_DESCR STD_AXIS van_kh_rg_delta FORMULA_0109 5 -0.5000 0.5000 FORMAT "%5.2" /end AXIS_DESCR
 FORMAT "%4.1" /end CHARACTERISTIC
/begin CHARACTERISTIC KL_KH_VAN_RG_REG_P "Katheiz Restgas P-Regler" CURVE 0x73C90 TKL_SW_VV_SW 100.0 FORMULA_0111 -80.0000 80.0000
 /begin AXIS_DESCR STD_AXIS van_kh_rg_delta FORMULA_0109 5 -0.5000 0.5000 FORMAT "%5.2" /end AXIS_DESCR
 FORMAT "%4.1" /end CHARACTERISTIC
/begin CHARACTERISTIC KL_KH_ALT_OFFSET "Katalterungsoffset | EN: Catalyst ageing offset [V912: differs from V452 160E]" CURVE 0x73CA6 TKL_UW_VV_SW 100.0 FORMULA_0076 -1000.0000 1000.0000
 /begin AXIS_DESCR STD_AXIS kat_obd_wert_nv FORMULA_0025 7 0.0 3.9990 FORMAT "%6.3" /end AXIS_DESCR
 FORMAT "%4.1" /end CHARACTERISTIC
/begin CHARACTERISTIC KL_KH_TZ_ABS_INIT "Init Wert fuer den Faktor" CURVE 0x73CC4 TKL_SW_VV_UW 100.0 FORMULA_0295 0.0 2.0000 /begin AXIS_DESCR STD_AXIS FORMULA_0023 6 -50.0000 170.0000 FORMAT "%4.1" /end AXIS_DESCR FORMAT "%7.4" /end CHARACTERISTIC
/begin CHARACTERISTIC KL_KH_TZ_ABS_AUF_TMOT "Aenderungsbegr. Faktor Beginn KH" CURVE 0x73CDE TKL_SW_VV_UW 100.0 FORMULA_0705 0.0 2.0000 /begin AXIS_DESCR STD_AXIS FORMULA_0023 6 -50.0000 170.0000 FORMAT "%4.1" /end AXIS_DESCR FORMAT "%7.4" /end CHARACTERISTIC
/begin CHARACTERISTIC KL_KH_TZ_PUMG_F "Hohenkorrektur uber pumg" CURVE 0x73CF8 TKL_SW_VV_UB 100.0 FORMULA_0704 0.0 1.9921 /begin AXIS_DESCR STD_AXIS FORMULA_0077 5 400.0000 1200.0000 FORMAT "%4.1" /end AXIS_DESCR /end CHARACTERISTIC
/begin CHARACTERISTIC KL_KH_T_MAX "Maximale KH-Zeit | EN: Maximum catalyst-heating time [V912: differs from V452 160E]" CURVE 0x73D0A TKL_SW_VV_UW 100.0 FORMULA_0021 0.0 655.0000 /begin AXIS_DESCR STD_AXIS FORMULA_0023 5 -50.0000 170.0000 FORMAT "%4.1" /end AXIS_DESCR FORMAT "%5.2" /end CHARACTERISTIC
/begin CHARACTERISTIC KF_KH_RG_OPT "RG-Gehalt fuer Vanos-KH" MAP 0x73D20 TKF_SW_SW_SW 100.0 FORMULA_0109 -0.5000 0.5000 /begin AXIS_DESCR STD_AXIS FORMULA_0006 8 0.0 10000.0000 /end AXIS_DESCR /begin AXIS_DESCR STD_AXIS dr_rel FORMULA_0115 8 0.0 199.9938 FORMAT "%5.2" /end AXIS_DESCR FORMAT "%5.2" /end CHARACTERISTIC
/begin CHARACTERISTIC KF_KH_TZ_GRUND "Grundkennfeld Zuendwinkel fuer KH" MAP 0x73DC2 TKF_SW_SW_SW 100.0 FORMULA_0111 -50.0000 60.0000 /begin AXIS_DESCR STD_AXIS FORMULA_0006 12 0.0 10000.0000 /end AXIS_DESCR /begin AXIS_DESCR STD_AXIS rf FORMULA_0007 10 0.0 2.0000 FORMAT "%6.3" /end AXIS_DESCR FORMAT "%4.1" /end CHARACTERISTIC
/begin CHARACTERISTIC KF_KH_TZ_LL "LL-Kennfeld Zuendwinkel fuer KH [V912: differs from V452 160E]" MAP 0x73EE0 TKF_SW_SW_SW 100.0 FORMULA_0111 -50.0000 60.0000 /begin AXIS_DESCR STD_AXIS FORMULA_0006 10 0.0 10000.0000 /end AXIS_DESCR /begin AXIS_DESCR STD_AXIS FORMULA_0007 4 0.0 2.0000 FORMAT "%6.3" /end AXIS_DESCR FORMAT "%4.1" /end CHARACTERISTIC
/begin CHARACTERISTIC KF_KH_TZ_ETA_GRUND "ETA Grund-KF fuer Katheizen" MAP 0x73F4E TKF_SW_SW_UW 100.0 FORMULA_0435 0.0 100.0000 /begin AXIS_DESCR STD_AXIS FORMULA_0006 10 0.0 10000.0000 /end AXIS_DESCR /begin AXIS_DESCR STD_AXIS FORMULA_0009 10 -100.0000 1000.0000 FORMAT "%4.1" /end AXIS_DESCR FORMAT "%4.1" /end CHARACTERISTIC
/begin CHARACTERISTIC KF_KH_TZ_ETA_LL "ETA KF fuer Katheizen im LL" MAP 0x74040 TKF_SW_SW_UW 100.0 FORMULA_0435 0.0 100.0000 /begin AXIS_DESCR STD_AXIS FORMULA_0006 10 0.0 10000.0000 /end AXIS_DESCR /begin AXIS_DESCR STD_AXIS FORMULA_0009 10 -100.0000 1000.0000 FORMAT "%4.1" /end AXIS_DESCR FORMAT "%4.1" /end CHARACTERISTIC
/begin CHARACTERISTIC KF_KH_TZ_ETA_AUF "Aenderungsbegrz. kh_tz_eta Aufwaerts" MAP 0x74132 TKF_SW_SW_UW 100.0 FORMULA_0707 0.0 100.0000 /begin AXIS_DESCR STD_AXIS FORMULA_0006 6 0.0 10000.0000 /end AXIS_DESCR /begin AXIS_DESCR STD_AXIS FORMULA_0009 6 -100.0000 1000.0000 FORMAT "%4.1" /end AXIS_DESCR FORMAT "%4.1" /end CHARACTERISTIC
/begin CHARACTERISTIC KF_KH_TZ_ETA_AB "Aenderungsbegrz. kh_tz_eta Abwaerts" MAP 0x74194 TKF_SW_SW_UW 100.0 FORMULA_0707 0.0 100.0000 /begin AXIS_DESCR STD_AXIS FORMULA_0006 6 0.0 10000.0000 /end AXIS_DESCR /begin AXIS_DESCR STD_AXIS FORMULA_0009 6 -100.0000 1000.0000 FORMAT "%4.1" /end AXIS_DESCR FORMAT "%4.1" /end CHARACTERISTIC
/begin CHARACTERISTIC KF_KH_VAN_TMOT_F "Faktor zwischen KF_VAN_A und KF_VAN_KH_A [V912: differs from V452 160E]" MAP 0x741F6 TKF_SW_SW_UW 100.0 FORMULA_0295 0.0 2.0000 /begin AXIS_DESCR STD_AXIS FORMULA_0023 6 -50.0000 170.0000 FORMAT "%4.1" /end AXIS_DESCR
 /begin AXIS_DESCR STD_AXIS kat_obd_wert_nv FORMULA_0025 4 0.0 1.9000 FORMAT "%6.3" /end AXIS_DESCR
 FORMAT "%7.4" /end CHARACTERISTIC
/begin CHARACTERISTIC KF_KH_TZ_ABS_TMOT_F "Faktor zwischen KF_TZ_GRUND und KF_KH_TZ_GRUND [V912: differs from V452 160E]" MAP 0x7423C TKF_SW_SW_UW 100.0 FORMULA_0295 0.0 2.0000 /begin AXIS_DESCR STD_AXIS FORMULA_0023 6 -50.0000 170.0000 FORMAT "%4.1" /end AXIS_DESCR
 /begin AXIS_DESCR STD_AXIS kat_obd_wert_nv FORMULA_0025 4 0.0 1.9000 FORMAT "%6.3" /end AXIS_DESCR
 FORMAT "%7.4" /end CHARACTERISTIC
/* ------------------ Abschnitt erzeugt aus kis.dat ------------------ */
/begin CHARACTERISTIC K_KIS_ACTIVE_PULSE "Aktiv Puls Konfiguration. | EN: Active pulse configuration" VALUE 0x74285 TKW_VV_VV_UB 100.0 FORMULA_0709 0.0 1.0 /end CHARACTERISTIC
/begin CHARACTERISTIC K_KIS_START "Pulsstart. | EN: Pulse start" VALUE 0x74286 TKW_VV_VV_UW 100.0 FORMULA_0710 0.0 719.9890 FORMAT "%4.1" /end CHARACTERISTIC
/begin CHARACTERISTIC K_KIS_LEN "Pulslaenge. | EN: Pulse length" VALUE 0x74288 TKW_VV_VV_UW 100.0 FORMULA_0710 0.0 719.9890 FORMAT "%4.1" /end CHARACTERISTIC
/begin CHARACTERISTIC K_KIS_TIME_OUT "Maximal Pulszeit. | EN: Maximum pulse time" VALUE 0x7428C TKW_VV_VV_UL 100.0 FORMULA_0017 0.0 1198.3724 FORMAT "%5.2" /end CHARACTERISTIC
/* ------------------ Abschnitt erzeugt aus kr.dat ------------------ */
/begin CHARACTERISTIC K_KR_CFG "Schalter Freigabe Klopfregelung. | EN: 0 Aus 0x1 Ein ELSE undefiniert Schalter Freigabe Klopfregelung. | [Code V452 IGN 0x44FA0/0x454BC] Knock control enable. 0 = knock control OFF: kr_dtz is reset to 0 every cycle and no knock retard is applied (knock adaptation then learns nothing). Keep 1." VALUE 0x74290 TKW_VV_VV_UB 100.0 FORMULA_0574 0.0 255.0 /end CHARACTERISTIC
/begin CHARACTERISTIC K_KR_FB_START "Frequenzbandstart." VALUE 0x74291 TKW_VV_VV_UB 100.0 FORMULA_0735 0.0 31.1279 /end CHARACTERISTIC
/begin CHARACTERISTIC K_KR_FB_LEN "Frequenzbandlaenge." VALUE 0x74292 TKW_VV_VV_UB 100.0 FORMULA_0735 0.1221 3.7841 /end CHARACTERISTIC
/begin CHARACTERISTIC K_KR_APPL_CFG "Schalter Freigabe Applikationshilfe. | EN: 0 Aus 0x1 Ein ELSE undefiniert Schalter Freigabe Applikationshilfe. | [Code V452 IGN 0x44FA0/0x454BC] Application aid: <>0 injects test retard K_KR_APPL_DTZ_ZYLi every K_KR_APPL_PER for K_KR_APPL_NUM_ZYLi times. Keep 0." VALUE 0x74293 TKW_VV_VV_UB 100.0 FORMULA_0574 0.0 255.0 /end CHARACTERISTIC
/begin CHARACTERISTIC K_KR_APPL_PER "Periode Applikationshilfe. | EN: Periode Applikationshilfe." VALUE 0x74294 TKW_VV_VV_UB 100.0 FORMULA_0003 0.0 255.0000 /end CHARACTERISTIC
/begin CHARACTERISTIC K_KR_DIAG_T "Maximalzeit der Bereichsueberwachungdiagnose. | EN: Maximalzeit der Bereichsueberwachungdiagnose." VALUE 0x74296 TKW_VV_VV_UW 100.0 FORMULA_0073 0.0 6553.5000 FORMAT "%4.1" /end CHARACTERISTIC
/begin CHARACTERISTIC K_KR_TMOT_MIN "Maximaltemperatur fuer KR-Freigabe | EN: Maximaltemperatur fuer KR-Freigabe | [Code V452 IGN 0x454BC] Knock control inhibited below this coolant temperature (50 degC)." VALUE 0x74298 TKW_VV_VV_SW 100.0 FORMULA_0023 -50.0000 170.0000 FORMAT "%4.1" /end CHARACTERISTIC
/begin CHARACTERISTIC K_KR_KLIPPING_MAX "Max zulaessiges Klipping im Klopffenster. | EN: Maximum permitted clipping in the knock window [V]" VALUE 0x7429A TKW_VV_VV_SW 100.0 FORMULA_0443 0.0 3.3000 FORMAT "%5.2" /end CHARACTERISTIC
/begin CHARACTERISTIC K_KR_APPL_NUM_ZYL1 "Anzahl Applikationszuendwinkelverstellung. | EN: Number of calibration ignition-angle adjustments" VALUE 0x7429C TKW_VV_VV_UB 100.0 FORMULA_0003 0.0 255.0000 /end CHARACTERISTIC
/begin CHARACTERISTIC K_KR_APPL_NUM_ZYL2 "Anzahl Applikationszuendwinkelverstellung. | EN: Number of calibration ignition-angle adjustments" VALUE 0x7429D TKW_VV_VV_UB 100.0 FORMULA_0003 0.0 255.0000 /end CHARACTERISTIC
/begin CHARACTERISTIC K_KR_APPL_NUM_ZYL3 "Anzahl Applikationszuendwinkelverstellung. | EN: Number of calibration ignition-angle adjustments" VALUE 0x7429E TKW_VV_VV_UB 100.0 FORMULA_0003 0.0 255.0000 /end CHARACTERISTIC
/begin CHARACTERISTIC K_KR_APPL_NUM_ZYL4 "Anzahl Applikationszuendwinkelverstellung. | EN: Number of calibration ignition-angle adjustments" VALUE 0x7429F TKW_VV_VV_UB 100.0 FORMULA_0003 0.0 255.0000 /end CHARACTERISTIC
/begin CHARACTERISTIC K_KR_APPL_NUM_ZYL5 "Anzahl Applikationszuendwinkelverstellung. | EN: Number of calibration ignition-angle adjustments" VALUE 0x742A0 TKW_VV_VV_UB 100.0 FORMULA_0003 0.0 255.0000 /end CHARACTERISTIC
/begin CHARACTERISTIC K_KR_APPL_NUM_ZYL6 "Anzahl Applikationszuendwinkelverstellung. | EN: Number of calibration ignition-angle adjustments" VALUE 0x742A1 TKW_VV_VV_UB 100.0 FORMULA_0003 0.0 255.0000 /end CHARACTERISTIC
/begin CHARACTERISTIC K_KR_APPL_NUM_ZYL7 "Anzahl Applikationszuendwinkelverstellung. | EN: Number of calibration ignition-angle adjustments" VALUE 0x742A2 TKW_VV_VV_UB 100.0 FORMULA_0003 0.0 255.0000 /end CHARACTERISTIC
/begin CHARACTERISTIC K_KR_APPL_NUM_ZYL8 "Anzahl Applikationszuendwinkelverstellung. | EN: Number of calibration ignition-angle adjustments" VALUE 0x742A3 TKW_VV_VV_UB 100.0 FORMULA_0003 0.0 255.0000 /end CHARACTERISTIC
/begin CHARACTERISTIC K_KR_APPL_NUM_ZYL9 "Anzahl Applikationszuendwinkelverstellung. | EN: Number of calibration ignition-angle adjustments" VALUE 0x742A4 TKW_VV_VV_UB 100.0 FORMULA_0003 0.0 255.0000 /end CHARACTERISTIC
/begin CHARACTERISTIC K_KR_APPL_NUM_ZYL10 "Anzahl Applikationszuendwinkelverstellung. | EN: Number of calibration ignition-angle adjustments" VALUE 0x742A5 TKW_VV_VV_UB 100.0 FORMULA_0003 0.0 255.0000 /end CHARACTERISTIC
/begin CHARACTERISTIC K_KR_APPL_DTZ_ZYL1 "Applikationszuendwinkeloffset. | EN: Calibration ignition angle offset" VALUE 0x742A6 TKW_VV_VV_SW 100.0 FORMULA_0111 -50.0000 60.0000 FORMAT "%4.1" /end CHARACTERISTIC
/begin CHARACTERISTIC K_KR_APPL_DTZ_ZYL2 "Applikationszuendwinkeloffset. | EN: Calibration ignition angle offset" VALUE 0x742A8 TKW_VV_VV_SW 100.0 FORMULA_0111 -50.0000 60.0000 FORMAT "%4.1" /end CHARACTERISTIC
/begin CHARACTERISTIC K_KR_APPL_DTZ_ZYL3 "Applikationszuendwinkeloffset. | EN: Calibration ignition angle offset" VALUE 0x742AA TKW_VV_VV_SW 100.0 FORMULA_0111 -50.0000 60.0000 FORMAT "%4.1" /end CHARACTERISTIC
/begin CHARACTERISTIC K_KR_APPL_DTZ_ZYL4 "Applikationszuendwinkeloffset. | EN: Calibration ignition angle offset" VALUE 0x742AC TKW_VV_VV_SW 100.0 FORMULA_0111 -50.0000 60.0000 FORMAT "%4.1" /end CHARACTERISTIC
/begin CHARACTERISTIC K_KR_APPL_DTZ_ZYL5 "Applikationszuendwinkeloffset. | EN: Calibration ignition angle offset" VALUE 0x742AE TKW_VV_VV_SW 100.0 FORMULA_0111 -50.0000 60.0000 FORMAT "%4.1" /end CHARACTERISTIC
/begin CHARACTERISTIC K_KR_APPL_DTZ_ZYL6 "Applikationszuendwinkeloffset. | EN: Calibration ignition angle offset" VALUE 0x742B0 TKW_VV_VV_SW 100.0 FORMULA_0111 -50.0000 60.0000 FORMAT "%4.1" /end CHARACTERISTIC
/begin CHARACTERISTIC K_KR_APPL_DTZ_ZYL7 "Applikationszuendwinkeloffset. | EN: Calibration ignition angle offset" VALUE 0x742B2 TKW_VV_VV_SW 100.0 FORMULA_0111 -50.0000 60.0000 FORMAT "%4.1" /end CHARACTERISTIC
/begin CHARACTERISTIC K_KR_APPL_DTZ_ZYL8 "Applikationszuendwinkeloffset. | EN: Calibration ignition angle offset" VALUE 0x742B4 TKW_VV_VV_SW 100.0 FORMULA_0111 -50.0000 60.0000 FORMAT "%4.1" /end CHARACTERISTIC
/begin CHARACTERISTIC K_KR_APPL_DTZ_ZYL9 "Applikationszuendwinkeloffset. | EN: Calibration ignition angle offset" VALUE 0x742B6 TKW_VV_VV_SW 100.0 FORMULA_0111 -50.0000 60.0000 FORMAT "%4.1" /end CHARACTERISTIC
/begin CHARACTERISTIC K_KR_APPL_DTZ_ZYL10 "Applikationszuendwinkeloffset. | EN: Calibration ignition angle offset" VALUE 0x742B8 TKW_VV_VV_SW 100.0 FORMULA_0111 -50.0000 60.0000 FORMAT "%4.1" /end CHARACTERISTIC
/begin CHARACTERISTIC GKL_KR_DTZ_MAX "Maximal zulaessiger Klopfregelungseingriff. | EN: Max. permitted knock-control retard over n | [Code V452 IGN 0x44FA0/0x454BC] Maximum knock-control retard over n (-7 ... -15 degKW). Clamps kr_dtz per cylinder (0x454BC). KF_TZ_MIN can limit earlier." CURVE 0x742D4 TGL_VV_VV_SW 110.0 FORMULA_0111 -50.0000 60.0000 FORMAT "%4.1"
 /begin AXIS_DESCR COM_AXIS FORMULA_0006 10 0.0 10000.0000 AXIS_PTS_REF AXIS_N10 /end AXIS_DESCR
/end CHARACTERISTIC
/begin CHARACTERISTIC GKL_KR_RF_MIN "Mindestfuellung fuer KR-Freigabe. | EN: Minimum relative filling for knock-control release over n | [Code V452 IGN 0x45304/0x454BC] Minimum rf (over n) for knock control; below it no new knock retard." CURVE 0x742E8 TGL_VV_VV_SW 2.0 FORMULA_0007 0.0 2.0000 FORMAT "%6.3"
 /begin AXIS_DESCR COM_AXIS FORMULA_0006 12 0.0 10000.0000 AXIS_PTS_REF AXIS_N12 /end AXIS_DESCR
/end CHARACTERISTIC
/begin CHARACTERISTIC KL_KR_FBS_AVG_NO "Anzahl der Arbeitsspiele fuer Mittelwertsbildung." CURVE 0x74300 TKL_SW_VV_UB 100.0 FORMULA_0003 0.0 255.0000 /begin AXIS_DESCR STD_AXIS FORMULA_0204 12 -200.0000 200.0000 FORMAT "%6.3" /end AXIS_DESCR /end CHARACTERISTIC
/begin CHARACTERISTIC GKL_KR_FBS_AVG_OFF_MAX "Zulaessiges Delta zum Mittelwert Engeriespektrum der Klopffrequenz bei VL. | [Code V452 IGN 0x45304/0x454BC] Knock threshold: knock is detected when the cylinder's knock signal exceeds its running reference by more than this value." CURVE 0x74326 TGL_VV_VV_SW 74.4 FORMULA_0734 0.0 74.4334 FORMAT "%5.2"
 /begin AXIS_DESCR COM_AXIS FORMULA_0006 16 0.0 10000.0000 AXIS_PTS_REF AXIS_N16 /end AXIS_DESCR
/end CHARACTERISTIC
/begin CHARACTERISTIC GKF_KR_KNOCK_TZ_OFFS "Offset des Klopffensters gegenueber dem Zuendwinkel." MAP 0x74346 TGF_VV_VV_SW 180.0 FORMULA_0710 0.0 180.0000 FORMAT "%4.1"
 /begin AXIS_DESCR COM_AXIS FORMULA_0006 16 0.0 10000.0000 AXIS_PTS_REF AXIS_N16 /end AXIS_DESCR
 /begin AXIS_DESCR COM_AXIS FORMULA_0007 10 0.0 2.0000 AXIS_PTS_REF AXIS_RF10 /end AXIS_DESCR
/end CHARACTERISTIC
/begin CHARACTERISTIC GKF_KR_KNOCK_LAENGE "Laenge des Klopffensters." MAP 0x74486 TGF_VV_VV_SW 180.0 FORMULA_0710 0.0 180.0000 FORMAT "%4.1"
 /begin AXIS_DESCR COM_AXIS FORMULA_0006 16 0.0 10000.0000 AXIS_PTS_REF AXIS_N16 /end AXIS_DESCR
 /begin AXIS_DESCR COM_AXIS FORMULA_0007 10 0.0 2.0000 AXIS_PTS_REF AXIS_RF10 /end AXIS_DESCR
/end CHARACTERISTIC
/begin CHARACTERISTIC GKF_KR_FBS_AVG_OFF_MAX "Zulaessiges Delta zum Mittelwert Engeriespektrum der Klopffrequenz." MAP 0x745C6 TGF_VV_VV_SW 74.4 FORMULA_0734 0.0 74.4334 FORMAT "%5.2"
 /begin AXIS_DESCR COM_AXIS FORMULA_0006 16 0.0 10000.0000 AXIS_PTS_REF AXIS_N16 /end AXIS_DESCR
 /begin AXIS_DESCR COM_AXIS FORMULA_0007 10 0.0 2.0000 AXIS_PTS_REF AXIS_RF10 /end AXIS_DESCR
/end CHARACTERISTIC
/begin CHARACTERISTIC GKF_KR_ANZ_ASP_HOLD "Anzahl der Arbeitsspiele in Haltephase. | [Code V452 IGN 0x454BC] Combustion cycles to hold the retard after a knock (n x intensity) before recovery starts." MAP 0x74706 TGF_VV_VV_UB 255.0 FORMULA_0003 0.0 255.0000
 /begin AXIS_DESCR COM_AXIS FORMULA_0006 12 0.0 10000.0000 AXIS_PTS_REF AXIS_N12 /end AXIS_DESCR
 /begin AXIS_DESCR COM_AXIS fbs FORMULA_0734 12 0.0 74.4334 AXIS_PTS_REF GKL_KR_AXIS_FBS /end AXIS_DESCR
/end CHARACTERISTIC
/begin CHARACTERISTIC GKF_KR_DTZ_AB "Klopfregelungseingriff in Abregelphase. | [Code V452 IGN 0x454BC] Retard step per detected knock (n x knock intensity above threshold). Step is also limited so the result stays above tz_min." MAP 0x74796 TGF_VV_VV_SW 110.0 FORMULA_0111 -50.0000 60.0000 FORMAT "%4.1"
 /begin AXIS_DESCR COM_AXIS FORMULA_0006 12 0.0 10000.0000 AXIS_PTS_REF AXIS_N12 /end AXIS_DESCR
 /begin AXIS_DESCR COM_AXIS fbs FORMULA_0734 12 0.0 74.4334 AXIS_PTS_REF GKL_KR_AXIS_FBS /end AXIS_DESCR
/end CHARACTERISTIC
/begin CHARACTERISTIC GKF_KR_ANZ_ASP_AUF "Anzahl der Arbeitsspiele fuer Aufregelphase. | [Code V452 IGN 0x44FA0/0x454BC] Recovery: the accumulated retard is returned linearly over this many cycles (n x n gradient). Larger = slower recovery." MAP 0x748B6 TGF_VV_VV_UB 254.0 FORMULA_0003 1.0000 255.0000
 /begin AXIS_DESCR COM_AXIS FORMULA_0006 12 0.0 10000.0000 AXIS_PTS_REF AXIS_N12 /end AXIS_DESCR
 /begin AXIS_DESCR COM_AXIS FORMULA_0114 6 -10000.0000 10000.0000 AXIS_PTS_REF AXIS_N_GRAD6 /end AXIS_DESCR
/end CHARACTERISTIC
/begin AXIS_PTS GKL_KR_AXIS_FBS "Stuetzstellen ueber Frequenz-Band-Spektrum." 0x742BA fbs TAD_UB_VV_SW 74.4 FORMULA_0734 12 0.0 74.4334 FORMAT "%5.2" /end AXIS_PTS
/* ------------------ Abschnitt erzeugt aus n_getr.dat ------------------ */
/begin CHARACTERISTIC K_N_GETR_MAX_PERIOD_HS "maximal zulaessige Zahnperiode (*6us) | EN: Maximum permitted tooth period (*6 us) [us]" VALUE 0x78694 TKW_VV_VV_UW 100.0 FORMULA_0839 0.0 393210.0000 /end CHARACTERISTIC
/begin CHARACTERISTIC K_N_GETR_F_HS "Faktor zur Drehzahlberechnung | EN: Factor for engine-speed calculation" VALUE 0x78698 TKW_VV_VV_UL 100.0 FORMULA_0000 0.0 4294967295.0000 /end CHARACTERISTIC
/begin CHARACTERISTIC K_N_GETR_CFG "Schalter Auswahl Getriebeeingangsdrehzahl" VALUE 0x7869C TKW_VV_VV_UB 100.0 FORMULA_0840 0.0 255.0 /end CHARACTERISTIC
/begin CHARACTERISTIC K_N_GETR_ABTRIEB_MIN "Getriebeabtriebssdrehzahl Minimum | EN: Getriebeabtriebssdrehzahl Minimum" VALUE 0x7869E TKW_VV_VV_SW 100.0 FORMULA_0006 -12000.0000 12000.0000 /end CHARACTERISTIC
/begin CHARACTERISTIC K_N_GETR_ABTRIEB_MAX "Getriebeabtriebssdrehzahl Maximum | EN: Getriebeabtriebssdrehzahl Maximum" VALUE 0x786A0 TKW_VV_VV_SW 100.0 FORMULA_0006 0.0 12000.0000 /end CHARACTERISTIC
/begin CHARACTERISTIC K_N_GETR_HS_DIAG_N "Leergasse: Bandgrenze Getr.eing.drehz. - Motordrehzahl | EN: Leergasse: Bandgrenze Getr.eing.drehz. - Motordrehzahl" VALUE 0x786A2 TKW_VV_VV_SW 100.0 FORMULA_0006 0.0 12000.0000 /end CHARACTERISTIC
/begin CHARACTERISTIC K_N_GETR_HS_DIAG_N_KS "Kraftschluss: Bandgrenze Getr.eing.drehz. - Motordrehzahl | EN: Kraftschluss: Bandgrenze Getr.eing.drehz. - Motordrehzahl" VALUE 0x786A4 TKW_VV_VV_SW 100.0 FORMULA_0006 0.0 12000.0000 /end CHARACTERISTIC
/begin CHARACTERISTIC K_N_GETR_HS_DIAG_T "Timergrenze, um Diagnose zu beenden | EN: Timergrenze, um Diagnose zu beenden" VALUE 0x786A6 TKW_VV_VV_UW 100.0 FORMULA_0117 0.0 325.0000 FORMAT "%5.2" /end CHARACTERISTIC
/* ------------------ Abschnitt erzeugt aus vr.dat ------------------ */
/begin CHARACTERISTIC K_VR_REG_CFG "Schalter Freigabe Verstaerkungsregelung." VALUE 0x7A330 TKW_VV_VV_UB 100.0 FORMULA_0574 0.0 1.0 /end CHARACTERISTIC
/begin CHARACTERISTIC K_VR_ED_GAIN "Sollaussteuerung im Fehlerfall." VALUE 0x7A332 TKW_VV_VV_SW 100.0 FORMULA_0449 0.0 16.0000 FORMAT "%5.2" /end CHARACTERISTIC
/begin CHARACTERISTIC K_VR_SOLL "Sollaussteuerung. | EN: Target signal level" VALUE 0x7A334 TKW_VV_VV_SW 100.0 FORMULA_0578 -800.1953 800.1709 FORMAT "%5.2" /end CHARACTERISTIC
/begin CHARACTERISTIC K_VR_PROP_GAIN "Proportionalreglerverstaerkung." VALUE 0x7A336 TKW_VV_VV_SW 100.0 FORMULA_1057 0.0 4.0000 FORMAT "%7.4" /end CHARACTERISTIC
/begin CHARACTERISTIC K_VR_INT_GAIN "Integralreglerverstaerkung." VALUE 0x7A338 TKW_VV_VV_SW 100.0 FORMULA_1057 0.0 4.0000 FORMAT "%7.4" /end CHARACTERISTIC
/begin CHARACTERISTIC K_VR_INI "Initialwert aller Messverstaerkungen." VALUE 0x7A33A TKW_VV_VV_SW 100.0 FORMULA_0449 0.0 16.0000 FORMAT "%5.2" /end CHARACTERISTIC
/begin CHARACTERISTIC K_VR_VORST_MIN "Minimale Verstaerkung der Vorsteuerung. | EN: Minimum gain of the pre-control" VALUE 0x7A33C TKW_VV_VV_SW 100.0 FORMULA_0449 0.0 16.0000 FORMAT "%5.2" /end CHARACTERISTIC
/begin CHARACTERISTIC K_VR_VORST_MAX "Maximale Verstaerkung der Vorsteuerung. | EN: Maximum gain of the pre-control" VALUE 0x7A33E TKW_VV_VV_SW 100.0 FORMULA_0449 0.0 16.0000 FORMAT "%5.2" /end CHARACTERISTIC
/begin CHARACTERISTIC K_VR_REG_MIN_SAT "Minimale Verstaerkung des Reglers." VALUE 0x7A340 TKW_VV_VV_SW 100.0 FORMULA_0449 -16.0000 16.0000 FORMAT "%5.2" /end CHARACTERISTIC
/begin CHARACTERISTIC K_VR_REG_MAX_SAT "Maximale Verstaerkung des Reglers." VALUE 0x7A342 TKW_VV_VV_SW 100.0 FORMULA_0449 -16.0000 16.0000 FORMAT "%5.2" /end CHARACTERISTIC
/begin CHARACTERISTIC K_VR_REG_MIN_IC "Minimale Verstaerkung des Reglers." VALUE 0x7A344 TKW_VV_VV_SW 100.0 FORMULA_0449 -16.0000 16.0000 FORMAT "%5.2" /end CHARACTERISTIC
/begin CHARACTERISTIC K_VR_REG_MAX_IC "Maximale Verstaerkung des Reglers." VALUE 0x7A346 TKW_VV_VV_SW 100.0 FORMULA_0449 -16.0000 16.0000 FORMAT "%5.2" /end CHARACTERISTIC
/begin CHARACTERISTIC K_VR_MESS_MIN_SAT "Minimale Messverstaerkung." VALUE 0x7A348 TKW_VV_VV_SW 100.0 FORMULA_0449 0.0 16.0000 FORMAT "%5.2" /end CHARACTERISTIC
/begin CHARACTERISTIC K_VR_MESS_MAX_SAT "Maximale Messverstaerkung." VALUE 0x7A34A TKW_VV_VV_SW 100.0 FORMULA_0449 0.0 16.0000 FORMAT "%5.2" /end CHARACTERISTIC
/begin CHARACTERISTIC K_VR_MESS_MIN_IC "Minimale Messverstaerkung." VALUE 0x7A34C TKW_VV_VV_SW 100.0 FORMULA_0449 0.0 16.0000 FORMAT "%5.2" /end CHARACTERISTIC
/begin CHARACTERISTIC K_VR_MESS_MAX_IC "Maximale Messverstaerkung." VALUE 0x7A34E TKW_VV_VV_SW 100.0 FORMULA_0449 0.0 16.0000 FORMAT "%5.2" /end CHARACTERISTIC
/begin CHARACTERISTIC K_VR_SAT_0 "Verstaerkungsstufen Ionensatellit." VALUE 0x7A350 TKW_VV_VV_SW 100.0 FORMULA_0449 0.0 16.0000 FORMAT "%5.2" /end CHARACTERISTIC
/begin CHARACTERISTIC K_VR_SAT_1 "Verstaerkungsstufen Ionensatellit." VALUE 0x7A352 TKW_VV_VV_SW 100.0 FORMULA_0449 0.0 16.0000 FORMAT "%5.2" /end CHARACTERISTIC
/begin CHARACTERISTIC K_VR_SAT_2 "Verstaerkungsstufen Ionensatellit." VALUE 0x7A354 TKW_VV_VV_SW 100.0 FORMULA_0449 0.0 16.0000 FORMAT "%5.2" /end CHARACTERISTIC
/begin CHARACTERISTIC K_VR_SAT_3 "Verstaerkungsstufen Ionensatellit." VALUE 0x7A356 TKW_VV_VV_SW 100.0 FORMULA_0449 0.0 16.0000 FORMAT "%5.2" /end CHARACTERISTIC
/begin CHARACTERISTIC K_VR_IC_0 "Verstaerkungsstufen integrierte Spulen." VALUE 0x7A358 TKW_VV_VV_SW 100.0 FORMULA_0449 0.0 16.0000 FORMAT "%5.2" /end CHARACTERISTIC
/begin CHARACTERISTIC K_VR_IC_1 "Verstaerkungsstufen integrierte Spulen." VALUE 0x7A35A TKW_VV_VV_SW 100.0 FORMULA_0449 0.0 16.0000 FORMAT "%5.2" /end CHARACTERISTIC
/begin CHARACTERISTIC K_VR_IC_2 "Verstaerkungsstufen integrierte Spulen." VALUE 0x7A35C TKW_VV_VV_SW 100.0 FORMULA_0449 0.0 16.0000 FORMAT "%5.2" /end CHARACTERISTIC
/begin CHARACTERISTIC K_VR_IC_3 "Verstaerkungsstufen integrierte Spulen." VALUE 0x7A35E TKW_VV_VV_SW 100.0 FORMULA_0449 0.0 16.0000 FORMAT "%5.2" /end CHARACTERISTIC
/begin CHARACTERISTIC K_VR_IC_4 "Verstaerkungsstufen integrierte Spulen." VALUE 0x7A360 TKW_VV_VV_SW 100.0 FORMULA_0449 0.0 16.0000 FORMAT "%5.2" /end CHARACTERISTIC
/begin CHARACTERISTIC K_VR_IC_5 "Verstaerkungsstufen integrierte Spulen." VALUE 0x7A362 TKW_VV_VV_SW 100.0 FORMULA_0449 0.0 16.0000 FORMAT "%5.2" /end CHARACTERISTIC
/begin CHARACTERISTIC K_VR_IC_6 "Verstaerkungsstufen integrierte Spulen." VALUE 0x7A364 TKW_VV_VV_SW 100.0 FORMULA_0449 0.0 16.0000 FORMAT "%5.2" /end CHARACTERISTIC
/begin CHARACTERISTIC K_VR_IC_7 "Verstaerkungsstufen integrierte Spulen." VALUE 0x7A366 TKW_VV_VV_SW 100.0 FORMULA_0449 0.0 16.0000 FORMAT "%5.2" /end CHARACTERISTIC
/begin CHARACTERISTIC K_VR_IC_8 "Verstaerkungsstufen integrierte Spulen." VALUE 0x7A368 TKW_VV_VV_SW 100.0 FORMULA_0449 0.0 16.0000 FORMAT "%5.2" /end CHARACTERISTIC
/begin CHARACTERISTIC K_VR_LP_COEF_1of20_ "Tief-Pass Filter zur Maximalwertbestimmung." VALUE 0x7A36C TKW_VV_VV_SF 100.0 FORMULA_0579 -340282346638528860000000000000000000000.0000 340282346638528860000000000000000000000.0000 FORMAT "%7.4" /end CHARACTERISTIC
/begin CHARACTERISTIC K_VR_LP_COEF_2of20_ "Tief-Pass Filter zur Maximalwertbestimmung." VALUE 0x7A370 TKW_VV_VV_SF 100.0 FORMULA_0579 -340282346638528860000000000000000000000.0000 340282346638528860000000000000000000000.0000 FORMAT "%7.4" /end CHARACTERISTIC
/begin CHARACTERISTIC K_VR_LP_COEF_3of20_ "Tief-Pass Filter zur Maximalwertbestimmung." VALUE 0x7A374 TKW_VV_VV_SF 100.0 FORMULA_0579 -340282346638528860000000000000000000000.0000 340282346638528860000000000000000000000.0000 FORMAT "%7.4" /end CHARACTERISTIC
/begin CHARACTERISTIC K_VR_LP_COEF_4of20_ "Tief-Pass Filter zur Maximalwertbestimmung." VALUE 0x7A378 TKW_VV_VV_SF 100.0 FORMULA_0579 -340282346638528860000000000000000000000.0000 340282346638528860000000000000000000000.0000 FORMAT "%7.4" /end CHARACTERISTIC
/begin CHARACTERISTIC K_VR_LP_COEF_5of20_ "Tief-Pass Filter zur Maximalwertbestimmung." VALUE 0x7A37C TKW_VV_VV_SF 100.0 FORMULA_0579 -340282346638528860000000000000000000000.0000 340282346638528860000000000000000000000.0000 FORMAT "%7.4" /end CHARACTERISTIC
/begin CHARACTERISTIC K_VR_LP_COEF_6of20_ "Tief-Pass Filter zur Maximalwertbestimmung." VALUE 0x7A380 TKW_VV_VV_SF 100.0 FORMULA_0579 -340282346638528860000000000000000000000.0000 340282346638528860000000000000000000000.0000 FORMAT "%7.4" /end CHARACTERISTIC
/begin CHARACTERISTIC K_VR_LP_COEF_7of20_ "Tief-Pass Filter zur Maximalwertbestimmung." VALUE 0x7A384 TKW_VV_VV_SF 100.0 FORMULA_0579 -340282346638528860000000000000000000000.0000 340282346638528860000000000000000000000.0000 FORMAT "%7.4" /end CHARACTERISTIC
/begin CHARACTERISTIC K_VR_LP_COEF_8of20_ "Tief-Pass Filter zur Maximalwertbestimmung." VALUE 0x7A388 TKW_VV_VV_SF 100.0 FORMULA_0579 -340282346638528860000000000000000000000.0000 340282346638528860000000000000000000000.0000 FORMAT "%7.4" /end CHARACTERISTIC
/begin CHARACTERISTIC K_VR_LP_COEF_9of20_ "Tief-Pass Filter zur Maximalwertbestimmung." VALUE 0x7A38C TKW_VV_VV_SF 100.0 FORMULA_0579 -340282346638528860000000000000000000000.0000 340282346638528860000000000000000000000.0000 FORMAT "%7.4" /end CHARACTERISTIC
/begin CHARACTERISTIC K_VR_LP_COEF_10of20_ "Tief-Pass Filter zur Maximalwertbestimmung." VALUE 0x7A390 TKW_VV_VV_SF 100.0 FORMULA_0579 -340282346638528860000000000000000000000.0000 340282346638528860000000000000000000000.0000 FORMAT "%7.4" /end CHARACTERISTIC
/begin CHARACTERISTIC K_VR_LP_COEF_11of20_ "Tief-Pass Filter zur Maximalwertbestimmung." VALUE 0x7A394 TKW_VV_VV_SF 100.0 FORMULA_0579 -340282346638528860000000000000000000000.0000 340282346638528860000000000000000000000.0000 FORMAT "%7.4" /end CHARACTERISTIC
/begin CHARACTERISTIC K_VR_LP_COEF_12of20_ "Tief-Pass Filter zur Maximalwertbestimmung." VALUE 0x7A398 TKW_VV_VV_SF 100.0 FORMULA_0579 -340282346638528860000000000000000000000.0000 340282346638528860000000000000000000000.0000 FORMAT "%7.4" /end CHARACTERISTIC
/begin CHARACTERISTIC K_VR_LP_COEF_13of20_ "Tief-Pass Filter zur Maximalwertbestimmung." VALUE 0x7A39C TKW_VV_VV_SF 100.0 FORMULA_0579 -340282346638528860000000000000000000000.0000 340282346638528860000000000000000000000.0000 FORMAT "%7.4" /end CHARACTERISTIC
/begin CHARACTERISTIC K_VR_LP_COEF_14of20_ "Tief-Pass Filter zur Maximalwertbestimmung." VALUE 0x7A3A0 TKW_VV_VV_SF 100.0 FORMULA_0579 -340282346638528860000000000000000000000.0000 340282346638528860000000000000000000000.0000 FORMAT "%7.4" /end CHARACTERISTIC
/begin CHARACTERISTIC K_VR_LP_COEF_15of20_ "Tief-Pass Filter zur Maximalwertbestimmung." VALUE 0x7A3A4 TKW_VV_VV_SF 100.0 FORMULA_0579 -340282346638528860000000000000000000000.0000 340282346638528860000000000000000000000.0000 FORMAT "%7.4" /end CHARACTERISTIC
/begin CHARACTERISTIC K_VR_LP_COEF_16of20_ "Tief-Pass Filter zur Maximalwertbestimmung." VALUE 0x7A3A8 TKW_VV_VV_SF 100.0 FORMULA_0579 -340282346638528860000000000000000000000.0000 340282346638528860000000000000000000000.0000 FORMAT "%7.4" /end CHARACTERISTIC
/begin CHARACTERISTIC K_VR_LP_COEF_17of20_ "Tief-Pass Filter zur Maximalwertbestimmung." VALUE 0x7A3AC TKW_VV_VV_SF 100.0 FORMULA_0579 -340282346638528860000000000000000000000.0000 340282346638528860000000000000000000000.0000 FORMAT "%7.4" /end CHARACTERISTIC
/begin CHARACTERISTIC K_VR_LP_COEF_18of20_ "Tief-Pass Filter zur Maximalwertbestimmung." VALUE 0x7A3B0 TKW_VV_VV_SF 100.0 FORMULA_0579 -340282346638528860000000000000000000000.0000 340282346638528860000000000000000000000.0000 FORMAT "%7.4" /end CHARACTERISTIC
/begin CHARACTERISTIC K_VR_LP_COEF_19of20_ "Tief-Pass Filter zur Maximalwertbestimmung." VALUE 0x7A3B4 TKW_VV_VV_SF 100.0 FORMULA_0579 -340282346638528860000000000000000000000.0000 340282346638528860000000000000000000000.0000 FORMAT "%7.4" /end CHARACTERISTIC
/begin CHARACTERISTIC K_VR_LP_COEF_20of20_ "Tief-Pass Filter zur Maximalwertbestimmung." VALUE 0x7A3B8 TKW_VV_VV_SF 100.0 FORMULA_0579 -340282346638528860000000000000000000000.0000 340282346638528860000000000000000000000.0000 FORMAT "%7.4" /end CHARACTERISTIC
/begin CHARACTERISTIC K_VR_TEST_SEND_ENABLE "Sender-Freigabe | EN: Test function enable" VALUE 0x7A3BC TKW_VV_VV_UB 100.0 FORMULA_1058 0.0 255.0 /end CHARACTERISTIC
/begin CHARACTERISTIC K_VR_TEST_V_MESS "Verstaerkungsstufe Test. | EN: Test gain stage" VALUE 0x7A3BD TKW_VV_VV_UB 100.0 FORMULA_0003 0.0 7.0000 /end CHARACTERISTIC
/begin CHARACTERISTIC K_VR_TEST_U_MESS "Spannungs-Umschaltung Test. | EN: Test voltage selection" VALUE 0x7A3BE TKW_VV_VV_UB 100.0 FORMULA_1059 0.0 255.0 /end CHARACTERISTIC
/begin CHARACTERISTIC K_VR_TEST_I_SOFT_OFF "Stromschwelle SoftOff Test." VALUE 0x7A3BF TKW_VV_VV_UB 100.0 FORMULA_1060 0.0 255.0 /end CHARACTERISTIC
/begin CHARACTERISTIC KL_VR_VORST_DTZ "Korrekturfaktor ueber Rueckziehwinkel. | EN: Correction factor over retraction angle" CURVE 0x7A3C0 TKL_SW_VV_SW 100.0 FORMULA_0449 0.0 16.0000 /begin AXIS_DESCR STD_AXIS tz FORMULA_0111 8 -50.0000 60.0000 FORMAT "%4.1" /end AXIS_DESCR FORMAT "%5.2" /end CHARACTERISTIC
/begin CHARACTERISTIC GKF_VR_VORST_BAS "Basisvorsteuereung der Erfassungstufe. | EN: Base pre-control of the measuring stage (ion current)" MAP 0x7A3E2 TGF_VV_VV_SW 16.0 FORMULA_0449 0.0 16.0000 FORMAT "%5.2"
 /begin AXIS_DESCR COM_AXIS FORMULA_0006 16 0.0 10000.0000 AXIS_PTS_REF AXIS_N16 /end AXIS_DESCR
 /begin AXIS_DESCR COM_AXIS FORMULA_0007 10 0.0 2.0000 AXIS_PTS_REF AXIS_RF10 /end AXIS_DESCR
/end CHARACTERISTIC
/* ------------------ Abschnitt erzeugt aus v_direkt.dat ------------------ */
/begin CHARACTERISTIC K_V_DIREKT_TAU "TAU Geschwindigkeitserfassung | EN: Time constant, speed sensing" VALUE 0x7A31C TKW_VV_VV_UB 100.0 FORMULA_0462 0.0101 2.5600 /end CHARACTERISTIC
/begin CHARACTERISTIC K_V_DIREKT_FAK "Umrechnungsfaktor | EN: Conversion factor" VALUE 0x7A320 TKW_VV_VV_UL 100.0 FORMULA_0000 0.0 4294967295.0000 /end CHARACTERISTIC
/begin CHARACTERISTIC K_VDIAG_OFFSET "Diagnoseschwelle | EN: Diagnosis threshold" VALUE 0x7A324 TKW_VV_VV_SW 100.0 FORMULA_0078 -80.0000 360.0000 FORMAT "%4.1" /end CHARACTERISTIC
/begin CHARACTERISTIC K_VDIAG_VMAX "max. Diagnoseschwelle | EN: Maximum diagnosis threshold" VALUE 0x7A326 TKW_VV_VV_SW 100.0 FORMULA_0078 -80.0000 400.0000 FORMAT "%4.1" /end CHARACTERISTIC
/begin CHARACTERISTIC K_VDIAG_GRAD_MAX "max. Geschwindigkeitssprung in 10ms | EN: Maximum speed jump in 10 ms" VALUE 0x7A328 TKW_VV_VV_SW 100.0 FORMULA_1061 -80.0000 360.0000 FORMAT "%4.1" /end CHARACTERISTIC
/begin CHARACTERISTIC K_VDIAG_SA_OHNE_V "Timer fuer v-Diagnose | EN: Timer for speed diagnosis" VALUE 0x7A32A TKW_VV_VV_UW 100.0 FORMULA_0021 0.0 655.0000 FORMAT "%5.2" /end CHARACTERISTIC
/begin CHARACTERISTIC K_VDIAG_DN_OHNE_V "dn-Schwelle fuer v-Diagnose | EN: Engine-speed delta threshold for speed diagnosis" VALUE 0x7A32C TKW_VV_VV_SW 100.0 FORMULA_0114 -10000.0000 10000.0000 /end CHARACTERISTIC
/begin CHARACTERISTIC K_V_MAX_NEG_GRAD_E2 "min. Aenderungsbegrenzung - Ebene 2 | EN: Minimum rate limit - level 2 [km/h*10ms]" VALUE 0x7A9CE TKW_VV_VV_SW 100.0 FORMULA_1061 -80.0000 0.0 FORMAT "%4.1" /end CHARACTERISTIC
/begin CHARACTERISTIC K_V_MAX_POS_GRAD_E2 "max. Aenderungsbegrenzung - Ebene 2 | EN: Maximum rate limit - level 2 [km/h*10ms] [V912: differs from V452 160E]" VALUE 0x7A9D0 TKW_VV_VV_SW 100.0 FORMULA_1061 0.0 360.0000 FORMAT "%4.1" /end CHARACTERISTIC
/begin CHARACTERISTIC K_V_MIN_E2 "min. Geschwindigkeit - Ebene 2 | EN: Minimum speed - level 2 [km/h] [V912: differs from V452 160E]" VALUE 0x7A9D2 TKW_VV_VV_SW 100.0 FORMULA_0078 -100.0000 360.0000 FORMAT "%4.1" /end CHARACTERISTIC
/begin CHARACTERISTIC K_V_MAX_E2 "max. Geschwindigkeit - Ebene 2 | EN: Maximum speed - level 2 [km/h] [V912: differs from V452 160E]" VALUE 0x7A9D4 TKW_VV_VV_SW 100.0 FORMULA_0078 -80.0000 400.0000 FORMAT "%4.1" /end CHARACTERISTIC
/begin FUNCTION Eigendiagnose ""
 /begin DEF_CHARACTERISTIC K_ED_TUMG.DEC_VOR_EINTRAG K_ED_TUMG.FEHLERSCHWELLE K_ED_TUMG.INC_NACH_EINTRAG K_ED_TUMG.INC_VOR_EINTRAG K_ED_TUMG.KLASSENINDEX K_ED_TUMG.OK_SCHWELLE K_ED_TUMG.P_CODE_OPENLOAD K_ED_TUMG.P_CODE_SH_TO_GND K_ED_TUMG.P_CODE_SH_TO_UB K_ED_TUMG.P_CODE_UNPLAUSIBEL K_ED_TUMG_OBD.DEC_NACH_EINTRAG K_ED_TUMG_OBD.DEC_VOR_EINTRAG K_ED_TUMG_OBD.FEHLERSCHWELLE K_ED_TUMG_OBD.INC_NACH_EINTRAG K_ED_TUMG_OBD.INC_VOR_EINTRAG K_ED_TUMG_OBD.KLASSENINDEX K_ED_TUMG_OBD.OK_SCHWELLE K_ED_TUMG_OBD.P_CODE_OPENLOAD K_ED_TUMG_OBD.P_CODE_SH_TO_GND K_ED_TUMG_OBD.P_CODE_SH_TO_UB K_ED_TUMG_OBD.P_CODE_UNPLAUSIBEL K_ED_UB.DEC_NACH_EINTRAG K_ED_UB.DEC_VOR_EINTRAG K_ED_UB.FEHLERSCHWELLE K_ED_UB.INC_NACH_EINTRAG K_ED_UB.INC_VOR_EINTRAG K_ED_UB.KLASSENINDEX K_ED_UB.OK_SCHWELLE K_ED_UB.P_CODE_OPENLOAD K_ED_UB.P_CODE_SH_TO_GND K_ED_UB.P_CODE_SH_TO_UB K_ED_UB.P_CODE_UNPLAUSIBEL K_ED_UBMIN K_ED_UEXT_111219514.DEC_NACH_EINTRAG K_ED_UEXT_111219514.DEC_VOR_EINTRAG K_ED_UEXT_111219514.FEHLERSCHWELLE K_ED_UEXT_111219514.INC_NACH_EINTRAG K_ED_UEXT_111219514.INC_VOR_EINTRAG K_ED_UEXT_111219514.KLASSENINDEX K_ED_UEXT_111219514.OK_SCHWELLE K_ED_UEXT_111219514.P_CODE_OPENLOAD K_ED_UEXT_111219514.P_CODE_SH_TO_GND K_ED_UEXT_111219514.P_CODE_SH_TO_UB K_ED_UEXT_111219514.P_CODE_UNPLAUSIBEL K_ED_UEXT_124_512.DEC_NACH_EINTRAG K_ED_UEXT_124_512.DEC_VOR_EINTRAG K_ED_UEXT_124_512.FEHLERSCHWELLE K_ED_UEXT_124_512.INC_NACH_EINTRAG K_ED_UEXT_124_512.INC_VOR_EINTRAG K_ED_UEXT_124_512.KLASSENINDEX K_ED_UEXT_124_512.OK_SCHWELLE K_ED_UEXT_124_512.P_CODE_OPENLOAD K_ED_UEXT_124_512.P_CODE_SH_TO_GND K_ED_UEXT_124_512.P_CODE_SH_TO_UB K_ED_UEXT_124_512.P_CODE_UNPLAUSIBEL K_ED_V_DIREKT.DEC_NACH_EINTRAG K_ED_V_DIREKT.DEC_VOR_EINTRAG K_ED_V_DIREKT.FEHLERSCHWELLE K_ED_V_DIREKT.INC_NACH_EINTRAG K_ED_V_DIREKT.INC_VOR_EINTRAG K_ED_V_DIREKT.KLASSENINDEX K_ED_V_DIREKT.OK_SCHWELLE K_ED_V_DIREKT.P_CODE_OPENLOAD K_ED_V_DIREKT.P_CODE_SH_TO_GND K_ED_V_DIREKT.P_CODE_SH_TO_UB K_ED_V_DIREKT.P_CODE_UNPLAUSIBEL K_ED_WUC_DELTA_TMOT K_ED_WUC_TMOT_MIN K_ED_ZOELP1.DEC_NACH_EINTRAG K_ED_ZOELP1.DEC_VOR_EINTRAG K_ED_ZOELP1.FEHLERSCHWELLE K_ED_ZOELP1.INC_NACH_EINTRAG K_ED_ZOELP1.INC_VOR_EINTRAG K_ED_ZOELP1.KLASSENINDEX K_ED_ZOELP1.OK_SCHWELLE K_ED_ZOELP1.P_CODE_OPENLOAD K_ED_ZOELP1.P_CODE_SH_TO_GND K_ED_ZOELP1.P_CODE_SH_TO_UB K_ED_ZOELP1.P_CODE_UNPLAUSIBEL K_ED_ZOELP2.DEC_NACH_EINTRAG K_ED_ZOELP2.DEC_VOR_EINTRAG K_ED_ZOELP2.FEHLERSCHWELLE K_ED_ZOELP2.INC_NACH_EINTRAG K_ED_ZOELP2.INC_VOR_EINTRAG K_ED_ZOELP2.KLASSENINDEX K_ED_ZOELP2.OK_SCHWELLE K_ED_ZOELP2.P_CODE_OPENLOAD K_ED_ZOELP2.P_CODE_SH_TO_GND K_ED_ZOELP2.P_CODE_SH_TO_UB K_ED_ZOELP2.P_CODE_UNPLAUSIBEL /end DEF_CHARACTERISTIC
/end FUNCTION
/begin FUNCTION Ercosek_SC "" /begin DEF_CHARACTERISTIC K_DIAGNOSE_INDEX_HI K_DIAGNOSE_INDEX_LO /end DEF_CHARACTERISTIC /begin REF_CHARACTERISTIC /end REF_CHARACTERISTIC /begin IN_MEASUREMENT /end IN_MEASUREMENT /begin OUT_MEASUREMENT /end OUT_MEASUREMENT /end FUNCTION
/begin FUNCTION FGR ""
 /begin DEF_CHARACTERISTIC KF_FGR_FAK_V_WA KF_FGR_KR KF_FGR_KR_CONST KF_FGR_TN KF_FGR_TN_CONST KF_FGR_TV KF_FGR_TV_CONST KF_FGR_VORST KF_FGR_VORST_UP KL_FGR_FAK_T_BESCHL KL_FGR_FAK_T_VERZ KL_FGR_FAK_T_WA KL_FGR_FAK_V_TIP KL_FGR_KOEFF_WICHT KL_FGR_KR_FAK KL_FGR_MD_FW_LL KL_FGR_MD_RAMPE_DELTA KL_FGR_TN_FAK KL_FGR_TV_FAK KL_FGR_VAHA_DIAG KL_FGR_VERZ_WA KL_FGR_V_FIL_A1 KL_FGR_V_FIL_B1 KL_FGR_V_FIL_B2 KL_FGR_V_SA_SPERRE K_FGR_A1 K_FGR_AX_MAX K_FGR_AX_TAU K_FGR_BESCHL_KOMFORT K_FGR_BESCHL_NORMAL K_FGR_BESCHL_SPORT K_FGR_BESCHL_TIP K_FGR_BESCHL_WA_KOMFORT K_FGR_BESCHL_WA_NORMAL K_FGR_BESCHL_WA_SPORT K_FGR_CFG_VORST K_FGR_CFG_V_IST K_FGR_CFG_V_MAX K_FGR_DSC_BLS_T K_FGR_DSC_MD_BLS_T K_FGR_DSC_MD_T K_FGR_EIN K_FGR_FAK_V_KOMFORT K_FGR_FAK_V_MAX K_FGR_FAK_V_MIN K_FGR_FAK_V_NORMAL K_FGR_FAK_V_SPORT K_FGR_FAK_V_TIP K_FGR_FSP_EIN K_FGR_MARKE_CFG K_FGR_MD_DELTA K_FGR_MD_FW_HYS K_FGR_MD_FW_LL_HYS K_FGR_MSW_T_MIN K_FGR_N_DIF_DIAG_T K_FGR_N_DIF_MAX K_FGR_N_MAX K_FGR_SMG_MCS K_FGR_STATE_AG K_FGR_STEP_T_MIN K_FGR_STUFE_KMH K_FGR_STUFE_MPH K_FGR_TIP_T_MIN K_FGR_T_AUS K_FGR_T_CONSTF_RAMPE K_FGR_T_FEHLER_E2 K_FGR_T_MIN_SA K_FGR_T_STRICH K_FGR_T_UEBERHOL_MAX K_FGR_VAHA_DIAG_T K_FGR_VERZ K_FGR_VERZ_TIP K_FGR_V_DIAG K_FGR_V_DIAG_T K_FGR_V_DIF_MAX K_FGR_V_DIF_MAX_AUFST K_FGR_V_DIF_MAX_LL K_FGR_V_DIF_MIN K_FGR_V_DIF_MIN_AUFST K_FGR_V_DIF_MIN_LL K_FGR_V_DIF_MIN_UEBERHOL K_FGR_V_FEHLER_T K_FGR_V_IST_MIN K_FGR_V_IST_TAU K_FGR_V_MAX K_FGR_V_SOLL_DIF_KONST K_FGR_V_SOLL_DIF_MAX K_FGR_V_SOLL_DIF_MIN K_FGR_V_SOLL_MAX_HYS K_FGR_V_SOLL_MAX_KMH K_FGR_V_SOLL_MAX_MPH K_FGR_V_SOLL_MAX_T K_FGR_V_SOLL_MIN_KMH K_FGR_V_SOLL_MIN_KMH_E2 K_FGR_V_SOLL_MIN_MPH K_FGR_V_SOLL_MIN_MPH_E2 K_FGR_V_SOLL_OFFSET K_FGR_V_TIP_INC_DEC /end DEF_CHARACTERISTIC
 /begin REF_CHARACTERISTIC /end REF_CHARACTERISTIC
 /begin IN_MEASUREMENT /end IN_MEASUREMENT
 /begin OUT_MEASUREMENT /end OUT_MEASUREMENT
/end FUNCTION
/begin FUNCTION Fahrzeuggeschwindigkeit ""
 /begin DEF_CHARACTERISTIC K_VDIAG_DN_OHNE_V K_VDIAG_GRAD_MAX K_VDIAG_OFFSET K_VDIAG_SA_OHNE_V K_VDIAG_VMAX K_V_DIREKT_FAK K_V_DIREKT_TAU K_V_MAX_E2 K_V_MAX_NEG_GRAD_E2 K_V_MAX_POS_GRAD_E2 K_V_MIN_E2 /end DEF_CHARACTERISTIC
 /begin REF_CHARACTERISTIC /end REF_CHARACTERISTIC
 /begin IN_MEASUREMENT /end IN_MEASUREMENT
 /begin OUT_MEASUREMENT /end OUT_MEASUREMENT
/end FUNCTION
/begin FUNCTION Flashservice "" /begin DEF_CHARACTERISTIC /end DEF_CHARACTERISTIC /begin REF_CHARACTERISTIC /end REF_CHARACTERISTIC /begin IN_MEASUREMENT /end IN_MEASUREMENT /begin OUT_MEASUREMENT /end OUT_MEASUREMENT /end FUNCTION
/begin FUNCTION Fuellungsadaption ""
 /begin DEF_CHARACTERISTIC KL_FRA_XSI_PSAU K_FRA_AQ_ADAPT_MAX K_FRA_AQ_ADAPT_MIN K_FRA_AQ_DELTA_FAST K_FRA_AQ_DELTA_SLOW K_FRA_AQ_MAX_FAST K_FRA_AQ_MAX_SLOW K_FRA_CFG K_FRA_FR_I_REG_SCHW K_FRA_GRUNDLECKLUFT K_FRA_RF_DELTA_SCHW K_FRA_RF_MAX K_FRA_TMOT_SCHW K_FRA_WAIT /end DEF_CHARACTERISTIC
 /begin REF_CHARACTERISTIC /end REF_CHARACTERISTIC
 /begin IN_MEASUREMENT /end IN_MEASUREMENT
 /begin OUT_MEASUREMENT /end OUT_MEASUREMENT
/end FUNCTION
/begin FUNCTION Fuellungsregler ""
 /begin DEF_CHARACTERISTIC KF_FR_RF_DELTA_REL_HYS KL_FR_DRREL_MAX_N KL_FR_IANT K_FR_ADAPT_SCHW_1of8_ K_FR_ADAPT_SCHW_2of8_ K_FR_ADAPT_SCHW_3of8_ K_FR_ADAPT_SCHW_4of8_ K_FR_ADAPT_SCHW_5of8_ K_FR_ADAPT_SCHW_6of8_ K_FR_ADAPT_SCHW_7of8_ K_FR_ADAPT_SCHW_8of8_ K_FR_ADAPT_TAU K_FR_CFG K_FR_DI_ENTDR K_FR_DRREL_MAX K_FR_EDK_DIFF K_FR_EINGER_HYS K_FR_EINGER_SCHW K_FR_IMAX K_FR_IMIN K_FR_START_DELAY /end DEF_CHARACTERISTIC
 /begin REF_CHARACTERISTIC /end REF_CHARACTERISTIC
 /begin IN_MEASUREMENT /end IN_MEASUREMENT
 /begin OUT_MEASUREMENT /end OUT_MEASUREMENT
/end FUNCTION
/begin FUNCTION GETR ""
 /begin DEF_CHARACTERISTIC K_N_GETR_ABTRIEB_MAX K_N_GETR_ABTRIEB_MIN K_N_GETR_CFG K_N_GETR_F_HS K_N_GETR_HS_DIAG_N K_N_GETR_HS_DIAG_N_KS K_N_GETR_HS_DIAG_T K_N_GETR_MAX_PERIOD_HS /end DEF_CHARACTERISTIC
 /begin REF_CHARACTERISTIC /end REF_CHARACTERISTIC
 /begin IN_MEASUREMENT /end IN_MEASUREMENT
 /begin OUT_MEASUREMENT /end OUT_MEASUREMENT
/end FUNCTION
/begin FUNCTION Gangerkennung ""
 /begin DEF_CHARACTERISTIC KL_GANG_I_HS KL_GANG_I_SMG K_GANG_1_TIMER_MAX K_GANG_GLG_TIMER_MAX K_GANG_I_HA_ADAPT_CNT_MAX K_GANG_I_HA_ADAPT_GANG_MAX_HS K_GANG_I_HA_ADAPT_GANG_MIN_HS K_GANG_I_HA_ADAPT_MAX K_GANG_I_HA_ADAPT_MD_MAX_HS K_GANG_I_HA_ADAPT_MD_MIN_HS K_GANG_I_HA_ADAPT_MIN K_GANG_I_HA_ADAPT_SCHLUPF_MIN_HS K_GANG_I_HA_ADAPT_V_MAX_HS K_GANG_I_HA_ADAPT_V_MIN_HS K_GANG_I_HA_HS K_GANG_I_HA_SMG K_GANG_I_RW_HS K_GANG_I_RW_SMG K_GANG_N_VERH_MAX K_GANG_N_VERH_MIN K_GANG_R_RAD_DYN_NV /end DEF_CHARACTERISTIC
 /begin REF_CHARACTERISTIC /end REF_CHARACTERISTIC
 /begin IN_MEASUREMENT /end IN_MEASUREMENT
 /begin OUT_MEASUREMENT /end OUT_MEASUREMENT
/end FUNCTION
/begin FUNCTION Global "" /begin DEF_CHARACTERISTIC /end DEF_CHARACTERISTIC /begin REF_CHARACTERISTIC /end REF_CHARACTERISTIC /begin IN_MEASUREMENT /end IN_MEASUREMENT /begin OUT_MEASUREMENT /end OUT_MEASUREMENT /end FUNCTION
/begin FUNCTION Gruppenkennlinien "" /begin DEF_CHARACTERISTIC AXIS_N10 AXIS_N12 AXIS_N16 AXIS_N_GRAD6 AXIS_RF10 /end DEF_CHARACTERISTIC /begin REF_CHARACTERISTIC /end REF_CHARACTERISTIC /begin IN_MEASUREMENT /end IN_MEASUREMENT /begin OUT_MEASUREMENT /end OUT_MEASUREMENT /end FUNCTION
/begin FUNCTION Inter_Prozessor_Kommunikation "" /begin DEF_CHARACTERISTIC K_IPK_INJ_T_SYNC_MAX /end DEF_CHARACTERISTIC /begin REF_CHARACTERISTIC /end REF_CHARACTERISTIC /begin IN_MEASUREMENT /end IN_MEASUREMENT /begin OUT_MEASUREMENT /end OUT_MEASUREMENT /end FUNCTION
/begin FUNCTION Ionenstrom ""
 /begin DEF_CHARACTERISTIC GKF_VR_VORST_BAS KL_VR_VORST_DTZ K_ISS_ADC_MAX K_ISS_ADC_MIN K_ISS_KLIPPING_MAX K_ISS_MAX_DELTA K_ISS_TIME_MS_MIN K_VR_ED_GAIN K_VR_IC_0 K_VR_IC_1 K_VR_IC_2 K_VR_IC_3 K_VR_IC_4 K_VR_IC_5 K_VR_IC_6 K_VR_IC_7 K_VR_IC_8 K_VR_INI K_VR_INT_GAIN K_VR_LP_COEF_10of20_ K_VR_LP_COEF_11of20_ K_VR_LP_COEF_12of20_ K_VR_LP_COEF_13of20_ K_VR_LP_COEF_14of20_ K_VR_LP_COEF_15of20_ K_VR_LP_COEF_16of20_ K_VR_LP_COEF_17of20_ K_VR_LP_COEF_18of20_ K_VR_LP_COEF_19of20_ K_VR_LP_COEF_1of20_ K_VR_LP_COEF_20of20_ K_VR_LP_COEF_2of20_ K_VR_LP_COEF_3of20_ K_VR_LP_COEF_4of20_ K_VR_LP_COEF_5of20_ K_VR_LP_COEF_6of20_ K_VR_LP_COEF_7of20_ K_VR_LP_COEF_8of20_ K_VR_LP_COEF_9of20_ K_VR_MESS_MAX_IC K_VR_MESS_MAX_SAT K_VR_MESS_MIN_IC K_VR_MESS_MIN_SAT K_VR_PROP_GAIN K_VR_REG_CFG K_VR_REG_MAX_IC K_VR_REG_MAX_SAT K_VR_REG_MIN_IC K_VR_REG_MIN_SAT K_VR_SAT_0 K_VR_SAT_1 K_VR_SAT_2 K_VR_SAT_3 K_VR_SOLL K_VR_TEST_I_SOFT_OFF K_VR_TEST_SEND_ENABLE K_VR_TEST_U_MESS K_VR_TEST_V_MESS K_VR_VORST_MAX K_VR_VORST_MIN /end DEF_CHARACTERISTIC
 /begin REF_CHARACTERISTIC /end REF_CHARACTERISTIC
 /begin IN_MEASUREMENT /end IN_MEASUREMENT
 /begin OUT_MEASUREMENT /end OUT_MEASUREMENT
/end FUNCTION
/begin FUNCTION KFIPOL "" /begin DEF_CHARACTERISTIC /end DEF_CHARACTERISTIC /begin REF_CHARACTERISTIC /end REF_CHARACTERISTIC /begin IN_MEASUREMENT /end IN_MEASUREMENT /begin OUT_MEASUREMENT /end OUT_MEASUREMENT /end FUNCTION
/begin FUNCTION KIS-Schnittstelle "" /begin DEF_CHARACTERISTIC K_KIS_ACTIVE_PULSE K_KIS_LEN K_KIS_START K_KIS_TIME_OUT /end DEF_CHARACTERISTIC /begin REF_CHARACTERISTIC /end REF_CHARACTERISTIC /begin IN_MEASUREMENT /end IN_MEASUREMENT /begin OUT_MEASUREMENT /end OUT_MEASUREMENT /end FUNCTION
/begin FUNCTION KWP-Jobs "" /begin DEF_CHARACTERISTIC /end DEF_CHARACTERISTIC /begin REF_CHARACTERISTIC /end REF_CHARACTERISTIC /begin IN_MEASUREMENT /end IN_MEASUREMENT /begin OUT_MEASUREMENT /end OUT_MEASUREMENT /end FUNCTION
/begin FUNCTION KWP-Programmierung "" /begin DEF_CHARACTERISTIC /end DEF_CHARACTERISTIC /begin REF_CHARACTERISTIC /end REF_CHARACTERISTIC /begin IN_MEASUREMENT /end IN_MEASUREMENT /begin OUT_MEASUREMENT /end OUT_MEASUREMENT /end FUNCTION
/begin FUNCTION Kh ""
 /begin DEF_CHARACTERISTIC KF_KH_RG_OPT KF_KH_TZ_ABS_TMOT_F KF_KH_TZ_ETA_AB KF_KH_TZ_ETA_AUF KF_KH_TZ_ETA_GRUND KF_KH_TZ_ETA_LL KF_KH_TZ_GRUND KF_KH_TZ_LL KF_KH_VAN_TMOT_F KL_KH_ALT_OFFSET KL_KH_TZ_ABS_AUF_TMOT KL_KH_TZ_ABS_INIT KL_KH_TZ_DELAY_TMOT KL_KH_TZ_PUMG_F KL_KH_T_MAX KL_KH_VAN_AUF_TMOT_A KL_KH_VAN_AUF_TMOT_E KL_KH_VAN_DELAY_TMOT KL_KH_VAN_RG_REG_I KL_KH_VAN_RG_REG_P K_KH_N_MAX K_KH_N_MAX_HYS K_KH_PKSR_PL_TMOT_MIN K_KH_RF_MAX K_KH_RF_MAX_HYS K_KH_SMG_TMOT_MAX K_KH_SMG_TMOT_MIN K_KH_TKAT_CFG K_KH_TKAT_ENDE K_KH_TKAT_HYST K_KH_TZ_AB K_KH_TZ_ABS_AB K_KH_TZ_AUF K_KH_TZ_CFG K_KH_VAN_AB_Auslass K_KH_VAN_AB_Einlass K_KH_VAN_CFG K_KH_VAN_TMOT_MAX K_KH_VAN_VO_FAKT K_KH_VAN_VO_I_MAX /end DEF_CHARACTERISTIC
 /begin REF_CHARACTERISTIC /end REF_CHARACTERISTIC
 /begin IN_MEASUREMENT /end IN_MEASUREMENT
 /begin OUT_MEASUREMENT /end OUT_MEASUREMENT
/end FUNCTION
/begin FUNCTION Klopfadaption ""
 /begin DEF_CHARACTERISTIC GKL_KA_ADAPT_MIN KF_KA_F KF_KA_F_K KF_KA_OFFS KF_KA_OFFS_VL KF_KA_T_KOMP KL_KA_F_VL KL_KA_PUMG_VL KL_KA_RF_MIN K_KA_ADAPT_MAX K_KA_AQ_GRAD_MAX K_KA_AQ_GRAD_SEGM_CNT K_KA_DIAG_T K_KA_DTZ_MAX K_KA_FILT_KK_KA K_KA_FILT_KK_KKA K_KA_FILT_LK K_KA_FILT_SK K_KA_KLIPPING_MAX K_KA_KS_CFG K_KA_RESET_CFG K_KA_TP_TAU K_KA_TREPP_F K_KA_TZ_KS K_KA_TZ_MIN_HYST /end DEF_CHARACTERISTIC
 /begin REF_CHARACTERISTIC /end REF_CHARACTERISTIC
 /begin IN_MEASUREMENT /end IN_MEASUREMENT
 /begin OUT_MEASUREMENT /end OUT_MEASUREMENT
/end FUNCTION
/begin FUNCTION Klopfregelung ""
 /begin DEF_CHARACTERISTIC GKF_KR_ANZ_ASP_AUF GKF_KR_ANZ_ASP_HOLD GKF_KR_DTZ_AB GKF_KR_FBS_AVG_OFF_MAX GKF_KR_KNOCK_LAENGE GKF_KR_KNOCK_TZ_OFFS GKL_KR_AXIS_FBS GKL_KR_DTZ_MAX GKL_KR_FBS_AVG_OFF_MAX GKL_KR_RF_MIN KL_KR_FBS_AVG_NO K_KR_APPL_CFG K_KR_APPL_DTZ_ZYL1 K_KR_APPL_DTZ_ZYL10 K_KR_APPL_DTZ_ZYL2 K_KR_APPL_DTZ_ZYL3 K_KR_APPL_DTZ_ZYL4 K_KR_APPL_DTZ_ZYL5 K_KR_APPL_DTZ_ZYL6 K_KR_APPL_DTZ_ZYL7 K_KR_APPL_DTZ_ZYL8 K_KR_APPL_DTZ_ZYL9 K_KR_APPL_NUM_ZYL1 K_KR_APPL_NUM_ZYL10 K_KR_APPL_NUM_ZYL2 K_KR_APPL_NUM_ZYL3 K_KR_APPL_NUM_ZYL4 K_KR_APPL_NUM_ZYL5 K_KR_APPL_NUM_ZYL6 K_KR_APPL_NUM_ZYL7 K_KR_APPL_NUM_ZYL8 K_KR_APPL_NUM_ZYL9 K_KR_APPL_PER K_KR_CFG K_KR_DIAG_T K_KR_FB_LEN K_KR_FB_START K_KR_KLIPPING_MAX K_KR_TMOT_MIN /end DEF_CHARACTERISTIC
 /begin REF_CHARACTERISTIC /end REF_CHARACTERISTIC
 /begin IN_MEASUREMENT /end IN_MEASUREMENT
 /begin OUT_MEASUREMENT /end OUT_MEASUREMENT
/end FUNCTION
/begin RECORD_LAYOUT TKW_VV_VV_UB FNC_VALUES 1 UBYTE COLUMN_DIR DIRECT /end RECORD_LAYOUT
/begin RECORD_LAYOUT TKW_VV_VV_SB FNC_VALUES 1 SBYTE COLUMN_DIR DIRECT /end RECORD_LAYOUT
/begin RECORD_LAYOUT TKW_VV_VV_UW FNC_VALUES 1 UWORD COLUMN_DIR DIRECT /end RECORD_LAYOUT
/begin RECORD_LAYOUT TKW_VV_VV_SW FNC_VALUES 1 SWORD COLUMN_DIR DIRECT /end RECORD_LAYOUT
/begin RECORD_LAYOUT TKW_VV_VV_UL FNC_VALUES 1 ULONG COLUMN_DIR DIRECT /end RECORD_LAYOUT
/begin RECORD_LAYOUT TKW_VV_VV_SF FNC_VALUES 1 FLOAT32_IEEE COLUMN_DIR DIRECT /end RECORD_LAYOUT
/begin RECORD_LAYOUT TKL_UB_VV_UB NO_AXIS_PTS_X 1 UBYTE RESERVED 2 BYTE AXIS_PTS_X 3 UBYTE INDEX_INCR DIRECT FNC_VALUES 4 UBYTE COLUMN_DIR DIRECT /end RECORD_LAYOUT
/begin RECORD_LAYOUT TKL_UW_VV_UW NO_AXIS_PTS_X 1 UBYTE RESERVED 2 BYTE AXIS_PTS_X 3 UWORD INDEX_INCR DIRECT FNC_VALUES 4 UWORD COLUMN_DIR DIRECT /end RECORD_LAYOUT
/begin RECORD_LAYOUT TKL_UW_VV_SW NO_AXIS_PTS_X 1 UBYTE RESERVED 2 BYTE AXIS_PTS_X 3 UWORD INDEX_INCR DIRECT FNC_VALUES 4 SWORD COLUMN_DIR DIRECT /end RECORD_LAYOUT
/begin RECORD_LAYOUT TKL_SW_VV_UB NO_AXIS_PTS_X 1 UBYTE RESERVED 2 BYTE AXIS_PTS_X 3 SWORD INDEX_INCR DIRECT FNC_VALUES 4 UBYTE COLUMN_DIR DIRECT /end RECORD_LAYOUT
/begin RECORD_LAYOUT TKL_SW_VV_UW NO_AXIS_PTS_X 1 UBYTE RESERVED 2 BYTE AXIS_PTS_X 3 SWORD INDEX_INCR DIRECT FNC_VALUES 4 UWORD COLUMN_DIR DIRECT /end RECORD_LAYOUT
/begin RECORD_LAYOUT TKL_SW_VV_SW NO_AXIS_PTS_X 1 UBYTE RESERVED 2 BYTE AXIS_PTS_X 3 SWORD INDEX_INCR DIRECT FNC_VALUES 4 SWORD COLUMN_DIR DIRECT /end RECORD_LAYOUT
/begin RECORD_LAYOUT TKF_SW_SW_UB NO_AXIS_PTS_X 1 UBYTE NO_AXIS_PTS_Y 2 UBYTE AXIS_PTS_X 3 SWORD INDEX_INCR DIRECT AXIS_PTS_Y 4 SWORD INDEX_INCR DIRECT FNC_VALUES 5 UBYTE COLUMN_DIR DIRECT /end RECORD_LAYOUT
/begin RECORD_LAYOUT TKF_SW_SW_UW NO_AXIS_PTS_X 1 UBYTE NO_AXIS_PTS_Y 2 UBYTE AXIS_PTS_X 3 SWORD INDEX_INCR DIRECT AXIS_PTS_Y 4 SWORD INDEX_INCR DIRECT FNC_VALUES 5 UWORD COLUMN_DIR DIRECT /end RECORD_LAYOUT
/begin RECORD_LAYOUT TKF_SW_SW_SW NO_AXIS_PTS_X 1 UBYTE NO_AXIS_PTS_Y 2 UBYTE AXIS_PTS_X 3 SWORD INDEX_INCR DIRECT AXIS_PTS_Y 4 SWORD INDEX_INCR DIRECT FNC_VALUES 5 SWORD COLUMN_DIR DIRECT /end RECORD_LAYOUT
/begin RECORD_LAYOUT TGL_VV_VV_SW FNC_VALUES 1 SWORD COLUMN_DIR DIRECT /end RECORD_LAYOUT
/begin RECORD_LAYOUT TGF_VV_VV_UB FNC_VALUES 1 UBYTE COLUMN_DIR DIRECT /end RECORD_LAYOUT
/begin RECORD_LAYOUT TGF_VV_VV_SW FNC_VALUES 1 SWORD COLUMN_DIR DIRECT /end RECORD_LAYOUT
/begin RECORD_LAYOUT TAD_UB_VV_SW NO_AXIS_PTS_X 1 UBYTE RESERVED 2 BYTE AXIS_PTS_X 3 SWORD INDEX_INCR DIRECT /end RECORD_LAYOUT
/end MODULE
/end PROJECT
