/begin PROJECT MSS65-ign-V912 "MSS65 IGN - V912.00-B204.00, data set 0569Q60Z520E"
/begin HEADER "" VERSION "V912.00-B204.00" /end HEADER
/begin MODULE _MSS65-ign "MSS65 IGN - V912.00-B204.00, data 7842800"
/begin MOD_COMMON "" BYTE_ORDER MSB_FIRST /* Default byteorder (Motorola) */ /end MOD_COMMON
/begin COMPU_METHOD FORMULA_0001 "FORMULA_0001" RAT_FUNC "%6.1" "%" COEFFS 0 10 0 0 0 1 /end COMPU_METHOD
/begin COMPU_METHOD FORMULA_0003 "FORMULA_0003" RAT_FUNC "%3.0" "-" COEFFS 0 1 0 0 0 1 /end COMPU_METHOD
/begin COMPU_METHOD FORMULA_0006 "FORMULA_0006" RAT_FUNC "%5.0" "Upm" COEFFS 0 1 0 0 0 1 /end COMPU_METHOD
/begin COMPU_METHOD FORMULA_0008 "FORMULA_0008" RAT_FUNC "%6.1" "V" COEFFS 0 10 0 0 0 1 /end COMPU_METHOD
/begin COMPU_METHOD FORMULA_0009 "FORMULA_0009" RAT_FUNC "%6.1" "Nm" COEFFS 0 10 0 0 0 1 /end COMPU_METHOD
/begin COMPU_METHOD FORMULA_0010 "FORMULA_0010" RAT_FUNC "%5.0" "-" COEFFS 0 1 0 0 0 1 /end COMPU_METHOD
/begin COMPU_METHOD FORMULA_0021 "FORMULA_0021" RAT_FUNC "%7.2" "s" COEFFS 0 100 0 0 0 1 /end COMPU_METHOD
/* ------------------ Abschnitt erzeugt aus adapt_glob.dat ------------------ */
/begin COMPU_METHOD FORMULA_0023 "FORMULA_0023" RAT_FUNC "%6.1" "�C" COEFFS 0 10 2732 0 0 1 /end COMPU_METHOD
/begin COMPU_METHOD FORMULA_0033 "FORMULA_0033" RAT_FUNC "%5.2" "-" COEFFS 0 1 0 0 0 1 /end COMPU_METHOD
/begin COMPU_METHOD FORMULA_0062 "FORMULA_0062" RAT_FUNC "%5.0" "s" COEFFS 0 1 0 0 0 1 /end COMPU_METHOD
/begin COMPU_METHOD FORMULA_0073 "FORMULA_0073" RAT_FUNC "%6.1" "s" COEFFS 0 10 0 0 0 1 /end COMPU_METHOD
/begin COMPU_METHOD FORMULA_0075 "FORMULA_0075" RAT_FUNC "%8.3" "-" COEFFS 0 1024 0 0 0 1 /end COMPU_METHOD
/begin COMPU_METHOD FORMULA_0076 "FORMULA_0076" RAT_FUNC "%6.1" "Kelvin" COEFFS 0 10 0 0 0 1 /end COMPU_METHOD
/begin COMPU_METHOD FORMULA_0078 "FORMULA_0078" RAT_FUNC "%6.1" "km/h" COEFFS 0 16 0 0 0 1 /end COMPU_METHOD
/begin COMPU_METHOD FORMULA_0114 "FORMULA_0114" RAT_FUNC "%5.0" "Upm/s" COEFFS 0 1 0 0 0 1 /end COMPU_METHOD
/begin COMPU_METHOD FORMULA_0117 "FORMULA_0117" RAT_FUNC "%7.2" "s" COEFFS 0 200 0 0 0 1 /end COMPU_METHOD
/begin COMPU_METHOD FORMULA_0132 "FORMULA_0132" RAT_FUNC "%7.2" "m/(s*s)" COEFFS 0 40 0 0 0 1 /end COMPU_METHOD
/begin COMPU_METHOD FORMULA_0152 "FORMULA_0152" RAT_FUNC "%9.2" "s" COEFFS 0 100 0 0 0 1 /end COMPU_METHOD
/begin COMPU_METHOD FORMULA_0279 "FORMULA_0279" RAT_FUNC "%3.0" ".Prog" COEFFS 0 1 0 0 0 1 /end COMPU_METHOD
/begin COMPU_METHOD FORMULA_0317 "FORMULA_0317" RAT_FUNC "%5.2" "s" COEFFS 0 100 0 0 0 1 /end COMPU_METHOD
/begin COMPU_METHOD FORMULA_0356 "FORMULA_0356" RAT_FUNC "%3.0" "us" COEFFS 0 1 0 0 0 1 /end COMPU_METHOD
/begin COMPU_METHOD FORMULA_0357 "FORMULA_0357" TAB_VERB "%5.2" "-" COMPU_TAB_REF FORMULA_0357_VTAB /end COMPU_METHOD
/begin COMPU_VTAB FORMULA_0357_VTAB "FORMULA_0357_VTAB" TAB_VERB 2 0 "Aus" 1 "Ein" /end COMPU_VTAB
/begin COMPU_METHOD FORMULA_0363 "FORMULA_0363" TAB_VERB "%5.2" "-" COMPU_TAB_REF FORMULA_0363_VTAB /end COMPU_METHOD
/begin COMPU_VTAB FORMULA_0363_VTAB "FORMULA_0363_VTAB" TAB_VERB 2 0 "SK aus" 1 "SK aktiv" /end COMPU_VTAB
/begin COMPU_METHOD FORMULA_0364 "FORMULA_0364" TAB_VERB "%3.0" "-" COMPU_TAB_REF FORMULA_0364_VTAB /end COMPU_METHOD
/begin COMPU_VTAB FORMULA_0364_VTAB "FORMULA_0364_VTAB" TAB_VERB 5 0 "Aus" 1 "MVAC" 2 "ELUP" 3 "MVAC+ELUP" 6 "System" /end COMPU_VTAB
/begin COMPU_METHOD FORMULA_0365 "FORMULA_0365" TAB_VERB "%3.0" "-" COMPU_TAB_REF FORMULA_0365_VTAB /end COMPU_METHOD
/begin COMPU_VTAB FORMULA_0365_VTAB "FORMULA_0365_VTAB" TAB_VERB 8 0 "Inaktiv" 1 "D-CRC" 2 "P-CRC" 3 "PD-CRC" 4 "B-CRC" 5 "BD-CRC" 6 "BP-CRC" 7 "BPD-CRC" /end COMPU_VTAB
/begin COMPU_METHOD FORMULA_0366 "FORMULA_0366" TAB_VERB "%3.0" "-" COMPU_TAB_REF FORMULA_0366_VTAB /end COMPU_METHOD
/begin COMPU_VTAB FORMULA_0366_VTAB "FORMULA_0366_VTAB" TAB_VERB 8 0 "alle an" 3 "LA" 12 "LAA" 15 "LA+LAA" 48 "Mager" 51 "LA+Mager" 60 "LAA+Mager" 63 "LA+LAA+Mager" /end COMPU_VTAB
/begin COMPU_METHOD FORMULA_0367 "FORMULA_0367" TAB_VERB "%3.0" "-" COMPU_TAB_REF FORMULA_0367_VTAB /end COMPU_METHOD
/begin COMPU_VTAB FORMULA_0367_VTAB "FORMULA_0367_VTAB" TAB_VERB 8 0 "alle an" 1 "LA" 2 "LAA" 3 "LA+LAA" 4 "Mager" 5 "LA+Mager" 6 "LAA+Mager" 7 "LA+LAA+Mager" /end COMPU_VTAB
/begin COMPU_METHOD FORMULA_0368 "FORMULA_0368" TAB_VERB "%3.0" "-" COMPU_TAB_REF FORMULA_0368_VTAB /end COMPU_METHOD
/begin COMPU_VTAB FORMULA_0368_VTAB "FORMULA_0368_VTAB" TAB_VERB 2 0 "aktiv" 1 "gesperrt" /end COMPU_VTAB
/* ------------------ Abschnitt erzeugt aus sw_confg.dat ------------------ */
/begin COMPU_METHOD FORMULA_0371 "FORMULA_0371" TAB_VERB "%7.2" "-" COMPU_TAB_REF FORMULA_0371_VTAB /end COMPU_METHOD
/begin COMPU_VTAB FORMULA_0371_VTAB "FORMULA_0371_VTAB" TAB_VERB 5 8192 "S65" 8448 "S65FLACH" 8704 "S65V" 256 "S15" 16384 "S85" DEFAULT_VALUE "undefiniert" /end COMPU_VTAB
/begin COMPU_METHOD FORMULA_0372 "FORMULA_0372" TAB_VERB "%5.2" "-" COMPU_TAB_REF FORMULA_0372_VTAB /end COMPU_METHOD
/begin COMPU_VTAB FORMULA_0372_VTAB "FORMULA_0372_VTAB" TAB_VERB 7 16 "E60" 17 "E63" 18 "E64" 32 "E65" 64 "E85" 128 "E90" 129 "E91" DEFAULT_VALUE "undefiniert" /end COMPU_VTAB
/begin COMPU_METHOD FORMULA_0373 "FORMULA_0373" TAB_VERB "%5.2" "-" COMPU_TAB_REF FORMULA_0373_VTAB /end COMPU_METHOD
/begin COMPU_VTAB FORMULA_0373_VTAB "FORMULA_0373_VTAB" TAB_VERB 3 16 "HS" 64 "SMG" 128 "DKG" DEFAULT_VALUE "undefiniert" /end COMPU_VTAB
/begin COMPU_METHOD FORMULA_0374 "FORMULA_0374" TAB_VERB "%5.2" "-" COMPU_TAB_REF FORMULA_0374_VTAB /end COMPU_METHOD
/begin COMPU_VTAB FORMULA_0374_VTAB "FORMULA_0374_VTAB" TAB_VERB 5 1 "ECE" 2 "US" 4 "Golfstaaten" 8 "ZA" 16 "JAPAN" DEFAULT_VALUE "undefiniert" /end COMPU_VTAB
/begin COMPU_METHOD FORMULA_0375 "FORMULA_0375" TAB_VERB "%5.2" "-" COMPU_TAB_REF FORMULA_0375_VTAB /end COMPU_METHOD
/begin COMPU_VTAB FORMULA_0375_VTAB "FORMULA_0375_VTAB" TAB_VERB 6 16 "EU3" 17 "EU4" 1 "D4" 32 "LEV" 33 "LEV2" 34 "ULEV" DEFAULT_VALUE "undefiniert" /end COMPU_VTAB
/begin COMPU_METHOD FORMULA_0376 "FORMULA_0376" TAB_VERB "%5.2" "-" COMPU_TAB_REF FORMULA_0376_VTAB /end COMPU_METHOD
/begin COMPU_VTAB FORMULA_0376_VTAB "FORMULA_0376_VTAB" TAB_VERB 3 1 "MIL_OFF" 2 "MIL_FSP" 4 "MIL_ON" DEFAULT_VALUE "undefiniert" /end COMPU_VTAB
/begin COMPU_METHOD FORMULA_0377 "FORMULA_0377" TAB_VERB "%5.2" "-" COMPU_TAB_REF FORMULA_0377_VTAB /end COMPU_METHOD
/begin COMPU_VTAB FORMULA_0377_VTAB "FORMULA_0377_VTAB" TAB_VERB 2 128 "Serienstand" 1 "Entwicklung" DEFAULT_VALUE "undefiniert" /end COMPU_VTAB
/begin COMPU_METHOD FORMULA_0378 "FORMULA_0378" TAB_VERB "%5.2" "-" COMPU_TAB_REF FORMULA_0378_VTAB /end COMPU_METHOD
/begin COMPU_VTAB FORMULA_0378_VTAB "FORMULA_0378_VTAB" TAB_VERB 2 1 "CAN 11H" 2 "CAN 12H" DEFAULT_VALUE "undefiniert" /end COMPU_VTAB
/begin COMPU_METHOD FORMULA_0379 "FORMULA_0379" TAB_VERB "%5.2" "-" COMPU_TAB_REF FORMULA_0379_VTAB /end COMPU_METHOD
/begin COMPU_VTAB FORMULA_0379_VTAB "FORMULA_0379_VTAB" TAB_VERB 3 0 "Fz-Betrieb" 1 "Pruefstand" 2 "Rolle" /end COMPU_VTAB
/begin COMPU_METHOD FORMULA_0380 "FORMULA_0380" TAB_VERB "%5.2" "-" COMPU_TAB_REF FORMULA_0380_VTAB /end COMPU_METHOD
/begin COMPU_VTAB FORMULA_0380_VTAB "FORMULA_0380_VTAB" TAB_VERB 4 0 "auto Erkennung" 1 "ApplDFlash, rest auto" 2 "ETH aus, rest auto" 3 "ApplDFlash, ETH aus" DEFAULT_VALUE "ungueltig" /end COMPU_VTAB
/begin COMPU_METHOD FORMULA_0381 "FORMULA_0381" TAB_VERB "%5.2" "-" COMPU_TAB_REF FORMULA_0381_VTAB /end COMPU_METHOD
/begin COMPU_VTAB FORMULA_0381_VTAB "FORMULA_0381_VTAB" TAB_VERB 2 0 "Teves" 1 "Bosch" /end COMPU_VTAB
/begin COMPU_METHOD FORMULA_0382 "FORMULA_0382" TAB_VERB "%5.2" "-" COMPU_TAB_REF FORMULA_0382_VTAB /end COMPU_METHOD
/begin COMPU_VTAB FORMULA_0382_VTAB "FORMULA_0382_VTAB" TAB_VERB 3 0 "Aus" 1 "dSPACE" 2 "noLoop" /end COMPU_VTAB
/* ------------------ Abschnitt erzeugt aus adapt.dat ------------------ */
/begin COMPU_METHOD FORMULA_0418 "FORMULA_0418" RAT_FUNC "%8.3" "V" COEFFS 0 1024 0 0 0 5 /end COMPU_METHOD
/begin COMPU_METHOD FORMULA_0435 "FORMULA_0435" RAT_FUNC "%6.1" "%" COEFFS 0 32768 0 0 0 100 /end COMPU_METHOD
/begin COMPU_METHOD FORMULA_0462 "FORMULA_0462" RAT_FUNC "%5.2" "s" COEFFS 0 0 2.56 0 1 0 /end COMPU_METHOD
/begin COMPU_METHOD FORMULA_0478 "FORMULA_0478" RAT_FUNC "%6.3" "s" COEFFS 0 0 1.28 0 1 0 /end COMPU_METHOD
/begin COMPU_METHOD FORMULA_0479 "FORMULA_0479" RAT_FUNC "%4.1" "%" COEFFS 0 10 0 0 0 1 /end COMPU_METHOD
/begin COMPU_METHOD FORMULA_0486 "FORMULA_0486" RAT_FUNC "%5.0" ".Gang" COEFFS 0 1 0 0 0 1 /end COMPU_METHOD
/begin COMPU_METHOD FORMULA_0513 "FORMULA_0513" TAB_VERB "%5.0" "-" COMPU_TAB_REF FORMULA_0513_VTAB /end COMPU_METHOD
/begin COMPU_VTAB FORMULA_0513_VTAB "FORMULA_0513_VTAB" TAB_VERB 1 0 "Zyl. 10 ok." DEFAULT_VALUE "Fehler Ausschw. Zyl. 10." /end COMPU_VTAB
/begin COMPU_METHOD FORMULA_0514 "FORMULA_0514" TAB_VERB "%5.0" "-" COMPU_TAB_REF FORMULA_0514_VTAB /end COMPU_METHOD
/begin COMPU_VTAB FORMULA_0514_VTAB "FORMULA_0514_VTAB" TAB_VERB 1 0 "Verbrennung ok." DEFAULT_VALUE "Fehler Verbrennung." /end COMPU_VTAB
/begin COMPU_METHOD FORMULA_0515 "FORMULA_0515" TAB_VERB "%5.0" "-" COMPU_TAB_REF FORMULA_0515_VTAB /end COMPU_METHOD
/begin COMPU_VTAB FORMULA_0515_VTAB "FORMULA_0515_VTAB" TAB_VERB 1 0 "Zyl. 1 ok." DEFAULT_VALUE "Fehler Verbr. Zyl. 1." /end COMPU_VTAB
/begin COMPU_METHOD FORMULA_0516 "FORMULA_0516" TAB_VERB "%5.0" "-" COMPU_TAB_REF FORMULA_0516_VTAB /end COMPU_METHOD
/begin COMPU_VTAB FORMULA_0516_VTAB "FORMULA_0516_VTAB" TAB_VERB 1 0 "Zyl. 2 ok." DEFAULT_VALUE "Fehler Verbr. Zyl. 2." /end COMPU_VTAB
/begin COMPU_METHOD FORMULA_0517 "FORMULA_0517" TAB_VERB "%5.0" "-" COMPU_TAB_REF FORMULA_0517_VTAB /end COMPU_METHOD
/begin COMPU_VTAB FORMULA_0517_VTAB "FORMULA_0517_VTAB" TAB_VERB 1 0 "Zyl. 3 ok." DEFAULT_VALUE "Fehler Verbr. Zyl. 3." /end COMPU_VTAB
/begin COMPU_METHOD FORMULA_0518 "FORMULA_0518" TAB_VERB "%5.0" "-" COMPU_TAB_REF FORMULA_0518_VTAB /end COMPU_METHOD
/begin COMPU_VTAB FORMULA_0518_VTAB "FORMULA_0518_VTAB" TAB_VERB 1 0 "Zyl. 4 ok." DEFAULT_VALUE "Fehler Verbr. Zyl. 4." /end COMPU_VTAB
/begin COMPU_METHOD FORMULA_0519 "FORMULA_0519" TAB_VERB "%5.0" "-" COMPU_TAB_REF FORMULA_0519_VTAB /end COMPU_METHOD
/begin COMPU_VTAB FORMULA_0519_VTAB "FORMULA_0519_VTAB" TAB_VERB 1 0 "Zyl. 5 ok." DEFAULT_VALUE "Fehler Verbr. Zyl. 5." /end COMPU_VTAB
/begin COMPU_METHOD FORMULA_0520 "FORMULA_0520" TAB_VERB "%5.0" "-" COMPU_TAB_REF FORMULA_0520_VTAB /end COMPU_METHOD
/begin COMPU_VTAB FORMULA_0520_VTAB "FORMULA_0520_VTAB" TAB_VERB 1 0 "Zyl. 6 ok." DEFAULT_VALUE "Fehler Verbr. Zyl. 6." /end COMPU_VTAB
/begin COMPU_METHOD FORMULA_0521 "FORMULA_0521" TAB_VERB "%5.0" "-" COMPU_TAB_REF FORMULA_0521_VTAB /end COMPU_METHOD
/begin COMPU_VTAB FORMULA_0521_VTAB "FORMULA_0521_VTAB" TAB_VERB 1 0 "Zyl. 7 ok." DEFAULT_VALUE "Fehler Verbr. Zyl. 7." /end COMPU_VTAB
/begin COMPU_METHOD FORMULA_0522 "FORMULA_0522" TAB_VERB "%5.0" "-" COMPU_TAB_REF FORMULA_0522_VTAB /end COMPU_METHOD
/begin COMPU_VTAB FORMULA_0522_VTAB "FORMULA_0522_VTAB" TAB_VERB 1 0 "Zyl. 8 ok." DEFAULT_VALUE "Fehler Verbr. Zyl. 8." /end COMPU_VTAB
/begin COMPU_METHOD FORMULA_0523 "FORMULA_0523" TAB_VERB "%5.0" "-" COMPU_TAB_REF FORMULA_0523_VTAB /end COMPU_METHOD
/begin COMPU_VTAB FORMULA_0523_VTAB "FORMULA_0523_VTAB" TAB_VERB 1 0 "Zyl. 9 ok." DEFAULT_VALUE "Fehler Verbr. Zyl. 9." /end COMPU_VTAB
/begin COMPU_METHOD FORMULA_0524 "FORMULA_0524" TAB_VERB "%5.0" "-" COMPU_TAB_REF FORMULA_0524_VTAB /end COMPU_METHOD
/begin COMPU_VTAB FORMULA_0524_VTAB "FORMULA_0524_VTAB" TAB_VERB 1 0 "Zyl. 10 ok." DEFAULT_VALUE "Fehler Verbr. Zyl. 10." /end COMPU_VTAB
/begin COMPU_METHOD FORMULA_0525 "FORMULA_0525" TAB_VERB "%5.0" "-" COMPU_TAB_REF FORMULA_0525_VTAB /end COMPU_METHOD
/begin COMPU_VTAB FORMULA_0525_VTAB "FORMULA_0525_VTAB" TAB_VERB 1 0 "Kein Nebenschluss." DEFAULT_VALUE "Fehler Nebenschluss." /end COMPU_VTAB
/begin COMPU_METHOD FORMULA_0526 "FORMULA_0526" TAB_VERB "%5.0" "-" COMPU_TAB_REF FORMULA_0526_VTAB /end COMPU_METHOD
/begin COMPU_VTAB FORMULA_0526_VTAB "FORMULA_0526_VTAB" TAB_VERB 1 0 "Zyl. 1 ok." DEFAULT_VALUE "Nebenschluss. Zyl. 1." /end COMPU_VTAB
/begin COMPU_METHOD FORMULA_0527 "FORMULA_0527" TAB_VERB "%5.0" "-" COMPU_TAB_REF FORMULA_0527_VTAB /end COMPU_METHOD
/begin COMPU_VTAB FORMULA_0527_VTAB "FORMULA_0527_VTAB" TAB_VERB 1 0 "Zyl. 2 ok." DEFAULT_VALUE "Nebenschluss. Zyl. 2." /end COMPU_VTAB
/begin COMPU_METHOD FORMULA_0528 "FORMULA_0528" TAB_VERB "%5.0" "-" COMPU_TAB_REF FORMULA_0528_VTAB /end COMPU_METHOD
/begin COMPU_VTAB FORMULA_0528_VTAB "FORMULA_0528_VTAB" TAB_VERB 1 0 "Zyl. 3 ok." DEFAULT_VALUE "Nebenschluss. Zyl. 3." /end COMPU_VTAB
/begin COMPU_METHOD FORMULA_0529 "FORMULA_0529" TAB_VERB "%5.0" "-" COMPU_TAB_REF FORMULA_0529_VTAB /end COMPU_METHOD
/begin COMPU_VTAB FORMULA_0529_VTAB "FORMULA_0529_VTAB" TAB_VERB 1 0 "Zyl. 4 ok." DEFAULT_VALUE "Nebenschluss. Zyl. 4." /end COMPU_VTAB
/begin COMPU_METHOD FORMULA_0530 "FORMULA_0530" TAB_VERB "%5.0" "-" COMPU_TAB_REF FORMULA_0530_VTAB /end COMPU_METHOD
/begin COMPU_VTAB FORMULA_0530_VTAB "FORMULA_0530_VTAB" TAB_VERB 1 0 "Zyl. 5 ok." DEFAULT_VALUE "Nebenschluss. Zyl. 5." /end COMPU_VTAB
/begin COMPU_METHOD FORMULA_0531 "FORMULA_0531" TAB_VERB "%5.0" "-" COMPU_TAB_REF FORMULA_0531_VTAB /end COMPU_METHOD
/begin COMPU_VTAB FORMULA_0531_VTAB "FORMULA_0531_VTAB" TAB_VERB 1 0 "Zyl. 6 ok." DEFAULT_VALUE "Nebenschluss. Zyl. 6." /end COMPU_VTAB
/begin COMPU_METHOD FORMULA_0532 "FORMULA_0532" TAB_VERB "%5.0" "-" COMPU_TAB_REF FORMULA_0532_VTAB /end COMPU_METHOD
/begin COMPU_VTAB FORMULA_0532_VTAB "FORMULA_0532_VTAB" TAB_VERB 1 0 "Zyl. 7 ok." DEFAULT_VALUE "Nebenschluss. Zyl. 7." /end COMPU_VTAB
/begin COMPU_METHOD FORMULA_0533 "FORMULA_0533" TAB_VERB "%5.0" "-" COMPU_TAB_REF FORMULA_0533_VTAB /end COMPU_METHOD
/begin COMPU_VTAB FORMULA_0533_VTAB "FORMULA_0533_VTAB" TAB_VERB 1 0 "Zyl. 8 ok." DEFAULT_VALUE "Nebenschluss. Zyl. 8." /end COMPU_VTAB
/begin COMPU_METHOD FORMULA_0534 "FORMULA_0534" TAB_VERB "%5.0" "-" COMPU_TAB_REF FORMULA_0534_VTAB /end COMPU_METHOD
/begin COMPU_VTAB FORMULA_0534_VTAB "FORMULA_0534_VTAB" TAB_VERB 1 0 "Zyl. 9 ok." DEFAULT_VALUE "Nebenschluss. Zyl. 9." /end COMPU_VTAB
/begin COMPU_METHOD FORMULA_0535 "FORMULA_0535" TAB_VERB "%5.0" "-" COMPU_TAB_REF FORMULA_0535_VTAB /end COMPU_METHOD
/begin COMPU_VTAB FORMULA_0535_VTAB "FORMULA_0535_VTAB" TAB_VERB 1 0 "Zyl. 10 ok." DEFAULT_VALUE "Nebenschluss. Zyl. 10." /end COMPU_VTAB
/begin COMPU_METHOD FORMULA_0536 "FORMULA_0536" TAB_VERB "%5.0" "-" COMPU_TAB_REF FORMULA_0536_VTAB /end COMPU_METHOD
/begin COMPU_VTAB FORMULA_0536_VTAB "FORMULA_0536_VTAB" TAB_VERB 1 0 "kein Kat-Aussetzer" DEFAULT_VALUE "Kat-Aussetzer erkannt" /end COMPU_VTAB
/begin COMPU_METHOD FORMULA_0537 "FORMULA_0537" TAB_VERB "%5.0" "-" COMPU_TAB_REF FORMULA_0537_VTAB /end COMPU_METHOD
/begin COMPU_VTAB FORMULA_0537_VTAB "FORMULA_0537_VTAB" TAB_VERB 1 0 "Zyl. 1 ok." DEFAULT_VALUE "Kat-Auss. Zyl. 1." /end COMPU_VTAB
/begin COMPU_METHOD FORMULA_0538 "FORMULA_0538" TAB_VERB "%5.0" "-" COMPU_TAB_REF FORMULA_0538_VTAB /end COMPU_METHOD
/begin COMPU_VTAB FORMULA_0538_VTAB "FORMULA_0538_VTAB" TAB_VERB 1 0 "Zyl. 2 ok." DEFAULT_VALUE "Kat-Auss. Zyl. 2." /end COMPU_VTAB
/begin COMPU_METHOD FORMULA_0539 "FORMULA_0539" TAB_VERB "%5.0" "-" COMPU_TAB_REF FORMULA_0539_VTAB /end COMPU_METHOD
/begin COMPU_VTAB FORMULA_0539_VTAB "FORMULA_0539_VTAB" TAB_VERB 1 0 "Zyl. 3 ok." DEFAULT_VALUE "Kat-Auss. Zyl. 3." /end COMPU_VTAB
/begin COMPU_METHOD FORMULA_0540 "FORMULA_0540" TAB_VERB "%5.0" "-" COMPU_TAB_REF FORMULA_0540_VTAB /end COMPU_METHOD
/begin COMPU_VTAB FORMULA_0540_VTAB "FORMULA_0540_VTAB" TAB_VERB 1 0 "Zyl. 4 ok." DEFAULT_VALUE "Kat-Auss. Zyl. 4." /end COMPU_VTAB
/begin COMPU_METHOD FORMULA_0541 "FORMULA_0541" TAB_VERB "%5.0" "-" COMPU_TAB_REF FORMULA_0541_VTAB /end COMPU_METHOD
/begin COMPU_VTAB FORMULA_0541_VTAB "FORMULA_0541_VTAB" TAB_VERB 1 0 "Zyl. 5 ok." DEFAULT_VALUE "Kat-Auss. Zyl. 5." /end COMPU_VTAB
/begin COMPU_METHOD FORMULA_0542 "FORMULA_0542" TAB_VERB "%5.0" "-" COMPU_TAB_REF FORMULA_0542_VTAB /end COMPU_METHOD
/begin COMPU_VTAB FORMULA_0542_VTAB "FORMULA_0542_VTAB" TAB_VERB 1 0 "Zyl. 6 ok." DEFAULT_VALUE "Kat-Auss. Zyl. 6." /end COMPU_VTAB
/begin COMPU_METHOD FORMULA_0543 "FORMULA_0543" TAB_VERB "%5.0" "-" COMPU_TAB_REF FORMULA_0543_VTAB /end COMPU_METHOD
/begin COMPU_VTAB FORMULA_0543_VTAB "FORMULA_0543_VTAB" TAB_VERB 1 0 "Zyl. 7 ok." DEFAULT_VALUE "Kat-Auss. Zyl. 7." /end COMPU_VTAB
/begin COMPU_METHOD FORMULA_0544 "FORMULA_0544" TAB_VERB "%5.0" "-" COMPU_TAB_REF FORMULA_0544_VTAB /end COMPU_METHOD
/begin COMPU_VTAB FORMULA_0544_VTAB "FORMULA_0544_VTAB" TAB_VERB 1 0 "Zyl. 8 ok." DEFAULT_VALUE "Kat-Auss. Zyl. 8." /end COMPU_VTAB
/begin COMPU_METHOD FORMULA_0545 "FORMULA_0545" TAB_VERB "%5.0" "-" COMPU_TAB_REF FORMULA_0545_VTAB /end COMPU_METHOD
/begin COMPU_VTAB FORMULA_0545_VTAB "FORMULA_0545_VTAB" TAB_VERB 1 0 "Zyl. 9 ok." DEFAULT_VALUE "Kat-Auss. Zyl. 9." /end COMPU_VTAB
/begin COMPU_METHOD FORMULA_0546 "FORMULA_0546" TAB_VERB "%5.0" "-" COMPU_TAB_REF FORMULA_0546_VTAB /end COMPU_METHOD
/begin COMPU_VTAB FORMULA_0546_VTAB "FORMULA_0546_VTAB" TAB_VERB 1 0 "Zyl. 10 ok." DEFAULT_VALUE "Kat-Auss. Zyl. 10." /end COMPU_VTAB
/begin COMPU_METHOD FORMULA_0547 "FORMULA_0547" TAB_VERB "%5.0" "-" COMPU_TAB_REF FORMULA_0547_VTAB /end COMPU_METHOD
/begin COMPU_VTAB FORMULA_0547_VTAB "FORMULA_0547_VTAB" TAB_VERB 1 0 "kein Abgas-Aussetzer" DEFAULT_VALUE "Abgas-Aussetzer erkannt" /end COMPU_VTAB
/begin COMPU_METHOD FORMULA_0548 "FORMULA_0548" TAB_VERB "%5.0" "-" COMPU_TAB_REF FORMULA_0548_VTAB /end COMPU_METHOD
/begin COMPU_VTAB FORMULA_0548_VTAB "FORMULA_0548_VTAB" TAB_VERB 1 0 "Zyl. 1 ok." DEFAULT_VALUE "Abgas-Auss. Zyl. 1." /end COMPU_VTAB
/begin COMPU_METHOD FORMULA_0549 "FORMULA_0549" TAB_VERB "%5.0" "-" COMPU_TAB_REF FORMULA_0549_VTAB /end COMPU_METHOD
/begin COMPU_VTAB FORMULA_0549_VTAB "FORMULA_0549_VTAB" TAB_VERB 1 0 "Zyl. 2 ok." DEFAULT_VALUE "Abgas-Auss. Zyl. 2." /end COMPU_VTAB
/begin COMPU_METHOD FORMULA_0550 "FORMULA_0550" TAB_VERB "%5.0" "-" COMPU_TAB_REF FORMULA_0550_VTAB /end COMPU_METHOD
/begin COMPU_VTAB FORMULA_0550_VTAB "FORMULA_0550_VTAB" TAB_VERB 1 0 "Zyl. 3 ok." DEFAULT_VALUE "Abgas-Auss. Zyl. 3." /end COMPU_VTAB
/begin COMPU_METHOD FORMULA_0551 "FORMULA_0551" TAB_VERB "%5.0" "-" COMPU_TAB_REF FORMULA_0551_VTAB /end COMPU_METHOD
/begin COMPU_VTAB FORMULA_0551_VTAB "FORMULA_0551_VTAB" TAB_VERB 1 0 "Zyl. 4 ok." DEFAULT_VALUE "Abgas-Auss. Zyl. 4." /end COMPU_VTAB
/begin COMPU_METHOD FORMULA_0552 "FORMULA_0552" TAB_VERB "%5.0" "-" COMPU_TAB_REF FORMULA_0552_VTAB /end COMPU_METHOD
/begin COMPU_VTAB FORMULA_0552_VTAB "FORMULA_0552_VTAB" TAB_VERB 1 0 "Zyl. 5 ok." DEFAULT_VALUE "Abgas-Auss. Zyl. 5." /end COMPU_VTAB
/begin COMPU_METHOD FORMULA_0553 "FORMULA_0553" TAB_VERB "%5.0" "-" COMPU_TAB_REF FORMULA_0553_VTAB /end COMPU_METHOD
/begin COMPU_VTAB FORMULA_0553_VTAB "FORMULA_0553_VTAB" TAB_VERB 1 0 "Zyl. 6 ok." DEFAULT_VALUE "Abgas-Auss. Zyl. 6." /end COMPU_VTAB
/begin COMPU_METHOD FORMULA_0554 "FORMULA_0554" TAB_VERB "%5.0" "-" COMPU_TAB_REF FORMULA_0554_VTAB /end COMPU_METHOD
/begin COMPU_VTAB FORMULA_0554_VTAB "FORMULA_0554_VTAB" TAB_VERB 1 0 "Zyl. 7 ok." DEFAULT_VALUE "Abgas-Auss. Zyl. 7." /end COMPU_VTAB
/begin COMPU_METHOD FORMULA_0555 "FORMULA_0555" TAB_VERB "%5.0" "-" COMPU_TAB_REF FORMULA_0555_VTAB /end COMPU_METHOD
/begin COMPU_VTAB FORMULA_0555_VTAB "FORMULA_0555_VTAB" TAB_VERB 1 0 "Zyl. 8 ok." DEFAULT_VALUE "Abgas-Auss. Zyl. 8." /end COMPU_VTAB
/begin COMPU_METHOD FORMULA_0556 "FORMULA_0556" TAB_VERB "%5.0" "-" COMPU_TAB_REF FORMULA_0556_VTAB /end COMPU_METHOD
/begin COMPU_VTAB FORMULA_0556_VTAB "FORMULA_0556_VTAB" TAB_VERB 1 0 "Zyl. 9 ok." DEFAULT_VALUE "Abgas-Auss. Zyl. 9." /end COMPU_VTAB
/begin COMPU_METHOD FORMULA_0557 "FORMULA_0557" TAB_VERB "%5.0" "-" COMPU_TAB_REF FORMULA_0557_VTAB /end COMPU_METHOD
/begin COMPU_VTAB FORMULA_0557_VTAB "FORMULA_0557_VTAB" TAB_VERB 1 0 "Zyl. 10 ok." DEFAULT_VALUE "Abgas-Auss. Zyl. 10." /end COMPU_VTAB
/begin COMPU_METHOD FORMULA_0558 "FORMULA_0558" TAB_VERB "%5.0" "-" COMPU_TAB_REF FORMULA_0558_VTAB /end COMPU_METHOD
/begin COMPU_VTAB FORMULA_0558_VTAB "FORMULA_0558_VTAB" TAB_VERB 1 0 "dtz ok" DEFAULT_VALUE "dtz zu gross" /end COMPU_VTAB
/begin COMPU_METHOD FORMULA_0559 "FORMULA_0559" TAB_VERB "%5.0" "-" COMPU_TAB_REF FORMULA_0559_VTAB /end COMPU_METHOD
/begin COMPU_VTAB FORMULA_0559_VTAB "FORMULA_0559_VTAB" TAB_VERB 1 0 "Zyl. 1 ok." DEFAULT_VALUE "dtz zu gross Zyl. 1." /end COMPU_VTAB
/begin COMPU_METHOD FORMULA_0560 "FORMULA_0560" TAB_VERB "%5.0" "-" COMPU_TAB_REF FORMULA_0560_VTAB /end COMPU_METHOD
/begin COMPU_VTAB FORMULA_0560_VTAB "FORMULA_0560_VTAB" TAB_VERB 1 0 "Zyl. 2 ok." DEFAULT_VALUE "dtz zu gross Zyl. 2." /end COMPU_VTAB
/begin COMPU_METHOD FORMULA_0561 "FORMULA_0561" TAB_VERB "%5.0" "-" COMPU_TAB_REF FORMULA_0561_VTAB /end COMPU_METHOD
/begin COMPU_VTAB FORMULA_0561_VTAB "FORMULA_0561_VTAB" TAB_VERB 1 0 "Zyl. 3 ok." DEFAULT_VALUE "dtz zu gross Zyl. 3." /end COMPU_VTAB
/begin COMPU_METHOD FORMULA_0562 "FORMULA_0562" TAB_VERB "%5.0" "-" COMPU_TAB_REF FORMULA_0562_VTAB /end COMPU_METHOD
/begin COMPU_VTAB FORMULA_0562_VTAB "FORMULA_0562_VTAB" TAB_VERB 1 0 "Zyl. 4 ok." DEFAULT_VALUE "dtz zu gross Zyl. 4." /end COMPU_VTAB
/begin COMPU_METHOD FORMULA_0563 "FORMULA_0563" TAB_VERB "%5.0" "-" COMPU_TAB_REF FORMULA_0563_VTAB /end COMPU_METHOD
/begin COMPU_VTAB FORMULA_0563_VTAB "FORMULA_0563_VTAB" TAB_VERB 1 0 "Zyl. 5 ok." DEFAULT_VALUE "dtz zu gross Zyl. 5." /end COMPU_VTAB
/begin COMPU_METHOD FORMULA_0564 "FORMULA_0564" TAB_VERB "%5.0" "-" COMPU_TAB_REF FORMULA_0564_VTAB /end COMPU_METHOD
/begin COMPU_VTAB FORMULA_0564_VTAB "FORMULA_0564_VTAB" TAB_VERB 1 0 "Zyl. 6 ok." DEFAULT_VALUE "dtz zu gross Zyl. 6." /end COMPU_VTAB
/begin COMPU_METHOD FORMULA_0565 "FORMULA_0565" TAB_VERB "%5.0" "-" COMPU_TAB_REF FORMULA_0565_VTAB /end COMPU_METHOD
/begin COMPU_VTAB FORMULA_0565_VTAB "FORMULA_0565_VTAB" TAB_VERB 1 0 "Zyl. 7 ok." DEFAULT_VALUE "dtz zu gross Zyl. 7." /end COMPU_VTAB
/begin COMPU_METHOD FORMULA_0566 "FORMULA_0566" TAB_VERB "%5.0" "-" COMPU_TAB_REF FORMULA_0566_VTAB /end COMPU_METHOD
/begin COMPU_VTAB FORMULA_0566_VTAB "FORMULA_0566_VTAB" TAB_VERB 1 0 "Zyl. 8 ok." DEFAULT_VALUE "dtz zu gross Zyl. 8." /end COMPU_VTAB
/begin COMPU_METHOD FORMULA_0567 "FORMULA_0567" TAB_VERB "%5.0" "-" COMPU_TAB_REF FORMULA_0567_VTAB /end COMPU_METHOD
/begin COMPU_VTAB FORMULA_0567_VTAB "FORMULA_0567_VTAB" TAB_VERB 1 0 "Zyl. 9 ok." DEFAULT_VALUE "dtz zu gross Zyl. 9." /end COMPU_VTAB
/begin COMPU_METHOD FORMULA_0568 "FORMULA_0568" TAB_VERB "%5.0" "-" COMPU_TAB_REF FORMULA_0568_VTAB /end COMPU_METHOD
/begin COMPU_VTAB FORMULA_0568_VTAB "FORMULA_0568_VTAB" TAB_VERB 1 0 "Zyl. 10 ok." DEFAULT_VALUE "dtz zu gross Zyl. 10." /end COMPU_VTAB
/begin COMPU_METHOD FORMULA_0571 "FORMULA_0571" RAT_FUNC "%5.0" "Nm/s" COEFFS 0 1 0 0 0 20 /end COMPU_METHOD
/* ------------------ Abschnitt erzeugt aus diag_tr.dat ------------------ */
/begin COMPU_METHOD FORMULA_0580 "FORMULA_0580" TAB_VERB "%5.2" "-" COMPU_TAB_REF FORMULA_0580_VTAB /end COMPU_METHOD
/begin COMPU_VTAB FORMULA_0580_VTAB "FORMULA_0580_VTAB" TAB_VERB 4 0 "Aus" 1 "readDummy" 2 "An" 4 "Stop" DEFAULT_VALUE "undef" /end COMPU_VTAB
/* ------------------ Abschnitt erzeugt aus dsp.dat ------------------ */
/begin COMPU_METHOD FORMULA_0581 "FORMULA_0581" TAB_VERB "%3.0" "-" COMPU_TAB_REF FORMULA_0581_VTAB /end COMPU_METHOD
/begin COMPU_VTAB FORMULA_0581_VTAB "FORMULA_0581_VTAB" TAB_VERB 4 0 "DMA Ok" 1 "Write Error" 2 "Read Error" 3 "Read+Write Error" DEFAULT_VALUE "Unknown Status" /end COMPU_VTAB
/begin COMPU_METHOD FORMULA_0582 "FORMULA_0582" TAB_VERB "%5.0" "-" COMPU_TAB_REF FORMULA_0582_VTAB /end COMPU_METHOD
/begin COMPU_VTAB FORMULA_0582_VTAB "FORMULA_0582_VTAB" TAB_VERB 32 0 "Bus Ok" 2 "Loaded" 6 "Booted" 14 "Run" 1 "Bus Error" 3 "Bus Error" 7 "Bus Error" 15 "Bus Error" 16 "Stack Error" 18 "Stack Error" 22 "Stack Error" 30 "Stack Error" 32 "Watchdog" 34 "Watchdog" 38 "Watchdog" 46 "Watchdog" 64 "Run Error" 66 "Run Error" 70 "Run Error" 78 "Run Error" 128 "MISC Error" 130 "MISC Error" 134 "MISC Error" 142 "MISC Error" 256 "PM Error" 258 "PM Error" 262 "PM Error" 270 "PM Error" 512 "DM Error" 514 "DM Error" 518 "DM Error" 526 "DM Error" DEFAULT_VALUE "Access denied" /end COMPU_VTAB
/begin COMPU_METHOD FORMULA_0583 "FORMULA_0583" RAT_FUNC "%6.1" "%" COEFFS 0 120 0 0 0 1 /end COMPU_METHOD
/begin COMPU_METHOD FORMULA_0584 "FORMULA_0584" RAT_FUNC "%9.2" "ms" COEFFS 0 250 0 0 0 1 /end COMPU_METHOD
/begin COMPU_METHOD FORMULA_0585 "FORMULA_0585" RAT_FUNC "%9.2" "mVs" COEFFS 0 1 0 0 0 3.22265625 /end COMPU_METHOD
/begin COMPU_METHOD FORMULA_0586 "FORMULA_0586" RAT_FUNC "%9.2" "V" COEFFS 0 1 0 0 0 0.00080566 /end COMPU_METHOD
/begin COMPU_METHOD FORMULA_0588 "FORMULA_0588" TAB_VERB "%3.0" "-" COMPU_TAB_REF FORMULA_0588_VTAB /end COMPU_METHOD
/begin COMPU_VTAB FORMULA_0588_VTAB "FORMULA_0588_VTAB" TAB_VERB 8 0 "Keine" 1 "LLS1" 2 "LLS2" 3 "LLS1+2" 4 "DK1" 8 "DK2" 12 "DK1+2" 15 "Alle" /end COMPU_VTAB
/begin COMPU_METHOD FORMULA_0589 "FORMULA_0589" RAT_FUNC "%10.3" "V" COEFFS 0 1024 0 0 0 5 /end COMPU_METHOD
/begin COMPU_METHOD FORMULA_0590 "FORMULA_0590" RAT_FUNC "%3.0" "ms" COEFFS 0 1 0 0 0 5 /end COMPU_METHOD
/begin COMPU_METHOD FORMULA_0591 "FORMULA_0591" RAT_FUNC "%4.1" "%" COEFFS 0 1.28 128 0 0 1 /end COMPU_METHOD
/begin COMPU_METHOD FORMULA_0592 "FORMULA_0592" TAB_VERB "%5.2" "-" COMPU_TAB_REF FORMULA_0592_VTAB /end COMPU_METHOD
/begin COMPU_VTAB FORMULA_0592_VTAB "FORMULA_0592_VTAB" TAB_VERB 2 0 "disable" 1 "enable" /end COMPU_VTAB
/begin COMPU_METHOD FORMULA_0593 "FORMULA_0593" TAB_VERB "%5.2" "-" COMPU_TAB_REF FORMULA_0593_VTAB /end COMPU_METHOD
/begin COMPU_VTAB FORMULA_0593_VTAB "FORMULA_0593_VTAB" TAB_VERB 7 0 "Init" 1 "Inaktiv" 2 "NP-Adapt" 4 "Aktiv" 8 "Zust bb" 10 "Federtest" 15 "Failsafe" /end COMPU_VTAB
/begin COMPU_METHOD FORMULA_0594 "FORMULA_0594" TAB_VERB "%3.0" "-" COMPU_TAB_REF FORMULA_0594_VTAB /end COMPU_METHOD
/begin COMPU_VTAB FORMULA_0594_VTAB "FORMULA_0594_VTAB" TAB_VERB 13 0 "NP aus" 1 "NP default" 2 "NP aktiv" 3 "NP erfolgreich" 4 "NP abgelehnt" 5 "NP abgebrochen" 6 "NP fehlerhaft" 8 "FT aus" 10 "FT aktiv" 11 "FT erfolgreich" 12 "FT abgelehnt" 13 "FT abgebrochen" 14 "FT fehlerhaft" DEFAULT_VALUE "undef" /end COMPU_VTAB
/begin COMPU_METHOD FORMULA_0595 "FORMULA_0595" TAB_VERB "%5.2" "-" COMPU_TAB_REF FORMULA_0595_VTAB /end COMPU_METHOD
/begin COMPU_VTAB FORMULA_0595_VTAB "FORMULA_0595_VTAB" TAB_VERB 9 0 "Wait" 1 "Inaktiv" 2 "Gestaengetest" 3 "Adaption" 4 "EnableLtg-S" 5 "EnableLtg" 6 "Aktiv" 7 "Federtest" 255 "Failsafe" /end COMPU_VTAB
/begin COMPU_METHOD FORMULA_0597 "FORMULA_0597" TAB_VERB "%3.0" "-" COMPU_TAB_REF FORMULA_0597_VTAB /end COMPU_METHOD
/begin COMPU_VTAB FORMULA_0597_VTAB "FORMULA_0597_VTAB" TAB_VERB 1 0 "Disable" DEFAULT_VALUE "Enable" /end COMPU_VTAB
/begin COMPU_METHOD FORMULA_0598 "FORMULA_0598" TAB_VERB "%3.0" "-" COMPU_TAB_REF FORMULA_0598_VTAB /end COMPU_METHOD
/begin COMPU_VTAB FORMULA_0598_VTAB "FORMULA_0598_VTAB" TAB_VERB 15 0 "No" 1 "NP" 2 "EN" 3 "NP+EN" 4 "FT" 5 "NP+FT" 6 "EN+FT" 7 "NP+En+FT" 8 "GT" 9 "GT+NP" 10 "GT+EN" 11 "GT+NP+EN" 12 "GT+FT" 14 "GT+FT+EN" 15 "GT+NP+EN+FT" /end COMPU_VTAB
/begin COMPU_METHOD FORMULA_0599 "FORMULA_0599" TAB_VERB "%3.0" "-" COMPU_TAB_REF FORMULA_0599_VTAB /end COMPU_METHOD
/begin COMPU_VTAB FORMULA_0599_VTAB "FORMULA_0599_VTAB" TAB_VERB 1 0 "Nein" DEFAULT_VALUE "Ja" /end COMPU_VTAB
/begin COMPU_METHOD FORMULA_0600 "FORMULA_0600" TAB_VERB "%3.0" "-" COMPU_TAB_REF FORMULA_0600_VTAB /end COMPU_METHOD
/begin COMPU_VTAB FORMULA_0600_VTAB "FORMULA_0600_VTAB" TAB_VERB 1 0 "Nein" DEFAULT_VALUE "Frei" /end COMPU_VTAB
/begin COMPU_METHOD FORMULA_0601 "FORMULA_0601" TAB_VERB "%3.0" "-" COMPU_TAB_REF FORMULA_0601_VTAB /end COMPU_METHOD
/begin COMPU_VTAB FORMULA_0601_VTAB "FORMULA_0601_VTAB" TAB_VERB 1 0 "Inaktiv" DEFAULT_VALUE "Aktiv" /end COMPU_VTAB
/begin COMPU_METHOD FORMULA_0602 "FORMULA_0602" TAB_VERB "%5.0" "-" COMPU_TAB_REF FORMULA_0602_VTAB /end COMPU_METHOD
/begin COMPU_VTAB FORMULA_0602_VTAB "FORMULA_0602_VTAB" TAB_VERB 12 0 "kein Fehler" 1 "R-Mode" 2 "Diagnose" 4 "undef" 8 "CAN-Fehler" 16 "EnLtg-Err" 32 "EnLtg-Diag" 64 "Startup" 128 "EnLtg-En" 256 "Gestaenge" 512 "EnLtg-Dis" 1024 "Federntest" DEFAULT_VALUE "Mehrfachfehler" /end COMPU_VTAB
/begin COMPU_METHOD FORMULA_0603 "FORMULA_0603" TAB_VERB "%5.2" "-" COMPU_TAB_REF FORMULA_0603_VTAB /end COMPU_METHOD
/begin COMPU_VTAB FORMULA_0603_VTAB "FORMULA_0603_VTAB" TAB_VERB 6 0 "Init" 1 "Inaktiv" 4 "Aktiv" 6 "Aktiv/Adapt" 8 "Zust bb" 15 "Failsafe" /end COMPU_VTAB
/begin COMPU_METHOD FORMULA_0604 "FORMULA_0604" TAB_VERB "%5.2" "-" COMPU_TAB_REF FORMULA_0604_VTAB /end COMPU_METHOD
/begin COMPU_VTAB FORMULA_0604_VTAB "FORMULA_0604_VTAB" TAB_VERB 5 0 "Init" 1 "Inaktiv" 4 "Aktiv" 6 "Aktiv/Adapt" 15 "Failsafe" /end COMPU_VTAB
/begin COMPU_METHOD FORMULA_0636 "FORMULA_0636" RAT_FUNC "%6.1" "%" COEFFS 0 640 0 0 0 1 /end COMPU_METHOD
/begin COMPU_METHOD FORMULA_0679 "FORMULA_0679" RAT_FUNC "%5.2" "s" COEFFS 0 0 25.6 0 1 0 /end COMPU_METHOD
/begin COMPU_METHOD FORMULA_0704 "FORMULA_0704" RAT_FUNC "%5.2" "-" COEFFS 0 128 0 0 0 1 /end COMPU_METHOD
/begin COMPU_METHOD FORMULA_0746 "FORMULA_0746" RAT_FUNC "%3.0" "Upm" COEFFS 0 1 0 0 0 1 /end COMPU_METHOD
/begin COMPU_METHOD FORMULA_0749 "FORMULA_0749" RAT_FUNC "%4.1" "Nm" COEFFS 0 10 0 0 0 1 /end COMPU_METHOD
/begin COMPU_METHOD FORMULA_0799 "FORMULA_0799" RAT_FUNC "%3.0" "Nm/s" COEFFS 0 1 0 0 0 10 /end COMPU_METHOD
/begin COMPU_METHOD FORMULA_0827 "FORMULA_0827" RAT_FUNC "%3.0" "Nm/s" COEFFS 0 1 0 0 0 20 /end COMPU_METHOD
/* ------------------ Abschnitt erzeugt aus pwg.dat ------------------ */
/begin COMPU_METHOD FORMULA_0888 "FORMULA_0888" RAT_FUNC "%8.3" "%/V" COEFFS 0 100 0 0 0 1 /end COMPU_METHOD
/begin COMPU_METHOD FORMULA_0893 "FORMULA_0893" RAT_FUNC "%5.0" "ms" COEFFS 0 1 0 0 0 5 /end COMPU_METHOD
/begin COMPU_METHOD FORMULA_0904 "FORMULA_0904" TAB_VERB "%3.0" "-" COMPU_TAB_REF FORMULA_0904_VTAB /end COMPU_METHOD
/begin COMPU_VTAB FORMULA_0904_VTAB "FORMULA_0904_VTAB" TAB_VERB 3 0 "Begr. ueber v" 1 "Begr. ueber Druck" 2 "keine Begrenzung" /end COMPU_VTAB
/begin COMPU_METHOD FORMULA_0905 "FORMULA_0905" RAT_FUNC "%9.4" "s" COEFFS 0 0 327.68 0 1 0 /end COMPU_METHOD
/begin COMPU_METHOD FORMULA_0906 "FORMULA_0906" RAT_FUNC "%7.2" "1/s" COEFFS 0 1024 0 0 0 200 /end COMPU_METHOD
/begin COMPU_METHOD FORMULA_0907 "FORMULA_0907" RAT_FUNC "%5.0" "bar" COEFFS 0 1 0 0 0 1 /end COMPU_METHOD
/begin COMPU_METHOD FORMULA_0917 "FORMULA_0917" RAT_FUNC "%7.2" "%" COEFFS 0 10.24 0 0 0 1 /end COMPU_METHOD
/begin COMPU_METHOD FORMULA_0926 "FORMULA_0926" RAT_FUNC "%4.1" "%" COEFFS 0 128 0 0 0 100 /end COMPU_METHOD
/begin COMPU_METHOD FORMULA_0939 "FORMULA_0939" RAT_FUNC "%5.2" "Nms2" COEFFS 0 128 0 0 0 1 /end COMPU_METHOD
/begin COMPU_METHOD FORMULA_0942 "FORMULA_0942" RAT_FUNC "%5.0" "km" COEFFS 0 1 0 0 0 1 /end COMPU_METHOD
/begin COMPU_METHOD FORMULA_0943 "FORMULA_0943" RAT_FUNC "%4.1" "%" COEFFS 0 10.24 0 0 0 1 /end COMPU_METHOD
/begin COMPU_METHOD FORMULA_0944 "FORMULA_0944" TAB_VERB "%5.2" "-" COMPU_TAB_REF FORMULA_0944_VTAB /end COMPU_METHOD
/begin COMPU_VTAB FORMULA_0944_VTAB "FORMULA_0944_VTAB" TAB_VERB 2 0 "AKS bei Passiv" 1 "AKS bei Sport" /end COMPU_VTAB
/begin COMPU_METHOD FORMULA_0945 "FORMULA_0945" TAB_VERB "%5.2" "-" COMPU_TAB_REF FORMULA_0945_VTAB /end COMPU_METHOD
/begin COMPU_VTAB FORMULA_0945_VTAB "FORMULA_0945_VTAB" TAB_VERB 3 0 "aus" 1 "n-Regler" 2 "Automat-Prg" /end COMPU_VTAB
/begin COMPU_METHOD FORMULA_0946 "FORMULA_0946" RAT_FUNC "%6.3" "Nm/Upm" COEFFS 0 1000 0 0 0 1 /end COMPU_METHOD
/begin COMPU_METHOD FORMULA_0947 "FORMULA_0947" RAT_FUNC "%5.0" "Nm/s" COEFFS 0 10 0 0 0 1 /end COMPU_METHOD
/begin COMPU_METHOD FORMULA_0948 "FORMULA_0948" RAT_FUNC "%7.4" "Nms/Upm" COEFFS 0 10000 0 0 0 1 /end COMPU_METHOD
/begin COMPU_METHOD FORMULA_0949 "FORMULA_0949" RAT_FUNC "%5.0" "%" COEFFS 0 10.24 0 0 0 1 /end COMPU_METHOD
/begin COMPU_METHOD FORMULA_0950 "FORMULA_0950" TAB_VERB "%5.2" "-" COMPU_TAB_REF FORMULA_0950_VTAB /end COMPU_METHOD
/begin COMPU_VTAB FORMULA_0950_VTAB "FORMULA_0950_VTAB" TAB_VERB 1 0 "ohne Eingriff" DEFAULT_VALUE "mit Eingriff" /end COMPU_VTAB
/begin COMPU_METHOD FORMULA_0951 "FORMULA_0951" RAT_FUNC "%5.2" "cm" COEFFS 0 1 0 0 0 1 /end COMPU_METHOD
/begin COMPU_METHOD FORMULA_0952 "FORMULA_0952" TAB_VERB "%5.2" "-" COMPU_TAB_REF FORMULA_0952_VTAB /end COMPU_METHOD
/begin COMPU_VTAB FORMULA_0952_VTAB "FORMULA_0952_VTAB" TAB_VERB 2 0 "SK aus" 1 "SK ein" /end COMPU_VTAB
/begin COMPU_METHOD FORMULA_0953 "FORMULA_0953" RAT_FUNC "%4.1" "%FW" COEFFS 0 128 0 0 0 100 /end COMPU_METHOD
/begin COMPU_METHOD FORMULA_0954 "FORMULA_0954" RAT_FUNC "%4.1" "%t_END" COEFFS 0 128 0 0 0 100 /end COMPU_METHOD
/begin COMPU_METHOD FORMULA_0955 "FORMULA_0955" RAT_FUNC "%6.1" "2" COEFFS 0 128 0 0 0 1 /end COMPU_METHOD
/begin COMPU_METHOD FORMULA_0956 "FORMULA_0956" RAT_FUNC "%3.0" "%" COEFFS 0 128 0 0 0 100 /end COMPU_METHOD
/begin COMPU_METHOD FORMULA_0957 "FORMULA_0957" RAT_FUNC "%5.2" "Nm/Upm" COEFFS 0 100 0 0 0 1 /end COMPU_METHOD
/begin COMPU_METHOD FORMULA_0958 "FORMULA_0958" RAT_FUNC "%5.2" "Nm/Upm" COEFFS 0 10 0 0 0 1 /end COMPU_METHOD
/begin COMPU_METHOD FORMULA_0959 "FORMULA_0959" RAT_FUNC "%6.3" "Nms/Upm" COEFFS 0 1000 0 0 0 1 /end COMPU_METHOD
/begin COMPU_METHOD FORMULA_0960 "FORMULA_0960" RAT_FUNC "%3.0" "Prog" COEFFS 0 1 0 0 0 1 /end COMPU_METHOD
/begin COMPU_METHOD FORMULA_0961 "FORMULA_0961" RAT_FUNC "%5.2" "-" COEFFS 0 -128 128 0 0 -1 /end COMPU_METHOD
/begin COMPU_METHOD FORMULA_0962 "FORMULA_0962" RAT_FUNC "%5.0" "Nm/s" COEFFS 0 1 0 0 0 10 /end COMPU_METHOD
/begin COMPU_METHOD FORMULA_0968 "FORMULA_0968" RAT_FUNC "%4.1" "km/h" COEFFS 0 16 0 0 0 1 /end COMPU_METHOD
/begin COMPU_METHOD FORMULA_0969 "FORMULA_0969" TAB_VERB "%3.0" "-" COMPU_TAB_REF FORMULA_0969_VTAB /end COMPU_METHOD
/begin COMPU_VTAB FORMULA_0969_VTAB "FORMULA_0969_VTAB" TAB_VERB 8 0 "aus" 1 "Getr-Adapt" 2 "Getr-Ausl" 3 "Kupp-Adapt" 4 "GW-Adapt" 5 "a-Laengs" 6 "KKL-Default" 255 "Fehler" DEFAULT_VALUE "undef" /end COMPU_VTAB
/begin COMPU_METHOD FORMULA_0986 "FORMULA_0986" RAT_FUNC "%7.2" "min" COEFFS 0 60 0 0 0 1 /end COMPU_METHOD
/begin COMPU_METHOD FORMULA_1001 "FORMULA_1001" TAB_VERB "%5.2" "-" COMPU_TAB_REF FORMULA_1001_VTAB /end COMPU_METHOD
/begin COMPU_VTAB FORMULA_1001_VTAB "FORMULA_1001_VTAB" TAB_VERB 2 0 "Diag. aus" 1 "Diag. aktiv" DEFAULT_VALUE "undef" /end COMPU_VTAB
/begin COMPU_METHOD FORMULA_1002 "FORMULA_1002" RAT_FUNC "%5.0" "min" COEFFS 0 1 0 0 0 1 /end COMPU_METHOD
/* ------------------ Abschnitt erzeugt aus qadc.dat ------------------ */ /* ------------------ Abschnitt erzeugt aus ram_chk.dat ------------------ */
/begin CHARACTERISTIC K_RAM_CHK_T "Zeit fuer den Ramcheck pro Aufruf" VALUE 0x78756 TKW_VV_VV_UB 100.0 FORMULA_0356 1.0000 255.0000 /end CHARACTERISTIC
/begin CHARACTERISTIC K_RAM_CHK_CFG "Ramcheck Config | EN: Ramcheck Config" VALUE 0x78757 TKW_VV_VV_UB 100.0 FORMULA_0357 0.0 255.0 /end CHARACTERISTIC
/* ------------------ Abschnitt erzeugt aus sk.dat ------------------ */
/begin CHARACTERISTIC K_SK_CFG "SK-Cfg" VALUE 0x7875C TKW_VV_VV_UB 100.0 FORMULA_0363 0.0 255.0 /end CHARACTERISTIC
/begin CHARACTERISTIC K_SK_MAX_RESETS "max. Anzahl von Resets pro SG-Lauf | EN: Maximum number of resets per ECU run" VALUE 0x7875D TKW_VV_VV_UB 100.0 FORMULA_0003 0.0 255.0000 /end CHARACTERISTIC
/begin CHARACTERISTIC K_SK_FM_GEMISCH_TEST "SK Gemischtestmaske | EN: Safety-concept mixture test mask" VALUE 0x7875E TKW_VV_VV_UB 100.0 FORMULA_0003 0.0 255.0000 /end CHARACTERISTIC
/begin CHARACTERISTIC K_SK_FM_KR_TEST "SK KR-Testmaske" VALUE 0x7875F TKW_VV_VV_UB 100.0 FORMULA_0003 0.0 255.0000 /end CHARACTERISTIC
/begin CHARACTERISTIC K_SK_FM_EGAS_TEST "SK Egastestmaske | EN: Safety-concept E-gas test mask" VALUE 0x78760 TKW_VV_VV_UB 100.0 FORMULA_0003 0.0 255.0000 /end CHARACTERISTIC
/begin CHARACTERISTIC K_SK_ZYL_OFF_MAX "Anzahl der abg. Zyl. pro Bank | EN: Number of cylinders cut per bank" VALUE 0x78761 TKW_VV_VV_UB 100.0 FORMULA_0003 0.0 255.0000 /end CHARACTERISTIC
/begin CHARACTERISTIC K_SK_FM_FAIL_ZYL_TEST "SK TI-Testmaske (1=Aus) | EN: Safety-concept injection test mask (1=off)" VALUE 0x78762 TKW_VV_VV_UW 100.0 FORMULA_0010 0.0 65535.0000 /end CHARACTERISTIC
/begin CHARACTERISTIC K_SK_FM_SMG_TEST "SK SMG-Testmaske | EN: Safety-concept SMG test mask" VALUE 0x78764 TKW_VV_VV_UB 100.0 FORMULA_0003 0.0 255.0000 /end CHARACTERISTIC
/begin CHARACTERISTIC K_SK_FM_MD_TEST "SK Md-Testmaske | EN: Safety-concept torque test mask" VALUE 0x78765 TKW_VV_VV_UB 100.0 FORMULA_0003 0.0 255.0000 /end CHARACTERISTIC
/begin CHARACTERISTIC K_SK_FM_LAM_TEST "SK LAM-Testmaske | EN: Safety-concept lambda test mask" VALUE 0x78766 TKW_VV_VV_UB 100.0 FORMULA_0003 0.0 255.0000 /end CHARACTERISTIC
/begin CHARACTERISTIC K_SK_FM_MVAC_TEST "SK MVAC-Testmaske" VALUE 0x78767 TKW_VV_VV_UB 100.0 FORMULA_0364 0.0 255.0 /end CHARACTERISTIC
/begin CHARACTERISTIC K_SK_MAX_OS_ERR "erlaubte OS-Fehler bis zum Reset | EN: Permitted operating-system faults before reset" VALUE 0x78768 TKW_VV_VV_UB 100.0 FORMULA_0003 0.0 255.0000 /end CHARACTERISTIC
/begin CHARACTERISTIC K_SK_TASK_ERR "Maske Taskueberwachung | EN: Task monitoring mask" VALUE 0x78769 TKW_VV_VV_UB 100.0 FORMULA_0003 0.0 255.0000 /end CHARACTERISTIC
/begin CHARACTERISTIC K_SK_CRC32 "CRC32-Aktivierung" VALUE 0x7876A TKW_VV_VV_UB 100.0 FORMULA_0365 0.0 255.0 /end CHARACTERISTIC
/begin CHARACTERISTIC K_SK_PKS_NOTLAUF "PKS-Aktivierung | EN: Fuel-pressure-control activation" VALUE 0x7876B TKW_VV_VV_UB 100.0 FORMULA_0003 0.0 255.0000 /end CHARACTERISTIC
/begin CHARACTERISTIC K_SK_LLRA_SPERRE "LLRA-Sperre | EN: Idle-controller adaptation lock" VALUE 0x7876C TKW_VV_VV_UB 100.0 FORMULA_0003 0.0 255.0000 /end CHARACTERISTIC
/begin CHARACTERISTIC K_SK_FRA_SPERRE "FRA-Sperre | EN: Charge-adaptation lock" VALUE 0x7876D TKW_VV_VV_UB 100.0 FORMULA_0003 0.0 255.0000 /end CHARACTERISTIC
/begin CHARACTERISTIC K_SK_KH_SPERRE "KH-Sperre | EN: Catalyst-heating lock" VALUE 0x7876E TKW_VV_VV_UB 100.0 FORMULA_0003 0.0 255.0000 /end CHARACTERISTIC
/begin CHARACTERISTIC K_SK_FGR_SPERRE "FGR-Sperre | EN: Cruise control lock" VALUE 0x7876F TKW_VV_VV_UB 100.0 FORMULA_0003 0.0 255.0000 /end CHARACTERISTIC
/begin CHARACTERISTIC K_SK_MD_TI_EINGR "Freigabe Teilfeuern | EN: Enable partial firing (cylinder cut-out)" VALUE 0x78770 TKW_VV_VV_UB 100.0 FORMULA_0003 0.0 255.0000 /end CHARACTERISTIC
/begin CHARACTERISTIC K_SK_MD_VL_SPERRE "VL-Sperre | EN: Full-load lock" VALUE 0x78771 TKW_VV_VV_UB 100.0 FORMULA_0003 0.0 255.0000 /end CHARACTERISTIC
/begin CHARACTERISTIC K_SK_MD_BEGR_DK_OFFEN "Begrenzung bei offenen Klappen | EN: Limitation with open flaps" VALUE 0x78772 TKW_VV_VV_UB 100.0 FORMULA_0003 0.0 255.0000 /end CHARACTERISTIC
/begin CHARACTERISTIC K_SK_LAM_EINGR_TI "LA-Eingriff bei Teilfeuerung" VALUE 0x78773 TKW_VV_VV_UB 100.0 FORMULA_0366 0.0 255.0 /end CHARACTERISTIC
/begin CHARACTERISTIC K_SK_T_RESET_DELAY_OS "Resetdelay fuer Betriebssystem Fehler | EN: Reset delay for operating-system fault [s]" VALUE 0x78774 TKW_VV_VV_UB 100.0 FORMULA_0317 0.0 2.0000 /end CHARACTERISTIC
/begin CHARACTERISTIC K_SK_EGAS_OFF_TIME "Zeit bis Egasabschaltung | EN: Time until throttle (E-gas) shut-off [s]" VALUE 0x78776 TKW_VV_VV_UW 100.0 FORMULA_0021 0.0 5.0000 FORMAT "%5.2" /end CHARACTERISTIC
/begin CHARACTERISTIC K_SK_PROZ_ERR "Maske Prozessueberwachung | EN: Process monitoring mask" VALUE 0x78778 TKW_VV_VV_UW 100.0 FORMULA_0010 0.0 65535.0000 /end CHARACTERISTIC
/begin CHARACTERISTIC K_SK_MD_BEGR_MVAC_SYS "Begrenzung bei MVAC-Systemfehler | EN: Limitation with brake-booster vacuum system fault" VALUE 0x7877A TKW_VV_VV_UB 100.0 FORMULA_0003 0.0 255.0000 /end CHARACTERISTIC
/begin CHARACTERISTIC K_SK_MD_BEGR_RESET "Begrenzung ab dem 1.Reset | EN: Limitation from the 1st reset" VALUE 0x7877B TKW_VV_VV_UB 100.0 FORMULA_0003 0.0 255.0000 /end CHARACTERISTIC
/begin CHARACTERISTIC K_SK_EGAS_OFF_1of16_ "DK2 DK1 LLS2 LLS1 | EN: DK2 DK1 LLS2 LLS1" VALUE 0x7877C TKW_VV_VV_UB 100.0 FORMULA_0003 0.0 255.0000 /end CHARACTERISTIC
/begin CHARACTERISTIC K_SK_EGAS_OFF_2of16_ "DK2 DK1 LLS2 LLS1 | EN: DK2 DK1 LLS2 LLS1" VALUE 0x7877D TKW_VV_VV_UB 100.0 FORMULA_0003 0.0 255.0000 /end CHARACTERISTIC
/begin CHARACTERISTIC K_SK_EGAS_OFF_3of16_ "DK2 DK1 LLS2 LLS1 | EN: DK2 DK1 LLS2 LLS1" VALUE 0x7877E TKW_VV_VV_UB 100.0 FORMULA_0003 0.0 255.0000 /end CHARACTERISTIC
/begin CHARACTERISTIC K_SK_EGAS_OFF_4of16_ "DK2 DK1 LLS2 LLS1 | EN: DK2 DK1 LLS2 LLS1" VALUE 0x7877F TKW_VV_VV_UB 100.0 FORMULA_0003 0.0 255.0000 /end CHARACTERISTIC
/begin CHARACTERISTIC K_SK_EGAS_OFF_5of16_ "DK2 DK1 LLS2 LLS1 | EN: DK2 DK1 LLS2 LLS1" VALUE 0x78780 TKW_VV_VV_UB 100.0 FORMULA_0003 0.0 255.0000 /end CHARACTERISTIC
/begin CHARACTERISTIC K_SK_EGAS_OFF_6of16_ "DK2 DK1 LLS2 LLS1" VALUE 0x78781 TKW_VV_VV_UB 100.0 FORMULA_0003 0.0 255.0000 /end CHARACTERISTIC
/begin CHARACTERISTIC K_SK_EGAS_OFF_7of16_ "DK2 DK1 LLS2 LLS1 | EN: DK2 DK1 LLS2 LLS1" VALUE 0x78782 TKW_VV_VV_UB 100.0 FORMULA_0003 0.0 255.0000 /end CHARACTERISTIC
/begin CHARACTERISTIC K_SK_EGAS_OFF_8of16_ "DK2 DK1 LLS2 LLS1" VALUE 0x78783 TKW_VV_VV_UB 100.0 FORMULA_0003 0.0 255.0000 /end CHARACTERISTIC
/begin CHARACTERISTIC K_SK_EGAS_OFF_9of16_ "DK2 DK1 LLS2 LLS1" VALUE 0x78784 TKW_VV_VV_UB 100.0 FORMULA_0003 0.0 255.0000 /end CHARACTERISTIC
/begin CHARACTERISTIC K_SK_EGAS_OFF_10of16_ "DK2 DK1 LLS2 LLS1" VALUE 0x78785 TKW_VV_VV_UB 100.0 FORMULA_0003 0.0 255.0000 /end CHARACTERISTIC
/begin CHARACTERISTIC K_SK_EGAS_OFF_11of16_ "DK2 DK1 LLS2 LLS1" VALUE 0x78786 TKW_VV_VV_UB 100.0 FORMULA_0003 0.0 255.0000 /end CHARACTERISTIC
/begin CHARACTERISTIC K_SK_EGAS_OFF_12of16_ "DK2 DK1 LLS2 LLS1" VALUE 0x78787 TKW_VV_VV_UB 100.0 FORMULA_0003 0.0 255.0000 /end CHARACTERISTIC
/begin CHARACTERISTIC K_SK_EGAS_OFF_13of16_ "DK2 DK1 LLS2 LLS1" VALUE 0x78788 TKW_VV_VV_UB 100.0 FORMULA_0003 0.0 255.0000 /end CHARACTERISTIC
/begin CHARACTERISTIC K_SK_EGAS_OFF_14of16_ "DK2 DK1 LLS2 LLS1 | EN: DK2 DK1 LLS2 LLS1" VALUE 0x78789 TKW_VV_VV_UB 100.0 FORMULA_0003 0.0 255.0000 /end CHARACTERISTIC
/begin CHARACTERISTIC K_SK_EGAS_OFF_15of16_ "DK2 DK1 LLS2 LLS1 | EN: DK2 DK1 LLS2 LLS1" VALUE 0x7878A TKW_VV_VV_UB 100.0 FORMULA_0003 0.0 255.0000 /end CHARACTERISTIC
/begin CHARACTERISTIC K_SK_EGAS_OFF_16of16_ "DK2 DK1 LLS2 LLS1 | EN: DK2 DK1 LLS2 LLS1" VALUE 0x7878B TKW_VV_VV_UB 100.0 FORMULA_0003 0.0 255.0000 /end CHARACTERISTIC
/begin CHARACTERISTIC K_SK_MD_BEGR_EGAS_1of64_ "WDK2 WDK1 DK2 DK1 LLS2 LLS1 | EN: WDK2 WDK1 DK2 DK1 LLS2 LLS1" VALUE 0x7878C TKW_VV_VV_UB 100.0 FORMULA_0003 0.0 255.0000 /end CHARACTERISTIC
/begin CHARACTERISTIC K_SK_MD_BEGR_EGAS_2of64_ "WDK2 WDK1 DK2 DK1 LLS2 LLS1 | EN: WDK2 WDK1 DK2 DK1 LLS2 LLS1" VALUE 0x7878D TKW_VV_VV_UB 100.0 FORMULA_0003 0.0 255.0000 /end CHARACTERISTIC
/begin CHARACTERISTIC K_SK_MD_BEGR_EGAS_3of64_ "WDK2 WDK1 DK2 DK1 LLS2 LLS1 | EN: WDK2 WDK1 DK2 DK1 LLS2 LLS1" VALUE 0x7878E TKW_VV_VV_UB 100.0 FORMULA_0003 0.0 255.0000 /end CHARACTERISTIC
/begin CHARACTERISTIC K_SK_MD_BEGR_EGAS_4of64_ "WDK2 WDK1 DK2 DK1 LLS2 LLS1 | EN: WDK2 WDK1 DK2 DK1 LLS2 LLS1" VALUE 0x7878F TKW_VV_VV_UB 100.0 FORMULA_0003 0.0 255.0000 /end CHARACTERISTIC
/begin CHARACTERISTIC K_SK_MD_BEGR_EGAS_5of64_ "WDK2 WDK1 DK2 DK1 LLS2 LLS1 | EN: WDK2 WDK1 DK2 DK1 LLS2 LLS1" VALUE 0x78790 TKW_VV_VV_UB 100.0 FORMULA_0003 0.0 255.0000 /end CHARACTERISTIC
/begin CHARACTERISTIC K_SK_MD_BEGR_EGAS_6of64_ "WDK2 WDK1 DK2 DK1 LLS2 LLS1 | EN: WDK2 WDK1 DK2 DK1 LLS2 LLS1" VALUE 0x78791 TKW_VV_VV_UB 100.0 FORMULA_0003 0.0 255.0000 /end CHARACTERISTIC
/begin CHARACTERISTIC K_SK_MD_BEGR_EGAS_7of64_ "WDK2 WDK1 DK2 DK1 LLS2 LLS1 | EN: WDK2 WDK1 DK2 DK1 LLS2 LLS1" VALUE 0x78792 TKW_VV_VV_UB 100.0 FORMULA_0003 0.0 255.0000 /end CHARACTERISTIC
/begin CHARACTERISTIC K_SK_MD_BEGR_EGAS_8of64_ "WDK2 WDK1 DK2 DK1 LLS2 LLS1 | EN: WDK2 WDK1 DK2 DK1 LLS2 LLS1" VALUE 0x78793 TKW_VV_VV_UB 100.0 FORMULA_0003 0.0 255.0000 /end CHARACTERISTIC
/begin CHARACTERISTIC K_SK_MD_BEGR_EGAS_9of64_ "WDK2 WDK1 DK2 DK1 LLS2 LLS1 | EN: WDK2 WDK1 DK2 DK1 LLS2 LLS1" VALUE 0x78794 TKW_VV_VV_UB 100.0 FORMULA_0003 0.0 255.0000 /end CHARACTERISTIC
/begin CHARACTERISTIC K_SK_MD_BEGR_EGAS_10of64_ "WDK2 WDK1 DK2 DK1 LLS2 LLS1 | EN: WDK2 WDK1 DK2 DK1 LLS2 LLS1" VALUE 0x78795 TKW_VV_VV_UB 100.0 FORMULA_0003 0.0 255.0000 /end CHARACTERISTIC
/begin CHARACTERISTIC K_SK_MD_BEGR_EGAS_11of64_ "WDK2 WDK1 DK2 DK1 LLS2 LLS1 | EN: WDK2 WDK1 DK2 DK1 LLS2 LLS1" VALUE 0x78796 TKW_VV_VV_UB 100.0 FORMULA_0003 0.0 255.0000 /end CHARACTERISTIC
/begin CHARACTERISTIC K_SK_MD_BEGR_EGAS_12of64_ "WDK2 WDK1 DK2 DK1 LLS2 LLS1 | EN: WDK2 WDK1 DK2 DK1 LLS2 LLS1" VALUE 0x78797 TKW_VV_VV_UB 100.0 FORMULA_0003 0.0 255.0000 /end CHARACTERISTIC
/begin CHARACTERISTIC K_SK_MD_BEGR_EGAS_13of64_ "WDK2 WDK1 DK2 DK1 LLS2 LLS1 | EN: WDK2 WDK1 DK2 DK1 LLS2 LLS1" VALUE 0x78798 TKW_VV_VV_UB 100.0 FORMULA_0003 0.0 255.0000 /end CHARACTERISTIC
/begin CHARACTERISTIC K_SK_MD_BEGR_EGAS_14of64_ "WDK2 WDK1 DK2 DK1 LLS2 LLS1 | EN: WDK2 WDK1 DK2 DK1 LLS2 LLS1" VALUE 0x78799 TKW_VV_VV_UB 100.0 FORMULA_0003 0.0 255.0000 /end CHARACTERISTIC
/begin CHARACTERISTIC K_SK_MD_BEGR_EGAS_15of64_ "WDK2 WDK1 DK2 DK1 LLS2 LLS1 | EN: WDK2 WDK1 DK2 DK1 LLS2 LLS1" VALUE 0x7879A TKW_VV_VV_UB 100.0 FORMULA_0003 0.0 255.0000 /end CHARACTERISTIC
/begin CHARACTERISTIC K_SK_MD_BEGR_EGAS_16of64_ "WDK2 WDK1 DK2 DK1 LLS2 LLS1 | EN: WDK2 WDK1 DK2 DK1 LLS2 LLS1" VALUE 0x7879B TKW_VV_VV_UB 100.0 FORMULA_0003 0.0 255.0000 /end CHARACTERISTIC
/begin CHARACTERISTIC K_SK_MD_BEGR_EGAS_17of64_ "WDK2 WDK1 DK2 DK1 LLS2 LLS1" VALUE 0x7879C TKW_VV_VV_UB 100.0 FORMULA_0003 0.0 255.0000 /end CHARACTERISTIC
/begin CHARACTERISTIC K_SK_MD_BEGR_EGAS_18of64_ "WDK2 WDK1 DK2 DK1 LLS2 LLS1" VALUE 0x7879D TKW_VV_VV_UB 100.0 FORMULA_0003 0.0 255.0000 /end CHARACTERISTIC
/begin CHARACTERISTIC K_SK_MD_BEGR_EGAS_19of64_ "WDK2 WDK1 DK2 DK1 LLS2 LLS1" VALUE 0x7879E TKW_VV_VV_UB 100.0 FORMULA_0003 0.0 255.0000 /end CHARACTERISTIC
/begin CHARACTERISTIC K_SK_MD_BEGR_EGAS_20of64_ "WDK2 WDK1 DK2 DK1 LLS2 LLS1" VALUE 0x7879F TKW_VV_VV_UB 100.0 FORMULA_0003 0.0 255.0000 /end CHARACTERISTIC
/begin CHARACTERISTIC K_SK_MD_BEGR_EGAS_21of64_ "WDK2 WDK1 DK2 DK1 LLS2 LLS1" VALUE 0x787A0 TKW_VV_VV_UB 100.0 FORMULA_0003 0.0 255.0000 /end CHARACTERISTIC
/begin CHARACTERISTIC K_SK_MD_BEGR_EGAS_22of64_ "WDK2 WDK1 DK2 DK1 LLS2 LLS1" VALUE 0x787A1 TKW_VV_VV_UB 100.0 FORMULA_0003 0.0 255.0000 /end CHARACTERISTIC
/begin CHARACTERISTIC K_SK_MD_BEGR_EGAS_23of64_ "WDK2 WDK1 DK2 DK1 LLS2 LLS1" VALUE 0x787A2 TKW_VV_VV_UB 100.0 FORMULA_0003 0.0 255.0000 /end CHARACTERISTIC
/begin CHARACTERISTIC K_SK_MD_BEGR_EGAS_24of64_ "WDK2 WDK1 DK2 DK1 LLS2 LLS1" VALUE 0x787A3 TKW_VV_VV_UB 100.0 FORMULA_0003 0.0 255.0000 /end CHARACTERISTIC
/begin CHARACTERISTIC K_SK_MD_BEGR_EGAS_25of64_ "WDK2 WDK1 DK2 DK1 LLS2 LLS1 | EN: WDK2 WDK1 DK2 DK1 LLS2 LLS1" VALUE 0x787A4 TKW_VV_VV_UB 100.0 FORMULA_0003 0.0 255.0000 /end CHARACTERISTIC
/begin CHARACTERISTIC K_SK_MD_BEGR_EGAS_26of64_ "WDK2 WDK1 DK2 DK1 LLS2 LLS1 | EN: WDK2 WDK1 DK2 DK1 LLS2 LLS1" VALUE 0x787A5 TKW_VV_VV_UB 100.0 FORMULA_0003 0.0 255.0000 /end CHARACTERISTIC
/begin CHARACTERISTIC K_SK_MD_BEGR_EGAS_27of64_ "WDK2 WDK1 DK2 DK1 LLS2 LLS1 | EN: WDK2 WDK1 DK2 DK1 LLS2 LLS1" VALUE 0x787A6 TKW_VV_VV_UB 100.0 FORMULA_0003 0.0 255.0000 /end CHARACTERISTIC
/begin CHARACTERISTIC K_SK_MD_BEGR_EGAS_28of64_ "WDK2 WDK1 DK2 DK1 LLS2 LLS1 | EN: WDK2 WDK1 DK2 DK1 LLS2 LLS1" VALUE 0x787A7 TKW_VV_VV_UB 100.0 FORMULA_0003 0.0 255.0000 /end CHARACTERISTIC
/begin CHARACTERISTIC K_SK_MD_BEGR_EGAS_29of64_ "WDK2 WDK1 DK2 DK1 LLS2 LLS1" VALUE 0x787A8 TKW_VV_VV_UB 100.0 FORMULA_0003 0.0 255.0000 /end CHARACTERISTIC
/begin CHARACTERISTIC K_SK_MD_BEGR_EGAS_30of64_ "WDK2 WDK1 DK2 DK1 LLS2 LLS1" VALUE 0x787A9 TKW_VV_VV_UB 100.0 FORMULA_0003 0.0 255.0000 /end CHARACTERISTIC
/begin CHARACTERISTIC K_SK_MD_BEGR_EGAS_31of64_ "WDK2 WDK1 DK2 DK1 LLS2 LLS1" VALUE 0x787AA TKW_VV_VV_UB 100.0 FORMULA_0003 0.0 255.0000 /end CHARACTERISTIC
/begin CHARACTERISTIC K_SK_MD_BEGR_EGAS_32of64_ "WDK2 WDK1 DK2 DK1 LLS2 LLS1" VALUE 0x787AB TKW_VV_VV_UB 100.0 FORMULA_0003 0.0 255.0000 /end CHARACTERISTIC
/begin CHARACTERISTIC K_SK_MD_BEGR_EGAS_33of64_ "WDK2 WDK1 DK2 DK1 LLS2 LLS1" VALUE 0x787AC TKW_VV_VV_UB 100.0 FORMULA_0003 0.0 255.0000 /end CHARACTERISTIC
/begin CHARACTERISTIC K_SK_MD_BEGR_EGAS_34of64_ "WDK2 WDK1 DK2 DK1 LLS2 LLS1" VALUE 0x787AD TKW_VV_VV_UB 100.0 FORMULA_0003 0.0 255.0000 /end CHARACTERISTIC
/begin CHARACTERISTIC K_SK_MD_BEGR_EGAS_35of64_ "WDK2 WDK1 DK2 DK1 LLS2 LLS1" VALUE 0x787AE TKW_VV_VV_UB 100.0 FORMULA_0003 0.0 255.0000 /end CHARACTERISTIC
/begin CHARACTERISTIC K_SK_MD_BEGR_EGAS_36of64_ "WDK2 WDK1 DK2 DK1 LLS2 LLS1" VALUE 0x787AF TKW_VV_VV_UB 100.0 FORMULA_0003 0.0 255.0000 /end CHARACTERISTIC
/begin CHARACTERISTIC K_SK_MD_BEGR_EGAS_37of64_ "WDK2 WDK1 DK2 DK1 LLS2 LLS1" VALUE 0x787B0 TKW_VV_VV_UB 100.0 FORMULA_0003 0.0 255.0000 /end CHARACTERISTIC
/begin CHARACTERISTIC K_SK_MD_BEGR_EGAS_38of64_ "WDK2 WDK1 DK2 DK1 LLS2 LLS1" VALUE 0x787B1 TKW_VV_VV_UB 100.0 FORMULA_0003 0.0 255.0000 /end CHARACTERISTIC
/begin CHARACTERISTIC K_SK_MD_BEGR_EGAS_39of64_ "WDK2 WDK1 DK2 DK1 LLS2 LLS1" VALUE 0x787B2 TKW_VV_VV_UB 100.0 FORMULA_0003 0.0 255.0000 /end CHARACTERISTIC
/begin CHARACTERISTIC K_SK_MD_BEGR_EGAS_40of64_ "WDK2 WDK1 DK2 DK1 LLS2 LLS1" VALUE 0x787B3 TKW_VV_VV_UB 100.0 FORMULA_0003 0.0 255.0000 /end CHARACTERISTIC
/begin CHARACTERISTIC K_SK_MD_BEGR_EGAS_41of64_ "WDK2 WDK1 DK2 DK1 LLS2 LLS1 | EN: WDK2 WDK1 DK2 DK1 LLS2 LLS1" VALUE 0x787B4 TKW_VV_VV_UB 100.0 FORMULA_0003 0.0 255.0000 /end CHARACTERISTIC
/begin CHARACTERISTIC K_SK_MD_BEGR_EGAS_42of64_ "WDK2 WDK1 DK2 DK1 LLS2 LLS1 | EN: WDK2 WDK1 DK2 DK1 LLS2 LLS1" VALUE 0x787B5 TKW_VV_VV_UB 100.0 FORMULA_0003 0.0 255.0000 /end CHARACTERISTIC
/begin CHARACTERISTIC K_SK_MD_BEGR_EGAS_43of64_ "WDK2 WDK1 DK2 DK1 LLS2 LLS1 | EN: WDK2 WDK1 DK2 DK1 LLS2 LLS1" VALUE 0x787B6 TKW_VV_VV_UB 100.0 FORMULA_0003 0.0 255.0000 /end CHARACTERISTIC
/begin CHARACTERISTIC K_SK_MD_BEGR_EGAS_44of64_ "WDK2 WDK1 DK2 DK1 LLS2 LLS1 | EN: WDK2 WDK1 DK2 DK1 LLS2 LLS1" VALUE 0x787B7 TKW_VV_VV_UB 100.0 FORMULA_0003 0.0 255.0000 /end CHARACTERISTIC
/begin CHARACTERISTIC K_SK_MD_BEGR_EGAS_45of64_ "WDK2 WDK1 DK2 DK1 LLS2 LLS1" VALUE 0x787B8 TKW_VV_VV_UB 100.0 FORMULA_0003 0.0 255.0000 /end CHARACTERISTIC
/begin CHARACTERISTIC K_SK_MD_BEGR_EGAS_46of64_ "WDK2 WDK1 DK2 DK1 LLS2 LLS1" VALUE 0x787B9 TKW_VV_VV_UB 100.0 FORMULA_0003 0.0 255.0000 /end CHARACTERISTIC
/begin CHARACTERISTIC K_SK_MD_BEGR_EGAS_47of64_ "WDK2 WDK1 DK2 DK1 LLS2 LLS1" VALUE 0x787BA TKW_VV_VV_UB 100.0 FORMULA_0003 0.0 255.0000 /end CHARACTERISTIC
/begin CHARACTERISTIC K_SK_MD_BEGR_EGAS_48of64_ "WDK2 WDK1 DK2 DK1 LLS2 LLS1" VALUE 0x787BB TKW_VV_VV_UB 100.0 FORMULA_0003 0.0 255.0000 /end CHARACTERISTIC
/begin CHARACTERISTIC K_SK_MD_BEGR_EGAS_49of64_ "WDK2 WDK1 DK2 DK1 LLS2 LLS1" VALUE 0x787BC TKW_VV_VV_UB 100.0 FORMULA_0003 0.0 255.0000 /end CHARACTERISTIC
/begin CHARACTERISTIC K_SK_MD_BEGR_EGAS_50of64_ "WDK2 WDK1 DK2 DK1 LLS2 LLS1" VALUE 0x787BD TKW_VV_VV_UB 100.0 FORMULA_0003 0.0 255.0000 /end CHARACTERISTIC
/begin CHARACTERISTIC K_SK_MD_BEGR_EGAS_51of64_ "WDK2 WDK1 DK2 DK1 LLS2 LLS1" VALUE 0x787BE TKW_VV_VV_UB 100.0 FORMULA_0003 0.0 255.0000 /end CHARACTERISTIC
/begin CHARACTERISTIC K_SK_MD_BEGR_EGAS_52of64_ "WDK2 WDK1 DK2 DK1 LLS2 LLS1" VALUE 0x787BF TKW_VV_VV_UB 100.0 FORMULA_0003 0.0 255.0000 /end CHARACTERISTIC
/begin CHARACTERISTIC K_SK_MD_BEGR_EGAS_53of64_ "WDK2 WDK1 DK2 DK1 LLS2 LLS1" VALUE 0x787C0 TKW_VV_VV_UB 100.0 FORMULA_0003 0.0 255.0000 /end CHARACTERISTIC
/begin CHARACTERISTIC K_SK_MD_BEGR_EGAS_54of64_ "WDK2 WDK1 DK2 DK1 LLS2 LLS1" VALUE 0x787C1 TKW_VV_VV_UB 100.0 FORMULA_0003 0.0 255.0000 /end CHARACTERISTIC
/begin CHARACTERISTIC K_SK_MD_BEGR_EGAS_55of64_ "WDK2 WDK1 DK2 DK1 LLS2 LLS1" VALUE 0x787C2 TKW_VV_VV_UB 100.0 FORMULA_0003 0.0 255.0000 /end CHARACTERISTIC
/begin CHARACTERISTIC K_SK_MD_BEGR_EGAS_56of64_ "WDK2 WDK1 DK2 DK1 LLS2 LLS1" VALUE 0x787C3 TKW_VV_VV_UB 100.0 FORMULA_0003 0.0 255.0000 /end CHARACTERISTIC
/begin CHARACTERISTIC K_SK_MD_BEGR_EGAS_57of64_ "WDK2 WDK1 DK2 DK1 LLS2 LLS1" VALUE 0x787C4 TKW_VV_VV_UB 100.0 FORMULA_0003 0.0 255.0000 /end CHARACTERISTIC
/begin CHARACTERISTIC K_SK_MD_BEGR_EGAS_58of64_ "WDK2 WDK1 DK2 DK1 LLS2 LLS1" VALUE 0x787C5 TKW_VV_VV_UB 100.0 FORMULA_0003 0.0 255.0000 /end CHARACTERISTIC
/begin CHARACTERISTIC K_SK_MD_BEGR_EGAS_59of64_ "WDK2 WDK1 DK2 DK1 LLS2 LLS1" VALUE 0x787C6 TKW_VV_VV_UB 100.0 FORMULA_0003 0.0 255.0000 /end CHARACTERISTIC
/begin CHARACTERISTIC K_SK_MD_BEGR_EGAS_60of64_ "WDK2 WDK1 DK2 DK1 LLS2 LLS1" VALUE 0x787C7 TKW_VV_VV_UB 100.0 FORMULA_0003 0.0 255.0000 /end CHARACTERISTIC
/begin CHARACTERISTIC K_SK_MD_BEGR_EGAS_61of64_ "WDK2 WDK1 DK2 DK1 LLS2 LLS1" VALUE 0x787C8 TKW_VV_VV_UB 100.0 FORMULA_0003 0.0 255.0000 /end CHARACTERISTIC
/begin CHARACTERISTIC K_SK_MD_BEGR_EGAS_62of64_ "WDK2 WDK1 DK2 DK1 LLS2 LLS1" VALUE 0x787C9 TKW_VV_VV_UB 100.0 FORMULA_0003 0.0 255.0000 /end CHARACTERISTIC
/begin CHARACTERISTIC K_SK_MD_BEGR_EGAS_63of64_ "WDK2 WDK1 DK2 DK1 LLS2 LLS1" VALUE 0x787CA TKW_VV_VV_UB 100.0 FORMULA_0003 0.0 255.0000 /end CHARACTERISTIC
/begin CHARACTERISTIC K_SK_MD_BEGR_EGAS_64of64_ "WDK2 WDK1 DK2 DK1 LLS2 LLS1 | EN: WDK2 WDK1 DK2 DK1 LLS2 LLS1" VALUE 0x787CB TKW_VV_VV_UB 100.0 FORMULA_0003 0.0 255.0000 /end CHARACTERISTIC
/begin CHARACTERISTIC K_SK_MD_BEGR_TI_1of16_ "B2 B1 Z2 Z1" VALUE 0x787CC TKW_VV_VV_UB 100.0 FORMULA_0003 0.0 255.0000 /end CHARACTERISTIC
/begin CHARACTERISTIC K_SK_MD_BEGR_TI_2of16_ "B2 B1 Z2 Z1 | EN: B2 B1 Z2 Z1" VALUE 0x787CD TKW_VV_VV_UB 100.0 FORMULA_0003 0.0 255.0000 /end CHARACTERISTIC
/begin CHARACTERISTIC K_SK_MD_BEGR_TI_3of16_ "B2 B1 Z2 Z1 | EN: B2 B1 Z2 Z1" VALUE 0x787CE TKW_VV_VV_UB 100.0 FORMULA_0003 0.0 255.0000 /end CHARACTERISTIC
/begin CHARACTERISTIC K_SK_MD_BEGR_TI_4of16_ "B2 B1 Z2 Z1 | EN: B2 B1 Z2 Z1" VALUE 0x787CF TKW_VV_VV_UB 100.0 FORMULA_0003 0.0 255.0000 /end CHARACTERISTIC
/begin CHARACTERISTIC K_SK_MD_BEGR_TI_5of16_ "B2 B1 Z2 Z1 | EN: B2 B1 Z2 Z1" VALUE 0x787D0 TKW_VV_VV_UB 100.0 FORMULA_0003 0.0 255.0000 /end CHARACTERISTIC
/begin CHARACTERISTIC K_SK_MD_BEGR_TI_6of16_ "B2 B1 Z2 Z1 | EN: B2 B1 Z2 Z1" VALUE 0x787D1 TKW_VV_VV_UB 100.0 FORMULA_0003 0.0 255.0000 /end CHARACTERISTIC
/begin CHARACTERISTIC K_SK_MD_BEGR_TI_7of16_ "B2 B1 Z2 Z1 | EN: B2 B1 Z2 Z1" VALUE 0x787D2 TKW_VV_VV_UB 100.0 FORMULA_0003 0.0 255.0000 /end CHARACTERISTIC
/begin CHARACTERISTIC K_SK_MD_BEGR_TI_8of16_ "B2 B1 Z2 Z1 | EN: B2 B1 Z2 Z1" VALUE 0x787D3 TKW_VV_VV_UB 100.0 FORMULA_0003 0.0 255.0000 /end CHARACTERISTIC
/begin CHARACTERISTIC K_SK_MD_BEGR_TI_9of16_ "B2 B1 Z2 Z1 | EN: B2 B1 Z2 Z1" VALUE 0x787D4 TKW_VV_VV_UB 100.0 FORMULA_0003 0.0 255.0000 /end CHARACTERISTIC
/begin CHARACTERISTIC K_SK_MD_BEGR_TI_10of16_ "B2 B1 Z2 Z1 | EN: B2 B1 Z2 Z1" VALUE 0x787D5 TKW_VV_VV_UB 100.0 FORMULA_0003 0.0 255.0000 /end CHARACTERISTIC
/begin CHARACTERISTIC K_SK_MD_BEGR_TI_11of16_ "B2 B1 Z2 Z1 | EN: B2 B1 Z2 Z1" VALUE 0x787D6 TKW_VV_VV_UB 100.0 FORMULA_0003 0.0 255.0000 /end CHARACTERISTIC
/begin CHARACTERISTIC K_SK_MD_BEGR_TI_12of16_ "B2 B1 Z2 Z1 | EN: B2 B1 Z2 Z1" VALUE 0x787D7 TKW_VV_VV_UB 100.0 FORMULA_0003 0.0 255.0000 /end CHARACTERISTIC
/begin CHARACTERISTIC K_SK_MD_BEGR_TI_13of16_ "B2 B1 Z2 Z1 | EN: B2 B1 Z2 Z1" VALUE 0x787D8 TKW_VV_VV_UB 100.0 FORMULA_0003 0.0 255.0000 /end CHARACTERISTIC
/begin CHARACTERISTIC K_SK_MD_BEGR_TI_14of16_ "B2 B1 Z2 Z1 | EN: B2 B1 Z2 Z1" VALUE 0x787D9 TKW_VV_VV_UB 100.0 FORMULA_0003 0.0 255.0000 /end CHARACTERISTIC
/begin CHARACTERISTIC K_SK_MD_BEGR_TI_15of16_ "B2 B1 Z2 Z1 | EN: B2 B1 Z2 Z1" VALUE 0x787DA TKW_VV_VV_UB 100.0 FORMULA_0003 0.0 255.0000 /end CHARACTERISTIC
/begin CHARACTERISTIC K_SK_MD_BEGR_TI_16of16_ "B2 B1 Z2 Z1 | EN: B2 B1 Z2 Z1" VALUE 0x787DB TKW_VV_VV_UB 100.0 FORMULA_0003 0.0 255.0000 /end CHARACTERISTIC
/begin CHARACTERISTIC K_SK_TI_OFF_EGAS_1of64_ "TI2 TI1 DK2 DK1 LLS2 LLS1 | EN: TI2 TI1 DK2 DK1 LLS2 LLS1" VALUE 0x787DC TKW_VV_VV_UB 100.0 FORMULA_0003 0.0 255.0000 /end CHARACTERISTIC
/begin CHARACTERISTIC K_SK_TI_OFF_EGAS_2of64_ "TI2 TI1 DK2 DK1 LLS2 LLS1 | EN: TI2 TI1 DK2 DK1 LLS2 LLS1" VALUE 0x787DD TKW_VV_VV_UB 100.0 FORMULA_0003 0.0 255.0000 /end CHARACTERISTIC
/begin CHARACTERISTIC K_SK_TI_OFF_EGAS_3of64_ "TI2 TI1 DK2 DK1 LLS2 LLS1 | EN: TI2 TI1 DK2 DK1 LLS2 LLS1" VALUE 0x787DE TKW_VV_VV_UB 100.0 FORMULA_0003 0.0 255.0000 /end CHARACTERISTIC
/begin CHARACTERISTIC K_SK_TI_OFF_EGAS_4of64_ "TI2 TI1 DK2 DK1 LLS2 LLS1 | EN: TI2 TI1 DK2 DK1 LLS2 LLS1" VALUE 0x787DF TKW_VV_VV_UB 100.0 FORMULA_0003 0.0 255.0000 /end CHARACTERISTIC
/begin CHARACTERISTIC K_SK_TI_OFF_EGAS_5of64_ "TI2 TI1 DK2 DK1 LLS2 LLS1 | EN: TI2 TI1 DK2 DK1 LLS2 LLS1" VALUE 0x787E0 TKW_VV_VV_UB 100.0 FORMULA_0003 0.0 255.0000 /end CHARACTERISTIC
/begin CHARACTERISTIC K_SK_TI_OFF_EGAS_6of64_ "TI2 TI1 DK2 DK1 LLS2 LLS1 | EN: TI2 TI1 DK2 DK1 LLS2 LLS1" VALUE 0x787E1 TKW_VV_VV_UB 100.0 FORMULA_0003 0.0 255.0000 /end CHARACTERISTIC
/begin CHARACTERISTIC K_SK_TI_OFF_EGAS_7of64_ "TI2 TI1 DK2 DK1 LLS2 LLS1 | EN: TI2 TI1 DK2 DK1 LLS2 LLS1" VALUE 0x787E2 TKW_VV_VV_UB 100.0 FORMULA_0003 0.0 255.0000 /end CHARACTERISTIC
/begin CHARACTERISTIC K_SK_TI_OFF_EGAS_8of64_ "TI2 TI1 DK2 DK1 LLS2 LLS1 | EN: TI2 TI1 DK2 DK1 LLS2 LLS1" VALUE 0x787E3 TKW_VV_VV_UB 100.0 FORMULA_0003 0.0 255.0000 /end CHARACTERISTIC
/begin CHARACTERISTIC K_SK_TI_OFF_EGAS_9of64_ "TI2 TI1 DK2 DK1 LLS2 LLS1 | EN: TI2 TI1 DK2 DK1 LLS2 LLS1" VALUE 0x787E4 TKW_VV_VV_UB 100.0 FORMULA_0003 0.0 255.0000 /end CHARACTERISTIC
/begin CHARACTERISTIC K_SK_TI_OFF_EGAS_10of64_ "TI2 TI1 DK2 DK1 LLS2 LLS1 | EN: TI2 TI1 DK2 DK1 LLS2 LLS1" VALUE 0x787E5 TKW_VV_VV_UB 100.0 FORMULA_0003 0.0 255.0000 /end CHARACTERISTIC
/begin CHARACTERISTIC K_SK_TI_OFF_EGAS_11of64_ "TI2 TI1 DK2 DK1 LLS2 LLS1 | EN: TI2 TI1 DK2 DK1 LLS2 LLS1" VALUE 0x787E6 TKW_VV_VV_UB 100.0 FORMULA_0003 0.0 255.0000 /end CHARACTERISTIC
/begin CHARACTERISTIC K_SK_TI_OFF_EGAS_12of64_ "TI2 TI1 DK2 DK1 LLS2 LLS1 | EN: TI2 TI1 DK2 DK1 LLS2 LLS1" VALUE 0x787E7 TKW_VV_VV_UB 100.0 FORMULA_0003 0.0 255.0000 /end CHARACTERISTIC
/begin CHARACTERISTIC K_SK_TI_OFF_EGAS_13of64_ "TI2 TI1 DK2 DK1 LLS2 LLS1 | EN: TI2 TI1 DK2 DK1 LLS2 LLS1" VALUE 0x787E8 TKW_VV_VV_UB 100.0 FORMULA_0003 0.0 255.0000 /end CHARACTERISTIC
/begin CHARACTERISTIC K_SK_TI_OFF_EGAS_14of64_ "TI2 TI1 DK2 DK1 LLS2 LLS1 | EN: TI2 TI1 DK2 DK1 LLS2 LLS1" VALUE 0x787E9 TKW_VV_VV_UB 100.0 FORMULA_0003 0.0 255.0000 /end CHARACTERISTIC
/begin CHARACTERISTIC K_SK_TI_OFF_EGAS_15of64_ "TI2 TI1 DK2 DK1 LLS2 LLS1 | EN: TI2 TI1 DK2 DK1 LLS2 LLS1" VALUE 0x787EA TKW_VV_VV_UB 100.0 FORMULA_0003 0.0 255.0000 /end CHARACTERISTIC
/begin CHARACTERISTIC K_SK_TI_OFF_EGAS_16of64_ "TI2 TI1 DK2 DK1 LLS2 LLS1 | EN: TI2 TI1 DK2 DK1 LLS2 LLS1" VALUE 0x787EB TKW_VV_VV_UB 100.0 FORMULA_0003 0.0 255.0000 /end CHARACTERISTIC
/begin CHARACTERISTIC K_SK_TI_OFF_EGAS_17of64_ "TI2 TI1 DK2 DK1 LLS2 LLS1 | EN: TI2 TI1 DK2 DK1 LLS2 LLS1" VALUE 0x787EC TKW_VV_VV_UB 100.0 FORMULA_0003 0.0 255.0000 /end CHARACTERISTIC
/begin CHARACTERISTIC K_SK_TI_OFF_EGAS_18of64_ "TI2 TI1 DK2 DK1 LLS2 LLS1 | EN: TI2 TI1 DK2 DK1 LLS2 LLS1" VALUE 0x787ED TKW_VV_VV_UB 100.0 FORMULA_0003 0.0 255.0000 /end CHARACTERISTIC
/begin CHARACTERISTIC K_SK_TI_OFF_EGAS_19of64_ "TI2 TI1 DK2 DK1 LLS2 LLS1 | EN: TI2 TI1 DK2 DK1 LLS2 LLS1" VALUE 0x787EE TKW_VV_VV_UB 100.0 FORMULA_0003 0.0 255.0000 /end CHARACTERISTIC
/begin CHARACTERISTIC K_SK_TI_OFF_EGAS_20of64_ "TI2 TI1 DK2 DK1 LLS2 LLS1 | EN: TI2 TI1 DK2 DK1 LLS2 LLS1" VALUE 0x787EF TKW_VV_VV_UB 100.0 FORMULA_0003 0.0 255.0000 /end CHARACTERISTIC
/begin CHARACTERISTIC K_SK_TI_OFF_EGAS_21of64_ "TI2 TI1 DK2 DK1 LLS2 LLS1 | EN: TI2 TI1 DK2 DK1 LLS2 LLS1" VALUE 0x787F0 TKW_VV_VV_UB 100.0 FORMULA_0003 0.0 255.0000 /end CHARACTERISTIC
/begin CHARACTERISTIC K_SK_TI_OFF_EGAS_22of64_ "TI2 TI1 DK2 DK1 LLS2 LLS1 | EN: TI2 TI1 DK2 DK1 LLS2 LLS1" VALUE 0x787F1 TKW_VV_VV_UB 100.0 FORMULA_0003 0.0 255.0000 /end CHARACTERISTIC
/begin CHARACTERISTIC K_SK_TI_OFF_EGAS_23of64_ "TI2 TI1 DK2 DK1 LLS2 LLS1 | EN: TI2 TI1 DK2 DK1 LLS2 LLS1" VALUE 0x787F2 TKW_VV_VV_UB 100.0 FORMULA_0003 0.0 255.0000 /end CHARACTERISTIC
/begin CHARACTERISTIC K_SK_TI_OFF_EGAS_24of64_ "TI2 TI1 DK2 DK1 LLS2 LLS1 | EN: TI2 TI1 DK2 DK1 LLS2 LLS1" VALUE 0x787F3 TKW_VV_VV_UB 100.0 FORMULA_0003 0.0 255.0000 /end CHARACTERISTIC
/begin CHARACTERISTIC K_SK_TI_OFF_EGAS_25of64_ "TI2 TI1 DK2 DK1 LLS2 LLS1 | EN: TI2 TI1 DK2 DK1 LLS2 LLS1" VALUE 0x787F4 TKW_VV_VV_UB 100.0 FORMULA_0003 0.0 255.0000 /end CHARACTERISTIC
/begin CHARACTERISTIC K_SK_TI_OFF_EGAS_26of64_ "TI2 TI1 DK2 DK1 LLS2 LLS1 | EN: TI2 TI1 DK2 DK1 LLS2 LLS1" VALUE 0x787F5 TKW_VV_VV_UB 100.0 FORMULA_0003 0.0 255.0000 /end CHARACTERISTIC
/begin CHARACTERISTIC K_SK_TI_OFF_EGAS_27of64_ "TI2 TI1 DK2 DK1 LLS2 LLS1 | EN: TI2 TI1 DK2 DK1 LLS2 LLS1" VALUE 0x787F6 TKW_VV_VV_UB 100.0 FORMULA_0003 0.0 255.0000 /end CHARACTERISTIC
/begin CHARACTERISTIC K_SK_TI_OFF_EGAS_28of64_ "TI2 TI1 DK2 DK1 LLS2 LLS1 | EN: TI2 TI1 DK2 DK1 LLS2 LLS1" VALUE 0x787F7 TKW_VV_VV_UB 100.0 FORMULA_0003 0.0 255.0000 /end CHARACTERISTIC
/begin CHARACTERISTIC K_SK_TI_OFF_EGAS_29of64_ "TI2 TI1 DK2 DK1 LLS2 LLS1 | EN: TI2 TI1 DK2 DK1 LLS2 LLS1" VALUE 0x787F8 TKW_VV_VV_UB 100.0 FORMULA_0003 0.0 255.0000 /end CHARACTERISTIC
/begin CHARACTERISTIC K_SK_TI_OFF_EGAS_30of64_ "TI2 TI1 DK2 DK1 LLS2 LLS1 | EN: TI2 TI1 DK2 DK1 LLS2 LLS1" VALUE 0x787F9 TKW_VV_VV_UB 100.0 FORMULA_0003 0.0 255.0000 /end CHARACTERISTIC
/begin CHARACTERISTIC K_SK_TI_OFF_EGAS_31of64_ "TI2 TI1 DK2 DK1 LLS2 LLS1 | EN: TI2 TI1 DK2 DK1 LLS2 LLS1" VALUE 0x787FA TKW_VV_VV_UB 100.0 FORMULA_0003 0.0 255.0000 /end CHARACTERISTIC
/begin CHARACTERISTIC K_SK_TI_OFF_EGAS_32of64_ "TI2 TI1 DK2 DK1 LLS2 LLS1 | EN: TI2 TI1 DK2 DK1 LLS2 LLS1" VALUE 0x787FB TKW_VV_VV_UB 100.0 FORMULA_0003 0.0 255.0000 /end CHARACTERISTIC
/begin CHARACTERISTIC K_SK_TI_OFF_EGAS_33of64_ "TI2 TI1 DK2 DK1 LLS2 LLS1 | EN: TI2 TI1 DK2 DK1 LLS2 LLS1" VALUE 0x787FC TKW_VV_VV_UB 100.0 FORMULA_0003 0.0 255.0000 /end CHARACTERISTIC
/begin CHARACTERISTIC K_SK_TI_OFF_EGAS_34of64_ "TI2 TI1 DK2 DK1 LLS2 LLS1 | EN: TI2 TI1 DK2 DK1 LLS2 LLS1" VALUE 0x787FD TKW_VV_VV_UB 100.0 FORMULA_0003 0.0 255.0000 /end CHARACTERISTIC
/begin CHARACTERISTIC K_SK_TI_OFF_EGAS_35of64_ "TI2 TI1 DK2 DK1 LLS2 LLS1 | EN: TI2 TI1 DK2 DK1 LLS2 LLS1" VALUE 0x787FE TKW_VV_VV_UB 100.0 FORMULA_0003 0.0 255.0000 /end CHARACTERISTIC
/begin CHARACTERISTIC K_SK_TI_OFF_EGAS_36of64_ "TI2 TI1 DK2 DK1 LLS2 LLS1 | EN: TI2 TI1 DK2 DK1 LLS2 LLS1" VALUE 0x787FF TKW_VV_VV_UB 100.0 FORMULA_0003 0.0 255.0000 /end CHARACTERISTIC
/begin CHARACTERISTIC K_SK_TI_OFF_EGAS_37of64_ "TI2 TI1 DK2 DK1 LLS2 LLS1 | EN: TI2 TI1 DK2 DK1 LLS2 LLS1" VALUE 0x78800 TKW_VV_VV_UB 100.0 FORMULA_0003 0.0 255.0000 /end CHARACTERISTIC
/begin CHARACTERISTIC K_SK_TI_OFF_EGAS_38of64_ "TI2 TI1 DK2 DK1 LLS2 LLS1 | EN: TI2 TI1 DK2 DK1 LLS2 LLS1" VALUE 0x78801 TKW_VV_VV_UB 100.0 FORMULA_0003 0.0 255.0000 /end CHARACTERISTIC
/begin CHARACTERISTIC K_SK_TI_OFF_EGAS_39of64_ "TI2 TI1 DK2 DK1 LLS2 LLS1 | EN: TI2 TI1 DK2 DK1 LLS2 LLS1" VALUE 0x78802 TKW_VV_VV_UB 100.0 FORMULA_0003 0.0 255.0000 /end CHARACTERISTIC
/begin CHARACTERISTIC K_SK_TI_OFF_EGAS_40of64_ "TI2 TI1 DK2 DK1 LLS2 LLS1 | EN: TI2 TI1 DK2 DK1 LLS2 LLS1" VALUE 0x78803 TKW_VV_VV_UB 100.0 FORMULA_0003 0.0 255.0000 /end CHARACTERISTIC
/begin CHARACTERISTIC K_SK_TI_OFF_EGAS_41of64_ "TI2 TI1 DK2 DK1 LLS2 LLS1 | EN: TI2 TI1 DK2 DK1 LLS2 LLS1" VALUE 0x78804 TKW_VV_VV_UB 100.0 FORMULA_0003 0.0 255.0000 /end CHARACTERISTIC
/begin CHARACTERISTIC K_SK_TI_OFF_EGAS_42of64_ "TI2 TI1 DK2 DK1 LLS2 LLS1 | EN: TI2 TI1 DK2 DK1 LLS2 LLS1" VALUE 0x78805 TKW_VV_VV_UB 100.0 FORMULA_0003 0.0 255.0000 /end CHARACTERISTIC
/begin CHARACTERISTIC K_SK_TI_OFF_EGAS_43of64_ "TI2 TI1 DK2 DK1 LLS2 LLS1 | EN: TI2 TI1 DK2 DK1 LLS2 LLS1" VALUE 0x78806 TKW_VV_VV_UB 100.0 FORMULA_0003 0.0 255.0000 /end CHARACTERISTIC
/begin CHARACTERISTIC K_SK_TI_OFF_EGAS_44of64_ "TI2 TI1 DK2 DK1 LLS2 LLS1 | EN: TI2 TI1 DK2 DK1 LLS2 LLS1" VALUE 0x78807 TKW_VV_VV_UB 100.0 FORMULA_0003 0.0 255.0000 /end CHARACTERISTIC
/begin CHARACTERISTIC K_SK_TI_OFF_EGAS_45of64_ "TI2 TI1 DK2 DK1 LLS2 LLS1 | EN: TI2 TI1 DK2 DK1 LLS2 LLS1" VALUE 0x78808 TKW_VV_VV_UB 100.0 FORMULA_0003 0.0 255.0000 /end CHARACTERISTIC
/begin CHARACTERISTIC K_SK_TI_OFF_EGAS_46of64_ "TI2 TI1 DK2 DK1 LLS2 LLS1 | EN: TI2 TI1 DK2 DK1 LLS2 LLS1" VALUE 0x78809 TKW_VV_VV_UB 100.0 FORMULA_0003 0.0 255.0000 /end CHARACTERISTIC
/begin CHARACTERISTIC K_SK_TI_OFF_EGAS_47of64_ "TI2 TI1 DK2 DK1 LLS2 LLS1 | EN: TI2 TI1 DK2 DK1 LLS2 LLS1" VALUE 0x7880A TKW_VV_VV_UB 100.0 FORMULA_0003 0.0 255.0000 /end CHARACTERISTIC
/begin CHARACTERISTIC K_SK_TI_OFF_EGAS_48of64_ "TI2 TI1 DK2 DK1 LLS2 LLS1 | EN: TI2 TI1 DK2 DK1 LLS2 LLS1" VALUE 0x7880B TKW_VV_VV_UB 100.0 FORMULA_0003 0.0 255.0000 /end CHARACTERISTIC
/begin CHARACTERISTIC K_SK_TI_OFF_EGAS_49of64_ "TI2 TI1 DK2 DK1 LLS2 LLS1 | EN: TI2 TI1 DK2 DK1 LLS2 LLS1" VALUE 0x7880C TKW_VV_VV_UB 100.0 FORMULA_0003 0.0 255.0000 /end CHARACTERISTIC
/begin CHARACTERISTIC K_SK_TI_OFF_EGAS_50of64_ "TI2 TI1 DK2 DK1 LLS2 LLS1 | EN: TI2 TI1 DK2 DK1 LLS2 LLS1" VALUE 0x7880D TKW_VV_VV_UB 100.0 FORMULA_0003 0.0 255.0000 /end CHARACTERISTIC
/begin CHARACTERISTIC K_SK_TI_OFF_EGAS_51of64_ "TI2 TI1 DK2 DK1 LLS2 LLS1 | EN: TI2 TI1 DK2 DK1 LLS2 LLS1" VALUE 0x7880E TKW_VV_VV_UB 100.0 FORMULA_0003 0.0 255.0000 /end CHARACTERISTIC
/begin CHARACTERISTIC K_SK_TI_OFF_EGAS_52of64_ "TI2 TI1 DK2 DK1 LLS2 LLS1 | EN: TI2 TI1 DK2 DK1 LLS2 LLS1" VALUE 0x7880F TKW_VV_VV_UB 100.0 FORMULA_0003 0.0 255.0000 /end CHARACTERISTIC
/begin CHARACTERISTIC K_SK_TI_OFF_EGAS_53of64_ "TI2 TI1 DK2 DK1 LLS2 LLS1 | EN: TI2 TI1 DK2 DK1 LLS2 LLS1" VALUE 0x78810 TKW_VV_VV_UB 100.0 FORMULA_0003 0.0 255.0000 /end CHARACTERISTIC
/begin CHARACTERISTIC K_SK_TI_OFF_EGAS_54of64_ "TI2 TI1 DK2 DK1 LLS2 LLS1 | EN: TI2 TI1 DK2 DK1 LLS2 LLS1" VALUE 0x78811 TKW_VV_VV_UB 100.0 FORMULA_0003 0.0 255.0000 /end CHARACTERISTIC
/begin CHARACTERISTIC K_SK_TI_OFF_EGAS_55of64_ "TI2 TI1 DK2 DK1 LLS2 LLS1 | EN: TI2 TI1 DK2 DK1 LLS2 LLS1" VALUE 0x78812 TKW_VV_VV_UB 100.0 FORMULA_0003 0.0 255.0000 /end CHARACTERISTIC
/begin CHARACTERISTIC K_SK_TI_OFF_EGAS_56of64_ "TI2 TI1 DK2 DK1 LLS2 LLS1 | EN: TI2 TI1 DK2 DK1 LLS2 LLS1" VALUE 0x78813 TKW_VV_VV_UB 100.0 FORMULA_0003 0.0 255.0000 /end CHARACTERISTIC
/begin CHARACTERISTIC K_SK_TI_OFF_EGAS_57of64_ "TI2 TI1 DK2 DK1 LLS2 LLS1 | EN: TI2 TI1 DK2 DK1 LLS2 LLS1" VALUE 0x78814 TKW_VV_VV_UB 100.0 FORMULA_0003 0.0 255.0000 /end CHARACTERISTIC
/begin CHARACTERISTIC K_SK_TI_OFF_EGAS_58of64_ "TI2 TI1 DK2 DK1 LLS2 LLS1 | EN: TI2 TI1 DK2 DK1 LLS2 LLS1" VALUE 0x78815 TKW_VV_VV_UB 100.0 FORMULA_0003 0.0 255.0000 /end CHARACTERISTIC
/begin CHARACTERISTIC K_SK_TI_OFF_EGAS_59of64_ "TI2 TI1 DK2 DK1 LLS2 LLS1 | EN: TI2 TI1 DK2 DK1 LLS2 LLS1" VALUE 0x78816 TKW_VV_VV_UB 100.0 FORMULA_0003 0.0 255.0000 /end CHARACTERISTIC
/begin CHARACTERISTIC K_SK_TI_OFF_EGAS_60of64_ "TI2 TI1 DK2 DK1 LLS2 LLS1 | EN: TI2 TI1 DK2 DK1 LLS2 LLS1" VALUE 0x78817 TKW_VV_VV_UB 100.0 FORMULA_0003 0.0 255.0000 /end CHARACTERISTIC
/begin CHARACTERISTIC K_SK_TI_OFF_EGAS_61of64_ "TI2 TI1 DK2 DK1 LLS2 LLS1 | EN: TI2 TI1 DK2 DK1 LLS2 LLS1" VALUE 0x78818 TKW_VV_VV_UB 100.0 FORMULA_0003 0.0 255.0000 /end CHARACTERISTIC
/begin CHARACTERISTIC K_SK_TI_OFF_EGAS_62of64_ "TI2 TI1 DK2 DK1 LLS2 LLS1 | EN: TI2 TI1 DK2 DK1 LLS2 LLS1" VALUE 0x78819 TKW_VV_VV_UB 100.0 FORMULA_0003 0.0 255.0000 /end CHARACTERISTIC
/begin CHARACTERISTIC K_SK_TI_OFF_EGAS_63of64_ "TI2 TI1 DK2 DK1 LLS2 LLS1 | EN: TI2 TI1 DK2 DK1 LLS2 LLS1" VALUE 0x7881A TKW_VV_VV_UB 100.0 FORMULA_0003 0.0 255.0000 /end CHARACTERISTIC
/begin CHARACTERISTIC K_SK_TI_OFF_EGAS_64of64_ "TI2 TI1 DK2 DK1 LLS2 LLS1 | EN: TI2 TI1 DK2 DK1 LLS2 LLS1" VALUE 0x7881B TKW_VV_VV_UB 100.0 FORMULA_0003 0.0 255.0000 /end CHARACTERISTIC
/begin CHARACTERISTIC K_SK_MD_BEGR_SMG_1of16_ "CANErr CANSk STAT SABR | EN: CANErr CANSk STAT SABR" VALUE 0x7881C TKW_VV_VV_UB 100.0 FORMULA_0003 0.0 255.0000 /end CHARACTERISTIC
/begin CHARACTERISTIC K_SK_MD_BEGR_SMG_2of16_ "CANErr CANSk STAT SABR | EN: CANErr CANSk STAT SABR" VALUE 0x7881D TKW_VV_VV_UB 100.0 FORMULA_0003 0.0 255.0000 /end CHARACTERISTIC
/begin CHARACTERISTIC K_SK_MD_BEGR_SMG_3of16_ "CANErr CANSk STAT SABR | EN: CANErr CANSk STAT SABR" VALUE 0x7881E TKW_VV_VV_UB 100.0 FORMULA_0003 0.0 255.0000 /end CHARACTERISTIC
/begin CHARACTERISTIC K_SK_MD_BEGR_SMG_4of16_ "CANErr CANSk STAT SABR | EN: CANErr CANSk STAT SABR" VALUE 0x7881F TKW_VV_VV_UB 100.0 FORMULA_0003 0.0 255.0000 /end CHARACTERISTIC
/begin CHARACTERISTIC K_SK_MD_BEGR_SMG_5of16_ "CANErr CANSk STAT SABR | EN: CANErr CANSk STAT SABR" VALUE 0x78820 TKW_VV_VV_UB 100.0 FORMULA_0003 0.0 255.0000 /end CHARACTERISTIC
/begin CHARACTERISTIC K_SK_MD_BEGR_SMG_6of16_ "CANErr CANSk STAT SABR | EN: CANErr CANSk STAT SABR" VALUE 0x78821 TKW_VV_VV_UB 100.0 FORMULA_0003 0.0 255.0000 /end CHARACTERISTIC
/begin CHARACTERISTIC K_SK_MD_BEGR_SMG_7of16_ "CANErr CANSk STAT SABR | EN: CANErr CANSk STAT SABR" VALUE 0x78822 TKW_VV_VV_UB 100.0 FORMULA_0003 0.0 255.0000 /end CHARACTERISTIC
/begin CHARACTERISTIC K_SK_MD_BEGR_SMG_8of16_ "CANErr CANSk STAT SABR | EN: CANErr CANSk STAT SABR" VALUE 0x78823 TKW_VV_VV_UB 100.0 FORMULA_0003 0.0 255.0000 /end CHARACTERISTIC
/begin CHARACTERISTIC K_SK_MD_BEGR_SMG_9of16_ "CANErr CANSk STAT SABR | EN: CANErr CANSk STAT SABR" VALUE 0x78824 TKW_VV_VV_UB 100.0 FORMULA_0003 0.0 255.0000 /end CHARACTERISTIC
/begin CHARACTERISTIC K_SK_MD_BEGR_SMG_10of16_ "CANErr CANSk STAT SABR | EN: CANErr CANSk STAT SABR" VALUE 0x78825 TKW_VV_VV_UB 100.0 FORMULA_0003 0.0 255.0000 /end CHARACTERISTIC
/begin CHARACTERISTIC K_SK_MD_BEGR_SMG_11of16_ "CANErr CANSk STAT SABR | EN: CANErr CANSk STAT SABR" VALUE 0x78826 TKW_VV_VV_UB 100.0 FORMULA_0003 0.0 255.0000 /end CHARACTERISTIC
/begin CHARACTERISTIC K_SK_MD_BEGR_SMG_12of16_ "CANErr CANSk STAT SABR | EN: CANErr CANSk STAT SABR" VALUE 0x78827 TKW_VV_VV_UB 100.0 FORMULA_0003 0.0 255.0000 /end CHARACTERISTIC
/begin CHARACTERISTIC K_SK_MD_BEGR_SMG_13of16_ "CANErr CANSk STAT SABR | EN: CANErr CANSk STAT SABR" VALUE 0x78828 TKW_VV_VV_UB 100.0 FORMULA_0003 0.0 255.0000 /end CHARACTERISTIC
/begin CHARACTERISTIC K_SK_MD_BEGR_SMG_14of16_ "CANErr CANSk STAT SABR | EN: CANErr CANSk STAT SABR" VALUE 0x78829 TKW_VV_VV_UB 100.0 FORMULA_0003 0.0 255.0000 /end CHARACTERISTIC
/begin CHARACTERISTIC K_SK_MD_BEGR_SMG_15of16_ "CANErr CANSk STAT SABR | EN: CANErr CANSk STAT SABR" VALUE 0x7882A TKW_VV_VV_UB 100.0 FORMULA_0003 0.0 255.0000 /end CHARACTERISTIC
/begin CHARACTERISTIC K_SK_MD_BEGR_SMG_16of16_ "CANErr CANSk STAT SABR | EN: CANErr CANSk STAT SABR" VALUE 0x7882B TKW_VV_VV_UB 100.0 FORMULA_0003 0.0 255.0000 /end CHARACTERISTIC
/begin CHARACTERISTIC K_SK_MD_BEGR_MD_1of16_ "SollIst Mdmin EtaRf LLR | EN: SollIst Mdmin EtaRf LLR" VALUE 0x7882C TKW_VV_VV_UB 100.0 FORMULA_0003 0.0 255.0000 /end CHARACTERISTIC
/begin CHARACTERISTIC K_SK_MD_BEGR_MD_2of16_ "SollIst Mdmin EtaRf LLR" VALUE 0x7882D TKW_VV_VV_UB 100.0 FORMULA_0003 0.0 255.0000 /end CHARACTERISTIC
/begin CHARACTERISTIC K_SK_MD_BEGR_MD_3of16_ "SollIst Mdmin EtaRf LLR" VALUE 0x7882E TKW_VV_VV_UB 100.0 FORMULA_0003 0.0 255.0000 /end CHARACTERISTIC
/begin CHARACTERISTIC K_SK_MD_BEGR_MD_4of16_ "SollIst Mdmin EtaRf LLR | EN: SollIst Mdmin EtaRf LLR" VALUE 0x7882F TKW_VV_VV_UB 100.0 FORMULA_0003 0.0 255.0000 /end CHARACTERISTIC
/begin CHARACTERISTIC K_SK_MD_BEGR_MD_5of16_ "SollIst Mdmin EtaRf LLR | EN: SollIst Mdmin EtaRf LLR" VALUE 0x78830 TKW_VV_VV_UB 100.0 FORMULA_0003 0.0 255.0000 /end CHARACTERISTIC
/begin CHARACTERISTIC K_SK_MD_BEGR_MD_6of16_ "SollIst Mdmin EtaRf LLR | EN: SollIst Mdmin EtaRf LLR" VALUE 0x78831 TKW_VV_VV_UB 100.0 FORMULA_0003 0.0 255.0000 /end CHARACTERISTIC
/begin CHARACTERISTIC K_SK_MD_BEGR_MD_7of16_ "SollIst Mdmin EtaRf LLR | EN: SollIst Mdmin EtaRf LLR" VALUE 0x78832 TKW_VV_VV_UB 100.0 FORMULA_0003 0.0 255.0000 /end CHARACTERISTIC
/begin CHARACTERISTIC K_SK_MD_BEGR_MD_8of16_ "SollIst Mdmin EtaRf LLR | EN: SollIst Mdmin EtaRf LLR" VALUE 0x78833 TKW_VV_VV_UB 100.0 FORMULA_0003 0.0 255.0000 /end CHARACTERISTIC
/begin CHARACTERISTIC K_SK_MD_BEGR_MD_9of16_ "SollIst Mdmin EtaRf LLR | EN: SollIst Mdmin EtaRf LLR" VALUE 0x78834 TKW_VV_VV_UB 100.0 FORMULA_0003 0.0 255.0000 /end CHARACTERISTIC
/begin CHARACTERISTIC K_SK_MD_BEGR_MD_10of16_ "SollIst Mdmin EtaRf LLR | EN: SollIst Mdmin EtaRf LLR" VALUE 0x78835 TKW_VV_VV_UB 100.0 FORMULA_0003 0.0 255.0000 /end CHARACTERISTIC
/begin CHARACTERISTIC K_SK_MD_BEGR_MD_11of16_ "SollIst Mdmin EtaRf LLR | EN: SollIst Mdmin EtaRf LLR" VALUE 0x78836 TKW_VV_VV_UB 100.0 FORMULA_0003 0.0 255.0000 /end CHARACTERISTIC
/begin CHARACTERISTIC K_SK_MD_BEGR_MD_12of16_ "SollIst Mdmin EtaRf LLR | EN: SollIst Mdmin EtaRf LLR" VALUE 0x78837 TKW_VV_VV_UB 100.0 FORMULA_0003 0.0 255.0000 /end CHARACTERISTIC
/begin CHARACTERISTIC K_SK_MD_BEGR_MD_13of16_ "SollIst Mdmin EtaRf LLR | EN: SollIst Mdmin EtaRf LLR" VALUE 0x78838 TKW_VV_VV_UB 100.0 FORMULA_0003 0.0 255.0000 /end CHARACTERISTIC
/begin CHARACTERISTIC K_SK_MD_BEGR_MD_14of16_ "SollIst Mdmin EtaRf LLR | EN: SollIst Mdmin EtaRf LLR" VALUE 0x78839 TKW_VV_VV_UB 100.0 FORMULA_0003 0.0 255.0000 /end CHARACTERISTIC
/begin CHARACTERISTIC K_SK_MD_BEGR_MD_15of16_ "SollIst Mdmin EtaRf LLR | EN: SollIst Mdmin EtaRf LLR" VALUE 0x7883A TKW_VV_VV_UB 100.0 FORMULA_0003 0.0 255.0000 /end CHARACTERISTIC
/begin CHARACTERISTIC K_SK_MD_BEGR_MD_16of16_ "SollIst Mdmin EtaRf LLR | EN: SollIst Mdmin EtaRf LLR" VALUE 0x7883B TKW_VV_VV_UB 100.0 FORMULA_0003 0.0 255.0000 /end CHARACTERISTIC
/begin CHARACTERISTIC K_SK_MD_BEGR_GEMISCH_1of32_ "VAN KATS FPLAU LAVK PKS | EN: VAN KATS FPLAU LAVK PKS" VALUE 0x7883C TKW_VV_VV_UB 100.0 FORMULA_0003 0.0 255.0000 /end CHARACTERISTIC
/begin CHARACTERISTIC K_SK_MD_BEGR_GEMISCH_2of32_ "VAN KATS FPLAU LAVK PKS | EN: VAN KATS FPLAU LAVK PKS" VALUE 0x7883D TKW_VV_VV_UB 100.0 FORMULA_0003 0.0 255.0000 /end CHARACTERISTIC
/begin CHARACTERISTIC K_SK_MD_BEGR_GEMISCH_3of32_ "VAN KATS FPLAU LAVK PKS | EN: VAN KATS FPLAU LAVK PKS" VALUE 0x7883E TKW_VV_VV_UB 100.0 FORMULA_0003 0.0 255.0000 /end CHARACTERISTIC
/begin CHARACTERISTIC K_SK_MD_BEGR_GEMISCH_4of32_ "VAN KATS FPLAU LAVK PKS | EN: VAN KATS FPLAU LAVK PKS" VALUE 0x7883F TKW_VV_VV_UB 100.0 FORMULA_0003 0.0 255.0000 /end CHARACTERISTIC
/begin CHARACTERISTIC K_SK_MD_BEGR_GEMISCH_5of32_ "VAN KATS FPLAU LAVK PKS" VALUE 0x78840 TKW_VV_VV_UB 100.0 FORMULA_0003 0.0 255.0000 /end CHARACTERISTIC
/begin CHARACTERISTIC K_SK_MD_BEGR_GEMISCH_6of32_ "VAN KATS FPLAU LAVK PKS" VALUE 0x78841 TKW_VV_VV_UB 100.0 FORMULA_0003 0.0 255.0000 /end CHARACTERISTIC
/begin CHARACTERISTIC K_SK_MD_BEGR_GEMISCH_7of32_ "VAN KATS FPLAU LAVK PKS" VALUE 0x78842 TKW_VV_VV_UB 100.0 FORMULA_0003 0.0 255.0000 /end CHARACTERISTIC
/begin CHARACTERISTIC K_SK_MD_BEGR_GEMISCH_8of32_ "VAN KATS FPLAU LAVK PKS" VALUE 0x78843 TKW_VV_VV_UB 100.0 FORMULA_0003 0.0 255.0000 /end CHARACTERISTIC
/begin CHARACTERISTIC K_SK_MD_BEGR_GEMISCH_9of32_ "VAN KATS FPLAU LAVK PKS" VALUE 0x78844 TKW_VV_VV_UB 100.0 FORMULA_0003 0.0 255.0000 /end CHARACTERISTIC
/begin CHARACTERISTIC K_SK_MD_BEGR_GEMISCH_10of32_ "VAN KATS FPLAU LAVK PKS" VALUE 0x78845 TKW_VV_VV_UB 100.0 FORMULA_0003 0.0 255.0000 /end CHARACTERISTIC
/begin CHARACTERISTIC K_SK_MD_BEGR_GEMISCH_11of32_ "VAN KATS FPLAU LAVK PKS" VALUE 0x78846 TKW_VV_VV_UB 100.0 FORMULA_0003 0.0 255.0000 /end CHARACTERISTIC
/begin CHARACTERISTIC K_SK_MD_BEGR_GEMISCH_12of32_ "VAN KATS FPLAU LAVK PKS" VALUE 0x78847 TKW_VV_VV_UB 100.0 FORMULA_0003 0.0 255.0000 /end CHARACTERISTIC
/begin CHARACTERISTIC K_SK_MD_BEGR_GEMISCH_13of32_ "VAN KATS FPLAU LAVK PKS" VALUE 0x78848 TKW_VV_VV_UB 100.0 FORMULA_0003 0.0 255.0000 /end CHARACTERISTIC
/begin CHARACTERISTIC K_SK_MD_BEGR_GEMISCH_14of32_ "VAN KATS FPLAU LAVK PKS" VALUE 0x78849 TKW_VV_VV_UB 100.0 FORMULA_0003 0.0 255.0000 /end CHARACTERISTIC
/begin CHARACTERISTIC K_SK_MD_BEGR_GEMISCH_15of32_ "VAN KATS FPLAU LAVK PKS" VALUE 0x7884A TKW_VV_VV_UB 100.0 FORMULA_0003 0.0 255.0000 /end CHARACTERISTIC
/begin CHARACTERISTIC K_SK_MD_BEGR_GEMISCH_16of32_ "VAN KATS FPLAU LAVK PKS" VALUE 0x7884B TKW_VV_VV_UB 100.0 FORMULA_0003 0.0 255.0000 /end CHARACTERISTIC
/begin CHARACTERISTIC K_SK_MD_BEGR_GEMISCH_17of32_ "VAN KATS FPLAU LAVK PKS | EN: VAN KATS FPLAU LAVK PKS" VALUE 0x7884C TKW_VV_VV_UB 100.0 FORMULA_0003 0.0 255.0000 /end CHARACTERISTIC
/begin CHARACTERISTIC K_SK_MD_BEGR_GEMISCH_18of32_ "VAN KATS FPLAU LAVK PKS | EN: VAN KATS FPLAU LAVK PKS" VALUE 0x7884D TKW_VV_VV_UB 100.0 FORMULA_0003 0.0 255.0000 /end CHARACTERISTIC
/begin CHARACTERISTIC K_SK_MD_BEGR_GEMISCH_19of32_ "VAN KATS FPLAU LAVK PKS | EN: VAN KATS FPLAU LAVK PKS" VALUE 0x7884E TKW_VV_VV_UB 100.0 FORMULA_0003 0.0 255.0000 /end CHARACTERISTIC
/begin CHARACTERISTIC K_SK_MD_BEGR_GEMISCH_20of32_ "VAN KATS FPLAU LAVK PKS | EN: VAN KATS FPLAU LAVK PKS" VALUE 0x7884F TKW_VV_VV_UB 100.0 FORMULA_0003 0.0 255.0000 /end CHARACTERISTIC
/begin CHARACTERISTIC K_SK_MD_BEGR_GEMISCH_21of32_ "VAN KATS FPLAU LAVK PKS | EN: VAN KATS FPLAU LAVK PKS" VALUE 0x78850 TKW_VV_VV_UB 100.0 FORMULA_0003 0.0 255.0000 /end CHARACTERISTIC
/begin CHARACTERISTIC K_SK_MD_BEGR_GEMISCH_22of32_ "VAN KATS FPLAU LAVK PKS | EN: VAN KATS FPLAU LAVK PKS" VALUE 0x78851 TKW_VV_VV_UB 100.0 FORMULA_0003 0.0 255.0000 /end CHARACTERISTIC
/begin CHARACTERISTIC K_SK_MD_BEGR_GEMISCH_23of32_ "VAN KATS FPLAU LAVK PKS | EN: VAN KATS FPLAU LAVK PKS" VALUE 0x78852 TKW_VV_VV_UB 100.0 FORMULA_0003 0.0 255.0000 /end CHARACTERISTIC
/begin CHARACTERISTIC K_SK_MD_BEGR_GEMISCH_24of32_ "VAN KATS FPLAU LAVK PKS | EN: VAN KATS FPLAU LAVK PKS" VALUE 0x78853 TKW_VV_VV_UB 100.0 FORMULA_0003 0.0 255.0000 /end CHARACTERISTIC
/begin CHARACTERISTIC K_SK_MD_BEGR_GEMISCH_25of32_ "VAN KATS FPLAU LAVK PKS | EN: VAN KATS FPLAU LAVK PKS" VALUE 0x78854 TKW_VV_VV_UB 100.0 FORMULA_0003 0.0 255.0000 /end CHARACTERISTIC
/begin CHARACTERISTIC K_SK_MD_BEGR_GEMISCH_26of32_ "VAN KATS FPLAU LAVK PKS | EN: VAN KATS FPLAU LAVK PKS" VALUE 0x78855 TKW_VV_VV_UB 100.0 FORMULA_0003 0.0 255.0000 /end CHARACTERISTIC
/begin CHARACTERISTIC K_SK_MD_BEGR_GEMISCH_27of32_ "VAN KATS FPLAU LAVK PKS | EN: VAN KATS FPLAU LAVK PKS" VALUE 0x78856 TKW_VV_VV_UB 100.0 FORMULA_0003 0.0 255.0000 /end CHARACTERISTIC
/begin CHARACTERISTIC K_SK_MD_BEGR_GEMISCH_28of32_ "VAN KATS FPLAU LAVK PKS | EN: VAN KATS FPLAU LAVK PKS" VALUE 0x78857 TKW_VV_VV_UB 100.0 FORMULA_0003 0.0 255.0000 /end CHARACTERISTIC
/begin CHARACTERISTIC K_SK_MD_BEGR_GEMISCH_29of32_ "VAN KATS FPLAU LAVK PKS | EN: VAN KATS FPLAU LAVK PKS" VALUE 0x78858 TKW_VV_VV_UB 100.0 FORMULA_0003 0.0 255.0000 /end CHARACTERISTIC
/begin CHARACTERISTIC K_SK_MD_BEGR_GEMISCH_30of32_ "VAN KATS FPLAU LAVK PKS | EN: VAN KATS FPLAU LAVK PKS" VALUE 0x78859 TKW_VV_VV_UB 100.0 FORMULA_0003 0.0 255.0000 /end CHARACTERISTIC
/begin CHARACTERISTIC K_SK_MD_BEGR_GEMISCH_31of32_ "VAN KATS FPLAU LAVK PKS | EN: VAN KATS FPLAU LAVK PKS" VALUE 0x7885A TKW_VV_VV_UB 100.0 FORMULA_0003 0.0 255.0000 /end CHARACTERISTIC
/begin CHARACTERISTIC K_SK_MD_BEGR_GEMISCH_32of32_ "VAN KATS FPLAU LAVK PKS | EN: VAN KATS FPLAU LAVK PKS" VALUE 0x7885B TKW_VV_VV_UB 100.0 FORMULA_0003 0.0 255.0000 /end CHARACTERISTIC
/begin CHARACTERISTIC K_SK_MD_BEGR_KR_1of8_ "nc nc SpVe" VALUE 0x7885C TKW_VV_VV_UB 100.0 FORMULA_0003 0.0 255.0000 /end CHARACTERISTIC
/begin CHARACTERISTIC K_SK_MD_BEGR_KR_2of8_ "nc nc SpVe" VALUE 0x7885D TKW_VV_VV_UB 100.0 FORMULA_0003 0.0 255.0000 /end CHARACTERISTIC
/begin CHARACTERISTIC K_SK_MD_BEGR_KR_3of8_ "nc nc SpVe" VALUE 0x7885E TKW_VV_VV_UB 100.0 FORMULA_0003 0.0 255.0000 /end CHARACTERISTIC
/begin CHARACTERISTIC K_SK_MD_BEGR_KR_4of8_ "nc nc SpVe" VALUE 0x7885F TKW_VV_VV_UB 100.0 FORMULA_0003 0.0 255.0000 /end CHARACTERISTIC
/begin CHARACTERISTIC K_SK_MD_BEGR_KR_5of8_ "nc nc SpVe" VALUE 0x78860 TKW_VV_VV_UB 100.0 FORMULA_0003 0.0 255.0000 /end CHARACTERISTIC
/begin CHARACTERISTIC K_SK_MD_BEGR_KR_6of8_ "nc nc SpVe" VALUE 0x78861 TKW_VV_VV_UB 100.0 FORMULA_0003 0.0 255.0000 /end CHARACTERISTIC
/begin CHARACTERISTIC K_SK_MD_BEGR_KR_7of8_ "nc nc SpVe" VALUE 0x78862 TKW_VV_VV_UB 100.0 FORMULA_0003 0.0 255.0000 /end CHARACTERISTIC
/begin CHARACTERISTIC K_SK_MD_BEGR_KR_8of8_ "nc nc SpVe" VALUE 0x78863 TKW_VV_VV_UB 100.0 FORMULA_0003 0.0 255.0000 /end CHARACTERISTIC
/begin CHARACTERISTIC K_SK_LAM_EINGR_1of32_ "Gemisch Boff Zoff DK LLS | EN: Gemisch Boff Zoff DK LLS" VALUE 0x78864 TKW_VV_VV_UB 100.0 FORMULA_0367 0.0 255.0 /end CHARACTERISTIC
/begin CHARACTERISTIC K_SK_LAM_EINGR_2of32_ "Gemisch Boff Zoff DK LLS | EN: Gemisch Boff Zoff DK LLS" VALUE 0x78865 TKW_VV_VV_UB 100.0 FORMULA_0367 0.0 255.0 /end CHARACTERISTIC
/begin CHARACTERISTIC K_SK_LAM_EINGR_3of32_ "Gemisch Boff Zoff DK LLS | EN: Gemisch Boff Zoff DK LLS" VALUE 0x78866 TKW_VV_VV_UB 100.0 FORMULA_0367 0.0 255.0 /end CHARACTERISTIC
/begin CHARACTERISTIC K_SK_LAM_EINGR_4of32_ "Gemisch Boff Zoff DK LLS | EN: Gemisch Boff Zoff DK LLS" VALUE 0x78867 TKW_VV_VV_UB 100.0 FORMULA_0367 0.0 255.0 /end CHARACTERISTIC
/begin CHARACTERISTIC K_SK_LAM_EINGR_5of32_ "Gemisch Boff Zoff DK LLS | EN: Gemisch Boff Zoff DK LLS" VALUE 0x78868 TKW_VV_VV_UB 100.0 FORMULA_0367 0.0 255.0 /end CHARACTERISTIC
/begin CHARACTERISTIC K_SK_LAM_EINGR_6of32_ "Gemisch Boff Zoff DK LLS | EN: Gemisch Boff Zoff DK LLS" VALUE 0x78869 TKW_VV_VV_UB 100.0 FORMULA_0367 0.0 255.0 /end CHARACTERISTIC
/begin CHARACTERISTIC K_SK_LAM_EINGR_7of32_ "Gemisch Boff Zoff DK LLS | EN: Gemisch Boff Zoff DK LLS" VALUE 0x7886A TKW_VV_VV_UB 100.0 FORMULA_0367 0.0 255.0 /end CHARACTERISTIC
/begin CHARACTERISTIC K_SK_LAM_EINGR_8of32_ "Gemisch Boff Zoff DK LLS | EN: Gemisch Boff Zoff DK LLS" VALUE 0x7886B TKW_VV_VV_UB 100.0 FORMULA_0367 0.0 255.0 /end CHARACTERISTIC
/begin CHARACTERISTIC K_SK_LAM_EINGR_9of32_ "Gemisch Boff Zoff DK LLS | EN: Gemisch Boff Zoff DK LLS" VALUE 0x7886C TKW_VV_VV_UB 100.0 FORMULA_0367 0.0 255.0 /end CHARACTERISTIC
/begin CHARACTERISTIC K_SK_LAM_EINGR_10of32_ "Gemisch Boff Zoff DK LLS | EN: Gemisch Boff Zoff DK LLS" VALUE 0x7886D TKW_VV_VV_UB 100.0 FORMULA_0367 0.0 255.0 /end CHARACTERISTIC
/begin CHARACTERISTIC K_SK_LAM_EINGR_11of32_ "Gemisch Boff Zoff DK LLS | EN: Gemisch Boff Zoff DK LLS" VALUE 0x7886E TKW_VV_VV_UB 100.0 FORMULA_0367 0.0 255.0 /end CHARACTERISTIC
/begin CHARACTERISTIC K_SK_LAM_EINGR_12of32_ "Gemisch Boff Zoff DK LLS | EN: Gemisch Boff Zoff DK LLS" VALUE 0x7886F TKW_VV_VV_UB 100.0 FORMULA_0367 0.0 255.0 /end CHARACTERISTIC
/begin CHARACTERISTIC K_SK_LAM_EINGR_13of32_ "Gemisch Boff Zoff DK LLS | EN: Gemisch Boff Zoff DK LLS" VALUE 0x78870 TKW_VV_VV_UB 100.0 FORMULA_0367 0.0 255.0 /end CHARACTERISTIC
/begin CHARACTERISTIC K_SK_LAM_EINGR_14of32_ "Gemisch Boff Zoff DK LLS | EN: Gemisch Boff Zoff DK LLS" VALUE 0x78871 TKW_VV_VV_UB 100.0 FORMULA_0367 0.0 255.0 /end CHARACTERISTIC
/begin CHARACTERISTIC K_SK_LAM_EINGR_15of32_ "Gemisch Boff Zoff DK LLS | EN: Gemisch Boff Zoff DK LLS" VALUE 0x78872 TKW_VV_VV_UB 100.0 FORMULA_0367 0.0 255.0 /end CHARACTERISTIC
/begin CHARACTERISTIC K_SK_LAM_EINGR_16of32_ "Gemisch Boff Zoff DK LLS | EN: Gemisch Boff Zoff DK LLS" VALUE 0x78873 TKW_VV_VV_UB 100.0 FORMULA_0367 0.0 255.0 /end CHARACTERISTIC
/begin CHARACTERISTIC K_SK_LAM_EINGR_17of32_ "Gemisch Boff Zoff DK LLS | EN: Gemisch Boff Zoff DK LLS" VALUE 0x78874 TKW_VV_VV_UB 100.0 FORMULA_0367 0.0 255.0 /end CHARACTERISTIC
/begin CHARACTERISTIC K_SK_LAM_EINGR_18of32_ "Gemisch Boff Zoff DK LLS | EN: Gemisch Boff Zoff DK LLS" VALUE 0x78875 TKW_VV_VV_UB 100.0 FORMULA_0367 0.0 255.0 /end CHARACTERISTIC
/begin CHARACTERISTIC K_SK_LAM_EINGR_19of32_ "Gemisch Boff Zoff DK LLS | EN: Gemisch Boff Zoff DK LLS" VALUE 0x78876 TKW_VV_VV_UB 100.0 FORMULA_0367 0.0 255.0 /end CHARACTERISTIC
/begin CHARACTERISTIC K_SK_LAM_EINGR_20of32_ "Gemisch Boff Zoff DK LLS | EN: Gemisch Boff Zoff DK LLS" VALUE 0x78877 TKW_VV_VV_UB 100.0 FORMULA_0367 0.0 255.0 /end CHARACTERISTIC
/begin CHARACTERISTIC K_SK_LAM_EINGR_21of32_ "Gemisch Boff Zoff DK LLS | EN: Gemisch Boff Zoff DK LLS" VALUE 0x78878 TKW_VV_VV_UB 100.0 FORMULA_0367 0.0 255.0 /end CHARACTERISTIC
/begin CHARACTERISTIC K_SK_LAM_EINGR_22of32_ "Gemisch Boff Zoff DK LLS | EN: Gemisch Boff Zoff DK LLS" VALUE 0x78879 TKW_VV_VV_UB 100.0 FORMULA_0367 0.0 255.0 /end CHARACTERISTIC
/begin CHARACTERISTIC K_SK_LAM_EINGR_23of32_ "Gemisch Boff Zoff DK LLS | EN: Gemisch Boff Zoff DK LLS" VALUE 0x7887A TKW_VV_VV_UB 100.0 FORMULA_0367 0.0 255.0 /end CHARACTERISTIC
/begin CHARACTERISTIC K_SK_LAM_EINGR_24of32_ "Gemisch Boff Zoff DK LLS | EN: Gemisch Boff Zoff DK LLS" VALUE 0x7887B TKW_VV_VV_UB 100.0 FORMULA_0367 0.0 255.0 /end CHARACTERISTIC
/begin CHARACTERISTIC K_SK_LAM_EINGR_25of32_ "Gemisch Boff Zoff DK LLS | EN: Gemisch Boff Zoff DK LLS" VALUE 0x7887C TKW_VV_VV_UB 100.0 FORMULA_0367 0.0 255.0 /end CHARACTERISTIC
/begin CHARACTERISTIC K_SK_LAM_EINGR_26of32_ "Gemisch Boff Zoff DK LLS | EN: Gemisch Boff Zoff DK LLS" VALUE 0x7887D TKW_VV_VV_UB 100.0 FORMULA_0367 0.0 255.0 /end CHARACTERISTIC
/begin CHARACTERISTIC K_SK_LAM_EINGR_27of32_ "Gemisch Boff Zoff DK LLS | EN: Gemisch Boff Zoff DK LLS" VALUE 0x7887E TKW_VV_VV_UB 100.0 FORMULA_0367 0.0 255.0 /end CHARACTERISTIC
/begin CHARACTERISTIC K_SK_LAM_EINGR_28of32_ "Gemisch Boff Zoff DK LLS | EN: Gemisch Boff Zoff DK LLS" VALUE 0x7887F TKW_VV_VV_UB 100.0 FORMULA_0367 0.0 255.0 /end CHARACTERISTIC
/begin CHARACTERISTIC K_SK_LAM_EINGR_29of32_ "Gemisch Boff Zoff DK LLS | EN: Gemisch Boff Zoff DK LLS" VALUE 0x78880 TKW_VV_VV_UB 100.0 FORMULA_0367 0.0 255.0 /end CHARACTERISTIC
/begin CHARACTERISTIC K_SK_LAM_EINGR_30of32_ "Gemisch Boff Zoff DK LLS | EN: Gemisch Boff Zoff DK LLS" VALUE 0x78881 TKW_VV_VV_UB 100.0 FORMULA_0367 0.0 255.0 /end CHARACTERISTIC
/begin CHARACTERISTIC K_SK_LAM_EINGR_31of32_ "Gemisch Boff Zoff DK LLS | EN: Gemisch Boff Zoff DK LLS" VALUE 0x78882 TKW_VV_VV_UB 100.0 FORMULA_0367 0.0 255.0 /end CHARACTERISTIC
/begin CHARACTERISTIC K_SK_LAM_EINGR_32of32_ "Gemisch Boff Zoff DK LLS | EN: Gemisch Boff Zoff DK LLS" VALUE 0x78883 TKW_VV_VV_UB 100.0 FORMULA_0367 0.0 255.0 /end CHARACTERISTIC
/begin CHARACTERISTIC K_SK_MD_BEGR_PWG_2of6_ "pwg_mode | EN: pwg_mode" VALUE 0x78885 TKW_VV_VV_UB 100.0 FORMULA_0003 0.0 255.0000 /end CHARACTERISTIC
/begin CHARACTERISTIC K_SK_MD_BEGR_PWG_3of6_ "pwg_mode | EN: pwg_mode" VALUE 0x78886 TKW_VV_VV_UB 100.0 FORMULA_0003 0.0 255.0000 /end CHARACTERISTIC
/begin CHARACTERISTIC K_SK_MD_BEGR_PWG_4of6_ "pwg_mode | EN: pwg_mode" VALUE 0x78887 TKW_VV_VV_UB 100.0 FORMULA_0003 0.0 255.0000 /end CHARACTERISTIC
/begin CHARACTERISTIC K_SK_MD_BEGR_PWG_5of6_ "pwg_mode | EN: pwg_mode" VALUE 0x78888 TKW_VV_VV_UB 100.0 FORMULA_0003 0.0 255.0000 /end CHARACTERISTIC
/begin CHARACTERISTIC K_SK_MD_BEGR_PWG_6of6_ "pwg_mode | EN: pwg_mode" VALUE 0x78889 TKW_VV_VV_UB 100.0 FORMULA_0003 0.0 255.0000 /end CHARACTERISTIC
/begin CHARACTERISTIC K_SK_MD_BEGR_MVAC_1of4_ "ELUP MVAC | EN: ELUP MVAC" VALUE 0x7888A TKW_VV_VV_UB 100.0 FORMULA_0003 0.0 255.0000 /end CHARACTERISTIC
/begin CHARACTERISTIC K_SK_MD_BEGR_MVAC_2of4_ "ELUP MVAC | EN: ELUP MVAC" VALUE 0x7888B TKW_VV_VV_UB 100.0 FORMULA_0003 0.0 255.0000 /end CHARACTERISTIC
/begin CHARACTERISTIC K_SK_MD_BEGR_MVAC_3of4_ "ELUP MVAC | EN: ELUP MVAC" VALUE 0x7888C TKW_VV_VV_UB 100.0 FORMULA_0003 0.0 255.0000 /end CHARACTERISTIC
/begin CHARACTERISTIC K_SK_MD_BEGR_MVAC_4of4_ "ELUP MVAC | EN: ELUP MVAC" VALUE 0x7888D TKW_VV_VV_UB 100.0 FORMULA_0003 0.0 255.0000 /end CHARACTERISTIC
/begin CHARACTERISTIC K_SK_MVAC_KH_1of4_ "ELUP MVAC | EN: ELUP MVAC" VALUE 0x7888E TKW_VV_VV_UB 100.0 FORMULA_0368 0.0 255.0 /end CHARACTERISTIC
/begin CHARACTERISTIC K_SK_MVAC_KH_2of4_ "ELUP MVAC | EN: ELUP MVAC" VALUE 0x7888F TKW_VV_VV_UB 100.0 FORMULA_0368 0.0 255.0 /end CHARACTERISTIC
/begin CHARACTERISTIC K_SK_MVAC_KH_3of4_ "ELUP MVAC | EN: ELUP MVAC" VALUE 0x78890 TKW_VV_VV_UB 100.0 FORMULA_0368 0.0 255.0 /end CHARACTERISTIC
/begin CHARACTERISTIC K_SK_MVAC_KH_4of4_ "ELUP MVAC | EN: ELUP MVAC" VALUE 0x78891 TKW_VV_VV_UB 100.0 FORMULA_0368 0.0 255.0 /end CHARACTERISTIC
/* ------------------ Abschnitt erzeugt aus sk_e2_glob.dat ------------------ */
/begin CHARACTERISTIC K_SK_E2_KOMP_ERR_MAX "max. Fehler fuer Komplementvergleich | EN: Maximum faults for complement comparison" VALUE 0x78892 TKW_VV_VV_UB 100.0 FORMULA_0003 0.0 255.0000 /end CHARACTERISTIC
/begin CHARACTERISTIC K_SK_MAX_RESETS_E2 "max. Anzahl von Resets pro SG-Lauf Ebene 2 | EN: Maximum number of resets per ECU run, level 2" VALUE 0x78893 TKW_VV_VV_UB 100.0 FORMULA_0003 0.0 255.0000 /end CHARACTERISTIC
/* ------------------ Abschnitt erzeugt aus spi.dat ------------------ */ /* ------------------ Abschnitt erzeugt aus sw_confg.dat ------------------ */
/begin CHARACTERISTIC cfg.motortyp "Konfigurationsparameter: Motortyp | EN: Konfigurationsparameter: Motortyp" VALUE 0x792F4 TKW_VV_VV_UW 100.0 FORMULA_0371 0.0 65535.0 FORMAT "%5.2" /end CHARACTERISTIC
/begin CHARACTERISTIC cfg.baureihe "Konfigurationsparameter: Fz Baureihe" VALUE 0x792F6 TKW_VV_VV_UB 100.0 FORMULA_0372 0.0 255.0 /end CHARACTERISTIC
/begin CHARACTERISTIC cfg.getriebetyp "Konfigurationsparameter: Getriebetyp | EN: Konfigurationsparameter: Getriebetyp" VALUE 0x792F7 TKW_VV_VV_UB 100.0 FORMULA_0373 0.0 255.0 /end CHARACTERISTIC
/begin CHARACTERISTIC cfg.la_variante "Konfigurationsparameter: LA-Variante | EN: Konfigurationsparameter: LA-Variante [V912: differs from V452 160E]" VALUE 0x792F8 TKW_VV_VV_UB 100.0 FORMULA_0374 0.0 255.0 /end CHARACTERISTIC
/begin CHARACTERISTIC cfg.abgas "Konfigurationsparameter: ABGAS-Variante [V912: differs from V452 160E]" VALUE 0x792F9 TKW_VV_VV_UB 100.0 FORMULA_0375 0.0 255.0 /end CHARACTERISTIC
/begin CHARACTERISTIC cfg.diagnose "Konfigurationsparameter: Diagnose | EN: Konfigurationsparameter: Diagnose" VALUE 0x792FA TKW_VV_VV_UB 100.0 FORMULA_0376 0.0 255.0 /end CHARACTERISTIC
/begin CHARACTERISTIC cfg.status "Konfigurationsparameter: SG Status | EN: Konfigurationsparameter: SG Status" VALUE 0x792FB TKW_VV_VV_UB 100.0 FORMULA_0377 0.0 255.0 /end CHARACTERISTIC
/begin CHARACTERISTIC cfg.canstand "Konfigurationsparameter: CAN Stand | EN: Konfigurationsparameter: CAN Stand" VALUE 0x792FC TKW_VV_VV_UB 100.0 FORMULA_0378 0.0 255.0 /end CHARACTERISTIC
/begin CHARACTERISTIC cfg.betriebsmode "Konfigurationsparameter: SG Typ | EN: Konfigurationsparameter: SG Typ" VALUE 0x792FD TKW_VV_VV_UB 100.0 FORMULA_0379 0.0 255.0 /end CHARACTERISTIC
/begin CHARACTERISTIC cfg.sg_mode "Steuergeraete Mode | EN: Steuergeraete Mode" VALUE 0x792FE TKW_VV_VV_UB 100.0 FORMULA_0380 0.0 255.0 BIT_MASK 0xF /end CHARACTERISTIC
/begin CHARACTERISTIC cfg.peripherie "Konfigurationsparameter: Motorperipherie" VALUE 0x792FF TKW_VV_VV_UB 100.0 FORMULA_0033 0.0 255.0000 /end CHARACTERISTIC
/begin CHARACTERISTIC cfg.dsc_typ "Konfigurationsparameter: DSC" VALUE 0x79300 TKW_VV_VV_UB 100.0 FORMULA_0381 0.0 255.0 /end CHARACTERISTIC
/begin CHARACTERISTIC cfg.canmess "Konfigurationsparameter: CAN-Messtechnik | EN: Konfigurationsparameter: CAN-Messtechnik" VALUE 0x79301 TKW_VV_VV_UB 100.0 FORMULA_0357 0.0 255.0 /end CHARACTERISTIC
/begin CHARACTERISTIC cfg.hil "Konfigurationsparameter: HIL-Betrieb | EN: Konfigurationsparameter: HIL-Betrieb" VALUE 0x79302 TKW_VV_VV_UB 100.0 FORMULA_0382 0.0 255.0 /end CHARACTERISTIC
/begin CHARACTERISTIC cfg.ipm "Konfigurationsparameter: IPM | EN: Konfigurationsparameter: IPM" VALUE 0x79303 TKW_VV_VV_UB 100.0 FORMULA_0357 0.0 255.0 /end CHARACTERISTIC
/* ------------------ Abschnitt erzeugt aus pwg.dat ------------------ */
/begin CHARACTERISTIC K_PWG_A0_MIN_E2 "Unter Adaptionschwelle Ebene 2 | EN: Unter Adaptionschwelle Ebene 2" VALUE 0x7A99A TKW_VV_VV_SW 100.0 FORMULA_0418 0.0 5.0000 FORMAT "%6.3" /end CHARACTERISTIC
/begin CHARACTERISTIC K_PWG_NORM_E2 "Normierung Potentiometerspannung Ebene 2 | EN: Normierung Potentiometerspannung Ebene 2" VALUE 0x7A99C TKW_VV_VV_SW 100.0 FORMULA_0888 0.0 100.0000 FORMAT "%6.3" /end CHARACTERISTIC
/begin CHARACTERISTIC K_PWG_NORM_HS_E2 "Normierung Potentiometerspannung fuer Handschalter Ebene 2 | EN: Normierung Potentiometerspannung für Handschalter Ebene 2" VALUE 0x7A99E TKW_VV_VV_SW 100.0 FORMULA_0888 0.0 100.0000 FORMAT "%6.3" /end CHARACTERISTIC
/begin CHARACTERISTIC K_PWG_DELTA_E2 "Zulaessige Differenz zur Ebene 2 | EN: Zulaessige Differenz zur Ebene 2" VALUE 0x7A9A0 TKW_VV_VV_SW 100.0 FORMULA_0001 0.0 120.0000 FORMAT "%4.1" /end CHARACTERISTIC
/begin CHARACTERISTIC K_PWG_ERR_MAX_E2 "max. Fehler fuer Vergleich | EN: max. Fehler fuer Vergleich" VALUE 0x7A9A2 TKW_VV_VV_UB 100.0 FORMULA_0003 0.0 255.0000 /end CHARACTERISTIC
/begin CHARACTERISTIC K_PWG_SMG_ANFAHREN_FAK_E2 "max. Faktor fuer 2. Ganganfahrt Ebene 2 | EN: max. Faktor fuer 2. Gan ganfahrt Ebene 2" VALUE 0x7A9A4 TKW_VV_VV_UW 100.0 FORMULA_0075 0.0 2.0000 FORMAT "%6.3" /end CHARACTERISTIC
/begin CHARACTERISTIC K_PWG_BLS_CFG "Einschalten der Diagnose | EN: 0 Begr. ueber v 0x1 Begr. ueber Druck 0x2 keine Begrenzung Einschalten der Diagnose" VALUE 0x786B0 TKW_VV_VV_UB 100.0 FORMULA_0904 0.0 255.0 /end CHARACTERISTIC
/begin CHARACTERISTIC K_PWG_BLS_T_BRP_FEHLER "Begrenzungsverzoegerung-Bremsdruck | EN: Limitation delay - brake pressure [ms]" VALUE 0x786B1 TKW_VV_VV_UB 100.0 FORMULA_0590 0.0 1275.0000 /end CHARACTERISTIC
/begin CHARACTERISTIC K_PWG_BLS_T_V_FEHLER "Begrenzungsverzoegerung-Bremsdruck | EN: Limitation delay - brake pressure [ms]" VALUE 0x786B2 TKW_VV_VV_UB 100.0 FORMULA_0590 0.0 1275.0000 /end CHARACTERISTIC
/begin CHARACTERISTIC K_PWG_BLS_V_VORNE_MAX "Geschwindigkeitschwelle fuer Begrenzung | EN: Speed threshold for limitation [Km/h]" VALUE 0x786B4 TKW_VV_VV_SW 100.0 FORMULA_0078 -80.0000 360.0000 FORMAT "%4.1" /end CHARACTERISTIC
/begin CHARACTERISTIC K_PWG_BLS_V_MIN "Geschwindigkeitsschwelle Berganfahrt ermoeglichen | EN: Speed threshold to enable hill start [Km/h]" VALUE 0x786B6 TKW_VV_VV_SW 100.0 FORMULA_0078 -80.0000 360.0000 FORMAT "%4.1" /end CHARACTERISTIC
/begin CHARACTERISTIC K_PWG_BLS_PWG_MAX "Pedalwertschwelle Berganfahrt ermoeglichen | EN: Pedal threshold to enable hill start [%]" VALUE 0x786B8 TKW_VV_VV_UW 100.0 FORMULA_0636 0.0 100.0000 FORMAT "%4.1" /end CHARACTERISTIC
/begin CHARACTERISTIC K_PWG_BLS_V_MAX "Geschwindigkeitsschwelle Berganfahrt sperren | EN: Speed threshold to block hill start [Km/h]" VALUE 0x786BA TKW_VV_VV_SW 100.0 FORMULA_0078 -80.0000 360.0000 FORMAT "%4.1" /end CHARACTERISTIC
/begin CHARACTERISTIC K_PWG_BLS_PWG_MIN "Pedalwertschwelle Berganfahrt sperren | EN: Pedal threshold to block hill start [%]" VALUE 0x786BC TKW_VV_VV_UW 100.0 FORMULA_0636 0.0 100.0000 FORMAT "%4.1" /end CHARACTERISTIC
/begin CHARACTERISTIC K_PWG_BLS_N_MAX_FSP "Drehzahlschwelle fuer Fehlerspeichereintrag bei Leistungsreduktion | EN: Engine-speed threshold for fault entry during power reduction [Upm]" VALUE 0x786BE TKW_VV_VV_SW 100.0 FORMULA_0006 0.0 10000.0000 /end CHARACTERISTIC
/begin CHARACTERISTIC K_PWG_BLS_HS_VERZ "Verzoergerungszeit der Begrenzung beim Handschalter | EN: Verzoegerungszeit der Begre n-zung beim Handschalter" VALUE 0x786C0 TKW_VV_VV_UW 100.0 FORMULA_0893 0.0 327675.0000 /end CHARACTERISTIC
/begin CHARACTERISTIC K_PWG1_DIAG_MIN "Unter Diagnoseschwelle-Pedalwertgeber 1 | EN: Unter Diagnoseschwelle -Pedalwertgeber 1" VALUE 0x786C2 TKW_VV_VV_SW 100.0 FORMULA_0418 0.0 5.0000 FORMAT "%6.3" /end CHARACTERISTIC
/begin CHARACTERISTIC K_PWG1_DIAG_MAX "Obere Diagnoseschwelle-Pedalwertgeber 1 | EN: Obere Diagnoseschwelle-Pedalwertgeber 1" VALUE 0x786C4 TKW_VV_VV_SW 100.0 FORMULA_0418 0.0 5.0000 FORMAT "%6.3" /end CHARACTERISTIC
/begin CHARACTERISTIC K_PWG1_NORM "Normierung Potentiometerspannung - %-Pedalwert 1 | EN: Normierung Potentiometerspannung - %- Pedalwert 1" VALUE 0x786C6 TKW_VV_VV_SW 100.0 FORMULA_0888 0.0 100.0000 FORMAT "%6.3" /end CHARACTERISTIC
/begin CHARACTERISTIC K_PWG1_NORM_HS "Normierung Potentiometerspannung fuer Handschalter- %-Pedalwert 1 | EN: Normierung Potentiometerspannung - %- Pedalwert 1" VALUE 0x786C8 TKW_VV_VV_SW 100.0 FORMULA_0888 0.0 100.0000 FORMAT "%6.3" /end CHARACTERISTIC
/begin CHARACTERISTIC K_PWG_TAU "Filterkonstante fuer den absoluten Spannungswert | EN: Filterkonstante fuer den absol u-ten Spannungswert" VALUE 0x786CA TKW_VV_VV_UB 100.0 FORMULA_0478 0.0051 1.2800 /end CHARACTERISTIC
/begin CHARACTERISTIC K_PWG_TAU_FEHLER "Filterkonstante fuer den absoluten Spannungswert im Fehlerfall | EN: Filterkonstante fuer den absol u-ten Spannungswert im Fehlerfall" VALUE 0x786CB TKW_VV_VV_UB 100.0 FORMULA_0478 0.0051 1.2800 /end CHARACTERISTIC
/begin CHARACTERISTIC K_PWG1_A0_MIN "Unter Adaptionschwelle Pedalwertgeber 1 | EN: Unter Adaptionschwelle Peda l-wertgeber 1" VALUE 0x786CC TKW_VV_VV_SW 100.0 FORMULA_0418 0.0 5.0000 FORMAT "%6.3" /end CHARACTERISTIC
/begin CHARACTERISTIC K_PWG1_A0_MAX "Obere Adaptionschwelle Pedalwertgeber 1 | EN: Upper adaptation threshold, pedal sensor 1 [V]" VALUE 0x786CE TKW_VV_VV_SW 100.0 FORMULA_0418 0.0 5.0000 FORMAT "%6.3" /end CHARACTERISTIC
/begin CHARACTERISTIC K_PWG_A0_TAU "Filterkonstante fuer die LL-Winkel Abwaertsadaption 1 | EN: Filter constant for idle-angle downward adaptation 1 [s]" VALUE 0x786D0 TKW_VV_VV_UB 100.0 FORMULA_0679 0.1004 25.6000 /end CHARACTERISTIC
/begin CHARACTERISTIC K_PWG1_INC_A0_ADAPT "Freischalten der Aufwaertsadaption | EN: Enable upward adaptation [V]" VALUE 0x786D2 TKW_VV_VV_SW 100.0 FORMULA_0418 0.0 5.0000 FORMAT "%6.3" /end CHARACTERISTIC
/begin CHARACTERISTIC K_PWG_A0_ZAEHLER "Zaehler fuer die Aufwaertsadaption | EN: Counter for upward adaptation" VALUE 0x786D4 TKW_VV_VV_UB 100.0 FORMULA_0003 1.0000 255.0000 /end CHARACTERISTIC
/begin CHARACTERISTIC K_PWG1_A0_INITINC "Aufwertsadaption der LL-Potentiometerspannung beim Start | EN: Upward adaptation of idle potentiometer voltage at start [V]" VALUE 0x786D6 TKW_VV_VV_SW 100.0 FORMULA_0418 0.0 5.0000 FORMAT "%6.3" /end CHARACTERISTIC
/begin CHARACTERISTIC K_PWG_AB_RAMPE "Dauer der Abregelrampe bei Leistungsbegrenzung | EN: Duration of ramp-down during power limitation [s]" VALUE 0x786D8 TKW_VV_VV_UW 100.0 FORMULA_0905 0.0051 327.6800 FORMAT "%7.4" /end CHARACTERISTIC
/begin CHARACTERISTIC K_PWG_SK_NULLAGE "Diagnose Schwelle | EN: Diagnosis threshold [%]" VALUE 0x786DA TKW_VV_VV_SW 100.0 FORMULA_0001 -10.0000 120.0000 FORMAT "%4.1" /end CHARACTERISTIC
/begin CHARACTERISTIC K_PWG_KD "Pedalwert fuer Kick Down | EN: Pedal value for kick-down [%]" VALUE 0x786DC TKW_VV_VV_SW 100.0 FORMULA_0001 -10.0000 150.0000 FORMAT "%4.1" /end CHARACTERISTIC
/begin CHARACTERISTIC K_PWG_SOLL_2GANG_MAX "max. Pedalwert 2. Ganganfahrt | EN: Maximum pedal value for 2nd-gear pull-away [%]" VALUE 0x786DE TKW_VV_VV_SW 100.0 FORMULA_0001 -10.0000 120.0000 FORMAT "%4.1" /end CHARACTERISTIC
/begin CHARACTERISTIC K_PWG_SOLL_2GANG_VMAX "max. Gewschwindigkeit 2. Ganganfahrt | EN: Maximum vehicle speed for 2nd-gear pull-away [Km/h]" VALUE 0x786E0 TKW_VV_VV_SW 100.0 FORMULA_0078 -80.0000 360.0000 FORMAT "%4.1" /end CHARACTERISTIC
/begin CHARACTERISTIC K_PWG_SOLL_2GANG_FAK "max. Faktor fuer 2. Ganganfahrt | EN: Maximum factor for 2nd-gear pull-away" VALUE 0x786E2 TKW_VV_VV_UW 100.0 FORMULA_0075 0.0 2.0000 FORMAT "%6.3" /end CHARACTERISTIC
/begin CHARACTERISTIC K_PWG_SOLL_2GANG_AUF "Schrittweite fuer 2. Ganganfahrt | EN: Step size for 2nd-gear pull-away [1/s]" VALUE 0x786E4 TKW_VV_VV_UW 100.0 FORMULA_0906 0.1000 12799.8046 FORMAT "%5.2" /end CHARACTERISTIC
/begin CHARACTERISTIC K_PWG_SOLL_2GANG_AB "Schrittweite fuer 2. Ganganfahrt" VALUE 0x786E6 TKW_VV_VV_UW 100.0 FORMULA_0906 0.0 12799.8046 FORMAT "%5.2" /end CHARACTERISTIC
/begin CHARACTERISTIC KL_PWG_MAX_DIFF "MAX PWG-Abweichung | EN: Maximum pedal-sensor deviation" CURVE 0x786E8 TKL_SW_VV_SW 100.0 FORMULA_0001 0.0 120.0000 /begin AXIS_DESCR STD_AXIS pwg1_2 FORMULA_0001 3 0.0 120.0000 FORMAT "%4.1" /end AXIS_DESCR FORMAT "%4.1" /end CHARACTERISTIC
/begin CHARACTERISTIC KL_PWG_SOLL_NOTLAUF "Pedalwert im Fehlerfall | EN: Pedal value in fault case" CURVE 0x786F6 TKL_SW_VV_SW 100.0 FORMULA_0001 0.0 100.0000 /begin AXIS_DESCR STD_AXIS FORMULA_0001 10 0.0 120.0000 FORMAT "%4.1" /end AXIS_DESCR FORMAT "%4.1" /end CHARACTERISTIC
/begin CHARACTERISTIC KL_PWG_SOLL "Messwert in Pedalwert | EN: Measured value to pedal value" CURVE 0x78720 TKL_SW_VV_SW 100.0 FORMULA_0001 0.0 100.0000 /begin AXIS_DESCR STD_AXIS FORMULA_0001 2 0.0 120.0000 FORMAT "%4.1" /end AXIS_DESCR FORMAT "%4.1" /end CHARACTERISTIC
/begin CHARACTERISTIC KL_PWG_BLS_BRP "Begrenzung Bremsdruck | EN: Brake pressure limit" CURVE 0x7872A TKL_UW_VV_UW 100.0 FORMULA_0636 0.0 100.0000 /begin AXIS_DESCR STD_AXIS FORMULA_0907 5 0.0 255.0000 /end AXIS_DESCR FORMAT "%4.1" /end CHARACTERISTIC
/begin CHARACTERISTIC KL_PWG_BLS_V "Begrenzung Geschwindigkeit | EN: Vehicle speed limit" CURVE 0x78740 TKL_SW_VV_UW 100.0 FORMULA_0636 0.0 100.0000 /begin AXIS_DESCR STD_AXIS FORMULA_0078 5 -80.0000 360.0000 FORMAT "%4.1" /end AXIS_DESCR FORMAT "%4.1" /end CHARACTERISTIC
/* ------------------ Abschnitt erzeugt aus sk_ign.dat ------------------ */
/begin CHARACTERISTIC KL_SK_LLR_N_SOLL "Solldrehzahl durch SK-Stufe | EN: Target engine speed from safety-concept stage" CURVE 0x7890E TKL_UB_VV_SW 100.0 FORMULA_0006 0.0 10000.0000 /begin AXIS_DESCR STD_AXIS Stufe FORMULA_0003 6 0.0 255.0000 /end AXIS_DESCR /end CHARACTERISTIC
/* ------------------ Abschnitt erzeugt aus smg.dat ------------------ */
/begin CHARACTERISTIC K_SMG_TAU_MD_FAHRER "Filter Fahrerwunsch | EN: Filter Fahrerwunsch" VALUE 0x78928 TKW_VV_VV_UB 100.0 FORMULA_0462 0.0101 2.5600 /end CHARACTERISTIC
/begin CHARACTERISTIC K_SMG_TAU_DN_FILTER "Filter Drehzahlgradient | EN: Filter Drehzahlgradient" VALUE 0x78929 TKW_VV_VV_UB 100.0 FORMULA_0462 0.0101 2.5600 /end CHARACTERISTIC
/begin CHARACTERISTIC K_SMG_TAU_DN_GETR "Filter Getriebedrehzahlgradient | EN: Filter Getriebedrehzahlgradient" VALUE 0x7892A TKW_VV_VV_UB 100.0 FORMULA_0462 0.0101 2.5600 /end CHARACTERISTIC
/begin CHARACTERISTIC K_SMG_TAU_KSCHLUPF "Filter Kupplungsschlupf | EN: Filter Kupplungsschlupf" VALUE 0x7892B TKW_VV_VV_UB 100.0 FORMULA_0462 0.0101 2.5600 /end CHARACTERISTIC
/begin CHARACTERISTIC K_SMG_TAU_AX_BERECH "Filter berech. ax | EN: Filter berech. ax" VALUE 0x7892C TKW_VV_VV_UB 100.0 FORMULA_0462 0.0101 2.5600 /end CHARACTERISTIC
/begin CHARACTERISTIC K_SMG_TAU_AX_MESS "Filter gem. ax | EN: Filter gem. ax" VALUE 0x7892D TKW_VV_VV_UB 100.0 FORMULA_0462 0.0101 2.5600 /end CHARACTERISTIC
/begin CHARACTERISTIC K_SMG_TAU_AX_BERG "Filter Steigung | EN: Filter Steigung" VALUE 0x7892E TKW_VV_VV_UB 100.0 FORMULA_0462 0.0101 2.5600 /end CHARACTERISTIC
/begin CHARACTERISTIC K_SMG_TAU_RSCHLUPF "Filter Radschlupf | EN: Filter Radschlupf" VALUE 0x7892F TKW_VV_VV_UB 100.0 FORMULA_0462 0.0101 2.5600 /end CHARACTERISTIC
/begin CHARACTERISTIC K_SMG_TAU_DSC_ABS "Filter DSC-Anforderung | EN: Filter DSC-Anforderung" VALUE 0x78930 TKW_VV_VV_UB 100.0 FORMULA_0462 0.0101 2.5600 /end CHARACTERISTIC
/begin CHARACTERISTIC K_SMG_MOT_J_MOTOR_ZR "Faktor fuer Vorst 2 bei ZR | EN: Faktor fuer Vorst 2 bei ZR" VALUE 0x78931 TKW_VV_VV_UB 100.0 FORMULA_0939 0.0 1.9921 /end CHARACTERISTIC
/begin CHARACTERISTIC K_SMG_PROG_V_SCHW "v-Schwelle fuer Schub-Programm | EN: v-Schwelle fuer Schub-Programm" VALUE 0x78932 TKW_VV_VV_SW 100.0 FORMULA_0078 -80.0000 360.0000 FORMAT "%4.1" /end CHARACTERISTIC
/begin CHARACTERISTIC K_SMG_PROG_MIN_ZR "min. Programm fuer ZR | EN: Minimum program for traction downshift" VALUE 0x78934 TKW_VV_VV_UB 100.0 FORMULA_0279 1.0000 8.0000 /end CHARACTERISTIC
/begin CHARACTERISTIC K_SMG_PROG_MIN_ANH "min. Programm mit Anhaenger | EN: Minimum program with trailer" VALUE 0x78935 TKW_VV_VV_UB 100.0 FORMULA_0279 1.0000 8.0000 /end CHARACTERISTIC
/begin CHARACTERISTIC K_SMG_PROG_MAX_ANH "max. Programm mit Anhaenger | EN: Maximum program with trailer" VALUE 0x78936 TKW_VV_VV_UB 100.0 FORMULA_0279 1.0000 8.0000 /end CHARACTERISTIC
/begin CHARACTERISTIC K_SMG_PROG_MAX_FETRAWE "max. Programm bei FeTraWe | EN: Maximum program in factory/transport/workshop mode" VALUE 0x78937 TKW_VV_VV_UB 100.0 FORMULA_0279 1.0000 8.0000 /end CHARACTERISTIC
/begin CHARACTERISTIC K_SMG_PROG_MAX_EINFAHR "max. Programm beim Einfahren | EN: Maximum program during running-in" VALUE 0x78938 TKW_VV_VV_UB 100.0 FORMULA_0279 1.0000 8.0000 /end CHARACTERISTIC
/begin CHARACTERISTIC K_SMG_PROG_FETRAWE_WEG "zul. Kilometerstand fuer SMG-Begrenzung im FeTra-Mode | EN: Permitted mileage for SMG limitation in factory/transport mode" VALUE 0x7893A TKW_VV_VV_UW 100.0 FORMULA_0942 0.0 65535.0000 /end CHARACTERISTIC
/begin CHARACTERISTIC K_SMG_PROG_EINFAHR_WEG "Kilometerstand Einfahr-Begrenzung | EN: Mileage for running-in limitation" VALUE 0x7893C TKW_VV_VV_UW 100.0 FORMULA_0942 0.0 65535.0000 /end CHARACTERISTIC
/begin CHARACTERISTIC K_SMG_N_ABRISS_HYS "Hysterese f�r Abrisserkennung | EN: Hysteresis for tear-off detection" VALUE 0x7893E TKW_VV_VV_SW 100.0 FORMULA_0006 0.0 10000.0000 /end CHARACTERISTIC
/begin CHARACTERISTIC K_SMG_N_ABRISS_ANF "Abrisserkennungschwelle beim Anfahren | EN: Tear-off detection threshold at pull-away" VALUE 0x78940 TKW_VV_VV_SW 100.0 FORMULA_0006 0.0 10000.0000 /end CHARACTERISTIC
/begin CHARACTERISTIC K_SMG_N_NULL "Drehzahl-Nullschwelle | EN: Zero-speed threshold" VALUE 0x78942 TKW_VV_VV_SW 100.0 FORMULA_0006 0.0 10000.0000 /end CHARACTERISTIC
/begin CHARACTERISTIC K_SMG_M_NULL "Moment-Nullschwelle | EN: Zero-torque threshold" VALUE 0x78944 TKW_VV_VV_SW 100.0 FORMULA_0009 -100.0000 1000.0000 FORMAT "%4.1" /end CHARACTERISTIC
/begin CHARACTERISTIC K_SMG_KSCHLUPF_N "n-Schwelle Kupplungsschlupf | EN: Speed threshold, clutch slip" VALUE 0x78946 TKW_VV_VV_SW 100.0 FORMULA_0006 0.0 10000.0000 /end CHARACTERISTIC
/begin CHARACTERISTIC K_SMG_KSCHLUPF_AUF "Kupplungsschlupfschwelle beim Aufregeln | EN: Clutch slip threshold during ramp-up" VALUE 0x78948 TKW_VV_VV_UB 100.0 FORMULA_0943 0.0 10.0000 /end CHARACTERISTIC
/begin CHARACTERISTIC K_SMG_KSCHLUPF_DSC "Kupplungsschlupf bei DSC-Eingr | EN: Clutch slip during DSC intervention" VALUE 0x78949 TKW_VV_VV_UB 100.0 FORMULA_0943 0.0 10.0000 /end CHARACTERISTIC
/begin CHARACTERISTIC K_SMG_KSCHLUPF_T_SCHW "Zeitschwelle fuer Kupplungsschlupf | EN: Time threshold for clutch slip" VALUE 0x7894A TKW_VV_VV_UB 100.0 FORMULA_0317 0.0 2.5500 /end CHARACTERISTIC
/begin CHARACTERISTIC K_SMG_KI_CFG "KI-Konfiguration | EN: Shift-index configuration" VALUE 0x7894B TKW_VV_VV_UB 100.0 FORMULA_0944 0.0 255.0 /end CHARACTERISTIC
/begin CHARACTERISTIC K_SMG_KI_SCHALT_DSC "max. Schalt-Index bei DSC aktiv | EN: Maximum shift index with DSC active" VALUE 0x7894C TKW_VV_VV_UB 100.0 FORMULA_0003 0.0 14.0000 /end CHARACTERISTIC
/begin CHARACTERISTIC K_SMG_KI_AUF_DSC "max. Aufregel-Index bei DSC passiv | EN: Maximum ramp-up index with DSC off" VALUE 0x7894D TKW_VV_VV_UB 100.0 FORMULA_0003 0.0 12.0000 /end CHARACTERISTIC
/begin CHARACTERISTIC K_SMG_KI_AUF_DSC2 "max. Aufregel-Index bei DSC-Sport | EN: Maximum ramp-up index in DSC Sport" VALUE 0x7894E TKW_VV_VV_UB 100.0 FORMULA_0003 0.0 12.0000 /end CHARACTERISTIC
/begin CHARACTERISTIC K_SMG_KI_AUF_EINGR "max. Aufregel-Index bei DSC-Eingriff | EN: Maximum ramp-up index during DSC intervention" VALUE 0x7894F TKW_VV_VV_UB 100.0 FORMULA_0003 0.0 12.0000 /end CHARACTERISTIC
/begin CHARACTERISTIC K_SMG_KI_AUF_ZR "max. Aufregel-Index bei Zugrueck | EN: Maximum ramp-up index on traction downshift" VALUE 0x78950 TKW_VV_VV_UB 100.0 FORMULA_0003 0.0 12.0000 /end CHARACTERISTIC
/begin CHARACTERISTIC K_SMG_KI_AUF_T_EINGR "max. Zeit mit DSC-Eingriff | EN: Maximum time with DSC intervention" VALUE 0x78952 TKW_VV_VV_UW 100.0 FORMULA_0021 0.0 655.0000 FORMAT "%5.2" /end CHARACTERISTIC
/begin CHARACTERISTIC K_SMG_KI_AKS_AY_MAX "AKS-Sperre bei hohen ay | EN: Auto-upshift lock at high lateral acceleration" VALUE 0x78954 TKW_VV_VV_SW 100.0 FORMULA_0132 -20.0000 20.0000 FORMAT "%5.2" /end CHARACTERISTIC
/begin CHARACTERISTIC K_SMG_KI_AKS_DAY_MAX "AKS-Sperre bei ay-Zunahme | EN: Auto-upshift lock on lateral-acceleration increase" VALUE 0x78956 TKW_VV_VV_SW 100.0 FORMULA_0132 -20.0000 20.0000 FORMAT "%5.2" /end CHARACTERISTIC
/begin CHARACTERISTIC K_SMG_KI_NEU_AY_MAX "kein Aktualisieren der KI bei hohen ay | EN: No shift-index update at high lateral acceleration" VALUE 0x78958 TKW_VV_VV_SW 100.0 FORMULA_0132 -20.0000 20.0000 FORMAT "%5.2" /end CHARACTERISTIC
/begin CHARACTERISTIC K_SMG_KI_DELTA_PWG "Neubestimmung der KIs | EN: Re-determination of shift indices" VALUE 0x7895A TKW_VV_VV_SW 100.0 FORMULA_0001 -10.0000 120.0000 FORMAT "%4.1" /end CHARACTERISTIC
/begin CHARACTERISTIC K_SMG_T_ABREGEL_AKS "Sprung auf Nullmoment | EN: Step to zero torque" VALUE 0x7895C TKW_VV_VV_UB 100.0 FORMULA_0317 0.0 2.5500 /end CHARACTERISTIC
/begin CHARACTERISTIC K_SMG_T_KORR_AB_MIN "t-Verkuerzung | EN: Time shortening" VALUE 0x7895D TKW_VV_VV_UB 100.0 FORMULA_0317 0.0 2.5500 /end CHARACTERISTIC
/begin CHARACTERISTIC K_SMG_T_KORR_AB_FW "Kuerzen wegen Fahreraktion | EN: Shorten due to driver action" VALUE 0x7895E TKW_VV_VV_UW 100.0 FORMULA_0009 0.0 6553.5000 FORMAT "%4.1" /end CHARACTERISTIC
/begin CHARACTERISTIC K_SMG_NO_LW_N_SCHW "Ende bei LW | EN: End at load change" VALUE 0x78960 TKW_VV_VV_UB 100.0 FORMULA_0746 0.0 255.0000 /end CHARACTERISTIC
/begin CHARACTERISTIC K_SMG_TESTMODE "Testfunktionen | EN: Test functions" VALUE 0x78961 TKW_VV_VV_UB 100.0 FORMULA_0945 0.0 255.0 /end CHARACTERISTIC
/begin CHARACTERISTIC K_SMG_MD_FW_MIN_AB "min. Abregelmoment | EN: Minimum ramp-down torque" VALUE 0x78962 TKW_VV_VV_SW 100.0 FORMULA_0009 -100.0000 1000.0000 FORMAT "%4.1" /end CHARACTERISTIC
/begin CHARACTERISTIC K_SMG_MD_FW_MIN_AUF "min. Aufregelmoment | EN: Minimum ramp-up torque" VALUE 0x78964 TKW_VV_VV_SW 100.0 FORMULA_0009 -100.0000 1000.0000 FORMAT "%4.1" /end CHARACTERISTIC
/begin CHARACTERISTIC K_SMG_MD_FW_HYS_ZUG "Hysterese Zugerkennung | EN: Hysteresis, traction detection" VALUE 0x78966 TKW_VV_VV_SW 100.0 FORMULA_0009 -100.0000 1000.0000 FORMAT "%4.1" /end CHARACTERISTIC
/begin CHARACTERISTIC K_SMG_MD_FW_HYS_SCH "Hysterese Schuberkennung | EN: Hysteresis, overrun detection" VALUE 0x78968 TKW_VV_VV_SW 100.0 FORMULA_0009 -100.0000 1000.0000 FORMAT "%4.1" /end CHARACTERISTIC
/begin CHARACTERISTIC K_SMG_PWG_FW_SCH "Pwg-Schuberkennung | EN: Pedal-based overrun detection" VALUE 0x7896A TKW_VV_VV_SW 100.0 FORMULA_0001 -10.0000 120.0000 FORMAT "%4.1" /end CHARACTERISTIC
/begin CHARACTERISTIC K_SMG_PWG_FW_SCH_N_OFF "LL-Offset fuer Pwg-Schuberkennung | EN: Idle offset for pedal-based overrun detection" VALUE 0x7896C TKW_VV_VV_SW 100.0 FORMULA_0006 0.0 10000.0000 /end CHARACTERISTIC
/begin CHARACTERISTIC K_SMG_KUPP_DM_MIN "min. Kupplungsgradient | EN: Minimum clutch gradient" VALUE 0x7896E TKW_VV_VV_SW 100.0 FORMULA_0571 -5000.0000 5000.0000 /end CHARACTERISTIC
/begin CHARACTERISTIC K_SMG_KUPP_DM_RAB "Kupplungsgradient bei RAB | EN: Clutch gradient during roll-back" VALUE 0x78970 TKW_VV_VV_UB 100.0 FORMULA_0827 0.0 5100.0000 /end CHARACTERISTIC
/begin CHARACTERISTIC K_SMG_KUPP_DM_ABS "Kupplungsgradient bei ABS-Eingr | EN: Clutch gradient during ABS intervention" VALUE 0x78971 TKW_VV_VV_UB 100.0 FORMULA_0827 0.0 5100.0000 /end CHARACTERISTIC
/begin CHARACTERISTIC K_SMG_KUPP_DM_SOLL_F "Faktor auf Kupplungsgradient | EN: Factor on clutch gradient" VALUE 0x78972 TKW_VV_VV_UB 100.0 FORMULA_0704 0.0 1.9921 /end CHARACTERISTIC
/begin CHARACTERISTIC K_SMG_KUPP_M_MAX_1 "Max. Schubmoment im 1.Gang | EN: Maximum overrun torque in 1st gear" VALUE 0x78974 TKW_VV_VV_SW 100.0 FORMULA_0009 -100.0000 1000.0000 FORMAT "%4.1" /end CHARACTERISTIC
/begin CHARACTERISTIC K_SMG_KUPP_M_MAX_2 "Max. Schubmoment im 2.Gang | EN: Maximum overrun torque in 2nd gear" VALUE 0x78976 TKW_VV_VV_SW 100.0 FORMULA_0009 -100.0000 1000.0000 FORMAT "%4.1" /end CHARACTERISTIC
/begin CHARACTERISTIC K_SMG_KUPP_REG_T "Einschaltschwelle Regler | EN: Controller switch-on threshold" VALUE 0x78978 TKW_VV_VV_UW 100.0 FORMULA_0021 0.0 655.0000 FORMAT "%5.2" /end CHARACTERISTIC
/begin CHARACTERISTIC K_SMG_KUPP_RAMPE_N_ABW "Ausloeseschwelle Rampe - Abwuergen | EN: Trigger threshold, ramp - stalling" VALUE 0x7897A TKW_VV_VV_SW 100.0 FORMULA_0006 0.0 10000.0000 /end CHARACTERISTIC
/begin CHARACTERISTIC K_SMG_KUPP_RAMPE_N "Ausloeseschwelle Rampe | EN: Trigger threshold, ramp" VALUE 0x7897C TKW_VV_VV_SW 100.0 FORMULA_0006 0.0 10000.0000 /end CHARACTERISTIC
/begin CHARACTERISTIC K_SMG_KUPP_RAMPE_DM "Steigung Kupplungsrampe | EN: Slope of clutch ramp" VALUE 0x7897E TKW_VV_VV_UB 100.0 FORMULA_0946 0.0 0.2550 /end CHARACTERISTIC
/begin CHARACTERISTIC K_SMG_KUPP_N_KSCHUTZ "Ausloeseschwelle fuer Kupplungsschutz | EN: Trigger threshold for clutch protection" VALUE 0x78980 TKW_VV_VV_SW 100.0 FORMULA_0006 0.0 10000.0000 /end CHARACTERISTIC
/begin CHARACTERISTIC K_SMG_KUPP_UL_FW_SCHW "min. Fahrerwunsch fuer Kupplungsschutz | EN: Minimum driver demand for clutch protection" VALUE 0x78982 TKW_VV_VV_SW 100.0 FORMULA_0009 -100.0000 1000.0000 FORMAT "%4.1" /end CHARACTERISTIC
/begin CHARACTERISTIC K_SMG_KUPP_UL_MD_SCHW "Offset auf Istmoment | EN: Offset on actual torque" VALUE 0x78984 TKW_VV_VV_SW 100.0 FORMULA_0009 -100.0000 1000.0000 FORMAT "%4.1" /end CHARACTERISTIC
/begin CHARACTERISTIC K_SMG_KUPP_UL_N_SCHW "Differenz Motor/Getriebe | EN: Difference engine/gearbox" VALUE 0x78986 TKW_VV_VV_SW 100.0 FORMULA_0006 0.0 10000.0000 /end CHARACTERISTIC
/begin CHARACTERISTIC K_SMG_KUPP_UL_FW_MAX "max. FW-Reduktion bei UL | EN: Maximum driver-demand reduction during overload" VALUE 0x78988 TKW_VV_VV_SW 100.0 FORMULA_0009 -100.0000 1000.0000 FORMAT "%4.1" /end CHARACTERISTIC
/begin CHARACTERISTIC K_SMG_KUPP_RAMPE_UL "Kupplungsrampe bei UL | EN: Clutch ramp during overload" VALUE 0x7898A TKW_VV_VV_UW 100.0 FORMULA_0947 0.0 6553.5000 /end CHARACTERISTIC
/begin CHARACTERISTIC K_SMG_KUPP_UL_FW_DM "Fahrerwunschrampe bei UL | EN: Driver-demand ramp during overload" VALUE 0x7898C TKW_VV_VV_UB 100.0 FORMULA_0799 0.0 2550.0000 /end CHARACTERISTIC
/begin CHARACTERISTIC K_SMG_KUPP_AUF_SCHW_N "n-Schwelle fuer Aufregelschwingen | EN: Speed threshold for ramp-up oscillation" VALUE 0x7898E TKW_VV_VV_SW 100.0 FORMULA_0006 0.0 10000.0000 /end CHARACTERISTIC
/begin CHARACTERISTIC K_SMG_TZ_EINGR_T_AB "Schwelle Abregeln mit TZ-Eingr | EN: Threshold for ramp-down with ignition intervention" VALUE 0x78990 TKW_VV_VV_UB 100.0 FORMULA_0317 0.0 2.5500 /end CHARACTERISTIC
/begin CHARACTERISTIC K_SMG_N_ZIEL_OFF_ZH "Offset zur EKR-Zieldrehzahl bei ZugHoch | EN: Offset to drag-control target speed on traction upshift" VALUE 0x78992 TKW_VV_VV_SW 100.0 FORMULA_0006 0.0 10000.0000 /end CHARACTERISTIC
/begin CHARACTERISTIC K_SMG_N_ZIEL_OFF_SCH "Offset zur EKR-Zieldrehzahl bei Schub | EN: Offset to drag-control target speed in overrun" VALUE 0x78994 TKW_VV_VV_SW 100.0 FORMULA_0006 0.0 10000.0000 /end CHARACTERISTIC
/begin CHARACTERISTIC K_SMG_N_ZIEL_HYS "max. Drehzahldifferenz | EN: Maximum speed difference" VALUE 0x78996 TKW_VV_VV_SW 100.0 FORMULA_0006 0.0 10000.0000 /end CHARACTERISTIC
/begin CHARACTERISTIC K_SMG_N_ZIEL_OFF_BEGR "Offset auf n-Begrenzer | EN: Offset on rev limiter" VALUE 0x78998 TKW_VV_VV_UB 100.0 FORMULA_0746 0.0 255.0000 /end CHARACTERISTIC
/begin CHARACTERISTIC K_SMG_N_EKR_OFF_BEGR "EKR-Offset auf n-Begrenzer | EN: Engine-drag-control offset on rev limiter" VALUE 0x78999 TKW_VV_VV_UB 100.0 FORMULA_0746 0.0 255.0000 /end CHARACTERISTIC
/begin CHARACTERISTIC K_SMG_N_ZIEL_ABWUERG "Abwuergsolldrehzahl | EN: Anti-stall target speed" VALUE 0x7899A TKW_VV_VV_SW 100.0 FORMULA_0006 0.0 10000.0000 /end CHARACTERISTIC
/begin CHARACTERISTIC K_SMG_N_ZIEL_ANF_V_MAX "v-Schwelle fuer Anfahrdrehzahl | EN: Speed threshold for pull-away engine speed" VALUE 0x7899C TKW_VV_VV_SW 100.0 FORMULA_0078 -80.0000 360.0000 FORMAT "%4.1" /end CHARACTERISTIC
/begin CHARACTERISTIC K_SMG_MOT_M_VOR_AUF "Vorausschau | EN: Look-ahead" VALUE 0x7899E TKW_VV_VV_UB 100.0 FORMULA_0317 0.0 2.5500 /end CHARACTERISTIC
/begin CHARACTERISTIC K_SMG_MOT_NL_MD_MAX "max. Abw. FW TZ-Nachlauf | EN: Maximum driver-demand deviation, ignition follow-up" VALUE 0x789A0 TKW_VV_VV_SW 100.0 FORMULA_0009 -100.0000 1000.0000 FORMAT "%4.1" /end CHARACTERISTIC
/begin CHARACTERISTIC K_SMG_MOT_NL_T_MAX "max. TZ-Nachlaufzeit | EN: Maximum ignition follow-up time" VALUE 0x789A2 TKW_VV_VV_UW 100.0 FORMULA_0117 0.0 325.0000 FORMAT "%5.2" /end CHARACTERISTIC
/begin CHARACTERISTIC K_SMG_MOT_NL_DELTA_FW "FW-Abbruchschwelle fuer Rampe | EN: Driver-demand abort threshold for ramp" VALUE 0x789A4 TKW_VV_VV_UB 100.0 FORMULA_0479 0.0 25.0000 /end CHARACTERISTIC
/begin CHARACTERISTIC K_SMG_MOT_NL_MD "Md-Abbruchschwelle fuer Rampe | EN: Torque abort threshold for ramp" VALUE 0x789A5 TKW_VV_VV_UB 100.0 FORMULA_0749 0.0 25.0000 /end CHARACTERISTIC
/begin CHARACTERISTIC K_SMG_MOT_NL_ETA "Eta-Abbruchschwelle fuer Rampe | EN: Efficiency abort threshold for ramp" VALUE 0x789A6 TKW_VV_VV_UW 100.0 FORMULA_0435 0.0 150.0000 FORMAT "%4.1" /end CHARACTERISTIC
/begin CHARACTERISTIC K_SMG_MOT_NL_TAU "Filter nach Rampenende | EN: Filter after end of ramp" VALUE 0x789A8 TKW_VV_VV_UB 100.0 FORMULA_0478 0.0051 1.2800 /end CHARACTERISTIC
/begin CHARACTERISTIC K_SMG_MOT_M_RES_EXT_MAX "Reserve inaktiv wg. ext. Reserve | EN: Reserve inactive due to external reserve" VALUE 0x789AA TKW_VV_VV_SW 100.0 FORMULA_0009 -100.0000 1000.0000 FORMAT "%4.1" /end CHARACTERISTIC
/begin CHARACTERISTIC K_SMG_MOT_M_RES_MAX "max. Momentenreserve | EN: Maximum torque reserve" VALUE 0x789AC TKW_VV_VV_SW 100.0 FORMULA_0009 0.0 1000.0000 FORMAT "%4.1" /end CHARACTERISTIC
/begin CHARACTERISTIC K_SMG_MOT_M_RES_SCHA "Momentenreserve Schalten | EN: Torque reserve, shifting" VALUE 0x789AE TKW_VV_VV_SW 100.0 FORMULA_0009 -1.0000 1000.0000 FORMAT "%4.1" /end CHARACTERISTIC
/begin CHARACTERISTIC K_SMG_MOT_M_RES_AUF "Momentenreserve Aufregeln | EN: Torque reserve during ramp-up" VALUE 0x789B0 TKW_VV_VV_SW 100.0 FORMULA_0009 -1.0000 1000.0000 FORMAT "%4.1" /end CHARACTERISTIC
/begin CHARACTERISTIC K_SMG_MOT_M_RES_RS "Momentenreserve RS | EN: Torque reserve, race start" VALUE 0x789B2 TKW_VV_VV_SW 100.0 FORMULA_0009 -1.0000 1000.0000 FORMAT "%4.1" /end CHARACTERISTIC
/begin CHARACTERISTIC K_SMG_MOT_M_RES_ABW "Momentenreserve Abwuergen | EN: Torque reserve against stalling" VALUE 0x789B4 TKW_VV_VV_SW 100.0 FORMULA_0009 -1.0000 1000.0000 FORMAT "%4.1" /end CHARACTERISTIC
/begin CHARACTERISTIC K_SMG_MOT_M_RES_RAMPE "Reserve-Rampe | EN: Reserve ramp" VALUE 0x789B6 TKW_VV_VV_SW 100.0 FORMULA_0571 -5000.0000 5000.0000 /end CHARACTERISTIC
/begin CHARACTERISTIC K_SMG_MOT_M_RES_RAMPE_KS "Reserve-Rampe bei Kupplungsschlupf | EN: Reserve ramp during clutch slip" VALUE 0x789B8 TKW_VV_VV_SW 100.0 FORMULA_0571 -5000.0000 5000.0000 /end CHARACTERISTIC
/begin CHARACTERISTIC K_SMG_MOT_M_RES_T_MAX "max. Zeit fuer Momentenreserve | EN: Maximum time for torque reserve" VALUE 0x789BA TKW_VV_VV_UW 100.0 FORMULA_0117 0.0 325.0000 FORMAT "%5.2" /end CHARACTERISTIC
/begin CHARACTERISTIC K_SMG_MOT_DN_SOLL_MIN "min. Drehzahlsollgradient | EN: Minimum target speed gradient" VALUE 0x789BC TKW_VV_VV_SW 100.0 FORMULA_0114 -10000.0000 10000.0000 /end CHARACTERISTIC
/begin CHARACTERISTIC K_SMG_MOT_DN_SOLL_VOR "Schwelle fuer DN-Umschaltung | EN: Threshold for speed-gradient switchover" VALUE 0x789BE TKW_VV_VV_SW 100.0 FORMULA_0006 0.0 10000.0000 /end CHARACTERISTIC
/begin CHARACTERISTIC K_SMG_MOT_DN_GANG_1of3_ "DN-Wichtung ueber Gang | EN: DN-Wichtung ueber Gang" VALUE 0x789C0 TKW_VV_VV_UB 100.0 FORMULA_0704 0.0 1.9921 /end CHARACTERISTIC
/begin CHARACTERISTIC K_SMG_MOT_DN_GANG_2of3_ "DN-Wichtung ueber Gang | EN: DN-Wichtung ueber Gang" VALUE 0x789C1 TKW_VV_VV_UB 100.0 FORMULA_0704 0.0 1.9921 /end CHARACTERISTIC
/begin CHARACTERISTIC K_SMG_MOT_DN_GANG_3of3_ "DN-Wichtung ueber Gang | EN: DN-Wichtung ueber Gang" VALUE 0x789C2 TKW_VV_VV_UB 100.0 FORMULA_0704 0.0 1.9921 /end CHARACTERISTIC
/begin CHARACTERISTIC K_SMG_MOT_DN_REG_I_P "I-Anteil Gradientenregler pos. | EN: Integral share, gradient controller, positive" VALUE 0x789C3 TKW_VV_VV_UB 100.0 FORMULA_0948 0.0 0.0255 /end CHARACTERISTIC
/begin CHARACTERISTIC K_SMG_MOT_DN_REG_I_N "I-Anteil Gradientenregler neg. | EN: Integral share, gradient controller, negative" VALUE 0x789C4 TKW_VV_VV_UB 100.0 FORMULA_0948 0.0 0.0255 /end CHARACTERISTIC
/begin CHARACTERISTIC K_SMG_MOT_DN_REG_I_S "I-Anteil Gradientenregler pos. Schub | EN: Integral share, gradient controller, positive, overrun" VALUE 0x789C5 TKW_VV_VV_UB 100.0 FORMULA_0948 0.0 0.0255 /end CHARACTERISTIC
/begin CHARACTERISTIC K_SMG_MOT_DN_REG_T "Einschaltschwelle dn-Regler | EN: Switch-on threshold, speed-gradient controller" VALUE 0x789C6 TKW_VV_VV_UW 100.0 FORMULA_0021 0.0100 655.0000 FORMAT "%5.2" /end CHARACTERISTIC
/begin CHARACTERISTIC K_SMG_MOT_RAB_M_MIN "min. Moment bei Radabriss | EN: Minimum torque on wheel tear-off" VALUE 0x789C8 TKW_VV_VV_SW 100.0 FORMULA_0009 -100.0000 1000.0000 FORMAT "%4.1" /end CHARACTERISTIC
/begin CHARACTERISTIC K_SMG_MOT_RAB_M_MAX "max. Moment bei Radabriss | EN: Maximum torque on wheel tear-off" VALUE 0x789CA TKW_VV_VV_SW 100.0 FORMULA_0009 -100.0000 1000.0000 FORMAT "%4.1" /end CHARACTERISTIC
/begin CHARACTERISTIC K_SMG_MOT_RAB_DM_MAX "Abbau max. Moment bei Radabriss | EN: Decay of maximum torque on wheel tear-off" VALUE 0x789CC TKW_VV_VV_SW 100.0 FORMULA_0571 -5000.0000 5000.0000 /end CHARACTERISTIC
/begin CHARACTERISTIC K_SMG_MOT_RAB_T_MAX "Maximalzeit fuer Radabriss | EN: Maximum time for wheel tear-off" VALUE 0x789CE TKW_VV_VV_UW 100.0 FORMULA_0021 0.0 655.0000 FORMAT "%5.2" /end CHARACTERISTIC
/begin CHARACTERISTIC K_SMG_MOT_ABS_N_OFF "Offset auf nGetr bei ABS-Eingriff | EN: Offset on gearbox speed during ABS intervention" VALUE 0x789D0 TKW_VV_VV_SW 100.0 FORMULA_0006 -1000.0000 10000.0000 /end CHARACTERISTIC
/begin CHARACTERISTIC K_SMG_MOT_ABS_M_MIN "min. Moment bei ABS-Eingriff | EN: Minimum torque during ABS intervention" VALUE 0x789D2 TKW_VV_VV_SW 100.0 FORMULA_0009 -100.0000 1000.0000 FORMAT "%4.1" /end CHARACTERISTIC
/begin CHARACTERISTIC K_SMG_MOT_ABS_M_MAX "max. Moment bei ABS-Eingriff | EN: Maximum torque during ABS intervention" VALUE 0x789D4 TKW_VV_VV_SW 100.0 FORMULA_0009 -100.0000 1000.0000 FORMAT "%4.1" /end CHARACTERISTIC
/begin CHARACTERISTIC K_SMG_MOT_ABS_DM_MAX "Abbau max. Moment bei ABS-Eingriff | EN: Decay of maximum torque during ABS intervention" VALUE 0x789D6 TKW_VV_VV_SW 100.0 FORMULA_0571 -5000.0000 5000.0000 /end CHARACTERISTIC
/begin CHARACTERISTIC K_SMG_MOT_ABS_T_MAX "Maximalzeit fuer ABS-Eingriff | EN: Maximum time for ABS intervention" VALUE 0x789D8 TKW_VV_VV_UW 100.0 FORMULA_0021 0.0 655.0000 FORMAT "%5.2" /end CHARACTERISTIC
/begin CHARACTERISTIC K_SMG_MOT_N_REG_I_UP "I-Anteil n-Regler Up | EN: Integral share, speed controller up" VALUE 0x789DA TKW_VV_VV_UB 100.0 FORMULA_0946 0.0 0.2550 /end CHARACTERISTIC
/begin CHARACTERISTIC K_SMG_MOT_N_REG_I_DN "I-Anteil n-Regler Down | EN: Integral share, speed controller down" VALUE 0x789DB TKW_VV_VV_UB 100.0 FORMULA_0946 0.0 0.2550 /end CHARACTERISTIC
/begin CHARACTERISTIC K_SMG_MOT_N_REG_I_SCHW "max. Regeldifferenz-Schwelle fuer I-Anteil (n-Regler) | EN: Maximum control-error threshold for integral share (speed controller)" VALUE 0x789DC TKW_VV_VV_SW 100.0 FORMULA_0006 0.0 10000.0000 /end CHARACTERISTIC
/begin CHARACTERISTIC K_SMG_MOT_N_REG_I_T "Einschaltschwelle I-Anteil | EN: Switch-on threshold, integral share" VALUE 0x789DE TKW_VV_VV_UW 100.0 FORMULA_0117 0.0 325.0000 FORMAT "%5.2" /end CHARACTERISTIC
/begin CHARACTERISTIC K_SMG_MOT_N_REG_I_T_RAB "Einschaltschwelle I-Anteil bei RAB | EN: Switch-on threshold, integral share during roll-back" VALUE 0x789E0 TKW_VV_VV_UW 100.0 FORMULA_0117 0.0 325.0000 FORMAT "%5.2" /end CHARACTERISTIC
/begin CHARACTERISTIC K_SMG_MOT_N_REG_M_STG "max. Moment fuer Stoerrgroessenaufschaltung | EN: Maximum torque for disturbance feed-forward" VALUE 0x789E2 TKW_VV_VV_SW 100.0 FORMULA_0009 -100.0000 1000.0000 FORMAT "%4.1" /end CHARACTERISTIC
/begin CHARACTERISTIC K_SMG_MOT_N_REG_D_MIN "min. Regeldifferenz fuer D-Anteil | EN: Minimum control error for derivative share" VALUE 0x789E4 TKW_VV_VV_SW 100.0 FORMULA_0006 0.0 10000.0000 /end CHARACTERISTIC
/begin CHARACTERISTIC K_SMG_MOT_N_REG_D_MAX "max. Regeldifferenz fuer D-Anteil | EN: Maximum control error for derivative share" VALUE 0x789E6 TKW_VV_VV_SW 100.0 FORMULA_0006 0.0 10000.0000 /end CHARACTERISTIC
/begin CHARACTERISTIC K_SMG_MOT_N_REG_M_MAX "max. Reglermoment im Aufregeln | EN: Maximum controller torque during ramp-up" VALUE 0x789E8 TKW_VV_VV_SW 100.0 FORMULA_0009 -100.0000 1000.0000 FORMAT "%4.1" /end CHARACTERISTIC
/begin CHARACTERISTIC K_SMG_MOT_N_REG_T_MAX "Abregelzeit max. Reglermoment | EN: Ramp-down time of maximum controller torque" VALUE 0x789EA TKW_VV_VV_UW 100.0 FORMULA_0117 0.0050 325.0000 FORMAT "%5.2" /end CHARACTERISTIC
/begin CHARACTERISTIC K_SMG_MOT_N_REG_M_BEGR "v-Schwelle fuer Begrenzung | EN: Speed threshold for limitation" VALUE 0x789EC TKW_VV_VV_SW 100.0 FORMULA_0078 -80.0000 360.0000 FORMAT "%4.1" /end CHARACTERISTIC
/begin CHARACTERISTIC K_SMG_MOT_ANF_N_OFF "Drehzahloffset auf Anfahrdrehzahl | EN: Speed offset on pull-away speed" VALUE 0x789EE TKW_VV_VV_SW 100.0 FORMULA_0006 0.0 10000.0000 /end CHARACTERISTIC
/begin CHARACTERISTIC K_SMG_MOT_ANF_FW_X "Abregelfaktor Anfahrdrehzahl | EN: Ramp-down factor, pull-away speed" VALUE 0x789F0 TKW_VV_VV_SW 100.0 FORMULA_0006 0.0 10000.0000 /end CHARACTERISTIC
/begin CHARACTERISTIC K_SMG_MOT_ANF_M_MIN "Erkennung Anfahren aus Schalten | EN: Detection of pull-away from a shift" VALUE 0x789F2 TKW_VV_VV_SW 100.0 FORMULA_0009 -100.0000 1000.0000 FORMAT "%4.1" /end CHARACTERISTIC
/begin CHARACTERISTIC K_SMG_MOT_ANF_DM_DSC "Rampe bei DSC-Anfahrt | EN: Ramp for DSC pull-away" VALUE 0x789F4 TKW_VV_VV_SW 100.0 FORMULA_0571 -5000.0000 5000.0000 /end CHARACTERISTIC
/begin CHARACTERISTIC K_SMG_MOT_RS_N_SCHW "n-Abbruchschwelle Rennstart | EN: Speed abort threshold, race start" VALUE 0x789F6 TKW_VV_VV_SW 100.0 FORMULA_0006 0.0 10000.0000 /end CHARACTERISTIC
/begin CHARACTERISTIC K_SMG_MOT_RS_S_SCHW "Schlupf-Abbruchsschwelle Rennstart | EN: Slip abort threshold, race start" VALUE 0x789F8 TKW_VV_VV_SW 100.0 FORMULA_0949 -100.0000 100.0000 /end CHARACTERISTIC
/begin CHARACTERISTIC K_SMG_MOT_RS_N_OFF "Offset auf RS-Anfahrdrehzahl | EN: Offset on race-start pull-away speed" VALUE 0x789FA TKW_VV_VV_SW 100.0 FORMULA_0006 0.0 10000.0000 /end CHARACTERISTIC
/begin CHARACTERISTIC K_SMG_MOT_RS_T_LO "Lowzeit | EN: Low time" VALUE 0x789FC TKW_VV_VV_UW 100.0 FORMULA_0117 0.0050 325.0000 FORMAT "%5.2" /end CHARACTERISTIC
/begin CHARACTERISTIC K_SMG_MOT_RS_T_HI "Highzeit | EN: High time" VALUE 0x789FE TKW_VV_VV_UW 100.0 FORMULA_0117 0.0050 325.0000 FORMAT "%5.2" /end CHARACTERISTIC
/begin CHARACTERISTIC K_SMG_MOT_RS_TI_TIME "Zeit fuer TI-Eingriff | EN: Time for injection intervention" VALUE 0x78A00 TKW_VV_VV_UW 100.0 FORMULA_0117 0.0 325.0000 FORMAT "%5.2" /end CHARACTERISTIC
/begin CHARACTERISTIC K_SMG_MOT_RS_TI_TABG "max. TABG fuer TI-Eingriff | EN: Maximum exhaust temperature for injection intervention" VALUE 0x78A02 TKW_VV_VV_SW 100.0 FORMULA_0023 -50.0000 1000.0000 FORMAT "%4.1" /end CHARACTERISTIC
/begin CHARACTERISTIC K_SMG_MOT_RSS_MD_EINGR "Config-Rennstartschaltung | EN: Race-start (launch) configuration" VALUE 0x78A04 TKW_VV_VV_UB 100.0 FORMULA_0950 0.0 255.0 /end CHARACTERISTIC
/begin CHARACTERISTIC K_SMG_MOT_AKS_N_SCHW "max. Differenz zu nBegr fuer AKS | EN: Maximum difference to rev limit for auto-upshift" VALUE 0x78A06 TKW_VV_VV_SW 100.0 FORMULA_0006 0.0 10000.0000 /end CHARACTERISTIC
/begin CHARACTERISTIC K_SMG_MOT_M_RES_POS_MAX "Start Moment pos. Reserve | EN: Start torque for positive reserve" VALUE 0x78A08 TKW_VV_VV_SW 100.0 FORMULA_0009 -100.0000 1000.0000 FORMAT "%4.1" /end CHARACTERISTIC
/begin CHARACTERISTIC K_SMG_MOT_M_RES_POS_N "Start Drehzahl pos. Reserve | EN: Start engine speed for positive reserve" VALUE 0x78A0A TKW_VV_VV_SW 100.0 FORMULA_0006 0.0 10000.0000 /end CHARACTERISTIC
/begin CHARACTERISTIC K_SMG_BERG_V_MIN_SCHW "min. v-Schwelle Bergerkennung | EN: Minimum speed threshold for hill detection" VALUE 0x78A0C TKW_VV_VV_SW 100.0 FORMULA_0078 -80.0000 360.0000 FORMAT "%4.1" /end CHARACTERISTIC
/begin CHARACTERISTIC K_SMG_BERG_V_MAX_SCHW "max. v-Schwelle Bergerkennung | EN: Maximum speed threshold for hill detection" VALUE 0x78A0E TKW_VV_VV_SW 100.0 FORMULA_0078 -80.0000 360.0000 FORMAT "%4.1" /end CHARACTERISTIC
/begin CHARACTERISTIC K_SMG_BERG_MD_KW_SCHW "Md-Schwelle Bergerkennung | EN: Torque threshold for hill detection" VALUE 0x78A10 TKW_VV_VV_SW 100.0 FORMULA_0009 -100.0000 1000.0000 FORMAT "%4.1" /end CHARACTERISTIC
/begin CHARACTERISTIC K_SMG_ADAPT_SP_TOEL "Toel-Sperre fuer Kupplungsadaption | EN: Oil-temperature lock for clutch adaptation" VALUE 0x78A12 TKW_VV_VV_SW 100.0 FORMULA_0023 -50.0000 170.0000 FORMAT "%4.1" /end CHARACTERISTIC
/begin CHARACTERISTIC K_SMG_ADAPT_SP_DMD_FW "Gradient-Sperre fuer Kupplungsadaption | EN: Gradient lock for clutch adaptation" VALUE 0x78A14 TKW_VV_VV_SW 100.0 FORMULA_0571 -5000.0000 5000.0000 /end CHARACTERISTIC
/begin CHARACTERISTIC K_SMG_ADAPT_SP_DM_MAX "zulaessige Abweichung fuer Kupplungsadaption | EN: Permitted deviation for clutch adaptation" VALUE 0x78A16 TKW_VV_VV_SW 100.0 FORMULA_0009 -100.0000 1000.0000 FORMAT "%4.1" /end CHARACTERISTIC
/begin CHARACTERISTIC K_SMG_ADAPT_SP_N_MIN "min. Drehzahl fuer Kupplungsadaption | EN: Minimum engine speed for clutch adaptation" VALUE 0x78A18 TKW_VV_VV_SW 100.0 FORMULA_0006 0.0 10000.0000 /end CHARACTERISTIC
/begin CHARACTERISTIC K_SMG_ADAPT_SP_N_MAX "max. Drehzahl fuer Kupplungsadaption | EN: Maximum engine speed for clutch adaptation" VALUE 0x78A1A TKW_VV_VV_SW 100.0 FORMULA_0006 0.0 10000.0000 /end CHARACTERISTIC
/begin CHARACTERISTIC K_SMG_OHNE_EINGR_OFF "Offset auf sa_n_we | EN: Offset on sa_n_we" VALUE 0x78A1C TKW_VV_VV_SW 100.0 FORMULA_0006 0.0 10000.0000 /end CHARACTERISTIC
/begin CHARACTERISTIC K_SMG_I_GANG_R "Gang�bersetzung | EN: Gear ratio" VALUE 0x78A1E TKW_VV_VV_UW 100.0 FORMULA_0075 0.0 4.0000 FORMAT "%6.3" /end CHARACTERISTIC
/begin CHARACTERISTIC K_SMG_I_GANG_N "Gang�bersetzung | EN: Gear ratio" VALUE 0x78A20 TKW_VV_VV_UW 100.0 FORMULA_0075 0.0 4.0000 FORMAT "%6.3" /end CHARACTERISTIC
/begin CHARACTERISTIC K_SMG_I_GANG_1 "Gang�bersetzung | EN: Gear ratio" VALUE 0x78A22 TKW_VV_VV_UW 100.0 FORMULA_0075 0.0 4.0000 FORMAT "%6.3" /end CHARACTERISTIC
/begin CHARACTERISTIC K_SMG_I_GANG_2 "Gang�bersetzung | EN: Gear ratio" VALUE 0x78A24 TKW_VV_VV_UW 100.0 FORMULA_0075 0.0 4.0000 FORMAT "%6.3" /end CHARACTERISTIC
/begin CHARACTERISTIC K_SMG_I_GANG_3 "Gang�bersetzung | EN: Gear ratio" VALUE 0x78A26 TKW_VV_VV_UW 100.0 FORMULA_0075 0.0 4.0000 FORMAT "%6.3" /end CHARACTERISTIC
/begin CHARACTERISTIC K_SMG_I_GANG_4 "Gang�bersetzung | EN: Gear ratio" VALUE 0x78A28 TKW_VV_VV_UW 100.0 FORMULA_0075 0.0 4.0000 FORMAT "%6.3" /end CHARACTERISTIC
/begin CHARACTERISTIC K_SMG_I_GANG_5 "Gang�bersetzung | EN: Gear ratio" VALUE 0x78A2A TKW_VV_VV_UW 100.0 FORMULA_0075 0.0 4.0000 FORMAT "%6.3" /end CHARACTERISTIC
/begin CHARACTERISTIC K_SMG_I_GANG_6 "Gang�bersetzung | EN: Gear ratio" VALUE 0x78A2C TKW_VV_VV_UW 100.0 FORMULA_0075 0.0 4.0000 FORMAT "%6.3" /end CHARACTERISTIC
/begin CHARACTERISTIC K_SMG_I_GANG_7 "Gang�bersetzung | EN: Gear ratio" VALUE 0x78A2E TKW_VV_VV_UW 100.0 FORMULA_0075 0.0 4.0000 FORMAT "%6.3" /end CHARACTERISTIC
/begin CHARACTERISTIC K_SMG_I_HA "Hinterachsuebersetzung | EN: Rear-axle ratio" VALUE 0x78A30 TKW_VV_VV_UW 100.0 FORMULA_0075 0.0 4.0000 FORMAT "%6.3" /end CHARACTERISTIC
/begin CHARACTERISTIC K_SMG_R_DYN "Reifenradius | EN: Tyre radius" VALUE 0x78A32 TKW_VV_VV_UB 100.0 FORMULA_0951 0.0 100.0000 /end CHARACTERISTIC
/begin CHARACTERISTIC K_SMG_SK_CONTROL "SK-Config | EN: Safety-concept configuration" VALUE 0x78A33 TKW_VV_VV_UB 100.0 FORMULA_0952 0.0 255.0 /end CHARACTERISTIC
/begin CHARACTERISTIC K_SMG_SK_T_PHASE_MAX_AB "max. Zeit | EN: Maximum time" VALUE 0x78A34 TKW_VV_VV_UW 100.0 FORMULA_0021 0.0 655.0000 FORMAT "%5.2" /end CHARACTERISTIC
/begin CHARACTERISTIC K_SMG_SK_T_PHASE_MAX_SCHA "max. Zeit | EN: Maximum time" VALUE 0x78A36 TKW_VV_VV_UW 100.0 FORMULA_0021 0.0 655.0000 FORMAT "%5.2" /end CHARACTERISTIC
/begin CHARACTERISTIC K_SMG_SK_T_PHASE_MAX_AUF "max. Zeit | EN: Maximum time" VALUE 0x78A38 TKW_VV_VV_UW 100.0 FORMULA_0021 0.0 655.0000 FORMAT "%5.2" /end CHARACTERISTIC
/begin CHARACTERISTIC K_SMG_SK_T_PHASE_N_MAX "max. Zeit Nmax-Ueberschreitung | EN: Maximum time for Nmax exceedance" VALUE 0x78A3A TKW_VV_VV_UW 100.0 FORMULA_0021 0.0 655.0000 FORMAT "%5.2" /end CHARACTERISTIC
/begin CHARACTERISTIC K_SMG_SK_T_MAX "Zeitschwelle CAN-Fehlerkennung | EN: Time threshold, CAN fault detection" VALUE 0x78A3C TKW_VV_VV_UB 100.0 FORMULA_0317 0.0 2.5500 /end CHARACTERISTIC
/begin CHARACTERISTIC K_SMG_SK_T_DME_ST_MAX "Zeitschwelle Statuscheck | EN: Time threshold, status check" VALUE 0x78A3D TKW_VV_VV_UB 100.0 FORMULA_0317 0.0 2.5500 /end CHARACTERISTIC
/begin CHARACTERISTIC K_SMG_SK_NBERCH_T "Zeitschwelle nBerech | EN: Time threshold nBerech" VALUE 0x78A3E TKW_VV_VV_UB 100.0 FORMULA_0317 0.0 2.5500 /end CHARACTERISTIC
/begin CHARACTERISTIC K_SMG_SK_NBERCH_MAX "Drehzahlschwelle nBerech | EN: Engine-speed threshold nBerech (calculated speed)" VALUE 0x78A40 TKW_VV_VV_SW 100.0 FORMULA_0006 0.0 10000.0000 /end CHARACTERISTIC
/begin CHARACTERISTIC K_SMG_SK_NZIEL_T "Zeitschwelle nZiel | EN: Time threshold, target speed" VALUE 0x78A42 TKW_VV_VV_UB 100.0 FORMULA_0317 0.0 2.5500 /end CHARACTERISTIC
/begin CHARACTERISTIC K_SMG_SK_NZIEL_MAX "Drehzahlschwelle nZiel | EN: Engine-speed threshold, target speed" VALUE 0x78A44 TKW_VV_VV_SW 100.0 FORMULA_0006 0.0 10000.0000 /end CHARACTERISTIC
/begin CHARACTERISTIC K_SMG_SK_NGETR_T "Zeitschwelle nGetr | EN: Time threshold, gearbox speed" VALUE 0x78A46 TKW_VV_VV_UB 100.0 FORMULA_0317 0.0 2.5500 /end CHARACTERISTIC
/begin CHARACTERISTIC K_SMG_SK_NGETR_MAX "Drehzahlschwelle nGetr | EN: Engine-speed threshold, gearbox speed" VALUE 0x78A48 TKW_VV_VV_SW 100.0 FORMULA_0006 0.0 10000.0000 /end CHARACTERISTIC
/begin CHARACTERISTIC K_SMG_SK_T_NGETR_MAX "Zeitschwelle max. nGetr | EN: Time threshold, maximum gearbox speed" VALUE 0x78A4A TKW_VV_VV_UB 100.0 FORMULA_0317 0.0 2.5500 /end CHARACTERISTIC
/begin CHARACTERISTIC K_SMG_SK_T_NZIEL_MAX "Zeitschwelle max. nZiel | EN: Time threshold, maximum target speed" VALUE 0x78A4B TKW_VV_VV_UB 100.0 FORMULA_0317 0.0 2.5500 /end CHARACTERISTIC
/begin CHARACTERISTIC K_SMG_SK_M_KUPP_MIN "max. Kupplungsmoment bei AK | EN: Maximum clutch torque at AK" VALUE 0x78A4C TKW_VV_VV_SW 100.0 FORMULA_0009 -100.0000 1000.0000 FORMAT "%4.1" /end CHARACTERISTIC
/begin CHARACTERISTIC K_SMG_SK_NMAX_FSP_INAKTIV "Nmax-Schwelle ausserhalb Schaltung | EN: Nmax threshold outside shift" VALUE 0x78A4E TKW_VV_VV_SW 100.0 FORMULA_0006 0.0 10000.0000 /end CHARACTERISTIC
/begin CHARACTERISTIC K_SMG_SK_NMAX_FSP "Nmax-Schwelle innerhalb Schaltung | EN: Nmax threshold during shift" VALUE 0x78A50 TKW_VV_VV_SW 100.0 FORMULA_0006 0.0 10000.0000 /end CHARACTERISTIC
/begin CHARACTERISTIC K_SMG_SK_V_SCHW "v-Diagnoseschwelle | EN: Vehicle-speed diagnosis threshold" VALUE 0x78A52 TKW_VV_VV_SW 100.0 FORMULA_0078 -80.0000 360.0000 FORMAT "%4.1" /end CHARACTERISTIC
/begin CHARACTERISTIC K_SMG_SK_MD_SCHW "Md-Diagnoseschwelle | EN: Torque diagnosis threshold" VALUE 0x78A54 TKW_VV_VV_SW 100.0 FORMULA_0009 -100.0000 1000.0000 FORMAT "%4.1" /end CHARACTERISTIC
/begin CHARACTERISTIC K_SMG_ADAPT_IHAR_CNT "Counter IHAR-Adaption | EN: Counter, rear-axle ratio adaptation" VALUE 0x78A56 TKW_VV_VV_UB 100.0 FORMULA_0033 0.0 255.0000 /end CHARACTERISTIC
/begin CHARACTERISTIC K_SMG_ADAPT_IHAR_MIN "min. IHAR-Uebersetzung | EN: Minimum rear-axle ratio" VALUE 0x78A58 TKW_VV_VV_UW 100.0 FORMULA_0075 0.0 4.0000 FORMAT "%6.3" /end CHARACTERISTIC
/begin CHARACTERISTIC K_SMG_ADAPT_IHAR_MAX "max. IHAR-Uebersetzung | EN: Maximum rear-axle ratio" VALUE 0x78A5A TKW_VV_VV_UW 100.0 FORMULA_0075 0.0 4.0000 FORMAT "%6.3" /end CHARACTERISTIC
/begin CHARACTERISTIC K_SMG_ADAPT_IHAR_DFLT "Default IHAR-Uebersetzung | EN: Default rear-axle ratio" VALUE 0x78A5C TKW_VV_VV_UW 100.0 FORMULA_0075 0.0 4.0000 FORMAT "%6.3" /end CHARACTERISTIC
/begin CHARACTERISTIC KL_SMG_PROG_MANUELL "Manuelle Programme | EN: Manual programs" CURVE 0x78A5E TKL_UB_VV_UB 100.0 FORMULA_0003 0.0 8.0000 /begin AXIS_DESCR STD_AXIS canP FORMULA_0003 6 0.0 6.0000 /end AXIS_DESCR /end CHARACTERISTIC
/begin CHARACTERISTIC KL_SMG_PROG_AUTOMAT "Automat-Programme | EN: Automatic programs" CURVE 0x78A6C TKL_UB_VV_UB 100.0 FORMULA_0003 0.0 8.0000 /begin AXIS_DESCR STD_AXIS canP FORMULA_0003 6 0.0 6.0000 /end AXIS_DESCR /end CHARACTERISTIC
/begin CHARACTERISTIC KL_SMG_SK_PROG_MAX "max. Programme bei SK-Begr | EN: Maximum programs with safety-concept limit" CURVE 0x78A7A TKL_UB_VV_UB 100.0 FORMULA_0003 0.0 8.0000 /begin AXIS_DESCR STD_AXIS sk_stufe FORMULA_0003 6 0.0 6.0000 /end AXIS_DESCR /end CHARACTERISTIC
/begin CHARACTERISTIC KL_SMG_T_KORR_AB "Faktor fuer Korrektur | EN: Correction factor" CURVE 0x78A88 TKL_UB_VV_UB 100.0 FORMULA_0926 0.0 199.2187 /begin AXIS_DESCR STD_AXIS rel_fw FORMULA_0926 6 0.0 199.2187 /end AXIS_DESCR /end CHARACTERISTIC
/begin CHARACTERISTIC KL_SMG_N_ABRISS_SCHW "Schwelle fuer Abriss | EN: Threshold for tear-off (wheel slip)" CURVE 0x78A96 TKL_SW_VV_SW 100.0 FORMULA_0006 0.0 10000.0000
 /begin AXIS_DESCR STD_AXIS md_kw FORMULA_0009 4 -100.0000 1000.0000 FORMAT "%4.1" /end AXIS_DESCR
/end CHARACTERISTIC
/begin CHARACTERISTIC KL_SMG_FW_REL_VIRT "virt. Fahrerwunsch | EN: Virtual driver demand" CURVE 0x78AA8 TKL_SW_VV_UB 100.0 FORMULA_0704 0.0 1.9921
 /begin AXIS_DESCR STD_AXIS rschlupf FORMULA_0917 4 -100.0000 100.0000 FORMAT "%5.2" /end AXIS_DESCR
/end CHARACTERISTIC
/begin CHARACTERISTIC KL_SMG_KI_DAY_MAX "max. Zunahme ay | EN: Maximum increase of lateral acceleration" CURVE 0x78AB6 TKL_SW_VV_UB 100.0 FORMULA_0003 0.0 15.0000 /begin AXIS_DESCR STD_AXIS day FORMULA_0132 3 -20.0000 20.0000 FORMAT "%5.2" /end AXIS_DESCR /end CHARACTERISTIC
/begin CHARACTERISTIC KL_SMG_KI_AKS_GANG "maximale KI ueber Ziel-Gang | EN: Maximum shift index over target gear" CURVE 0x78AC2 TKL_SB_VV_UB 100.0 FORMULA_0003 0.0 255.0000 /begin AXIS_DESCR STD_AXIS istgang FORMULA_0003 7 -128.0000 127.0000 /end AXIS_DESCR /end CHARACTERISTIC
/begin CHARACTERISTIC KL_SMG_KUPP_M_AB_ZH "Abregel-Kennlinie ZugHoch | EN: Ramp-down curve, traction upshift" CURVE 0x78AD2 TKL_UB_VV_UB 100.0 FORMULA_0953 0.0 199.2187 /begin AXIS_DESCR STD_AXIS t_norm FORMULA_0954 8 0.0 199.2187 /end AXIS_DESCR /end CHARACTERISTIC
/begin CHARACTERISTIC KL_SMG_KUPP_M_AB_ZR "Abregel-Kennlinie ZugRueck | EN: Ramp-down curve, traction downshift" CURVE 0x78AE4 TKL_UB_VV_UB 100.0 FORMULA_0953 0.0 199.2187 /begin AXIS_DESCR STD_AXIS t_norm FORMULA_0954 8 0.0 199.2187 /end AXIS_DESCR /end CHARACTERISTIC
/begin CHARACTERISTIC KL_SMG_KUPP_M_AB_SH "Abregel-Kennlinie SchubHoch | EN: Ramp-down curve, overrun upshift" CURVE 0x78AF6 TKL_UB_VV_UB 100.0 FORMULA_0953 0.0 199.2187 /begin AXIS_DESCR STD_AXIS t_norm FORMULA_0954 8 0.0 199.2187 /end AXIS_DESCR /end CHARACTERISTIC
/begin CHARACTERISTIC KL_SMG_KUPP_M_AB_SR "Abregel-Kennlinie SchubRueck | EN: Ramp-down curve, overrun downshift" CURVE 0x78B08 TKL_UB_VV_UB 100.0 FORMULA_0953 0.0 199.2187 /begin AXIS_DESCR STD_AXIS t_norm FORMULA_0954 8 0.0 199.2187 /end AXIS_DESCR /end CHARACTERISTIC
/begin CHARACTERISTIC KL_SMG_KUPP_M_AB_ANF "Abregel-Kennlinie nach Anfahren | EN: Ramp-down curve after pull-away" CURVE 0x78B1A TKL_UB_VV_UB 100.0 FORMULA_0953 0.0 199.2187 /begin AXIS_DESCR STD_AXIS t_norm FORMULA_0954 6 0.0 199.2187 /end AXIS_DESCR /end CHARACTERISTIC
/begin CHARACTERISTIC KL_SMG_KUPP_M_AUF_Z1 "Aufregel-Kennlinie Zug | EN: Ramp-up curve, traction" CURVE 0x78B28 TKL_UB_VV_UB 100.0 FORMULA_0953 0.0 100.0000 /begin AXIS_DESCR STD_AXIS t_norm FORMULA_0954 8 0.0 199.2187 /end AXIS_DESCR /end CHARACTERISTIC
/begin CHARACTERISTIC KL_SMG_KUPP_M_AUF_S1 "Aufregel-Kennlinie Schub | EN: Ramp-up curve, overrun" CURVE 0x78B3A TKL_UB_VV_UB 100.0 FORMULA_0953 0.0 100.0000 /begin AXIS_DESCR STD_AXIS t_norm FORMULA_0954 8 0.0 199.2187 /end AXIS_DESCR /end CHARACTERISTIC
/begin CHARACTERISTIC KL_SMG_KUPP_M_AUF_KI "Offset auf Aufregelrampe | EN: Offset on ramp-up ramp" CURVE 0x78B4C TKL_UB_VV_UB 100.0 FORMULA_0953 0.0 50.0000 /begin AXIS_DESCR STD_AXIS ki_auf FORMULA_0003 4 0.0 12.0000 /end AXIS_DESCR /end CHARACTERISTIC
/begin CHARACTERISTIC KL_SMG_KUPP_M_AUF_OFF "Kupplungsoffset beim Aufregeln | EN: Clutch offset during ramp-up" CURVE 0x78B56 TKL_UB_VV_UB 100.0 FORMULA_0749 0.0 25.5000 /begin AXIS_DESCR STD_AXIS t_norm FORMULA_0954 8 0.0 199.2187 /end AXIS_DESCR /end CHARACTERISTIC
/begin CHARACTERISTIC KL_SMG_KUPP_REG_I_F "Faktor fuer Rampe und Regler | EN: Factor for ramp and controller" CURVE 0x78B68 TKL_SW_VV_UW 100.0 FORMULA_0955 1.0000 10.0000
 /begin AXIS_DESCR STD_AXIS vor1 FORMULA_0009 3 -100.0000 1000.0000 FORMAT "%4.1" /end AXIS_DESCR
 FORMAT "%4.1" /end CHARACTERISTIC
/begin CHARACTERISTIC KL_SMG_KUPP_M_AB_OFF "Offset auf Fahrer beim Abregeln | EN: Offset on driver demand during ramp-down" CURVE 0x78B76 TKL_SW_VV_SW 100.0 FORMULA_0009 -100.0000 1000.0000
 /begin AXIS_DESCR STD_AXIS md_fw FORMULA_0009 3 -100.0000 1000.0000 FORMAT "%4.1" /end AXIS_DESCR
 FORMAT "%4.1" /end CHARACTERISTIC
/begin CHARACTERISTIC KL_SMG_KUPP_UL_DN_POS "Gradientenschwelle Ueberlastschutz | EN: Gradient threshold, overload protection" CURVE 0x78B84 TKL_SW_VV_SW 100.0 FORMULA_0114 0.0 10000.0000 /begin AXIS_DESCR STD_AXIS n_diff FORMULA_0006 3 0.0 10000.0000 /end AXIS_DESCR /end CHARACTERISTIC
/begin CHARACTERISTIC KL_SMG_MOT_M_AB_ZH "Abregel-Kennlinie ZugHoch | EN: Ramp-down curve, traction upshift" CURVE 0x78B92 TKL_UB_VV_UB 100.0 FORMULA_0953 0.0 199.2187 /begin AXIS_DESCR STD_AXIS t_norm FORMULA_0954 8 0.0 199.2187 /end AXIS_DESCR /end CHARACTERISTIC
/begin CHARACTERISTIC KL_SMG_MOT_M_AB_ZR "Abregel-Kennlinie ZugRueck | EN: Ramp-down curve, traction downshift" CURVE 0x78BA4 TKL_UB_VV_UB 100.0 FORMULA_0953 0.0 199.2187 /begin AXIS_DESCR STD_AXIS t_norm FORMULA_0954 8 0.0 199.2187 /end AXIS_DESCR /end CHARACTERISTIC
/begin CHARACTERISTIC KL_SMG_MOT_M_AB_SH "Abregel-Kennlinie SchubHoch | EN: Ramp-down curve, overrun upshift" CURVE 0x78BB6 TKL_UB_VV_UB 100.0 FORMULA_0953 0.0 199.2187 /begin AXIS_DESCR STD_AXIS t_norm FORMULA_0954 8 0.0 199.2187 /end AXIS_DESCR /end CHARACTERISTIC
/begin CHARACTERISTIC KL_SMG_MOT_M_AB_SR "Abregel-Kennlinie SchubRueck | EN: Ramp-down curve, overrun downshift" CURVE 0x78BC8 TKL_UB_VV_UB 100.0 FORMULA_0953 0.0 199.2187 /begin AXIS_DESCR STD_AXIS t_norm FORMULA_0954 8 0.0 199.2187 /end AXIS_DESCR /end CHARACTERISTIC
/begin CHARACTERISTIC KL_SMG_MOT_VOR_2_KI "Faktor fuer Vorsteuerung 2 | EN: Factor for pre-control 2" CURVE 0x78BDA TKL_UB_VV_UB 100.0 FORMULA_0704 0.0 1.9921 /begin AXIS_DESCR STD_AXIS FORMULA_0003 4 0.0 12.0000 /end AXIS_DESCR /end CHARACTERISTIC
/begin CHARACTERISTIC KL_SMG_N_ZIEL_OFF_MAX "maximaler Offsetfaktor | EN: Maximum offset factor" CURVE 0x78BE4 TKL_SW_VV_UB 100.0 FORMULA_0956 0.0 100.0000 /begin AXIS_DESCR STD_AXIS FORMULA_0023 4 -50.0000 170.0000 FORMAT "%4.1" /end AXIS_DESCR /end CHARACTERISTIC
/begin CHARACTERISTIC KL_SMG_N_ZIEL_OFF_ANF "Offset auf n-Anfahr | EN: Offset on pull-away speed" CURVE 0x78BF2 TKL_SW_VV_SW 100.0 FORMULA_0006 0.0 10000.0000 /begin AXIS_DESCR STD_AXIS FORMULA_0001 3 -10.0000 120.0000 FORMAT "%4.1" /end AXIS_DESCR /end CHARACTERISTIC
/begin CHARACTERISTIC KL_SMG_N_ZIEL_OFF_LL "Offset auf nLL | EN: Offset on idle speed" CURVE 0x78C00 TKL_SW_VV_SW 100.0 FORMULA_0006 0.0 10000.0000 /begin AXIS_DESCR STD_AXIS FORMULA_0001 3 -10.0000 120.0000 FORMAT "%4.1" /end AXIS_DESCR /end CHARACTERISTIC
/begin CHARACTERISTIC KL_SMG_MOT_N_REG_P_UP "P-Anteil UP | EN: P share UP" CURVE 0x78C0E TKL_SW_VV_UB 100.0 FORMULA_0957 0.0 2.5500 /begin AXIS_DESCR STD_AXIS n_soll FORMULA_0006 6 0.0 10000.0000 /end AXIS_DESCR /end CHARACTERISTIC
/begin CHARACTERISTIC KL_SMG_MOT_N_REG_P_DN "P-Anteil DOWN | EN: P share DOWN" CURVE 0x78C22 TKL_SW_VV_UB 100.0 FORMULA_0957 0.0 2.5500 /begin AXIS_DESCR STD_AXIS n_soll FORMULA_0006 6 0.0 10000.0000 /end AXIS_DESCR /end CHARACTERISTIC
/begin CHARACTERISTIC KL_SMG_MOT_N_REG_D_UP "D-Anteil UP | EN: Derivative share UP" CURVE 0x78C36 TKL_SW_VV_UB 100.0 FORMULA_0958 0.0 25.5000 /begin AXIS_DESCR STD_AXIS n_soll FORMULA_0006 6 0.0 10000.0000 /end AXIS_DESCR /end CHARACTERISTIC
/begin CHARACTERISTIC KL_SMG_MOT_N_REG_D_DN "D-Anteil DOWN | EN: Derivative share DOWN" CURVE 0x78C4A TKL_SW_VV_UB 100.0 FORMULA_0958 0.0 25.5000 /begin AXIS_DESCR STD_AXIS n_soll FORMULA_0006 6 0.0 10000.0000 /end AXIS_DESCR /end CHARACTERISTIC
/begin CHARACTERISTIC KL_SMG_MOT_DN_SOLL "Betrag Sollgradient | EN: Magnitude of target gradient" CURVE 0x78C5E TKL_SW_VV_SW 100.0 FORMULA_0114 -10000.0000 10000.0000 /begin AXIS_DESCR STD_AXIS n_diff FORMULA_0006 6 0.0 10000.0000 /end AXIS_DESCR /end CHARACTERISTIC
/begin CHARACTERISTIC KL_SMG_MOT_DN_REG_P "P-Anteil Gradientenreglers | EN: P share of gradient controller" CURVE 0x78C78 TKL_SW_VV_UB 100.0 FORMULA_0959 0.0 0.2550 /begin AXIS_DESCR STD_AXIS n_diff FORMULA_0006 4 0.0 10000.0000 /end AXIS_DESCR /end CHARACTERISTIC
/begin CHARACTERISTIC KL_SMG_MOT_J_MOTOR "Faktor fuer Vorst 2 | EN: Factor for pre-control 2" CURVE 0x78C86 TKL_SW_VV_UB 100.0 FORMULA_0939 0.0 1.9921 /begin AXIS_DESCR STD_AXIS n_ziel FORMULA_0006 3 0.0 10000.0000 /end AXIS_DESCR /end CHARACTERISTIC
/begin CHARACTERISTIC KL_SMG_MOT_M_VOR_AUF "Motor-Vorausschau | EN: Engine look-ahead" CURVE 0x78C92 TKL_SW_VV_UB 100.0 FORMULA_0317 0.0 2.5500 /begin AXIS_DESCR STD_AXIS FORMULA_0006 4 0.0 10000.0000 /end AXIS_DESCR /end CHARACTERISTIC
/begin CHARACTERISTIC KL_SMG_N_ZIEL_OFF_ZR "Offset bei ZR | EN: Offset during traction downshift" CURVE 0x78CA0 TKL_UW_VV_SW 100.0 FORMULA_0006 0.0 10000.0000 /begin AXIS_DESCR STD_AXIS ki FORMULA_0010 3 0.0 65535.0000 /end AXIS_DESCR /end CHARACTERISTIC
/begin CHARACTERISTIC KL_SMG_N_ZIEL_OFF_RAB "Offsetdrehzahl bei Radabriss | EN: Speed offset on wheel tear-off" CURVE 0x78CAE TKL_SW_VV_SW 100.0 FORMULA_0006 0.0 10000.0000
 /begin AXIS_DESCR STD_AXIS m_k_1 FORMULA_0009 4 -100.0000 1000.0000 FORMAT "%4.1" /end AXIS_DESCR
/end CHARACTERISTIC
/begin CHARACTERISTIC KL_SMG_MOT_M_RES_AUF "Reserve beim Aufregeln | EN: Reserve during ramp-up" CURVE 0x78CC0 TKL_SW_VV_SW 100.0 FORMULA_0009 -100.0000 1000.0000 /begin AXIS_DESCR STD_AXIS FORMULA_0009 4 -100.0000 1000.0000 FORMAT "%4.1" /end AXIS_DESCR FORMAT "%4.1" /end CHARACTERISTIC
/begin CHARACTERISTIC KL_SMG_PROG_MAX_TOEL "maximales Programm ueber Toel | EN: Maximum program over oil temperature" CURVE 0x78CD2 TKL_SW_VV_UB 100.0 FORMULA_0960 1.0000 12.0000 /begin AXIS_DESCR STD_AXIS FORMULA_0023 4 -50.0000 170.0000 FORMAT "%4.1" /end AXIS_DESCR /end CHARACTERISTIC
/begin CHARACTERISTIC KL_SMG_PROG_MIN_BERG "minimales Programm bei Steigung | EN: Minimum program on incline" CURVE 0x78CE0 TKL_SW_VV_UB 100.0 FORMULA_0960 1.0000 12.0000 /begin AXIS_DESCR STD_AXIS FORMULA_0132 4 -20.0000 20.0000 FORMAT "%5.2" /end AXIS_DESCR /end CHARACTERISTIC
/begin CHARACTERISTIC KL_SMG_MOT_N_REG_M_LW "Max. Moment beim Lastwechsel | EN: Maximum torque during load change" CURVE 0x78CEE TKL_SW_VV_SW 100.0 FORMULA_0009 -100.0000 1000.0000 /begin AXIS_DESCR STD_AXIS FORMULA_0009 4 -100.0000 1000.0000 FORMAT "%4.1" /end AXIS_DESCR FORMAT "%4.1" /end CHARACTERISTIC
/begin CHARACTERISTIC KL_SMG_MOT_N_REG_SA_DIFF "Drehzahldifferenz SA-Ausloesung | EN: Speed difference for cruise switch-off" CURVE 0x78D00 TKL_SW_VV_SW 100.0 FORMULA_0006 0.0 10000.0000 /begin AXIS_DESCR STD_AXIS FORMULA_0486 6 -1.0000 10.0000 /end AXIS_DESCR /end CHARACTERISTIC
/begin CHARACTERISTIC KF_SMG_KI_AB_K "Abregel-Index Komfort | EN: Ramp-down index, Comfort" MAP 0x78D1A TKF_SW_SW_UB 100.0 FORMULA_0003 0.0 12.0000 /begin AXIS_DESCR STD_AXIS FORMULA_0001 8 -10.0000 120.0000 FORMAT "%4.1" /end AXIS_DESCR /begin AXIS_DESCR STD_AXIS FORMULA_0006 6 0.0 10000.0000 /end AXIS_DESCR /end CHARACTERISTIC
/begin CHARACTERISTIC KF_SMG_KI_AB_S "Abregel-Index Sport | EN: Ramp-down index, Sport" MAP 0x78D68 TKF_SW_SW_UB 100.0 FORMULA_0003 0.0 12.0000 /begin AXIS_DESCR STD_AXIS FORMULA_0001 8 -10.0000 120.0000 FORMAT "%4.1" /end AXIS_DESCR /begin AXIS_DESCR STD_AXIS FORMULA_0006 6 0.0 10000.0000 /end AXIS_DESCR /end CHARACTERISTIC
/begin CHARACTERISTIC KF_SMG_KI_SCHA_K "Schalt-Index Komfort | EN: Shift index, Comfort" MAP 0x78DB6 TKF_SW_SW_UB 100.0 FORMULA_0003 0.0 14.0000 /begin AXIS_DESCR STD_AXIS FORMULA_0001 8 -10.0000 120.0000 FORMAT "%4.1" /end AXIS_DESCR /begin AXIS_DESCR STD_AXIS FORMULA_0006 6 0.0 10000.0000 /end AXIS_DESCR /end CHARACTERISTIC
/begin CHARACTERISTIC KF_SMG_KI_SCHA_S "Schalt-Index Sport | EN: Shift index, Sport" MAP 0x78E04 TKF_SW_SW_UB 100.0 FORMULA_0003 0.0 14.0000 /begin AXIS_DESCR STD_AXIS FORMULA_0001 8 -10.0000 120.0000 FORMAT "%4.1" /end AXIS_DESCR /begin AXIS_DESCR STD_AXIS FORMULA_0006 6 0.0 10000.0000 /end AXIS_DESCR /end CHARACTERISTIC
/begin CHARACTERISTIC KF_SMG_KI_AUF_K "Aufregel-Index Komfort | EN: Ramp-up index, Comfort" MAP 0x78E52 TKF_SW_SW_UB 100.0 FORMULA_0003 0.0 12.0000 /begin AXIS_DESCR STD_AXIS FORMULA_0001 8 -10.0000 120.0000 FORMAT "%4.1" /end AXIS_DESCR /begin AXIS_DESCR STD_AXIS FORMULA_0006 6 0.0 10000.0000 /end AXIS_DESCR /end CHARACTERISTIC
/begin CHARACTERISTIC KF_SMG_KI_AUF_S "Aufregel-Index Sport | EN: Ramp-up index, Sport" MAP 0x78EA0 TKF_SW_SW_UB 100.0 FORMULA_0003 0.0 12.0000 /begin AXIS_DESCR STD_AXIS FORMULA_0001 8 -10.0000 120.0000 FORMAT "%4.1" /end AXIS_DESCR /begin AXIS_DESCR STD_AXIS FORMULA_0006 6 0.0 10000.0000 /end AXIS_DESCR /end CHARACTERISTIC
/begin CHARACTERISTIC KF_SMG_KI_AB_SCH_K "Abregel-Index Schub Komfort | EN: Ramp-down index, overrun, Comfort" MAP 0x78EEE TKF_SW_SW_UB 100.0 FORMULA_0003 0.0 12.0000 /begin AXIS_DESCR STD_AXIS FORMULA_0132 5 -20.0000 20.0000 FORMAT "%5.2" /end AXIS_DESCR /begin AXIS_DESCR STD_AXIS FORMULA_0006 6 0.0 10000.0000 /end AXIS_DESCR /end CHARACTERISTIC
/begin CHARACTERISTIC KF_SMG_KI_AB_SCH_S "Abregel-Index Schub Sport | EN: Ramp-down index, overrun, Sport" MAP 0x78F24 TKF_SW_SW_UB 100.0 FORMULA_0003 0.0 12.0000 /begin AXIS_DESCR STD_AXIS FORMULA_0132 5 -20.0000 20.0000 FORMAT "%5.2" /end AXIS_DESCR /begin AXIS_DESCR STD_AXIS FORMULA_0006 6 0.0 10000.0000 /end AXIS_DESCR /end CHARACTERISTIC
/begin CHARACTERISTIC KF_SMG_KI_SCHA_SCH_K "Schalt-Index Schub Komfort | EN: Shift index, overrun, Comfort" MAP 0x78F5A TKF_SW_SW_UB 100.0 FORMULA_0003 0.0 12.0000 /begin AXIS_DESCR STD_AXIS FORMULA_0132 5 -20.0000 20.0000 FORMAT "%5.2" /end AXIS_DESCR /begin AXIS_DESCR STD_AXIS FORMULA_0006 6 0.0 10000.0000 /end AXIS_DESCR /end CHARACTERISTIC
/begin CHARACTERISTIC KF_SMG_KI_SCHA_SCH_S "Schalt-Index Schub Sport | EN: Shift index, overrun, Sport" MAP 0x78F90 TKF_SW_SW_UB 100.0 FORMULA_0003 0.0 12.0000 /begin AXIS_DESCR STD_AXIS FORMULA_0132 5 -20.0000 20.0000 FORMAT "%5.2" /end AXIS_DESCR /begin AXIS_DESCR STD_AXIS FORMULA_0006 6 0.0 10000.0000 /end AXIS_DESCR /end CHARACTERISTIC
/begin CHARACTERISTIC KF_SMG_KI_AUF_SCH_K "Aufregel-Index Schub Komfort | EN: Ramp-up index, overrun, Comfort" MAP 0x78FC6 TKF_SW_SW_UB 100.0 FORMULA_0003 0.0 12.0000 /begin AXIS_DESCR STD_AXIS FORMULA_0132 5 -20.0000 20.0000 FORMAT "%5.2" /end AXIS_DESCR /begin AXIS_DESCR STD_AXIS FORMULA_0006 6 0.0 10000.0000 /end AXIS_DESCR /end CHARACTERISTIC
/begin CHARACTERISTIC KF_SMG_KI_AUF_SCH_S "Aufregel-Index Schub Sport | EN: Ramp-up index, overrun, Sport" MAP 0x78FFC TKF_SW_SW_UB 100.0 FORMULA_0003 0.0 12.0000 /begin AXIS_DESCR STD_AXIS FORMULA_0132 5 -20.0000 20.0000 FORMAT "%5.2" /end AXIS_DESCR /begin AXIS_DESCR STD_AXIS FORMULA_0006 6 0.0 10000.0000 /end AXIS_DESCR /end CHARACTERISTIC
/begin CHARACTERISTIC KF_SMG_T_ABREGEL "Abregelzeit | EN: Ramp-down time" MAP 0x79032 TKF_UB_UB_UB 100.0 FORMULA_0317 0.0100 2.4500 /begin AXIS_DESCR STD_AXIS Kennung FORMULA_0003 12 0.0 255.0000 /end AXIS_DESCR /begin AXIS_DESCR STD_AXIS Istgang FORMULA_0003 7 0.0 255.0000 /end AXIS_DESCR /end CHARACTERISTIC
/begin CHARACTERISTIC KF_SMG_T_AUFREGEL "Aufregelzeit | EN: Ramp-up time" MAP 0x7909B TKF_UB_UB_UB 100.0 FORMULA_0317 0.0100 2.4500 /begin AXIS_DESCR STD_AXIS Kennung FORMULA_0003 12 0.0 255.0000 /end AXIS_DESCR /begin AXIS_DESCR STD_AXIS Istgang FORMULA_0003 7 0.0 255.0000 /end AXIS_DESCR /end CHARACTERISTIC
/begin CHARACTERISTIC KF_SMG_BW_NULL "Bewertung Nulldurchgang | EN: Zero-crossing evaluation" MAP 0x79104 TKF_UB_UB_UB 100.0 FORMULA_0003 0.0 15.0000 /begin AXIS_DESCR STD_AXIS KI_AB FORMULA_0003 6 1.0000 12.0000 /end AXIS_DESCR /begin AXIS_DESCR STD_AXIS KI_SCHA FORMULA_0003 6 1.0000 12.0000 /end AXIS_DESCR /end CHARACTERISTIC
/begin CHARACTERISTIC KF_SMG_N_ZIEL_OFF_K "Offsetfaktor auf Zieldrehzahl Komfort | EN: Offset factor on target speed, Comfort" MAP 0x79136 TKF_SW_SW_UB 100.0 FORMULA_0956 0.0 100.0000 /begin AXIS_DESCR STD_AXIS ax FORMULA_0132 4 -20.0000 20.0000 FORMAT "%5.2" /end AXIS_DESCR /begin AXIS_DESCR STD_AXIS FORMULA_0006 6 0.0 10000.0000 /end AXIS_DESCR /end CHARACTERISTIC
/begin CHARACTERISTIC KF_SMG_N_ZIEL_OFF_S "Offsetfaktor auf Zieldrehzahl Sport | EN: Offset factor on target speed, Sport" MAP 0x79164 TKF_SW_SW_UB 100.0 FORMULA_0956 0.0 100.0000 /begin AXIS_DESCR STD_AXIS ax FORMULA_0132 4 -20.0000 20.0000 FORMAT "%5.2" /end AXIS_DESCR /begin AXIS_DESCR STD_AXIS FORMULA_0006 6 0.0 10000.0000 /end AXIS_DESCR /end CHARACTERISTIC
/begin CHARACTERISTIC KF_SMG_MOT_N_REG_M_MAX "Max-Begrenzung n-Regler | EN: Maximum limit of speed controller" MAP 0x79192 TKF_SW_SW_SW 100.0 FORMULA_0009 -100.0000 1000.0000 /begin AXIS_DESCR STD_AXIS FORMULA_0001 5 -10.0000 120.0000 FORMAT "%4.1" /end AXIS_DESCR /begin AXIS_DESCR STD_AXIS canP FORMULA_0010 5 0.0 8.0000 /end AXIS_DESCR FORMAT "%4.1" /end CHARACTERISTIC
/begin CHARACTERISTIC KF_SMG_MOT_ANF_M_RAMPE_1R "Rampe beim Anfahren in 1 und R | EN: Ramp for pull-away in 1st and reverse" MAP 0x791DA TKF_SW_SW_SW 100.0 FORMULA_0571 0.0 5000.0000 /begin AXIS_DESCR STD_AXIS FORMULA_0001 4 -10.0000 120.0000 FORMAT "%4.1" /end AXIS_DESCR /begin AXIS_DESCR STD_AXIS FORMULA_0132 4 0.0 20.0000 FORMAT "%5.2" /end AXIS_DESCR /end CHARACTERISTIC
/begin CHARACTERISTIC KF_SMG_MOT_ANF_M_RAMPE_2 "Rampe beim Anfahren in 2 | EN: Ramp for pull-away in 2nd" MAP 0x7920C TKF_SW_SW_SW 100.0 FORMULA_0571 0.0 5000.0000 /begin AXIS_DESCR STD_AXIS FORMULA_0001 4 -10.0000 120.0000 FORMAT "%4.1" /end AXIS_DESCR /begin AXIS_DESCR STD_AXIS FORMULA_0132 4 0.0 20.0000 FORMAT "%5.2" /end AXIS_DESCR /end CHARACTERISTIC
/begin CHARACTERISTIC KF_SMG_MOT_N_REG_P_KO "Korrektur P-Faktor | EN: P-factor correction" MAP 0x7923E TKF_SW_SW_UB 100.0 FORMULA_0961 1.0000 2.9921 /begin AXIS_DESCR STD_AXIS n_diff FORMULA_0006 6 0.0 10000.0000 /end AXIS_DESCR /begin AXIS_DESCR STD_AXIS FORMULA_0114 6 -10000.0000 10000.0000 /end AXIS_DESCR /end CHARACTERISTIC
/begin CHARACTERISTIC KF_SMG_KUPP_REG_I_ZUG "Kupplungsregler fuer Zug | EN: Clutch controller for traction (drive)" MAP 0x7927C TKF_SW_SW_UB 100.0 FORMULA_0948 0.0 0.0255 /begin AXIS_DESCR STD_AXIS n_diff FORMULA_0006 4 0.0 10000.0000 /end AXIS_DESCR /begin AXIS_DESCR STD_AXIS n_grad_diff FORMULA_0114 3 -10000.0000 10000.0000 /end AXIS_DESCR /end CHARACTERISTIC
/begin CHARACTERISTIC KF_SMG_KUPP_REG_I_SCH "Kupplungsregler fuer Schub | EN: Clutch controller for overrun" MAP 0x79298 TKF_SW_SW_UB 100.0 FORMULA_0948 0.0 0.0255 /begin AXIS_DESCR STD_AXIS n_diff FORMULA_0006 4 0.0 10000.0000 /end AXIS_DESCR /begin AXIS_DESCR STD_AXIS n_grad_diff FORMULA_0114 3 -10000.0000 10000.0000 /end AXIS_DESCR /end CHARACTERISTIC
/begin CHARACTERISTIC KF_SMG_KUPP_LW_RAMPE "Rampe beim Lastwechsel | EN: Ramp on load change" MAP 0x792B4 TKF_SW_SW_SW 100.0 FORMULA_0962 -5000.0000 5000.0000 /begin AXIS_DESCR STD_AXIS FORMULA_0001 4 -10.0000 120.0000 FORMAT "%4.1" /end AXIS_DESCR /begin AXIS_DESCR STD_AXIS FORMULA_0009 4 0.0 1000.0000 FORMAT "%4.1" /end AXIS_DESCR /end CHARACTERISTIC
/* ------------------ Abschnitt erzeugt aus smg_can.dat ------------------ */
/begin CHARACTERISTIC K_SMG_CAN_ED_TSPERR "max. Zeit f�r CAN-Chksum | EN: Maximum time for CAN checksum" VALUE 0x792E6 TKW_VV_VV_UW 100.0 FORMULA_0117 0.0 325.0000 FORMAT "%5.2" /end CHARACTERISTIC
/begin CHARACTERISTIC K_SMG_CAN_ED_UB_MIN "min. Ub fuer CAN-Diagnose | EN: Minimum battery voltage for CAN diagnosis" VALUE 0x792E8 TKW_VV_VV_SW 100.0 FORMULA_0008 0.0 28.0000 FORMAT "%4.1" /end CHARACTERISTIC
/begin CHARACTERISTIC K_SMG_ALIVE_ERR_MAX "max. Zeit f�r CAN-Alive | EN: Maximum time for CAN alive signal" VALUE 0x792EA TKW_VV_VV_UB 100.0 FORMULA_0003 0.0 255.0000 /end CHARACTERISTIC
/begin CHARACTERISTIC K_SMG_CHKSUM_ERR_MAX "max. Zeit f�r CAN-Chksum | EN: Maximum time for CAN checksum" VALUE 0x792EB TKW_VV_VV_UB 100.0 FORMULA_0003 0.0 255.0000 /end CHARACTERISTIC
/begin CHARACTERISTIC K_SMG_V_KRAFTS_ERSATZ "v-Schwelle fuer Kraftschlussersatzwert | EN: Speed threshold for drivetrain-engagement substitute value" VALUE 0x792EC TKW_VV_VV_UB 100.0 FORMULA_0968 0.0 15.9375 /end CHARACTERISTIC
/begin CHARACTERISTIC K_SMG_CAN_TESTMODE "Vorgabe Testmode | EN: Test mode setting" VALUE 0x792ED TKW_VV_VV_UB 100.0 FORMULA_0969 0.0 255.0 /end CHARACTERISTIC
/begin CHARACTERISTIC K_SMG_CAN_KL87_TMAX "KL87-Timeout | EN: Terminal 87 timeout" VALUE 0x792EE TKW_VV_VV_UW 100.0 FORMULA_0073 0.0 6553.5000 FORMAT "%4.1" /end CHARACTERISTIC
/begin CHARACTERISTIC K_SMG_TAU_NGETR_ZIEL "Filter Getriebezieldrehzahl | EN: Filter, gearbox target speed" VALUE 0x792F0 TKW_VV_VV_UB 100.0 FORMULA_0478 0.0051 1.2800 /end CHARACTERISTIC
/* ------------------ Abschnitt erzeugt aus time_rel_diag.dat ------------------ */
/begin CHARACTERISTIC K_TIME_REL_OBD_CFG "Konfiguration Relativzeitdiagnose | EN: 0 Diag. aus 1 Diag. aktiv ELSE undef Konfiguration Relativzeitdiagn o- se" VALUE 0x79644 TKW_VV_VV_UB 100.0 FORMULA_1001 0.0 255.0 /end CHARACTERISTIC
/begin CHARACTERISTIC K_TIME_REL_OBD_MAX_FEHLER "Fehlerschwelle | EN: Fehlerschwelle" VALUE 0x79645 TKW_VV_VV_UB 100.0 FORMULA_0033 0.0 255.0000 /end CHARACTERISTIC
/begin CHARACTERISTIC K_TIME_REL_OBD_T_MAX "Maximaler Fortschritt time_rel im lfd. Betrieb | EN: Maximaler Fortschritt time_rel im lfd. Betrieb" VALUE 0x79646 TKW_VV_VV_UW 100.0 FORMULA_0062 0.0 65535.0000 /end CHARACTERISTIC
/begin CHARACTERISTIC K_TIME_REL_OBD_T_MIN "Minimaler Fortschritt time_rel im lfd. Betrieb | EN: Minimaler Fortschritt time_rel im lfd. Betrieb" VALUE 0x79648 TKW_VV_VV_UW 100.0 FORMULA_0062 0.0 65535.0000 /end CHARACTERISTIC
/begin CHARACTERISTIC K_TIME_REL_OBD_T_ML "Min. Laufzeit Motor fuer Diagnose | EN: Min. Laufzeit Motor fuer Diagn o-se" VALUE 0x7964C TKW_VV_VV_UL 100.0 FORMULA_0152 0.0 3600.0000 FORMAT "%5.2" /end CHARACTERISTIC
/begin CHARACTERISTIC K_TIME_REL_OBD_TMOT_ABSTELL "Minimale Abstelltemp. d. Motors fuer Diagnose | EN: Minimale Abstelltemp. d. Motors fuer Diagnose" VALUE 0x79650 TKW_VV_VV_SW 100.0 FORMULA_0023 -50.0000 170.0000 FORMAT "%4.1" /end CHARACTERISTIC
/begin CHARACTERISTIC K_TIME_REL_OBD_TMOT_START_SLOW "minimales tmot fuer Standzeitdiagnose SLOW | EN: minimales tmot fuer Standzeitd i-agnose SLOW" VALUE 0x79652 TKW_VV_VV_SW 100.0 FORMULA_0023 -50.0000 170.0000 FORMAT "%4.1" /end CHARACTERISTIC
/begin CHARACTERISTIC K_TIME_REL_OBD_TMOT_START_FAST "minimales tmot fuer Standzeitdiagnose FAST | EN: minimales tmot fuer Standzeitd i-agnose FAST" VALUE 0x79654 TKW_VV_VV_SW 100.0 FORMULA_0023 -50.0000 170.0000 FORMAT "%4.1" /end CHARACTERISTIC
/begin CHARACTERISTIC K_TIME_REL_OBD_UB_MIN "Schwelle U-Batt. Diagnose | EN: Schwelle U-Batt. Diagnose" VALUE 0x79656 TKW_VV_VV_SW 100.0 FORMULA_0008 0.0 28.0000 FORMAT "%4.1" /end CHARACTERISTIC
/begin CHARACTERISTIC K_TIME_REL_OBD_ZERO_CNT_MAX "time_rel-Reset-Zaehler Maxwert | EN: time_rel-Reset-Zaehler Maxwert" VALUE 0x79658 TKW_VV_VV_UB 100.0 FORMULA_0003 0.0 255.0000 /end CHARACTERISTIC
/begin CHARACTERISTIC K_TIME_REL_OBD_TMOT_DELTA_MIN "tmot-Mindestabkuehlung bei MS | EN: tmot-Mindestabkuehlung bei MS" VALUE 0x7965A TKW_VV_VV_SW 100.0 FORMULA_0076 -1000.0000 1000.0000 FORMAT "%4.1" /end CHARACTERISTIC
/begin CHARACTERISTIC KF_TIME_REL_OBD_MIN_STANDZEIT "Minimale Standzeit des Motors | EN: Minimum engine-off (soak) time [V912: differs from V452 160E]" MAP 0x7965C TKF_SW_SW_UW 100.0 FORMULA_0986 0.0 1092.2500 /begin AXIS_DESCR STD_AXIS FORMULA_0023 6 -50.0000 170.0000 FORMAT "%4.1" /end AXIS_DESCR /begin AXIS_DESCR STD_AXIS FORMULA_0023 6 -50.0000 170.0000 FORMAT "%4.1" /end AXIS_DESCR FORMAT "%5.2" /end CHARACTERISTIC
/begin CHARACTERISTIC KF_TIME_REL_OBD_MAX_STANDZEIT "Maximale Standzeit des Motors | EN: Maximum engine-off (soak) time [V912: differs from V452 160E]" MAP 0x796BE TKF_SW_SW_UW 100.0 FORMULA_1002 0.0 65535.0000 /begin AXIS_DESCR STD_AXIS FORMULA_0023 4 -50.0000 170.0000 FORMAT "%4.1" /end AXIS_DESCR /begin AXIS_DESCR STD_AXIS FORMULA_0023 4 -50.0000 170.0000 FORMAT "%4.1" /end AXIS_DESCR /end CHARACTERISTIC
/begin FUNCTION Pedalwertgeber ""
 /begin DEF_CHARACTERISTIC KL_PWG_BLS_BRP KL_PWG_BLS_V KL_PWG_MAX_DIFF KL_PWG_SOLL KL_PWG_SOLL_NOTLAUF K_PWG1_A0_INITINC K_PWG1_A0_MAX K_PWG1_A0_MIN K_PWG1_DIAG_MAX K_PWG1_DIAG_MIN K_PWG1_INC_A0_ADAPT K_PWG1_NORM K_PWG1_NORM_HS K_PWG_A0_MIN_E2 K_PWG_A0_TAU K_PWG_A0_ZAEHLER K_PWG_AB_RAMPE K_PWG_BLS_CFG K_PWG_BLS_HS_VERZ K_PWG_BLS_N_MAX_FSP K_PWG_BLS_PWG_MAX K_PWG_BLS_PWG_MIN K_PWG_BLS_T_BRP_FEHLER K_PWG_BLS_T_V_FEHLER K_PWG_BLS_V_MAX K_PWG_BLS_V_MIN K_PWG_BLS_V_VORNE_MAX K_PWG_DELTA_E2 K_PWG_ERR_MAX_E2 K_PWG_KD K_PWG_NORM_E2 K_PWG_NORM_HS_E2 K_PWG_SK_NULLAGE K_PWG_SMG_ANFAHREN_FAK_E2 K_PWG_SOLL_2GANG_AB K_PWG_SOLL_2GANG_AUF K_PWG_SOLL_2GANG_FAK K_PWG_SOLL_2GANG_MAX K_PWG_SOLL_2GANG_VMAX K_PWG_TAU K_PWG_TAU_FEHLER /end DEF_CHARACTERISTIC
 /begin REF_CHARACTERISTIC /end REF_CHARACTERISTIC
 /begin IN_MEASUREMENT /end IN_MEASUREMENT
 /begin OUT_MEASUREMENT /end OUT_MEASUREMENT
/end FUNCTION
/begin FUNCTION RTA "" /begin DEF_CHARACTERISTIC /end DEF_CHARACTERISTIC /begin REF_CHARACTERISTIC /end REF_CHARACTERISTIC /begin IN_MEASUREMENT /end IN_MEASUREMENT /begin OUT_MEASUREMENT /end OUT_MEASUREMENT /end FUNCTION
/begin FUNCTION RamCheck "" /begin DEF_CHARACTERISTIC K_RAM_CHK_CFG K_RAM_CHK_T /end DEF_CHARACTERISTIC /begin REF_CHARACTERISTIC /end REF_CHARACTERISTIC /begin IN_MEASUREMENT /end IN_MEASUREMENT /begin OUT_MEASUREMENT /end OUT_MEASUREMENT /end FUNCTION
/begin FUNCTION Relativzeitdiagnose ""
 /begin DEF_CHARACTERISTIC KF_TIME_REL_OBD_MAX_STANDZEIT KF_TIME_REL_OBD_MIN_STANDZEIT K_TIME_REL_OBD_CFG K_TIME_REL_OBD_MAX_FEHLER K_TIME_REL_OBD_TMOT_ABSTELL K_TIME_REL_OBD_TMOT_DELTA_MIN K_TIME_REL_OBD_TMOT_START_FAST K_TIME_REL_OBD_TMOT_START_SLOW K_TIME_REL_OBD_T_MAX K_TIME_REL_OBD_T_MIN K_TIME_REL_OBD_T_ML K_TIME_REL_OBD_UB_MIN K_TIME_REL_OBD_ZERO_CNT_MAX /end DEF_CHARACTERISTIC
 /begin REF_CHARACTERISTIC /end REF_CHARACTERISTIC
 /begin IN_MEASUREMENT /end IN_MEASUREMENT
 /begin OUT_MEASUREMENT /end OUT_MEASUREMENT
/end FUNCTION
/begin FUNCTION SG-Konfiguration ""
 /begin DEF_CHARACTERISTIC cfg.abgas cfg.baureihe cfg.betriebsmode cfg.canmess cfg.canstand cfg.diagnose cfg.dsc_typ cfg.getriebetyp cfg.hil cfg.ipm cfg.la_variante cfg.motortyp cfg.peripherie cfg.sg_mode cfg.status /end DEF_CHARACTERISTIC
 /begin REF_CHARACTERISTIC /end REF_CHARACTERISTIC
 /begin IN_MEASUREMENT /end IN_MEASUREMENT
 /begin OUT_MEASUREMENT /end OUT_MEASUREMENT
/end FUNCTION
/begin FUNCTION SK-Ebene_2 "" /begin DEF_CHARACTERISTIC K_SK_E2_KOMP_ERR_MAX K_SK_MAX_RESETS_E2 /end DEF_CHARACTERISTIC /begin REF_CHARACTERISTIC /end REF_CHARACTERISTIC /begin IN_MEASUREMENT /end IN_MEASUREMENT /begin OUT_MEASUREMENT /end OUT_MEASUREMENT /end FUNCTION
/begin FUNCTION SK-Manager ""
 /begin DEF_CHARACTERISTIC KL_SK_LLR_N_SOLL K_SK_CFG K_SK_CRC32 K_SK_EGAS_OFF_10of16_ K_SK_EGAS_OFF_11of16_ K_SK_EGAS_OFF_12of16_ K_SK_EGAS_OFF_13of16_ K_SK_EGAS_OFF_14of16_ K_SK_EGAS_OFF_15of16_ K_SK_EGAS_OFF_16of16_ K_SK_EGAS_OFF_1of16_ K_SK_EGAS_OFF_2of16_ K_SK_EGAS_OFF_3of16_ K_SK_EGAS_OFF_4of16_ K_SK_EGAS_OFF_5of16_ K_SK_EGAS_OFF_6of16_ K_SK_EGAS_OFF_7of16_ K_SK_EGAS_OFF_8of16_ K_SK_EGAS_OFF_9of16_ K_SK_EGAS_OFF_TIME K_SK_FGR_SPERRE K_SK_FM_EGAS_TEST K_SK_FM_FAIL_ZYL_TEST K_SK_FM_GEMISCH_TEST K_SK_FM_KR_TEST K_SK_FM_LAM_TEST K_SK_FM_MD_TEST K_SK_FM_MVAC_TEST K_SK_FM_SMG_TEST K_SK_FRA_SPERRE K_SK_KH_SPERRE K_SK_LAM_EINGR_10of32_ K_SK_LAM_EINGR_11of32_ K_SK_LAM_EINGR_12of32_ K_SK_LAM_EINGR_13of32_ K_SK_LAM_EINGR_14of32_ K_SK_LAM_EINGR_15of32_ K_SK_LAM_EINGR_16of32_ K_SK_LAM_EINGR_17of32_ K_SK_LAM_EINGR_18of32_ K_SK_LAM_EINGR_19of32_ K_SK_LAM_EINGR_1of32_ K_SK_LAM_EINGR_20of32_ K_SK_LAM_EINGR_21of32_ K_SK_LAM_EINGR_22of32_ K_SK_LAM_EINGR_23of32_ K_SK_LAM_EINGR_24of32_ K_SK_LAM_EINGR_25of32_ K_SK_LAM_EINGR_26of32_ K_SK_LAM_EINGR_27of32_ K_SK_LAM_EINGR_28of32_ K_SK_LAM_EINGR_29of32_ K_SK_LAM_EINGR_2of32_ K_SK_LAM_EINGR_30of32_ K_SK_LAM_EINGR_31of32_ K_SK_LAM_EINGR_32of32_ K_SK_LAM_EINGR_3of32_ K_SK_LAM_EINGR_4of32_ K_SK_LAM_EINGR_5of32_ K_SK_LAM_EINGR_6of32_ K_SK_LAM_EINGR_7of32_ K_SK_LAM_EINGR_8of32_ K_SK_LAM_EINGR_9of32_ K_SK_LAM_EINGR_TI K_SK_LLRA_SPERRE K_SK_MAX_OS_ERR K_SK_MAX_RESETS K_SK_MD_BEGR_DK_OFFEN K_SK_MD_BEGR_EGAS_10of64_ K_SK_MD_BEGR_EGAS_11of64_ K_SK_MD_BEGR_EGAS_12of64_ K_SK_MD_BEGR_EGAS_13of64_ K_SK_MD_BEGR_EGAS_14of64_ K_SK_MD_BEGR_EGAS_15of64_ K_SK_MD_BEGR_EGAS_16of64_ K_SK_MD_BEGR_EGAS_17of64_ K_SK_MD_BEGR_EGAS_18of64_ K_SK_MD_BEGR_EGAS_19of64_ K_SK_MD_BEGR_EGAS_1of64_ K_SK_MD_BEGR_EGAS_20of64_ K_SK_MD_BEGR_EGAS_21of64_ K_SK_MD_BEGR_EGAS_22of64_ K_SK_MD_BEGR_EGAS_23of64_ K_SK_MD_BEGR_EGAS_24of64_ K_SK_MD_BEGR_EGAS_25of64_ K_SK_MD_BEGR_EGAS_26of64_ K_SK_MD_BEGR_EGAS_27of64_ K_SK_MD_BEGR_EGAS_28of64_ K_SK_MD_BEGR_EGAS_29of64_ K_SK_MD_BEGR_EGAS_2of64_ K_SK_MD_BEGR_EGAS_30of64_ K_SK_MD_BEGR_EGAS_31of64_ K_SK_MD_BEGR_EGAS_32of64_ K_SK_MD_BEGR_EGAS_33of64_ K_SK_MD_BEGR_EGAS_34of64_ K_SK_MD_BEGR_EGAS_35of64_ K_SK_MD_BEGR_EGAS_36of64_ K_SK_MD_BEGR_EGAS_37of64_ K_SK_MD_BEGR_EGAS_38of64_ K_SK_MD_BEGR_EGAS_39of64_ K_SK_MD_BEGR_EGAS_3of64_ K_SK_MD_BEGR_EGAS_40of64_ K_SK_MD_BEGR_EGAS_41of64_ K_SK_MD_BEGR_EGAS_42of64_ K_SK_MD_BEGR_EGAS_43of64_ K_SK_MD_BEGR_EGAS_44of64_ K_SK_MD_BEGR_EGAS_45of64_ K_SK_MD_BEGR_EGAS_46of64_ K_SK_MD_BEGR_EGAS_47of64_ K_SK_MD_BEGR_EGAS_48of64_ K_SK_MD_BEGR_EGAS_49of64_ K_SK_MD_BEGR_EGAS_4of64_ K_SK_MD_BEGR_EGAS_50of64_ K_SK_MD_BEGR_EGAS_51of64_ K_SK_MD_BEGR_EGAS_52of64_ K_SK_MD_BEGR_EGAS_53of64_ K_SK_MD_BEGR_EGAS_54of64_ K_SK_MD_BEGR_EGAS_55of64_ K_SK_MD_BEGR_EGAS_56of64_ K_SK_MD_BEGR_EGAS_57of64_ K_SK_MD_BEGR_EGAS_58of64_ K_SK_MD_BEGR_EGAS_59of64_ K_SK_MD_BEGR_EGAS_5of64_ K_SK_MD_BEGR_EGAS_60of64_ K_SK_MD_BEGR_EGAS_61of64_ K_SK_MD_BEGR_EGAS_62of64_ K_SK_MD_BEGR_EGAS_63of64_ K_SK_MD_BEGR_EGAS_64of64_ K_SK_MD_BEGR_EGAS_6of64_ K_SK_MD_BEGR_EGAS_7of64_ K_SK_MD_BEGR_EGAS_8of64_ K_SK_MD_BEGR_EGAS_9of64_ K_SK_MD_BEGR_GEMISCH_10of32_ K_SK_MD_BEGR_GEMISCH_11of32_ K_SK_MD_BEGR_GEMISCH_12of32_ K_SK_MD_BEGR_GEMISCH_13of32_ K_SK_MD_BEGR_GEMISCH_14of32_ K_SK_MD_BEGR_GEMISCH_15of32_ K_SK_MD_BEGR_GEMISCH_16of32_ K_SK_MD_BEGR_GEMISCH_17of32_ K_SK_MD_BEGR_GEMISCH_18of32_ K_SK_MD_BEGR_GEMISCH_19of32_ K_SK_MD_BEGR_GEMISCH_1of32_ K_SK_MD_BEGR_GEMISCH_20of32_ K_SK_MD_BEGR_GEMISCH_21of32_ K_SK_MD_BEGR_GEMISCH_22of32_ K_SK_MD_BEGR_GEMISCH_23of32_ K_SK_MD_BEGR_GEMISCH_24of32_ K_SK_MD_BEGR_GEMISCH_25of32_ K_SK_MD_BEGR_GEMISCH_26of32_ K_SK_MD_BEGR_GEMISCH_27of32_ K_SK_MD_BEGR_GEMISCH_28of32_ K_SK_MD_BEGR_GEMISCH_29of32_ K_SK_MD_BEGR_GEMISCH_2of32_ K_SK_MD_BEGR_GEMISCH_30of32_ K_SK_MD_BEGR_GEMISCH_31of32_ K_SK_MD_BEGR_GEMISCH_32of32_ K_SK_MD_BEGR_GEMISCH_3of32_ K_SK_MD_BEGR_GEMISCH_4of32_ K_SK_MD_BEGR_GEMISCH_5of32_ K_SK_MD_BEGR_GEMISCH_6of32_ K_SK_MD_BEGR_GEMISCH_7of32_ K_SK_MD_BEGR_GEMISCH_8of32_ K_SK_MD_BEGR_GEMISCH_9of32_ K_SK_MD_BEGR_KR_1of8_ K_SK_MD_BEGR_KR_2of8_ K_SK_MD_BEGR_KR_3of8_ K_SK_MD_BEGR_KR_4of8_ K_SK_MD_BEGR_KR_5of8_ K_SK_MD_BEGR_KR_6of8_ K_SK_MD_BEGR_KR_7of8_ K_SK_MD_BEGR_KR_8of8_ K_SK_MD_BEGR_MD_10of16_ K_SK_MD_BEGR_MD_11of16_ K_SK_MD_BEGR_MD_12of16_ K_SK_MD_BEGR_MD_13of16_ K_SK_MD_BEGR_MD_14of16_ K_SK_MD_BEGR_MD_15of16_ K_SK_MD_BEGR_MD_16of16_ K_SK_MD_BEGR_MD_1of16_ K_SK_MD_BEGR_MD_2of16_ K_SK_MD_BEGR_MD_3of16_ K_SK_MD_BEGR_MD_4of16_ K_SK_MD_BEGR_MD_5of16_ K_SK_MD_BEGR_MD_6of16_ K_SK_MD_BEGR_MD_7of16_ K_SK_MD_BEGR_MD_8of16_ K_SK_MD_BEGR_MD_9of16_ K_SK_MD_BEGR_MVAC_1of4_ K_SK_MD_BEGR_MVAC_2of4_ K_SK_MD_BEGR_MVAC_3of4_ K_SK_MD_BEGR_MVAC_4of4_ K_SK_MD_BEGR_MVAC_SYS K_SK_MD_BEGR_PWG_2of6_ K_SK_MD_BEGR_PWG_3of6_ K_SK_MD_BEGR_PWG_4of6_ K_SK_MD_BEGR_PWG_5of6_ K_SK_MD_BEGR_PWG_6of6_ K_SK_MD_BEGR_RESET K_SK_MD_BEGR_SMG_10of16_ K_SK_MD_BEGR_SMG_11of16_ K_SK_MD_BEGR_SMG_12of16_ K_SK_MD_BEGR_SMG_13of16_ K_SK_MD_BEGR_SMG_14of16_ K_SK_MD_BEGR_SMG_15of16_ K_SK_MD_BEGR_SMG_16of16_ K_SK_MD_BEGR_SMG_1of16_ K_SK_MD_BEGR_SMG_2of16_ K_SK_MD_BEGR_SMG_3of16_ K_SK_MD_BEGR_SMG_4of16_ K_SK_MD_BEGR_SMG_5of16_ K_SK_MD_BEGR_SMG_6of16_ K_SK_MD_BEGR_SMG_7of16_ K_SK_MD_BEGR_SMG_8of16_ K_SK_MD_BEGR_SMG_9of16_ K_SK_MD_BEGR_TI_10of16_ K_SK_MD_BEGR_TI_11of16_ K_SK_MD_BEGR_TI_12of16_ K_SK_MD_BEGR_TI_13of16_ K_SK_MD_BEGR_TI_14of16_ K_SK_MD_BEGR_TI_15of16_ K_SK_MD_BEGR_TI_16of16_ K_SK_MD_BEGR_TI_1of16_ K_SK_MD_BEGR_TI_2of16_ K_SK_MD_BEGR_TI_3of16_ K_SK_MD_BEGR_TI_4of16_ K_SK_MD_BEGR_TI_5of16_ K_SK_MD_BEGR_TI_6of16_ K_SK_MD_BEGR_TI_7of16_ K_SK_MD_BEGR_TI_8of16_ K_SK_MD_BEGR_TI_9of16_ K_SK_MD_TI_EINGR K_SK_MD_VL_SPERRE K_SK_MVAC_KH_1of4_ K_SK_MVAC_KH_2of4_ K_SK_MVAC_KH_3of4_ K_SK_MVAC_KH_4of4_ K_SK_PKS_NOTLAUF K_SK_PROZ_ERR K_SK_TASK_ERR K_SK_TI_OFF_EGAS_10of64_ K_SK_TI_OFF_EGAS_11of64_ K_SK_TI_OFF_EGAS_12of64_ K_SK_TI_OFF_EGAS_13of64_ K_SK_TI_OFF_EGAS_14of64_ K_SK_TI_OFF_EGAS_15of64_ K_SK_TI_OFF_EGAS_16of64_ K_SK_TI_OFF_EGAS_17of64_ K_SK_TI_OFF_EGAS_18of64_ K_SK_TI_OFF_EGAS_19of64_ K_SK_TI_OFF_EGAS_1of64_ K_SK_TI_OFF_EGAS_20of64_ K_SK_TI_OFF_EGAS_21of64_ K_SK_TI_OFF_EGAS_22of64_ K_SK_TI_OFF_EGAS_23of64_ K_SK_TI_OFF_EGAS_24of64_ K_SK_TI_OFF_EGAS_25of64_ K_SK_TI_OFF_EGAS_26of64_ K_SK_TI_OFF_EGAS_27of64_ K_SK_TI_OFF_EGAS_28of64_ K_SK_TI_OFF_EGAS_29of64_ K_SK_TI_OFF_EGAS_2of64_ K_SK_TI_OFF_EGAS_30of64_ K_SK_TI_OFF_EGAS_31of64_ K_SK_TI_OFF_EGAS_32of64_ K_SK_TI_OFF_EGAS_33of64_ K_SK_TI_OFF_EGAS_34of64_ K_SK_TI_OFF_EGAS_35of64_ K_SK_TI_OFF_EGAS_36of64_ K_SK_TI_OFF_EGAS_37of64_ K_SK_TI_OFF_EGAS_38of64_ K_SK_TI_OFF_EGAS_39of64_ K_SK_TI_OFF_EGAS_3of64_ K_SK_TI_OFF_EGAS_40of64_ K_SK_TI_OFF_EGAS_41of64_ K_SK_TI_OFF_EGAS_42of64_ K_SK_TI_OFF_EGAS_43of64_ K_SK_TI_OFF_EGAS_44of64_ K_SK_TI_OFF_EGAS_45of64_ K_SK_TI_OFF_EGAS_46of64_ K_SK_TI_OFF_EGAS_47of64_ K_SK_TI_OFF_EGAS_48of64_ K_SK_TI_OFF_EGAS_49of64_ K_SK_TI_OFF_EGAS_4of64_ K_SK_TI_OFF_EGAS_50of64_ K_SK_TI_OFF_EGAS_51of64_ K_SK_TI_OFF_EGAS_52of64_ K_SK_TI_OFF_EGAS_53of64_ K_SK_TI_OFF_EGAS_54of64_ K_SK_TI_OFF_EGAS_55of64_ K_SK_TI_OFF_EGAS_56of64_ K_SK_TI_OFF_EGAS_57of64_ K_SK_TI_OFF_EGAS_58of64_ K_SK_TI_OFF_EGAS_59of64_ K_SK_TI_OFF_EGAS_5of64_ K_SK_TI_OFF_EGAS_60of64_ K_SK_TI_OFF_EGAS_61of64_ K_SK_TI_OFF_EGAS_62of64_ K_SK_TI_OFF_EGAS_63of64_ K_SK_TI_OFF_EGAS_64of64_ K_SK_TI_OFF_EGAS_6of64_ K_SK_TI_OFF_EGAS_7of64_ K_SK_TI_OFF_EGAS_8of64_ K_SK_TI_OFF_EGAS_9of64_ K_SK_T_RESET_DELAY_OS K_SK_ZYL_OFF_MAX /end DEF_CHARACTERISTIC
 /begin REF_CHARACTERISTIC /end REF_CHARACTERISTIC
 /begin IN_MEASUREMENT /end IN_MEASUREMENT
 /begin OUT_MEASUREMENT /end OUT_MEASUREMENT
/end FUNCTION
/begin FUNCTION SMG ""
 /begin DEF_CHARACTERISTIC KF_SMG_BW_NULL KF_SMG_KI_AB_K KF_SMG_KI_AB_S KF_SMG_KI_AB_SCH_K KF_SMG_KI_AB_SCH_S KF_SMG_KI_AUF_K KF_SMG_KI_AUF_S KF_SMG_KI_AUF_SCH_K KF_SMG_KI_AUF_SCH_S KF_SMG_KI_SCHA_K KF_SMG_KI_SCHA_S KF_SMG_KI_SCHA_SCH_K KF_SMG_KI_SCHA_SCH_S KF_SMG_KUPP_LW_RAMPE KF_SMG_KUPP_REG_I_SCH KF_SMG_KUPP_REG_I_ZUG KF_SMG_MOT_ANF_M_RAMPE_1R KF_SMG_MOT_ANF_M_RAMPE_2 KF_SMG_MOT_N_REG_M_MAX KF_SMG_MOT_N_REG_P_KO KF_SMG_N_ZIEL_OFF_K KF_SMG_N_ZIEL_OFF_S KF_SMG_T_ABREGEL KF_SMG_T_AUFREGEL KL_SMG_FW_REL_VIRT KL_SMG_KI_AKS_GANG KL_SMG_KI_DAY_MAX KL_SMG_KUPP_M_AB_ANF KL_SMG_KUPP_M_AB_OFF KL_SMG_KUPP_M_AB_SH KL_SMG_KUPP_M_AB_SR KL_SMG_KUPP_M_AB_ZH KL_SMG_KUPP_M_AB_ZR KL_SMG_KUPP_M_AUF_KI KL_SMG_KUPP_M_AUF_OFF KL_SMG_KUPP_M_AUF_S1 KL_SMG_KUPP_M_AUF_Z1 KL_SMG_KUPP_REG_I_F KL_SMG_KUPP_UL_DN_POS KL_SMG_MOT_DN_REG_P KL_SMG_MOT_DN_SOLL KL_SMG_MOT_J_MOTOR KL_SMG_MOT_M_AB_SH KL_SMG_MOT_M_AB_SR KL_SMG_MOT_M_AB_ZH KL_SMG_MOT_M_AB_ZR KL_SMG_MOT_M_RES_AUF KL_SMG_MOT_M_VOR_AUF KL_SMG_MOT_N_REG_D_DN KL_SMG_MOT_N_REG_D_UP KL_SMG_MOT_N_REG_M_LW KL_SMG_MOT_N_REG_P_DN KL_SMG_MOT_N_REG_P_UP KL_SMG_MOT_N_REG_SA_DIFF KL_SMG_MOT_VOR_2_KI KL_SMG_N_ABRISS_SCHW KL_SMG_N_ZIEL_OFF_ANF KL_SMG_N_ZIEL_OFF_LL KL_SMG_N_ZIEL_OFF_MAX KL_SMG_N_ZIEL_OFF_RAB KL_SMG_N_ZIEL_OFF_ZR KL_SMG_PROG_AUTOMAT KL_SMG_PROG_MANUELL KL_SMG_PROG_MAX_TOEL KL_SMG_PROG_MIN_BERG KL_SMG_SK_PROG_MAX KL_SMG_T_KORR_AB K_SMG_ADAPT_IHAR_CNT K_SMG_ADAPT_IHAR_DFLT K_SMG_ADAPT_IHAR_MAX K_SMG_ADAPT_IHAR_MIN K_SMG_ADAPT_SP_DMD_FW K_SMG_ADAPT_SP_DM_MAX K_SMG_ADAPT_SP_N_MAX K_SMG_ADAPT_SP_N_MIN K_SMG_ADAPT_SP_TOEL K_SMG_ALIVE_ERR_MAX K_SMG_BERG_MD_KW_SCHW K_SMG_BERG_V_MAX_SCHW K_SMG_BERG_V_MIN_SCHW K_SMG_CAN_ED_TSPERR K_SMG_CAN_ED_UB_MIN K_SMG_CAN_KL87_TMAX K_SMG_CAN_TESTMODE K_SMG_CHKSUM_ERR_MAX K_SMG_I_GANG_1 K_SMG_I_GANG_2 K_SMG_I_GANG_3 K_SMG_I_GANG_4 K_SMG_I_GANG_5 K_SMG_I_GANG_6 K_SMG_I_GANG_7 K_SMG_I_GANG_N K_SMG_I_GANG_R K_SMG_I_HA K_SMG_KI_AKS_AY_MAX K_SMG_KI_AKS_DAY_MAX K_SMG_KI_AUF_DSC K_SMG_KI_AUF_DSC2 K_SMG_KI_AUF_EINGR K_SMG_KI_AUF_T_EINGR K_SMG_KI_AUF_ZR K_SMG_KI_CFG K_SMG_KI_DELTA_PWG K_SMG_KI_NEU_AY_MAX K_SMG_KI_SCHALT_DSC K_SMG_KSCHLUPF_AUF K_SMG_KSCHLUPF_DSC K_SMG_KSCHLUPF_N K_SMG_KSCHLUPF_T_SCHW K_SMG_KUPP_AUF_SCHW_N K_SMG_KUPP_DM_ABS K_SMG_KUPP_DM_MIN K_SMG_KUPP_DM_RAB K_SMG_KUPP_DM_SOLL_F K_SMG_KUPP_M_MAX_1 K_SMG_KUPP_M_MAX_2 K_SMG_KUPP_N_KSCHUTZ K_SMG_KUPP_RAMPE_DM K_SMG_KUPP_RAMPE_N K_SMG_KUPP_RAMPE_N_ABW K_SMG_KUPP_RAMPE_UL K_SMG_KUPP_REG_T K_SMG_KUPP_UL_FW_DM K_SMG_KUPP_UL_FW_MAX K_SMG_KUPP_UL_FW_SCHW K_SMG_KUPP_UL_MD_SCHW K_SMG_KUPP_UL_N_SCHW K_SMG_MD_FW_HYS_SCH K_SMG_MD_FW_HYS_ZUG K_SMG_MD_FW_MIN_AB K_SMG_MD_FW_MIN_AUF K_SMG_MOT_ABS_DM_MAX K_SMG_MOT_ABS_M_MAX K_SMG_MOT_ABS_M_MIN K_SMG_MOT_ABS_N_OFF K_SMG_MOT_ABS_T_MAX K_SMG_MOT_AKS_N_SCHW K_SMG_MOT_ANF_DM_DSC K_SMG_MOT_ANF_FW_X K_SMG_MOT_ANF_M_MIN K_SMG_MOT_ANF_N_OFF K_SMG_MOT_DN_GANG_1of3_ K_SMG_MOT_DN_GANG_2of3_ K_SMG_MOT_DN_GANG_3of3_ K_SMG_MOT_DN_REG_I_N K_SMG_MOT_DN_REG_I_P K_SMG_MOT_DN_REG_I_S K_SMG_MOT_DN_REG_T K_SMG_MOT_DN_SOLL_MIN K_SMG_MOT_DN_SOLL_VOR K_SMG_MOT_J_MOTOR_ZR K_SMG_MOT_M_RES_ABW K_SMG_MOT_M_RES_AUF K_SMG_MOT_M_RES_EXT_MAX K_SMG_MOT_M_RES_MAX K_SMG_MOT_M_RES_POS_MAX K_SMG_MOT_M_RES_POS_N K_SMG_MOT_M_RES_RAMPE K_SMG_MOT_M_RES_RAMPE_KS K_SMG_MOT_M_RES_RS K_SMG_MOT_M_RES_SCHA K_SMG_MOT_M_RES_T_MAX K_SMG_MOT_M_VOR_AUF K_SMG_MOT_NL_DELTA_FW K_SMG_MOT_NL_ETA K_SMG_MOT_NL_MD K_SMG_MOT_NL_MD_MAX K_SMG_MOT_NL_TAU K_SMG_MOT_NL_T_MAX K_SMG_MOT_N_REG_D_MAX K_SMG_MOT_N_REG_D_MIN K_SMG_MOT_N_REG_I_DN K_SMG_MOT_N_REG_I_SCHW K_SMG_MOT_N_REG_I_T K_SMG_MOT_N_REG_I_T_RAB K_SMG_MOT_N_REG_I_UP K_SMG_MOT_N_REG_M_BEGR K_SMG_MOT_N_REG_M_MAX K_SMG_MOT_N_REG_M_STG K_SMG_MOT_N_REG_T_MAX K_SMG_MOT_RAB_DM_MAX K_SMG_MOT_RAB_M_MAX K_SMG_MOT_RAB_M_MIN K_SMG_MOT_RAB_T_MAX K_SMG_MOT_RSS_MD_EINGR K_SMG_MOT_RS_N_OFF K_SMG_MOT_RS_N_SCHW K_SMG_MOT_RS_S_SCHW K_SMG_MOT_RS_TI_TABG K_SMG_MOT_RS_TI_TIME K_SMG_MOT_RS_T_HI K_SMG_MOT_RS_T_LO K_SMG_M_NULL K_SMG_NO_LW_N_SCHW K_SMG_N_ABRISS_ANF K_SMG_N_ABRISS_HYS K_SMG_N_EKR_OFF_BEGR K_SMG_N_NULL K_SMG_N_ZIEL_ABWUERG K_SMG_N_ZIEL_ANF_V_MAX K_SMG_N_ZIEL_HYS K_SMG_N_ZIEL_OFF_BEGR K_SMG_N_ZIEL_OFF_SCH K_SMG_N_ZIEL_OFF_ZH K_SMG_OHNE_EINGR_OFF K_SMG_PROG_EINFAHR_WEG K_SMG_PROG_FETRAWE_WEG K_SMG_PROG_MAX_ANH K_SMG_PROG_MAX_EINFAHR K_SMG_PROG_MAX_FETRAWE K_SMG_PROG_MIN_ANH K_SMG_PROG_MIN_ZR K_SMG_PROG_V_SCHW K_SMG_PWG_FW_SCH K_SMG_PWG_FW_SCH_N_OFF K_SMG_R_DYN K_SMG_SK_CONTROL K_SMG_SK_MD_SCHW K_SMG_SK_M_KUPP_MIN K_SMG_SK_NBERCH_MAX K_SMG_SK_NBERCH_T K_SMG_SK_NGETR_MAX K_SMG_SK_NGETR_T K_SMG_SK_NMAX_FSP K_SMG_SK_NMAX_FSP_INAKTIV K_SMG_SK_NZIEL_MAX K_SMG_SK_NZIEL_T K_SMG_SK_T_DME_ST_MAX K_SMG_SK_T_MAX K_SMG_SK_T_NGETR_MAX K_SMG_SK_T_NZIEL_MAX K_SMG_SK_T_PHASE_MAX_AB K_SMG_SK_T_PHASE_MAX_AUF K_SMG_SK_T_PHASE_MAX_SCHA K_SMG_SK_T_PHASE_N_MAX K_SMG_SK_V_SCHW K_SMG_TAU_AX_BERECH K_SMG_TAU_AX_BERG K_SMG_TAU_AX_MESS K_SMG_TAU_DN_FILTER K_SMG_TAU_DN_GETR K_SMG_TAU_DSC_ABS K_SMG_TAU_KSCHLUPF K_SMG_TAU_MD_FAHRER K_SMG_TAU_NGETR_ZIEL K_SMG_TAU_RSCHLUPF K_SMG_TESTMODE K_SMG_TZ_EINGR_T_AB K_SMG_T_ABREGEL_AKS K_SMG_T_KORR_AB_FW K_SMG_T_KORR_AB_MIN K_SMG_V_KRAFTS_ERSATZ /end DEF_CHARACTERISTIC
 /begin REF_CHARACTERISTIC /end REF_CHARACTERISTIC
 /begin IN_MEASUREMENT /end IN_MEASUREMENT
 /begin OUT_MEASUREMENT /end OUT_MEASUREMENT
/end FUNCTION
/begin RECORD_LAYOUT TKW_VV_VV_UB FNC_VALUES 1 UBYTE COLUMN_DIR DIRECT /end RECORD_LAYOUT
/begin RECORD_LAYOUT TKW_VV_VV_UW FNC_VALUES 1 UWORD COLUMN_DIR DIRECT /end RECORD_LAYOUT
/begin RECORD_LAYOUT TKW_VV_VV_SW FNC_VALUES 1 SWORD COLUMN_DIR DIRECT /end RECORD_LAYOUT
/begin RECORD_LAYOUT TKW_VV_VV_UL FNC_VALUES 1 ULONG COLUMN_DIR DIRECT /end RECORD_LAYOUT
/begin RECORD_LAYOUT TKL_UB_VV_UB NO_AXIS_PTS_X 1 UBYTE RESERVED 2 BYTE AXIS_PTS_X 3 UBYTE INDEX_INCR DIRECT FNC_VALUES 4 UBYTE COLUMN_DIR DIRECT /end RECORD_LAYOUT
/begin RECORD_LAYOUT TKL_UB_VV_SW NO_AXIS_PTS_X 1 UBYTE RESERVED 2 BYTE AXIS_PTS_X 3 UBYTE INDEX_INCR DIRECT FNC_VALUES 4 SWORD COLUMN_DIR DIRECT /end RECORD_LAYOUT
/begin RECORD_LAYOUT TKL_SB_VV_UB NO_AXIS_PTS_X 1 UBYTE RESERVED 2 BYTE AXIS_PTS_X 3 SBYTE INDEX_INCR DIRECT FNC_VALUES 4 UBYTE COLUMN_DIR DIRECT /end RECORD_LAYOUT
/begin RECORD_LAYOUT TKL_UW_VV_UW NO_AXIS_PTS_X 1 UBYTE RESERVED 2 BYTE AXIS_PTS_X 3 UWORD INDEX_INCR DIRECT FNC_VALUES 4 UWORD COLUMN_DIR DIRECT /end RECORD_LAYOUT
/begin RECORD_LAYOUT TKL_UW_VV_SW NO_AXIS_PTS_X 1 UBYTE RESERVED 2 BYTE AXIS_PTS_X 3 UWORD INDEX_INCR DIRECT FNC_VALUES 4 SWORD COLUMN_DIR DIRECT /end RECORD_LAYOUT
/begin RECORD_LAYOUT TKL_SW_VV_UB NO_AXIS_PTS_X 1 UBYTE RESERVED 2 BYTE AXIS_PTS_X 3 SWORD INDEX_INCR DIRECT FNC_VALUES 4 UBYTE COLUMN_DIR DIRECT /end RECORD_LAYOUT
/begin RECORD_LAYOUT TKL_SW_VV_UW NO_AXIS_PTS_X 1 UBYTE RESERVED 2 BYTE AXIS_PTS_X 3 SWORD INDEX_INCR DIRECT FNC_VALUES 4 UWORD COLUMN_DIR DIRECT /end RECORD_LAYOUT
/begin RECORD_LAYOUT TKL_SW_VV_SW NO_AXIS_PTS_X 1 UBYTE RESERVED 2 BYTE AXIS_PTS_X 3 SWORD INDEX_INCR DIRECT FNC_VALUES 4 SWORD COLUMN_DIR DIRECT /end RECORD_LAYOUT
/begin RECORD_LAYOUT TKF_UB_UB_UB NO_AXIS_PTS_X 1 UBYTE NO_AXIS_PTS_Y 2 UBYTE AXIS_PTS_X 3 UBYTE INDEX_INCR DIRECT AXIS_PTS_Y 4 UBYTE INDEX_INCR DIRECT FNC_VALUES 5 UBYTE COLUMN_DIR DIRECT /end RECORD_LAYOUT
/begin RECORD_LAYOUT TKF_SW_SW_UB NO_AXIS_PTS_X 1 UBYTE NO_AXIS_PTS_Y 2 UBYTE AXIS_PTS_X 3 SWORD INDEX_INCR DIRECT AXIS_PTS_Y 4 SWORD INDEX_INCR DIRECT FNC_VALUES 5 UBYTE COLUMN_DIR DIRECT /end RECORD_LAYOUT
/begin RECORD_LAYOUT TKF_SW_SW_UW NO_AXIS_PTS_X 1 UBYTE NO_AXIS_PTS_Y 2 UBYTE AXIS_PTS_X 3 SWORD INDEX_INCR DIRECT AXIS_PTS_Y 4 SWORD INDEX_INCR DIRECT FNC_VALUES 5 UWORD COLUMN_DIR DIRECT /end RECORD_LAYOUT
/begin RECORD_LAYOUT TKF_SW_SW_SW NO_AXIS_PTS_X 1 UBYTE NO_AXIS_PTS_Y 2 UBYTE AXIS_PTS_X 3 SWORD INDEX_INCR DIRECT AXIS_PTS_Y 4 SWORD INDEX_INCR DIRECT FNC_VALUES 5 SWORD COLUMN_DIR DIRECT /end RECORD_LAYOUT
/end MODULE
/end PROJECT
