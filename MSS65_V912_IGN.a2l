/* ------------------------------------------------------------------
MSS65 IGN A2L - Data 7842800 / program 7842123 (V912.00-B204.00, data set 0569Q60Z520E)
Created by ZiMMie for the M5Board and Nam3Forum communities.
This project exists to make this information freely available to
everyone: to share the work, encourage collaboration, and let others
learn from it, use it and add their own knowledge.
The reference material is based on publicly available program data.
The V912 program was disassembled and analysed to place and verify the
definitions for this calibration.
This is a community effort, and every contribution matters.
Corrections, additional findings, technical knowledge and general
feedback are all very welcome. The more knowledge is shared and the
more people work together, the more can be achieved.
Completely free to use and share.
------------------------------------------------------------------ */
/* Technical notes - V912 definitions.
Calibration addresses aligned against the V912 image (0pa/0da) by table structure, code read-width
evidence and value comparison with V452 (05.11.2026). Ignition calibration layout is identical to V452.
Characteristics that could not be placed with confidence are left out, including most of the
generator / power-management / IBS block (rewritten in V912).
Descriptions ending in [V912: differs from V452 160E] hold a different value than the V452 160E data set.
RAM measurements are not included: the V912 RAM layout differs from V452 and has not been re-mapped. */
/begin PROJECT MSS65-ign-V912 "MSS65 IGN - V912.00-B204.00, data set 0569Q60Z520E"
/begin HEADER "" VERSION "V912.00-B204.00" /end HEADER
/begin MODULE _MSS65-ign "MSS65 IGN - V912.00-B204.00, data 7842800"
/begin MOD_COMMON "" BYTE_ORDER MSB_FIRST /* Default byteorder (Motorola) */ /end MOD_COMMON
/*--------------------------- QADC A + B ------------------------------------------------*/ /*--------------------------- CAN A + B ------------------------------------------------*/ /* TPU KW FORMELN ------------------------------------------------------------------------*/
/begin COMPU_METHOD FORMULA_KW1 "FORMULA_KW1" RAT_FUNC "%5.0" "-" COEFFS 0 256 0 0 0 1 /end COMPU_METHOD
/begin COMPU_METHOD FORMULA_KW3 "FORMULA_KW3" TAB_VERB "%5.0" "-" COMPU_TAB_REF FORMULA_KW3_VTAB /end COMPU_METHOD
/begin COMPU_VTAB FORMULA_KW3_VTAB "FORMULA_KW3_VTAB" TAB_VERB 13 0 "ini" 1 "1st edge" 2 "second edge" 3 "wait teeth" 4 "search gap" 5 "1st missing required" 6 "last tooth until gap" 7 "1st missing tooth" 8 "2nd missing tooth" 9 "1st tooth after gap" 10 "2nd tooth after gap" 11 "tooth 2..56, 62..116" 12 "gap required" DEFAULT_VALUE "1 undefined" /end COMPU_VTAB
/begin COMPU_METHOD FORMULA_KW4 "FORMULA_KW4" RAT_FUNC "%5.0" "-" COEFFS 0 1 0 0 0 1 /end COMPU_METHOD
/begin COMPU_METHOD FORMULA_KW5 "FORMULA_KW5" RAT_FUNC "%5.0" "Upm" COEFFS 0 0 27344 0 1 0 /end COMPU_METHOD
/begin COMPU_METHOD FORMULA_KW6 "FORMULA_KW6" RAT_FUNC "%6.4" "�" COEFFS 0 1 0 0 0 0.00004291534423828125 /end COMPU_METHOD
/begin COMPU_METHOD FORMULA_KW8 "FORMULA_KW8" RAT_FUNC "%9.2" "ms" COEFFS 0 7000 0 0 0 1 /end COMPU_METHOD
/begin COMPU_METHOD FORMULA_KW9 "FORMULA_KW9" RAT_FUNC "%7.2" "ms" COEFFS 0 1 0 0 0 2.34057 /end COMPU_METHOD
/begin COMPU_METHOD FORMULA_KW10 "FORMULA_KW10" RAT_FUNC "%7.2" "�" COEFFS 0 1 0 0 0 0.01098633 /end COMPU_METHOD
/begin COMPU_METHOD FORMULA_KW11 "FORMULA_KW11" RAT_FUNC "%7.2" "ms" COEFFS 0 7000 0 0 0 1 /end COMPU_METHOD
/begin COMPU_METHOD FORMULA_KW12 "FORMULA_KW12" RAT_FUNC "%9.2" "ms" COEFFS 0 7000 0 0 0 256 /end COMPU_METHOD
/begin COMPU_METHOD FORMULA_KW13 "FORMULA_KW13" RAT_FUNC "%12.2" "ms" COEFFS 0 840000 0 0 0 1 /end COMPU_METHOD
/* TPU KW A ------------------------------------------------------------------------------*/ /* TPU KW B ------------------------------------------------------------------------------*/ /* TPU KW LU Messfenster -----------------------------------------------------------------*/ /* TPU PWM FORMELN -----------------------------------------------------------------------*/
/begin COMPU_METHOD FORMULA_PWM1 "FORMULA_PWM1" RAT_FUNC "%7.2" "ms" COEFFS 0 7000 0 0 0 1 /end COMPU_METHOD
/* TPU PWM -------------------------------------------------------------------------------*/ /* TPU DIO FORMELN -----------------------------------------------------------------------*/
/begin COMPU_METHOD FORMULA_DIO1 "FORMULA_DIO1" TAB_VERB "%5.0" "-" COMPU_TAB_REF FORMULA_DIO1_VTAB /end COMPU_METHOD
/begin COMPU_VTAB FORMULA_DIO1_VTAB "FORMULA_DIO1_VTAB" TAB_VERB 5 0x04 "in rising edge" 0x08 "in falling edge" 0x0C "in both edges" 0xE1 "out pin high" 0xE2 "out pin low" DEFAULT_VALUE "1 undefined" /end COMPU_VTAB
/begin COMPU_METHOD FORMULA_DIO2 "FORMULA_DIO2" RAT_FUNC "%5.0" "-" COEFFS 0 1 0 0 0 1 /end COMPU_METHOD
/begin COMPU_METHOD FORMULA_DIO3 "FORMULA_DIO3" RAT_FUNC "%7.2" "ms" COEFFS 0 7000 0 0 0 1 /end COMPU_METHOD
/* TPU DIO -------------------------------------------------------------------------------*/ /* TPU FI FORMELN ------------------------------------------------------------------------*/
/begin COMPU_METHOD FORMULA_FI1 "FORMULA_FI1" RAT_FUNC "%7.2" "ms" COEFFS 0 14000 0 0 0 1 /end COMPU_METHOD
/begin COMPU_METHOD FORMULA_FI2 "FORMULA_FI2" RAT_FUNC "%5.0" "-" COEFFS 0 256 0 0 0 1 /end COMPU_METHOD
/begin COMPU_METHOD FORMULA_FI3 "FORMULA_FI3" RAT_FUNC "%5.0" "-" COEFFS 0 1 0 0 0 1 /end COMPU_METHOD
/* TPU FI --------------------------------------------------------------------------------*/ /* TPU AA FORMELN ------------------------------------------------------------------------*/
/begin COMPU_METHOD FORMULA_AA1 "FORMULA_AA1" RAT_FUNC "%7.2" "�" COEFFS 0 1 0 0 0 0.01098633 /end COMPU_METHOD
/begin COMPU_METHOD FORMULA_AA2 "FORMULA_AA2" RAT_FUNC "%9.2" "ms" COEFFS 0 7000 0 0 0 1 /end COMPU_METHOD
/begin COMPU_METHOD FORMULA_AA3 "FORMULA_AA3" RAT_FUNC "%7.2" "ms" COEFFS 0 7000 0 0 0 1 /end COMPU_METHOD
/begin COMPU_METHOD FORMULA_AA4 "FORMULA_AA4" RAT_FUNC "%9.2" "ms" COEFFS 0 7000 0 0 0 256 /end COMPU_METHOD
/* TPU AA --------------------------------------------------------------------------------*/ /* TPU IGN FORMELN -----------------------------------------------------------------------*/
/begin COMPU_METHOD FORMULA_IGN1 "FORMULA_IGN1" RAT_FUNC "%7.2" "�" COEFFS 0 1 0 0 0 0.01098633 /end COMPU_METHOD
/begin COMPU_METHOD FORMULA_IGN2 "FORMULA_IGN2" RAT_FUNC "%7.2" "ms" COEFFS 0 1750 0 0 0 1 /end COMPU_METHOD
/begin COMPU_METHOD FORMULA_IGN3 "FORMULA_IGN3" RAT_FUNC "%5.0" "-" COEFFS 0 1 0 0 0 1 /end COMPU_METHOD
/begin COMPU_METHOD FORMULA_IGN4 "FORMULA_IGN4" RAT_FUNC "%5.0" "-" COEFFS 0 32768 0 0 0 1 /end COMPU_METHOD
/begin COMPU_METHOD FORMULA_IGN5 "FORMULA_IGN5" RAT_FUNC "%5.0" "-" COEFFS 0 16384 0 0 0 1 /end COMPU_METHOD
/begin COMPU_METHOD FORMULA_IGN6 "FORMULA_IGN6" RAT_FUNC "%5.0" "-" COEFFS 0 8192 0 0 0 1 /end COMPU_METHOD
/begin COMPU_METHOD FORMULA_IGN7 "FORMULA_IGN7" RAT_FUNC "%5.0" "-" COEFFS 0 4096 0 0 0 1 /end COMPU_METHOD
/begin COMPU_METHOD FORMULA_IGN8 "FORMULA_IGN8" RAT_FUNC "%5.0" "-" COEFFS 0 256 0 0 0 1 /end COMPU_METHOD
/begin COMPU_METHOD FORMULA_IGN9 "FORMULA_IGN9" RAT_FUNC "%5.0" "-" COEFFS 0 512 0 0 0 1 /end COMPU_METHOD
/begin COMPU_METHOD FORMULA_IGN10 "FORMULA_IGN10" RAT_FUNC "%7.2" "ms" COEFFS 0 49000 0 0 0 1 /end COMPU_METHOD
/begin COMPU_METHOD FORMULA_IGN11 "FORMULA_IGN11" RAT_FUNC "%7.2" "ms" COEFFS 0 7000 0 0 0 1 /end COMPU_METHOD
/* TPU IGN Globale Parameter -------------------------------------------------------------*/ /* TPU IGN Parameter Zylinder 1 ----------------------------------------------------------*/ /* TPU IGN Parameter Zylinder 2 ----------------------------------------------------------*/ /* TPU IGN Parameter Zylinder 3 ----------------------------------------------------------*/ /* TPU IGN Parameter Zylinder 4 ----------------------------------------------------------*/ /* TPU IGN Parameter Zylinder 5 ----------------------------------------------------------*/ /* TPU IGN Parameter Zylinder 6 ----------------------------------------------------------*/ /* TPU IGN Parameter Zylinder 7 ----------------------------------------------------------*/ /* TPU IGN Parameter Zylinder 8 ----------------------------------------------------------*/ /* TPU IGN Parameter Zylinder 9 ----------------------------------------------------------*/ /* TPU IGN Parameter Zylinder 10 ----------------------------------------------------------*/ /* TPU APG FORMELN -----------------------------------------------------------------------*/
/begin COMPU_METHOD FORMULA_APG1 "FORMULA_APG1" RAT_FUNC "%7.2" "�" COEFFS 0 1 0 0 0 0.01098633 /end COMPU_METHOD
/begin COMPU_METHOD FORMULA_APG2 "FORMULA_APG2" RAT_FUNC "%9.2" "ms" COEFFS 0 7000 0 0 0 1 /end COMPU_METHOD
/begin COMPU_METHOD FORMULA_APG3 "FORMULA_APG3" RAT_FUNC "%7.2" "ms" COEFFS 0 7000 0 0 0 1 /end COMPU_METHOD
/begin COMPU_METHOD FORMULA_APG4 "FORMULA_APG4" RAT_FUNC "%5.0" "-" COEFFS 0 2048 0 0 0 1 /end COMPU_METHOD
/* TPU APG Bank 1 ------------------------------------------------------------------------*/ /* TPU APG Bank 2 ------------------------------------------------------------------------*/
/begin MOD_PAR "" VERSION "ccp 2.1" ADDR_EPK 0x00070289 EPK "V912" SUPPLIER "" CUSTOMER "" CUSTOMER_NO "" USER "" ECU "MSS65-IGN" /* Description of memory-segments. There has to be a CODE and DATA-Segment to */ /* support the generation of valid flashable HEX-Files */
 /begin MEMORY_SEGMENT CODESEG1 "Program" CODE FLASH INTERN 0x10000 0x60000 -1 -1 -1 -1 -1 /end MEMORY_SEGMENT
 /begin MEMORY_SEGMENT CODESEG2 "Program" CODE FLASH EXTERN 0x450000 0x1B0000 -1 -1 -1 -1 -1 /end MEMORY_SEGMENT
 /begin MEMORY_SEGMENT DATASEG1 "Appl.-DATA" DATA FLASH /* Memorytype; RAM wird nicht unterst�tzt */ INTERN 0x70000 0x10000 -1 -1 -1 -1 -1 /end MEMORY_SEGMENT
 /begin MEMORY_SEGMENT /* The new keyword MEMORY_SEGMENT */ VARSEG "Variablen" VARIABLES RAM INTERN 0x3F8000 0x8000 -1 -1 -1 -1 -1 /end MEMORY_SEGMENT
 /begin CALIBRATION_METHOD "DSERAP" /* Name of Method */ 1 /* Version No. */
  /begin CALIBRATION_HANDLE 0x70000 /* Begin of Calibration-Data */ 0xFFFC /* Length of Calibration-Data */ /end CALIBRATION_HANDLE
 /end CALIBRATION_METHOD
/end MOD_PAR
/begin IF_DATA ASAP1B_CCP /* spezific definition for CCP */ /* schnelle zeitsynchrone DAQ-Liste */
 /begin SOURCE "5 ms" 3 /* Basic Scale Unit: 3 -> 1ms */ 5 /* Rate: 5 * 1ms = 5ms */
  /begin QP_BLOB /* The QP-BLOB specifies the behavior of*/ 0 LENGTH 20 CAN_ID_FIXED 0x410 RASTER 0 FIRST_PID 0 /end QP_BLOB
 /end SOURCE
 /* langsame zeitsynchrone DAQ-Liste */
 /begin SOURCE "100 ms" 5 /* Basic Scale Unit: 5 -> 100ms */ 1 /* Rate: 1 * 100ms = 100ms */
  /begin QP_BLOB /* The QP-BLOB specifies the behavior of*/ 1 LENGTH 10 CAN_ID_FIXED 0x411 RASTER 1 FIRST_PID 20 /end QP_BLOB
 /end SOURCE
 /* winkelsynchrone DAQ-Liste */
 /begin SOURCE "segment-synchron" 103 /* Basic Scale Unit: 103 -> Segment */ 1 /* Rate: 1 * Seg = Seg */
  /begin QP_BLOB /* The QP-BLOB specify the behavior of */ 2 LENGTH 10 CAN_ID_FIXED 0x412 RASTER 2 /* noch pruefen!!!! p_wax */ FIRST_PID 30 /end QP_BLOB
 /end SOURCE
 /begin RASTER "5ms-Task" "5ms" 0 3 /* Scaling Unit: 3 = 1 msec */ 5 /* Rate in Scaling Unit: 5 */ /end RASTER
 /begin RASTER "100ms-Task" "100ms" 1 5 /* Scaling Unit: 5 = 100 msec */ 1 /* Rate in Scaling Unit: 1 */ /end RASTER
 /begin RASTER "sync-Task" "sync" 2 103 /* Scaling Unit: 103 = cylinder segment */ 1 /* Rate in Scaling Unit: 1 */ /end RASTER
 /begin TP_BLOB /* This BLOB describes all parameters */ /* that are necessary for CAN-timing and*/ /* ECU-calibration-technics */ 0x0201 /* CCP-Version V2.1 => 0x0201 */ 0x0202 /* BLOB-Version V2.2 => 0x0202 */ 0x400 /* CAN-ID CCP -> ECU */ 0x401 /* CAN-ID ECU -> CCP */ 0x1234 /* ECU CCP-Address */ 1 /* Byte-order: 1 - High-Byte-First (MOT)*/ /* 2 - Low-Byte-First(INTEL)*/
  /begin CAN_PARAM /* Interface CAN-Conrtoller settings */ 0x01f4 /* CAN-Baudrate in kBd: 0x01F4 = 500 kBd*/ 0x41 /* Bittimingregister BTR0: 0x41 */ 0x25 /* Bittimingregister BTR1: 0x25 */ /end CAN_PARAM
  BAUDRATE 500000 /* Baud rate */ SAMPLE_POINT 66 /* Sampling Point of time in percent */ SAMPLE_RATE 1 /* number of samples per bit */ STORE_SUPPORTED /* ECU supports the Store function */ RESUME_SUPPORTED /* ECU supports the Resume function */
  /begin CHECKSUM_PARAM 0x8009 /* Auswahl Checksum-Funktionen */ 0xFFFC /* Max. Blocklaenge */ CHECKSUM_CALCULATION ACTIVE_PAGE /* akt. Seite berechnen */ /end CHECKSUM_PARAM
  /begin DEFINED_PAGES /* Description of the memory-page */ 1 /* Logical-page-number */ "Workingpage" /* Name of page */ 0x0000 /* Address-Extension */ /* (only low-byte sgnificant) */ 0xc70000 /* Address of Memorypage */ 0x10000 /* Memorysize */ RAM FLASH_BACK /* feature available to flash back the RAM memory page */ DEFAULT /* Page is standard (fallback mode) */ RAM_INIT_BY_ECU /* Initialisationmethode: die ECU initialisiert die WP eigenstaendig */ /* INCA vermeidet mit dieser Einstellung das Senden des MOVE-Commands */ /* beim CCP-Session-Login. */ /end DEFINED_PAGES
  /begin DEFINED_PAGES /* Description of the memory-page */ 2 /* Logical-page-number */ "Referenzpage" /* Name of page */ 0x0000 /* Address-Extension */ /* (only low-byte sgnificant) */ 0x70000 /* Address of Memorypage */ 0x10000 /* Memorysize */ FLASH RAM_INIT_BY_ECU /* Initialisationmethode: die ECU initialisiert die WP eigenstaendig */ /* INCA vermeidet mit dieser Einstellung das Senden des MOVE-Commands */ /* beim CCP-Session-Login. */ /end DEFINED_PAGES
  OPTIONAL_CMD 0x0C /* GetSessionStatus */ OPTIONAL_CMD 0x0D /* SetSessionStatus */ OPTIONAL_CMD 0x0E /* BuildChecksum */ OPTIONAL_CMD 0x09 /* GetCalPage */ OPTIONAL_CMD 0x10 /* Clear Memory */ OPTIONAL_CMD 0x11 /* SelectCalPage */ OPTIONAL_CMD 0x12 /* GetSeed */ OPTIONAL_CMD 0x13 /* Unlock */ OPTIONAL_CMD 0x18 /* Programm */ OPTIONAL_CMD 0x19 /* Move */ OPTIONAL_CMD 0x22 /* Programm6 */ OPTIONAL_CMD 0x23 /* Download6 */ /end TP_BLOB
/end IF_DATA
/begin IF_DATA ASAP1B_KWP2000
 /begin SOURCE "timeslot" 0 0 QP_BLOB 0 BLOCKMODE 0xf0 0 20 /end SOURCE
 /begin TP_BLOB 0x0100 /* blob Version */ 0x11 /* ECU address on k line */ 0xF1 /* required tester address */ WuP /* stimulation mode of ECU: WuP */ MSB_FIRST /* byte order in measurements and characteristics */ 1 /* 1: 1st startDiagnosticSession without baudrate switch */ 0x00000 /* Project base address (PBA) */ /*SERAM SERAM_A SERAM_U SERAM_O SERAM_E Flash addr RAM addr Data rd code ver Code read Load mode*/ SERAM 0x60100 0x60100 0x6FAFF 0x6FAFF 0 0 1 0 0 1
  /begin CHECKSUM 0x010201 /* check sum type qualifier (see table) */ 1 /* 1: check sum calculation only on active page */ 1 /* No of local routine for check sum */ RequestRoutineResults /* result of checksum routine delivered by */ RNC_RESULT 0x23 /* only at 'RequestRoutineResults': */ /* result codes, that sign 'calculation in progress' */ /end CHECKSUM
  /begin FLASH_COPY TOOLFLASHBACK /* ECU mode for copying RAM into Flash */ 3 /* No of local routine for copy Flash to RAM */ RequestRoutineResults /* result of copy routine delivered by */ RAM_InitByECU /* ECU mode for copying Flash into RAM */ 0x86 /* diagnostic mode for copy RAM to Flash */ COPY_FRAME 1 /* list of page frames to be copied */ RNC_RESULT 0x23 0xfb 0xfc /* only at 'RequestRoutineResults': */ /* result codes, that sign 'copy in progress' */ /* COPY_PARA */ /* list of add. parameters for local routine */ /end FLASH_COPY
  /*Baudrate switch: BaudRate DiagMode i,k for ECU baudrate*/ /* BAUD_DEF 250000 0x86 0xA7 */ /* BAUD_DEF 125000 0x86 0x87 */ /* BAUD_DEF 111111 0x86 0x84 */ /* BAUD_DEF 55555 0x86 0x64 */ /* BAUD_DEF 10400 0x86 0x14 */ /*Timing parameter: p1Max p2Min p2Max p3Min p3Max p4Min */ /*Timing parameter: p1Max p2Min p2Max p3Min p3Max p4Min */ /* TIME_DEF 1 0 50 0 500 0 */ /* TIME_DEF 2 0 50 0 500 0 */ /* TIME_DEF 5 1 100 1 500 0 */ /* TIME_DEF 10 1 500 2 1000 1 */ TIME_DEF 20 2 25 28 250 0 /end TP_BLOB
/end IF_DATA
/begin IF_DATA EDIC_ISO_DS2 "V1.0" 0x12 25 1 SUPP_SERVICE READMEM SUPP_SERVICE WRITEMEM SUPP_SERVICE ACK TELDATA 0x9E /end IF_DATA
/begin COMPU_METHOD DEFAULT_FORMULA "DEFAULT_FORMULA" RAT_FUNC "%7.0" "" COEFFS 0 1 0 0 0 1 /end COMPU_METHOD
/begin COMPU_METHOD FORMULA_0001 "FORMULA_0001" RAT_FUNC "%6.1" "%" COEFFS 0 10 0 0 0 1 /end COMPU_METHOD
/begin COMPU_METHOD FORMULA_0002 "FORMULA_0002" TAB_VERB "%3.0" "-" COMPU_TAB_REF FORMULA_0002_VTAB /end COMPU_METHOD
/begin COMPU_VTAB FORMULA_0002_VTAB "FORMULA_0002_VTAB" TAB_VERB 4 0 "in Ordnung" 128 "queue full" 64 "queue fehler" 32 "IRQ illegal" DEFAULT_VALUE "undefiniert" /end COMPU_VTAB
/begin COMPU_METHOD FORMULA_0003 "FORMULA_0003" RAT_FUNC "%3.0" "-" COEFFS 0 1 0 0 0 1 /end COMPU_METHOD
/begin COMPU_METHOD FORMULA_0004 "FORMULA_0004" TAB_VERB "%5.2" "-" COMPU_TAB_REF FORMULA_0004_VTAB /end COMPU_METHOD
/begin COMPU_VTAB FORMULA_0004_VTAB "FORMULA_0004_VTAB" TAB_VERB 9 0 "OK" 1 "NR CS0" 2 "NR CS1" 4 "NR CS2" 8 "NR CS3" 16 "CNT CS0" 17 "CNT CS1" 18 "CNT CS2" 20 "CNT CS3" /end COMPU_VTAB
/begin COMPU_METHOD FORMULA_0005 "FORMULA_0005" TAB_VERB "%5.2" "-" COMPU_TAB_REF FORMULA_0005_VTAB /end COMPU_METHOD
/begin COMPU_VTAB FORMULA_0005_VTAB "FORMULA_0005_VTAB" TAB_VERB 7 0 "OK" 1 "Seg-Kanal" 2 "5ms-Kanal" 4 "10ms-Kanal" 8 "100ms-Kanal" 16 "bgnd-Kanal" 32 "kwp-Kanal" DEFAULT_VALUE "ungueltig" /end COMPU_VTAB
/begin COMPU_METHOD FORMULA_0006 "FORMULA_0006" RAT_FUNC "%5.0" "Upm" COEFFS 0 1 0 0 0 1 /end COMPU_METHOD
/begin COMPU_METHOD FORMULA_0007 "FORMULA_0007" RAT_FUNC "%8.3" "-" COEFFS 0 10000 0 0 0 1 /end COMPU_METHOD
/begin COMPU_METHOD FORMULA_0008 "FORMULA_0008" RAT_FUNC "%6.1" "V" COEFFS 0 10 0 0 0 1 /end COMPU_METHOD
/begin COMPU_METHOD FORMULA_0009 "FORMULA_0009" RAT_FUNC "%6.1" "Nm" COEFFS 0 10 0 0 0 1 /end COMPU_METHOD
/begin COMPU_METHOD FORMULA_0010 "FORMULA_0010" RAT_FUNC "%5.0" "-" COEFFS 0 1 0 0 0 1 /end COMPU_METHOD
/begin COMPU_METHOD FORMULA_0011 "FORMULA_0011" TAB_VERB "%5.0" "-" COMPU_TAB_REF FORMULA_0011_VTAB /end COMPU_METHOD
/begin COMPU_VTAB FORMULA_0011_VTAB "FORMULA_0011_VTAB" TAB_VERB 15 0 "kein Fehler" 1 "Egasueberwachung" 2 "Momentenueberwachung" 4 "Einspritzueberwachung" 8 "SMG-Ueberwachung" 16 "Systemfehler" 32 "Stackueberwachung" 64 "Resetanzahl" 128 "Gemischfehler" 256 "Klopfregelung" 512 "CRC-Check" 1024 "Taskueberwachung" 2048 "Prozessueberwachung" 4096 "Pedalwertgeber" 8192 "Mastervac" DEFAULT_VALUE "undef" /end COMPU_VTAB
/begin COMPU_METHOD FORMULA_0012 "FORMULA_0012" TAB_VERB "%3.0" "-" COMPU_TAB_REF FORMULA_0012_VTAB /end COMPU_METHOD
/begin COMPU_VTAB FORMULA_0012_VTAB "FORMULA_0012_VTAB" TAB_VERB 1 0 "iO" DEFAULT_VALUE "Fehler" /end COMPU_VTAB
/begin COMPU_METHOD FORMULA_0013 "FORMULA_0013" TAB_VERB "%3.0" "-" COMPU_TAB_REF FORMULA_0013_VTAB /end COMPU_METHOD
/begin COMPU_VTAB FORMULA_0013_VTAB "FORMULA_0013_VTAB" TAB_VERB 5 0 "CRC iO" 1 "D-Fehler" 2 "P-Fehler" 3 "PD-Fehler" 4 "B-Fehler" DEFAULT_VALUE "Mehrfachfehler" /end COMPU_VTAB
/begin COMPU_METHOD FORMULA_0014 "FORMULA_0014" TAB_VERB "%3.0" "-" COMPU_TAB_REF FORMULA_0014_VTAB /end COMPU_METHOD
/begin COMPU_VTAB FORMULA_0014_VTAB "FORMULA_0014_VTAB" TAB_VERB 5 0 "OK" 3 "ID" 4 "Limit" 11 "Overrun" 14 "Stack" /end COMPU_VTAB
/begin COMPU_METHOD FORMULA_0015 "FORMULA_0015" TAB_VERB "%5.0" "-" COMPU_TAB_REF FORMULA_0015_VTAB /end COMPU_METHOD
/begin COMPU_VTAB FORMULA_0015_VTAB "FORMULA_0015_VTAB" TAB_VERB 6 512 "MCI" 768 "DataAcc" 1024 "IntrAcc" 1536 "Align" 1792 "PrgExc" 8192 "NMI" /end COMPU_VTAB
/begin COMPU_METHOD FORMULA_0016 "FORMULA_0016" TAB_VERB "%3.0" "-" COMPU_TAB_REF FORMULA_0016_VTAB /end COMPU_METHOD
/begin COMPU_VTAB FORMULA_0016_VTAB "FORMULA_0016_VTAB" TAB_VERB 13 0 "ini" 1 "1st edge" 2 "second edge" 3 "wait teeth" 4 "search gap" 5 "1st missing required" 6 "last tooth until gap" 7 "1st missing tooth" 8 "2nd missing tooth" 9 "1st tooth after gap" 10 "2nd tooth after gap" 11 "tooth 2..56, 62..116" 12 "gap required" DEFAULT_VALUE "undefined" /end COMPU_VTAB
/begin COMPU_METHOD FORMULA_0018 "FORMULA_0018" RAT_FUNC "%5.0" "us" COEFFS 0 1 0 0 0 1 /end COMPU_METHOD
/begin COMPU_METHOD FORMULA_0019 "FORMULA_0019" TAB_VERB "%7.2" "-" COMPU_TAB_REF FORMULA_0019_VTAB /end COMPU_METHOD
/begin COMPU_VTAB FORMULA_0019_VTAB "FORMULA_0019_VTAB" TAB_VERB 13 1 "Motor steht" 2 "Motor presync" 4 "Start" 8 "LLOKS" 16 "LLMKS" 32 "TL" 64 "VL" 128 "SA" 256 "NL" 512 "Abgew." 1024 "Kl15 aus" 2048 "Wakeup" 4096 "Schub" DEFAULT_VALUE "undefiniert" /end COMPU_VTAB
/begin COMPU_METHOD FORMULA_0021 "FORMULA_0021" RAT_FUNC "%7.2" "s" COEFFS 0 100 0 0 0 1 /end COMPU_METHOD
/* ------------------ Abschnitt erzeugt aus adapt_glob.dat ------------------ */
/begin COMPU_METHOD FORMULA_0023 "FORMULA_0023" RAT_FUNC "%6.1" "�C" COEFFS 0 10 2732 0 0 1 /end COMPU_METHOD
/begin COMPU_METHOD FORMULA_0025 "FORMULA_0025" RAT_FUNC "%8.3" "-" COEFFS 0 16384 0 0 0 1 /end COMPU_METHOD
/begin COMPU_METHOD FORMULA_0026 "FORMULA_0026" TAB_VERB "%3.0" "-" COMPU_TAB_REF FORMULA_0026_VTAB /end COMPU_METHOD
/begin COMPU_VTAB FORMULA_0026_VTAB "FORMULA_0026_VTAB" TAB_VERB 4 0 "off" 1 "Fertigungsmode" 2 "Transportmode" 4 "Werkstattmode" DEFAULT_VALUE "off" /end COMPU_VTAB
/begin COMPU_METHOD FORMULA_0027 "FORMULA_0027" RAT_FUNC "%7.0" "km" COEFFS 0 1 0 0 0 1 /end COMPU_METHOD
/begin COMPU_METHOD FORMULA_0028 "FORMULA_0028" TAB_VERB "%3.0" "-" COMPU_TAB_REF FORMULA_0028_VTAB /end COMPU_METHOD
/begin COMPU_VTAB FORMULA_0028_VTAB "FORMULA_0028_VTAB" TAB_VERB 7 0 "kein Land" 1 "ECE" 2 "US" 3 "D" 4 "GB" 5 "J" 255 "ungueltig" /end COMPU_VTAB
/begin COMPU_METHOD FORMULA_0029 "FORMULA_0029" TAB_VERB "%3.0" "-" COMPU_TAB_REF FORMULA_0029_VTAB /end COMPU_METHOD
/begin COMPU_VTAB FORMULA_0029_VTAB "FORMULA_0029_VTAB" TAB_VERB 9 0 "keine Angabe" 4 "E60" 5 "E61" 6 "E63" 7 "E64" 8 "E90" 13 "E91" 14 "E92" 15 "E93" DEFAULT_VALUE "ungueltig" /end COMPU_VTAB
/begin COMPU_METHOD FORMULA_0030 "FORMULA_0030" TAB_VERB "%3.0" "-" COMPU_TAB_REF FORMULA_0030_VTAB /end COMPU_METHOD
/begin COMPU_VTAB FORMULA_0030_VTAB "FORMULA_0030_VTAB" TAB_VERB 3 0 "v_max 250" 1 "reserviert" 2 "v_max angehoben" DEFAULT_VALUE "undef" /end COMPU_VTAB
/begin COMPU_METHOD FORMULA_0031 "FORMULA_0031" TAB_VERB "%3.0" "-" COMPU_TAB_REF FORMULA_0031_VTAB /end COMPU_METHOD
/begin COMPU_VTAB FORMULA_0031_VTAB "FORMULA_0031_VTAB" TAB_VERB 5 0 "HS" 1 "Automat" 2 "Steptronic" 3 "SMG" 15 "ungueltig" /end COMPU_VTAB
/begin COMPU_METHOD FORMULA_0032 "FORMULA_0032" RAT_FUNC "%3.0" "%" COEFFS 0 1 0 0 0 1 /end COMPU_METHOD
/begin COMPU_METHOD FORMULA_0033 "FORMULA_0033" RAT_FUNC "%5.2" "-" COEFFS 0 1 0 0 0 1 /end COMPU_METHOD
/begin COMPU_METHOD FORMULA_0034 "FORMULA_0034" TAB_VERB "%5.2" "-" COMPU_TAB_REF FORMULA_0034_VTAB /end COMPU_METHOD
/begin COMPU_VTAB FORMULA_0034_VTAB "FORMULA_0034_VTAB" TAB_VERB 1 0 "erfuellt" DEFAULT_VALUE "offen" /end COMPU_VTAB
/begin COMPU_METHOD FORMULA_0035 "FORMULA_0035" TAB_VERB "%5.2" "-" COMPU_TAB_REF FORMULA_0035_VTAB /end COMPU_METHOD
/begin COMPU_VTAB FORMULA_0035_VTAB "FORMULA_0035_VTAB" TAB_VERB 1 0 "erfuellt" DEFAULT_VALUE "offen" /end COMPU_VTAB
/begin COMPU_METHOD FORMULA_0036 "FORMULA_0036" TAB_VERB "%5.2" "-" COMPU_TAB_REF FORMULA_0036_VTAB /end COMPU_METHOD
/begin COMPU_VTAB FORMULA_0036_VTAB "FORMULA_0036_VTAB" TAB_VERB 1 0 "erfuellt" DEFAULT_VALUE "offen" /end COMPU_VTAB
/begin COMPU_METHOD FORMULA_0037 "FORMULA_0037" TAB_VERB "%5.2" "-" COMPU_TAB_REF FORMULA_0037_VTAB /end COMPU_METHOD
/begin COMPU_VTAB FORMULA_0037_VTAB "FORMULA_0037_VTAB" TAB_VERB 1 0 "erfuellt" DEFAULT_VALUE "offen" /end COMPU_VTAB
/begin COMPU_METHOD FORMULA_0038 "FORMULA_0038" TAB_VERB "%5.2" "-" COMPU_TAB_REF FORMULA_0038_VTAB /end COMPU_METHOD
/begin COMPU_VTAB FORMULA_0038_VTAB "FORMULA_0038_VTAB" TAB_VERB 1 0 "erfuellt" DEFAULT_VALUE "offen" /end COMPU_VTAB
/* ------------------ Abschnitt erzeugt aus crc32.dat ------------------ */
/begin COMPU_METHOD FORMULA_0039 "FORMULA_0039" TAB_VERB "%3.0" "-" COMPU_TAB_REF FORMULA_0039_VTAB /end COMPU_METHOD
/begin COMPU_VTAB FORMULA_0039_VTAB "FORMULA_0039_VTAB" TAB_VERB 4 0 "CRC iO" 1 "Daten falsch" 2 "Prog falsch" 4 "Booter falsch" DEFAULT_VALUE "Mehrfachfehler" /end COMPU_VTAB
/begin COMPU_METHOD FORMULA_0040 "FORMULA_0040" TAB_VERB "%3.0" "-" COMPU_TAB_REF FORMULA_0040_VTAB /end COMPU_METHOD
/begin COMPU_VTAB FORMULA_0040_VTAB "FORMULA_0040_VTAB" TAB_VERB 4 0 "Inaktiv" 1 "Start" 2 "Aktiv" 3 "Ende" DEFAULT_VALUE "undef" /end COMPU_VTAB
/* ------------------ Abschnitt erzeugt aus debug.dat ------------------ */
/begin COMPU_METHOD FORMULA_0041 "FORMULA_0041" RAT_FUNC "%9.2" "-" COEFFS 0 1 0 0 0 1 /end COMPU_METHOD
/* ------------------ Abschnitt erzeugt aus ed_glob.dat ------------------ */
/begin COMPU_METHOD FORMULA_0042 "FORMULA_0042" TAB_VERB "%5.2" "-" COMPU_TAB_REF FORMULA_0042_VTAB /end COMPU_METHOD
/begin COMPU_VTAB FORMULA_0042_VTAB "FORMULA_0042_VTAB" TAB_VERB 1 0 "kein WUC" DEFAULT_VALUE "Warmcycle" /end COMPU_VTAB
/begin COMPU_METHOD FORMULA_0043 "FORMULA_0043" TAB_VERB "%5.2" "-" COMPU_TAB_REF FORMULA_0043_VTAB /end COMPU_METHOD
/begin COMPU_VTAB FORMULA_0043_VTAB "FORMULA_0043_VTAB" TAB_VERB 1 0 "Kein Cycle" DEFAULT_VALUE "Rate-Based-DCY" /end COMPU_VTAB
/begin COMPU_METHOD FORMULA_0044 "FORMULA_0044" TAB_VERB "%5.2" "-" COMPU_TAB_REF FORMULA_0044_VTAB /end COMPU_METHOD
/begin COMPU_VTAB FORMULA_0044_VTAB "FORMULA_0044_VTAB" TAB_VERB 1 0 "Kein RBM-EVAP" DEFAULT_VALUE "RBM-EVAP" /end COMPU_VTAB
/begin COMPU_METHOD FORMULA_0045 "FORMULA_0045" TAB_VERB "%5.2" "-" COMPU_TAB_REF FORMULA_0045_VTAB /end COMPU_METHOD
/begin COMPU_VTAB FORMULA_0045_VTAB "FORMULA_0045_VTAB" TAB_VERB 1 0 "Kein RBM-SLP" DEFAULT_VALUE "RBM-SLP" /end COMPU_VTAB
/begin COMPU_METHOD FORMULA_0046 "FORMULA_0046" TAB_VERB "%5.2" "-" COMPU_TAB_REF FORMULA_0046_VTAB /end COMPU_METHOD
/begin COMPU_VTAB FORMULA_0046_VTAB "FORMULA_0046_VTAB" TAB_VERB 1 0 "Kein Abbruch" DEFAULT_VALUE "Abbruch" /end COMPU_VTAB
/begin COMPU_METHOD FORMULA_0047 "FORMULA_0047" TAB_VERB "%5.2" "-" COMPU_TAB_REF FORMULA_0047_VTAB /end COMPU_METHOD
/begin COMPU_VTAB FORMULA_0047_VTAB "FORMULA_0047_VTAB" TAB_VERB 1 0 "Kein CSS-DEN" DEFAULT_VALUE "CSS-DEN" /end COMPU_VTAB
/begin COMPU_METHOD FORMULA_0048 "FORMULA_0048" TAB_VERB "%5.2" "-" COMPU_TAB_REF FORMULA_0048_VTAB /end COMPU_METHOD
/begin COMPU_VTAB FORMULA_0048_VTAB "FORMULA_0048_VTAB" TAB_VERB 1 0 "Kein CSS-NUM" DEFAULT_VALUE "CSS-NUM" /end COMPU_VTAB
/begin COMPU_METHOD FORMULA_0049 "FORMULA_0049" TAB_VERB "%7.2" "-" COMPU_TAB_REF FORMULA_0049_VTAB /end COMPU_METHOD
/begin COMPU_VTAB FORMULA_0049_VTAB "FORMULA_0049_VTAB" TAB_VERB 44 0 "O.K." 1 "SH_TO_UB" 2 "SH_TO_GND" 4 "OPENLOAD" 8 "UNPLAUSI" 256 "O.K./ZYKLUS" 512 "FILTER" 513 "FIL/SH_TO_UB" 514 "FIL/SH_TO_GND" 516 "FIL/OPENLOAD" 520 "FIL/UNPLAUSI" 576 "VORHANDEN" 577 "VORH/SH_TO_UB" 578 "VORH/SH_TO_GND" 580 "VORH/OPENLOAD" 584 "VORH/UNPLAUSI" 768 "FILTER/ZYKLUS" 769 "FIL/ZYK/SH_TO_UB" 770 "FIL/ZYK/SH_TO_GND" 772 "FIL/ZYK/OPENLOAD" 776 "FIL/ZYK/UNPLAUSI" 832 "VORHANDEN/ZYKLUS" 833 "VORH/ZYK/SH_TO_UB" 834 "VORH/ZYK/SH_TO_GND" 836 "VORH/ZYK/OPENLOAD" 840 "VORH/ZYK/UNPLAUSI" 2048 "O.K./SCDN" 2304 "O.K./S/ZYKLUS" 2561 "FIL/S/SH_TO_UB" 2562 "FIL/S/SH_TO_GND" 2564 "FIL/S/OPENLOAD" 2568 "FIL/S/UNPLAUSI" 2625 "VORH/S/SH_TO_UB" 2626 "VORH/S/SH_TO_GND" 2628 "VORH/S/OPENLOAD" 2632 "VORH/S/UNPLAUSI" 2817 "FIL/ZYK/S/SH_TO_UB" 2818 "FIL/ZYK/S/SH_TO_GND" 2820 "FIL/ZYK/S/OPENLOAD" 2824 "FIL/ZYK/S/UNPLAUSI" 2881 "VORH/ZYK/S/SH_TO_UB" 2882 "VORH/ZYK/S/SH_TO_GND" 2884 "VORH/ZYK/S/OPENLOAD" 2888 "VORH/ZYK/S/UNPLAUSI" /end COMPU_VTAB
/begin COMPU_METHOD FORMULA_0050 "FORMULA_0050" TAB_VERB "%5.0" "-" COMPU_TAB_REF FORMULA_0050_VTAB /end COMPU_METHOD
/begin COMPU_VTAB FORMULA_0050_VTAB "FORMULA_0050_VTAB" TAB_VERB 352 10000 "SK_INJ_TESTFEHLER" 10001 "PUMG_FEHLER" 10002 "HFM1_FEHLER" 10003 "HFM2_FEHLER" 10004 "PSAU1_FEHLER" 10005 "PSAU2_FEHLER" 10006 "VAN_HALL_E1_FEHLER" 10007 "VAN_HALL_A1_FEHLER" 10008 "VAN_HALL_E2_FEHLER" 10009 "VAN_HALL_A2_FEHLER" 10010 "VAN_REGL_E1_FEHLER" 10011 "VAN_REGL_A1_FEHLER" 10012 "VAN_REGL_E2_FEHLER" 10013 "VAN_REGL_A2_FEHLER" 10014 "NW1_SYNC_FEHLER" 10015 "NW2_SYNC_FEHLER" 10016 "PCTRL_IGN_FEHLER" 10017 "PT_TORQDKG_FEHLER" 10018 "PKS_FEHLER" 10019 "PT_STATUSR_FEHLER" 10020 "LAVK1_FEHLER" 10021 "LAVK2_FEHLER" 10022 "LAVK1_OBD_PLAU_FEHLER" 10023 "LAVK2_OBD_PLAU_FEHLER" 10024 "LAVK1_OBD_SA_FEHLER" 10025 "LAVK2_OBD_SA_FEHLER" 10026 "LANK1_FEHLER" 10027 "LANK2_FEHLER" 10028 "LSHNK1_FEHLER" 10029 "LSHNK2_FEHLER" 52615 "PT_BUSOFF" 52632 "PT_TORQDSC_FEHLER" 52645 "PT_STDSC_FEHLER" 52667 "PT_VRAD_FEHLER" 52636 "PT_VFZG_FEHLER" 52628 "PT_ATEMP_FEHLER" 52640 "PT_KLST_FEHLER" 52649 "PT_KKOS_FEHLER" 52641 "PT_LRW_FEHLER" 10039 "FPLAU1_FEHLER" 10040 "FPLAU2_FEHLER" 10041 "SL_ML_HFM_FEHLER" 10042 "LANK1_OBD_S_FEHLER" 10043 "LANK2_OBD_S_FEHLER" 10044 "LAVK1_OBD_TL_FEHLER" 10045 "LAVK2_OBD_TL_FEHLER" 10046 "LSHVK1_FEHLER" 10047 "LSHVK2_FEHLER" 10048 "LSRVK1_OBD_REG_FEHLER" 10049 "LSRVK2_OBD_REG_FEHLER" 10050 "LSHVK1_R_FEHLER" 10051 "LSHVK2_R_FEHLER" 10052 "LSRVK1_OBD_START_FEHLER" 10053 "LSRVK2_OBD_START_FEHLER" 10054 "LSRVK1_OBD_REF_FEHLER" 10055 "LSRVK2_OBD_REF_FEHLER" 10056 "LAVK1_DIAG_FEHLER" 10057 "LAVK2_DIAG_FEHLER" 10058 "LAVK1_IA_OPENLOAD_FEHLER" 10059 "LAVK2_IA_OPENLOAD_FEHLER" 10060 "PT_GRB_FEHLER" 10061 "PT_GRB2_FEHLER" 10062 "LAVK1_UN_OPENLOAD_FEHLER" 10063 "LAVK2_UN_OPENLOAD_FEHLER" 10064 "LAVK1_IP_OPENLOAD_FEHLER" 10065 "LAVK2_IP_OPENLOAD_FEHLER" 10066 "APPL_DATA_INJ" 10067 "TZ1_FEHLER" 10068 "TZ2_FEHLER" 10069 "TZ3_FEHLER" 10070 "TZ4_FEHLER" 10071 "TZ5_FEHLER" 10072 "TZ6_FEHLER" 10073 "TZ7_FEHLER" 10074 "TZ8_FEHLER" 10075 "TZ9_FEHLER" 10076 "TZ10_FEHLER" 10077 "LAM1_REG_FEHLER" 10078 "LAM2_REG_FEHLER" 10079 "VAN_ANSCHL_E1_FEHLER" 10080 "VAN_ANSCHL_A1_FEHLER" 10081 "VAN_ANSCHL_E2_FEHLER" 10082 "VAN_ANSCHL_A2_FEHLER" 10083 "VAN_VENT_E1_FEHLER" 10084 "VAN_VENT_A1_FEHLER" 10085 "VAN_VENT_E2_FEHLER" 10086 "VAN_VENT_A2_FEHLER" 10087 "EV1_FEHLER" 10088 "EV2_FEHLER" 10089 "EV3_FEHLER" 10090 "EV4_FEHLER" 10091 "EV5_FEHLER" 10092 "EV6_FEHLER" 10093 "EV7_FEHLER" 10094 "EV8_FEHLER" 10095 "EV9_FEHLER" 10096 "EV10_FEHLER" 10097 "LAVK1_OBD_DYN_FEHLER" 10098 "LAVK2_OBD_DYN_FEHLER" 52650 "PT_CRASH_FEHLER" 52635 "PT_VEHMOD_FEHLER" 52629 "PT_BEDFGR_FEHLER" 10102 "DMTL_P_FEHLER" 10103 "DMTL_V_FEHLER" 10104 "DMTL_H_FEHLER" 10105 "DMTL_GROBLECK_FEHLER" 10106 "DMTL_FEUCHT_FEHLER" 10107 "DMTL_DECKEL_MELDUNG" 10108 "LA1_TRIM_FEHLER" 10109 "LA2_TRIM_FEHLER" 10110 "RLU87_FEHLER" 10111 "EKP_PWM_FEHLER" 10112 "SSP_FEHLER" 10113 "TD_FEHLER" 10114 "RLSLP_FEHLER" 10115 "SLV_FEHLER" 52639 "PT_KMST_FEHLER" 52648 "PT_STATKOM_FEHLER" 10118 "PKS_LL_FEHLER" 10119 "PKS_TL_FEHLER" 10120 "PKS_Q_FEHLER" 10121 "KAT_OBD1_FEHLER" 10122 "KAT_OBD2_FEHLER" 10123 "VAN_DSV_FEHLER" 10124 "FI_GEN" 10125 "FI_BSD" 10126 "FI_QLT" 10127 "FI_IBS1" 10128 "FI_IBS2" 10129 "FI_IBS3" 10130 "FI_PMBN" 10131 "FI_PMBATT" 10132 "MVAC_DRUCKSENSOR" 52668 "PT_BEDAT_FEHLER" 10134 "SK_MANAGER_INJ" 10135 "SSP_DIAG_FEHLER" 10136 "EWS_SCI_FEHLER" 10137 "EWS_MAN_FEHLER" 10138 "FI_BSD_0" 10139 "FI_BSD_6" 10140 "FI_BSDGLOB" 10141 "FI_PMRUHVERL" 10142 "FI_TOENS" 10143 "EBOX_ELU_FEHLER" 10144 "SG_INJ_FEHLER" 10145 "EGAS_ENLTG1_DIAG" 10146 "EGAS_ENLTG2_DIAG" 10147 "S_POEL_FEHLER" 10148 "TEV1_OBD_FEHLER" 10149 "TEV2_OBD_FEHLER" 10150 "TEV1_FEHLER" 10151 "TEV2_FEHLER" 10152 "EBENE2_INJ_FEHLER" 10153 "KW_FEHLER" 10154 "LA1_ADAPT_FEHLER" 10155 "LA2_ADAPT_FEHLER" 10156 "KGE1_FEHLER" 10157 "KGE2_FEHLER" 10158 "FST_FEHLER" 10159 "SLP_FEHLER" 10160 "SL_DURCHS_B1" 10161 "SL_DURCHS_B2" 10162 "SL_DURCHS_HSTRANG" 10163 "FETRAWE_FEHLER" 10164 "S_GETR_HS_FEHLER" 10165 "S_KUPP_HS_FEHLER" 10166 "VAN_DRUCK_FEHLER" 10167 "ELUP_FEHLER" 10168 "ELU_FEHLER" 52655 "PT_STATANH_FEHLER" 10170 "KSD1_FEHLER" 10171 "KSD2_FEHLER" 10172 "KATS1_FEHLER" 10173 "KATS2_FEHLER" 10174 "PT_STATGRB_FEHLER" 10175 "PT_ANFRADMOM_FEHLER" 10176 "FST_GEBER_FEHLER" 10177 "TANK_LEER_INFO" 10178 "PT_TOMA_FEHLER" 10179 "DMTL_FEINLECK_FEHLER" 10180 "PUMG_OBD_FEHLER" 10181 "SL_ML_HFM_OBD_FEHLER" 10182 "LA1_TRIM_AD_FEHLER" 10183 "LA2_TRIM_AD_FEHLER" 10184 "LANK1_OPENLOAD_FEHLER" 10185 "LANK2_OPENLOAD_FEHLER" 10186 "LANK1_OBD_WE_FEHLER" 10187 "LANK2_OBD_WE_FEHLER" 10188 "LSHNK1_R_FEHLER" 10189 "LSHNK2_R_FEHLER" 10190 "PKS_MODELL_FEHLER" 10191 "PKS_PAUFBAU_FEHLER" 10192 "PKSR_ADAPT_ANSCHL_FEHLER" 10193 "TGETR_FEHLER" 10194 "LAVK_ATIC42_FEHLER" 10195 "PT_ALAENGS_FEHLER" 10196 "PT_OBD_ED_FEHLER" 10197 "FST_GEBER_LI_FEHLER" 10198 "FST_GEBER_RE_FEHLER" 10199 "LANK1_OBD_SLOPE_FEHLER" 10200 "LANK2_OBD_SLOPE_FEHLER" 10201 "MVAC_OBD_FEHLER" 10202 "ELUP_OBD_FEHLER" 10203 "LAVK2_ATIC42_FEHLER" 10204 "INDEX_204_INJ" 10205 "INDEX_205_INJ" 10206 "INDEX_206_INJ" 10207 "INDEX_207_INJ" 10208 "INDEX_208_INJ" 10209 "INDEX_209_INJ" 10210 "INDEX_210_INJ" 10211 "INDEX_211_INJ" 10212 "INDEX_212_INJ" 10213 "INDEX_213_INJ" 10214 "INDEX_214_INJ" 10215 "INDEX_215_INJ" 10216 "INDEX_216_INJ" 10217 "INDEX_217_INJ" 10218 "INDEX_218_INJ" 10219 "INDEX_219_INJ" 10220 "INDEX_220_INJ" 10221 "INDEX_221_INJ" 10222 "INDEX_222_INJ" 10223 "INDEX_223_INJ" 11000 "SK_IGN_TESTFEHLER" 11001 "TMOT_FEHLER" 11002 "TMOT_OBD_FEHLER" 11003 "TAN1_FEHLER" 11004 "TAN2_FEHLER" 11005 "TIME_REL_OBD_FEHLER" 11006 "UB_FEHLER" 11007 "TKA_FEHLER" 11008 "TDME_FEHLER" 11009 "UEXT_111_219_514_FEHLER" 11010 "UEXT_124_512_FEHLER" 11011 "APPL_DATA_IGN" 11012 "TKA_OBD_FEHLER" 11013 "PWG1_FEHLER" 11014 "PWG2_FEHLER" 11015 "PWG_VGL_FEHLER" 11016 "PCTRL_INJ_FEHLER" 52669 "EC_LLS1_FEHLER" 52670 "EC_LLS2_FEHLER" 52671 "EC_DK1_FEHLER" 52672 "EC_DK2_FEHLER" 11021 "LLS1_SK_FEHLER" 11022 "LLS2_SK_FEHLER" 11023 "SMG_SCHALTABLAUF" 11024 "SMG_SK_FEHLER" 11025 "SMG_SK_N_UEBERWACHUNG" 11026 "TUMG_OBD_FEHLER" 11027 "V_FEHLER" 11028 "DK_INIT_FEHLER" 11029 "DK1_REG_FEHLER" 11030 "DK2_REG_FEHLER" 11031 "DK1_ADAPT_FEHLER" 11032 "DK2_ADAPT_FEHLER" 11033 "IONVERST_B1" 11034 "IONSPG_B1" 11035 "IONVERST_B2" 11036 "IONSPG_B2" 11037 "TABG1_FEHLER" 11038 "TABG2_FEHLER" 11039 "DK1_WDK_FEHLER" 11040 "DK2_WDK_FEHLER" 11041 "DK1_PDR_FEHLER" 11042 "DK2_PDR_FEHLER" 11043 "LLS1_REG_FEHLER" 11044 "LLS2_REG_FEHLER" 11045 "DK1_SK_FEHLER" 11046 "DK2_SK_FEHLER" 11047 "DK1_FT_FEHLER" 11048 "DK2_FT_FEHLER" 11049 "MD_SK_ERR" 11050 "LLS_INIT_FEHLER" 11051 "DSC_EINGR_FEHLER" 11052 "DK1_CMD_FEHLER" 11053 "DK2_CMD_FEHLER" 11054 "LLS1_CMD_FEHLER" 11055 "LLS2_CMD_FEHLER" 52673 "SC_SMG1_FEHLER" 52674 "SC_SMG2_FEHLER" 52675 "SC_SMG3_FEHLER" 52619 "SC_BUSOFF_FEHLER" 52627 "EC_BUSOFF_FEHLER" 11061 "AUSS_KAT_Z1_FEHLER" 11062 "AUSS_KAT_Z2_FEHLER" 11063 "AUSS_KAT_Z3_FEHLER" 11064 "AUSS_KAT_Z4_FEHLER" 11065 "AUSS_KAT_Z5_FEHLER" 11066 "AUSS_KAT_Z6_FEHLER" 11067 "AUSS_KAT_Z7_FEHLER" 11068 "AUSS_KAT_Z8_FEHLER" 11069 "AUSS_KAT_Z9_FEHLER" 11070 "AUSS_KAT_Z10_FEHLER" 11071 "ION_SIG_BANK_1" 11072 "ION_SIG_BANK_2" 11073 "AUSS_KAT_MULT_FEHLER" 11074 "AUSS_ABG_Z1_FEHLER" 11075 "AUSS_ABG_Z2_FEHLER" 11076 "AUSS_ABG_Z3_FEHLER" 11077 "AUSS_ABG_Z4_FEHLER" 11078 "AUSS_ABG_Z5_FEHLER" 11079 "AUSS_ABG_Z6_FEHLER" 11080 "AUSS_ABG_Z7_FEHLER" 11081 "AUSS_ABG_Z8_FEHLER" 11082 "AUSS_ABG_Z9_FEHLER" 11083 "AUSS_ABG_Z10_FEHLER" 11084 "ION_SAT_BANK_1" 11085 "ION_SAT_BANK_2" 11086 "AUSS_ABG_MULT_FEHLER" 11087 "TAN_OBD_B1_FEHLER" 11088 "DKG_EINGR_FEHLER" 11089 "SC_PKS_FEHLER" 11090 "ZOELP1_FEHLER" 11091 "ZOELP2_FEHLER" 11092 "SG_IGN_FEHLER" 11093 "EBENE2_IGN_FEHLER" 11094 "BLS_PLAU_FEHLER" 11095 "SK_MANAGER_IGN" 11096 "LLR_DIAGNOSE" 11097 "THERMOSTAT_FEHLER" 11098 "TAN_OBD_B2_FEHLER" 11099 "DK1_ZUSTAND" 11100 "DK2_ZUSTAND" 11101 "FGR_ABWURF" 11102 "PWG_BLS_FEHLER" 11103 "START_RL_FEHLER" 11104 "AFZ_FEHLER" 11105 "N_GETR_EIN_HS_FEHLER" 11106 "TUMG_FEHLER" 11107 "LLR_DIAGNOSE_CSS" 11108 "TMOT_HIGH_FEHLER" 11109 "AFZ_NA_FEHLER" 11110 "INDEX_110_IGN" 11111 "INDEX_111_IGN" 11112 "INDEX_112_IGN" 11113 "INDEX_113_IGN" 11114 "INDEX_114_IGN" 11115 "INDEX_115_IGN" 11116 "INDEX_116_IGN" 11117 "INDEX_117_IGN" 11118 "INDEX_118_IGN" 11119 "INDEX_119_IGN" 11120 "INDEX_120_IGN" 11121 "INDEX_121_IGN" 11122 "INDEX_122_IGN" 11123 "INDEX_123_IGN" 11124 "INDEX_124_IGN" 11125 "INDEX_125_IGN" 11126 "INDEX_126_IGN" 11127 "INDEX_127_IGN" /end COMPU_VTAB
/begin COMPU_METHOD FORMULA_0051 "FORMULA_0051" RAT_FUNC "%5.0" "km" COEFFS 0 1 0 0 0 8 /end COMPU_METHOD
/begin COMPU_METHOD FORMULA_0052 "FORMULA_0052" RAT_FUNC "%5.0" "-" COEFFS 0 4 0 0 0 1 /end COMPU_METHOD
/begin COMPU_METHOD FORMULA_0053 "FORMULA_0053" RAT_FUNC "%7.2" "g/s" COEFFS 0 100 0 0 0 1 /end COMPU_METHOD
/begin COMPU_METHOD FORMULA_0054 "FORMULA_0054" TAB_VERB "%3.0" "-" COMPU_TAB_REF FORMULA_0054_VTAB /end COMPU_METHOD
/begin COMPU_VTAB FORMULA_0054_VTAB "FORMULA_0054_VTAB" TAB_VERB 4 1 "Regler noch aus" 2 "Regler aktiv" 4 "Schubabschalten" 8 "Sonde defekt" /end COMPU_VTAB
/begin COMPU_METHOD FORMULA_0055 "FORMULA_0055" RAT_FUNC "%7.4" "-" COEFFS 0 128 0 0 0 1 /end COMPU_METHOD
/begin COMPU_METHOD FORMULA_0056 "FORMULA_0056" RAT_FUNC "%7.4" "%" COEFFS 0 255 0 0 0 100 /end COMPU_METHOD
/begin COMPU_METHOD FORMULA_0057 "FORMULA_0057" RAT_FUNC "%3.0" "�C" COEFFS 0 1 40 0 0 1 /end COMPU_METHOD
/begin COMPU_METHOD FORMULA_0058 "FORMULA_0058" RAT_FUNC "%3.0" "kPa" COEFFS 0 1 0 0 0 3 /end COMPU_METHOD
/begin COMPU_METHOD FORMULA_0059 "FORMULA_0059" RAT_FUNC "%3.0" "km/h" COEFFS 0 1 0 0 0 1 /end COMPU_METHOD
/begin COMPU_METHOD FORMULA_0060 "FORMULA_0060" RAT_FUNC "%4.1" "�KW" COEFFS 0 2 128 0 0 1 /end COMPU_METHOD
/begin COMPU_METHOD FORMULA_0061 "FORMULA_0061" TAB_VERB "%3.0" "-" COMPU_TAB_REF FORMULA_0061_VTAB /end COMPU_METHOD
/begin COMPU_VTAB FORMULA_0061_VTAB "FORMULA_0061_VTAB" TAB_VERB 2 1 "Einblasung" 4 "Keine Einblasung" /end COMPU_VTAB
/begin COMPU_METHOD FORMULA_0063 "FORMULA_0063" RAT_FUNC "%8.3" "V" COEFFS 0 1000 0 0 0 1 /end COMPU_METHOD
/begin COMPU_METHOD FORMULA_0064 "FORMULA_0064" RAT_FUNC "%9.4" "%" COEFFS 0 255 0 0 0 1 /end COMPU_METHOD
/begin COMPU_METHOD FORMULA_0065 "FORMULA_0065" RAT_FUNC "%5.2" "%" COEFFS 0 255 0 0 0 100 /end COMPU_METHOD
/begin COMPU_METHOD FORMULA_0066 "FORMULA_0066" RAT_FUNC "%3.0" "kPa" COEFFS 0 1 0 0 0 1 /end COMPU_METHOD
/begin COMPU_METHOD FORMULA_0067 "FORMULA_0067" TAB_VERB "%5.2" "-" COMPU_TAB_REF FORMULA_0067_VTAB /end COMPU_METHOD
/begin COMPU_VTAB FORMULA_0067_VTAB "FORMULA_0067_VTAB" TAB_VERB 1 0 "MIL aus" DEFAULT_VALUE "MIL an" /end COMPU_VTAB
/begin COMPU_METHOD FORMULA_0068 "FORMULA_0068" TAB_VERB "%5.2" "-" COMPU_TAB_REF FORMULA_0068_VTAB /end COMPU_METHOD
/begin COMPU_VTAB FORMULA_0068_VTAB "FORMULA_0068_VTAB" TAB_VERB 1 0 "PRE-MIL aus" DEFAULT_VALUE "PRE-MIL an" /end COMPU_VTAB
/begin COMPU_METHOD FORMULA_0069 "FORMULA_0069" TAB_VERB "%5.2" "-" COMPU_TAB_REF FORMULA_0069_VTAB /end COMPU_METHOD
/begin COMPU_VTAB FORMULA_0069_VTAB "FORMULA_0069_VTAB" TAB_VERB 1 0 "DME-MIL aus" DEFAULT_VALUE "DME-MIL an" /end COMPU_VTAB
/begin COMPU_METHOD FORMULA_0070 "FORMULA_0070" TAB_VERB "%5.2" "-" COMPU_TAB_REF FORMULA_0070_VTAB /end COMPU_METHOD
/begin COMPU_VTAB FORMULA_0070_VTAB "FORMULA_0070_VTAB" TAB_VERB 1 0 "ZYL_OFF-MIL aus" DEFAULT_VALUE "ZYL_OFF-MIL an" /end COMPU_VTAB
/begin COMPU_METHOD FORMULA_0071 "FORMULA_0071" TAB_VERB "%5.2" "-" COMPU_TAB_REF FORMULA_0071_VTAB /end COMPU_METHOD
/begin COMPU_VTAB FORMULA_0071_VTAB "FORMULA_0071_VTAB" TAB_VERB 1 0 "SMG-MIL aus" DEFAULT_VALUE "SMG-MIL an" /end COMPU_VTAB
/begin COMPU_METHOD FORMULA_0072 "FORMULA_0072" TAB_VERB "%3.0" "-" COMPU_TAB_REF FORMULA_0072_VTAB /end COMPU_METHOD
/begin COMPU_VTAB FORMULA_0072_VTAB "FORMULA_0072_VTAB" TAB_VERB 1 165 "fsp_loeschen" DEFAULT_VALUE "fsp_sichern" /end COMPU_VTAB
/begin COMPU_METHOD FORMULA_0073 "FORMULA_0073" RAT_FUNC "%6.1" "s" COEFFS 0 10 0 0 0 1 /end COMPU_METHOD
/begin COMPU_METHOD FORMULA_0074 "FORMULA_0074" RAT_FUNC "%7.0" "us" COEFFS 0 1 0 0 0 1 /end COMPU_METHOD
/begin COMPU_METHOD FORMULA_0075 "FORMULA_0075" RAT_FUNC "%8.3" "-" COEFFS 0 1024 0 0 0 1 /end COMPU_METHOD
/begin COMPU_METHOD FORMULA_0076 "FORMULA_0076" RAT_FUNC "%6.1" "Kelvin" COEFFS 0 10 0 0 0 1 /end COMPU_METHOD
/begin COMPU_METHOD FORMULA_0077 "FORMULA_0077" RAT_FUNC "%6.1" "mbar" COEFFS 0 16 0 0 0 1 /end COMPU_METHOD
/begin COMPU_METHOD FORMULA_0078 "FORMULA_0078" RAT_FUNC "%6.1" "km/h" COEFFS 0 16 0 0 0 1 /end COMPU_METHOD
/* ------------------ Abschnitt erzeugt aus eeprom.dat ------------------ */
/begin COMPU_METHOD FORMULA_0080 "FORMULA_0080" TAB_VERB "%3.0" "Seite" COMPU_TAB_REF FORMULA_0080_VTAB /end COMPU_METHOD
/begin COMPU_VTAB FORMULA_0080_VTAB "FORMULA_0080_VTAB" TAB_VERB 1 128 "Keine Daten)" /end COMPU_VTAB
/begin COMPU_METHOD FORMULA_0081 "FORMULA_0081" TAB_VERB "%3.0" "Seite" COMPU_TAB_REF FORMULA_0081_VTAB /end COMPU_METHOD
/begin COMPU_VTAB FORMULA_0081_VTAB "FORMULA_0081_VTAB" TAB_VERB 2 64 "Sektoren voll->A" 72 "Sektoren voll->B" /end COMPU_VTAB
/begin COMPU_METHOD FORMULA_0082 "FORMULA_0082" TAB_VERB "%3.0" "-" COMPU_TAB_REF FORMULA_0082_VTAB /end COMPU_METHOD
/begin COMPU_VTAB FORMULA_0082_VTAB "FORMULA_0082_VTAB" TAB_VERB 9 0 "Daten o.k." 1 "CRC Stand falsch" 2 "Andere Erstellung" 4 "Andere Version" 8 "Wichtig groesser" 16 "Wichtig kleiner" 32 "Wichtig CRC falsch" 64 "Wichtig Laenge nio" 128 "keine Daten" /end COMPU_VTAB
/begin COMPU_METHOD FORMULA_0084 "FORMULA_0084" TAB_VERB "%7.2" "-" COMPU_TAB_REF FORMULA_0084_VTAB /end COMPU_METHOD
/begin COMPU_VTAB FORMULA_0084_VTAB "FORMULA_0084_VTAB" TAB_VERB 3 1 "Regler-RESET" 2 "Regler aktiv" 4 "Regler inaktiv" /end COMPU_VTAB
/begin COMPU_METHOD FORMULA_0085 "FORMULA_0085" TAB_VERB "%7.2" "-" COMPU_TAB_REF FORMULA_0085_VTAB /end COMPU_METHOD
/begin COMPU_VTAB FORMULA_0085_VTAB "FORMULA_0085_VTAB" TAB_VERB 2 0 "nicht einger." 1 "einger." /end COMPU_VTAB
/begin COMPU_METHOD FORMULA_0086 "FORMULA_0086" TAB_VERB "%7.2" "-" COMPU_TAB_REF FORMULA_0086_VTAB /end COMPU_METHOD
/begin COMPU_VTAB FORMULA_0086_VTAB "FORMULA_0086_VTAB" TAB_VERB 2 0 "inaktiv" 1 "aktiv" /end COMPU_VTAB
/begin COMPU_METHOD FORMULA_0087 "FORMULA_0087" TAB_VERB "%7.2" "-" COMPU_TAB_REF FORMULA_0087_VTAB /end COMPU_METHOD
/begin COMPU_VTAB FORMULA_0087_VTAB "FORMULA_0087_VTAB" TAB_VERB 2 0 "i.O." 1 "ti_min" /end COMPU_VTAB
/begin COMPU_METHOD FORMULA_0088 "FORMULA_0088" TAB_VERB "%7.2" "-" COMPU_TAB_REF FORMULA_0088_VTAB /end COMPU_METHOD
/begin COMPU_VTAB FORMULA_0088_VTAB "FORMULA_0088_VTAB" TAB_VERB 2 0 "i.O." 1 "MIN" /end COMPU_VTAB
/begin COMPU_METHOD FORMULA_0089 "FORMULA_0089" TAB_VERB "%7.2" "-" COMPU_TAB_REF FORMULA_0089_VTAB /end COMPU_METHOD
/begin COMPU_VTAB FORMULA_0089_VTAB "FORMULA_0089_VTAB" TAB_VERB 2 0 "i.O." 1 "MAX" /end COMPU_VTAB
/begin COMPU_METHOD FORMULA_0090 "FORMULA_0090" TAB_VERB "%7.2" "-" COMPU_TAB_REF FORMULA_0090_VTAB /end COMPU_METHOD
/begin COMPU_VTAB FORMULA_0090_VTAB "FORMULA_0090_VTAB" TAB_VERB 2 0 "-" 1 "SA-Verz." /end COMPU_VTAB
/begin COMPU_METHOD FORMULA_0091 "FORMULA_0091" TAB_VERB "%7.2" "-" COMPU_TAB_REF FORMULA_0091_VTAB /end COMPU_METHOD
/begin COMPU_VTAB FORMULA_0091_VTAB "FORMULA_0091_VTAB" TAB_VERB 2 0 "-" 1 "SLP-Verz." /end COMPU_VTAB
/begin COMPU_METHOD FORMULA_0092 "FORMULA_0092" TAB_VERB "%7.2" "-" COMPU_TAB_REF FORMULA_0092_VTAB /end COMPU_METHOD
/begin COMPU_VTAB FORMULA_0092_VTAB "FORMULA_0092_VTAB" TAB_VERB 2 0 "nicht einger." 1 "einger." /end COMPU_VTAB
/begin COMPU_METHOD FORMULA_0093 "FORMULA_0093" RAT_FUNC "%7.2" "mg" COEFFS 0 10 0 0 0 1 /end COMPU_METHOD
/begin COMPU_METHOD FORMULA_0094 "FORMULA_0094" TAB_VERB "%7.2" "-" COMPU_TAB_REF FORMULA_0094_VTAB /end COMPU_METHOD
/begin COMPU_VTAB FORMULA_0094_VTAB "FORMULA_0094_VTAB" TAB_VERB 2 0 "inaktiv" 1 "aktiv" /end COMPU_VTAB
/begin COMPU_METHOD FORMULA_0095 "FORMULA_0095" TAB_VERB "%7.2" "-" COMPU_TAB_REF FORMULA_0095_VTAB /end COMPU_METHOD
/begin COMPU_VTAB FORMULA_0095_VTAB "FORMULA_0095_VTAB" TAB_VERB 2 0 "inaktiv" 1 "aktiv" /end COMPU_VTAB
/begin COMPU_METHOD FORMULA_0096 "FORMULA_0096" TAB_VERB "%7.2" "-" COMPU_TAB_REF FORMULA_0096_VTAB /end COMPU_METHOD
/begin COMPU_VTAB FORMULA_0096_VTAB "FORMULA_0096_VTAB" TAB_VERB 2 0 "inaktiv" 1 "aktiv" /end COMPU_VTAB
/begin COMPU_METHOD FORMULA_0097 "FORMULA_0097" TAB_VERB "%7.2" "-" COMPU_TAB_REF FORMULA_0097_VTAB /end COMPU_METHOD
/begin COMPU_VTAB FORMULA_0097_VTAB "FORMULA_0097_VTAB" TAB_VERB 2 0 "inaktiv" 1 "aktiv" /end COMPU_VTAB
/begin COMPU_METHOD FORMULA_0098 "FORMULA_0098" TAB_VERB "%7.2" "-" COMPU_TAB_REF FORMULA_0098_VTAB /end COMPU_METHOD
/begin COMPU_VTAB FORMULA_0098_VTAB "FORMULA_0098_VTAB" TAB_VERB 2 0 "nein" 1 "ja" /end COMPU_VTAB
/begin COMPU_METHOD FORMULA_0099 "FORMULA_0099" TAB_VERB "%7.2" "-" COMPU_TAB_REF FORMULA_0099_VTAB /end COMPU_METHOD
/begin COMPU_VTAB FORMULA_0099_VTAB "FORMULA_0099_VTAB" TAB_VERB 2 0 "inaktiv" 1 "aktiv" /end COMPU_VTAB
/begin COMPU_METHOD FORMULA_0100 "FORMULA_0100" TAB_VERB "%7.2" "-" COMPU_TAB_REF FORMULA_0100_VTAB /end COMPU_METHOD
/begin COMPU_VTAB FORMULA_0100_VTAB "FORMULA_0100_VTAB" TAB_VERB 2 0 "inaktiv" 1 "aktiv" /end COMPU_VTAB
/begin COMPU_METHOD FORMULA_0101 "FORMULA_0101" TAB_VERB "%7.2" "-" COMPU_TAB_REF FORMULA_0101_VTAB /end COMPU_METHOD
/begin COMPU_VTAB FORMULA_0101_VTAB "FORMULA_0101_VTAB" TAB_VERB 2 0 "inaktiv" 1 "aktiv" /end COMPU_VTAB
/begin COMPU_METHOD FORMULA_0102 "FORMULA_0102" TAB_VERB "%7.2" "-" COMPU_TAB_REF FORMULA_0102_VTAB /end COMPU_METHOD
/begin COMPU_VTAB FORMULA_0102_VTAB "FORMULA_0102_VTAB" TAB_VERB 2 0 "no" 1 "yes" /end COMPU_VTAB
/begin COMPU_METHOD FORMULA_0103 "FORMULA_0103" TAB_VERB "%7.2" "-" COMPU_TAB_REF FORMULA_0103_VTAB /end COMPU_METHOD
/begin COMPU_VTAB FORMULA_0103_VTAB "FORMULA_0103_VTAB" TAB_VERB 5 1 "PASSIV" 2 "WARTEN" 4 "AMPLITUDE" 8 "NORMIERUNG" 16 "ENDE" DEFAULT_VALUE "undef." /end COMPU_VTAB
/begin COMPU_METHOD FORMULA_0104 "FORMULA_0104" TAB_VERB "%7.2" "-" COMPU_TAB_REF FORMULA_0104_VTAB /end COMPU_METHOD
/begin COMPU_VTAB FORMULA_0104_VTAB "FORMULA_0104_VTAB" TAB_VERB 1 0 "-" DEFAULT_VALUE "MAX-Ermittlung" /end COMPU_VTAB
/begin COMPU_METHOD FORMULA_0105 "FORMULA_0105" TAB_VERB "%7.2" "-" COMPU_TAB_REF FORMULA_0105_VTAB /end COMPU_METHOD
/begin COMPU_VTAB FORMULA_0105_VTAB "FORMULA_0105_VTAB" TAB_VERB 1 0 "-" DEFAULT_VALUE "MIN-Ermittlung" /end COMPU_VTAB
/begin COMPU_METHOD FORMULA_0106 "FORMULA_0106" TAB_VERB "%7.2" "-" COMPU_TAB_REF FORMULA_0106_VTAB /end COMPU_METHOD
/begin COMPU_VTAB FORMULA_0106_VTAB "FORMULA_0106_VTAB" TAB_VERB 1 0 "-" DEFAULT_VALUE "aktiv" /end COMPU_VTAB
/begin COMPU_METHOD FORMULA_0107 "FORMULA_0107" TAB_VERB "%7.2" "-" COMPU_TAB_REF FORMULA_0107_VTAB /end COMPU_METHOD
/begin COMPU_VTAB FORMULA_0107_VTAB "FORMULA_0107_VTAB" TAB_VERB 1 0 "inaktiv" DEFAULT_VALUE "aktiv" /end COMPU_VTAB
/begin COMPU_METHOD FORMULA_0108 "FORMULA_0108" TAB_VERB "%7.2" "-" COMPU_TAB_REF FORMULA_0108_VTAB /end COMPU_METHOD
/begin COMPU_VTAB FORMULA_0108_VTAB "FORMULA_0108_VTAB" TAB_VERB 1 0 "inaktiv" DEFAULT_VALUE "aktiv" /end COMPU_VTAB
/begin COMPU_METHOD FORMULA_0109 "FORMULA_0109" RAT_FUNC "%7.2" "-" COEFFS 0 10000 0 0 0 1 /end COMPU_METHOD
/begin COMPU_METHOD FORMULA_0110 "FORMULA_0110" TAB_VERB "%3.0" "-" COMPU_TAB_REF FORMULA_0110_VTAB /end COMPU_METHOD
/begin COMPU_VTAB FORMULA_0110_VTAB "FORMULA_0110_VTAB" TAB_VERB 5 1 "warte Sync." 2 "Sync. laeuft" 4 "synchronisiert" 8 "nicht sync." 20 "Sync. vio Ionenstrom" DEFAULT_VALUE "gibts nicht" /end COMPU_VTAB
/begin COMPU_METHOD FORMULA_0111 "FORMULA_0111" RAT_FUNC "%6.1" "�KW" COEFFS 0 10 0 0 0 1 /end COMPU_METHOD
/begin COMPU_METHOD FORMULA_0112 "FORMULA_0112" RAT_FUNC "%6.1" "kg/h" COEFFS 0 10 0 0 0 1 /end COMPU_METHOD
/begin COMPU_METHOD FORMULA_0113 "FORMULA_0113" RAT_FUNC "%6.1" "mg/asp" COEFFS 0 10 0 0 0 1 /end COMPU_METHOD
/begin COMPU_METHOD FORMULA_0114 "FORMULA_0114" RAT_FUNC "%5.0" "Upm/s" COEFFS 0 1 0 0 0 1 /end COMPU_METHOD
/begin COMPU_METHOD FORMULA_0115 "FORMULA_0115" RAT_FUNC "%7.2" "%" COEFFS 0 16384 0 0 0 100 /end COMPU_METHOD
/begin COMPU_METHOD FORMULA_0116 "FORMULA_0116" TAB_VERB "%5.2" "-" COMPU_TAB_REF FORMULA_0116_VTAB /end COMPU_METHOD
/begin COMPU_VTAB FORMULA_0116_VTAB "FORMULA_0116_VTAB" TAB_VERB 7 0 "Inaktiv" 1 "Trigger" 2 "Bereit" 3 "Tr+Be" 4 "Aktiv" 7 "Tr+Be+Aktiv" 8 "WE" DEFAULT_VALUE "undef" /end COMPU_VTAB
/begin COMPU_METHOD FORMULA_0117 "FORMULA_0117" RAT_FUNC "%7.2" "s" COEFFS 0 200 0 0 0 1 /end COMPU_METHOD
/begin COMPU_METHOD FORMULA_0118 "FORMULA_0118" RAT_FUNC "%8.3" "bar" COEFFS 0 1000 0 0 0 1 /end COMPU_METHOD
/begin COMPU_METHOD FORMULA_0119 "FORMULA_0119" RAT_FUNC "%5.2" "bar" COEFFS 0 100 0 0 0 3 /end COMPU_METHOD
/begin COMPU_METHOD FORMULA_0120 "FORMULA_0120" TAB_VERB "%5.2" "-" COMPU_TAB_REF FORMULA_0120_VTAB /end COMPU_METHOD
/begin COMPU_VTAB FORMULA_0120_VTAB "FORMULA_0120_VTAB" TAB_VERB 2 0 "QLT-Temp.fehler" 1 "QLT-Temp.OK" DEFAULT_VALUE "undef." /end COMPU_VTAB
/begin COMPU_METHOD FORMULA_0121 "FORMULA_0121" RAT_FUNC "%7.2" "Nm" COEFFS 0 10 0 0 0 1 /end COMPU_METHOD
/begin COMPU_METHOD FORMULA_0122 "FORMULA_0122" TAB_VERB "%5.2" "-" COMPU_TAB_REF FORMULA_0122_VTAB /end COMPU_METHOD
/begin COMPU_VTAB FORMULA_0122_VTAB "FORMULA_0122_VTAB" TAB_VERB 2 0 "Inaktiv" 1 "Aktiv" /end COMPU_VTAB
/begin COMPU_METHOD FORMULA_0123 "FORMULA_0123" RAT_FUNC "%5.0" "digit" COEFFS 0 1 0 0 0 1 /end COMPU_METHOD
/begin COMPU_METHOD FORMULA_0124 "FORMULA_0124" TAB_VERB "%3.0" "-" COMPU_TAB_REF FORMULA_0124_VTAB /end COMPU_METHOD
/begin COMPU_VTAB FORMULA_0124_VTAB "FORMULA_0124_VTAB" TAB_VERB 2 0 "CBS-RESET nicht ausgef." 1 "CBS-RESET ausgefuehrt" /end COMPU_VTAB
/begin COMPU_METHOD FORMULA_0125 "FORMULA_0125" TAB_VERB "%5.0" "-" COMPU_TAB_REF FORMULA_0125_VTAB /end COMPU_METHOD
/begin COMPU_VTAB FORMULA_0125_VTAB "FORMULA_0125_VTAB" TAB_VERB 8 0 "O.K." 1 "BusOff" 2 "DPR" 4 "Timeout" 5 "BusOff+Timeout" 8 "Overflow" 16 "Chksum" 32 "Alive" DEFAULT_VALUE "Mehrfachfehler" /end COMPU_VTAB
/begin COMPU_METHOD FORMULA_0126 "FORMULA_0126" TAB_VERB "%3.0" "-" COMPU_TAB_REF FORMULA_0126_VTAB /end COMPU_METHOD
/begin COMPU_VTAB FORMULA_0126_VTAB "FORMULA_0126_VTAB" TAB_VERB 8 0 "O.K." 1 "BusOff" 2 "DPR" 4 "Timeout" 5 "BusOff+Timeout" 8 "Overflow" 16 "Chksum" 32 "Alive" DEFAULT_VALUE "Mehrfachfehler" /end COMPU_VTAB
/begin COMPU_METHOD FORMULA_0127 "FORMULA_0127" TAB_VERB "%3.0" "-" COMPU_TAB_REF FORMULA_0127_VTAB /end COMPU_METHOD
/begin COMPU_VTAB FORMULA_0127_VTAB "FORMULA_0127_VTAB" TAB_VERB 4 0 "aus" 1 "ein" 2 "Stufe 1" 4 "Stufe 2" DEFAULT_VALUE "ungueltig" /end COMPU_VTAB
/begin COMPU_METHOD FORMULA_0128 "FORMULA_0128" TAB_VERB "%3.0" "-" COMPU_TAB_REF FORMULA_0128_VTAB /end COMPU_METHOD
/begin COMPU_VTAB FORMULA_0128_VTAB "FORMULA_0128_VTAB" TAB_VERB 3 0 "aus" 1 "ZH" 2 "NTKW" DEFAULT_VALUE "ungueltig" /end COMPU_VTAB
/begin COMPU_METHOD FORMULA_0129 "FORMULA_0129" RAT_FUNC "%6.1" "Nm" COEFFS 0 2 0 0 0 1 /end COMPU_METHOD
/begin COMPU_METHOD FORMULA_0130 "FORMULA_0130" TAB_VERB "%7.2" "-" COMPU_TAB_REF FORMULA_0130_VTAB /end COMPU_METHOD
/begin COMPU_VTAB FORMULA_0130_VTAB "FORMULA_0130_VTAB" TAB_VERB 7 0 "iO" 1 "VL defekt" 2 "VR defekt" 4 "HL defekt" 8 "HR defekt" 16 "vVorne" 20 "vTacho" DEFAULT_VALUE "Mehrfach" /end COMPU_VTAB
/begin COMPU_METHOD FORMULA_0131 "FORMULA_0131" TAB_VERB "%5.2" "-" COMPU_TAB_REF FORMULA_0131_VTAB /end COMPU_METHOD
/begin COMPU_VTAB FORMULA_0131_VTAB "FORMULA_0131_VTAB" TAB_VERB 4 0 "steht" 1 "vorwaerts" 2 "rueckwaerts" 3 "faehrt" DEFAULT_VALUE "ungueltig" /end COMPU_VTAB
/begin COMPU_METHOD FORMULA_0132 "FORMULA_0132" RAT_FUNC "%7.2" "m/(s*s)" COEFFS 0 40 0 0 0 1 /end COMPU_METHOD
/begin COMPU_METHOD FORMULA_0133 "FORMULA_0133" TAB_VERB "%5.2" "-" COMPU_TAB_REF FORMULA_0133_VTAB /end COMPU_METHOD
/begin COMPU_VTAB FORMULA_0133_VTAB "FORMULA_0133_VTAB" TAB_VERB 4 0 "iO" 1 "ax-Err" 2 "ay-Err" 3 "ax-ay-Err" DEFAULT_VALUE "ungueltig" /end COMPU_VTAB
/begin COMPU_METHOD FORMULA_0134 "FORMULA_0134" TAB_VERB "%5.2" "-" COMPU_TAB_REF FORMULA_0134_VTAB /end COMPU_METHOD
/begin COMPU_VTAB FORMULA_0134_VTAB "FORMULA_0134_VTAB" TAB_VERB 3 0 "Inaktiv" 1 "MSR" 2 "ASC" DEFAULT_VALUE "ungueltig" /end COMPU_VTAB
/begin COMPU_METHOD FORMULA_0135 "FORMULA_0135" TAB_VERB "%3.0" "-" COMPU_TAB_REF FORMULA_0135_VTAB /end COMPU_METHOD
/begin COMPU_VTAB FORMULA_0135_VTAB "FORMULA_0135_VTAB" TAB_VERB 8 0 "iO" 1 "passiv" 2 "defekt" 3 "reserviert" 4 "MDM" 5 "reserviert" 6 "Unterspannung" 7 "ungueltig" /end COMPU_VTAB
/begin COMPU_METHOD FORMULA_0136 "FORMULA_0136" TAB_VERB "%3.0" "-" COMPU_TAB_REF FORMULA_0136_VTAB /end COMPU_METHOD
/begin COMPU_VTAB FORMULA_0136_VTAB "FORMULA_0136_VTAB" TAB_VERB 11 0 "keine" 1 "ABS" 2 "ASC" 3 "ABS/ASC" 4 "DSC" 5 "ABS/DSC" 8 "HBA" 16 "MSR" 17 "ABS/MSR" 32 "EBV" 255 "ungueltig" DEFAULT_VALUE "selbstrechnen" /end COMPU_VTAB
/begin COMPU_METHOD FORMULA_0137 "FORMULA_0137" TAB_VERB "%3.0" "-" COMPU_TAB_REF FORMULA_0137_VTAB /end COMPU_METHOD
/begin COMPU_VTAB FORMULA_0137_VTAB "FORMULA_0137_VTAB" TAB_VERB 4 0 "keiner" 1 "vorhanden" 2 "???" 3 "ungueltig" /end COMPU_VTAB
/begin COMPU_METHOD FORMULA_0138 "FORMULA_0138" RAT_FUNC "%3.0" "bar" COEFFS 0 1 0 0 0 1 /end COMPU_METHOD
/begin COMPU_METHOD FORMULA_0139 "FORMULA_0139" TAB_VERB "%5.2" "-" COMPU_TAB_REF FORMULA_0139_VTAB /end COMPU_METHOD
/begin COMPU_VTAB FORMULA_0139_VTAB "FORMULA_0139_VTAB" TAB_VERB 4 0 "iO" 1 "Verifikation" 2 "Fehler" 3 "ungueltig" /end COMPU_VTAB
/begin COMPU_METHOD FORMULA_0143 "FORMULA_0143" TAB_VERB "%3.0" "-" COMPU_TAB_REF FORMULA_0143_VTAB /end COMPU_METHOD
/begin COMPU_VTAB FORMULA_0143_VTAB "FORMULA_0143_VTAB" TAB_VERB 8 0 "alle aus" 1 "Kl R" 2 "Kl 15" 3 "Kl R+15" 4 "Kl 50" 5 "Kl R+50" 6 "Kl 15+50" 7 "Kl R+15+50" /end COMPU_VTAB
/begin COMPU_METHOD FORMULA_0144 "FORMULA_0144" TAB_VERB "%3.0" "-" COMPU_TAB_REF FORMULA_0144_VTAB /end COMPU_METHOD
/begin COMPU_VTAB FORMULA_0144_VTAB "FORMULA_0144_VTAB" TAB_VERB 8 0 "keine" 1 "T vo" 2 "UeT vo" 4 "T hi" 8 "UeT hi" 16 "T ob/un" 64 "T ax" 255 "ungueltig" /end COMPU_VTAB
/begin COMPU_METHOD FORMULA_0145 "FORMULA_0145" TAB_VERB "%5.2" "-" COMPU_TAB_REF FORMULA_0145_VTAB /end COMPU_METHOD
/begin COMPU_VTAB FORMULA_0145_VTAB "FORMULA_0145_VTAB" TAB_VERB 4 0 "aus" 1 "an" 2 "Anf aus" 4 "Anf aus rec" DEFAULT_VALUE "ungueltig" /end COMPU_VTAB
/begin COMPU_METHOD FORMULA_0147 "FORMULA_0147" RAT_FUNC "%6.1" "qmm" COEFFS 0 10 0 0 0 1 /end COMPU_METHOD
/begin COMPU_METHOD FORMULA_0148 "FORMULA_0148" RAT_FUNC "%8.3" "ml" COEFFS 0 1000 0 0 0 1 /end COMPU_METHOD
/begin COMPU_METHOD FORMULA_0149 "FORMULA_0149" RAT_FUNC "%9.2" "min" COEFFS 0 60 0 0 0 1 /end COMPU_METHOD
/begin COMPU_METHOD FORMULA_0150 "FORMULA_0150" TAB_VERB "%5.2" "-" COMPU_TAB_REF FORMULA_0150_VTAB /end COMPU_METHOD
/begin COMPU_VTAB FORMULA_0150_VTAB "FORMULA_0150_VTAB" TAB_VERB 2 0 "Ok" 1 "Fehler" /end COMPU_VTAB
/begin COMPU_METHOD FORMULA_0151 "FORMULA_0151" TAB_VERB "%7.2" "-" COMPU_TAB_REF FORMULA_0151_VTAB /end COMPU_METHOD
/begin COMPU_VTAB FORMULA_0151_VTAB "FORMULA_0151_VTAB" TAB_VERB 5 1 "PASSIV" 2 "WARTEN" 4 "ZYK MAGER" 8 "ZYK FETT" 16 "ENDE" DEFAULT_VALUE "undef." /end COMPU_VTAB
/begin COMPU_METHOD FORMULA_0152 "FORMULA_0152" RAT_FUNC "%9.2" "s" COEFFS 0 100 0 0 0 1 /end COMPU_METHOD
/begin COMPU_METHOD FORMULA_0153 "FORMULA_0153" TAB_VERB "%5.2" "-" COMPU_TAB_REF FORMULA_0153_VTAB /end COMPU_METHOD
/begin COMPU_VTAB FORMULA_0153_VTAB "FORMULA_0153_VTAB" TAB_VERB 4 0 "inaktiv" 1 "Momenteneingriff" 2 "Einspritzausblendung" 3 "Md + TT-Eingriff" /end COMPU_VTAB
/begin COMPU_METHOD FORMULA_0154 "FORMULA_0154" TAB_VERB "%5.2" "-" COMPU_TAB_REF FORMULA_0154_VTAB /end COMPU_METHOD
/begin COMPU_VTAB FORMULA_0154_VTAB "FORMULA_0154_VTAB" TAB_VERB 2 0 "inaktiv" 1 "N-Dynamik aktiv" /end COMPU_VTAB
/begin COMPU_METHOD FORMULA_0155 "FORMULA_0155" TAB_VERB "%7.2" "-" COMPU_TAB_REF FORMULA_0155_VTAB /end COMPU_METHOD
/begin COMPU_VTAB FORMULA_0155_VTAB "FORMULA_0155_VTAB" TAB_VERB 2 0 "BLS aus" 1 "BLS ein" /end COMPU_VTAB
/begin COMPU_METHOD FORMULA_0156 "FORMULA_0156" TAB_VERB "%7.2" "-" COMPU_TAB_REF FORMULA_0156_VTAB /end COMPU_METHOD
/begin COMPU_VTAB FORMULA_0156_VTAB "FORMULA_0156_VTAB" TAB_VERB 2 0 "offen" 1 "geschlossen" /end COMPU_VTAB
/begin COMPU_METHOD FORMULA_0157 "FORMULA_0157" TAB_VERB "%7.2" "-" COMPU_TAB_REF FORMULA_0157_VTAB /end COMPU_METHOD
/begin COMPU_VTAB FORMULA_0157_VTAB "FORMULA_0157_VTAB" TAB_VERB 4 0 "Leergasse" 1 "Gerader Gang" 8 "Leergasse" 9 "Ungerader Gang" /end COMPU_VTAB
/begin COMPU_METHOD FORMULA_0158 "FORMULA_0158" TAB_VERB "%7.2" "-" COMPU_TAB_REF FORMULA_0158_VTAB /end COMPU_METHOD
/begin COMPU_VTAB FORMULA_0158_VTAB "FORMULA_0158_VTAB" TAB_VERB 2 0 "Sleep" 1 "Wakeup" /end COMPU_VTAB
/begin COMPU_METHOD FORMULA_0159 "FORMULA_0159" TAB_VERB "%7.2" "-" COMPU_TAB_REF FORMULA_0159_VTAB /end COMPU_METHOD
/begin COMPU_VTAB FORMULA_0159_VTAB "FORMULA_0159_VTAB" TAB_VERB 2 0 "aus" 1 "ein" /end COMPU_VTAB
/begin COMPU_METHOD FORMULA_0160 "FORMULA_0160" TAB_VERB "%7.2" "-" COMPU_TAB_REF FORMULA_0160_VTAB /end COMPU_METHOD
/begin COMPU_VTAB FORMULA_0160_VTAB "FORMULA_0160_VTAB" TAB_VERB 2 0 "keine Schaltung" 1 "Schaltung" /end COMPU_VTAB
/begin COMPU_METHOD FORMULA_0161 "FORMULA_0161" TAB_VERB "%7.2" "-" COMPU_TAB_REF FORMULA_0161_VTAB /end COMPU_METHOD
/begin COMPU_VTAB FORMULA_0161_VTAB "FORMULA_0161_VTAB" TAB_VERB 2 0 "kein Druck" 1 "Oeldruck" /end COMPU_VTAB
/begin COMPU_METHOD FORMULA_0162 "FORMULA_0162" TAB_VERB "%7.2" "-" COMPU_TAB_REF FORMULA_0162_VTAB /end COMPU_METHOD
/begin COMPU_VTAB FORMULA_0162_VTAB "FORMULA_0162_VTAB" TAB_VERB 2 0 "Motor abstellen" 1 "O.K." /end COMPU_VTAB
/begin COMPU_METHOD FORMULA_0163 "FORMULA_0163" TAB_VERB "%7.2" "-" COMPU_TAB_REF FORMULA_0163_VTAB /end COMPU_METHOD
/begin COMPU_VTAB FORMULA_0163_VTAB "FORMULA_0163_VTAB" TAB_VERB 2 0 "offen" 1 "Kraftschluss" /end COMPU_VTAB
/begin COMPU_METHOD FORMULA_0164 "FORMULA_0164" TAB_VERB "%5.2" "-" COMPU_TAB_REF FORMULA_0164_VTAB /end COMPU_METHOD
/begin COMPU_VTAB FORMULA_0164_VTAB "FORMULA_0164_VTAB" TAB_VERB 2 0 "AUS" 1 "EIN" DEFAULT_VALUE "ungueltig" /end COMPU_VTAB
/begin COMPU_METHOD FORMULA_0165 "FORMULA_0165" TAB_VERB "%3.0" "-" COMPU_TAB_REF FORMULA_0165_VTAB /end COMPU_METHOD
/begin COMPU_VTAB FORMULA_0165_VTAB "FORMULA_0165_VTAB" TAB_VERB 5 1 "Init" 2 "Awake" 3 "Ring" 4 "GoSleep" 5 "BusSleep" /end COMPU_VTAB
/begin COMPU_METHOD FORMULA_0166 "FORMULA_0166" TAB_VERB "%5.2" "-" COMPU_TAB_REF FORMULA_0166_VTAB /end COMPU_METHOD
/begin COMPU_VTAB FORMULA_0166_VTAB "FORMULA_0166_VTAB" TAB_VERB 2 0 "Inaktiv" 1 "Aktiv" /end COMPU_VTAB
/begin COMPU_METHOD FORMULA_0167 "FORMULA_0167" TAB_VERB "%5.2" "-" COMPU_TAB_REF FORMULA_0167_VTAB /end COMPU_METHOD
/begin COMPU_VTAB FORMULA_0167_VTAB "FORMULA_0167_VTAB" TAB_VERB 2 0 "Inaktiv" 1 "Aktiv" /end COMPU_VTAB
/begin COMPU_METHOD FORMULA_0168 "FORMULA_0168" TAB_VERB "%3.0" "-" COMPU_TAB_REF FORMULA_0168_VTAB /end COMPU_METHOD
/begin COMPU_VTAB FORMULA_0168_VTAB "FORMULA_0168_VTAB" TAB_VERB 3 0 "Konfigmodus" 1 "Aus" 2 "Ein" DEFAULT_VALUE "undef" /end COMPU_VTAB
/begin COMPU_METHOD FORMULA_0169 "FORMULA_0169" TAB_VERB "%3.0" "-" COMPU_TAB_REF FORMULA_0169_VTAB /end COMPU_METHOD
/begin COMPU_VTAB FORMULA_0169_VTAB "FORMULA_0169_VTAB" TAB_VERB 3 0 "Komfort" 1 "Normal" 2 "Sport" DEFAULT_VALUE "undef" /end COMPU_VTAB
/begin COMPU_METHOD FORMULA_0170 "FORMULA_0170" RAT_FUNC "%6.3" "�C" COEFFS 0 1 48 0 0 1 /end COMPU_METHOD
/begin COMPU_METHOD FORMULA_0171 "FORMULA_0171" RAT_FUNC "%3.0" "Upm" COEFFS 0 1 0 0 0 50 /end COMPU_METHOD
/begin COMPU_METHOD FORMULA_0232 "FORMULA_0232" RAT_FUNC "%3.0" "s" COEFFS 0 1 0 0 0 1 /end COMPU_METHOD
/begin COMPU_METHOD FORMULA_0245 "FORMULA_0245" RAT_FUNC "%7.2" "nSs" COEFFS 0 1 0 0 0 0.01952206 /end COMPU_METHOD
/begin COMPU_METHOD FORMULA_0249 "FORMULA_0249" RAT_FUNC "%8.3" "�KW/Segm" COEFFS 0 10 0 0 0 1 /end COMPU_METHOD
/begin COMPU_METHOD FORMULA_0277 "FORMULA_0277" RAT_FUNC "%8.3" "V" COEFFS 0 1 0 0 0 0.00155892 /end COMPU_METHOD
/begin COMPU_METHOD FORMULA_0295 "FORMULA_0295" RAT_FUNC "%9.4" "-" COEFFS 0 16384 0 0 0 1 /end COMPU_METHOD
/begin COMPU_METHOD FORMULA_0317 "FORMULA_0317" RAT_FUNC "%5.2" "s" COEFFS 0 100 0 0 0 1 /end COMPU_METHOD
/begin COMPU_METHOD FORMULA_0333 "FORMULA_0333" RAT_FUNC "%7.2" "�C" COEFFS 0 20 5463 0 0 1 /end COMPU_METHOD
/* ------------------ Abschnitt erzeugt aus pctrl.dat ------------------ */
/begin COMPU_METHOD FORMULA_0352 "FORMULA_0352" RAT_FUNC "%5.2" "s" COEFFS 0 200 0 0 0 1 /end COMPU_METHOD
/* ------------------ Abschnitt erzeugt aus adapt.dat ------------------ */
/begin COMPU_METHOD FORMULA_0418 "FORMULA_0418" RAT_FUNC "%8.3" "V" COEFFS 0 1024 0 0 0 5 /end COMPU_METHOD
/begin COMPU_METHOD FORMULA_0420 "FORMULA_0420" RAT_FUNC "%3.0" "mal" COEFFS 0 1 0 0 0 1 /end COMPU_METHOD
/begin COMPU_METHOD FORMULA_0435 "FORMULA_0435" RAT_FUNC "%6.1" "%" COEFFS 0 32768 0 0 0 100 /end COMPU_METHOD
/begin COMPU_METHOD FORMULA_0443 "FORMULA_0443" RAT_FUNC "%7.2" "V" COEFFS 0 1 0 0 0 0.00080566 /end COMPU_METHOD
/begin COMPU_METHOD FORMULA_0447 "FORMULA_0447" RAT_FUNC "%7.2" "ms" COEFFS 0 7000 0 0 0 1 /end COMPU_METHOD
/begin COMPU_METHOD FORMULA_0448 "FORMULA_0448" RAT_FUNC "%7.2" "ms" COEFFS 0 250 0 0 0 1 /end COMPU_METHOD
/begin COMPU_METHOD FORMULA_0452 "FORMULA_0452" RAT_FUNC "%6.1" "trmp" COEFFS 0 16 0 0 0 1 /end COMPU_METHOD
/begin COMPU_METHOD FORMULA_0458 "FORMULA_0458" RAT_FUNC "%7.2" "m/(s*s)" COEFFS 0 286720 0 0 0 19613 /end COMPU_METHOD
/begin COMPU_METHOD FORMULA_0460 "FORMULA_0460" RAT_FUNC "%8.1" "m" COEFFS 0 1600 0 0 0 1 /end COMPU_METHOD
/begin COMPU_METHOD FORMULA_0462 "FORMULA_0462" RAT_FUNC "%5.2" "s" COEFFS 0 0 2.56 0 1 0 /end COMPU_METHOD
/begin COMPU_METHOD FORMULA_0463 "FORMULA_0463" RAT_FUNC "%6.1" "%" COEFFS 0 100 0 0 0 1 /end COMPU_METHOD
/begin COMPU_METHOD FORMULA_0465 "FORMULA_0465" TAB_VERB "%3.0" "-" COMPU_TAB_REF FORMULA_0465_VTAB /end COMPU_METHOD
/begin COMPU_VTAB FORMULA_0465_VTAB "FORMULA_0465_VTAB" TAB_VERB 4 0 "Aus" 1 "Statisch" 2 "Sequentiell" 3 "Sporadisch" DEFAULT_VALUE "undefined" /end COMPU_VTAB
/begin COMPU_METHOD FORMULA_0478 "FORMULA_0478" RAT_FUNC "%6.3" "s" COEFFS 0 0 1.28 0 1 0 /end COMPU_METHOD
/begin COMPU_METHOD FORMULA_0479 "FORMULA_0479" RAT_FUNC "%4.1" "%" COEFFS 0 10 0 0 0 1 /end COMPU_METHOD
/begin COMPU_METHOD FORMULA_0483 "FORMULA_0483" TAB_VERB "%5.2" "-" COMPU_TAB_REF FORMULA_0483_VTAB /end COMPU_METHOD
/begin COMPU_VTAB FORMULA_0483_VTAB "FORMULA_0483_VTAB" TAB_VERB 5 0 "AR aus" 1 "1B+1V" 3 "2B+1V" 5 "1B+2V" 7 "2B+2V" DEFAULT_VALUE "undef" /end COMPU_VTAB
/begin COMPU_METHOD FORMULA_0484 "FORMULA_0484" RAT_FUNC "%7.2" "Nm/Upm" COEFFS 0 5120 0 0 0 1 /end COMPU_METHOD
/begin COMPU_METHOD FORMULA_0485 "FORMULA_0485" RAT_FUNC "%9.4" "-" COEFFS 0 1048576 0 0 0 1 /end COMPU_METHOD
/begin COMPU_METHOD FORMULA_0486 "FORMULA_0486" RAT_FUNC "%5.0" ".Gang" COEFFS 0 1 0 0 0 1 /end COMPU_METHOD
/begin COMPU_METHOD FORMULA_0491 "FORMULA_0491" RAT_FUNC "%9.4" "-" COEFFS 0 8192 0 0 0 1 /end COMPU_METHOD
/begin COMPU_METHOD FORMULA_0495 "FORMULA_0495" TAB_VERB "%3.0" "-" COMPU_TAB_REF FORMULA_0495_VTAB /end COMPU_METHOD
/begin COMPU_VTAB FORMULA_0495_VTAB "FORMULA_0495_VTAB" TAB_VERB 3 0 "Aus" 1 "immer Aktiv" 2 "HS Aktiv" /end COMPU_VTAB
/begin COMPU_METHOD FORMULA_0496 "FORMULA_0496" RAT_FUNC "%3.0" "Hz" COEFFS 0 1 0 0 0 1 /end COMPU_METHOD
/begin COMPU_METHOD FORMULA_0497 "FORMULA_0497" RAT_FUNC "%7.2" "-" COEFFS 0 100 0 0 0 1 /end COMPU_METHOD
/begin COMPU_METHOD FORMULA_0498 "FORMULA_0498" RAT_FUNC "%7.2" "Nm/trmp" COEFFS 0 100 0 0 0 1 /end COMPU_METHOD
/begin COMPU_METHOD FORMULA_0499 "FORMULA_0499" RAT_FUNC "%8.3" "s" COEFFS 0 1000 0 0 0 1 /end COMPU_METHOD
/begin COMPU_METHOD FORMULA_0501 "FORMULA_0501" RAT_FUNC "%4.1" "s" COEFFS 0 10 0 0 0 1 /end COMPU_METHOD
/begin COMPU_METHOD FORMULA_0502 "FORMULA_0502" RAT_FUNC "%5.2" "-" COEFFS 0 255 0 0 0 1 /end COMPU_METHOD
/begin COMPU_METHOD FORMULA_0569 "FORMULA_0569" RAT_FUNC "%5.0" "us" COEFFS 0 1 0 0 0 4 /end COMPU_METHOD
/begin COMPU_METHOD FORMULA_0570 "FORMULA_0570" RAT_FUNC "%7.2" "%" COEFFS 0 163.84 0 0 0 1 /end COMPU_METHOD
/begin COMPU_METHOD FORMULA_0571 "FORMULA_0571" RAT_FUNC "%5.0" "Nm/s" COEFFS 0 1 0 0 0 20 /end COMPU_METHOD
/begin COMPU_METHOD FORMULA_0572 "FORMULA_0572" RAT_FUNC "%7.2" "-" COEFFS 0 255 0 0 0 1 /end COMPU_METHOD
/begin COMPU_METHOD FORMULA_0573 "FORMULA_0573" RAT_FUNC "%9.4" "V" COEFFS 0 1 0 0 0 0.00080566 /end COMPU_METHOD
/begin COMPU_METHOD FORMULA_0574 "FORMULA_0574" TAB_VERB "%3.0" "-" COMPU_TAB_REF FORMULA_0574_VTAB /end COMPU_METHOD
/begin COMPU_VTAB FORMULA_0574_VTAB "FORMULA_0574_VTAB" TAB_VERB 2 0 "Aus" 1 "Ein" DEFAULT_VALUE "undefiniert" /end COMPU_VTAB
/begin COMPU_METHOD FORMULA_0575 "FORMULA_0575" TAB_VERB "%3.0" "-" COMPU_TAB_REF FORMULA_0575_VTAB /end COMPU_METHOD
/begin COMPU_VTAB FORMULA_0575_VTAB "FORMULA_0575_VTAB" TAB_VERB 2 0 "Fest" 1 "Adaptiert" DEFAULT_VALUE "undefiniert" /end COMPU_VTAB
/begin COMPU_METHOD FORMULA_0576 "FORMULA_0576" RAT_FUNC "%6.3" "-/asp" COEFFS 0 256 0 0 0 1 /end COMPU_METHOD
/begin COMPU_METHOD FORMULA_0577 "FORMULA_0577" RAT_FUNC "%7.2" "-" COEFFS 0 256 0 0 0 1 /end COMPU_METHOD
/begin COMPU_METHOD FORMULA_0578 "FORMULA_0578" RAT_FUNC "%7.2" "%" COEFFS 0 40.95 0 0 0 1 /end COMPU_METHOD
/begin COMPU_METHOD FORMULA_0579 "FORMULA_0579" RAT_FUNC "%11.4" "-" COEFFS 0 1 0 0 0 1 /end COMPU_METHOD
/* ------------------ Abschnitt erzeugt aus egas.dat ------------------ */
/begin COMPU_METHOD FORMULA_0587 "FORMULA_0587" RAT_FUNC "%5.2" "sec" COEFFS 0 200 0 0 0 1 /end COMPU_METHOD
/begin COMPU_METHOD FORMULA_0590 "FORMULA_0590" RAT_FUNC "%3.0" "ms" COEFFS 0 1 0 0 0 5 /end COMPU_METHOD
/begin COMPU_METHOD FORMULA_0596 "FORMULA_0596" RAT_FUNC "%7.2" "sec" COEFFS 0 200 0 0 0 1 /end COMPU_METHOD
/begin COMPU_METHOD FORMULA_0607 "FORMULA_0607" TAB_VERB "%5.2" "-" COMPU_TAB_REF FORMULA_0607_VTAB /end COMPU_METHOD
/begin COMPU_VTAB FORMULA_0607_VTAB "FORMULA_0607_VTAB" TAB_VERB 3 0 "no Testmode" 1 "noKL50" 2 "Testmode" DEFAULT_VALUE "undef" /end COMPU_VTAB
/begin COMPU_METHOD FORMULA_0608 "FORMULA_0608" TAB_VERB "%5.2" "-" COMPU_TAB_REF FORMULA_0608_VTAB /end COMPU_METHOD
/begin COMPU_VTAB FORMULA_0608_VTAB "FORMULA_0608_VTAB" TAB_VERB 2 0 "no Testmode" 1 "Testmode" DEFAULT_VALUE "undef" /end COMPU_VTAB
/begin COMPU_METHOD FORMULA_0609 "FORMULA_0609" TAB_VERB "%5.2" "-" COMPU_TAB_REF FORMULA_0609_VTAB /end COMPU_METHOD
/begin COMPU_VTAB FORMULA_0609_VTAB "FORMULA_0609_VTAB" TAB_VERB 2 0 "Poti normal" 1 "Poti invers" /end COMPU_VTAB
/begin COMPU_METHOD FORMULA_0610 "FORMULA_0610" TAB_VERB "%5.2" "-" COMPU_TAB_REF FORMULA_0610_VTAB /end COMPU_METHOD
/begin COMPU_VTAB FORMULA_0610_VTAB "FORMULA_0610_VTAB" TAB_VERB 4 0 "aus" 1 "KH" 2 "ML" 3 "KH+ML" /end COMPU_VTAB
/begin COMPU_METHOD FORMULA_0611 "FORMULA_0611" TAB_VERB "%3.0" "-" COMPU_TAB_REF FORMULA_0611_VTAB /end COMPU_METHOD
/begin COMPU_VTAB FORMULA_0611_VTAB "FORMULA_0611_VTAB" TAB_VERB 11 0 "Inaktiv" 1 "LLS1" 2 "LLS2" 3 "LLS1+2" 4 "DK1" 5 "LLS1+DK1" 8 "DK2" 10 "LLS2+DK2" 12 "DK1+2" 15 "Alle" 16 "Bowdenzug" /end COMPU_VTAB
/begin COMPU_METHOD FORMULA_0612 "FORMULA_0612" RAT_FUNC "%7.2" "-" COEFFS 0 -1024 1024 0 0 -1 /end COMPU_METHOD
/begin COMPU_METHOD FORMULA_0613 "FORMULA_0613" RAT_FUNC "%4.1" "%/s" COEFFS 0 10 0 0 0 1 /end COMPU_METHOD
/begin COMPU_METHOD FORMULA_0614 "FORMULA_0614" RAT_FUNC "%8.3" "%/V" COEFFS 0 102400 0 0 0 1023 /end COMPU_METHOD
/begin COMPU_METHOD FORMULA_0625 "FORMULA_0625" TAB_VERB "%5.2" "-" COMPU_TAB_REF FORMULA_0625_VTAB /end COMPU_METHOD
/begin COMPU_VTAB FORMULA_0625_VTAB "FORMULA_0625_VTAB" TAB_VERB 2 0 "SK aus" 1 "SK aktiv" /end COMPU_VTAB
/begin COMPU_METHOD FORMULA_0627 "FORMULA_0627" RAT_FUNC "%5.0" "min" COEFFS 0 60 0 0 0 1 /end COMPU_METHOD
/begin COMPU_METHOD FORMULA_0633 "FORMULA_0633" RAT_FUNC "%7.2" "sec" COEFFS 0 1000 0 0 0 5 /end COMPU_METHOD
/begin COMPU_METHOD FORMULA_0634 "FORMULA_0634" RAT_FUNC "%4.1" "%" COEFFS 0 1.28 0 0 0 1 /end COMPU_METHOD
/begin COMPU_METHOD FORMULA_0679 "FORMULA_0679" RAT_FUNC "%5.2" "s" COEFFS 0 0 25.6 0 1 0 /end COMPU_METHOD
/* ------------------ Abschnitt erzeugt aus tabg.dat ------------------ */
/begin COMPU_METHOD FORMULA_0975 "FORMULA_0975" RAT_FUNC "%7.2" "Kelvin" COEFFS 0 100 0 0 0 1 /end COMPU_METHOD
/begin COMPU_METHOD FORMULA_0976 "FORMULA_0976" TAB_VERB "%3.0" "-" COMPU_TAB_REF FORMULA_0976_VTAB /end COMPU_METHOD
/begin COMPU_VTAB FORMULA_0976_VTAB "FORMULA_0976_VTAB" TAB_VERB 3 0 "Messwert" 1 "Modell" 2 "kein Sensor" /end COMPU_VTAB
/begin COMPU_METHOD FORMULA_0977 "FORMULA_0977" TAB_VERB "%3.0" "-" COMPU_TAB_REF FORMULA_0977_VTAB /end COMPU_METHOD
/begin COMPU_VTAB FORMULA_0977_VTAB "FORMULA_0977_VTAB" TAB_VERB 2 0 "Messwert" 1 "Modell" /end COMPU_VTAB
/begin COMPU_METHOD FORMULA_0978 "FORMULA_0978" RAT_FUNC "%9.4" "W/Km�" COEFFS 0 1000 0 0 0 1 /end COMPU_METHOD
/begin COMPU_METHOD FORMULA_0979 "FORMULA_0979" RAT_FUNC "%9.4" "Wh/Km�km" COEFFS 0 10000 0 0 0 1 /end COMPU_METHOD
/begin COMPU_METHOD FORMULA_0980 "FORMULA_0980" RAT_FUNC "%7.2" "Kelvin" COEFFS 0 20 0 0 0 1 /end COMPU_METHOD
/begin COMPU_METHOD FORMULA_0981 "FORMULA_0981" RAT_FUNC "%7.2" "K/100ms" COEFFS 0 20 0 0 0 1 /end COMPU_METHOD
/begin COMPU_METHOD FORMULA_0982 "FORMULA_0982" RAT_FUNC "%5.0" "J/(kg*K)" COEFFS 0 1 0 0 0 1 /end COMPU_METHOD
/begin COMPU_METHOD FORMULA_0983 "FORMULA_0983" RAT_FUNC "%5.0" "J/Kelvin" COEFFS 0 1 0 0 0 1 /end COMPU_METHOD
/begin COMPU_METHOD FORMULA_0984 "FORMULA_0984" RAT_FUNC "%9.4" "m�" COEFFS 0 10000 0 0 0 1 /end COMPU_METHOD
/begin COMPU_METHOD FORMULA_0985 "FORMULA_0985" RAT_FUNC "%6.1" "Kelvin/s" COEFFS 0 10 0 0 0 1 /end COMPU_METHOD
/begin COMPU_METHOD FORMULA_0986 "FORMULA_0986" RAT_FUNC "%7.2" "min" COEFFS 0 60 0 0 0 1 /end COMPU_METHOD
/* ------------------ Abschnitt erzeugt aus tan.dat ------------------ */
/begin COMPU_METHOD FORMULA_0987 "FORMULA_0987" RAT_FUNC "%8.3" "�C" COEFFS 0 40 10926 0 0 1 /end COMPU_METHOD
/begin COMPU_METHOD FORMULA_0988 "FORMULA_0988" RAT_FUNC "%7.2" "s" COEFFS 0 0 6553.5 0 1 0 /end COMPU_METHOD
/begin COMPU_METHOD FORMULA_0993 "FORMULA_0993" RAT_FUNC "%7.2" "s" COEFFS 0 10 0 0 0 1 /end COMPU_METHOD
/begin COMPU_METHOD FORMULA_0994 "FORMULA_0994" TAB_VERB "%5.2" "-" COMPU_TAB_REF FORMULA_0994_VTAB /end COMPU_METHOD
/begin COMPU_VTAB FORMULA_0994_VTAB "FORMULA_0994_VTAB" TAB_VERB 2 0 "Disabled" 1 "Enabled" /end COMPU_VTAB
/begin COMPU_METHOD FORMULA_0995 "FORMULA_0995" TAB_VERB "%5.2" "-" COMPU_TAB_REF FORMULA_0995_VTAB /end COMPU_METHOD
/begin COMPU_VTAB FORMULA_0995_VTAB "FORMULA_0995_VTAB" TAB_VERB 2 0 "Not Allowed" 1 "Allowed" /end COMPU_VTAB
/begin COMPU_METHOD FORMULA_0996 "FORMULA_0996" TAB_VERB "%5.2" "-" COMPU_TAB_REF FORMULA_0996_VTAB /end COMPU_METHOD
/begin COMPU_VTAB FORMULA_0996_VTAB "FORMULA_0996_VTAB" TAB_VERB 2 0 "All Conditions" 1 "No Conditions" /end COMPU_VTAB
/begin COMPU_METHOD FORMULA_0997 "FORMULA_0997" RAT_FUNC "%5.0" "Kelvin/s" COEFFS 0 1 0 0 0 1 /end COMPU_METHOD
/* ------------------ Abschnitt erzeugt aus ub.dat ------------------ */
/begin COMPU_METHOD FORMULA_1044 "FORMULA_1044" RAT_FUNC "%8.3" "V/5ms" COEFFS 0 1 0 0 0 0.00155892 /end COMPU_METHOD
/* ------------------ Abschnitt erzeugt aus adapt_common.dat ------------------ */ /* ------------------ Abschnitt erzeugt aus adapt_glob.dat ------------------ */ /* ------------------ Abschnitt erzeugt aus crc32.dat ------------------ */ /* ------------------ Abschnitt erzeugt aus debug.dat ------------------ */
/begin CHARACTERISTIC K_DEBUG_READ_ADR "Read Address | EN: Debug read address" VALUE 0x70C4C TKW_VV_VV_UL 100.0 FORMULA_0041 0.0 4294967295.0000 FORMAT "%5.2" /end CHARACTERISTIC
/begin CHARACTERISTIC K_DEBUG_WRITE_ADR "Write Address | EN: Debug write address" VALUE 0x70C50 TKW_VV_VV_UL 100.0 FORMULA_0041 0.0 4294967295.0000 FORMAT "%5.2" /end CHARACTERISTIC
/begin CHARACTERISTIC K_DEBUG_WRITE_VALUE "Write VALUE | EN: Debug write value" VALUE 0x70C54 TKW_VV_VV_UL 100.0 FORMULA_0041 0.0 4294967295.0000 FORMAT "%5.2" /end CHARACTERISTIC
/begin CHARACTERISTIC K_DEBUG_RW_LENGTH "Read/-Write Length | EN: Debug read/write length" VALUE 0x70C58 TKW_VV_VV_UB 100.0 FORMULA_0033 0.0 255.0000 /end CHARACTERISTIC
/* ------------------ Abschnitt erzeugt aus diag_tr_ed.dat ------------------ */
/begin CHARACTERISTIC K_DIAG_TR_UB_MIN "UB-Schwelle ab der die Treiberdiagnose beginnen | EN: Battery-voltage threshold above which driver diagnosis starts" VALUE 0x70C5A TKW_VV_VV_SW 100.0 FORMULA_0008 0.0 28.0000 FORMAT "%4.1" /end CHARACTERISTIC
/* ------------------ Abschnitt erzeugt aus n.dat ------------------ */
/begin CHARACTERISTIC K_N_ZEIT_STOERUNG "Einfrierzeit Drehzahlerfassung nach TPU Stoerung | EN: Freeze time of speed sensing after TPU fault [s]" VALUE 0x7868C TKW_VV_VV_SB 100.0 FORMULA_0317 0.0 1.2700 /end CHARACTERISTIC
/begin CHARACTERISTIC K_N_OBERGRENZE "Plausibilitaetsgrenze fuer die n-Erfassung | EN: Plausibility limit for engine-speed sensing [Upm]" VALUE 0x7868E TKW_VV_VV_SW 100.0 FORMULA_0006 0.0 20000.0000 /end CHARACTERISTIC
/begin CHARACTERISTIC K_N_MIN_FREEZE "Minimale Eintrittsdrehzahl fuer Drehzahl-Freeze | EN: Minimum entry speed for engine-speed freeze [Upm]" VALUE 0x78690 TKW_VV_VV_SW 100.0 FORMULA_0006 0.0 10000.0000 /end CHARACTERISTIC
/* ------------------ Abschnitt erzeugt aus adapt.dat ------------------ */ /* ------------------ Abschnitt erzeugt aus adapt_wichtig.dat ------------------ */ /* ------------------ Abschnitt erzeugt aus afz.dat ------------------ */
/begin CHARACTERISTIC K_AFZ_TAU "Filterkonstante fuer die Beschleunigung Fahrzeug" VALUE 0x70294 TKW_VV_VV_UB 100.0 FORMULA_0462 0.0101 2.5600 /end CHARACTERISTIC
/begin CHARACTERISTIC K_AFZ_BERG_TAU "Filterkonstante fuer die Fahrbahnneigung" VALUE 0x70295 TKW_VV_VV_UB 100.0 FORMULA_0462 0.0101 2.5600 /end CHARACTERISTIC
/begin CHARACTERISTIC K_AFZ_A0_MIN "minimaler Nullpunktadaptionwert" VALUE 0x70296 TKW_VV_VV_SW 100.0 FORMULA_0123 0.0 1023.0000 /end CHARACTERISTIC
/begin CHARACTERISTIC K_AFZ_A0_MAX "maximaler Nullpunktadaptionwert" VALUE 0x70298 TKW_VV_VV_SW 100.0 FORMULA_0123 0.0 1023.0000 /end CHARACTERISTIC
/begin CHARACTERISTIC K_AFZ_DIAG_MIN "elektrische Diagnoseschwelle short-to-gnd" VALUE 0x7029A TKW_VV_VV_SW 100.0 FORMULA_0123 0.0 1023.0000 /end CHARACTERISTIC
/begin CHARACTERISTIC K_AFZ_DIAG_MAX "elektrische Diagnoseschwelle short-to-ub" VALUE 0x7029C TKW_VV_VV_SW 100.0 FORMULA_0123 0.0 1023.0000 /end CHARACTERISTIC
/begin CHARACTERISTIC K_AFZ_DIAG_AX "Bandgrenze Beschl. Fzg - Beschl. DSC" VALUE 0x7029E TKW_VV_VV_SW 100.0 FORMULA_0132 -50.0000 50.0000 FORMAT "%5.2" /end CHARACTERISTIC
/begin CHARACTERISTIC K_AFZ_DIAG_T "Timergrenze, um Diagnose zu beenden" VALUE 0x702A0 TKW_VV_VV_UW 100.0 FORMULA_0021 0.0 655.0000 FORMAT "%5.2" /end CHARACTERISTIC
/begin CHARACTERISTIC K_AFZ_F_KONV_ZAEHLER "Konvertierungsfaktor Zaehler AD-Wert nach Beschleunigung" VALUE 0x702A2 TKW_VV_VV_SW 100.0 FORMULA_0010 -32768.0000 32767.0000 /end CHARACTERISTIC
/begin CHARACTERISTIC K_AFZ_F_KONV_NENNER "Konvertierungsfaktor Nenner AD-Wert nach Beschleunigung" VALUE 0x702A4 TKW_VV_VV_SW 100.0 FORMULA_0010 -32768.0000 32767.0000 /end CHARACTERISTIC
/begin CHARACTERISTIC K_AFZ_A0 "applizierbarer Adaptionswert" VALUE 0x702A6 TKW_VV_VV_SW 100.0 FORMULA_0458 -50.0000 50.0000 FORMAT "%5.2" /end CHARACTERISTIC
/begin CHARACTERISTIC K_AFZ_A0_CNT_MAX "Zaehlerwert zum Beenden der Adaption" VALUE 0x702A8 TKW_VV_VV_UB 100.0 FORMULA_0003 0.0 255.0000 /end CHARACTERISTIC
/begin CHARACTERISTIC K_AFZ_MD_KUPP_WUNSCH_GES_MAX "max. Wunschmoment fuer Nachadaption" VALUE 0x702AA TKW_VV_VV_SW 100.0 FORMULA_0009 -100.0000 1000.0000 FORMAT "%4.1" /end CHARACTERISTIC
/begin CHARACTERISTIC K_AFZ_CAN_BRP_MAX "max. Bremsdruck fuer Nachadaption" VALUE 0x702AC TKW_VV_VV_UB 100.0 FORMULA_0138 0.0 200.0000 /end CHARACTERISTIC
/begin CHARACTERISTIC K_AFZ_V_DIREKT_WEG "Wegintervall fuer Nachadaption" VALUE 0x702B0 TKW_VV_VV_UL 100.0 FORMULA_0460 0.0 2684354.5593 FORMAT "%4.1" /end CHARACTERISTIC
/begin CHARACTERISTIC K_AFZ_NA0_CNT2_MAX "Anzahl der Durchschnittswerte fuer Nachadaption" VALUE 0x702B4 TKW_VV_VV_UW 100.0 FORMULA_0010 0.0 65535.0000 /end CHARACTERISTIC
/begin CHARACTERISTIC K_AFZ_NA0_FAK "Faktor Nachadaption" VALUE 0x702B6 TKW_VV_VV_SW 100.0 FORMULA_0463 -200.0000 200.0000 FORMAT "%4.1" /end CHARACTERISTIC
/* ------------------ Abschnitt erzeugt aus ag_tz.dat ------------------ */
/begin CHARACTERISTIC K_AG_TZ_CFG "Welcher Aussetzergenerator" VALUE 0x702B8 TKW_VV_VV_UB 100.0 FORMULA_0465 0.0 3.0 /end CHARACTERISTIC
/begin CHARACTERISTIC K_AG_TZ_ZYL "Statisches Ausblendmuster. | EN: Static suppression pattern" VALUE 0x702BA TKW_VV_VV_UW 100.0 FORMULA_0010 0.0 65535.0000 /end CHARACTERISTIC
/begin CHARACTERISTIC K_AG_TZ_ANZ "Anzahl der unmittelbar aufeinanderfolgenden Ausblendungen. | EN: Number of directly consecutive suppressions" VALUE 0x702BC TKW_VV_VV_UW 100.0 FORMULA_0010 0.0 65535.0000 /end CHARACTERISTIC
/begin CHARACTERISTIC K_AG_TZ_PAUSE "Anzahl der Arbeitsspiele zwischen Ausblendungen. | EN: Number of working cycles between suppressions" VALUE 0x702BE TKW_VV_VV_UW 100.0 FORMULA_0010 0.0 65535.0000 /end CHARACTERISTIC
/begin CHARACTERISTIC K_AG_TZ_V_MIN "Minimale Geschwindigkeitsschwelle. | EN: Minimum vehicle speed threshold [km/h]" VALUE 0x702C0 TKW_VV_VV_SW 100.0 FORMULA_0078 -80.0000 360.0000 FORMAT "%4.1" /end CHARACTERISTIC
/* ------------------ Abschnitt erzeugt aus ar.dat ------------------ */
/begin CHARACTERISTIC K_AR_CFG "Konfiguration | EN: Configuration" VALUE 0x7039A TKW_VV_VV_UB 100.0 FORMULA_0483 0.0 255.0 /end CHARACTERISTIC
/begin CHARACTERISTIC K_AR_N_MIN "min. Schwelle | EN: Minimum threshold" VALUE 0x7039C TKW_VV_VV_SW 100.0 FORMULA_0006 0.0 10000.0000 /end CHARACTERISTIC
/begin CHARACTERISTIC K_AR_N_MAX "max. Schwelle | EN: Maximum threshold" VALUE 0x7039E TKW_VV_VV_SW 100.0 FORMULA_0006 0.0 10000.0000 /end CHARACTERISTIC
/begin CHARACTERISTIC K_AR_T_PAS_DELAY "Delay nach Sperre | EN: Delay after lock-out" VALUE 0x703A0 TKW_VV_VV_UW 100.0 FORMULA_0117 0.0 325.0000 FORMAT "%5.2" /end CHARACTERISTIC
/begin CHARACTERISTIC K_AR_T_MAX "max. AR-Eingriffszeit | EN: Maximum anti-jerk intervention time" VALUE 0x703A2 TKW_VV_VV_UW 100.0 FORMULA_0117 0.0 325.0000 FORMAT "%5.2" /end CHARACTERISTIC
/begin CHARACTERISTIC K_AR_N_DIF_BESCHL_1 "Schwelle fuer 1. BWelle | EN: Threshold for 1st acceleration wave" VALUE 0x703A4 TKW_VV_VV_SW 100.0 FORMULA_0006 -10000.0000 10000.0000 /end CHARACTERISTIC
/begin CHARACTERISTIC K_AR_N_DIF_BESCHL_2 "Schwelle fuer 2. BWelle | EN: Threshold for 2nd acceleration wave" VALUE 0x703A6 TKW_VV_VV_SW 100.0 FORMULA_0006 -10000.0000 10000.0000 /end CHARACTERISTIC
/begin CHARACTERISTIC K_AR_N_DIF_VERZ_1 "Schwelle fuer 1. VWelle | EN: Threshold for 1st deceleration wave" VALUE 0x703A8 TKW_VV_VV_SW 100.0 FORMULA_0006 -10000.0000 10000.0000 /end CHARACTERISTIC
/begin CHARACTERISTIC K_AR_N_DIF_VERZ_2 "Schwelle fuer 2. VWelle | EN: Threshold for 2nd deceleration wave" VALUE 0x703AA TKW_VV_VV_SW 100.0 FORMULA_0006 -10000.0000 10000.0000 /end CHARACTERISTIC
/begin CHARACTERISTIC K_AR_N_DIF_REF_MIN "min. Differenz | EN: Minimum difference" VALUE 0x703AC TKW_VV_VV_SW 100.0 FORMULA_0006 -10000.0000 10000.0000 /end CHARACTERISTIC
/begin CHARACTERISTIC K_AR_N_DIF_REF_MAX "max. Differenz | EN: Maximum difference" VALUE 0x703AE TKW_VV_VV_SW 100.0 FORMULA_0006 -10000.0000 10000.0000 /end CHARACTERISTIC
/begin CHARACTERISTIC K_AR_KORR_P_R "P-Anteil zum Aufregeln auf n | EN: P share for ramping up to target rpm" VALUE 0x703B0 TKW_VV_VV_UW 100.0 FORMULA_0484 0.0 8.0000 FORMAT "%5.2" /end CHARACTERISTIC
/begin CHARACTERISTIC K_AR_KORR_P_N "P-Anteil zum Aufregeln auf n | EN: P share for ramping up to target rpm" VALUE 0x703B2 TKW_VV_VV_UW 100.0 FORMULA_0484 0.0 8.0000 FORMAT "%5.2" /end CHARACTERISTIC
/begin CHARACTERISTIC K_AR_KORR_P_1 "P-Anteil zum Aufregeln auf n | EN: P share for ramping up to target rpm" VALUE 0x703B4 TKW_VV_VV_UW 100.0 FORMULA_0484 0.0 8.0000 FORMAT "%5.2" /end CHARACTERISTIC
/begin CHARACTERISTIC K_AR_KORR_P_2 "P-Anteil zum Aufregeln auf n | EN: P share for ramping up to target rpm" VALUE 0x703B6 TKW_VV_VV_UW 100.0 FORMULA_0484 0.0 8.0000 FORMAT "%5.2" /end CHARACTERISTIC
/begin CHARACTERISTIC K_AR_KORR_P_3 "P-Anteil zum Aufregeln auf n | EN: P share for ramping up to target rpm" VALUE 0x703B8 TKW_VV_VV_UW 100.0 FORMULA_0484 0.0 8.0000 FORMAT "%5.2" /end CHARACTERISTIC
/begin CHARACTERISTIC K_AR_KORR_P_4 "P-Anteil zum Aufregeln auf n | EN: P share for ramping up to target rpm" VALUE 0x703BA TKW_VV_VV_UW 100.0 FORMULA_0484 0.0 8.0000 FORMAT "%5.2" /end CHARACTERISTIC
/begin CHARACTERISTIC K_AR_KORR_P_5 "P-Anteil zum Aufregeln auf n | EN: P share for ramping up to target rpm" VALUE 0x703BC TKW_VV_VV_UW 100.0 FORMULA_0484 0.0 8.0000 FORMAT "%5.2" /end CHARACTERISTIC
/begin CHARACTERISTIC K_AR_KORR_P_6 "P-Anteil zum Aufregeln auf n | EN: P share for ramping up to target rpm" VALUE 0x703BE TKW_VV_VV_UW 100.0 FORMULA_0484 0.0 8.0000 FORMAT "%5.2" /end CHARACTERISTIC
/begin CHARACTERISTIC K_AR_KORR_P_7 "P-Anteil zum Aufregeln auf n | EN: P share for ramping up to target rpm" VALUE 0x703C0 TKW_VV_VV_UW 100.0 FORMULA_0484 0.0 8.0000 FORMAT "%5.2" /end CHARACTERISTIC
/begin CHARACTERISTIC K_AR_N_FIL_0 "Filterkonstante | EN: Filter constant" VALUE 0x703C2 TKW_VV_VV_SW 100.0 FORMULA_0485 -0.0300 0.0300 FORMAT "%7.4" /end CHARACTERISTIC
/begin CHARACTERISTIC K_AR_N_FIL_1 "Filterkonstante | EN: Filter constant" VALUE 0x703C4 TKW_VV_VV_SW 100.0 FORMULA_0485 -0.0300 0.0300 FORMAT "%7.4" /end CHARACTERISTIC
/begin CHARACTERISTIC K_AR_N_FIL_2 "Filterkonstante | EN: Filter constant" VALUE 0x703C6 TKW_VV_VV_SW 100.0 FORMULA_0485 -0.0300 0.0300 FORMAT "%7.4" /end CHARACTERISTIC
/begin CHARACTERISTIC K_AR_N_FIL_3 "Filterkonstante | EN: Filter constant" VALUE 0x703C8 TKW_VV_VV_SW 100.0 FORMULA_0295 -2.0000 1.9900 FORMAT "%7.4" /end CHARACTERISTIC
/begin CHARACTERISTIC K_AR_N_FIL_4 "Filterkonstante | EN: Filter constant" VALUE 0x703CA TKW_VV_VV_SW 100.0 FORMULA_0295 -2.0000 1.9900 FORMAT "%7.4" /end CHARACTERISTIC
/begin CHARACTERISTIC K_AR_FAK_KOMFORT "Wichtungsfaktor bei Komfort | EN: Weighting factor in Comfort mode" VALUE 0x703CC TKW_VV_VV_UW 100.0 FORMULA_0075 0.0 4.0000 FORMAT "%6.3" /end CHARACTERISTIC
/begin CHARACTERISTIC K_AR_FAK_SPORT "Wichtungsfaktor bei Sport | EN: Weighting factor in Sport mode" VALUE 0x703CE TKW_VV_VV_UW 100.0 FORMULA_0075 0.0 4.0000 FORMAT "%6.3" /end CHARACTERISTIC
/begin CHARACTERISTIC K_AR_MD_MIN "min. Momentenanforderung | EN: Minimum torque request" VALUE 0x703D0 TKW_VV_VV_SW 100.0 FORMULA_0009 -100.0000 1000.0000 FORMAT "%4.1" /end CHARACTERISTIC
/begin CHARACTERISTIC K_AR_MD_MAX "max. Momentenanforderung | EN: Maximum torque request" VALUE 0x703D2 TKW_VV_VV_SW 100.0 FORMULA_0009 -100.0000 1000.0000 FORMAT "%4.1" /end CHARACTERISTIC
/begin CHARACTERISTIC KF_AR_MD_FAKTOR "P-Regler | EN: P controller" MAP 0x703D4 TKF_SW_SW_SW 100.0 FORMULA_0484 -2.0000 2.0000 /begin AXIS_DESCR STD_AXIS FORMULA_0006 8 0.0 10000.0000 /end AXIS_DESCR /begin AXIS_DESCR STD_AXIS FORMULA_0486 8 -1.0000 10.0000 /end AXIS_DESCR FORMAT "%5.2" /end CHARACTERISTIC
/* ------------------ Abschnitt erzeugt aus at.dat ------------------ */
/begin CHARACTERISTIC K_AT_CFG "Schalter Konfiguration Anti-Trampel-Funktion" VALUE 0x70476 TKW_VV_VV_UB 100.0 FORMULA_0495 0.0 255.0 /end CHARACTERISTIC
/begin CHARACTERISTIC K_AT_N_MIN "Minimale Motordrehzahl fuer Anti-Trampeln Eingriff" VALUE 0x70478 TKW_VV_VV_SW 100.0 FORMULA_0006 0.0 10000.0000 /end CHARACTERISTIC
/begin CHARACTERISTIC K_AT_N_MAX "Maximale Motordrehzahl fuer Anti-Trampeln Eingriff | EN: Maximale Motordrehzahl fuer Anti-Trampeln Eingriff" VALUE 0x7047A TKW_VV_VV_SW 100.0 FORMULA_0006 0.0 10000.0000 /end CHARACTERISTIC
/begin CHARACTERISTIC K_AT_SK_MAX "Maximales Notprogramm fuer Anti-Trampeln Eingriff" VALUE 0x7047C TKW_VV_VV_UB 100.0 FORMULA_0003 0.0 255.0000 /end CHARACTERISTIC
/begin CHARACTERISTIC K_AT_FG_TP_V "Grenzfrequenz TP Radgeschwindigkeit" VALUE 0x7047D TKW_VV_VV_UB 100.0 FORMULA_0496 0.0 255.0000 /end CHARACTERISTIC
/begin CHARACTERISTIC K_AT_FG_TP_N "Grenzfrequenz TP Motordrehzahl" VALUE 0x7047E TKW_VV_VV_UB 100.0 FORMULA_0496 0.0 255.0000 /end CHARACTERISTIC
/begin CHARACTERISTIC K_AT_FG_TP_TRAMPIN "Grenzfrequenz TP Trampeln" VALUE 0x7047F TKW_VV_VV_UB 100.0 FORMULA_0496 0.0 255.0000 /end CHARACTERISTIC
/begin CHARACTERISTIC K_AT_FG_TP_V_GRAD "Grenzfrequenz TP Radgeschwindigkeitsgradient" VALUE 0x70480 TKW_VV_VV_UB 100.0 FORMULA_0496 0.0 255.0000 /end CHARACTERISTIC
/begin CHARACTERISTIC K_AT_V_GRAD_UP_TAU "Zeitkonstante positiver Radgeschwindigkeitsgradient" VALUE 0x70481 TKW_VV_VV_UB 100.0 FORMULA_0478 0.0051 1.2800 /end CHARACTERISTIC
/begin CHARACTERISTIC K_AT_V_GRAD_DOWN_TAU "Zeitkonstante negativer Radgeschwindigkeitsgradient" VALUE 0x70482 TKW_VV_VV_UB 100.0 FORMULA_0478 0.0051 1.2800 /end CHARACTERISTIC
/begin CHARACTERISTIC K_AT_V_GRAD_INT_TGL "Gradientenumschaltung 80ms / 100ms Periode" VALUE 0x70484 TKW_VV_VV_SW 100.0 FORMULA_0078 -80.0000 360.0000 FORMAT "%4.1" /end CHARACTERISTIC
/begin CHARACTERISTIC K_AT_V_GRAD_INT_TAU "Zeitkonstante negativer Radgeschwindigkeitsgradient" VALUE 0x70486 TKW_VV_VV_UB 100.0 FORMULA_0478 0.0051 1.2800 /end CHARACTERISTIC
/begin CHARACTERISTIC K_AT_TRAMPIN_SOLL_START "Startschwelle AT Eingriff | EN: Startschwelle AT Eingriff" VALUE 0x70488 TKW_VV_VV_SW 100.0 FORMULA_0452 -80.0000 360.0000 FORMAT "%4.1" /end CHARACTERISTIC
/begin CHARACTERISTIC K_AT_TRAMPIN_SOLL_STOP "Startschwelle AT Eingriff" VALUE 0x7048A TKW_VV_VV_SW 100.0 FORMULA_0452 -80.0000 360.0000 FORMAT "%4.1" /end CHARACTERISTIC
/begin CHARACTERISTIC K_AT_TRAMPIN_SOLL_SCHUB "Schwelle Schubabschaltung AT Eingriff" VALUE 0x7048C TKW_VV_VV_SW 100.0 FORMULA_0452 -80.0000 360.0000 FORMAT "%4.1" /end CHARACTERISTIC
/begin CHARACTERISTIC K_AT_MD_BEGR_A1 "Koeffizient a1, PID-Regler | EN: Koeffizient a1, PID-Regler" VALUE 0x7048E TKW_VV_VV_SW 100.0 FORMULA_0497 -10.0000 10.0000 FORMAT "%5.2" /end CHARACTERISTIC
/begin CHARACTERISTIC K_AT_MD_GRAD_TAU_POS "PT1 Filterkonstante f�r positive Gradienten" VALUE 0x70490 TKW_VV_VV_UB 100.0 FORMULA_0478 0.0051 1.2800 /end CHARACTERISTIC
/begin CHARACTERISTIC K_AT_MD_GRAD_TAU_NEG "PT1 Filterkonstante f�r positive Gradienten" VALUE 0x70491 TKW_VV_VV_UB 100.0 FORMULA_0478 0.0051 1.2800 /end CHARACTERISTIC
/begin CHARACTERISTIC KL_AT_V_TP_A2 "Filterkoeffizient A2" CURVE 0x70492 TKL_UB_VV_SW 100.0 FORMULA_0491 -4.0000 3.9998 /begin AXIS_DESCR STD_AXIS Grenzfrequenz FORMULA_0496 12 0.0 255.0000 /end AXIS_DESCR FORMAT "%7.4" /end CHARACTERISTIC
/begin CHARACTERISTIC KL_AT_V_TP_A3 "Filterkoeffizient A3" CURVE 0x704B8 TKL_UB_VV_SW 100.0 FORMULA_0491 -4.0000 3.9998 /begin AXIS_DESCR STD_AXIS Grenzfrequenz FORMULA_0496 12 0.0 255.0000 /end AXIS_DESCR FORMAT "%7.4" /end CHARACTERISTIC
/begin CHARACTERISTIC KL_AT_V_TP_B1 "Filterkoeffizient B1" CURVE 0x704DE TKL_UB_VV_SW 100.0 FORMULA_0491 -4.0000 3.9998 /begin AXIS_DESCR STD_AXIS Grenzfrequenz FORMULA_0496 12 0.0 255.0000 /end AXIS_DESCR FORMAT "%7.4" /end CHARACTERISTIC
/begin CHARACTERISTIC KL_AT_V_TP_B2 "Filterkoeffizient B2" CURVE 0x70504 TKL_UB_VV_SW 100.0 FORMULA_0491 -4.0000 3.9998 /begin AXIS_DESCR STD_AXIS Grenzfrequenz FORMULA_0496 12 0.0 255.0000 /end AXIS_DESCR FORMAT "%7.4" /end CHARACTERISTIC
/begin CHARACTERISTIC KL_AT_V_TP_B3 "Filterkoeffizient B3" CURVE 0x7052A TKL_UB_VV_SW 100.0 FORMULA_0491 -4.0000 3.9998 /begin AXIS_DESCR STD_AXIS Grenzfrequenz FORMULA_0496 12 0.0 255.0000 /end AXIS_DESCR FORMAT "%7.4" /end CHARACTERISTIC
/begin CHARACTERISTIC KL_AT_N_FAK "Drehzahlwichtung" CURVE 0x70550 TKL_SW_VV_SW 100.0 FORMULA_0075 -2.0000 2.0000 /begin AXIS_DESCR STD_AXIS Trampeln_n FORMULA_0006 6 0.0 10000.0000 /end AXIS_DESCR FORMAT "%6.3" /end CHARACTERISTIC
/begin CHARACTERISTIC KL_AT_SCHLUPF_FAK "Schlupfwichtung" CURVE 0x7056A TKL_SW_VV_SW 100.0 FORMULA_0075 -2.0000 2.0000
 /begin AXIS_DESCR STD_AXIS Schlupf FORMULA_0463 6 -300.0000 300.0000 FORMAT "%4.1" /end AXIS_DESCR
 FORMAT "%6.3" /end CHARACTERISTIC
/begin CHARACTERISTIC KL_AT_V_GRAD_FAK "Wichtung Radgeschwindigkeitsgradient" CURVE 0x70584 TKL_SW_VV_SW 100.0 FORMULA_0075 -2.0000 2.0000
 /begin AXIS_DESCR STD_AXIS Gradient FORMULA_0078 6 -80.0000 360.0000 FORMAT "%4.1" /end AXIS_DESCR
 FORMAT "%6.3" /end CHARACTERISTIC
/begin CHARACTERISTIC KL_AT_V_GRAD_INT_FAK "Wichtung Gradientensumme HL und HR" CURVE 0x7059E TKL_SW_VV_SW 100.0 FORMULA_0075 -2.0000 2.0000
 /begin AXIS_DESCR STD_AXIS Gradient FORMULA_0078 6 -80.0000 360.0000 FORMAT "%4.1" /end AXIS_DESCR
 FORMAT "%6.3" /end CHARACTERISTIC
/begin CHARACTERISTIC KL_AT_MD_KUPP_MIN "minimales Moment durch AT Begrenzung" CURVE 0x705B8 TKL_SW_VV_SW 100.0 FORMULA_0009 -100.0000 1000.0000
 /begin AXIS_DESCR STD_AXIS Fahrerwunsch FORMULA_0009 4 -100.0000 1000.0000 FORMAT "%4.1" /end AXIS_DESCR
 FORMAT "%4.1" /end CHARACTERISTIC
/begin CHARACTERISTIC KL_AT_TRAMPIN_SCHUB "Momenteneingriff bei Schubtrampeln" CURVE 0x705CA TKL_SW_VV_SW 100.0 FORMULA_0009 -100.0000 1000.0000
 /begin AXIS_DESCR STD_AXIS Trampelintensitaet FORMULA_0452 8 -80.0000 360.0000 FORMAT "%4.1" /end AXIS_DESCR
 FORMAT "%4.1" /end CHARACTERISTIC
/begin CHARACTERISTIC KL_AT_MD_BEGR_KR_FAK "Faktor auf KR" CURVE 0x705EC TKL_SW_VV_UW 100.0 FORMULA_0075 0.0 20.0000
 /begin AXIS_DESCR STD_AXIS Regelabweichung FORMULA_0452 5 -360.0000 360.0000 FORMAT "%4.1" /end AXIS_DESCR
 FORMAT "%6.3" /end CHARACTERISTIC
/begin CHARACTERISTIC KL_AT_MD_BEGR_TN_FAK "Faktor auf TN" CURVE 0x70602 TKL_SW_VV_UW 100.0 FORMULA_0075 0.0 20.0000
 /begin AXIS_DESCR STD_AXIS Regelabweichung FORMULA_0452 5 -360.0000 360.0000 FORMAT "%4.1" /end AXIS_DESCR
 FORMAT "%6.3" /end CHARACTERISTIC
/begin CHARACTERISTIC KL_AT_MD_BEGR_TV_FAK "Faktor auf TV" CURVE 0x70618 TKL_SW_VV_UW 100.0 FORMULA_0075 0.0 20.0000
 /begin AXIS_DESCR STD_AXIS Regelabweichung FORMULA_0452 5 -360.0000 360.0000 FORMAT "%4.1" /end AXIS_DESCR
 FORMAT "%6.3" /end CHARACTERISTIC
/begin CHARACTERISTIC KF_AT_MD_BEGR_KR "Regelparameter KR" MAP 0x7062E TKF_SW_SW_SW 100.0 FORMULA_0498 0.0 20.0000 /begin AXIS_DESCR STD_AXIS Gang FORMULA_0486 6 -1.0000 10.0000 /end AXIS_DESCR
 /begin AXIS_DESCR STD_AXIS Wunschmoment FORMULA_0009 6 -100.0000 1000.0000 FORMAT "%4.1" /end AXIS_DESCR
 FORMAT "%5.2" /end CHARACTERISTIC
/begin CHARACTERISTIC KF_AT_MD_BEGR_TN "Regelparameter TN" MAP 0x70690 TKF_SW_SW_SW 100.0 FORMULA_0499 0.0030 30.0000 /begin AXIS_DESCR STD_AXIS Gang FORMULA_0486 6 -1.0000 10.0000 /end AXIS_DESCR
 /begin AXIS_DESCR STD_AXIS Wunschmoment FORMULA_0009 6 -100.0000 1000.0000 FORMAT "%4.1" /end AXIS_DESCR
 FORMAT "%6.3" /end CHARACTERISTIC
/begin CHARACTERISTIC KF_AT_MD_BEGR_TV "Regelparameter TV" MAP 0x706F2 TKF_SW_SW_SW 100.0 FORMULA_0499 0.0 20.0000 /begin AXIS_DESCR STD_AXIS Gang FORMULA_0486 6 -1.0000 10.0000 /end AXIS_DESCR
 /begin AXIS_DESCR STD_AXIS Wunschmoment FORMULA_0009 6 -100.0000 1000.0000 FORMAT "%4.1" /end AXIS_DESCR
 FORMAT "%6.3" /end CHARACTERISTIC
/* ------------------ Abschnitt erzeugt aus auss.dat ------------------ */
/begin CHARACTERISTIC K_AUSS_SPARK_TIME_MIN "Min zulaessige Funkenbrenndauer bei Verbrennungsaussetzer" VALUE 0x70754 TKW_VV_VV_SW 100.0 FORMULA_0447 0.0 4.6810 FORMAT "%5.2" /end CHARACTERISTIC
/begin CHARACTERISTIC K_AUSS_LP_MIN_BEGR "Minimalbegrenzung Aussetzer-Integralschwelle." VALUE 0x70756 TKW_VV_VV_SW 100.0 FORMULA_0245 0.0 4.0000 FORMAT "%5.2" /end CHARACTERISTIC
/begin CHARACTERISTIC K_AUSS_ED_LP_INT_MIN "Aussetzer-Integralschwelle bei Fehler Verstaerkungsumschaltung." VALUE 0x70758 TKW_VV_VV_SW 100.0 FORMULA_0245 0.0 4.0000 FORMAT "%5.2" /end CHARACTERISTIC
/begin CHARACTERISTIC K_AUSS_LP_MAX_OFFSET "Maximal zul. Offset des Tiefpassgefilterteren Leitwertes." VALUE 0x7075A TKW_VV_VV_SW 100.0 FORMULA_0443 0.0 3.3000 FORMAT "%5.2" /end CHARACTERISTIC
/begin CHARACTERISTIC K_AUSS_LP_NV_OFFSET "Offset zu auss_lp_min_sa_max_nv." VALUE 0x7075C TKW_VV_VV_SW 100.0 FORMULA_0443 0.0 3.3000 FORMAT "%5.2" /end CHARACTERISTIC
/begin CHARACTERISTIC K_AUSS_LP_MIN_NV_TREPP "Stufe fuer zuruecklernen von auss_lp_min_sa_max_nv." VALUE 0x7075E TKW_VV_VV_SW 100.0 FORMULA_0573 0.0 3.3000 FORMAT "%7.4" /end CHARACTERISTIC
/begin CHARACTERISTIC K_AUSS_OBD_CFG "Schalter Freigabe Aussetzererkennung: 0 = Aus; 1 = Aktiv | EN: Schalter Freigabe Aussetzererkennung: 0 = Aus; 1 = Aktiv" VALUE 0x70760 TKW_VV_VV_UB 100.0 FORMULA_0574 0.0 1.0 /end CHARACTERISTIC
/begin CHARACTERISTIC K_AUSS_MAX_OFFSET_CFG "Schalter Minimalwertbegrenzung | EN: Schalter Minimalwertbegrenzung" VALUE 0x70761 TKW_VV_VV_UB 100.0 FORMULA_0575 0.0 255.0 /end CHARACTERISTIC
/begin CHARACTERISTIC K_AUSS_OBD_RATE_ABG_ZYL "Rate Aussetzer je Zylinder Abgas. | EN: Rate Aussetzer je Zylinder Abgas." VALUE 0x70762 TKW_VV_VV_UB 100.0 FORMULA_0003 0.0 255.0000 /end CHARACTERISTIC
/begin CHARACTERISTIC K_AUSS_OBD_ABG_1 "Schwelle Aussetzer Abgas 1.Intervall. | EN: Schwelle Aussetzer Abgas 1.Intervall. [V912: differs from V452 160E]" VALUE 0x70763 TKW_VV_VV_UB 100.0 FORMULA_0003 0.0 255.0000 /end CHARACTERISTIC
/begin CHARACTERISTIC K_AUSS_OBD_ABG_4 "Schwelle Aussetzer je 1000er Intervall. | EN: Schwelle Aussetzer je 1000er Intervall." VALUE 0x70764 TKW_VV_VV_UB 100.0 FORMULA_0003 0.0 255.0000 /end CHARACTERISTIC
/begin CHARACTERISTIC K_AUSS_OBD_SA_CNT "Anzahl der SA-Bereiche fuer Wiedereinsetzen. | EN: Anzahl der SA-Bereiche fuer Wiedereinsetzen." VALUE 0x70765 TKW_VV_VV_UB 100.0 FORMULA_0003 0.0 255.0000 /end CHARACTERISTIC
/begin CHARACTERISTIC K_AUSS_OBD_SA_T_MIN "Min. Dauer fuer SA-Bereiche fuer Wiedereinsetzen. | EN: Min. Dauer fuer SA-Bereiche fuer Wiedereinsetzen." VALUE 0x70766 TKW_VV_VV_UB 100.0 FORMULA_0501 0.0 25.5000 /end CHARACTERISTIC
/begin CHARACTERISTIC K_AUSS_RF_TAU "Tau fuer auss_rf_fil" VALUE 0x70767 TKW_VV_VV_UB 100.0 FORMULA_0462 0.0101 2.5600 /end CHARACTERISTIC
/begin CHARACTERISTIC K_AUSS_SPARK_TIME_TAU "Tau fuer auss_spark_time_fil" VALUE 0x70768 TKW_VV_VV_UB 100.0 FORMULA_0576 0.0040 0.9960 /end CHARACTERISTIC
/begin CHARACTERISTIC K_AUSS_NS_TIME_MAX_SAT_0 "Maximal zulaessige Nebenschlusszeit im Aussetzerfenster." VALUE 0x7076A TKW_VV_VV_UW 100.0 FORMULA_0448 0.0 24.5760 FORMAT "%5.2" /end CHARACTERISTIC
/begin CHARACTERISTIC K_AUSS_NS_TIME_MAX_SAT_1 "Maximal zulaessige Nebenschlusszeit im Aussetzerfenster." VALUE 0x7076C TKW_VV_VV_UW 100.0 FORMULA_0448 0.0 24.5760 FORMAT "%5.2" /end CHARACTERISTIC
/begin CHARACTERISTIC K_AUSS_NS_TIME_MAX_SAT_2 "Maximal zulaessige Nebenschlusszeit im Aussetzerfenster." VALUE 0x7076E TKW_VV_VV_UW 100.0 FORMULA_0448 0.0 24.5760 FORMAT "%5.2" /end CHARACTERISTIC
/begin CHARACTERISTIC K_AUSS_NS_TIME_MAX_SAT_3 "Maximal zulaessige Nebenschlusszeit im Aussetzerfenster." VALUE 0x70770 TKW_VV_VV_UW 100.0 FORMULA_0448 0.0 24.5760 FORMAT "%5.2" /end CHARACTERISTIC
/begin CHARACTERISTIC K_AUSS_NS_TIME_MAX_IC_0 "Maximal zulaessige Nebenschlusszeit im Aussetzerfenster." VALUE 0x70772 TKW_VV_VV_UW 100.0 FORMULA_0448 0.0 24.5760 FORMAT "%5.2" /end CHARACTERISTIC
/begin CHARACTERISTIC K_AUSS_NS_TIME_MAX_IC_1 "Maximal zulaessige Nebenschlusszeit im Aussetzerfenster." VALUE 0x70774 TKW_VV_VV_UW 100.0 FORMULA_0448 0.0 24.5760 FORMAT "%5.2" /end CHARACTERISTIC
/begin CHARACTERISTIC K_AUSS_NS_TIME_MAX_IC_2 "Maximal zulaessige Nebenschlusszeit im Aussetzerfenster." VALUE 0x70776 TKW_VV_VV_UW 100.0 FORMULA_0448 0.0 24.5760 FORMAT "%5.2" /end CHARACTERISTIC
/begin CHARACTERISTIC K_AUSS_NS_TIME_MAX_IC_3 "Maximal zulaessige Nebenschlusszeit im Aussetzerfenster." VALUE 0x70778 TKW_VV_VV_UW 100.0 FORMULA_0448 0.0 24.5760 FORMAT "%5.2" /end CHARACTERISTIC
/begin CHARACTERISTIC K_AUSS_NS_TIME_MAX_IC_4 "Maximal zulaessige Nebenschlusszeit im Aussetzerfenster." VALUE 0x7077A TKW_VV_VV_UW 100.0 FORMULA_0448 0.0 24.5760 FORMAT "%5.2" /end CHARACTERISTIC
/begin CHARACTERISTIC K_AUSS_NS_TIME_MAX_IC_5 "Maximal zulaessige Nebenschlusszeit im Aussetzerfenster." VALUE 0x7077C TKW_VV_VV_UW 100.0 FORMULA_0448 0.0 24.5760 FORMAT "%5.2" /end CHARACTERISTIC
/begin CHARACTERISTIC K_AUSS_NS_TIME_MAX_IC_6 "Maximal zulaessige Nebenschlusszeit im Aussetzerfenster." VALUE 0x7077E TKW_VV_VV_UW 100.0 FORMULA_0448 0.0 24.5760 FORMAT "%5.2" /end CHARACTERISTIC
/begin CHARACTERISTIC K_AUSS_NS_TIME_MAX_IC_7 "Maximal zulaessige Nebenschlusszeit im Aussetzerfenster." VALUE 0x70780 TKW_VV_VV_UW 100.0 FORMULA_0448 0.0 24.5760 FORMAT "%5.2" /end CHARACTERISTIC
/begin CHARACTERISTIC K_AUSS_NS_TIME_MAX_IC_8 "Maximal zulaessige Nebenschlusszeit im Aussetzerfenster." VALUE 0x70782 TKW_VV_VV_UW 100.0 FORMULA_0448 0.0 24.5760 FORMAT "%5.2" /end CHARACTERISTIC
/begin CHARACTERISTIC K_AUSS_NS_TIME_MAX_IC_9 "Maximal zulaessige Nebenschlusszeit im Aussetzerfenster." VALUE 0x70784 TKW_VV_VV_UW 100.0 FORMULA_0448 0.0 24.5760 FORMAT "%5.2" /end CHARACTERISTIC
/begin CHARACTERISTIC K_AUSS_MIN_LAM "Minimal zul. Lambda | EN: Minimal zul. Lambda" VALUE 0x70786 TKW_VV_VV_UW 100.0 FORMULA_0025 0.0 3.9990 FORMAT "%6.3" /end CHARACTERISTIC
/begin CHARACTERISTIC K_AUSS_NS_MAX_ASP "Anzahl Arbeitspiele nach Start zur Aktivierung der Nebenschlusserkennung. | EN: Anzahl Arbeitspiele nach Start zur Aktivierung der Nebenschlusserkennung." VALUE 0x70788 TKW_VV_VV_UW 100.0 FORMULA_0010 0.0 65535.0000 /end CHARACTERISTIC
/begin CHARACTERISTIC K_AUSS_ED_WICHT_SPARK "Gewichtungsfaktors fuer Fehlereintrag Zuendauss. | EN: Gewichtungsfaktors fuer Fehlereintrag Zuendauss." VALUE 0x7078A TKW_VV_VV_UW 100.0 FORMULA_0577 0.0 255.9960 FORMAT "%5.2" /end CHARACTERISTIC
/begin CHARACTERISTIC K_AUSS_OBD_WICHT_SPARK "Gewichtungsfaktors fuer Zuendauss. | EN: Gewichtungsfaktors fuer Zuendauss." VALUE 0x7078C TKW_VV_VV_UW 100.0 FORMULA_0577 0.0 255.9960 FORMAT "%5.2" /end CHARACTERISTIC
/begin CHARACTERISTIC K_AUSS_OBD_WICHT_NS "Gewichtungsfaktors fuer Nebenschluss. | EN: Gewichtungsfaktors fuer Nebenschluss." VALUE 0x7078E TKW_VV_VV_UW 100.0 FORMULA_0577 0.0 255.9960 FORMAT "%5.2" /end CHARACTERISTIC
/begin CHARACTERISTIC K_AUSS_OBD_WICHT_EV "Gewichtungsfaktors fuer Einspritzauss." VALUE 0x70790 TKW_VV_VV_UW 100.0 FORMULA_0577 0.0 255.9960 FORMAT "%5.2" /end CHARACTERISTIC
/begin CHARACTERISTIC K_AUSS_OBD_N_MAX "Obere Aktivierungsdrehzahlschwelle. | EN: Obere Aktivierungsdrehzahlschwelle." VALUE 0x70792 TKW_VV_VV_SW 100.0 FORMULA_0006 0.0 10000.0000 /end CHARACTERISTIC
/begin CHARACTERISTIC K_AUSS_OBD_N_MIN "Untere Aktivierungsdrehzahlschwelle. | EN: Untere Aktivierungsdrehzahlschwelle." VALUE 0x70794 TKW_VV_VV_SW 100.0 FORMULA_0006 0.0 10000.0000 /end CHARACTERISTIC
/begin CHARACTERISTIC K_AUSS_OBD_T_IDLE "Zeit seit Deaktivierungsbedingung. | EN: Zeit seit Deaktivierungsbedingung. [V912: differs from V452 160E]" VALUE 0x70796 TKW_VV_VV_UW 100.0 FORMULA_0021 0.0 655.0000 FORMAT "%5.2" /end CHARACTERISTIC
/begin CHARACTERISTIC K_AUSS_OBD_T_MIN_LAM "Maximale Abschaltzeit wegen Lamda-Unterschreitung. | EN: Maximale Abschaltzeit wegen Lamda-Unterschreitung." VALUE 0x70798 TKW_VV_VV_UW 100.0 FORMULA_0021 0.0 655.0000 FORMAT "%5.2" /end CHARACTERISTIC
/begin CHARACTERISTIC K_AUSS_OBD_SUM_KAT "Schwelle Katschaedigen. | EN: Schwelle Katschaedigen." VALUE 0x7079A TKW_VV_VV_UW 100.0 FORMULA_0572 0.0 257.0000 FORMAT "%5.2" /end CHARACTERISTIC
/begin CHARACTERISTIC K_AUSS_ASP_SA_CNT "Min Anzahl Arbeitspiele waehren SA vor Adaption. | EN: Min Anzahl Arbeitspiele waehren SA vor Adaption." VALUE 0x7079C TKW_VV_VV_UW 100.0 FORMULA_0010 0.0 65535.0000 /end CHARACTERISTIC
/begin CHARACTERISTIC K_AUSS_SPARK_SIZE "Breite erstes Ausschwingen Zuendspule." VALUE 0x7079E TKW_VV_VV_SW 100.0 FORMULA_0569 4.0000 508.0000 /end CHARACTERISTIC
/begin CHARACTERISTIC K_AUSS_SPARK_LEV "Schwelle Ausschwingen Zuendspule." VALUE 0x707A0 TKW_VV_VV_SW 100.0 FORMULA_0578 0.0 100.0000 FORMAT "%5.2" /end CHARACTERISTIC
/begin CHARACTERISTIC K_AUSS_INT_START_FAKTOR_KOR "Faktor-Korrekturwert waerend Startphase. | EN: Faktor-Korrekturwert waerend Startphase." VALUE 0x707A2 TKW_VV_VV_SW 100.0 FORMULA_0570 0.0 199.9938 FORMAT "%5.2" /end CHARACTERISTIC
/begin CHARACTERISTIC K_AUSS_OBD_ABG_WORST_CYL "Schwelle schlechtester Zylinder. | EN: Schwelle schlechtester Zylinder." VALUE 0x707A4 TKW_VV_VV_SW 100.0 FORMULA_0570 0.0 199.9938 FORMAT "%5.2" /end CHARACTERISTIC
/begin CHARACTERISTIC K_AUSS_TMOT_LU "Tmot Schwelle fuer LU Plausibilisierung." VALUE 0x707A6 TKW_VV_VV_SW 100.0 FORMULA_0023 -50.0000 170.0000 FORMAT "%4.1" /end CHARACTERISTIC
/begin CHARACTERISTIC K_AUSS_LP_MIN_SA_MAX_INI "Initialwert vom max Offset im Aussetzerfenster bei SA. | EN: Initialwert vom max Offset im Aussetzerfenster bei SA." VALUE 0x707A8 TKW_VV_VV_SW 100.0 FORMULA_0443 0.0 3.3000 FORMAT "%5.2" /end CHARACTERISTIC
/begin CHARACTERISTIC K_AUSS_FETRAWE_N "Drehzahlgrenze bei Abschaltung im FeTraWe-Mode. | EN: Drehzahlgrenze bei Abschaltung im FeTraWe-Mode." VALUE 0x707AA TKW_VV_VV_SW 100.0 FORMULA_0006 0.0 10000.0000 /end CHARACTERISTIC
/begin CHARACTERISTIC K_AUSS_FETRAWE_RF "Lastgrenze bei Abschaltung im FeTraWe-Mode. | EN: Lastgrenze bei Abschaltung im FeTraWe-Mode." VALUE 0x707AC TKW_VV_VV_SW 100.0 FORMULA_0007 0.0 2.0000 FORMAT "%6.3" /end CHARACTERISTIC
/begin CHARACTERISTIC K_AUSS_FETRAWE_TIME_ML "Zeitgrenze bei Abschaltung im FeTraWe-Mode. | EN: Zeitgrenze bei Abschaltung im FeTraWe-Mode." VALUE 0x707B0 TKW_VV_VV_UL 100.0 FORMULA_0152 0.0 42949672.9500 FORMAT "%5.2" /end CHARACTERISTIC
/begin CHARACTERISTIC K_AUSS_LP_COEF_1of40_ "Tief-Pass Filter zur Aussetzererkennung." VALUE 0x707B4 TKW_VV_VV_SF 100.0 FORMULA_0579 -340282346638528860000000000000000000000.0000 340282346638528860000000000000000000000.0000 FORMAT "%7.4" /end CHARACTERISTIC
/begin CHARACTERISTIC K_AUSS_LP_COEF_2of40_ "Tief-Pass Filter zur Aussetzererkennung." VALUE 0x707B8 TKW_VV_VV_SF 100.0 FORMULA_0579 -340282346638528860000000000000000000000.0000 340282346638528860000000000000000000000.0000 FORMAT "%7.4" /end CHARACTERISTIC
/begin CHARACTERISTIC K_AUSS_LP_COEF_3of40_ "Tief-Pass Filter zur Aussetzererkennung." VALUE 0x707BC TKW_VV_VV_SF 100.0 FORMULA_0579 -340282346638528860000000000000000000000.0000 340282346638528860000000000000000000000.0000 FORMAT "%7.4" /end CHARACTERISTIC
/begin CHARACTERISTIC K_AUSS_LP_COEF_4of40_ "Tief-Pass Filter zur Aussetzererkennung." VALUE 0x707C0 TKW_VV_VV_SF 100.0 FORMULA_0579 -340282346638528860000000000000000000000.0000 340282346638528860000000000000000000000.0000 FORMAT "%7.4" /end CHARACTERISTIC
/begin CHARACTERISTIC K_AUSS_LP_COEF_5of40_ "Tief-Pass Filter zur Aussetzererkennung." VALUE 0x707C4 TKW_VV_VV_SF 100.0 FORMULA_0579 -340282346638528860000000000000000000000.0000 340282346638528860000000000000000000000.0000 FORMAT "%7.4" /end CHARACTERISTIC
/begin CHARACTERISTIC K_AUSS_LP_COEF_6of40_ "Tief-Pass Filter zur Aussetzererkennung." VALUE 0x707C8 TKW_VV_VV_SF 100.0 FORMULA_0579 -340282346638528860000000000000000000000.0000 340282346638528860000000000000000000000.0000 FORMAT "%7.4" /end CHARACTERISTIC
/begin CHARACTERISTIC K_AUSS_LP_COEF_7of40_ "Tief-Pass Filter zur Aussetzererkennung." VALUE 0x707CC TKW_VV_VV_SF 100.0 FORMULA_0579 -340282346638528860000000000000000000000.0000 340282346638528860000000000000000000000.0000 FORMAT "%7.4" /end CHARACTERISTIC
/begin CHARACTERISTIC K_AUSS_LP_COEF_8of40_ "Tief-Pass Filter zur Aussetzererkennung." VALUE 0x707D0 TKW_VV_VV_SF 100.0 FORMULA_0579 -340282346638528860000000000000000000000.0000 340282346638528860000000000000000000000.0000 FORMAT "%7.4" /end CHARACTERISTIC
/begin CHARACTERISTIC K_AUSS_LP_COEF_9of40_ "Tief-Pass Filter zur Aussetzererkennung." VALUE 0x707D4 TKW_VV_VV_SF 100.0 FORMULA_0579 -340282346638528860000000000000000000000.0000 340282346638528860000000000000000000000.0000 FORMAT "%7.4" /end CHARACTERISTIC
/begin CHARACTERISTIC K_AUSS_LP_COEF_10of40_ "Tief-Pass Filter zur Aussetzererkennung." VALUE 0x707D8 TKW_VV_VV_SF 100.0 FORMULA_0579 -340282346638528860000000000000000000000.0000 340282346638528860000000000000000000000.0000 FORMAT "%7.4" /end CHARACTERISTIC
/begin CHARACTERISTIC K_AUSS_LP_COEF_11of40_ "Tief-Pass Filter zur Aussetzererkennung." VALUE 0x707DC TKW_VV_VV_SF 100.0 FORMULA_0579 -340282346638528860000000000000000000000.0000 340282346638528860000000000000000000000.0000 FORMAT "%7.4" /end CHARACTERISTIC
/begin CHARACTERISTIC K_AUSS_LP_COEF_12of40_ "Tief-Pass Filter zur Aussetzererkennung." VALUE 0x707E0 TKW_VV_VV_SF 100.0 FORMULA_0579 -340282346638528860000000000000000000000.0000 340282346638528860000000000000000000000.0000 FORMAT "%7.4" /end CHARACTERISTIC
/begin CHARACTERISTIC K_AUSS_LP_COEF_13of40_ "Tief-Pass Filter zur Aussetzererkennung." VALUE 0x707E4 TKW_VV_VV_SF 100.0 FORMULA_0579 -340282346638528860000000000000000000000.0000 340282346638528860000000000000000000000.0000 FORMAT "%7.4" /end CHARACTERISTIC
/begin CHARACTERISTIC K_AUSS_LP_COEF_14of40_ "Tief-Pass Filter zur Aussetzererkennung." VALUE 0x707E8 TKW_VV_VV_SF 100.0 FORMULA_0579 -340282346638528860000000000000000000000.0000 340282346638528860000000000000000000000.0000 FORMAT "%7.4" /end CHARACTERISTIC
/begin CHARACTERISTIC K_AUSS_LP_COEF_15of40_ "Tief-Pass Filter zur Aussetzererkennung." VALUE 0x707EC TKW_VV_VV_SF 100.0 FORMULA_0579 -340282346638528860000000000000000000000.0000 340282346638528860000000000000000000000.0000 FORMAT "%7.4" /end CHARACTERISTIC
/begin CHARACTERISTIC K_AUSS_LP_COEF_16of40_ "Tief-Pass Filter zur Aussetzererkennung." VALUE 0x707F0 TKW_VV_VV_SF 100.0 FORMULA_0579 -340282346638528860000000000000000000000.0000 340282346638528860000000000000000000000.0000 FORMAT "%7.4" /end CHARACTERISTIC
/begin CHARACTERISTIC K_AUSS_LP_COEF_17of40_ "Tief-Pass Filter zur Aussetzererkennung." VALUE 0x707F4 TKW_VV_VV_SF 100.0 FORMULA_0579 -340282346638528860000000000000000000000.0000 340282346638528860000000000000000000000.0000 FORMAT "%7.4" /end CHARACTERISTIC
/begin CHARACTERISTIC K_AUSS_LP_COEF_18of40_ "Tief-Pass Filter zur Aussetzererkennung." VALUE 0x707F8 TKW_VV_VV_SF 100.0 FORMULA_0579 -340282346638528860000000000000000000000.0000 340282346638528860000000000000000000000.0000 FORMAT "%7.4" /end CHARACTERISTIC
/begin CHARACTERISTIC K_AUSS_LP_COEF_19of40_ "Tief-Pass Filter zur Aussetzererkennung." VALUE 0x707FC TKW_VV_VV_SF 100.0 FORMULA_0579 -340282346638528860000000000000000000000.0000 340282346638528860000000000000000000000.0000 FORMAT "%7.4" /end CHARACTERISTIC
/begin CHARACTERISTIC K_AUSS_LP_COEF_20of40_ "Tief-Pass Filter zur Aussetzererkennung." VALUE 0x70800 TKW_VV_VV_SF 100.0 FORMULA_0579 -340282346638528860000000000000000000000.0000 340282346638528860000000000000000000000.0000 FORMAT "%7.4" /end CHARACTERISTIC
/begin CHARACTERISTIC K_AUSS_LP_COEF_21of40_ "Tief-Pass Filter zur Aussetzererkennung." VALUE 0x70804 TKW_VV_VV_SF 100.0 FORMULA_0579 -340282346638528860000000000000000000000.0000 340282346638528860000000000000000000000.0000 FORMAT "%7.4" /end CHARACTERISTIC
/begin CHARACTERISTIC K_AUSS_LP_COEF_22of40_ "Tief-Pass Filter zur Aussetzererkennung." VALUE 0x70808 TKW_VV_VV_SF 100.0 FORMULA_0579 -340282346638528860000000000000000000000.0000 340282346638528860000000000000000000000.0000 FORMAT "%7.4" /end CHARACTERISTIC
/begin CHARACTERISTIC K_AUSS_LP_COEF_23of40_ "Tief-Pass Filter zur Aussetzererkennung." VALUE 0x7080C TKW_VV_VV_SF 100.0 FORMULA_0579 -340282346638528860000000000000000000000.0000 340282346638528860000000000000000000000.0000 FORMAT "%7.4" /end CHARACTERISTIC
/begin CHARACTERISTIC K_AUSS_LP_COEF_24of40_ "Tief-Pass Filter zur Aussetzererkennung." VALUE 0x70810 TKW_VV_VV_SF 100.0 FORMULA_0579 -340282346638528860000000000000000000000.0000 340282346638528860000000000000000000000.0000 FORMAT "%7.4" /end CHARACTERISTIC
/begin CHARACTERISTIC K_AUSS_LP_COEF_25of40_ "Tief-Pass Filter zur Aussetzererkennung." VALUE 0x70814 TKW_VV_VV_SF 100.0 FORMULA_0579 -340282346638528860000000000000000000000.0000 340282346638528860000000000000000000000.0000 FORMAT "%7.4" /end CHARACTERISTIC
/begin CHARACTERISTIC K_AUSS_LP_COEF_26of40_ "Tief-Pass Filter zur Aussetzererkennung." VALUE 0x70818 TKW_VV_VV_SF 100.0 FORMULA_0579 -340282346638528860000000000000000000000.0000 340282346638528860000000000000000000000.0000 FORMAT "%7.4" /end CHARACTERISTIC
/begin CHARACTERISTIC K_AUSS_LP_COEF_27of40_ "Tief-Pass Filter zur Aussetzererkennung." VALUE 0x7081C TKW_VV_VV_SF 100.0 FORMULA_0579 -340282346638528860000000000000000000000.0000 340282346638528860000000000000000000000.0000 FORMAT "%7.4" /end CHARACTERISTIC
/begin CHARACTERISTIC K_AUSS_LP_COEF_28of40_ "Tief-Pass Filter zur Aussetzererkennung." VALUE 0x70820 TKW_VV_VV_SF 100.0 FORMULA_0579 -340282346638528860000000000000000000000.0000 340282346638528860000000000000000000000.0000 FORMAT "%7.4" /end CHARACTERISTIC
/begin CHARACTERISTIC K_AUSS_LP_COEF_29of40_ "Tief-Pass Filter zur Aussetzererkennung." VALUE 0x70824 TKW_VV_VV_SF 100.0 FORMULA_0579 -340282346638528860000000000000000000000.0000 340282346638528860000000000000000000000.0000 FORMAT "%7.4" /end CHARACTERISTIC
/begin CHARACTERISTIC K_AUSS_LP_COEF_30of40_ "Tief-Pass Filter zur Aussetzererkennung." VALUE 0x70828 TKW_VV_VV_SF 100.0 FORMULA_0579 -340282346638528860000000000000000000000.0000 340282346638528860000000000000000000000.0000 FORMAT "%7.4" /end CHARACTERISTIC
/begin CHARACTERISTIC K_AUSS_LP_COEF_31of40_ "Tief-Pass Filter zur Aussetzererkennung." VALUE 0x7082C TKW_VV_VV_SF 100.0 FORMULA_0579 -340282346638528860000000000000000000000.0000 340282346638528860000000000000000000000.0000 FORMAT "%7.4" /end CHARACTERISTIC
/begin CHARACTERISTIC K_AUSS_LP_COEF_32of40_ "Tief-Pass Filter zur Aussetzererkennung." VALUE 0x70830 TKW_VV_VV_SF 100.0 FORMULA_0579 -340282346638528860000000000000000000000.0000 340282346638528860000000000000000000000.0000 FORMAT "%7.4" /end CHARACTERISTIC
/begin CHARACTERISTIC K_AUSS_LP_COEF_33of40_ "Tief-Pass Filter zur Aussetzererkennung." VALUE 0x70834 TKW_VV_VV_SF 100.0 FORMULA_0579 -340282346638528860000000000000000000000.0000 340282346638528860000000000000000000000.0000 FORMAT "%7.4" /end CHARACTERISTIC
/begin CHARACTERISTIC K_AUSS_LP_COEF_34of40_ "Tief-Pass Filter zur Aussetzererkennung." VALUE 0x70838 TKW_VV_VV_SF 100.0 FORMULA_0579 -340282346638528860000000000000000000000.0000 340282346638528860000000000000000000000.0000 FORMAT "%7.4" /end CHARACTERISTIC
/begin CHARACTERISTIC K_AUSS_LP_COEF_35of40_ "Tief-Pass Filter zur Aussetzererkennung." VALUE 0x7083C TKW_VV_VV_SF 100.0 FORMULA_0579 -340282346638528860000000000000000000000.0000 340282346638528860000000000000000000000.0000 FORMAT "%7.4" /end CHARACTERISTIC
/begin CHARACTERISTIC K_AUSS_LP_COEF_36of40_ "Tief-Pass Filter zur Aussetzererkennung." VALUE 0x70840 TKW_VV_VV_SF 100.0 FORMULA_0579 -340282346638528860000000000000000000000.0000 340282346638528860000000000000000000000.0000 FORMAT "%7.4" /end CHARACTERISTIC
/begin CHARACTERISTIC K_AUSS_LP_COEF_37of40_ "Tief-Pass Filter zur Aussetzererkennung." VALUE 0x70844 TKW_VV_VV_SF 100.0 FORMULA_0579 -340282346638528860000000000000000000000.0000 340282346638528860000000000000000000000.0000 FORMAT "%7.4" /end CHARACTERISTIC
/begin CHARACTERISTIC K_AUSS_LP_COEF_38of40_ "Tief-Pass Filter zur Aussetzererkennung." VALUE 0x70848 TKW_VV_VV_SF 100.0 FORMULA_0579 -340282346638528860000000000000000000000.0000 340282346638528860000000000000000000000.0000 FORMAT "%7.4" /end CHARACTERISTIC
/begin CHARACTERISTIC K_AUSS_LP_COEF_39of40_ "Tief-Pass Filter zur Aussetzererkennung." VALUE 0x7084C TKW_VV_VV_SF 100.0 FORMULA_0579 -340282346638528860000000000000000000000.0000 340282346638528860000000000000000000000.0000 FORMAT "%7.4" /end CHARACTERISTIC
/begin CHARACTERISTIC K_AUSS_LP_COEF_40of40_ "Tief-Pass Filter zur Aussetzererkennung." VALUE 0x70850 TKW_VV_VV_SF 100.0 FORMULA_0579 -340282346638528860000000000000000000000.0000 340282346638528860000000000000000000000.0000 FORMAT "%7.4" /end CHARACTERISTIC
/begin CHARACTERISTIC KL_AUSS_OBD_TZ_GRAD "Deaktivierungsschwelle fuer tz_grad. | EN: Deactivation threshold for tz_grad (ignition gradient) [V912: differs from V452 160E]" CURVE 0x70854 TKL_SW_VV_SW 100.0 FORMULA_0249 -100.0000 100.0000 /begin AXIS_DESCR STD_AXIS FORMULA_0006 4 0.0 10000.0000 /end AXIS_DESCR FORMAT "%6.3" /end CHARACTERISTIC
/begin CHARACTERISTIC KL_AUSS_PUMG_FAKTOR "Korrektur ueber pumg." CURVE 0x70866 TKL_SW_VV_SW 100.0 FORMULA_0570 0.0 199.9938 /begin AXIS_DESCR STD_AXIS FORMULA_0077 4 400.0000 1200.0000 FORMAT "%4.1" /end AXIS_DESCR FORMAT "%5.2" /end CHARACTERISTIC
/begin CHARACTERISTIC KL_AUSS_START_FAKTOR "Korrekturfaktor waerend Startphase von auss_lp_int_min. | EN: Correction factor during start phase for auss_lp_int_min" CURVE 0x70878 TKL_SW_VV_SW 100.0 FORMULA_0570 0.0 199.9938 /begin AXIS_DESCR STD_AXIS FORMULA_0023 5 -50.0000 170.0000 FORMAT "%4.1" /end AXIS_DESCR FORMAT "%5.2" /end CHARACTERISTIC
/begin CHARACTERISTIC KL_AUSS_OBD_POS_MD_DYN "Maximal zul. pos. Dynamik." CURVE 0x7088E TKL_SW_VV_SW 100.0 FORMULA_0571 -5000.0000 5000.0000 /begin AXIS_DESCR STD_AXIS rf FORMULA_0007 6 0.0 2.0000 FORMAT "%6.3" /end AXIS_DESCR /end CHARACTERISTIC
/begin CHARACTERISTIC KL_AUSS_OBD_NEG_MD_DYN "Minimale zul. neg. Dynamik." CURVE 0x708A8 TKL_SW_VV_SW 100.0 FORMULA_0571 -5000.0000 5000.0000 /begin AXIS_DESCR STD_AXIS rf FORMULA_0007 6 0.0 2.0000 FORMAT "%6.3" /end AXIS_DESCR /end CHARACTERISTIC
/begin CHARACTERISTIC KL_AUSS_OBD_POS_MD_DYN_KH "Maximal zul. pos. Dynamik im Katheizen. | EN: Maximum permitted positive dynamics during catalyst heating" CURVE 0x708C2 TKL_SW_VV_SW 100.0 FORMULA_0571 -5000.0000 5000.0000 /begin AXIS_DESCR STD_AXIS rf FORMULA_0007 6 0.0 2.0000 FORMAT "%6.3" /end AXIS_DESCR /end CHARACTERISTIC
/begin CHARACTERISTIC KL_AUSS_OBD_NEG_MD_DYN_KH "Minimale zul. neg. Dynamik im Katheizen." CURVE 0x708DC TKL_SW_VV_SW 100.0 FORMULA_0571 -5000.0000 5000.0000 /begin AXIS_DESCR STD_AXIS rf FORMULA_0007 6 0.0 2.0000 FORMAT "%6.3" /end AXIS_DESCR /end CHARACTERISTIC
/begin CHARACTERISTIC KL_AUSS_INT_TMOT_FAKTOR "Korrekturfaktor ueber Tmot. | EN: Correction factor over engine temperature" CURVE 0x708F6 TKL_SW_VV_SW 100.0 FORMULA_0570 0.0 199.9938 /begin AXIS_DESCR STD_AXIS FORMULA_0023 8 -50.0000 170.0000 FORMAT "%4.1" /end AXIS_DESCR FORMAT "%5.2" /end CHARACTERISTIC
/begin CHARACTERISTIC KL_AUSS_INT_DTZ_FAKTOR "Korrekturfaktor ueber Rueckziehwinkel." CURVE 0x70918 TKL_SW_VV_SW 100.0 FORMULA_0570 0.0 199.9938 /begin AXIS_DESCR STD_AXIS tz FORMULA_0111 8 -50.0000 60.0000 FORMAT "%4.1" /end AXIS_DESCR FORMAT "%5.2" /end CHARACTERISTIC
/begin CHARACTERISTIC KL_AUSS_OBD_RF_MIN "Minimale RF-Aktivierungsschwelle. [V912: differs from V452 160E]" CURVE 0x7093A TKL_SW_VV_SW 100.0 FORMULA_0007 0.0 2.0000 /begin AXIS_DESCR STD_AXIS FORMULA_0006 8 0.0 10000.0000 /end AXIS_DESCR FORMAT "%6.3" /end CHARACTERISTIC
/begin CHARACTERISTIC KL_AUSS_OBD_WICHT_KAT "Gewichtung Kattemperatur fuer Katschaedigung. | EN: Weighting of catalyst temperature for catalyst damage" CURVE 0x7095C TKL_SW_VV_UB 100.0 FORMULA_0502 0.0 1.0000
 /begin AXIS_DESCR STD_AXIS tabg_mkat FORMULA_0023 4 -50.0000 1250.0000 FORMAT "%4.1" /end AXIS_DESCR
/end CHARACTERISTIC
/begin CHARACTERISTIC KL_AUSS_MIN_AVG_SAMPLES "Anzahl Messpunkte Minimalintegral." CURVE 0x7096A TKL_SW_VV_UW 100.0 FORMULA_0569 4.0000 4092.0000 /begin AXIS_DESCR STD_AXIS FORMULA_0006 6 0.0 10000.0000 /end AXIS_DESCR /end CHARACTERISTIC
/begin CHARACTERISTIC KF_AUSS_SPARK_TIME_MIN "Min zulaessige Funkenbrenndauer." MAP 0x70984 TKF_SW_SW_SW 100.0 FORMULA_0447 0.0 4.6810 /begin AXIS_DESCR STD_AXIS FORMULA_0006 3 0.0 10000.0000 /end AXIS_DESCR /begin AXIS_DESCR STD_AXIS rf FORMULA_0007 3 0.0 2.0000 FORMAT "%6.3" /end AXIS_DESCR FORMAT "%5.2" /end CHARACTERISTIC
/begin CHARACTERISTIC KF_AUSS_SPARK_TIME_MAX "Max zulaessige Funkenbrenndauer. | EN: Maximum permitted spark burn duration" MAP 0x709A4 TKF_SW_SW_SW 100.0 FORMULA_0447 0.0 4.6810 /begin AXIS_DESCR STD_AXIS FORMULA_0006 3 0.0 10000.0000 /end AXIS_DESCR /begin AXIS_DESCR STD_AXIS rf FORMULA_0007 3 0.0 2.0000 FORMAT "%6.3" /end AXIS_DESCR FORMAT "%5.2" /end CHARACTERISTIC
/begin CHARACTERISTIC KF_AUSS_LP_INT_MIN "Minimales Ionenleitwertintegral zur Aussetzererkennung. | EN: Minimum ion-current integral for misfire detection" MAP 0x709C4 TKF_SW_SW_SW 100.0 FORMULA_0245 0.0 4.0000 /begin AXIS_DESCR STD_AXIS FORMULA_0006 16 0.0 10000.0000 /end AXIS_DESCR /begin AXIS_DESCR STD_AXIS rf FORMULA_0007 10 0.0 2.0000 FORMAT "%6.3" /end AXIS_DESCR FORMAT "%5.2" /end CHARACTERISTIC
/begin CHARACTERISTIC KF_AUSS_OBD_WICHT_KAT "Gewichtung Katschaedigen." MAP 0x70B3A TKF_SW_SW_UB 100.0 FORMULA_0502 0.0 1.0000 /begin AXIS_DESCR STD_AXIS FORMULA_0006 8 0.0 10000.0000 /end AXIS_DESCR /begin AXIS_DESCR STD_AXIS rf FORMULA_0007 5 0.0 2.0000 FORMAT "%6.3" /end AXIS_DESCR /end CHARACTERISTIC
/begin CHARACTERISTIC KF_AUSS_OBD_DTZ_MAX "Maximal zul. delta Zuendwinkel." MAP 0x70B7E TKF_SW_SW_SW 100.0 FORMULA_0111 -50.0000 60.0000 /begin AXIS_DESCR STD_AXIS FORMULA_0006 8 0.0 10000.0000 /end AXIS_DESCR /begin AXIS_DESCR STD_AXIS rf FORMULA_0007 5 0.0 2.0000 FORMAT "%6.3" /end AXIS_DESCR FORMAT "%4.1" /end CHARACTERISTIC
/begin CHARACTERISTIC KF_AUSS_TZ_OFFS "Ausetzerfensterstart (Offsetzeit nach Zuendzeitpunkt)." MAP 0x70BEA TKF_SW_SW_SW 100.0 FORMULA_0448 0.0040 8.1880 /begin AXIS_DESCR STD_AXIS FORMULA_0006 6 0.0 10000.0000 /end AXIS_DESCR /begin AXIS_DESCR STD_AXIS rf FORMULA_0007 6 0.0 2.0000 FORMAT "%6.3" /end AXIS_DESCR FORMAT "%5.2" /end CHARACTERISTIC
/* ------------------ Abschnitt erzeugt aus egas.dat ------------------ */
/begin CHARACTERISTIC K_EGAS_CFG_DK "DK-Konfiguration" VALUE 0x719B2 TKW_VV_VV_UB 100.0 FORMULA_0607 0.0 255.0 /end CHARACTERISTIC
/begin CHARACTERISTIC K_EGAS_CFG_LLS "LLS-Konfiguration | EN: 0 no Testmode 1 Testmode ELSE undef LLS-Konfiguration" VALUE 0x719B3 TKW_VV_VV_UB 100.0 FORMULA_0608 0.0 255.0 /end CHARACTERISTIC
/begin CHARACTERISTIC K_EGAS_CFG_WDK "WDK-Konfiguration | EN: 0 Poti normal 1 Poti invers WDK-Konfiguration" VALUE 0x719B4 TKW_VV_VV_UB 100.0 FORMULA_0609 0.0 255.0 /end CHARACTERISTIC
/begin CHARACTERISTIC K_EGAS_CFG_AQ_SOLL "Filter-Konfiguration | EN: 0 aus 1 KH 2 ML 3 KH+ML Filter-Konfiguration" VALUE 0x719B5 TKW_VV_VV_UB 100.0 FORMULA_0610 0.0 255.0 /end CHARACTERISTIC
/begin CHARACTERISTIC K_EGAS_CFG_MCS_SOLL "Konfiguration MCS-Vorgabe | EN: 0 Inaktiv 1 LLS1 2 LLS2 3 LLS1+2 4 DK1 5 LLS1+DK1 8 DK2 10 LLS2+DK2 12 DK1+2 15 Alle 16 Bowdenzug Ko" VALUE 0x719B6 TKW_VV_VV_UB 100.0 FORMULA_0611 0.0 255.0 /end CHARACTERISTIC
/begin CHARACTERISTIC K_EGAS_AQ_SOLL_GRAD_TAU "Tau fuer AQ-Soll | EN: Tau fuer AQ-Soll" VALUE 0x719B7 TKW_VV_VV_UB 100.0 FORMULA_0478 0.0051 1.2800 /end CHARACTERISTIC
/begin CHARACTERISTIC K_EGAS_FT_ERR_SCHW "min. Schwelle fuer FT-Fehler | EN: min. Schwelle fuer FT-Fehler" VALUE 0x719B8 TKW_VV_VV_UB 100.0 FORMULA_0479 0.0 10.0000 /end CHARACTERISTIC
/begin CHARACTERISTIC K_EGAS_SOLL_AQ_TI_OFF "Notlaufquerschnitt bei Bankabschaltung | EN: Notlaufquerschnitt bei Bankabschaltung" VALUE 0x719BA TKW_VV_VV_UW 100.0 FORMULA_0147 0.0 6500.0000 FORMAT "%4.1" /end CHARACTERISTIC
/begin CHARACTERISTIC K_EGAS_SOLL_AQ_KH_N_MAX "Drehzahlschwelle fuer KH-Querschnitt | EN: Drehzahlschwelle fuer KH-Querschnitt" VALUE 0x719BC TKW_VV_VV_SW 100.0 FORMULA_0006 0.0 10000.0000 /end CHARACTERISTIC
/begin CHARACTERISTIC K_EGAS_SOLL_VL_FAK "Anhebung bei Vollast" VALUE 0x719BE TKW_VV_VV_UW 100.0 FORMULA_0612 1.0000 64.9990 FORMAT "%5.2" /end CHARACTERISTIC
/begin CHARACTERISTIC K_EGAS_SOLL_ENTDR_SCHW "dr_rel-Schwelle fuer entdr. Betrieb" VALUE 0x719C0 TKW_VV_VV_SW 100.0 FORMULA_0115 0.0 199.9938 FORMAT "%5.2" /end CHARACTERISTIC
/begin CHARACTERISTIC K_EGAS_SOLL_GT_OFF "Offsetsprung beim Gestaengetest | EN: Offsetsprung beim Gestaengetest" VALUE 0x719C2 TKW_VV_VV_SW 100.0 FORMULA_0001 -10.0000 120.0000 FORMAT "%4.1" /end CHARACTERISTIC
/begin CHARACTERISTIC K_EGAS_SOLL_MCS_LLS "DK-Sollwert | EN: DK-Sollwert" VALUE 0x719C4 TKW_VV_VV_SW 100.0 FORMULA_0001 -10.0000 120.0000 FORMAT "%4.1" /end CHARACTERISTIC
/begin CHARACTERISTIC K_EGAS_SOLL_MCS_DK "DK-Sollwert | EN: DK-Sollwert" VALUE 0x719C6 TKW_VV_VV_SW 100.0 FORMULA_0001 -10.0000 120.0000 FORMAT "%4.1" /end CHARACTERISTIC
/begin CHARACTERISTIC K_EGAS_SOLL_LLS_DK_SCHW "DK-Schwelle fuer LLS-Schwebung | EN: DK-Schwelle fuer LLS - Schwebung" VALUE 0x719C8 TKW_VV_VV_UB 100.0 FORMULA_0479 0.0 25.0000 /end CHARACTERISTIC
/begin CHARACTERISTIC K_EGAS_SOLL_LLS_OFF "Offset fuer LLS-Schwebung | EN: Offset fuer LLS-Schwebung" VALUE 0x719C9 TKW_VV_VV_UB 100.0 FORMULA_0479 0.0 25.0000 /end CHARACTERISTIC
/begin CHARACTERISTIC K_EGAS_SOLL_LLS_DELTA "Rampe fuer LLS-Schwebung | EN: Rampe fuer LLS-Schwebung" VALUE 0x719CA TKW_VV_VV_UB 100.0 FORMULA_0613 0.0 25.0000 /end CHARACTERISTIC
/begin CHARACTERISTIC K_EGAS_WDK_MIN "min. WDK | EN: Minimum throttle angle [V]" VALUE 0x719CC TKW_VV_VV_SW 100.0 FORMULA_0418 0.0 5.0000 FORMAT "%6.3" /end CHARACTERISTIC
/begin CHARACTERISTIC K_EGAS_WDK_MAX "max. WDK | EN: Maximum throttle angle [V]" VALUE 0x719CE TKW_VV_VV_SW 100.0 FORMULA_0418 0.0 5.0000 FORMAT "%6.3" /end CHARACTERISTIC
/begin CHARACTERISTIC K_EGAS_WDK_NORM "Umrechnung V in % | EN: Conversion V to % [%/V]" VALUE 0x719D0 TKW_VV_VV_SW 100.0 FORMULA_0614 0.0 100.0000 FORMAT "%6.3" /end CHARACTERISTIC
/begin CHARACTERISTIC K_EGAS_WDK_A0_TIME "Zeit fuer Konstantwert | EN: Time for constant value [ms]" VALUE 0x719D2 TKW_VV_VV_UB 100.0 FORMULA_0590 0.0 1000.0000 /end CHARACTERISTIC
/begin CHARACTERISTIC K_EGAS_WDK_A0_KONST "A0 konstant | EN: A0 constant [V]" VALUE 0x719D4 TKW_VV_VV_SW 100.0 FORMULA_0418 0.0 0.5000 FORMAT "%6.3" /end CHARACTERISTIC
/begin CHARACTERISTIC K_EGAS_WDK_A0_OFF_B1 "min. A0-Wert | EN: Minimum A0 value" VALUE 0x719D6 TKW_VV_VV_SW 100.0 FORMULA_0418 -2.0000 2.0000 FORMAT "%6.3" /end CHARACTERISTIC
/begin CHARACTERISTIC K_EGAS_WDK_A0_OFF_B2 "min. A0-Wert | EN: Minimum A0 value" VALUE 0x719D8 TKW_VV_VV_SW 100.0 FORMULA_0418 -2.0000 2.0000 FORMAT "%6.3" /end CHARACTERISTIC
/begin CHARACTERISTIC K_EGAS_WDK_A0_MIN "min. A0-Wert | EN: Minimum A0 value [V]" VALUE 0x719DA TKW_VV_VV_SW 100.0 FORMULA_0418 0.0 5.0000 FORMAT "%6.3" /end CHARACTERISTIC
/begin CHARACTERISTIC K_EGAS_WDK_A0_MAX "max. A0-Wert | EN: Maximum A0 value [V]" VALUE 0x719DC TKW_VV_VV_SW 100.0 FORMULA_0418 0.0 5.0000 FORMAT "%6.3" /end CHARACTERISTIC
/begin CHARACTERISTIC K_EGAS_WDK_A0_DFT "Default A0-Wert | EN: Default A0 value [V]" VALUE 0x719DE TKW_VV_VV_SW 100.0 FORMULA_0418 0.0 5.0000 FORMAT "%6.3" /end CHARACTERISTIC
/begin CHARACTERISTIC K_EGAS_WDK_A0_DELTA_MAX "max. A0-Delta | EN: Maximum A0 delta [V]" VALUE 0x719E0 TKW_VV_VV_SW 100.0 FORMULA_0418 0.0 5.0000 FORMAT "%6.3" /end CHARACTERISTIC
/begin CHARACTERISTIC K_EGAS_WDK_A0_ANZAHL "Anzahl der A0-Mittelwerte | EN: Number of A0 averages [mal]" VALUE 0x719E2 TKW_VV_VV_UB 100.0 FORMULA_0420 0.0 250.0000 /end CHARACTERISTIC
/begin CHARACTERISTIC K_EGAS_CAN_ALIVE_ERR_MAX "max. Zeit f�r CAN-Alive | EN: Maximum time for CAN alive signal" VALUE 0x719E3 TKW_VV_VV_UB 100.0 FORMULA_0003 0.0 255.0000 /end CHARACTERISTIC
/begin CHARACTERISTIC K_EGAS_CAN_ED_TSPERR "Wartezeit fuer CAN-Diagnose | EN: Wait time for CAN diagnosis [sec]" VALUE 0x719E4 TKW_VV_VV_UB 100.0 FORMULA_0587 0.0 1.2750 /end CHARACTERISTIC
/begin CHARACTERISTIC K_EGAS_CAN_ED_UB_MIN "min. Ub fuer CAN-Diagnose | EN: Minimum battery voltage for CAN diagnosis [V]" VALUE 0x719E6 TKW_VV_VV_SW 100.0 FORMULA_0008 0.0 28.0000 FORMAT "%4.1" /end CHARACTERISTIC
/begin CHARACTERISTIC K_EGAS_LLS_R_DIAG_CLR "Fehlermaske fuer ClrDiag | EN: Fault mask for ClrDiag" VALUE 0x719E8 TKW_VV_VV_UW 100.0 FORMULA_0010 0.0 65535.0000 /end CHARACTERISTIC
/begin CHARACTERISTIC K_EGAS_LLS_R_DIAG_FAIL "Fehlermaske fuer Failsafe | EN: Fault mask for failsafe" VALUE 0x719EA TKW_VV_VV_UW 100.0 FORMULA_0010 0.0 65535.0000 /end CHARACTERISTIC
/begin CHARACTERISTIC K_EGAS_DK_R_DIAG_CLR "Fehlermaske fuer ClrDiag | EN: Fault mask for ClrDiag" VALUE 0x719EC TKW_VV_VV_UW 100.0 FORMULA_0010 0.0 65535.0000 /end CHARACTERISTIC
/begin CHARACTERISTIC K_EGAS_DK_R_DIAG_FAIL "Fehlermaske fuer Failsafe | EN: Fault mask for failsafe" VALUE 0x719EE TKW_VV_VV_UW 100.0 FORMULA_0010 0.0 65535.0000 /end CHARACTERISTIC
/begin CHARACTERISTIC K_EGAS_LLS_R_DIAG_CLR_MAX "max. Anzahl fuer ClrDiag LLS | EN: Maximum count for ClrDiag, idle air valve" VALUE 0x719F0 TKW_VV_VV_UB 100.0 FORMULA_0003 0.0 255.0000 /end CHARACTERISTIC
/begin CHARACTERISTIC K_EGAS_DK_R_DIAG_CLR_MAX "max. Anzahl fuer ClrDiag DK | EN: Maximum count for ClrDiag, throttle" VALUE 0x719F1 TKW_VV_VV_UB 100.0 FORMULA_0003 0.0 255.0000 /end CHARACTERISTIC
/begin CHARACTERISTIC K_EGAS_T_KL50 "Wartezeit bei KL50 | EN: Wait time at terminal 50 (cranking) [s]" VALUE 0x719F2 TKW_VV_VV_UB 100.0 FORMULA_0352 0.0 1.2750 /end CHARACTERISTIC
/begin CHARACTERISTIC K_EGAS_SOLL_BOWDEN_LLS_F "Fehlermaske fuer Failsafe | EN: Weighting factor" VALUE 0x719F4 TKW_VV_VV_UW 100.0 FORMULA_0075 0.0 4.0000 FORMAT "%6.3" /end CHARACTERISTIC
/begin CHARACTERISTIC KL_EGAS_N_AQ_START_POS "pos. Drehzahlfilter im Start | EN: Positive engine-speed filter during start" CURVE 0x719F6 TKL_SW_VV_UB 100.0 FORMULA_0478 0.0051 1.2800 /begin AXIS_DESCR STD_AXIS FORMULA_0006 6 0.0 10000.0000 /end AXIS_DESCR /end CHARACTERISTIC
/begin CHARACTERISTIC KL_EGAS_N_AQ_START_NEG "neg. Drehzahlfilter im Start | EN: Negative engine-speed filter during start" CURVE 0x71A0A TKL_SW_VV_UB 100.0 FORMULA_0478 0.0051 1.2800 /begin AXIS_DESCR STD_AXIS FORMULA_0006 6 0.0 10000.0000 /end AXIS_DESCR /end CHARACTERISTIC
/begin CHARACTERISTIC KF_EGAS_SOLL_AQ "AQ-Sollwert pro Bank | EN: Target charge (rf) from throttle opening area, per bank - core airflow/load model (normal operation)" MAP 0x71A1E TKF_SW_SW_UW 100.0 FORMULA_0147 0.0 6500.0000 /begin AXIS_DESCR STD_AXIS FORMULA_0006 22 0.0 10000.0000 /end AXIS_DESCR /begin AXIS_DESCR STD_AXIS rf_soll FORMULA_0007 22 0.0 2.0000 FORMAT "%6.3" /end AXIS_DESCR FORMAT "%4.1" /end CHARACTERISTIC
/begin CHARACTERISTIC KF_EGAS_SOLL_AQ_NOTL "AQ-Sollwert Notlauf pro Bank | EN: Target charge (rf) from throttle opening area, per bank - LIMP-HOME (Notlauf) map" MAP 0x71E40 TKF_SW_SW_UW 100.0 FORMULA_0147 0.0 6500.0000 /begin AXIS_DESCR STD_AXIS FORMULA_0006 22 0.0 10000.0000 /end AXIS_DESCR /begin AXIS_DESCR STD_AXIS rf_soll FORMULA_0007 22 0.0 2.0000 FORMAT "%6.3" /end AXIS_DESCR FORMAT "%4.1" /end CHARACTERISTIC
/begin CHARACTERISTIC KF_EGAS_SOLL_AQ_KH "AQ-Sollwert KH pro Bank" MAP 0x72262 TKF_SW_SW_UW 100.0 FORMULA_0147 0.0 6500.0000 /begin AXIS_DESCR STD_AXIS FORMULA_0006 18 0.0 10000.0000 /end AXIS_DESCR /begin AXIS_DESCR STD_AXIS rf_soll FORMULA_0007 22 0.0 2.0000 FORMAT "%6.3" /end AXIS_DESCR FORMAT "%4.1" /end CHARACTERISTIC
/begin CHARACTERISTIC KF_EGAS_SOLL_WL_OFFS "Warmlaufkorrektur, Faktor um 0 | EN: Warm-up correction factor" MAP 0x725CC TKF_SW_SW_SW 100.0 FORMULA_0075 -4.0000 4.0000 /begin AXIS_DESCR STD_AXIS FORMULA_0006 8 0.0 10000.0000 /end AXIS_DESCR /begin AXIS_DESCR STD_AXIS rf FORMULA_0007 8 0.0 2.0000 FORMAT "%6.3" /end AXIS_DESCR FORMAT "%6.3" /end CHARACTERISTIC
/begin CHARACTERISTIC KF_EGAS_SOLL_WL_GEW_F "Warmlaufegwichtungsfaktor, Faktor um 0 | EN: Warm-up weighting factor (factor around 0)" MAP 0x7266E TKF_SW_SW_SW 100.0 FORMULA_0075 -4.0000 4.0000 /begin AXIS_DESCR STD_AXIS FORMULA_0021 8 0.0 320.0000 FORMAT "%5.2" /end AXIS_DESCR /begin AXIS_DESCR STD_AXIS FORMULA_0023 8 -50.0000 170.0000 FORMAT "%4.1" /end AXIS_DESCR FORMAT "%6.3" /end CHARACTERISTIC
/begin CHARACTERISTIC KF_EGAS_N_AQ_KH_NEG "neg. Drehzahlfilter bei KH" MAP 0x72710 TKF_SW_SW_UB 100.0 FORMULA_0478 0.0051 1.2800 /begin AXIS_DESCR STD_AXIS FORMULA_0006 8 0.0 10000.0000 /end AXIS_DESCR
 /begin AXIS_DESCR STD_AXIS egas_aq_soll FORMULA_0147 8 0.0 3200.0000 FORMAT "%4.1" /end AXIS_DESCR
/end CHARACTERISTIC
/begin CHARACTERISTIC KF_EGAS_N_AQ_KH_POS "pos. Drehzahlfilter bei KH" MAP 0x72772 TKF_SW_SW_UB 100.0 FORMULA_0478 0.0051 1.2800 /begin AXIS_DESCR STD_AXIS FORMULA_0006 8 0.0 10000.0000 /end AXIS_DESCR
 /begin AXIS_DESCR STD_AXIS egas_aq_soll FORMULA_0147 8 0.0 3200.0000 FORMAT "%4.1" /end AXIS_DESCR
/end CHARACTERISTIC
/begin CHARACTERISTIC KF_EGAS_N_AQ_ML_NEG "neg. Drehzahlfilter bei ML | EN: Negative speed filter (tau) vs n and target area, engine running" MAP 0x727D4 TKF_SW_SW_UB 100.0 FORMULA_0478 0.0051 1.2800 /begin AXIS_DESCR STD_AXIS FORMULA_0006 8 0.0 10000.0000 /end AXIS_DESCR
 /begin AXIS_DESCR STD_AXIS egas_aq_soll FORMULA_0147 8 0.0 3200.0000 FORMAT "%4.1" /end AXIS_DESCR
/end CHARACTERISTIC
/begin CHARACTERISTIC KF_EGAS_N_AQ_ML_POS "pos. Drehzahlfilter bei ML" MAP 0x72836 TKF_SW_SW_UB 100.0 FORMULA_0478 0.0051 1.2800 /begin AXIS_DESCR STD_AXIS FORMULA_0006 8 0.0 10000.0000 /end AXIS_DESCR
 /begin AXIS_DESCR STD_AXIS egas_aq_soll FORMULA_0147 8 0.0 3200.0000 FORMAT "%4.1" /end AXIS_DESCR
/end CHARACTERISTIC
/begin CHARACTERISTIC K_EGAS_SOLL_BOWDEN_MIN "min. LLS-Schwelle | EN: Minimum idle air valve threshold [%] [V912: differs from V452 160E]" VALUE 0x7A9DC TKW_VV_VV_SW 100.0 FORMULA_0001 -10.0000 120.0000 FORMAT "%4.1" /end CHARACTERISTIC
/* ------------------ Abschnitt erzeugt aus egas_cmd.dat ------------------ */ /* ------------------ Abschnitt erzeugt aus egas_sk.dat ------------------ */
/begin CHARACTERISTIC K_EGAS_SK_CONTROL "SK-Schalter | EN: Safety-concept switch" VALUE 0x72898 TKW_VV_VV_UB 100.0 FORMULA_0625 0.0 255.0 /end CHARACTERISTIC
/begin CHARACTERISTIC K_EGAS_SK_T_OFFEN "max. Zeit Istwertabweichung | EN: Maximum time for actual-value deviation [s]" VALUE 0x72899 TKW_VV_VV_UB 100.0 FORMULA_0317 0.0 2.5500 /end CHARACTERISTIC
/begin CHARACTERISTIC K_EGAS_SK_TAU_LLS "Filter LLS-Ueberwachung | EN: Filter, idle air valve monitoring [s]" VALUE 0x7289A TKW_VV_VV_UB 100.0 FORMULA_0462 0.0101 2.5600 /end CHARACTERISTIC
/begin CHARACTERISTIC K_EGAS_SK_TAU_DK "Filter DK-Ueberwachung | EN: Filter, throttle monitoring [s]" VALUE 0x7289B TKW_VV_VV_UB 100.0 FORMULA_0462 0.0101 2.5600 /end CHARACTERISTIC
/begin CHARACTERISTIC K_EGAS_SK_SOLL_DIFF "max. Differenz Sollwertabweichung | EN: Maximum difference, setpoint deviation [%]" VALUE 0x7289C TKW_VV_VV_SW 100.0 FORMULA_0001 -10.0000 120.0000 FORMAT "%4.1" /end CHARACTERISTIC
/begin CHARACTERISTIC K_EGAS_SK_SOLL_DIFF_LLS "max. Differenz Sollwertabweichung | EN: Maximum difference, setpoint deviation [%]" VALUE 0x7289E TKW_VV_VV_SW 100.0 FORMULA_0001 -10.0000 120.0000 FORMAT "%4.1" /end CHARACTERISTIC
/begin CHARACTERISTIC K_EGAS_SK_IST_DIFF_LLS "max. Differenz Istwertabweichung | EN: Maximum difference, actual-value deviation [%]" VALUE 0x728A0 TKW_VV_VV_SW 100.0 FORMULA_0001 -10.0000 120.0000 FORMAT "%4.1" /end CHARACTERISTIC
/begin CHARACTERISTIC K_EGAS_SK_T_SOLL "max. Zeit Sollwertabweichung | EN: Maximum time for setpoint deviation [s]" VALUE 0x728A2 TKW_VV_VV_UW 100.0 FORMULA_0021 0.0 10.0000 FORMAT "%5.2" /end CHARACTERISTIC
/begin CHARACTERISTIC K_EGAS_SK_T_WDK "max. Zeit Analog-/CAN-Abweichung | EN: Maximum time for analogue vs CAN deviation [s]" VALUE 0x728A4 TKW_VV_VV_UW 100.0 FORMULA_0021 0.0 10.0000 FORMAT "%5.2" /end CHARACTERISTIC
/begin CHARACTERISTIC K_EGAS_SK_T_IST "max. Zeit Soll-/Istabweichung | EN: Maximum time for setpoint/actual deviation [s]" VALUE 0x728A6 TKW_VV_VV_UW 100.0 FORMULA_0021 0.0 10.0000 FORMAT "%5.2" /end CHARACTERISTIC
/begin CHARACTERISTIC K_EGAS_SK_T_SOLL_LLS "max. Zeit Sollwertabweichung | EN: Maximum time for setpoint deviation [s]" VALUE 0x728A8 TKW_VV_VV_UW 100.0 FORMULA_0021 0.0 10.0000 FORMAT "%5.2" /end CHARACTERISTIC
/begin CHARACTERISTIC K_EGAS_SK_T_IST_LLS "max. Zeit Istwertabweichung | EN: Maximum time for actual-value deviation [s]" VALUE 0x728AA TKW_VV_VV_UW 100.0 FORMULA_0021 0.0 10.0000 FORMAT "%5.2" /end CHARACTERISTIC
/begin CHARACTERISTIC K_EGAS_SK_T_MODE "max. Zeit Modeabweichung | EN: Maximum time for mode deviation [s]" VALUE 0x728AC TKW_VV_VV_UW 100.0 FORMULA_0021 0.0 10.0000 FORMAT "%5.2" /end CHARACTERISTIC
/begin CHARACTERISTIC K_EGAS_SK_T_MODE_INIT "max. Zeit Modeabweichung LLS-Init | EN: Maximum time for mode deviation during idle-valve init [s]" VALUE 0x728AE TKW_VV_VV_UW 100.0 FORMULA_0021 0.0 10.0000 FORMAT "%5.2" /end CHARACTERISTIC
/begin CHARACTERISTIC K_EGAS_SK_T_NP_MAX "max. Dauer fuer NP-Adaption | EN: Maximum duration for zero-point adaptation [sec]" VALUE 0x728B0 TKW_VV_VV_UW 100.0 FORMULA_0596 0.0 327.6750 FORMAT "%5.2" /end CHARACTERISTIC
/begin CHARACTERISTIC K_EGAS_SK_DK_OFFEN_1 "Schwelle fuer Spalt offen | EN: Threshold for gap open [%]" VALUE 0x728B2 TKW_VV_VV_SW 100.0 FORMULA_0001 -10.0000 120.0000 FORMAT "%4.1" /end CHARACTERISTIC
/begin CHARACTERISTIC K_EGAS_SK_DK_OFFEN_2 "Schwelle fuer Klemmen offen | EN: Threshold for clamping open [%]" VALUE 0x728B4 TKW_VV_VV_SW 100.0 FORMULA_0001 -10.0000 120.0000 FORMAT "%4.1" /end CHARACTERISTIC
/begin CHARACTERISTIC K_EGAS_SK_NEUINIT_MAX "max. Anzahl fuer Neuinits | EN: Maximum number of re-initialisations" VALUE 0x728B6 TKW_VV_VV_UB 100.0 FORMULA_0003 0.0 255.0000 /end CHARACTERISTIC
/begin CHARACTERISTIC K_EGAS_SK_FAIL_MAX "max. Anzahl fuer Fail-Status | EN: max. Anzahl fuer Fail-Status" VALUE 0x728B7 TKW_VV_VV_UB 100.0 FORMULA_0003 0.0 255.0000 /end CHARACTERISTIC
/begin CHARACTERISTIC K_EGAS_SK_RF_TSTART "Wartezeit nach Start" VALUE 0x728B8 TKW_VV_VV_UW 100.0 FORMULA_0021 0.0 10.0000 FORMAT "%5.2" /end CHARACTERISTIC
/begin CHARACTERISTIC K_EGAS_SK_RF_IO_OFF "Offset der zulaessigen Differenz wdk-rf" VALUE 0x728BA TKW_VV_VV_SW 100.0 FORMULA_0007 0.0 2.0000 FORMAT "%6.3" /end CHARACTERISTIC
/begin CHARACTERISTIC K_EGAS_SK_RF_IO_FAK "Faktor der zulaessigen Differenz wdk-rf" VALUE 0x728BC TKW_VV_VV_UW 100.0 FORMULA_0075 0.0 4.0000 FORMAT "%6.3" /end CHARACTERISTIC
/begin CHARACTERISTIC K_EGAS_SK_RF_IO_DK "Fehlerschwelle fuer DK iO" VALUE 0x728BE TKW_VV_VV_UB 100.0 FORMULA_0003 0.0 16.0000 /end CHARACTERISTIC
/begin CHARACTERISTIC K_EGAS_SK_RF_IO_WDK "Fehlerschwelle fuer WDK iO" VALUE 0x728BF TKW_VV_VV_UB 100.0 FORMULA_0003 0.0 16.0000 /end CHARACTERISTIC
/begin CHARACTERISTIC K_EGAS_SK_T_RGPOS "max. Zeit CAN-Fehlerkennung | EN: max. Zeit CAN-Fehlerkennung" VALUE 0x728C0 TKW_VV_VV_UB 100.0 FORMULA_0317 0.0 2.0000 /end CHARACTERISTIC
/begin CHARACTERISTIC KL_EGAS_SK_DK_DIFF_MAX "max. Differenz Soll/Ist | EN: Maximum setpoint/actual difference" CURVE 0x728C2 TKL_SW_VV_SW 100.0 FORMULA_0001 -10.0000 120.0000
 /begin AXIS_DESCR STD_AXIS dk_soll FORMULA_0001 4 -10.0000 120.0000 FORMAT "%4.1" /end AXIS_DESCR
 FORMAT "%4.1" /end CHARACTERISTIC
/begin CHARACTERISTIC KL_EGAS_SK_WDK_DIFF "max. Differenz Analog-/CAN-Abweichung | EN: Maximum analogue vs CAN deviation" CURVE 0x728D4 TKL_SW_VV_SW 100.0 FORMULA_0001 -10.0000 120.0000
 /begin AXIS_DESCR STD_AXIS dk_ist FORMULA_0001 4 -10.0000 120.0000 FORMAT "%4.1" /end AXIS_DESCR
 FORMAT "%4.1" /end CHARACTERISTIC
/* ------------------ Abschnitt erzeugt aus egas_stm.dat ------------------ */
/begin CHARACTERISTIC K_EGAS_STM_NOINIT_SK "SK-Fehler ohne Neuinit | EN: SK-Fehler ohne Neuinit" VALUE 0x728E6 TKW_VV_VV_UW 100.0 FORMULA_0010 0.0 65535.0000 /end CHARACTERISTIC
/begin CHARACTERISTIC K_EGAS_STM_NOINIT_FAIL "Fail-Fehler ohne Neuinit | EN: Fail-Fehler ohne Neuinit" VALUE 0x728E8 TKW_VV_VV_UW 100.0 FORMULA_0010 0.0 65535.0000 /end CHARACTERISTIC
/begin CHARACTERISTIC K_EGAS_STM_LLS_DK_SCHW "DK-Schwelle fuer LLS-Adaption | EN: DK-Schwelle fuer LLS - Adaption" VALUE 0x728EA TKW_VV_VV_SW 100.0 FORMULA_0001 -10.0000 120.0000 FORMAT "%4.1" /end CHARACTERISTIC
/begin CHARACTERISTIC K_EGAS_STM_LLS_T_ADAPT "max. Zeit fuer LLS-Adaption | EN: max. Zeit fuer LLS-Adaption" VALUE 0x728EC TKW_VV_VV_UW 100.0 FORMULA_0633 0.0 327.6750 FORMAT "%5.2" /end CHARACTERISTIC
/begin CHARACTERISTIC K_EGAS_STM_T_ADAPT "Adaptionszyklus fuer LLS und DK | EN: Adaptionszyklus fuer LLS und DK" VALUE 0x728EE TKW_VV_VV_UW 100.0 FORMULA_0627 0.0 1092.2500 /end CHARACTERISTIC
/begin CHARACTERISTIC K_EGAS_STM_DK_WAIT_DIS "Warten auf Disable | EN: Wait for disable [sec]" VALUE 0x728F0 TKW_VV_VV_UW 100.0 FORMULA_0633 0.0 327.6750 FORMAT "%5.2" /end CHARACTERISTIC
/begin CHARACTERISTIC K_EGAS_STM_DK_SK_ZU "Schwelle fuer SK-/GT-Test | EN: Threshold for safety-concept / linkage test [%]" VALUE 0x728F2 TKW_VV_VV_SW 100.0 FORMULA_0001 -10.0000 120.0000 FORMAT "%4.1" /end CHARACTERISTIC
/begin CHARACTERISTIC K_EGAS_STM_DK_SK_TST "SK-Testzeit | EN: Safety-concept test time [sec]" VALUE 0x728F4 TKW_VV_VV_UW 100.0 FORMULA_0633 0.0 327.6750 FORMAT "%5.2" /end CHARACTERISTIC
/begin CHARACTERISTIC K_EGAS_STM_DK_GT_TIME "max. Zeit fuer Gestaengetest | EN: Maximum time for linkage test [sec]" VALUE 0x728F6 TKW_VV_VV_UW 100.0 FORMULA_0633 0.0 327.6750 FORMAT "%5.2" /end CHARACTERISTIC
/begin CHARACTERISTIC K_EGAS_STM_DK_GT_TMOT "min. Temp fuer Gestaengetest | EN: Minimum temperature for linkage test [°C]" VALUE 0x728F8 TKW_VV_VV_SW 100.0 FORMULA_0023 -50.0000 170.0000 FORMAT "%4.1" /end CHARACTERISTIC
/begin CHARACTERISTIC K_EGAS_STM_DK_GT_UB "min. Ub fuer Gestaengetest | EN: Minimum battery voltage for linkage test [V]" VALUE 0x728FA TKW_VV_VV_SW 100.0 FORMULA_0008 0.0 28.0000 FORMAT "%4.1" /end CHARACTERISTIC
/begin CHARACTERISTIC K_EGAS_STM_DK_GT_MIN "min. Delta fuer Gestaengetest | EN: Minimum delta for linkage test [%]" VALUE 0x728FC TKW_VV_VV_SW 100.0 FORMULA_0001 -10.0000 120.0000 FORMAT "%4.1" /end CHARACTERISTIC
/begin CHARACTERISTIC K_EGAS_STM_DK_GT_MAX "max. Position fuer Abbruch Gestaengetest | EN: Maximum position for aborting linkage test [%]" VALUE 0x728FE TKW_VV_VV_SW 100.0 FORMULA_0001 -10.0000 120.0000 FORMAT "%4.1" /end CHARACTERISTIC
/begin CHARACTERISTIC K_EGAS_STM_DK_N_FAST "schneller DK-Hochlauf beim Reset | EN: Fast throttle run-up on reset [Upm]" VALUE 0x72900 TKW_VV_VV_SW 100.0 FORMULA_0006 0.0 10000.0000 /end CHARACTERISTIC
/begin CHARACTERISTIC K_EGAS_STM_DK_N_KL50 "schneller DK-Hochlauf bei Kl50 | EN: Fast throttle run-up at terminal 50 (cranking) [Upm]" VALUE 0x72902 TKW_VV_VV_SW 100.0 FORMULA_0006 0.0 10000.0000 /end CHARACTERISTIC
/begin CHARACTERISTIC K_EGAS_STM_DK_FT_TMOT "min. Temp fuer Federntest | EN: Minimum temperature for spring test [°C]" VALUE 0x72904 TKW_VV_VV_SW 100.0 FORMULA_0023 -50.0000 170.0000 FORMAT "%4.1" /end CHARACTERISTIC
/begin CHARACTERISTIC K_EGAS_STM_DK_NP_UB "min. Ub fuer Nullpunktsadaption | EN: Minimum battery voltage for zero-point adaptation [V]" VALUE 0x72906 TKW_VV_VV_SW 100.0 FORMULA_0008 0.0 28.0000 FORMAT "%4.1" /end CHARACTERISTIC
/begin CHARACTERISTIC K_EGAS_STM_DK_NP_NMAX "max. Drehzahl fuer Nachadaption | EN: Maximum engine speed for post-adaptation [Upm]" VALUE 0x72908 TKW_VV_VV_SW 100.0 FORMULA_0006 0.0 10000.0000 /end CHARACTERISTIC
/begin CHARACTERISTIC K_EGAS_STM_DK_NP_TMOT "Differenz fuer Nachadaption" VALUE 0x7290A TKW_VV_VV_SW 100.0 FORMULA_0076 -1000.0000 1000.0000 FORMAT "%4.1" /end CHARACTERISTIC
/begin CHARACTERISTIC K_EGAS_STM_DK_NP_TMOT_MIN "min. Temp fuer Nullpunktadaption | EN: min. Temp fuer Nullpunktadaption" VALUE 0x7290C TKW_VV_VV_SW 100.0 FORMULA_0023 -50.0000 170.0000 FORMAT "%4.1" /end CHARACTERISTIC
/begin CHARACTERISTIC K_EGAS_STM_DK_NP_PMIN "min. Psau fuer Nachadaption | EN: Minimum intake manifold pressure for post-adaptation [%]" VALUE 0x7290E TKW_VV_VV_SW 100.0 FORMULA_0115 0.0 120.0000 FORMAT "%5.2" /end CHARACTERISTIC
/begin CHARACTERISTIC K_EGAS_STM_DK_NP_PMAX "max. Psau fuer Nachadaption | EN: Maximum intake manifold pressure for post-adaptation [%]" VALUE 0x72910 TKW_VV_VV_SW 100.0 FORMULA_0115 0.0 120.0000 FORMAT "%5.2" /end CHARACTERISTIC
/begin CHARACTERISTIC K_EGAS_STM_DK_MODE_HW "HW-Nr fuer ModeVgl-Hosentraeger | EN: Hardware number for mode comparison (redundancy check)" VALUE 0x72912 TKW_VV_VV_UW 100.0 FORMULA_0010 0.0 65535.0000 /end CHARACTERISTIC
/begin CHARACTERISTIC K_EGAS_EXD_UB_MIN "min. Ub fuer DK-Diagnose | EN: Minimum battery voltage for throttle diagnosis [V]" VALUE 0x72914 TKW_VV_VV_SW 100.0 FORMULA_0008 0.0 28.0000 FORMAT "%4.1" /end CHARACTERISTIC
/begin CHARACTERISTIC K_EGAS_EXD_UB_MAX "max. Ub fuer DK-Diagnose | EN: Maximum battery voltage for throttle diagnosis [V]" VALUE 0x72916 TKW_VV_VV_SW 100.0 FORMULA_0008 0.0 28.0000 FORMAT "%4.1" /end CHARACTERISTIC
/begin CHARACTERISTIC K_EGAS_EXD_KS_T_MAX "max. Zeit Kleinsprung | EN: Maximum time for small step [s]" VALUE 0x72918 TKW_VV_VV_UB 100.0 FORMULA_0352 0.0 1.2750 /end CHARACTERISTIC
/begin CHARACTERISTIC K_EGAS_EXD_GS_T_MAX "max. Zeit Grosssprung | EN: Maximum time for large step [s]" VALUE 0x72919 TKW_VV_VV_UB 100.0 FORMULA_0352 0.0 1.2750 /end CHARACTERISTIC
/begin CHARACTERISTIC K_EGAS_EXD_SW_SOLL "Startwert Sprunge | EN: Start value for steps [%]" VALUE 0x7291A TKW_VV_VV_SW 100.0 FORMULA_0001 -10.0000 120.0000 FORMAT "%4.1" /end CHARACTERISTIC
/begin CHARACTERISTIC K_EGAS_EXD_KS_SOLL "Sollwert Kleinsprung | EN: Setpoint for small step (throttle test) [%]" VALUE 0x7291C TKW_VV_VV_SW 100.0 FORMULA_0001 -10.0000 120.0000 FORMAT "%4.1" /end CHARACTERISTIC
/begin CHARACTERISTIC K_EGAS_EXD_GS_SOLL "Sollwert Grosssprung | EN: Setpoint for large step (throttle test) [%]" VALUE 0x7291E TKW_VV_VV_SW 100.0 FORMULA_0001 -10.0000 120.0000 FORMAT "%4.1" /end CHARACTERISTIC
/begin CHARACTERISTIC K_EGAS_EXD_R1_SOLL_TV "min. Sollwert fuer TV - Oeffnen 1 | EN: Minimum setpoint for duty cycle - opening 1 [%]" VALUE 0x72920 TKW_VV_VV_SW 100.0 FORMULA_0001 -10.0000 120.0000 FORMAT "%4.1" /end CHARACTERISTIC
/begin CHARACTERISTIC K_EGAS_EXD_R1_SOLL "Endwert Rampe 1 - Oeffnen 1 | EN: End value ramp 1 - opening 1 [%]" VALUE 0x72922 TKW_VV_VV_SW 100.0 FORMULA_0001 -10.0000 120.0000 FORMAT "%4.1" /end CHARACTERISTIC
/begin CHARACTERISTIC K_EGAS_EXD_R2_SOLL "Endwert Rampe 2 - Oeffnen 2 | EN: End value ramp 2 - opening 2 [%]" VALUE 0x72924 TKW_VV_VV_SW 100.0 FORMULA_0001 -10.0000 120.0000 FORMAT "%4.1" /end CHARACTERISTIC
/begin CHARACTERISTIC K_EGAS_EXD_R1_TIME "Zeit Rampe 1 - Oeffnen 1 | EN: Time ramp 1 - opening 1 [s]" VALUE 0x72926 TKW_VV_VV_UW 100.0 FORMULA_0117 0.0 325.0000 FORMAT "%5.2" /end CHARACTERISTIC
/begin CHARACTERISTIC K_EGAS_EXD_R2_TIME "Zeit Rampe 2 - Oeffnen 2 | EN: Time ramp 2 - opening 2 [s]" VALUE 0x72928 TKW_VV_VV_UW 100.0 FORMULA_0117 0.0 325.0000 FORMAT "%5.2" /end CHARACTERISTIC
/begin CHARACTERISTIC K_EGAS_EXD_R3_TIME "Zeit Rampe 3 - Schliessen | EN: Time ramp 3 - closing [s]" VALUE 0x7292A TKW_VV_VV_UW 100.0 FORMULA_0117 0.0 325.0000 FORMAT "%5.2" /end CHARACTERISTIC
/begin CHARACTERISTIC KL_EGAS_EXD_VORST_LLS_AUF "Vorsteuerwert LLS-Auf | EN: Idle-air actuator feed-forward duty, opening" CURVE 0x7292C TKL_SW_VV_UB 100.0 FORMULA_0634 0.0 199.2187
 /begin AXIS_DESCR STD_AXIS r_sollw FORMULA_0001 4 -10.0000 120.0000 FORMAT "%4.1" /end AXIS_DESCR
/end CHARACTERISTIC
/begin CHARACTERISTIC KL_EGAS_EXD_VORST_LLS_ZU "Vorsteuerwert LLS-Zu | EN: Idle-air actuator feed-forward duty, closing" CURVE 0x7293A TKL_SW_VV_UB 100.0 FORMULA_0634 0.0 199.2187
 /begin AXIS_DESCR STD_AXIS r_sollw FORMULA_0001 4 -10.0000 120.0000 FORMAT "%4.1" /end AXIS_DESCR
/end CHARACTERISTIC
/begin CHARACTERISTIC KL_EGAS_EXD_VORST_DK_AUF "Vorsteuerwert DK-Auf | EN: Throttle pre-control value, opening" CURVE 0x72948 TKL_SW_VV_UB 100.0 FORMULA_0634 0.0 199.2187
 /begin AXIS_DESCR STD_AXIS r_sollw FORMULA_0001 4 -10.0000 120.0000 FORMAT "%4.1" /end AXIS_DESCR
/end CHARACTERISTIC
/begin CHARACTERISTIC KL_EGAS_EXD_VORST_DK_ZU "Vorsteuerwert DK-Zu | EN: Throttle pre-control value, closing" CURVE 0x72956 TKL_SW_VV_UB 100.0 FORMULA_0634 0.0 199.2187
 /begin AXIS_DESCR STD_AXIS r_sollw FORMULA_0001 4 -10.0000 120.0000 FORMAT "%4.1" /end AXIS_DESCR
/end CHARACTERISTIC
/* ------------------ Abschnitt erzeugt aus n_e2.dat ------------------ */
/begin CHARACTERISTIC K_N_E2_DELTA "Max zulaessige Drehzahl fuer Ebene 2 | EN: Max zulaessige Drehzahl fuer Ebene 2" VALUE 0x7A996 TKW_VV_VV_SW 100.0 FORMULA_0006 0.0 10000.0000 /end CHARACTERISTIC
/begin CHARACTERISTIC K_N_E2_T_MAX "Maximale Fehlerzeit der Drehzahl fuer Ebene 2 | EN: Maximale Fehlerzeit der Drehzahl fuer Ebene 2" VALUE 0x7A998 TKW_VV_VV_UW 100.0 FORMULA_0021 0.0 655.0000 FORMAT "%5.2" /end CHARACTERISTIC
/* ------------------ Abschnitt erzeugt aus ppcm.dat ------------------ */
/begin CHARACTERISTIC K_DSP_MESSEN "Schalter Freigabe DSP MESS: 0 = Aus; 1 = Aktiv | EN: Switch enabling DSP measurement: 0 = off, 1 = active [V912: differs from V452 160E]" VALUE 0x7A9D6 TKW_VV_VV_UB 100.0 FORMULA_0003 0.0 1.0000 /end CHARACTERISTIC
/* ------------------ Abschnitt erzeugt aus tabg.dat ------------------ */
/begin CHARACTERISTIC K_TABG_NKAT_CFG "Schalter welche Nachkattemperatur | EN: Schalter welche Nachkattemperatur" VALUE 0x79304 TKW_VV_VV_UB 100.0 FORMULA_0976 0.0 255.0 /end CHARACTERISTIC
/begin CHARACTERISTIC K_TABG_NKAT_MAX_CFG "Schalter welche Nachkattemperatur abgespeichert wird" VALUE 0x79305 TKW_VV_VV_UB 100.0 FORMULA_0977 0.0 255.0 /end CHARACTERISTIC
/begin CHARACTERISTIC K_TABG_PST_V "Ersatzgeschwindigkeit am Pruefstand | EN: Ersatzgeschwindigkeit am Pruefstand" VALUE 0x79306 TKW_VV_VV_SW 100.0 FORMULA_0078 -80.0000 360.0000 FORMAT "%4.1" /end CHARACTERISTIC
/begin CHARACTERISTIC K_TABG_NKAT_K_TUMG "Waermeuebergangskoeffizient | EN: Waermeuebergangskoeffizient" VALUE 0x79308 TKW_VV_VV_UW 100.0 FORMULA_0978 0.0 65.5350 FORMAT "%7.4" /end CHARACTERISTIC
/begin CHARACTERISTIC K_TABG_VKAT_K_V "Geschwindikeitsabhaengiger Waermeuebergangskoeffizient | EN: Geschwindikeitsabhaengiger Waermeuebergangskoeffizient" VALUE 0x7930A TKW_VV_VV_UW 100.0 FORMULA_0979 0.0 6.5535 FORMAT "%7.4" /end CHARACTERISTIC
/begin CHARACTERISTIC K_TABG_NKAT_K_V "Geschwindikeitsabhaengiger Waermeuebergangskoeffizient | EN: Geschwindikeitsabhaengiger Waermeuebergangskoeffizient" VALUE 0x7930C TKW_VV_VV_UW 100.0 FORMULA_0979 0.0 6.5535 FORMAT "%7.4" /end CHARACTERISTIC
/begin CHARACTERISTIC K_TABG_DIAG_MIN "Unter Grenze Abgastemperatur" VALUE 0x7930E TKW_VV_VV_SW 100.0 FORMULA_0333 -50.0000 1250.0000 FORMAT "%5.2" /end CHARACTERISTIC
/begin CHARACTERISTIC K_TABG_DIAG_MAX "Obere Grenze Abgastemperatur" VALUE 0x79310 TKW_VV_VV_SW 100.0 FORMULA_0333 -50.0000 1250.0000 FORMAT "%5.2" /end CHARACTERISTIC
/begin CHARACTERISTIC K_TABG_DIAG_PLAUSI_DELTA_NEG "Maximale negative Abweichung" VALUE 0x79312 TKW_VV_VV_SW 100.0 FORMULA_0980 -1000.0000 0.0 FORMAT "%5.2" /end CHARACTERISTIC
/begin CHARACTERISTIC K_TABG_DIAG_PLAUSI_DELTA_POS "Maximale positive Abweichung" VALUE 0x79314 TKW_VV_VV_SW 100.0 FORMULA_0980 0.0 1000.0000 FORMAT "%5.2" /end CHARACTERISTIC
/begin CHARACTERISTIC K_TABG_DIAG_PLAUSI_AKTIV_T_ML "Plausi-Diag-Sperrzeit nach Motorstart" VALUE 0x79316 TKW_VV_VV_UW 100.0 FORMULA_0021 0.0 655.0000 FORMAT "%5.2" /end CHARACTERISTIC
/begin CHARACTERISTIC K_TABG_DIAG_TIME "Sperrzeit fuer Plausifehler" VALUE 0x79318 TKW_VV_VV_UW 100.0 FORMULA_0073 0.0 6553.5000 FORMAT "%4.1" /end CHARACTERISTIC
/begin CHARACTERISTIC K_TABG_STAND_MAX "Maximale Abstellabgastemperatur | EN: Maximale Abstellabgastempe-ratur" VALUE 0x7931A TKW_VV_VV_SW 100.0 FORMULA_0076 -1000.0000 1250.0000 FORMAT "%4.1" /end CHARACTERISTIC
/begin CHARACTERISTIC K_TABG_TAU "Filterkonstante fuer die Abgastemperaturerfassung | EN: Filterkonstante fuer die A b-gastemperaturerfassung" VALUE 0x7931C TKW_VV_VV_UB 100.0 FORMULA_0679 0.1004 25.6000 /end CHARACTERISTIC
/begin CHARACTERISTIC K_TABG_KAT_OBD_GRAD_TAU "Filterkonstante fuer die Kattemperatur | EN: Filterkonstante fuer die Ka t-temperatur" VALUE 0x7931D TKW_VV_VV_UB 100.0 FORMULA_0679 0.1004 25.6000 /end CHARACTERISTIC
/begin CHARACTERISTIC K_TABG_KAT_OBD_GRAD_MAX "Max. Gradient ueber 100ms | EN: Max. Gradient ueber 100ms" VALUE 0x7931E TKW_VV_VV_SW 100.0 FORMULA_0981 0.0 1638.3500 FORMAT "%5.2" /end CHARACTERISTIC
/begin CHARACTERISTIC K_TABG_C "Mittlere spezifische Waermekapazitaet | EN: Mittlere spezifische Waerm e-kapazitaet" VALUE 0x79320 TKW_VV_VV_UW 100.0 FORMULA_0982 1.0000 65535.0000 /end CHARACTERISTIC
/begin CHARACTERISTIC K_TABG_VKAT_MC "Waermekapazitaet vor Kat | EN: Waermekapazitaet vor Kat" VALUE 0x79322 TKW_VV_VV_UW 100.0 FORMULA_0983 1.0000 65535.0000 /end CHARACTERISTIC
/begin CHARACTERISTIC K_TABG_VKAT_REAK_SCHWELLE "Aktivierungsschwelle Kruemmerreaktion | EN: Aktivierungsschwelle Kruemmerreaktion" VALUE 0x79324 TKW_VV_VV_SW 100.0 FORMULA_0023 -50.0000 1250.0000 FORMAT "%4.1" /end CHARACTERISTIC
/begin CHARACTERISTIC K_TABG_KAT_MC "Waermekapazitaet des Katalysatoranfangs | EN: Waermekapazitaet des Kat a-lysatoranfangs" VALUE 0x79326 TKW_VV_VV_UW 100.0 FORMULA_0983 1.0000 65535.0000 /end CHARACTERISTIC
/begin CHARACTERISTIC K_TABG_NKAT_MC "Waermekapazitaet des Katalysatorendes | EN: Waermekapazitaet des Kat a-lysatorendes" VALUE 0x79328 TKW_VV_VV_UW 100.0 FORMULA_0983 1.0000 65535.0000 /end CHARACTERISTIC
/begin CHARACTERISTIC K_TABG_LW_AUSBLEND_OFFS "Temperaturoffset ausgeblendeter Zylinder | EN: Temperaturoffset ausgeble n-deter Zylinder" VALUE 0x7932A TKW_VV_VV_SW 100.0 FORMULA_0076 -1000.0000 1000.0000 FORMAT "%4.1" /end CHARACTERISTIC
/begin CHARACTERISTIC K_TABG_VKAT_A "Kruemmerflaeche | EN: Krümmerflaeche" VALUE 0x7932C TKW_VV_VV_UW 100.0 FORMULA_0984 0.0 6.5535 FORMAT "%7.4" /end CHARACTERISTIC
/begin CHARACTERISTIC K_TABG_NKAT_A "Katflaeche | EN: Katflaeche" VALUE 0x7932E TKW_VV_VV_UW 100.0 FORMULA_0984 0.0 6.5535 FORMAT "%7.4" /end CHARACTERISTIC
/begin CHARACTERISTIC K_TABG_KAT_T_OFFS_AUF "Aufregelrampe Enthalpie | EN: Ramp-up for enthalpy" VALUE 0x79330 TKW_VV_VV_SW 100.0 FORMULA_0985 0.0 3276.7000 FORMAT "%4.1" /end CHARACTERISTIC
/begin CHARACTERISTIC K_TABG_KAT_T_OFFS_AB "Abregelrampe Enthalpie | EN: Ramp-down for enthalpy" VALUE 0x79332 TKW_VV_VV_SW 100.0 FORMULA_0985 0.0 3276.7000 FORMAT "%4.1" /end CHARACTERISTIC
/begin CHARACTERISTIC K_TABG_KAT_EXO_HYS "Hysterese fuer Enthalpie | EN: Hysteresis for enthalpy" VALUE 0x79334 TKW_VV_VV_SW 100.0 FORMULA_0076 -1000.0000 1000.0000 FORMAT "%4.1" /end CHARACTERISTIC
/begin CHARACTERISTIC K_TABG_KAT_EXO_ON "Startwert fuer Enthalpie | EN: Start value for enthalpy [°C]" VALUE 0x79336 TKW_VV_VV_SW 100.0 FORMULA_0023 -50.0000 1250.0000 FORMAT "%4.1" /end CHARACTERISTIC
/begin CHARACTERISTIC K_TABG_KAT_EXO_MS_SCHWELLE "Gespeicherte Sauerstoffmasse im KAT | EN: Stored oxygen mass in the catalyst [mg]" VALUE 0x79338 TKW_VV_VV_SW 100.0 FORMULA_0093 -3276.8000 3276.7000 FORMAT "%5.2" /end CHARACTERISTIC
/begin CHARACTERISTIC KL_TABG_PT200 "Kennlinie Abgastemperatur | EN: Exhaust temperature curve" CURVE 0x7933A TKL_SW_VV_SW 100.0 FORMULA_0333 -50.0000 1250.0000 /begin AXIS_DESCR STD_AXIS tabg_ad FORMULA_0123 18 0.0 1023.0000 /end AXIS_DESCR FORMAT "%5.2" /end CHARACTERISTIC
/begin CHARACTERISTIC KL_TABG_LW_F_RG "Gewichtungsfaktor Restgas" CURVE 0x79384 TKL_SW_VV_UW 100.0 FORMULA_0075 0.0 4.0000
 /begin AXIS_DESCR STD_AXIS rg_x_delta FORMULA_0109 7 -0.5000 0.5000 FORMAT "%5.2" /end AXIS_DESCR
 FORMAT "%6.3" /end CHARACTERISTIC
/begin CHARACTERISTIC KL_TABG_LW_F_ETA_ZW "Gewichtungsfaktor Zuendwinkel | EN: Weighting factor, ignition angle" CURVE 0x793A2 TKL_UW_VV_UW 100.0 FORMULA_0075 0.0 4.0000 /begin AXIS_DESCR STD_AXIS FORMULA_0435 6 0.0 150.0000 FORMAT "%4.1" /end AXIS_DESCR FORMAT "%6.3" /end CHARACTERISTIC
/begin CHARACTERISTIC KL_TABG_LW_F_LAM "Gewichtungsfaktor Lambda | EN: Weighting factor, lambda" CURVE 0x793BC TKL_UW_VV_UW 100.0 FORMULA_0075 0.0 4.0000
 /begin AXIS_DESCR STD_AXIS lam_ist_mw FORMULA_0025 4 0.0 3.9990 FORMAT "%6.3" /end AXIS_DESCR
 FORMAT "%6.3" /end CHARACTERISTIC
/begin CHARACTERISTIC KL_TABG_LW_VERH_WURZEL "Verhaeltnis der Ladungswechseltemperaturen | EN: Ratio of gas-exchange temperatures" CURVE 0x793CE TKL_UW_VV_UW 100.0 FORMULA_0075 0.0 4.0000
 /begin AXIS_DESCR STD_AXIS tabg_lw_verh FORMULA_0075 7 0.0 4.0000 FORMAT "%6.3" /end AXIS_DESCR
 FORMAT "%6.3" /end CHARACTERISTIC
/begin CHARACTERISTIC KL_TABG_VKAT_STAND_F "Faktor Standzeit | EN: Faktor Standzeit" CURVE 0x793EC TKL_UW_VV_UW 100.0 FORMULA_0075 0.0 4.0000 /begin AXIS_DESCR STD_AXIS FORMULA_0986 8 0.0 1092.2500 FORMAT "%5.2" /end AXIS_DESCR FORMAT "%6.3" /end CHARACTERISTIC
/begin CHARACTERISTIC KL_TABG_KAT_STAND_F "Faktor Standzeit | EN: Faktor Standzeit" CURVE 0x7940E TKL_UW_VV_UW 100.0 FORMULA_0075 0.0 4.0000 /begin AXIS_DESCR STD_AXIS FORMULA_0986 8 0.0 1092.2500 FORMAT "%5.2" /end AXIS_DESCR FORMAT "%6.3" /end CHARACTERISTIC
/begin CHARACTERISTIC KL_TABG_LW_STAND_F "Faktor Standzeit | EN: Faktor Standzeit" CURVE 0x79430 TKL_UW_VV_UW 100.0 FORMULA_0075 0.0 4.0000 /begin AXIS_DESCR STD_AXIS FORMULA_0986 4 0.0 1092.2500 FORMAT "%5.2" /end AXIS_DESCR FORMAT "%6.3" /end CHARACTERISTIC
/begin CHARACTERISTIC KL_TABG_LW_TAU "Filterzeitkonstante | EN: Filter time constant" CURVE 0x79442 TKL_SW_VV_UB 100.0 FORMULA_0679 0.1004 25.6000
 /begin AXIS_DESCR STD_AXIS tabg_lw_ml_ges FORMULA_0112 4 -100.0000 1400.0000 FORMAT "%4.1" /end AXIS_DESCR
/end CHARACTERISTIC
/begin CHARACTERISTIC KL_TABG_VKAT_K_TMOT "Waermeuebergangskoeffizient | EN: Waermeuebergangskoeffizient" CURVE 0x79450 TKL_SW_VV_UW 100.0 FORMULA_0978 0.0 65.5350
 /begin AXIS_DESCR STD_AXIS tabg_lw_ml_ges FORMULA_0112 4 -100.0000 1400.0000 FORMAT "%4.1" /end AXIS_DESCR
 FORMAT "%7.4" /end CHARACTERISTIC
/begin CHARACTERISTIC KL_TABG_VKAT_MC_F_TMOT "Waermekapazitaet vor Kat beim Start | EN: Waermekapazitaet vor Kat beim Start" CURVE 0x79462 TKL_SW_VV_UW 100.0 FORMULA_0075 0.0 63.9990 /begin AXIS_DESCR STD_AXIS FORMULA_0023 4 -50.0000 170.0000 FORMAT "%4.1" /end AXIS_DESCR FORMAT "%6.3" /end CHARACTERISTIC
/begin CHARACTERISTIC KL_TABG_VKAT_F_REAK "Reaktion im Kruemmer | EN: Reaction in the exhaust manifold" CURVE 0x79474 TKL_UW_VV_UW 100.0 FORMULA_0075 0.0 4.0000
 /begin AXIS_DESCR STD_AXIS lam_ist_mw FORMULA_0025 4 0.0 3.9990 FORMAT "%6.3" /end AXIS_DESCR
 FORMAT "%6.3" /end CHARACTERISTIC
/begin CHARACTERISTIC KL_TABG_KAT_EXO_MAX "Maximale Enthalpie | EN: Maximale Enthalpie" CURVE 0x79486 TKL_UW_VV_SW 100.0 FORMULA_0975 0.0 327.6700
 /begin AXIS_DESCR STD_AXIS lam_ist_mw FORMULA_0025 4 0.0 3.9990 FORMAT "%6.3" /end AXIS_DESCR
 FORMAT "%5.2" /end CHARACTERISTIC
/begin CHARACTERISTIC KL_TABG_DIAG_PLAUSI_ML_FAK "Gewichtungsfaktor bei der Diagnose | EN: Weighting factor during diagnosis" CURVE 0x79498 TKL_SW_VV_UW 100.0 FORMULA_0075 0.0 4.0000
 /begin AXIS_DESCR STD_AXIS tabg_ml_ges FORMULA_0112 4 -100.0000 1400.0000 FORMAT "%4.1" /end AXIS_DESCR
 FORMAT "%6.3" /end CHARACTERISTIC
/begin CHARACTERISTIC KF_TABG_LW_STAT "Stationaere Abgastemperatur nach Ladungswechsel | EN: Steady-state exhaust temperature after gas exchange" MAP 0x794AA TKF_SW_SW_SW 100.0 FORMULA_0023 -50.0000 1250.0000 /begin AXIS_DESCR STD_AXIS FORMULA_0006 8 0.0 10000.0000 /end AXIS_DESCR /begin AXIS_DESCR STD_AXIS rf FORMULA_0007 8 0.0 2.0000 FORMAT "%6.3" /end AXIS_DESCR FORMAT "%4.1" /end CHARACTERISTIC
/* ------------------ Abschnitt erzeugt aus tan.dat ------------------ */
/begin CHARACTERISTIC K_TAN_DIAG_MIN "Unter Grenze Ansauglufttemperatur | EN: Unter Grenze Ansauglufttemperatur" VALUE 0x7954C TKW_VV_VV_SW 100.0 FORMULA_0987 -50.0000 170.0000 FORMAT "%6.3" /end CHARACTERISTIC
/begin CHARACTERISTIC K_TAN_DIAG_MAX "Obere Grenze Ansauglufttemperatur | EN: Obere Grenze Ansauglufttemperatur" VALUE 0x7954E TKW_VV_VV_SW 100.0 FORMULA_0987 -50.0000 170.0000 FORMAT "%6.3" /end CHARACTERISTIC
/begin CHARACTERISTIC K_TAN_ERSATZ "Ersatzwert fuer die Ansauglufttemperatur | EN: Ersatzwert fuer die Ansauglufttemperatur" VALUE 0x79550 TKW_VV_VV_SW 100.0 FORMULA_0987 -50.0000 170.0000 FORMAT "%6.3" /end CHARACTERISTIC
/begin CHARACTERISTIC K_TAN_MW_ABGR_NEG "neg. Aenderungsbegr. Ansauglufttemperatur pro 100ms | EN: neg. Aenderungsbegr. Ansauglufttemperatur pro 100ms" VALUE 0x79552 TKW_VV_VV_UW 100.0 FORMULA_0023 0.0 100.0000 FORMAT "%4.1" /end CHARACTERISTIC
/begin CHARACTERISTIC K_TAN_MW_ABGR_POS "pos. Aenderungsbegr. Ansauglufttemperatur pro 100ms | EN: pos. Aenderungsbegr. Ansauglufttemperatur pro 100ms" VALUE 0x79554 TKW_VV_VV_UW 100.0 FORMULA_0023 0.0 100.0000 FORMAT "%4.1" /end CHARACTERISTIC
/begin CHARACTERISTIC K_TAN_TAU "Filterkonstante fuer die Ansauglufttemperaturerfassung | EN: Filterkonstante fuer die Ansauglufttemperaturerfassung" VALUE 0x79556 TKW_VV_VV_UB 100.0 FORMULA_0679 0.1004 25.6000 /end CHARACTERISTIC
/begin CHARACTERISTIC K_TAN_OBD_N_DYN_TAU "Filterkonstante f�r Drehzahldynamik | EN: Filterkonstante fï¿½r Drehzahldynamik" VALUE 0x79557 TKW_VV_VV_UB 100.0 FORMULA_0679 0.1004 25.6000 /end CHARACTERISTIC
/begin CHARACTERISTIC K_TAN_MODELL_MR_TAU "Filterkonstante fuer Motorraumtemperatur | EN: Filterkonstante fuer Motorraumtemperatur" VALUE 0x79558 TKW_VV_VV_UW 100.0 FORMULA_0988 0.1000 6553.5000 FORMAT "%5.2" /end CHARACTERISTIC
/begin CHARACTERISTIC K_TAN_OBD_CFG "Plausibilisierung Ansauglufttemperatur | EN: Plausibilisierung Ansauglufttemperatur" VALUE 0x7955A TKW_VV_VV_UB 100.0 FORMULA_0994 0.0 255.0 /end CHARACTERISTIC
/begin CHARACTERISTIC K_TAN_MODELL_ALLOW_NO_TUMG "Fehler Umgebungstemperatur zulassen | EN: Fehler Umgebungstemperatur zulassen" VALUE 0x7955B TKW_VV_VV_UB 100.0 FORMULA_0995 0.0 255.0 /end CHARACTERISTIC
/begin CHARACTERISTIC K_TAN_OBD_ALWAYS "Bedingungen ignorieren" VALUE 0x7955C TKW_VV_VV_UB 100.0 FORMULA_0996 0.0 255.0 /end CHARACTERISTIC
/begin CHARACTERISTIC K_TAN_OBD_DELTA_MAX "Maximale Temperaturdifferenz der beiden HFM | EN: Maximale Temperaturdifferenz der beiden HFM" VALUE 0x7955E TKW_VV_VV_SW 100.0 FORMULA_0076 -1000.0000 1000.0000 FORMAT "%4.1" /end CHARACTERISTIC
/begin CHARACTERISTIC K_TAN_OBD_T_DELTA "Zeitfenster f�r Temperaturabweichung | EN: Zeitfenster fï¿½r Temperaturabweichung" VALUE 0x79560 TKW_VV_VV_UW 100.0 FORMULA_0993 0.0 6553.5000 FORMAT "%5.2" /end CHARACTERISTIC
/begin CHARACTERISTIC K_TAN_OBD_V_T_MIN "Zeitfenster f�r Mindestgeschwindigkeit | EN: Zeitfenster fï¿½r Mindestgeschwindigkeit" VALUE 0x79562 TKW_VV_VV_UW 100.0 FORMULA_0993 0.0 6553.5000 FORMAT "%5.2" /end CHARACTERISTIC
/begin CHARACTERISTIC K_TAN_OBD_DYN_DELAY "Zeitfenster f�r Delay nach Dynamik" VALUE 0x79564 TKW_VV_VV_UW 100.0 FORMULA_0993 0.0 6553.5000 FORMAT "%5.2" /end CHARACTERISTIC
/begin CHARACTERISTIC K_TAN_OBD_V_MIN "Mindestgeschwindigkeit" VALUE 0x79566 TKW_VV_VV_SW 100.0 FORMULA_0078 -80.0000 360.0000 FORMAT "%4.1" /end CHARACTERISTIC
/begin CHARACTERISTIC K_TAN_OBD_N_MIN "Mindestdrehzahl | EN: Minimum engine speed [Upm]" VALUE 0x79568 TKW_VV_VV_SW 100.0 FORMULA_0006 0.0 10000.0000 /end CHARACTERISTIC
/begin CHARACTERISTIC K_TAN_OBD_N_MAX "Mindestdrehzahl | EN: Minimum engine speed [Upm]" VALUE 0x7956A TKW_VV_VV_SW 100.0 FORMULA_0006 0.0 10000.0000 /end CHARACTERISTIC
/begin CHARACTERISTIC K_TAN_OBD_N_DYN_MAX "Maximale Drehzahldynamik | EN: Maximum engine-speed dynamics [Upm/s]" VALUE 0x7956C TKW_VV_VV_SW 100.0 FORMULA_0114 -10000.0000 10000.0000 /end CHARACTERISTIC
/begin CHARACTERISTIC K_TAN_OBD_TMOT_MIN "Untergrenze Motortemperatur | EN: Lower limit, engine temperature [°C]" VALUE 0x7956E TKW_VV_VV_SW 100.0 FORMULA_0023 -50.0000 170.0000 FORMAT "%4.1" /end CHARACTERISTIC
/begin CHARACTERISTIC K_TAN_OBD_RF_MIN "Untergrenze relative F�llung | EN: Lower limit, relative charge" VALUE 0x79570 TKW_VV_VV_SW 100.0 FORMULA_0007 0.0 2.0000 FORMAT "%6.3" /end CHARACTERISTIC
/begin CHARACTERISTIC K_TAN_OBD_RF_MAX "Obergrenze relative F�llung | EN: Upper limit, relative charge" VALUE 0x79572 TKW_VV_VV_SW 100.0 FORMULA_0007 0.0 2.0000 FORMAT "%6.3" /end CHARACTERISTIC
/begin CHARACTERISTIC K_TAN_OBD_RF_DYN_MAX "Maximale Dynamik relative F�llung | EN: Maximum dynamics of relative charge" VALUE 0x79574 TKW_VV_VV_SW 100.0 FORMULA_0007 0.0 2.0000 FORMAT "%6.3" /end CHARACTERISTIC
/begin CHARACTERISTIC KL_TAN_NTC "Kennlinie Ansauglufttemperatur | EN: Intake air temperature curve" CURVE 0x79576 TKL_SW_VV_SW 100.0 FORMULA_0987 -50.0000 170.0000 /begin AXIS_DESCR STD_AXIS tan_ad FORMULA_0123 8 0.0 1023.0000 /end AXIS_DESCR FORMAT "%6.3" /end CHARACTERISTIC
/begin CHARACTERISTIC KL_TAN_MODELL_ML_TAU "Kennlinie Ansaugluftmasse zu tau" CURVE 0x79598 TKL_SW_VV_UW 100.0 FORMULA_0988 0.1000 6553.5000 /begin AXIS_DESCR STD_AXIS FORMULA_0112 6 -100.0000 1400.0000 FORMAT "%4.1" /end AXIS_DESCR FORMAT "%5.2" /end CHARACTERISTIC
/begin CHARACTERISTIC KL_TAN_MODELL_ML_RATIO "Kennlinie Ansaugluftmasse zu tau | EN: Curve: intake air mass to time constant" CURVE 0x795B2 TKL_SW_VV_UW 100.0 FORMULA_0295 0.0 2.0000 /begin AXIS_DESCR STD_AXIS FORMULA_0112 6 -100.0000 1400.0000 FORMAT "%4.1" /end AXIS_DESCR FORMAT "%7.4" /end CHARACTERISTIC
/begin CHARACTERISTIC KL_TAN_MODELL_ABREG "Kennlinie Temperaturabregung/Zeit | EN: Curve: temperature ramp-down over time" CURVE 0x795CC TKL_UW_VV_UW 100.0 FORMULA_0295 0.0 2.0000 /begin AXIS_DESCR STD_AXIS FORMULA_0986 6 0.0 1092.2500 FORMAT "%5.2" /end AXIS_DESCR FORMAT "%7.4" /end CHARACTERISTIC
/begin CHARACTERISTIC KL_TAN_MODELL_MR_ABREG "Kennlinie Temperaturabregung/Zeit | EN: Curve: temperature ramp-down over time" CURVE 0x795E6 TKL_UW_VV_UW 100.0 FORMULA_0295 0.0 2.0000 /begin AXIS_DESCR STD_AXIS FORMULA_0986 6 0.0 1092.2500 FORMAT "%5.2" /end AXIS_DESCR FORMAT "%7.4" /end CHARACTERISTIC
/begin CHARACTERISTIC KL_TAN_MODELL_MR_TUMG_KAL "Kalibrierung Motorraumtemp mit TUMG | EN: Engine-bay temperature calibration against ambient temperature" CURVE 0x79600 TKL_SW_VV_SW 100.0 FORMULA_0076 -1000.0000 1000.0000 /begin AXIS_DESCR STD_AXIS FORMULA_0023 6 -50.0000 170.0000 FORMAT "%4.1" /end AXIS_DESCR FORMAT "%4.1" /end CHARACTERISTIC
/begin CHARACTERISTIC K_TAN_MIN_E2 "min. Ansauglufttemperatur" VALUE 0x7A9B0 TKW_VV_VV_SW 100.0 FORMULA_0023 -50.0000 170.0000 FORMAT "%4.1" /end CHARACTERISTIC
/begin CHARACTERISTIC K_TAN_MAX_E2 "max. Ansauglufttemperatur" VALUE 0x7A9B2 TKW_VV_VV_SW 100.0 FORMULA_0023 -50.0000 170.0000 FORMAT "%4.1" /end CHARACTERISTIC
/begin CHARACTERISTIC K_TAN_MAX_NEG_GRAD_E2 "Gradientenschwelle Ebene 2" VALUE 0x7A9B4 TKW_VV_VV_SW 100.0 FORMULA_0997 -32768.0000 0.0 /end CHARACTERISTIC
/begin CHARACTERISTIC K_TAN_MAX_POS_GRAD_E2 "Gradientenschwelle Ebene 2" VALUE 0x7A9B6 TKW_VV_VV_SW 100.0 FORMULA_0997 0.0 32767.0000 /end CHARACTERISTIC
/* ------------------ Abschnitt erzeugt aus ub.dat ------------------ */
/begin CHARACTERISTIC K_UB_TAU "Filterkonstante Bordspannungserfassung | EN: Filter constant, battery-voltage sensing" VALUE 0x7A2F4 TKW_VV_VV_UB 100.0 FORMULA_0478 0.0051 1.2800 /end CHARACTERISTIC
/begin CHARACTERISTIC K_UB_TAU_START "Filterkonstante Bordspannungserfassung beim Start | EN: Filter constant, battery-voltage sensing during start" VALUE 0x7A2F5 TKW_VV_VV_UB 100.0 FORMULA_0478 0.0051 1.2800 /end CHARACTERISTIC
/begin CHARACTERISTIC K_UB_DIAG_MIN "Untere Grenze Bordspannung | EN: Lower limit, battery voltage" VALUE 0x7A2F6 TKW_VV_VV_SW 100.0 FORMULA_0277 0.0 28.0000 FORMAT "%6.3" /end CHARACTERISTIC
/begin CHARACTERISTIC K_UB_DIAG_MAX "Obere Grenze Bordspannung | EN: Upper limit, battery voltage" VALUE 0x7A2F8 TKW_VV_VV_SW 100.0 FORMULA_0277 0.0 28.0000 FORMAT "%6.3" /end CHARACTERISTIC
/begin CHARACTERISTIC K_UB_ML_MIN "Untere Grenze Bordspannung bei laufendem Motor | EN: Lower limit, battery voltage with engine running" VALUE 0x7A2FA TKW_VV_VV_SW 100.0 FORMULA_0277 0.0 28.0000 FORMAT "%6.3" /end CHARACTERISTIC
/begin CHARACTERISTIC K_UB_ERSATZ "Ersatzwert Bordspannung | EN: Substitute value, battery voltage" VALUE 0x7A2FC TKW_VV_VV_SW 100.0 FORMULA_0277 0.0 28.0000 FORMAT "%6.3" /end CHARACTERISTIC
/begin CHARACTERISTIC K_UB_GRAD_MAX "Endanschlag des Integrals | EN: End stop of the integral" VALUE 0x7A2FE TKW_VV_VV_SW 100.0 FORMULA_0277 0.0 50.0000 FORMAT "%6.3" /end CHARACTERISTIC
/begin CHARACTERISTIC K_UB_DIAG_GRAD_INT_MAX "Diagnoseschwelle Integreal | EN: Integral diagnosis threshold" VALUE 0x7A300 TKW_VV_VV_SW 100.0 FORMULA_0277 0.0 50.0000 FORMAT "%6.3" /end CHARACTERISTIC
/begin CHARACTERISTIC K_UB_GRAD_INT_REDUKTION "Integralreduktion pro Druchlauf | EN: Integral reduction per pass" VALUE 0x7A302 TKW_VV_VV_SW 100.0 FORMULA_1044 0.0 50.0000 FORMAT "%6.3" /end CHARACTERISTIC
/begin CHARACTERISTIC K_UB_START_TIME "Ansprechzeit der Plausibilitaet | EN: Plausibility response time" VALUE 0x7A304 TKW_VV_VV_UB 100.0 FORMULA_0232 0.0 255.0000 /end CHARACTERISTIC
/begin CHARACTERISTIC K_UB_DIAG_KL87_MAX_SPERRE "Max. Sperrzeit der Diagnose nach KL87 aus | EN: Maximum diagnosis lock time after terminal 87 off" VALUE 0x7A305 TKW_VV_VV_UB 100.0 FORMULA_0590 5.0000 1275.0000 /end CHARACTERISTIC
/* ------------------ Abschnitt erzeugt aus zust_ign.dat ------------------ */
/begin FUNCTION Abgastemperatur ""
 /begin DEF_CHARACTERISTIC KF_TABG_LW_STAT KL_TABG_DIAG_PLAUSI_ML_FAK KL_TABG_KAT_EXO_MAX KL_TABG_KAT_STAND_F KL_TABG_LW_F_ETA_ZW KL_TABG_LW_F_LAM KL_TABG_LW_F_RG KL_TABG_LW_STAND_F KL_TABG_LW_TAU KL_TABG_LW_VERH_WURZEL KL_TABG_PT200 KL_TABG_VKAT_F_REAK KL_TABG_VKAT_K_TMOT KL_TABG_VKAT_MC_F_TMOT KL_TABG_VKAT_STAND_F K_TABG_C K_TABG_DIAG_MAX K_TABG_DIAG_MIN K_TABG_DIAG_PLAUSI_AKTIV_T_ML K_TABG_DIAG_PLAUSI_DELTA_NEG K_TABG_DIAG_PLAUSI_DELTA_POS K_TABG_DIAG_TIME K_TABG_KAT_EXO_HYS K_TABG_KAT_EXO_MS_SCHWELLE K_TABG_KAT_EXO_ON K_TABG_KAT_MC K_TABG_KAT_OBD_GRAD_MAX K_TABG_KAT_OBD_GRAD_TAU K_TABG_KAT_T_OFFS_AB K_TABG_KAT_T_OFFS_AUF K_TABG_LW_AUSBLEND_OFFS K_TABG_NKAT_A K_TABG_NKAT_CFG K_TABG_NKAT_K_TUMG K_TABG_NKAT_K_V K_TABG_NKAT_MAX_CFG K_TABG_NKAT_MC K_TABG_PST_V K_TABG_STAND_MAX K_TABG_TAU K_TABG_VKAT_A K_TABG_VKAT_K_V K_TABG_VKAT_MC K_TABG_VKAT_REAK_SCHWELLE /end DEF_CHARACTERISTIC
 /begin REF_CHARACTERISTIC /end REF_CHARACTERISTIC
 /begin IN_MEASUREMENT /end IN_MEASUREMENT
 /begin OUT_MEASUREMENT /end OUT_MEASUREMENT
/end FUNCTION
/begin FUNCTION AdaptCommon "" /begin DEF_CHARACTERISTIC /end DEF_CHARACTERISTIC /begin REF_CHARACTERISTIC /end REF_CHARACTERISTIC /begin IN_MEASUREMENT /end IN_MEASUREMENT /begin OUT_MEASUREMENT /end OUT_MEASUREMENT /end FUNCTION
/begin FUNCTION Adaptiondaten_glob "" /begin DEF_CHARACTERISTIC /end DEF_CHARACTERISTIC /begin REF_CHARACTERISTIC /end REF_CHARACTERISTIC /begin IN_MEASUREMENT /end IN_MEASUREMENT /begin OUT_MEASUREMENT /end OUT_MEASUREMENT /end FUNCTION
/begin FUNCTION Adaptionswerte "" /begin DEF_CHARACTERISTIC /end DEF_CHARACTERISTIC /begin REF_CHARACTERISTIC /end REF_CHARACTERISTIC /begin IN_MEASUREMENT /end IN_MEASUREMENT /begin OUT_MEASUREMENT /end OUT_MEASUREMENT /end FUNCTION
/begin FUNCTION Ansauglufttemperatur ""
 /begin DEF_CHARACTERISTIC KL_TAN_MODELL_ABREG KL_TAN_MODELL_ML_RATIO KL_TAN_MODELL_ML_TAU KL_TAN_MODELL_MR_ABREG KL_TAN_MODELL_MR_TUMG_KAL KL_TAN_NTC K_TAN_DIAG_MAX K_TAN_DIAG_MIN K_TAN_ERSATZ K_TAN_MAX_E2 K_TAN_MAX_NEG_GRAD_E2 K_TAN_MAX_POS_GRAD_E2 K_TAN_MIN_E2 K_TAN_MODELL_ALLOW_NO_TUMG K_TAN_MODELL_MR_TAU K_TAN_MW_ABGR_NEG K_TAN_MW_ABGR_POS K_TAN_OBD_ALWAYS K_TAN_OBD_CFG K_TAN_OBD_DELTA_MAX K_TAN_OBD_DYN_DELAY K_TAN_OBD_N_DYN_MAX K_TAN_OBD_N_DYN_TAU K_TAN_OBD_N_MAX K_TAN_OBD_N_MIN K_TAN_OBD_RF_DYN_MAX K_TAN_OBD_RF_MAX K_TAN_OBD_RF_MIN K_TAN_OBD_TMOT_MIN K_TAN_OBD_T_DELTA K_TAN_OBD_V_MIN K_TAN_OBD_V_T_MIN K_TAN_TAU /end DEF_CHARACTERISTIC
 /begin REF_CHARACTERISTIC /end REF_CHARACTERISTIC
 /begin IN_MEASUREMENT /end IN_MEASUREMENT
 /begin OUT_MEASUREMENT /end OUT_MEASUREMENT
/end FUNCTION
/begin FUNCTION Anti-Trampeln ""
 /begin DEF_CHARACTERISTIC KF_AT_MD_BEGR_KR KF_AT_MD_BEGR_TN KF_AT_MD_BEGR_TV KL_AT_MD_BEGR_KR_FAK KL_AT_MD_BEGR_TN_FAK KL_AT_MD_BEGR_TV_FAK KL_AT_MD_KUPP_MIN KL_AT_N_FAK KL_AT_SCHLUPF_FAK KL_AT_TRAMPIN_SCHUB KL_AT_V_GRAD_FAK KL_AT_V_GRAD_INT_FAK KL_AT_V_TP_A2 KL_AT_V_TP_A3 KL_AT_V_TP_B1 KL_AT_V_TP_B2 KL_AT_V_TP_B3 K_AT_CFG K_AT_FG_TP_N K_AT_FG_TP_TRAMPIN K_AT_FG_TP_V K_AT_FG_TP_V_GRAD K_AT_MD_BEGR_A1 K_AT_MD_GRAD_TAU_NEG K_AT_MD_GRAD_TAU_POS K_AT_N_MAX K_AT_N_MIN K_AT_SK_MAX K_AT_TRAMPIN_SOLL_SCHUB K_AT_TRAMPIN_SOLL_START K_AT_TRAMPIN_SOLL_STOP K_AT_V_GRAD_DOWN_TAU K_AT_V_GRAD_INT_TAU K_AT_V_GRAD_INT_TGL K_AT_V_GRAD_UP_TAU /end DEF_CHARACTERISTIC
 /begin REF_CHARACTERISTIC /end REF_CHARACTERISTIC
 /begin IN_MEASUREMENT /end IN_MEASUREMENT
 /begin OUT_MEASUREMENT /end OUT_MEASUREMENT
/end FUNCTION
/begin FUNCTION Antiruckelregelung ""
 /begin DEF_CHARACTERISTIC KF_AR_MD_FAKTOR K_AR_CFG K_AR_FAK_KOMFORT K_AR_FAK_SPORT K_AR_KORR_P_1 K_AR_KORR_P_2 K_AR_KORR_P_3 K_AR_KORR_P_4 K_AR_KORR_P_5 K_AR_KORR_P_6 K_AR_KORR_P_7 K_AR_KORR_P_N K_AR_KORR_P_R K_AR_MD_MAX K_AR_MD_MIN K_AR_N_DIF_BESCHL_1 K_AR_N_DIF_BESCHL_2 K_AR_N_DIF_REF_MAX K_AR_N_DIF_REF_MIN K_AR_N_DIF_VERZ_1 K_AR_N_DIF_VERZ_2 K_AR_N_FIL_0 K_AR_N_FIL_1 K_AR_N_FIL_2 K_AR_N_FIL_3 K_AR_N_FIL_4 K_AR_N_MAX K_AR_N_MIN K_AR_T_MAX K_AR_T_PAS_DELAY /end DEF_CHARACTERISTIC
 /begin REF_CHARACTERISTIC /end REF_CHARACTERISTIC
 /begin IN_MEASUREMENT /end IN_MEASUREMENT
 /begin OUT_MEASUREMENT /end OUT_MEASUREMENT
/end FUNCTION
/begin FUNCTION Aussetzererkennung ""
 /begin DEF_CHARACTERISTIC KF_AUSS_LP_INT_MIN KF_AUSS_OBD_DTZ_MAX KF_AUSS_OBD_WICHT_KAT KF_AUSS_SPARK_TIME_MAX KF_AUSS_SPARK_TIME_MIN KF_AUSS_TZ_OFFS KL_AUSS_INT_DTZ_FAKTOR KL_AUSS_INT_TMOT_FAKTOR KL_AUSS_MIN_AVG_SAMPLES KL_AUSS_OBD_NEG_MD_DYN KL_AUSS_OBD_NEG_MD_DYN_KH KL_AUSS_OBD_POS_MD_DYN KL_AUSS_OBD_POS_MD_DYN_KH KL_AUSS_OBD_RF_MIN KL_AUSS_OBD_TZ_GRAD KL_AUSS_OBD_WICHT_KAT KL_AUSS_PUMG_FAKTOR KL_AUSS_START_FAKTOR K_AG_TZ_ANZ K_AG_TZ_CFG K_AG_TZ_PAUSE K_AG_TZ_V_MIN K_AG_TZ_ZYL K_AUSS_ASP_SA_CNT K_AUSS_ED_LP_INT_MIN K_AUSS_ED_WICHT_SPARK K_AUSS_FETRAWE_N K_AUSS_FETRAWE_RF K_AUSS_FETRAWE_TIME_ML K_AUSS_INT_START_FAKTOR_KOR K_AUSS_LP_COEF_10of40_ K_AUSS_LP_COEF_11of40_ K_AUSS_LP_COEF_12of40_ K_AUSS_LP_COEF_13of40_ K_AUSS_LP_COEF_14of40_ K_AUSS_LP_COEF_15of40_ K_AUSS_LP_COEF_16of40_ K_AUSS_LP_COEF_17of40_ K_AUSS_LP_COEF_18of40_ K_AUSS_LP_COEF_19of40_ K_AUSS_LP_COEF_1of40_ K_AUSS_LP_COEF_20of40_ K_AUSS_LP_COEF_21of40_ K_AUSS_LP_COEF_22of40_ K_AUSS_LP_COEF_23of40_ K_AUSS_LP_COEF_24of40_ K_AUSS_LP_COEF_25of40_ K_AUSS_LP_COEF_26of40_ K_AUSS_LP_COEF_27of40_ K_AUSS_LP_COEF_28of40_ K_AUSS_LP_COEF_29of40_ K_AUSS_LP_COEF_2of40_ K_AUSS_LP_COEF_30of40_ K_AUSS_LP_COEF_31of40_ K_AUSS_LP_COEF_32of40_ K_AUSS_LP_COEF_33of40_ K_AUSS_LP_COEF_34of40_ K_AUSS_LP_COEF_35of40_ K_AUSS_LP_COEF_36of40_ K_AUSS_LP_COEF_37of40_ K_AUSS_LP_COEF_38of40_ K_AUSS_LP_COEF_39of40_ K_AUSS_LP_COEF_3of40_ K_AUSS_LP_COEF_40of40_ K_AUSS_LP_COEF_4of40_ K_AUSS_LP_COEF_5of40_ K_AUSS_LP_COEF_6of40_ K_AUSS_LP_COEF_7of40_ K_AUSS_LP_COEF_8of40_ K_AUSS_LP_COEF_9of40_ K_AUSS_LP_MAX_OFFSET K_AUSS_LP_MIN_BEGR K_AUSS_LP_MIN_NV_TREPP K_AUSS_LP_MIN_SA_MAX_INI K_AUSS_LP_NV_OFFSET K_AUSS_MAX_OFFSET_CFG K_AUSS_MIN_LAM K_AUSS_NS_MAX_ASP K_AUSS_NS_TIME_MAX_IC_0 K_AUSS_NS_TIME_MAX_IC_1 K_AUSS_NS_TIME_MAX_IC_2 K_AUSS_NS_TIME_MAX_IC_3 K_AUSS_NS_TIME_MAX_IC_4 K_AUSS_NS_TIME_MAX_IC_5 K_AUSS_NS_TIME_MAX_IC_6 K_AUSS_NS_TIME_MAX_IC_7 K_AUSS_NS_TIME_MAX_IC_8 K_AUSS_NS_TIME_MAX_IC_9 K_AUSS_NS_TIME_MAX_SAT_0 K_AUSS_NS_TIME_MAX_SAT_1 K_AUSS_NS_TIME_MAX_SAT_2 K_AUSS_NS_TIME_MAX_SAT_3 K_AUSS_OBD_ABG_1 K_AUSS_OBD_ABG_4 K_AUSS_OBD_ABG_WORST_CYL K_AUSS_OBD_CFG K_AUSS_OBD_N_MAX K_AUSS_OBD_N_MIN K_AUSS_OBD_RATE_ABG_ZYL K_AUSS_OBD_SA_CNT K_AUSS_OBD_SA_T_MIN K_AUSS_OBD_SUM_KAT K_AUSS_OBD_T_IDLE K_AUSS_OBD_T_MIN_LAM K_AUSS_OBD_WICHT_EV K_AUSS_OBD_WICHT_NS K_AUSS_OBD_WICHT_SPARK K_AUSS_RF_TAU K_AUSS_SPARK_LEV K_AUSS_SPARK_SIZE K_AUSS_SPARK_TIME_MIN K_AUSS_SPARK_TIME_TAU K_AUSS_TMOT_LU /end DEF_CHARACTERISTIC
 /begin REF_CHARACTERISTIC /end REF_CHARACTERISTIC
 /begin IN_MEASUREMENT /end IN_MEASUREMENT
 /begin OUT_MEASUREMENT /end OUT_MEASUREMENT
/end FUNCTION
/begin FUNCTION Beschleunigung ""
 /begin DEF_CHARACTERISTIC K_AFZ_A0 K_AFZ_A0_CNT_MAX K_AFZ_A0_MAX K_AFZ_A0_MIN K_AFZ_BERG_TAU K_AFZ_CAN_BRP_MAX K_AFZ_DIAG_AX K_AFZ_DIAG_MAX K_AFZ_DIAG_MIN K_AFZ_DIAG_T K_AFZ_F_KONV_NENNER K_AFZ_F_KONV_ZAEHLER K_AFZ_MD_KUPP_WUNSCH_GES_MAX K_AFZ_NA0_CNT2_MAX K_AFZ_NA0_FAK K_AFZ_TAU K_AFZ_V_DIREKT_WEG /end DEF_CHARACTERISTIC
 /begin REF_CHARACTERISTIC /end REF_CHARACTERISTIC
 /begin IN_MEASUREMENT /end IN_MEASUREMENT
 /begin OUT_MEASUREMENT /end OUT_MEASUREMENT
/end FUNCTION
/begin FUNCTION Betriebssystem "" /begin DEF_CHARACTERISTIC /end DEF_CHARACTERISTIC /begin REF_CHARACTERISTIC /end REF_CHARACTERISTIC /begin IN_MEASUREMENT /end IN_MEASUREMENT /begin OUT_MEASUREMENT /end OUT_MEASUREMENT /end FUNCTION
/begin FUNCTION Bordspannung ""
 /begin DEF_CHARACTERISTIC K_UB_DIAG_GRAD_INT_MAX K_UB_DIAG_KL87_MAX_SPERRE K_UB_DIAG_MAX K_UB_DIAG_MIN K_UB_ERSATZ K_UB_GRAD_INT_REDUKTION K_UB_GRAD_MAX K_UB_ML_MIN K_UB_START_TIME K_UB_TAU K_UB_TAU_START /end DEF_CHARACTERISTIC
 /begin REF_CHARACTERISTIC /end REF_CHARACTERISTIC
 /begin IN_MEASUREMENT /end IN_MEASUREMENT
 /begin OUT_MEASUREMENT /end OUT_MEASUREMENT
/end FUNCTION
/begin FUNCTION Checksumme "" /begin DEF_CHARACTERISTIC /end DEF_CHARACTERISTIC /begin REF_CHARACTERISTIC /end REF_CHARACTERISTIC /begin IN_MEASUREMENT /end IN_MEASUREMENT /begin OUT_MEASUREMENT /end OUT_MEASUREMENT /end FUNCTION
/begin FUNCTION DSP "" /begin DEF_CHARACTERISTIC K_DSP_MESSEN /end DEF_CHARACTERISTIC /begin REF_CHARACTERISTIC /end REF_CHARACTERISTIC /begin IN_MEASUREMENT /end IN_MEASUREMENT /begin OUT_MEASUREMENT /end OUT_MEASUREMENT /end FUNCTION
/begin FUNCTION Debugging ""
 /begin DEF_CHARACTERISTIC K_DEBUG_READ_ADR K_DEBUG_RW_LENGTH K_DEBUG_WRITE_ADR K_DEBUG_WRITE_VALUE /end DEF_CHARACTERISTIC
 /begin REF_CHARACTERISTIC /end REF_CHARACTERISTIC
 /begin IN_MEASUREMENT /end IN_MEASUREMENT
 /begin OUT_MEASUREMENT /end OUT_MEASUREMENT
/end FUNCTION
/begin FUNCTION Diag_tr "" /begin DEF_CHARACTERISTIC K_DIAG_TR_UB_MIN /end DEF_CHARACTERISTIC /begin REF_CHARACTERISTIC /end REF_CHARACTERISTIC /begin IN_MEASUREMENT /end IN_MEASUREMENT /begin OUT_MEASUREMENT /end OUT_MEASUREMENT /end FUNCTION
/begin FUNCTION Drehzahl-Ebene_2 "" /begin DEF_CHARACTERISTIC K_N_E2_DELTA K_N_E2_T_MAX /end DEF_CHARACTERISTIC /begin REF_CHARACTERISTIC /end REF_CHARACTERISTIC /begin IN_MEASUREMENT /end IN_MEASUREMENT /begin OUT_MEASUREMENT /end OUT_MEASUREMENT /end FUNCTION
/begin FUNCTION Drehzahlerfassung "" /begin DEF_CHARACTERISTIC K_N_MIN_FREEZE K_N_OBERGRENZE K_N_ZEIT_STOERUNG /end DEF_CHARACTERISTIC /begin REF_CHARACTERISTIC /end REF_CHARACTERISTIC /begin IN_MEASUREMENT /end IN_MEASUREMENT /begin OUT_MEASUREMENT /end OUT_MEASUREMENT /end FUNCTION
/begin FUNCTION EEPROM "" /begin DEF_CHARACTERISTIC /end DEF_CHARACTERISTIC /begin REF_CHARACTERISTIC /end REF_CHARACTERISTIC /begin IN_MEASUREMENT /end IN_MEASUREMENT /begin OUT_MEASUREMENT /end OUT_MEASUREMENT /end FUNCTION
/begin FUNCTION Egas ""
 /begin DEF_CHARACTERISTIC KF_EGAS_N_AQ_KH_NEG KF_EGAS_N_AQ_KH_POS KF_EGAS_N_AQ_ML_NEG KF_EGAS_N_AQ_ML_POS KF_EGAS_SOLL_AQ KF_EGAS_SOLL_AQ_KH KF_EGAS_SOLL_AQ_NOTL KF_EGAS_SOLL_WL_GEW_F KF_EGAS_SOLL_WL_OFFS KL_EGAS_EXD_VORST_DK_AUF KL_EGAS_EXD_VORST_DK_ZU KL_EGAS_EXD_VORST_LLS_AUF KL_EGAS_EXD_VORST_LLS_ZU KL_EGAS_N_AQ_START_NEG KL_EGAS_N_AQ_START_POS KL_EGAS_SK_DK_DIFF_MAX KL_EGAS_SK_WDK_DIFF K_EGAS_AQ_SOLL_GRAD_TAU K_EGAS_CAN_ALIVE_ERR_MAX K_EGAS_CAN_ED_TSPERR K_EGAS_CAN_ED_UB_MIN K_EGAS_CFG_AQ_SOLL K_EGAS_CFG_DK K_EGAS_CFG_LLS K_EGAS_CFG_MCS_SOLL K_EGAS_CFG_WDK K_EGAS_DK_R_DIAG_CLR K_EGAS_DK_R_DIAG_CLR_MAX K_EGAS_DK_R_DIAG_FAIL K_EGAS_EXD_GS_SOLL K_EGAS_EXD_GS_T_MAX K_EGAS_EXD_KS_SOLL K_EGAS_EXD_KS_T_MAX K_EGAS_EXD_R1_SOLL K_EGAS_EXD_R1_SOLL_TV K_EGAS_EXD_R1_TIME K_EGAS_EXD_R2_SOLL K_EGAS_EXD_R2_TIME K_EGAS_EXD_R3_TIME K_EGAS_EXD_SW_SOLL K_EGAS_EXD_UB_MAX K_EGAS_EXD_UB_MIN K_EGAS_FT_ERR_SCHW K_EGAS_LLS_R_DIAG_CLR K_EGAS_LLS_R_DIAG_CLR_MAX K_EGAS_LLS_R_DIAG_FAIL K_EGAS_SK_CONTROL K_EGAS_SK_DK_OFFEN_1 K_EGAS_SK_DK_OFFEN_2 K_EGAS_SK_FAIL_MAX K_EGAS_SK_IST_DIFF_LLS K_EGAS_SK_NEUINIT_MAX K_EGAS_SK_RF_IO_DK K_EGAS_SK_RF_IO_FAK K_EGAS_SK_RF_IO_OFF K_EGAS_SK_RF_IO_WDK K_EGAS_SK_RF_TSTART K_EGAS_SK_SOLL_DIFF K_EGAS_SK_SOLL_DIFF_LLS K_EGAS_SK_TAU_DK K_EGAS_SK_TAU_LLS K_EGAS_SK_T_IST K_EGAS_SK_T_IST_LLS K_EGAS_SK_T_MODE K_EGAS_SK_T_MODE_INIT K_EGAS_SK_T_NP_MAX K_EGAS_SK_T_OFFEN K_EGAS_SK_T_RGPOS K_EGAS_SK_T_SOLL K_EGAS_SK_T_SOLL_LLS K_EGAS_SK_T_WDK K_EGAS_SOLL_AQ_KH_N_MAX K_EGAS_SOLL_AQ_TI_OFF K_EGAS_SOLL_BOWDEN_LLS_F K_EGAS_SOLL_BOWDEN_MIN K_EGAS_SOLL_ENTDR_SCHW K_EGAS_SOLL_GT_OFF K_EGAS_SOLL_LLS_DELTA K_EGAS_SOLL_LLS_DK_SCHW K_EGAS_SOLL_LLS_OFF K_EGAS_SOLL_MCS_DK K_EGAS_SOLL_MCS_LLS K_EGAS_SOLL_VL_FAK K_EGAS_STM_DK_FT_TMOT K_EGAS_STM_DK_GT_MAX K_EGAS_STM_DK_GT_MIN K_EGAS_STM_DK_GT_TIME K_EGAS_STM_DK_GT_TMOT K_EGAS_STM_DK_GT_UB K_EGAS_STM_DK_MODE_HW K_EGAS_STM_DK_NP_NMAX K_EGAS_STM_DK_NP_PMAX K_EGAS_STM_DK_NP_PMIN K_EGAS_STM_DK_NP_TMOT K_EGAS_STM_DK_NP_TMOT_MIN K_EGAS_STM_DK_NP_UB K_EGAS_STM_DK_N_FAST K_EGAS_STM_DK_N_KL50 K_EGAS_STM_DK_SK_TST K_EGAS_STM_DK_SK_ZU K_EGAS_STM_DK_WAIT_DIS K_EGAS_STM_LLS_DK_SCHW K_EGAS_STM_LLS_T_ADAPT K_EGAS_STM_NOINIT_FAIL K_EGAS_STM_NOINIT_SK K_EGAS_STM_T_ADAPT K_EGAS_T_KL50 K_EGAS_WDK_A0_ANZAHL K_EGAS_WDK_A0_DELTA_MAX K_EGAS_WDK_A0_DFT K_EGAS_WDK_A0_KONST K_EGAS_WDK_A0_MAX K_EGAS_WDK_A0_MIN K_EGAS_WDK_A0_OFF_B1 K_EGAS_WDK_A0_OFF_B2 K_EGAS_WDK_A0_TIME K_EGAS_WDK_MAX K_EGAS_WDK_MIN K_EGAS_WDK_NORM /end DEF_CHARACTERISTIC
 /begin REF_CHARACTERISTIC /end REF_CHARACTERISTIC
 /begin IN_MEASUREMENT /end IN_MEASUREMENT
 /begin OUT_MEASUREMENT /end OUT_MEASUREMENT
/end FUNCTION
/begin RECORD_LAYOUT TKW_VV_VV_UB FNC_VALUES 1 UBYTE COLUMN_DIR DIRECT /end RECORD_LAYOUT
/begin RECORD_LAYOUT TKW_VV_VV_SB FNC_VALUES 1 SBYTE COLUMN_DIR DIRECT /end RECORD_LAYOUT
/begin RECORD_LAYOUT TKW_VV_VV_UW FNC_VALUES 1 UWORD COLUMN_DIR DIRECT /end RECORD_LAYOUT
/begin RECORD_LAYOUT TKW_VV_VV_SW FNC_VALUES 1 SWORD COLUMN_DIR DIRECT /end RECORD_LAYOUT
/begin RECORD_LAYOUT TKW_VV_VV_UL FNC_VALUES 1 ULONG COLUMN_DIR DIRECT /end RECORD_LAYOUT
/begin RECORD_LAYOUT TKW_VV_VV_SF FNC_VALUES 1 FLOAT32_IEEE COLUMN_DIR DIRECT /end RECORD_LAYOUT
/begin RECORD_LAYOUT TKL_UB_VV_SW NO_AXIS_PTS_X 1 UBYTE RESERVED 2 BYTE AXIS_PTS_X 3 UBYTE INDEX_INCR DIRECT FNC_VALUES 4 SWORD COLUMN_DIR DIRECT /end RECORD_LAYOUT
/begin RECORD_LAYOUT TKL_UW_VV_UW NO_AXIS_PTS_X 1 UBYTE RESERVED 2 BYTE AXIS_PTS_X 3 UWORD INDEX_INCR DIRECT FNC_VALUES 4 UWORD COLUMN_DIR DIRECT /end RECORD_LAYOUT
/begin RECORD_LAYOUT TKL_UW_VV_SW NO_AXIS_PTS_X 1 UBYTE RESERVED 2 BYTE AXIS_PTS_X 3 UWORD INDEX_INCR DIRECT FNC_VALUES 4 SWORD COLUMN_DIR DIRECT /end RECORD_LAYOUT
/begin RECORD_LAYOUT TKL_SW_VV_UB NO_AXIS_PTS_X 1 UBYTE RESERVED 2 BYTE AXIS_PTS_X 3 SWORD INDEX_INCR DIRECT FNC_VALUES 4 UBYTE COLUMN_DIR DIRECT /end RECORD_LAYOUT
/begin RECORD_LAYOUT TKL_SW_VV_UW NO_AXIS_PTS_X 1 UBYTE RESERVED 2 BYTE AXIS_PTS_X 3 SWORD INDEX_INCR DIRECT FNC_VALUES 4 UWORD COLUMN_DIR DIRECT /end RECORD_LAYOUT
/begin RECORD_LAYOUT TKL_SW_VV_SW NO_AXIS_PTS_X 1 UBYTE RESERVED 2 BYTE AXIS_PTS_X 3 SWORD INDEX_INCR DIRECT FNC_VALUES 4 SWORD COLUMN_DIR DIRECT /end RECORD_LAYOUT
/begin RECORD_LAYOUT TKF_SW_SW_UB NO_AXIS_PTS_X 1 UBYTE NO_AXIS_PTS_Y 2 UBYTE AXIS_PTS_X 3 SWORD INDEX_INCR DIRECT AXIS_PTS_Y 4 SWORD INDEX_INCR DIRECT FNC_VALUES 5 UBYTE COLUMN_DIR DIRECT /end RECORD_LAYOUT
/begin RECORD_LAYOUT TKF_SW_SW_UW NO_AXIS_PTS_X 1 UBYTE NO_AXIS_PTS_Y 2 UBYTE AXIS_PTS_X 3 SWORD INDEX_INCR DIRECT AXIS_PTS_Y 4 SWORD INDEX_INCR DIRECT FNC_VALUES 5 UWORD COLUMN_DIR DIRECT /end RECORD_LAYOUT
/begin RECORD_LAYOUT TKF_SW_SW_SW NO_AXIS_PTS_X 1 UBYTE NO_AXIS_PTS_Y 2 UBYTE AXIS_PTS_X 3 SWORD INDEX_INCR DIRECT AXIS_PTS_Y 4 SWORD INDEX_INCR DIRECT FNC_VALUES 5 SWORD COLUMN_DIR DIRECT /end RECORD_LAYOUT
/end MODULE
/end PROJECT
