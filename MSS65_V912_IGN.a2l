/begin PROJECT MSS65-ign-V912 "MSS65 IGN - V912.00-B204.00, data set 0569Q60Z520E"
/begin HEADER "" VERSION "V912.00-B204.00" /end HEADER
/begin MODULE _MSS65-ign "MSS65 IGN - V912.00-B204.00, data 7842800"
/begin MOD_COMMON "" BYTE_ORDER MSB_FIRST /* Default byteorder (Motorola) */ /end MOD_COMMON
/* Formel fuer 1:1-Wiedergabe ohne Einheit */
/begin COMPU_METHOD FORMULA_USER1 "FORMULA_USER1" RAT_FUNC "%7.0" "-" COEFFS 0 1 0 0 0 1 /end COMPU_METHOD
/begin COMPU_METHOD FORMULA_0001 "FORMULA_0001" RAT_FUNC "%6.1" "%" COEFFS 0 10 0 0 0 1 /end COMPU_METHOD
/begin COMPU_METHOD FORMULA_0003 "FORMULA_0003" RAT_FUNC "%3.0" "-" COEFFS 0 1 0 0 0 1 /end COMPU_METHOD
/begin COMPU_METHOD FORMULA_0006 "FORMULA_0006" RAT_FUNC "%5.0" "Upm" COEFFS 0 1 0 0 0 1 /end COMPU_METHOD
/begin COMPU_METHOD FORMULA_0007 "FORMULA_0007" RAT_FUNC "%8.3" "-" COEFFS 0 10000 0 0 0 1 /end COMPU_METHOD
/begin COMPU_METHOD FORMULA_0008 "FORMULA_0008" RAT_FUNC "%6.1" "V" COEFFS 0 10 0 0 0 1 /end COMPU_METHOD
/begin COMPU_METHOD FORMULA_0009 "FORMULA_0009" RAT_FUNC "%6.1" "Nm" COEFFS 0 10 0 0 0 1 /end COMPU_METHOD
/begin COMPU_METHOD FORMULA_0010 "FORMULA_0010" RAT_FUNC "%5.0" "-" COEFFS 0 1 0 0 0 1 /end COMPU_METHOD
/begin COMPU_METHOD FORMULA_0020 "FORMULA_0020" RAT_FUNC "%5.0" "qmm/s" COEFFS 0 1 0 0 0 20 /end COMPU_METHOD
/begin COMPU_METHOD FORMULA_0021 "FORMULA_0021" RAT_FUNC "%7.2" "s" COEFFS 0 100 0 0 0 1 /end COMPU_METHOD
/* ------------------ Abschnitt erzeugt aus adapt_glob.dat ------------------ */
/begin COMPU_METHOD FORMULA_0023 "FORMULA_0023" RAT_FUNC "%6.1" "�C" COEFFS 0 10 2732 0 0 1 /end COMPU_METHOD
/begin COMPU_METHOD FORMULA_0024 "FORMULA_0024" RAT_FUNC "%9.4" "-" COEFFS 0 32768 0 0 0 1 /end COMPU_METHOD
/begin COMPU_METHOD FORMULA_0025 "FORMULA_0025" RAT_FUNC "%8.3" "-" COEFFS 0 16384 0 0 0 1 /end COMPU_METHOD
/begin COMPU_METHOD FORMULA_0062 "FORMULA_0062" RAT_FUNC "%5.0" "s" COEFFS 0 1 0 0 0 1 /end COMPU_METHOD
/begin COMPU_METHOD FORMULA_0073 "FORMULA_0073" RAT_FUNC "%6.1" "s" COEFFS 0 10 0 0 0 1 /end COMPU_METHOD
/begin COMPU_METHOD FORMULA_0075 "FORMULA_0075" RAT_FUNC "%8.3" "-" COEFFS 0 1024 0 0 0 1 /end COMPU_METHOD
/begin COMPU_METHOD FORMULA_0076 "FORMULA_0076" RAT_FUNC "%6.1" "Kelvin" COEFFS 0 10 0 0 0 1 /end COMPU_METHOD
/begin COMPU_METHOD FORMULA_0077 "FORMULA_0077" RAT_FUNC "%6.1" "mbar" COEFFS 0 16 0 0 0 1 /end COMPU_METHOD
/begin COMPU_METHOD FORMULA_0078 "FORMULA_0078" RAT_FUNC "%6.1" "km/h" COEFFS 0 16 0 0 0 1 /end COMPU_METHOD
/* ------------------ Abschnitt erzeugt aus glob.dat ------------------ */
/begin COMPU_METHOD FORMULA_0083 "FORMULA_0083" RAT_FUNC "%7.2" "-" COEFFS 0 1 0 0 0 1 /end COMPU_METHOD
/begin COMPU_METHOD FORMULA_0111 "FORMULA_0111" RAT_FUNC "%6.1" "�KW" COEFFS 0 10 0 0 0 1 /end COMPU_METHOD
/begin COMPU_METHOD FORMULA_0112 "FORMULA_0112" RAT_FUNC "%6.1" "kg/h" COEFFS 0 10 0 0 0 1 /end COMPU_METHOD
/begin COMPU_METHOD FORMULA_0115 "FORMULA_0115" RAT_FUNC "%7.2" "%" COEFFS 0 16384 0 0 0 100 /end COMPU_METHOD
/begin COMPU_METHOD FORMULA_0117 "FORMULA_0117" RAT_FUNC "%7.2" "s" COEFFS 0 200 0 0 0 1 /end COMPU_METHOD
/begin COMPU_METHOD FORMULA_0123 "FORMULA_0123" RAT_FUNC "%5.0" "digit" COEFFS 0 1 0 0 0 1 /end COMPU_METHOD
/begin COMPU_METHOD FORMULA_0132 "FORMULA_0132" RAT_FUNC "%7.2" "m/(s*s)" COEFFS 0 40 0 0 0 1 /end COMPU_METHOD
/begin COMPU_METHOD FORMULA_0140 "FORMULA_0140" RAT_FUNC "%5.0" "bar/s" COEFFS 0 1 0 0 0 50 /end COMPU_METHOD
/begin COMPU_METHOD FORMULA_0146 "FORMULA_0146" RAT_FUNC "%6.1" "%" COEFFS 0 1667 0 0 0 100 /end COMPU_METHOD
/begin COMPU_METHOD FORMULA_0147 "FORMULA_0147" RAT_FUNC "%6.1" "qmm" COEFFS 0 10 0 0 0 1 /end COMPU_METHOD
/begin COMPU_METHOD FORMULA_0152 "FORMULA_0152" RAT_FUNC "%9.2" "s" COEFFS 0 100 0 0 0 1 /end COMPU_METHOD
/begin COMPU_METHOD FORMULA_0276 "FORMULA_0276" RAT_FUNC "%5.0" "%/s" COEFFS 0 1 0 0 0 20 /end COMPU_METHOD
/begin COMPU_METHOD FORMULA_0290 "FORMULA_0290" RAT_FUNC "%7.2" "Nms2" COEFFS 0 512 0 0 0 1 /end COMPU_METHOD
/* ------------------ Abschnitt erzeugt aus pctrl.dat ------------------ */
/begin COMPU_METHOD FORMULA_0352 "FORMULA_0352" RAT_FUNC "%5.2" "s" COEFFS 0 200 0 0 0 1 /end COMPU_METHOD
/begin COMPU_METHOD FORMULA_0413 "FORMULA_0413" RAT_FUNC "%5.0" "Upm" COEFFS 0 0 27344 0 1 0 /end COMPU_METHOD
/* ------------------ Abschnitt erzeugt aus version.dat ------------------ */
/begin COMPU_METHOD FORMULA_0414 "FORMULA_0414" TAB_VERB "%3.0" "-" COMPU_TAB_REF FORMULA_0414_VTAB /end COMPU_METHOD
/begin COMPU_VTAB FORMULA_0414_VTAB "FORMULA_0414_VTAB" TAB_VERB 63 45 "-" 48 "0" 49 "1" 50 "2" 51 "3" 52 "4" 53 "5" 54 "6" 55 "7" 56 "8" 57 "9" 65 "A" 66 "B" 67 "C" 68 "D" 69 "E" 70 "F" 71 "G" 72 "H" 73 "I" 74 "J" 75 "K" 76 "L" 77 "M" 78 "N" 79 "O" 80 "P" 81 "Q" 82 "R" 83 "S" 84 "T" 85 "U" 86 "V" 87 "W" 88 "X" 89 "Y" 90 "Z" 97 "a" 98 "b" 99 "c" 100 "d" 101 "e" 102 "f" 103 "g" 104 "h" 105 "i" 106 "j" 107 "k" 108 "l" 109 "m" 110 "n" 111 "o" 112 "p" 113 "q" 114 "r" 115 "s" 116 "t" 117 "u" 118 "v" 119 "w" 120 "x" 121 "y" 122 "z" DEFAULT_VALUE "DEZ" /end COMPU_VTAB
/begin COMPU_METHOD FORMULA_0415 "FORMULA_0415" TAB_VERB "%5.2" "-" COMPU_TAB_REF FORMULA_0415_VTAB /end COMPU_METHOD
/begin COMPU_VTAB FORMULA_0415_VTAB "FORMULA_0415_VTAB" TAB_VERB 29 0 "Labordaten" 1 "ZS-E-45" 2 "Master" 3 "Prerauer" 4 "Erler" 5 "Heiss" 6 "Lutz" 7 "Maier" 8 "Andritzky" 9 "Neumann" 10 "Wilke" 11 "Scherer" 12 "Erdoedy" 13 "Fischer" 14 "May" 15 "ECE" 16 "US" 17 "Habermann" 18 "Moesbauer" 19 "Hartke" 20 "Renner" 21 "Stoll" 22 "Schaefer" 23 "Ast" 24 "Eickmeyer" 25 "Biebl" 26 "Betz" 27 "NN2" 28 "NN2" DEFAULT_VALUE "unbekannt" /end COMPU_VTAB
/begin COMPU_METHOD FORMULA_0417 "FORMULA_0417" TAB_VERB "%5.2" "-" COMPU_TAB_REF FORMULA_0417_VTAB /end COMPU_METHOD
/begin COMPU_VTAB FORMULA_0417_VTAB "FORMULA_0417_VTAB" TAB_VERB 2 1 "INJ" 2 "IGN" DEFAULT_VALUE "undefiniert" /end COMPU_VTAB
/* ------------------ Abschnitt erzeugt aus aq.dat ------------------ */
/begin COMPU_METHOD FORMULA_0477 "FORMULA_0477" RAT_FUNC "%7.2" "s" COEFFS 0 0 327.67 0 1 0 /end COMPU_METHOD
/begin COMPU_METHOD FORMULA_0478 "FORMULA_0478" RAT_FUNC "%6.3" "s" COEFFS 0 0 1.28 0 1 0 /end COMPU_METHOD
/begin COMPU_METHOD FORMULA_0479 "FORMULA_0479" RAT_FUNC "%4.1" "%" COEFFS 0 10 0 0 0 1 /end COMPU_METHOD
/begin COMPU_METHOD FORMULA_0497 "FORMULA_0497" RAT_FUNC "%7.2" "-" COEFFS 0 100 0 0 0 1 /end COMPU_METHOD
/begin COMPU_METHOD FORMULA_0501 "FORMULA_0501" RAT_FUNC "%4.1" "s" COEFFS 0 10 0 0 0 1 /end COMPU_METHOD
/begin COMPU_METHOD FORMULA_0605 "FORMULA_0605" TAB_VERB "%5.2" "-" COMPU_TAB_REF FORMULA_0605_VTAB /end COMPU_METHOD
/begin COMPU_VTAB FORMULA_0605_VTAB "FORMULA_0605_VTAB" TAB_VERB 6 0 "Init" 1 "Inaktiv" 4 "Aktiv" 6 "Aktiv/Adapt" 8 "Zust bb" 15 "Failsafe" /end COMPU_VTAB
/begin COMPU_METHOD FORMULA_0606 "FORMULA_0606" TAB_VERB "%5.2" "-" COMPU_TAB_REF FORMULA_0606_VTAB /end COMPU_METHOD
/begin COMPU_VTAB FORMULA_0606_VTAB "FORMULA_0606_VTAB" TAB_VERB 1 0 "aus" DEFAULT_VALUE "Adaption" /end COMPU_VTAB
/* ------------------ Abschnitt erzeugt aus egas_cmd.dat ------------------ */
/begin COMPU_METHOD FORMULA_0615 "FORMULA_0615" TAB_VERB "%5.2" "-" COMPU_TAB_REF FORMULA_0615_VTAB /end COMPU_METHOD
/begin COMPU_VTAB FORMULA_0615_VTAB "FORMULA_0615_VTAB" TAB_VERB 9 0 "INAKTIV" 3 "NEUINIT" 5 "GET_VERS" 6 "SET_VERS" 9 "CLR_DIAGST" 10 "SET_ZYLBANK" 12 "CLR_EEPROM" 14 "CS_ERROR" 15 "UNKNOWN" /end COMPU_VTAB
/begin COMPU_METHOD FORMULA_0616 "FORMULA_0616" TAB_VERB "%3.0" "-" COMPU_TAB_REF FORMULA_0616_VTAB /end COMPU_METHOD
/begin COMPU_VTAB FORMULA_0616_VTAB "FORMULA_0616_VTAB" TAB_VERB 9 0 "INAKTIV" 3 "NEUINIT" 5 "GET_VERS" 6 "SET_VERS" 9 "CLR_DIAGST" 10 "SET_ZYLBANK" 12 "CLR_EEPROM" 14 "CS_ERROR" 15 "UNKNOWN" /end COMPU_VTAB
/begin COMPU_METHOD FORMULA_0617 "FORMULA_0617" RAT_FUNC "%6.1" "s" COEFFS 0 200 0 0 0 1 /end COMPU_METHOD
/begin COMPU_METHOD FORMULA_0618 "FORMULA_0618" TAB_VERB "%5.2" "-" COMPU_TAB_REF FORMULA_0618_VTAB /end COMPU_METHOD
/begin COMPU_VTAB FORMULA_0618_VTAB "FORMULA_0618_VTAB" TAB_VERB 3 0 "nothing" 1 "ackn" 15 "timeout" /end COMPU_VTAB
/begin COMPU_METHOD FORMULA_0619 "FORMULA_0619" TAB_VERB "%7.2" "-" COMPU_TAB_REF FORMULA_0619_VTAB /end COMPU_METHOD
/begin COMPU_VTAB FORMULA_0619_VTAB "FORMULA_0619_VTAB" TAB_VERB 44 0 "O.K." 1 "SH_TO_UB" 2 "SH_TO_GND" 4 "OPENLOAD" 8 "UNPLAUSI" 256 "O.K./ZYKLUS" 512 "FILTER" 513 "FIL/SH_TO_UB" 514 "FIL/SH_TO_GND" 516 "FIL/OPENLOAD" 520 "FIL/UNPLAUSI" 576 "VORHANDEN" 577 "VORH/SH_TO_UB" 578 "VORH/SH_TO_GND" 580 "VORH/OPENLOAD" 584 "VORH/UNPLAUSI" 768 "FILTER/ZYKLUS" 769 "FIL/ZYK/SH_TO_UB" 770 "FIL/ZYK/SH_TO_GND" 772 "FIL/ZYK/OPENLOAD" 776 "FIL/ZYK/UNPLAUSI" 832 "VORHANDEN/ZYKLUS" 833 "VORH/ZYK/SH_TO_UB" 834 "VORH/ZYK/SH_TO_GND" 836 "VORH/ZYK/OPENLOAD" 840 "VORH/ZYK/UNPLAUSI" 2048 "O.K./SCDN" 2304 "O.K./S/ZYKLUS" 2561 "FIL/S/SH_TO_UB" 2562 "FIL/S/SH_TO_GND" 2564 "FIL/S/OPENLOAD" 2568 "FIL/S/UNPLAUSI" 2625 "VORH/S/SH_TO_UB" 2626 "VORH/S/SH_TO_GND" 2628 "VORH/S/OPENLOAD" 2632 "VORH/S/UNPLAUSI" 2817 "FIL/ZYK/S/SH_TO_UB" 2818 "FIL/ZYK/S/SH_TO_GND" 2820 "FIL/ZYK/S/OPENLOAD" 2824 "FIL/ZYK/S/UNPLAUSI" 2881 "VORH/ZYK/S/SH_TO_UB" 2882 "VORH/ZYK/S/SH_TO_GND" 2884 "VORH/ZYK/S/OPENLOAD" 2888 "VORH/ZYK/S/UNPLAUSI" /end COMPU_VTAB
/begin COMPU_METHOD FORMULA_0620 "FORMULA_0620" TAB_VERB "%5.0" "-" COMPU_TAB_REF FORMULA_0620_VTAB /end COMPU_METHOD
/begin COMPU_VTAB FORMULA_0620_VTAB "FORMULA_0620_VTAB" TAB_VERB 3 0 "nothing" 1 "ackn" 15 "timeout" /end COMPU_VTAB
/* ------------------ Abschnitt erzeugt aus egas_sk.dat ------------------ */
/begin COMPU_METHOD FORMULA_0621 "FORMULA_0621" TAB_VERB "%5.2" "-" COMPU_TAB_REF FORMULA_0621_VTAB /end COMPU_METHOD
/begin COMPU_VTAB FORMULA_0621_VTAB "FORMULA_0621_VTAB" TAB_VERB 5 0 "kein Fehler" 1 "Soll-Vgl" 2 "Soll-Ist-Vgl" 4 "Mode-Vgl" 8 "CAN-Istwert" DEFAULT_VALUE "Mehrfachfehler" /end COMPU_VTAB
/begin COMPU_METHOD FORMULA_0622 "FORMULA_0622" TAB_VERB "%5.2" "-" COMPU_TAB_REF FORMULA_0622_VTAB /end COMPU_METHOD
/begin COMPU_VTAB FORMULA_0622_VTAB "FORMULA_0622_VTAB" TAB_VERB 6 0 "kein Fehler" 1 "Spalt offen" 2 "Klemmen offen" 4 "WDK-Istwert" 8 "WDK-CAN-Vgl" 12 "WDK-Istwert" DEFAULT_VALUE "Mehrfachfehler" /end COMPU_VTAB
/begin COMPU_METHOD FORMULA_0623 "FORMULA_0623" TAB_VERB "%5.2" "-" COMPU_TAB_REF FORMULA_0623_VTAB /end COMPU_METHOD
/begin COMPU_VTAB FORMULA_0623_VTAB "FORMULA_0623_VTAB" TAB_VERB 4 0 "kein Fehler" 1 "Soll-Vgl" 2 "Soll-Ist-Vgl" 4 "Mode-Vgl" DEFAULT_VALUE "Mehrfachfehler" /end COMPU_VTAB
/begin COMPU_METHOD FORMULA_0624 "FORMULA_0624" RAT_FUNC "%7.2" "%/sec" COEFFS 0 1 0 0 0 20 /end COMPU_METHOD
/* ------------------ Abschnitt erzeugt aus egas_stm.dat ------------------ */
/begin COMPU_METHOD FORMULA_0626 "FORMULA_0626" TAB_VERB "%5.2" "-" COMPU_TAB_REF FORMULA_0626_VTAB /end COMPU_METHOD
/begin COMPU_VTAB FORMULA_0626_VTAB "FORMULA_0626_VTAB" TAB_VERB 6 0 "Init" 1 "Versionsabfrage" 2 "Versionsvorgabe" 3 "Bankzuordnung" 4 "Statusabfrage" 5 "Kl15 aus" /end COMPU_VTAB
/begin COMPU_METHOD FORMULA_0627 "FORMULA_0627" RAT_FUNC "%5.0" "min" COEFFS 0 60 0 0 0 1 /end COMPU_METHOD
/begin COMPU_METHOD FORMULA_0628 "FORMULA_0628" TAB_VERB "%5.2" "-" COMPU_TAB_REF FORMULA_0628_VTAB /end COMPU_METHOD
/begin COMPU_VTAB FORMULA_0628_VTAB "FORMULA_0628_VTAB" TAB_VERB 1 0 "kein Fehler" DEFAULT_VALUE "mind. 1 Fehler" /end COMPU_VTAB
/begin COMPU_METHOD FORMULA_0629 "FORMULA_0629" TAB_VERB "%3.0" "-" COMPU_TAB_REF FORMULA_0629_VTAB /end COMPU_METHOD
/begin COMPU_VTAB FORMULA_0629_VTAB "FORMULA_0629_VTAB" TAB_VERB 11 0 "Aus" 1 "Start" 2 "Predrive" 3 "Start KlSpr" 4 "Kl.Sprung" 5 "Gr. Sprung" 6 "Start Rampe" 7 "Oeffnen 1" 8 "Oeffnen 2" 9 "Schliessen" 15 "Abbruch" DEFAULT_VALUE "undef" /end COMPU_VTAB
/begin COMPU_METHOD FORMULA_0630 "FORMULA_0630" RAT_FUNC "%8.3" "s" COEFFS 0 200 0 0 0 1 /end COMPU_METHOD
/begin COMPU_METHOD FORMULA_0631 "FORMULA_0631" RAT_FUNC "%8.1" "%" COEFFS 0 1.28 0 0 0 1 /end COMPU_METHOD
/begin COMPU_METHOD FORMULA_0632 "FORMULA_0632" RAT_FUNC "%8.1" "%" COEFFS 0 10 0 0 0 1 /end COMPU_METHOD
/* ------------------ Abschnitt erzeugt aus fgr.dat ------------------ */
/begin COMPU_METHOD FORMULA_0635 "FORMULA_0635" TAB_VERB "%4.1" "-" COMPU_TAB_REF FORMULA_0635_VTAB /end COMPU_METHOD
/begin COMPU_VTAB FORMULA_0635_VTAB "FORMULA_0635_VTAB" TAB_VERB 2 0 "nein" 1 "ja" /end COMPU_VTAB
/begin COMPU_METHOD FORMULA_0637 "FORMULA_0637" TAB_VERB "%4.1" "-" COMPU_TAB_REF FORMULA_0637_VTAB /end COMPU_METHOD
/begin COMPU_VTAB FORMULA_0637_VTAB "FORMULA_0637_VTAB" TAB_VERB 19 0 "Kein Abwurf" 1 "Reglerabweichung zu gross" 2 "Ueberholen zu lang" 3 "Geschw. zu gross" 4 "DSC-Eingriff" 5 "Geschw. zu gering" 6 "Hochlaufsperre" 7 "Nmax Begrenzer" 8 "Vmax Begrenzer" 9 "Beschl. zu gross" 10 "SMG Abwurf" 11 "VAHA Plausi" 12 "Rennstart" 13 "SK Manager" 14 "FGR Fehler E2" 15 "BLS PWG Fehler" 16 "Kupplungs Fehler" 17 "CAN Fehler" 18 "Tuner Plausi" DEFAULT_VALUE "undefiniert" /end COMPU_VTAB
/begin COMPU_METHOD FORMULA_0638 "FORMULA_0638" TAB_VERB "%4.1" "-" COMPU_TAB_REF FORMULA_0638_VTAB /end COMPU_METHOD
/begin COMPU_VTAB FORMULA_0638_VTAB "FORMULA_0638_VTAB" TAB_VERB 2 0 "DSC inaktiv" 1 "DSC regelt" /end COMPU_VTAB
/begin COMPU_METHOD FORMULA_0639 "FORMULA_0639" TAB_VERB "%4.1" "-" COMPU_TAB_REF FORMULA_0639_VTAB /end COMPU_METHOD
/begin COMPU_VTAB FORMULA_0639_VTAB "FORMULA_0639_VTAB" TAB_VERB 2 0 "DSC inaktiv" 1 "DSC Eingriff" /end COMPU_VTAB
/begin COMPU_METHOD FORMULA_0640 "FORMULA_0640" TAB_VERB "%4.1" "-" COMPU_TAB_REF FORMULA_0640_VTAB /end COMPU_METHOD
/begin COMPU_VTAB FORMULA_0640_VTAB "FORMULA_0640_VTAB" TAB_VERB 2 0 "DSC inaktiv" 1 "DSC Reg./Eingriff" /end COMPU_VTAB
/begin COMPU_METHOD FORMULA_0641 "FORMULA_0641" TAB_VERB "%4.1" "-" COMPU_TAB_REF FORMULA_0641_VTAB /end COMPU_METHOD
/begin COMPU_VTAB FORMULA_0641_VTAB "FORMULA_0641_VTAB" TAB_VERB 2 0 "DSC inaktiv" 1 "DSC ABS/ASC/MSR" /end COMPU_VTAB
/begin COMPU_METHOD FORMULA_0642 "FORMULA_0642" TAB_VERB "%3.0" "-" COMPU_TAB_REF FORMULA_0642_VTAB /end COMPU_METHOD
/begin COMPU_VTAB FORMULA_0642_VTAB "FORMULA_0642_VTAB" TAB_VERB 8 0 "Keine Aktion" 1 "Tippen vorn" 2 "Ueberdruecken vorn" 4 "Tippen hinten" 8 "Ueberdruecken hinten" 16 "Tippen oben/unten" 64 "Tippen axial" 127 "ungueltig" DEFAULT_VALUE "undef" /end COMPU_VTAB
/begin COMPU_METHOD FORMULA_0643 "FORMULA_0643" TAB_VERB "%3.0" "-" COMPU_TAB_REF FORMULA_0643_VTAB /end COMPU_METHOD
/begin COMPU_VTAB FORMULA_0643_VTAB "FORMULA_0643_VTAB" TAB_VERB 10 0 "hart aus" 1 "weich aus" 2 "tip plus" 3 "tip minus" 4 "set beschl" 5 "wieder aufnehmen" 6 "set verzoegern" 7 "keine Aktion" 8 "Marke hoch" 9 "Marke runter" DEFAULT_VALUE "undef" /end COMPU_VTAB
/begin COMPU_METHOD FORMULA_0644 "FORMULA_0644" TAB_VERB "%3.0" "-" COMPU_TAB_REF FORMULA_0644_VTAB /end COMPU_METHOD
/begin COMPU_VTAB FORMULA_0644_VTAB "FORMULA_0644_VTAB" TAB_VERB 4 0 "keine Abschaltung" 1 "weiche Abschaltung rev." 2 "harte Abschaltung rev." 3 "harte Abschaltung irrev." DEFAULT_VALUE "undef" /end COMPU_VTAB
/begin COMPU_METHOD FORMULA_0645 "FORMULA_0645" TAB_VERB "%3.0" "-" COMPU_TAB_REF FORMULA_0645_VTAB /end COMPU_METHOD
/begin COMPU_VTAB FORMULA_0645_VTAB "FORMULA_0645_VTAB" TAB_VERB 6 0 "keine Abschaltung" 1 "Fahrereingabe" 2 "Regelabweichung zu gross" 3 "Ueberholfunktion" 4 "Geschwindigkeit zu gross" 5 "DSC-Eingriff" DEFAULT_VALUE "undef" /end COMPU_VTAB
/begin COMPU_METHOD FORMULA_0646 "FORMULA_0646" TAB_VERB "%3.0" "-" COMPU_TAB_REF FORMULA_0646_VTAB /end COMPU_METHOD
/begin COMPU_VTAB FORMULA_0646_VTAB "FORMULA_0646_VTAB" TAB_VERB 14 0 "keine Abschaltung" 1 "Fahrereingabe" 2 "Bremse" 3 "Kupplung HS" 4 "Neutralgang SMG" 5 "Geschw. zu gering" 6 "Motorzustand" 7 "Hochlaufsperre HS" 8 "Drehzahlbegrenzer" 9 "Geschw. Begrenzer" 10 "Beschl. zu gross" 11 "Abschaltung SMG" 12 "VAHA-Plausi" 13 "Rennstart" /end COMPU_VTAB
/begin COMPU_METHOD FORMULA_0647 "FORMULA_0647" TAB_VERB "%3.0" "-" COMPU_TAB_REF FORMULA_0647_VTAB /end COMPU_METHOD
/begin COMPU_VTAB FORMULA_0647_VTAB "FORMULA_0647_VTAB" TAB_VERB 8 0 "keine Abschaltung" 1 "SK Manager" 2 "FGR Fehler Ebene 2" 3 "BLS PWG Plausi" 4 "Fehler Kupplung" 5 "CAN-Fehler" 6 "Tuner Plausi" 7 "KL15 aus" /end COMPU_VTAB
/begin COMPU_METHOD FORMULA_0648 "FORMULA_0648" TAB_VERB "%3.0" "-" COMPU_TAB_REF FORMULA_0648_VTAB /end COMPU_METHOD
/begin COMPU_VTAB FORMULA_0648_VTAB "FORMULA_0648_VTAB" TAB_VERB 3 0 "keine Aktion" 1 "Stufe hoch" 2 "Stufe runter" /end COMPU_VTAB
/begin COMPU_METHOD FORMULA_0649 "FORMULA_0649" TAB_VERB "%3.0" "-" COMPU_TAB_REF FORMULA_0649_VTAB /end COMPU_METHOD
/begin COMPU_VTAB FORMULA_0649_VTAB "FORMULA_0649_VTAB" TAB_VERB 2 0 "beibehalten" 1 "ausschalten" /end COMPU_VTAB
/begin COMPU_METHOD FORMULA_0650 "FORMULA_0650" TAB_VERB "%3.0" "-" COMPU_TAB_REF FORMULA_0650_VTAB /end COMPU_METHOD
/begin COMPU_VTAB FORMULA_0650_VTAB "FORMULA_0650_VTAB" TAB_VERB 3 0 "aus" 1 "ein" 2 "verweigert" /end COMPU_VTAB
/begin COMPU_METHOD FORMULA_0651 "FORMULA_0651" TAB_VERB "%3.0" "-" COMPU_TAB_REF FORMULA_0651_VTAB /end COMPU_METHOD
/begin COMPU_VTAB FORMULA_0651_VTAB "FORMULA_0651_VTAB" TAB_VERB 2 0 "kein" 1 "erkannt" /end COMPU_VTAB
/begin COMPU_METHOD FORMULA_0652 "FORMULA_0652" RAT_FUNC "%9.2" "km/h" COEFFS 0 16384 0 0 0 1 /end COMPU_METHOD
/begin COMPU_METHOD FORMULA_0653 "FORMULA_0653" RAT_FUNC "%9.4" "kmh/10mS" COEFFS 0 16384 0 0 0 1 /end COMPU_METHOD
/begin COMPU_METHOD FORMULA_0657 "FORMULA_0657" RAT_FUNC "%6.1" "n" COEFFS 0 1 0 0 0 1 /end COMPU_METHOD
/begin COMPU_METHOD FORMULA_0659 "FORMULA_0659" RAT_FUNC "%9.2" "sec" COEFFS 0 100 0 0 0 1 /end COMPU_METHOD
/* ------------------ Abschnitt erzeugt aus fr.dat ------------------ */
/begin COMPU_METHOD FORMULA_0675 "FORMULA_0675" TAB_VERB "%3.0" "-" COMPU_TAB_REF FORMULA_0675_VTAB /end COMPU_METHOD
/begin COMPU_VTAB FORMULA_0675_VTAB "FORMULA_0675_VTAB" TAB_VERB 3 0 "Inaktiv" 1 "Aktiv" 2 "Gesperrt" /end COMPU_VTAB
/begin COMPU_METHOD FORMULA_0679 "FORMULA_0679" RAT_FUNC "%5.2" "s" COEFFS 0 0 25.6 0 1 0 /end COMPU_METHOD
/* ------------------ Abschnitt erzeugt aus fra.dat ------------------ */
/begin COMPU_METHOD FORMULA_0680 "FORMULA_0680" TAB_VERB "%3.0" "-" COMPU_TAB_REF FORMULA_0680_VTAB /end COMPU_METHOD
/begin COMPU_VTAB FORMULA_0680_VTAB "FORMULA_0680_VTAB" TAB_VERB 7 0 "Freigabe" 1 "FRA aus" 2 "KH" 4 "Tmot" 8 "Egas/SK" 16 "Rf" 32 "TE" /end COMPU_VTAB
/begin COMPU_METHOD FORMULA_0681 "FORMULA_0681" TAB_VERB "%3.0" "-" COMPU_TAB_REF FORMULA_0681_VTAB /end COMPU_METHOD
/begin COMPU_VTAB FORMULA_0681_VTAB "FORMULA_0681_VTAB" TAB_VERB 5 0 "Inaktiv" 1 "Warten" 3 "Adaption" 7 "Adapt+nBegr" 11 "Adapt+pBegr" /end COMPU_VTAB
/* ------------------ Abschnitt erzeugt aus gang.dat ------------------ */
/begin COMPU_METHOD FORMULA_0683 "FORMULA_0683" TAB_VERB "%5.2" "-" COMPU_TAB_REF FORMULA_0683_VTAB /end COMPU_METHOD
/begin COMPU_VTAB FORMULA_0683_VTAB "FORMULA_0683_VTAB" TAB_VERB 3 0 "unbekannt" 1 "vorwaerts" 2 "rueckwaerts" /end COMPU_VTAB
/begin COMPU_METHOD FORMULA_0685 "FORMULA_0685" TAB_VERB "%5.2" "-" COMPU_TAB_REF FORMULA_0685_VTAB /end COMPU_METHOD
/begin COMPU_VTAB FORMULA_0685_VTAB "FORMULA_0685_VTAB" TAB_VERB 2 0 "Sperre aus" 1 "Sperre ein" /end COMPU_VTAB
/begin COMPU_METHOD FORMULA_0686 "FORMULA_0686" TAB_VERB "%5.2" "-" COMPU_TAB_REF FORMULA_0686_VTAB /end COMPU_METHOD
/begin COMPU_VTAB FORMULA_0686_VTAB "FORMULA_0686_VTAB" TAB_VERB 2 0 "iHA gesperrt" 1 "iHA freigegeben" /end COMPU_VTAB
/begin COMPU_METHOD FORMULA_0687 "FORMULA_0687" TAB_VERB "%5.2" "-" COMPU_TAB_REF FORMULA_0687_VTAB /end COMPU_METHOD
/begin COMPU_VTAB FORMULA_0687_VTAB "FORMULA_0687_VTAB" TAB_VERB 2 0 "iHA ungueltig" 1 "iHA gueltig" /end COMPU_VTAB
/begin COMPU_METHOD FORMULA_0688 "FORMULA_0688" TAB_VERB "%5.2" "-" COMPU_TAB_REF FORMULA_0688_VTAB /end COMPU_METHOD
/begin COMPU_VTAB FORMULA_0688_VTAB "FORMULA_0688_VTAB" TAB_VERB 2 0 "iHA nicht verfuegbar" 1 "iHA verfuegbar" /end COMPU_VTAB
/begin COMPU_METHOD FORMULA_0689 "FORMULA_0689" RAT_FUNC "%10.3" "-" COEFFS 0 1024 0 0 0 1 /end COMPU_METHOD
/* ------------------ Abschnitt erzeugt aus ka.dat ------------------ */
/begin COMPU_METHOD FORMULA_0692 "FORMULA_0692" TAB_VERB "%5.0" "-" COMPU_TAB_REF FORMULA_0692_VTAB /end COMPU_METHOD
/begin COMPU_VTAB FORMULA_0692_VTAB "FORMULA_0692_VTAB" TAB_VERB 19 0 "kein Klopfschutz" 1 "K_KA_KS_CFG = Ein" 65 "K_KA_KS_CFG = Ein" 2 "K_KR_CFG = Aus" 66 "K_KR_CFG = Aus" 4 "Anschlag an tz_min" 8 "Doppelzuendung" 72 "Doppelzuendung" 16 "Klipping" 80 "Klipping" 32 "Fehlerspeicher" 96 "Fehlerspeicher" 112 "Fehlerspeicher" 40 "Fehlerspeicher" 104 "Fehlerspeicher" 120 "Fehlerspeicher" 64 "rf-Schwelle" 128 "Katheizen" 256 "Dynamik" DEFAULT_VALUE "Mehrfachanforderung" /end COMPU_VTAB
/begin COMPU_METHOD FORMULA_0693 "FORMULA_0693" TAB_VERB "%3.0" "-" COMPU_TAB_REF FORMULA_0693_VTAB /end COMPU_METHOD
/begin COMPU_VTAB FORMULA_0693_VTAB "FORMULA_0693_VTAB" TAB_VERB 4 0 "Ok" 1 "Bank 1" 2 "Bank 2" 3 "Bank 1+2" DEFAULT_VALUE "undefiniert" /end COMPU_VTAB
/* ------------------ Abschnitt erzeugt aus kh.dat ------------------ */
/begin COMPU_METHOD FORMULA_0698 "FORMULA_0698" RAT_FUNC "%7.2" "�KW" COEFFS 0 100 0 0 0 1 /end COMPU_METHOD
/* ------------------ Abschnitt erzeugt aus kis.dat ------------------ */
/begin COMPU_METHOD FORMULA_0708 "FORMULA_0708" TAB_VERB "%5.2" "-" COMPU_TAB_REF FORMULA_0708_VTAB /end COMPU_METHOD
/begin COMPU_VTAB FORMULA_0708_VTAB "FORMULA_0708_VTAB" TAB_VERB 2 0 "Aus" 1 "Senden" DEFAULT_VALUE "undefiniert" /end COMPU_VTAB
/begin COMPU_METHOD FORMULA_0710 "FORMULA_0710" RAT_FUNC "%6.1" "�KW" COEFFS 0 65536 0 0 0 720 /end COMPU_METHOD
/* ------------------ Abschnitt erzeugt aus kr.dat ------------------ */
/begin COMPU_METHOD FORMULA_0711 "FORMULA_0711" TAB_VERB "%3.0" "-" COMPU_TAB_REF FORMULA_0711_VTAB /end COMPU_METHOD
/begin COMPU_VTAB FORMULA_0711_VTAB "FORMULA_0711_VTAB" TAB_VERB 8 0 "Aktiv" 1 "K_KR_CFG = Aus" 2 "rf-Schwelle" 4 "Doppelzuendung" 8 "tmot-Schwelle" 10 "rf + tmot-Schwelle" 16 "Fehlerspeicher" 32 "dtz ausserhalb" DEFAULT_VALUE "Mehrfachdeaktiviert" /end COMPU_VTAB
/begin COMPU_METHOD FORMULA_0712 "FORMULA_0712" TAB_VERB "%3.0" "-" COMPU_TAB_REF FORMULA_0712_VTAB /end COMPU_METHOD
/begin COMPU_VTAB FORMULA_0712_VTAB "FORMULA_0712_VTAB" TAB_VERB 4 0 "Ok" 1 "Bank 1" 2 "Bank 2" 3 "Bank 1+2" DEFAULT_VALUE "undefiniert" /end COMPU_VTAB
/begin COMPU_METHOD FORMULA_0713 "FORMULA_0713" TAB_VERB "%5.0" "-" COMPU_TAB_REF FORMULA_0713_VTAB /end COMPU_METHOD
/begin COMPU_VTAB FORMULA_0713_VTAB "FORMULA_0713_VTAB" TAB_VERB 1 0 "Kein Klopfen." DEFAULT_VALUE "Klopfen Erkannt." /end COMPU_VTAB
/begin COMPU_METHOD FORMULA_0714 "FORMULA_0714" TAB_VERB "%5.0" "-" COMPU_TAB_REF FORMULA_0714_VTAB /end COMPU_METHOD
/begin COMPU_VTAB FORMULA_0714_VTAB "FORMULA_0714_VTAB" TAB_VERB 1 0 "Kein Klopfen." DEFAULT_VALUE "Klopfen Erkannt." /end COMPU_VTAB
/begin COMPU_METHOD FORMULA_0715 "FORMULA_0715" TAB_VERB "%5.0" "-" COMPU_TAB_REF FORMULA_0715_VTAB /end COMPU_METHOD
/begin COMPU_VTAB FORMULA_0715_VTAB "FORMULA_0715_VTAB" TAB_VERB 1 0 "Kein Klopfen." DEFAULT_VALUE "Klopfen Erkannt." /end COMPU_VTAB
/begin COMPU_METHOD FORMULA_0716 "FORMULA_0716" TAB_VERB "%5.0" "-" COMPU_TAB_REF FORMULA_0716_VTAB /end COMPU_METHOD
/begin COMPU_VTAB FORMULA_0716_VTAB "FORMULA_0716_VTAB" TAB_VERB 1 0 "Kein Klopfen." DEFAULT_VALUE "Klopfen Erkannt." /end COMPU_VTAB
/begin COMPU_METHOD FORMULA_0717 "FORMULA_0717" TAB_VERB "%5.0" "-" COMPU_TAB_REF FORMULA_0717_VTAB /end COMPU_METHOD
/begin COMPU_VTAB FORMULA_0717_VTAB "FORMULA_0717_VTAB" TAB_VERB 1 0 "Kein Klopfen." DEFAULT_VALUE "Klopfen Erkannt." /end COMPU_VTAB
/begin COMPU_METHOD FORMULA_0718 "FORMULA_0718" TAB_VERB "%5.0" "-" COMPU_TAB_REF FORMULA_0718_VTAB /end COMPU_METHOD
/begin COMPU_VTAB FORMULA_0718_VTAB "FORMULA_0718_VTAB" TAB_VERB 1 0 "Kein Klopfen." DEFAULT_VALUE "Klopfen Erkannt." /end COMPU_VTAB
/begin COMPU_METHOD FORMULA_0719 "FORMULA_0719" TAB_VERB "%5.0" "-" COMPU_TAB_REF FORMULA_0719_VTAB /end COMPU_METHOD
/begin COMPU_VTAB FORMULA_0719_VTAB "FORMULA_0719_VTAB" TAB_VERB 1 0 "Kein Klopfen." DEFAULT_VALUE "Klopfen Erkannt." /end COMPU_VTAB
/begin COMPU_METHOD FORMULA_0720 "FORMULA_0720" TAB_VERB "%5.0" "-" COMPU_TAB_REF FORMULA_0720_VTAB /end COMPU_METHOD
/begin COMPU_VTAB FORMULA_0720_VTAB "FORMULA_0720_VTAB" TAB_VERB 1 0 "Kein Klopfen." DEFAULT_VALUE "Klopfen Erkannt." /end COMPU_VTAB
/begin COMPU_METHOD FORMULA_0721 "FORMULA_0721" TAB_VERB "%5.0" "-" COMPU_TAB_REF FORMULA_0721_VTAB /end COMPU_METHOD
/begin COMPU_VTAB FORMULA_0721_VTAB "FORMULA_0721_VTAB" TAB_VERB 1 0 "Kein Klopfen." DEFAULT_VALUE "Klopfen Erkannt." /end COMPU_VTAB
/begin COMPU_METHOD FORMULA_0722 "FORMULA_0722" TAB_VERB "%5.0" "-" COMPU_TAB_REF FORMULA_0722_VTAB /end COMPU_METHOD
/begin COMPU_VTAB FORMULA_0722_VTAB "FORMULA_0722_VTAB" TAB_VERB 1 0 "Kein Klopfen." DEFAULT_VALUE "Klopfen Erkannt." /end COMPU_VTAB
/begin COMPU_METHOD FORMULA_0723 "FORMULA_0723" TAB_VERB "%5.0" "-" COMPU_TAB_REF FORMULA_0723_VTAB /end COMPU_METHOD
/begin COMPU_VTAB FORMULA_0723_VTAB "FORMULA_0723_VTAB" TAB_VERB 1 0 "Kein Klopfen." DEFAULT_VALUE "Klopfen Erkannt." /end COMPU_VTAB
/begin COMPU_METHOD FORMULA_0724 "FORMULA_0724" TAB_VERB "%5.0" "-" COMPU_TAB_REF FORMULA_0724_VTAB /end COMPU_METHOD
/begin COMPU_VTAB FORMULA_0724_VTAB "FORMULA_0724_VTAB" TAB_VERB 1 0 "Zyl. 1 idle." DEFAULT_VALUE "Zyl. 1 aktiv." /end COMPU_VTAB
/begin COMPU_METHOD FORMULA_0725 "FORMULA_0725" TAB_VERB "%5.0" "-" COMPU_TAB_REF FORMULA_0725_VTAB /end COMPU_METHOD
/begin COMPU_VTAB FORMULA_0725_VTAB "FORMULA_0725_VTAB" TAB_VERB 1 0 "Zyl. 2 idle." DEFAULT_VALUE "Zyl. 2 aktiv." /end COMPU_VTAB
/begin COMPU_METHOD FORMULA_0726 "FORMULA_0726" TAB_VERB "%5.0" "-" COMPU_TAB_REF FORMULA_0726_VTAB /end COMPU_METHOD
/begin COMPU_VTAB FORMULA_0726_VTAB "FORMULA_0726_VTAB" TAB_VERB 1 0 "Zyl. 3 idle." DEFAULT_VALUE "Zyl. 3 aktiv." /end COMPU_VTAB
/begin COMPU_METHOD FORMULA_0727 "FORMULA_0727" TAB_VERB "%5.0" "-" COMPU_TAB_REF FORMULA_0727_VTAB /end COMPU_METHOD
/begin COMPU_VTAB FORMULA_0727_VTAB "FORMULA_0727_VTAB" TAB_VERB 1 0 "Zyl. 4 idle." DEFAULT_VALUE "Zyl. 4 aktiv." /end COMPU_VTAB
/begin COMPU_METHOD FORMULA_0728 "FORMULA_0728" TAB_VERB "%5.0" "-" COMPU_TAB_REF FORMULA_0728_VTAB /end COMPU_METHOD
/begin COMPU_VTAB FORMULA_0728_VTAB "FORMULA_0728_VTAB" TAB_VERB 1 0 "Zyl. 5 idle." DEFAULT_VALUE "Zyl. 5 aktiv." /end COMPU_VTAB
/begin COMPU_METHOD FORMULA_0729 "FORMULA_0729" TAB_VERB "%5.0" "-" COMPU_TAB_REF FORMULA_0729_VTAB /end COMPU_METHOD
/begin COMPU_VTAB FORMULA_0729_VTAB "FORMULA_0729_VTAB" TAB_VERB 1 0 "Zyl. 6 idle." DEFAULT_VALUE "Zyl. 6 aktiv." /end COMPU_VTAB
/begin COMPU_METHOD FORMULA_0730 "FORMULA_0730" TAB_VERB "%5.0" "-" COMPU_TAB_REF FORMULA_0730_VTAB /end COMPU_METHOD
/begin COMPU_VTAB FORMULA_0730_VTAB "FORMULA_0730_VTAB" TAB_VERB 1 0 "Zyl. 7 idle." DEFAULT_VALUE "Zyl. 7 aktiv." /end COMPU_VTAB
/begin COMPU_METHOD FORMULA_0731 "FORMULA_0731" TAB_VERB "%5.0" "-" COMPU_TAB_REF FORMULA_0731_VTAB /end COMPU_METHOD
/begin COMPU_VTAB FORMULA_0731_VTAB "FORMULA_0731_VTAB" TAB_VERB 1 0 "Zyl. 8 idle." DEFAULT_VALUE "Zyl. 8 aktiv." /end COMPU_VTAB
/begin COMPU_METHOD FORMULA_0732 "FORMULA_0732" TAB_VERB "%5.0" "-" COMPU_TAB_REF FORMULA_0732_VTAB /end COMPU_METHOD
/begin COMPU_VTAB FORMULA_0732_VTAB "FORMULA_0732_VTAB" TAB_VERB 1 0 "Zyl. 9 idle." DEFAULT_VALUE "Zyl. 9 aktiv." /end COMPU_VTAB
/begin COMPU_METHOD FORMULA_0733 "FORMULA_0733" TAB_VERB "%5.0" "-" COMPU_TAB_REF FORMULA_0733_VTAB /end COMPU_METHOD
/begin COMPU_VTAB FORMULA_0733_VTAB "FORMULA_0733_VTAB" TAB_VERB 1 0 "Zyl. 10 idle." DEFAULT_VALUE "Zyl. 10 aktiv." /end COMPU_VTAB
/* ------------------ Abschnitt erzeugt aus kus.dat ------------------ */
/begin COMPU_METHOD FORMULA_0736 "FORMULA_0736" TAB_VERB "%5.2" "-" COMPU_TAB_REF FORMULA_0736_VTAB /end COMPU_METHOD
/begin COMPU_VTAB FORMULA_0736_VTAB "FORMULA_0736_VTAB" TAB_VERB 2 0 "KUS gesperrt" 1 "KUS freigegeben" /end COMPU_VTAB
/* ------------------ Abschnitt erzeugt aus llr.dat ------------------ */
/begin COMPU_METHOD FORMULA_0739 "FORMULA_0739" TAB_VERB "%3.0" "-" COMPU_TAB_REF FORMULA_0739_VTAB /end COMPU_METHOD
/begin COMPU_VTAB FORMULA_0739_VTAB "FORMULA_0739_VTAB" TAB_VERB 6 0 "Inaktiv" 1 "Aktiv" 2 "Filter LO" 3 "Filter HI" 4 "Fehler LO" 5 "Fehler HI" /end COMPU_VTAB
/begin COMPU_METHOD FORMULA_0740 "FORMULA_0740" TAB_VERB "%3.0" "-" COMPU_TAB_REF FORMULA_0740_VTAB /end COMPU_METHOD
/begin COMPU_VTAB FORMULA_0740_VTAB "FORMULA_0740_VTAB" TAB_VERB 5 0 "Inaktiv" 1 "Bed. niO" 5 "Aktiv" 6 "Ende" 7 "Abbruch" /end COMPU_VTAB
/begin COMPU_METHOD FORMULA_0741 "FORMULA_0741" TAB_VERB "%3.0" "-" COMPU_TAB_REF FORMULA_0741_VTAB /end COMPU_METHOD
/begin COMPU_VTAB FORMULA_0741_VTAB "FORMULA_0741_VTAB" TAB_VERB 2 0 "Normal" 1 "CSS" /end COMPU_VTAB
/begin COMPU_METHOD FORMULA_0742 "FORMULA_0742" RAT_FUNC "%7.2" "rad/s" COEFFS 0 100 0 0 0 1 /end COMPU_METHOD
/begin COMPU_METHOD FORMULA_0743 "FORMULA_0743" RAT_FUNC "%9.4" "Nm" COEFFS 0 2000 0 0 0 1 /end COMPU_METHOD
/* ------------------ Abschnitt erzeugt aus llr_ad.dat ------------------ */
/begin COMPU_METHOD FORMULA_0752 "FORMULA_0752" TAB_VERB "%5.2" "-" COMPU_TAB_REF FORMULA_0752_VTAB /end COMPU_METHOD
/begin COMPU_VTAB FORMULA_0752_VTAB "FORMULA_0752_VTAB" TAB_VERB 6 0 "Inaktiv" 1 "Aktiv" 3 "Wait" 5 "Normal" 9 "mit AC" 16 "Init" /end COMPU_VTAB
/begin COMPU_METHOD FORMULA_0757 "FORMULA_0757" RAT_FUNC "%9.4" "ms" COEFFS 0 7000 0 0 0 1 /end COMPU_METHOD
/begin COMPU_METHOD FORMULA_0758 "FORMULA_0758" RAT_FUNC "%9.4" "1/2*U" COEFFS 0 4048 0 0 0 1 /end COMPU_METHOD
/begin COMPU_METHOD FORMULA_0759 "FORMULA_0759" TAB_VERB "%7.2" "-" COMPU_TAB_REF FORMULA_0759_VTAB /end COMPU_METHOD
/begin COMPU_VTAB FORMULA_0759_VTAB "FORMULA_0759_VTAB" TAB_VERB 1 0 "ok" DEFAULT_VALUE "Auss" /end COMPU_VTAB
/begin COMPU_METHOD FORMULA_0760 "FORMULA_0760" TAB_VERB "%7.2" "-" COMPU_TAB_REF FORMULA_0760_VTAB /end COMPU_METHOD
/begin COMPU_VTAB FORMULA_0760_VTAB "FORMULA_0760_VTAB" TAB_VERB 1 0 "ok" DEFAULT_VALUE "Auss" /end COMPU_VTAB
/begin COMPU_METHOD FORMULA_0761 "FORMULA_0761" TAB_VERB "%7.2" "-" COMPU_TAB_REF FORMULA_0761_VTAB /end COMPU_METHOD
/begin COMPU_VTAB FORMULA_0761_VTAB "FORMULA_0761_VTAB" TAB_VERB 1 0 "ok" DEFAULT_VALUE "Auss" /end COMPU_VTAB
/begin COMPU_METHOD FORMULA_0762 "FORMULA_0762" TAB_VERB "%7.2" "-" COMPU_TAB_REF FORMULA_0762_VTAB /end COMPU_METHOD
/begin COMPU_VTAB FORMULA_0762_VTAB "FORMULA_0762_VTAB" TAB_VERB 1 0 "ok" DEFAULT_VALUE "Auss" /end COMPU_VTAB
/begin COMPU_METHOD FORMULA_0763 "FORMULA_0763" TAB_VERB "%7.2" "-" COMPU_TAB_REF FORMULA_0763_VTAB /end COMPU_METHOD
/begin COMPU_VTAB FORMULA_0763_VTAB "FORMULA_0763_VTAB" TAB_VERB 1 0 "ok" DEFAULT_VALUE "Auss" /end COMPU_VTAB
/begin COMPU_METHOD FORMULA_0764 "FORMULA_0764" TAB_VERB "%7.2" "-" COMPU_TAB_REF FORMULA_0764_VTAB /end COMPU_METHOD
/begin COMPU_VTAB FORMULA_0764_VTAB "FORMULA_0764_VTAB" TAB_VERB 1 0 "ok" DEFAULT_VALUE "Auss" /end COMPU_VTAB
/begin COMPU_METHOD FORMULA_0765 "FORMULA_0765" TAB_VERB "%7.2" "-" COMPU_TAB_REF FORMULA_0765_VTAB /end COMPU_METHOD
/begin COMPU_VTAB FORMULA_0765_VTAB "FORMULA_0765_VTAB" TAB_VERB 1 0 "ok" DEFAULT_VALUE "Auss" /end COMPU_VTAB
/begin COMPU_METHOD FORMULA_0766 "FORMULA_0766" TAB_VERB "%7.2" "-" COMPU_TAB_REF FORMULA_0766_VTAB /end COMPU_METHOD
/begin COMPU_VTAB FORMULA_0766_VTAB "FORMULA_0766_VTAB" TAB_VERB 1 0 "ok" DEFAULT_VALUE "Auss" /end COMPU_VTAB
/begin COMPU_METHOD FORMULA_0767 "FORMULA_0767" TAB_VERB "%7.2" "-" COMPU_TAB_REF FORMULA_0767_VTAB /end COMPU_METHOD
/begin COMPU_VTAB FORMULA_0767_VTAB "FORMULA_0767_VTAB" TAB_VERB 1 0 "ok" DEFAULT_VALUE "Auss" /end COMPU_VTAB
/begin COMPU_METHOD FORMULA_0768 "FORMULA_0768" TAB_VERB "%7.2" "-" COMPU_TAB_REF FORMULA_0768_VTAB /end COMPU_METHOD
/begin COMPU_VTAB FORMULA_0768_VTAB "FORMULA_0768_VTAB" TAB_VERB 1 0 "ok" DEFAULT_VALUE "Auss" /end COMPU_VTAB
/begin COMPU_METHOD FORMULA_0769 "FORMULA_0769" TAB_VERB "%5.2" "-" COMPU_TAB_REF FORMULA_0769_VTAB /end COMPU_METHOD
/begin COMPU_VTAB FORMULA_0769_VTAB "FORMULA_0769_VTAB" TAB_VERB 2 0 "kein Kraftschluss" 1 "Kraftschluss" /end COMPU_VTAB
/begin COMPU_METHOD FORMULA_0770 "FORMULA_0770" TAB_VERB "%5.2" "-" COMPU_TAB_REF FORMULA_0770_VTAB /end COMPU_METHOD
/begin COMPU_VTAB FORMULA_0770_VTAB "FORMULA_0770_VTAB" TAB_VERB 2 0 "KKOS ein" 1 "KKOS aus" /end COMPU_VTAB
/begin COMPU_METHOD FORMULA_0771 "FORMULA_0771" TAB_VERB "%5.2" "-" COMPU_TAB_REF FORMULA_0771_VTAB /end COMPU_METHOD
/begin COMPU_VTAB FORMULA_0771_VTAB "FORMULA_0771_VTAB" TAB_VERB 2 0 "gesperrt" 1 "frei" /end COMPU_VTAB
/begin COMPU_METHOD FORMULA_0772 "FORMULA_0772" TAB_VERB "%5.2" "-" COMPU_TAB_REF FORMULA_0772_VTAB /end COMPU_METHOD
/begin COMPU_VTAB FORMULA_0772_VTAB "FORMULA_0772_VTAB" TAB_VERB 17 0 "KEINER" 1 "N_MIN" 2 "N_MAX" 3 "RF_MIN" 4 "SA_BEREIT" 5 "KLIMAKOMP" 6 "SCHLECHTWEG" 7 "DSC_REGELT" 8 "TI_AUSBLEND" 9 "RF_DELTA" 10 "MD_WUNSCH_POS" 11 "MD_WUNSCH_NEG" 12 "TZ_DELTA" 13 "KRAFTSCHLUSS" 14 "NULLZEIT" 15 "VANOS_EXD" 16 "SEMGENTTASK" DEFAULT_VALUE "UNDEF." /end COMPU_VTAB
/begin COMPU_METHOD FORMULA_0774 "FORMULA_0774" RAT_FUNC "%3.0" "Segm" COEFFS 0 1 0 0 0 1 /end COMPU_METHOD
/begin COMPU_METHOD FORMULA_0775 "FORMULA_0775" TAB_VERB "%5.2" "-" COMPU_TAB_REF FORMULA_0775_VTAB /end COMPU_METHOD
/begin COMPU_VTAB FORMULA_0775_VTAB "FORMULA_0775_VTAB" TAB_VERB 4 0 "AUS" 1 "IDLE" 2 "AKTIV" 4 "ADAP" DEFAULT_VALUE "UNDEF." /end COMPU_VTAB
/begin COMPU_METHOD FORMULA_0776 "FORMULA_0776" RAT_FUNC "%11.4" "ms" COEFFS 0 7000 0 0 0 1 /end COMPU_METHOD
/* ------------------ Abschnitt erzeugt aus md_can.dat ------------------ */
/begin COMPU_METHOD FORMULA_0794 "FORMULA_0794" TAB_VERB "%5.2" "-" COMPU_TAB_REF FORMULA_0794_VTAB /end COMPU_METHOD
/begin COMPU_VTAB FORMULA_0794_VTAB "FORMULA_0794_VTAB" TAB_VERB 9 0 "Freigabe" 1 "Fehler" 2 "Start" 4 "Beschl." 8 "VL" 16 "WH" 32 "Tmot" 64 "Nmax" 128 "TEFC" DEFAULT_VALUE "Mehrfach" /end COMPU_VTAB
/begin COMPU_METHOD FORMULA_0795 "FORMULA_0795" TAB_VERB "%5.2" "-" COMPU_TAB_REF FORMULA_0795_VTAB /end COMPU_METHOD
/begin COMPU_VTAB FORMULA_0795_VTAB "FORMULA_0795_VTAB" TAB_VERB 7 0 "kein Fehler" 1 "CAN-Err" 2 "DME-Err" 4 "MD-Err" 8 "ELU-Err" 16 "Kuehl-Err" 32 "Bereit-Err" DEFAULT_VALUE "Mehrfach" /end COMPU_VTAB
/begin COMPU_METHOD FORMULA_0796 "FORMULA_0796" TAB_VERB "%5.2" "-" COMPU_TAB_REF FORMULA_0796_VTAB /end COMPU_METHOD
/begin COMPU_VTAB FORMULA_0796_VTAB "FORMULA_0796_VTAB" TAB_VERB 9 0 "aus" 1 "nLL-Anhebung" 2 "Klima-Anf." 3 "nLL+Klima" 4 "Reserve" 6 "Klima+Res" 7 "nLL+Klima+Res" 8 "nLL-ZH" 24 "nLL-ZH+Res" /end COMPU_VTAB
/begin COMPU_METHOD FORMULA_0797 "FORMULA_0797" TAB_VERB "%5.2" "-" COMPU_TAB_REF FORMULA_0797_VTAB /end COMPU_METHOD
/begin COMPU_VTAB FORMULA_0797_VTAB "FORMULA_0797_VTAB" TAB_VERB 5 0 "Inaktiv" 1 "Wait on" 2 "Filter on" 4 "Wait off" 8 "Filter off" DEFAULT_VALUE "undef" /end COMPU_VTAB
/* ------------------ Abschnitt erzeugt aus md_e2.dat ------------------ */
/begin COMPU_METHOD FORMULA_0801 "FORMULA_0801" TAB_VERB "%5.2" "-" COMPU_TAB_REF FORMULA_0801_VTAB /end COMPU_METHOD
/begin COMPU_VTAB FORMULA_0801_VTAB "FORMULA_0801_VTAB" TAB_VERB 6 0 "kein Fehler" 1 "Minmoment" 2 "Maxmoment" 4 "ind.Istmoment" 8 "Schleppmoment" 16 "Soll/Istvgl." DEFAULT_VALUE "Mehrfach" /end COMPU_VTAB
/begin COMPU_METHOD FORMULA_0802 "FORMULA_0802" TAB_VERB "%5.2" "-" COMPU_TAB_REF FORMULA_0802_VTAB /end COMPU_METHOD
/begin COMPU_VTAB FORMULA_0802_VTAB "FORMULA_0802_VTAB" TAB_VERB 3 0 "Inaktiv" 1 "MSR" 2 "ASC" DEFAULT_VALUE "undef" /end COMPU_VTAB
/* ------------------ Abschnitt erzeugt aus md_filter.dat ------------------ */
/begin COMPU_METHOD FORMULA_0804 "FORMULA_0804" TAB_VERB "%3.0" "-" COMPU_TAB_REF FORMULA_0804_VTAB /end COMPU_METHOD
/begin COMPU_VTAB FORMULA_0804_VTAB "FORMULA_0804_VTAB" TAB_VERB 6 0 "Inaktiv" 1 "SA aktiv" 2 "LSD" 4 "Dash" 3 "LSD+SA" 5 "Dash+SA" /end COMPU_VTAB
/begin COMPU_METHOD FORMULA_0805 "FORMULA_0805" TAB_VERB "%3.0" "-" COMPU_TAB_REF FORMULA_0805_VTAB /end COMPU_METHOD
/begin COMPU_VTAB FORMULA_0805_VTAB "FORMULA_0805_VTAB" TAB_VERB 1 0 "Inaktiv" DEFAULT_VALUE "Aktiv" /end COMPU_VTAB
/begin COMPU_METHOD FORMULA_0806 "FORMULA_0806" TAB_VERB "%3.0" "-" COMPU_TAB_REF FORMULA_0806_VTAB /end COMPU_METHOD
/begin COMPU_VTAB FORMULA_0806_VTAB "FORMULA_0806_VTAB" TAB_VERB 1 0 "Inaktiv" DEFAULT_VALUE "Aktiv" /end COMPU_VTAB
/begin COMPU_METHOD FORMULA_0807 "FORMULA_0807" TAB_VERB "%3.0" "-" COMPU_TAB_REF FORMULA_0807_VTAB /end COMPU_METHOD
/begin COMPU_VTAB FORMULA_0807_VTAB "FORMULA_0807_VTAB" TAB_VERB 2 0 "Filter aus" 1 "Filter ein" /end COMPU_VTAB
/begin COMPU_METHOD FORMULA_0808 "FORMULA_0808" TAB_VERB "%3.0" "-" COMPU_TAB_REF FORMULA_0808_VTAB /end COMPU_METHOD
/begin COMPU_VTAB FORMULA_0808_VTAB "FORMULA_0808_VTAB" TAB_VERB 3 -1 "fallend" 0 "konstant" 1 "steigend" DEFAULT_VALUE "undef" /end COMPU_VTAB
/begin COMPU_METHOD FORMULA_0809 "FORMULA_0809" TAB_VERB "%3.0" "-" COMPU_TAB_REF FORMULA_0809_VTAB /end COMPU_METHOD
/begin COMPU_VTAB FORMULA_0809_VTAB "FORMULA_0809_VTAB" TAB_VERB 3 0 "B1/unter 0Nm" 1 "B2/um 0Nm" 2 "B3/ueber 0Nm" DEFAULT_VALUE "undef" /end COMPU_VTAB
/begin COMPU_METHOD FORMULA_0810 "FORMULA_0810" RAT_FUNC "%7.0" "Nm/s" COEFFS 0 1 0 0 0 1 /end COMPU_METHOD
/begin COMPU_METHOD FORMULA_0812 "FORMULA_0812" RAT_FUNC "%8.1" "Nm" COEFFS 0 200 0 0 0 1 /end COMPU_METHOD
/* ------------------ Abschnitt erzeugt aus md_kus.dat ------------------ */
/begin COMPU_METHOD FORMULA_0815 "FORMULA_0815" RAT_FUNC "%10.3" "Nm/Upm" COEFFS 0 1000 0 0 0 1 /end COMPU_METHOD
/* ------------------ Abschnitt erzeugt aus md_soll.dat ------------------ */
/begin COMPU_METHOD FORMULA_0817 "FORMULA_0817" TAB_VERB "%5.2" "-" COMPU_TAB_REF FORMULA_0817_VTAB /end COMPU_METHOD
/begin COMPU_VTAB FORMULA_0817_VTAB "FORMULA_0817_VTAB" TAB_VERB 2 0 "Inaktiv" 1 "Aktiv" /end COMPU_VTAB
/begin COMPU_METHOD FORMULA_0819 "FORMULA_0819" RAT_FUNC "%10.3" "Nm/Upm" COEFFS 0 -1000 0 0 0 1 /end COMPU_METHOD
/begin COMPU_METHOD FORMULA_0820 "FORMULA_0820" RAT_FUNC "%10.3" "Nm/kmh" COEFFS 0 1000 0 0 0 1 /end COMPU_METHOD
/begin COMPU_METHOD FORMULA_0821 "FORMULA_0821" RAT_FUNC "%10.3" "Nm/kmh" COEFFS 0 -1000 0 0 0 1 /end COMPU_METHOD
/begin COMPU_METHOD FORMULA_0822 "FORMULA_0822" TAB_VERB "%5.2" "-" COMPU_TAB_REF FORMULA_0822_VTAB /end COMPU_METHOD
/begin COMPU_VTAB FORMULA_0822_VTAB "FORMULA_0822_VTAB" TAB_VERB 2 0 "Inaktiv" 128 "Erkannt" DEFAULT_VALUE "undef" /end COMPU_VTAB
/* ------------------ Abschnitt erzeugt aus mzyl_sek.dat ------------------ */
/begin COMPU_METHOD FORMULA_0835 "FORMULA_0835" RAT_FUNC "%7.2" "qmm" COEFFS 0 1000 0 0 0 1 /end COMPU_METHOD
/begin COMPU_METHOD FORMULA_0836 "FORMULA_0836" TAB_VERB "%5.2" "-" COMPU_TAB_REF FORMULA_0836_VTAB /end COMPU_METHOD
/begin COMPU_VTAB FORMULA_0836_VTAB "FORMULA_0836_VTAB" TAB_VERB 2 0 "immer" 1 "keine bei SSP-DIAG" DEFAULT_VALUE "undefiniert" /end COMPU_VTAB
/begin COMPU_METHOD FORMULA_0837 "FORMULA_0837" RAT_FUNC "%8.3" "-/5ms" COEFFS 0 1024 0 0 0 1 /end COMPU_METHOD
/* ------------------ Abschnitt erzeugt aus n_e2.dat ------------------ */
/begin COMPU_METHOD FORMULA_0838 "FORMULA_0838" TAB_VERB "%5.2" "-" COMPU_TAB_REF FORMULA_0838_VTAB /end COMPU_METHOD
/begin COMPU_VTAB FORMULA_0838_VTAB "FORMULA_0838_VTAB" TAB_VERB 2 0 "Ok" 1 "Fehler" DEFAULT_VALUE "undefined" /end COMPU_VTAB
/* ------------------ Abschnitt erzeugt aus ppcm.dat ------------------ */
/begin COMPU_METHOD FORMULA_0841 "FORMULA_0841" RAT_FUNC "%7.0" "U/min" COEFFS 0 1 0 0 0 1 /end COMPU_METHOD
/begin COMPU_METHOD FORMULA_0842 "FORMULA_0842" TAB_VERB "%9.2" "-" COMPU_TAB_REF FORMULA_0842_VTAB /end COMPU_METHOD
/begin COMPU_VTAB FORMULA_0842_VTAB "FORMULA_0842_VTAB" TAB_VERB 13 1 "Motor steht" 2 "Motor presync" 4 "Start" 8 "LLOKS" 16 "LLMKS" 32 "TL" 64 "VL" 128 "SA" 256 "NL" 512 "Abgew." 1024 "Kl15 aus" 2048 "Wakeup" 4096 "Schub" DEFAULT_VALUE "undefiniert" /end COMPU_VTAB
/begin COMPU_METHOD FORMULA_0843 "FORMULA_0843" RAT_FUNC "%10.3" "-" COEFFS 0 10000 0 0 0 1 /end COMPU_METHOD
/begin COMPU_METHOD FORMULA_0844 "FORMULA_0844" RAT_FUNC "%10.3" "-" COEFFS 0 16384 0 0 0 1 /end COMPU_METHOD
/begin COMPU_METHOD FORMULA_0845 "FORMULA_0845" RAT_FUNC "%9.2" "%" COEFFS 0 16384 0 0 0 100 /end COMPU_METHOD
/begin COMPU_METHOD FORMULA_0846 "FORMULA_0846" TAB_VERB "%7.0" "-" COMPU_TAB_REF FORMULA_0846_VTAB /end COMPU_METHOD
/begin COMPU_VTAB FORMULA_0846_VTAB "FORMULA_0846_VTAB" TAB_VERB 5 0 "Aus" 7 "Aktiv" 1 "Einspr. aus" 5 "Einspr. aus" 3 "Zuendung aus" DEFAULT_VALUE "Idle" /end COMPU_VTAB
/begin COMPU_METHOD FORMULA_0847 "FORMULA_0847" TAB_VERB "%7.0" "-" COMPU_TAB_REF FORMULA_0847_VTAB /end COMPU_METHOD
/begin COMPU_VTAB FORMULA_0847_VTAB "FORMULA_0847_VTAB" TAB_VERB 1 0 "Aus" DEFAULT_VALUE "Aktiv" /end COMPU_VTAB
/begin COMPU_METHOD FORMULA_0848 "FORMULA_0848" TAB_VERB "%7.0" "-" COMPU_TAB_REF FORMULA_0848_VTAB /end COMPU_METHOD
/begin COMPU_VTAB FORMULA_0848_VTAB "FORMULA_0848_VTAB" TAB_VERB 1 0 "Ausschwingen ok." DEFAULT_VALUE "Fehler Ausschwingen." /end COMPU_VTAB
/begin COMPU_METHOD FORMULA_0849 "FORMULA_0849" TAB_VERB "%7.0" "-" COMPU_TAB_REF FORMULA_0849_VTAB /end COMPU_METHOD
/begin COMPU_VTAB FORMULA_0849_VTAB "FORMULA_0849_VTAB" TAB_VERB 1 0 "Zyl. 1 ok." DEFAULT_VALUE "Fehler Ausschw. Zyl. 1." /end COMPU_VTAB
/begin COMPU_METHOD FORMULA_0850 "FORMULA_0850" TAB_VERB "%7.0" "-" COMPU_TAB_REF FORMULA_0850_VTAB /end COMPU_METHOD
/begin COMPU_VTAB FORMULA_0850_VTAB "FORMULA_0850_VTAB" TAB_VERB 1 0 "Zyl. 2 ok." DEFAULT_VALUE "Fehler Ausschw. Zyl. 2." /end COMPU_VTAB
/begin COMPU_METHOD FORMULA_0851 "FORMULA_0851" TAB_VERB "%7.0" "-" COMPU_TAB_REF FORMULA_0851_VTAB /end COMPU_METHOD
/begin COMPU_VTAB FORMULA_0851_VTAB "FORMULA_0851_VTAB" TAB_VERB 1 0 "Zyl. 3 ok." DEFAULT_VALUE "Fehler Ausschw. Zyl. 3." /end COMPU_VTAB
/begin COMPU_METHOD FORMULA_0852 "FORMULA_0852" TAB_VERB "%7.0" "-" COMPU_TAB_REF FORMULA_0852_VTAB /end COMPU_METHOD
/begin COMPU_VTAB FORMULA_0852_VTAB "FORMULA_0852_VTAB" TAB_VERB 1 0 "Zyl. 4 ok." DEFAULT_VALUE "Fehler Ausschw. Zyl. 4." /end COMPU_VTAB
/begin COMPU_METHOD FORMULA_0853 "FORMULA_0853" TAB_VERB "%7.0" "-" COMPU_TAB_REF FORMULA_0853_VTAB /end COMPU_METHOD
/begin COMPU_VTAB FORMULA_0853_VTAB "FORMULA_0853_VTAB" TAB_VERB 1 0 "Zyl. 5 ok." DEFAULT_VALUE "Fehler Ausschw. Zyl. 5." /end COMPU_VTAB
/begin COMPU_METHOD FORMULA_0854 "FORMULA_0854" TAB_VERB "%7.0" "-" COMPU_TAB_REF FORMULA_0854_VTAB /end COMPU_METHOD
/begin COMPU_VTAB FORMULA_0854_VTAB "FORMULA_0854_VTAB" TAB_VERB 1 0 "Zyl. 6 ok." DEFAULT_VALUE "Fehler Ausschw. Zyl. 6." /end COMPU_VTAB
/begin COMPU_METHOD FORMULA_0855 "FORMULA_0855" TAB_VERB "%7.0" "-" COMPU_TAB_REF FORMULA_0855_VTAB /end COMPU_METHOD
/begin COMPU_VTAB FORMULA_0855_VTAB "FORMULA_0855_VTAB" TAB_VERB 1 0 "Zyl. 7 ok." DEFAULT_VALUE "Fehler Ausschw. Zyl. 7." /end COMPU_VTAB
/begin COMPU_METHOD FORMULA_0856 "FORMULA_0856" TAB_VERB "%7.0" "-" COMPU_TAB_REF FORMULA_0856_VTAB /end COMPU_METHOD
/begin COMPU_VTAB FORMULA_0856_VTAB "FORMULA_0856_VTAB" TAB_VERB 1 0 "Zyl. 8 ok." DEFAULT_VALUE "Fehler Ausschw. Zyl. 8." /end COMPU_VTAB
/begin COMPU_METHOD FORMULA_0857 "FORMULA_0857" TAB_VERB "%7.0" "-" COMPU_TAB_REF FORMULA_0857_VTAB /end COMPU_METHOD
/begin COMPU_VTAB FORMULA_0857_VTAB "FORMULA_0857_VTAB" TAB_VERB 1 0 "Zyl. 9 ok." DEFAULT_VALUE "Fehler Ausschw. Zyl. 9." /end COMPU_VTAB
/begin COMPU_METHOD FORMULA_0858 "FORMULA_0858" TAB_VERB "%7.0" "-" COMPU_TAB_REF FORMULA_0858_VTAB /end COMPU_METHOD
/begin COMPU_VTAB FORMULA_0858_VTAB "FORMULA_0858_VTAB" TAB_VERB 1 0 "Zyl. 10 ok." DEFAULT_VALUE "Fehler Ausschw. Zyl. 10." /end COMPU_VTAB
/begin COMPU_METHOD FORMULA_0859 "FORMULA_0859" TAB_VERB "%7.0" "-" COMPU_TAB_REF FORMULA_0859_VTAB /end COMPU_METHOD
/begin COMPU_VTAB FORMULA_0859_VTAB "FORMULA_0859_VTAB" TAB_VERB 1 0 "Verbrennung ok." DEFAULT_VALUE "Fehler Verbrennung." /end COMPU_VTAB
/begin COMPU_METHOD FORMULA_0860 "FORMULA_0860" TAB_VERB "%7.0" "-" COMPU_TAB_REF FORMULA_0860_VTAB /end COMPU_METHOD
/begin COMPU_VTAB FORMULA_0860_VTAB "FORMULA_0860_VTAB" TAB_VERB 1 0 "Zyl. 1 ok." DEFAULT_VALUE "Fehler Verbr. Zyl. 1." /end COMPU_VTAB
/begin COMPU_METHOD FORMULA_0861 "FORMULA_0861" TAB_VERB "%7.0" "-" COMPU_TAB_REF FORMULA_0861_VTAB /end COMPU_METHOD
/begin COMPU_VTAB FORMULA_0861_VTAB "FORMULA_0861_VTAB" TAB_VERB 1 0 "Zyl. 2 ok." DEFAULT_VALUE "Fehler Verbr. Zyl. 2." /end COMPU_VTAB
/begin COMPU_METHOD FORMULA_0862 "FORMULA_0862" TAB_VERB "%7.0" "-" COMPU_TAB_REF FORMULA_0862_VTAB /end COMPU_METHOD
/begin COMPU_VTAB FORMULA_0862_VTAB "FORMULA_0862_VTAB" TAB_VERB 1 0 "Zyl. 3 ok." DEFAULT_VALUE "Fehler Verbr. Zyl. 3." /end COMPU_VTAB
/begin COMPU_METHOD FORMULA_0863 "FORMULA_0863" TAB_VERB "%7.0" "-" COMPU_TAB_REF FORMULA_0863_VTAB /end COMPU_METHOD
/begin COMPU_VTAB FORMULA_0863_VTAB "FORMULA_0863_VTAB" TAB_VERB 1 0 "Zyl. 4 ok." DEFAULT_VALUE "Fehler Verbr. Zyl. 4." /end COMPU_VTAB
/begin COMPU_METHOD FORMULA_0864 "FORMULA_0864" TAB_VERB "%7.0" "-" COMPU_TAB_REF FORMULA_0864_VTAB /end COMPU_METHOD
/begin COMPU_VTAB FORMULA_0864_VTAB "FORMULA_0864_VTAB" TAB_VERB 1 0 "Zyl. 5 ok." DEFAULT_VALUE "Fehler Verbr. Zyl. 5." /end COMPU_VTAB
/begin COMPU_METHOD FORMULA_0865 "FORMULA_0865" TAB_VERB "%7.0" "-" COMPU_TAB_REF FORMULA_0865_VTAB /end COMPU_METHOD
/begin COMPU_VTAB FORMULA_0865_VTAB "FORMULA_0865_VTAB" TAB_VERB 1 0 "Zyl. 6 ok." DEFAULT_VALUE "Fehler Verbr. Zyl. 6." /end COMPU_VTAB
/begin COMPU_METHOD FORMULA_0866 "FORMULA_0866" TAB_VERB "%7.0" "-" COMPU_TAB_REF FORMULA_0866_VTAB /end COMPU_METHOD
/begin COMPU_VTAB FORMULA_0866_VTAB "FORMULA_0866_VTAB" TAB_VERB 1 0 "Zyl. 7 ok." DEFAULT_VALUE "Fehler Verbr. Zyl. 7." /end COMPU_VTAB
/begin COMPU_METHOD FORMULA_0867 "FORMULA_0867" TAB_VERB "%7.0" "-" COMPU_TAB_REF FORMULA_0867_VTAB /end COMPU_METHOD
/begin COMPU_VTAB FORMULA_0867_VTAB "FORMULA_0867_VTAB" TAB_VERB 1 0 "Zyl. 8 ok." DEFAULT_VALUE "Fehler Verbr. Zyl. 8." /end COMPU_VTAB
/begin COMPU_METHOD FORMULA_0868 "FORMULA_0868" TAB_VERB "%7.0" "-" COMPU_TAB_REF FORMULA_0868_VTAB /end COMPU_METHOD
/begin COMPU_VTAB FORMULA_0868_VTAB "FORMULA_0868_VTAB" TAB_VERB 1 0 "Zyl. 9 ok." DEFAULT_VALUE "Fehler Verbr. Zyl. 9." /end COMPU_VTAB
/begin COMPU_METHOD FORMULA_0869 "FORMULA_0869" TAB_VERB "%7.0" "-" COMPU_TAB_REF FORMULA_0869_VTAB /end COMPU_METHOD
/begin COMPU_VTAB FORMULA_0869_VTAB "FORMULA_0869_VTAB" TAB_VERB 1 0 "Zyl. 10 ok." DEFAULT_VALUE "Fehler Verbr. Zyl. 10." /end COMPU_VTAB
/begin COMPU_METHOD FORMULA_0870 "FORMULA_0870" TAB_VERB "%7.0" "-" COMPU_TAB_REF FORMULA_0870_VTAB /end COMPU_METHOD
/begin COMPU_VTAB FORMULA_0870_VTAB "FORMULA_0870_VTAB" TAB_VERB 1 0 "Kein Nebenschluss." DEFAULT_VALUE "Fehler Nebenschluss." /end COMPU_VTAB
/begin COMPU_METHOD FORMULA_0871 "FORMULA_0871" TAB_VERB "%7.0" "-" COMPU_TAB_REF FORMULA_0871_VTAB /end COMPU_METHOD
/begin COMPU_VTAB FORMULA_0871_VTAB "FORMULA_0871_VTAB" TAB_VERB 1 0 "Zyl. 1 ok." DEFAULT_VALUE "Fehler Nebenschluss. Zyl. 1." /end COMPU_VTAB
/begin COMPU_METHOD FORMULA_0872 "FORMULA_0872" TAB_VERB "%7.0" "-" COMPU_TAB_REF FORMULA_0872_VTAB /end COMPU_METHOD
/begin COMPU_VTAB FORMULA_0872_VTAB "FORMULA_0872_VTAB" TAB_VERB 1 0 "Zyl. 2 ok." DEFAULT_VALUE "Fehler Nebenschluss. Zyl. 2." /end COMPU_VTAB
/begin COMPU_METHOD FORMULA_0873 "FORMULA_0873" TAB_VERB "%7.0" "-" COMPU_TAB_REF FORMULA_0873_VTAB /end COMPU_METHOD
/begin COMPU_VTAB FORMULA_0873_VTAB "FORMULA_0873_VTAB" TAB_VERB 1 0 "Zyl. 3 ok." DEFAULT_VALUE "Fehler Nebenschluss. Zyl. 3." /end COMPU_VTAB
/begin COMPU_METHOD FORMULA_0874 "FORMULA_0874" TAB_VERB "%7.0" "-" COMPU_TAB_REF FORMULA_0874_VTAB /end COMPU_METHOD
/begin COMPU_VTAB FORMULA_0874_VTAB "FORMULA_0874_VTAB" TAB_VERB 1 0 "Zyl. 4 ok." DEFAULT_VALUE "Fehler Nebenschluss. Zyl. 4." /end COMPU_VTAB
/begin COMPU_METHOD FORMULA_0875 "FORMULA_0875" TAB_VERB "%7.0" "-" COMPU_TAB_REF FORMULA_0875_VTAB /end COMPU_METHOD
/begin COMPU_VTAB FORMULA_0875_VTAB "FORMULA_0875_VTAB" TAB_VERB 1 0 "Zyl. 5 ok." DEFAULT_VALUE "Fehler Nebenschluss. Zyl. 5." /end COMPU_VTAB
/begin COMPU_METHOD FORMULA_0876 "FORMULA_0876" TAB_VERB "%7.0" "-" COMPU_TAB_REF FORMULA_0876_VTAB /end COMPU_METHOD
/begin COMPU_VTAB FORMULA_0876_VTAB "FORMULA_0876_VTAB" TAB_VERB 1 0 "Zyl. 6 ok." DEFAULT_VALUE "Fehler Nebenschluss. Zyl. 6." /end COMPU_VTAB
/begin COMPU_METHOD FORMULA_0877 "FORMULA_0877" TAB_VERB "%7.0" "-" COMPU_TAB_REF FORMULA_0877_VTAB /end COMPU_METHOD
/begin COMPU_VTAB FORMULA_0877_VTAB "FORMULA_0877_VTAB" TAB_VERB 1 0 "Zyl. 7 ok." DEFAULT_VALUE "Fehler Nebenschluss. Zyl. 7." /end COMPU_VTAB
/begin COMPU_METHOD FORMULA_0878 "FORMULA_0878" TAB_VERB "%7.0" "-" COMPU_TAB_REF FORMULA_0878_VTAB /end COMPU_METHOD
/begin COMPU_VTAB FORMULA_0878_VTAB "FORMULA_0878_VTAB" TAB_VERB 1 0 "Zyl. 8 ok." DEFAULT_VALUE "Fehler Nebenschluss. Zyl. 8." /end COMPU_VTAB
/begin COMPU_METHOD FORMULA_0879 "FORMULA_0879" TAB_VERB "%7.0" "-" COMPU_TAB_REF FORMULA_0879_VTAB /end COMPU_METHOD
/begin COMPU_VTAB FORMULA_0879_VTAB "FORMULA_0879_VTAB" TAB_VERB 1 0 "Zyl. 9 ok." DEFAULT_VALUE "Fehler Nebenschluss. Zyl. 9." /end COMPU_VTAB
/begin COMPU_METHOD FORMULA_0880 "FORMULA_0880" TAB_VERB "%7.0" "-" COMPU_TAB_REF FORMULA_0880_VTAB /end COMPU_METHOD
/begin COMPU_VTAB FORMULA_0880_VTAB "FORMULA_0880_VTAB" TAB_VERB 1 0 "Zyl. 10 ok." DEFAULT_VALUE "Fehler Nebenschluss. Zyl. 10." /end COMPU_VTAB
/begin COMPU_METHOD FORMULA_0881 "FORMULA_0881" TAB_VERB "%7.0" "-" COMPU_TAB_REF FORMULA_0881_VTAB /end COMPU_METHOD
/begin COMPU_VTAB FORMULA_0881_VTAB "FORMULA_0881_VTAB" TAB_VERB 11 0 "Aus" 511 "Aktiv" 505 "Einspr. aus" 509 "Einspr. aus" 507 "Zuendung aus" 503 "Rueckziehwinkel" 495 "N Schwelle" 479 "RF Schwelle" 447 "Diag. Fehler" 383 "Pos. Dynamik" 255 "Neg. Dynamik" DEFAULT_VALUE "Idle" /end COMPU_VTAB
/begin COMPU_METHOD FORMULA_0882 "FORMULA_0882" RAT_FUNC "%8.1" "Grad" COEFFS 0 10 0 0 0 1 /end COMPU_METHOD
/begin COMPU_METHOD FORMULA_0883 "FORMULA_0883" TAB_VERB "%7.0" "-" COMPU_TAB_REF FORMULA_0883_VTAB /end COMPU_METHOD
/begin COMPU_VTAB FORMULA_0883_VTAB "FORMULA_0883_VTAB" TAB_VERB 1 0 "Kein Klopfen." DEFAULT_VALUE "Klopfen Erkannt." /end COMPU_VTAB
/begin COMPU_METHOD FORMULA_0884 "FORMULA_0884" RAT_FUNC "%9.2" "*" COEFFS 0 1024 0 0 0 1 /end COMPU_METHOD
/begin COMPU_METHOD FORMULA_0885 "FORMULA_0885" RAT_FUNC "%5.0" "Volt" COEFFS 0 1 0 0 0 0.00080566 /end COMPU_METHOD
/begin COMPU_METHOD FORMULA_0886 "FORMULA_0886" RAT_FUNC "%5.0" "Bar" COEFFS 0 1 0 0 0 0.03223 /end COMPU_METHOD
/begin COMPU_METHOD FORMULA_0887 "FORMULA_0887" RAT_FUNC "%6.1" "Grad" COEFFS 0 100 0 0 0 1 /end COMPU_METHOD
/begin COMPU_METHOD FORMULA_0889 "FORMULA_0889" TAB_VERB "%5.2" "-" COMPU_TAB_REF FORMULA_0889_VTAB /end COMPU_METHOD
/begin COMPU_VTAB FORMULA_0889_VTAB "FORMULA_0889_VTAB" TAB_VERB 1 0 "keine Erfassung" DEFAULT_VALUE "Druckerfassung" /end COMPU_VTAB
/begin COMPU_METHOD FORMULA_0890 "FORMULA_0890" TAB_VERB "%5.2" "-" COMPU_TAB_REF FORMULA_0890_VTAB /end COMPU_METHOD
/begin COMPU_VTAB FORMULA_0890_VTAB "FORMULA_0890_VTAB" TAB_VERB 1 0 "kein Berganfahren" DEFAULT_VALUE "Berganfahren" /end COMPU_VTAB
/begin COMPU_METHOD FORMULA_0891 "FORMULA_0891" TAB_VERB "%5.2" "-" COMPU_TAB_REF FORMULA_0891_VTAB /end COMPU_METHOD
/begin COMPU_VTAB FORMULA_0891_VTAB "FORMULA_0891_VTAB" TAB_VERB 1 0 "keine v-Begrenzung" DEFAULT_VALUE "v-Begrenzung" /end COMPU_VTAB
/begin COMPU_METHOD FORMULA_0892 "FORMULA_0892" TAB_VERB "%5.2" "-" COMPU_TAB_REF FORMULA_0892_VTAB /end COMPU_METHOD
/begin COMPU_VTAB FORMULA_0892_VTAB "FORMULA_0892_VTAB" TAB_VERB 1 0 "keine Begrenzung" DEFAULT_VALUE "Begrenzung" /end COMPU_VTAB
/begin COMPU_METHOD FORMULA_0894 "FORMULA_0894" TAB_VERB "%5.2" "-" COMPU_TAB_REF FORMULA_0894_VTAB /end COMPU_METHOD
/begin COMPU_VTAB FORMULA_0894_VTAB "FORMULA_0894_VTAB" TAB_VERB 1 0 "O.K." DEFAULT_VALUE "Filter" /end COMPU_VTAB
/begin COMPU_METHOD FORMULA_0895 "FORMULA_0895" TAB_VERB "%5.2" "-" COMPU_TAB_REF FORMULA_0895_VTAB /end COMPU_METHOD
/begin COMPU_VTAB FORMULA_0895_VTAB "FORMULA_0895_VTAB" TAB_VERB 1 0 "O.K." DEFAULT_VALUE "Fehler" /end COMPU_VTAB
/begin COMPU_METHOD FORMULA_0896 "FORMULA_0896" TAB_VERB "%5.2" "-" COMPU_TAB_REF FORMULA_0896_VTAB /end COMPU_METHOD
/begin COMPU_VTAB FORMULA_0896_VTAB "FORMULA_0896_VTAB" TAB_VERB 1 0 "O.K." DEFAULT_VALUE "Fehler" /end COMPU_VTAB
/begin COMPU_METHOD FORMULA_0897 "FORMULA_0897" TAB_VERB "%5.2" "-" COMPU_TAB_REF FORMULA_0897_VTAB /end COMPU_METHOD
/begin COMPU_VTAB FORMULA_0897_VTAB "FORMULA_0897_VTAB" TAB_VERB 1 0 "O.K." DEFAULT_VALUE "Fehler" /end COMPU_VTAB
/begin COMPU_METHOD FORMULA_0898 "FORMULA_0898" TAB_VERB "%5.2" "-" COMPU_TAB_REF FORMULA_0898_VTAB /end COMPU_METHOD
/begin COMPU_VTAB FORMULA_0898_VTAB "FORMULA_0898_VTAB" TAB_VERB 1 0 "O.K." DEFAULT_VALUE "Fehler" /end COMPU_VTAB
/begin COMPU_METHOD FORMULA_0899 "FORMULA_0899" TAB_VERB "%5.2" "-" COMPU_TAB_REF FORMULA_0899_VTAB /end COMPU_METHOD
/begin COMPU_VTAB FORMULA_0899_VTAB "FORMULA_0899_VTAB" TAB_VERB 1 0 "O.K." DEFAULT_VALUE "Fehler" /end COMPU_VTAB
/begin COMPU_METHOD FORMULA_0900 "FORMULA_0900" TAB_VERB "%5.2" "-" COMPU_TAB_REF FORMULA_0900_VTAB /end COMPU_METHOD
/begin COMPU_VTAB FORMULA_0900_VTAB "FORMULA_0900_VTAB" TAB_VERB 1 0 "O.K." DEFAULT_VALUE "Bremse" /end COMPU_VTAB
/begin COMPU_METHOD FORMULA_0901 "FORMULA_0901" TAB_VERB "%5.2" "-" COMPU_TAB_REF FORMULA_0901_VTAB /end COMPU_METHOD
/begin COMPU_VTAB FORMULA_0901_VTAB "FORMULA_0901_VTAB" TAB_VERB 1 0 "O.K." DEFAULT_VALUE "Sperre" /end COMPU_VTAB
/begin COMPU_METHOD FORMULA_0902 "FORMULA_0902" RAT_FUNC "%9.4" "-" COEFFS 0 65536 0 0 0 1 /end COMPU_METHOD
/begin COMPU_METHOD FORMULA_0903 "FORMULA_0903" TAB_VERB "%5.2" "-" COMPU_TAB_REF FORMULA_0903_VTAB /end COMPU_METHOD
/begin COMPU_VTAB FORMULA_0903_VTAB "FORMULA_0903_VTAB" TAB_VERB 1 0 "Inaktiv" DEFAULT_VALUE "Aktiv" /end COMPU_VTAB
/* ------------------ Abschnitt erzeugt aus sl_zwd.dat ------------------ */
/begin COMPU_METHOD FORMULA_0908 "FORMULA_0908" TAB_VERB "%3.0" "-" COMPU_TAB_REF FORMULA_0908_VTAB /end COMPU_METHOD
/begin COMPU_VTAB FORMULA_0908_VTAB "FORMULA_0908_VTAB" TAB_VERB 5 0 "ZWD aus" 1 "ZWD ein" 2 "OBD anst." 4 "Test mode" 8 "EXD-Tester" DEFAULT_VALUE "ungueltig" /end COMPU_VTAB
/* ------------------ Abschnitt erzeugt aus smg.dat ------------------ */
/begin COMPU_METHOD FORMULA_0909 "FORMULA_0909" RAT_FUNC "%6.1" "%" COEFFS 0 128 0 0 0 100 /end COMPU_METHOD
/begin COMPU_METHOD FORMULA_0910 "FORMULA_0910" TAB_VERB "%3.0" "-" COMPU_TAB_REF FORMULA_0910_VTAB /end COMPU_METHOD
/begin COMPU_VTAB FORMULA_0910_VTAB "FORMULA_0910_VTAB" TAB_VERB 1 0 "gesperrt" DEFAULT_VALUE "frei" /end COMPU_VTAB
/begin COMPU_METHOD FORMULA_0911 "FORMULA_0911" TAB_VERB "%3.0" "-" COMPU_TAB_REF FORMULA_0911_VTAB /end COMPU_METHOD
/begin COMPU_VTAB FORMULA_0911_VTAB "FORMULA_0911_VTAB" TAB_VERB 1 0 "PT1" DEFAULT_VALUE "Rampe" /end COMPU_VTAB
/begin COMPU_METHOD FORMULA_0912 "FORMULA_0912" TAB_VERB "%3.0" "-" COMPU_TAB_REF FORMULA_0912_VTAB /end COMPU_METHOD
/begin COMPU_VTAB FORMULA_0912_VTAB "FORMULA_0912_VTAB" TAB_VERB 1 0 "nein" DEFAULT_VALUE "erkannt" /end COMPU_VTAB
/begin COMPU_METHOD FORMULA_0913 "FORMULA_0913" TAB_VERB "%5.2" "-" COMPU_TAB_REF FORMULA_0913_VTAB /end COMPU_METHOD
/begin COMPU_VTAB FORMULA_0913_VTAB "FORMULA_0913_VTAB" TAB_VERB 11 0 "undef" 1 "Anfahren" 2 "Anfahren-KD" 3 "Wait-RS" 4 "Anfahren-RS" 5 "Schalten" 6 "Einkuppeln" 7 "Anhalten" 8 "Abwuergen" 9 "Radabriss" 15 "Fehler" /end COMPU_VTAB
/begin COMPU_METHOD FORMULA_0914 "FORMULA_0914" TAB_VERB "%5.2" "-" COMPU_TAB_REF FORMULA_0914_VTAB /end COMPU_METHOD
/begin COMPU_VTAB FORMULA_0914_VTAB "FORMULA_0914_VTAB" TAB_VERB 1 0 "EKR frei" DEFAULT_VALUE "EKR gesperrt" /end COMPU_VTAB
/begin COMPU_METHOD FORMULA_0915 "FORMULA_0915" TAB_VERB "%5.2" "-" COMPU_TAB_REF FORMULA_0915_VTAB /end COMPU_METHOD
/begin COMPU_VTAB FORMULA_0915_VTAB "FORMULA_0915_VTAB" TAB_VERB 1 0 "EKR frei" DEFAULT_VALUE "EKR gesperrt" /end COMPU_VTAB
/begin COMPU_METHOD FORMULA_0916 "FORMULA_0916" TAB_VERB "%5.2" "-" COMPU_TAB_REF FORMULA_0916_VTAB /end COMPU_METHOD
/begin COMPU_VTAB FORMULA_0916_VTAB "FORMULA_0916_VTAB" TAB_VERB 2 0 "Kupplungsschlupf" 1 "kein Schlupf" DEFAULT_VALUE "undefiniert" /end COMPU_VTAB
/begin COMPU_METHOD FORMULA_0918 "FORMULA_0918" TAB_VERB "%5.2" "-" COMPU_TAB_REF FORMULA_0918_VTAB /end COMPU_METHOD
/begin COMPU_VTAB FORMULA_0918_VTAB "FORMULA_0918_VTAB" TAB_VERB 11 0 "Inaktiv" 1 "Abregeln" 2 "Schalten" 3 "Aufregeln" 4 "AKS aktiv" 5 "Anfahren" 6 "Auf-LW" 67 "Auf+Ext" 129 "Ab+Korr" 131 "Auf+Korr" 195 "Auf+Korr+Ext" /end COMPU_VTAB
/begin COMPU_METHOD FORMULA_0919 "FORMULA_0919" TAB_VERB "%5.2" "-" COMPU_TAB_REF FORMULA_0919_VTAB /end COMPU_METHOD
/begin COMPU_VTAB FORMULA_0919_VTAB "FORMULA_0919_VTAB" TAB_VERB 1 0 "inaktiv" DEFAULT_VALUE "aktiv" /end COMPU_VTAB
/begin COMPU_METHOD FORMULA_0920 "FORMULA_0920" TAB_VERB "%5.2" "-" COMPU_TAB_REF FORMULA_0920_VTAB /end COMPU_METHOD
/begin COMPU_VTAB FORMULA_0920_VTAB "FORMULA_0920_VTAB" TAB_VERB 1 0 "inaktiv" DEFAULT_VALUE "aktiv" /end COMPU_VTAB
/begin COMPU_METHOD FORMULA_0921 "FORMULA_0921" TAB_VERB "%5.2" "-" COMPU_TAB_REF FORMULA_0921_VTAB /end COMPU_METHOD
/begin COMPU_VTAB FORMULA_0921_VTAB "FORMULA_0921_VTAB" TAB_VERB 1 0 "inaktiv" DEFAULT_VALUE "aktiv" /end COMPU_VTAB
/begin COMPU_METHOD FORMULA_0922 "FORMULA_0922" TAB_VERB "%5.2" "-" COMPU_TAB_REF FORMULA_0922_VTAB /end COMPU_METHOD
/begin COMPU_VTAB FORMULA_0922_VTAB "FORMULA_0922_VTAB" TAB_VERB 1 0 "Begr." DEFAULT_VALUE "Rohwert" /end COMPU_VTAB
/begin COMPU_METHOD FORMULA_0923 "FORMULA_0923" TAB_VERB "%5.2" "-" COMPU_TAB_REF FORMULA_0923_VTAB /end COMPU_METHOD
/begin COMPU_VTAB FORMULA_0923_VTAB "FORMULA_0923_VTAB" TAB_VERB 1 0 "nein" DEFAULT_VALUE "ja" /end COMPU_VTAB
/begin COMPU_METHOD FORMULA_0924 "FORMULA_0924" TAB_VERB "%5.2" "-" COMPU_TAB_REF FORMULA_0924_VTAB /end COMPU_METHOD
/begin COMPU_VTAB FORMULA_0924_VTAB "FORMULA_0924_VTAB" TAB_VERB 1 0 "inaktiv" DEFAULT_VALUE "aktiv" /end COMPU_VTAB
/begin COMPU_METHOD FORMULA_0925 "FORMULA_0925" TAB_VERB "%5.2" "-" COMPU_TAB_REF FORMULA_0925_VTAB /end COMPU_METHOD
/begin COMPU_VTAB FORMULA_0925_VTAB "FORMULA_0925_VTAB" TAB_VERB 1 0 "Inaktiv" DEFAULT_VALUE "Aktiv" /end COMPU_VTAB
/begin COMPU_METHOD FORMULA_0927 "FORMULA_0927" RAT_FUNC "%4.1" "%" COEFFS 0 256 0 0 0 100 /end COMPU_METHOD
/begin COMPU_METHOD FORMULA_0928 "FORMULA_0928" RAT_FUNC "%10.3" "Nm" COEFFS 0 10000 0 0 0 1 /end COMPU_METHOD
/begin COMPU_METHOD FORMULA_0929 "FORMULA_0929" RAT_FUNC "%10.3" "Nm" COEFFS 0 1000 0 0 0 1 /end COMPU_METHOD
/begin COMPU_METHOD FORMULA_0930 "FORMULA_0930" TAB_VERB "%5.2" "-" COMPU_TAB_REF FORMULA_0930_VTAB /end COMPU_METHOD
/begin COMPU_VTAB FORMULA_0930_VTAB "FORMULA_0930_VTAB" TAB_VERB 4 0 "Inaktiv" 1 "Rampe" 2 "Reduktion" 3 "Rampe+Red" DEFAULT_VALUE "undef" /end COMPU_VTAB
/begin COMPU_METHOD FORMULA_0931 "FORMULA_0931" TAB_VERB "%5.2" "-" COMPU_TAB_REF FORMULA_0931_VTAB /end COMPU_METHOD
/begin COMPU_VTAB FORMULA_0931_VTAB "FORMULA_0931_VTAB" TAB_VERB 11 0 "Inaktiv" 1 "Abregeln" 2 "n-Ziel" 3 "n-Regler" 4 "Aufregeln" 5 "Abwuergen" 6 "Radabriss" 7 "Ab-AKS" 9 "Anfahren" 10 "TZ-Nachlauf" 11 "ABS-Eingr" /end COMPU_VTAB
/begin COMPU_METHOD FORMULA_0932 "FORMULA_0932" TAB_VERB "%5.2" "-" COMPU_TAB_REF FORMULA_0932_VTAB /end COMPU_METHOD
/begin COMPU_VTAB FORMULA_0932_VTAB "FORMULA_0932_VTAB" TAB_VERB 1 0 "gleich" DEFAULT_VALUE "aktualisiert" /end COMPU_VTAB
/begin COMPU_METHOD FORMULA_0933 "FORMULA_0933" TAB_VERB "%5.2" "-" COMPU_TAB_REF FORMULA_0933_VTAB /end COMPU_METHOD
/begin COMPU_VTAB FORMULA_0933_VTAB "FORMULA_0933_VTAB" TAB_VERB 1 0 "ueber" DEFAULT_VALUE "unter" /end COMPU_VTAB
/begin COMPU_METHOD FORMULA_0934 "FORMULA_0934" RAT_FUNC "%8.1" "Nm" COEFFS 0 1000 0 0 0 1 /end COMPU_METHOD
/begin COMPU_METHOD FORMULA_0935 "FORMULA_0935" TAB_VERB "%5.2" "-" COMPU_TAB_REF FORMULA_0935_VTAB /end COMPU_METHOD
/begin COMPU_VTAB FORMULA_0935_VTAB "FORMULA_0935_VTAB" TAB_VERB 4 0 "DN/STG-" 1 "UP/STG-" 2 "DN/STG+" 3 "UP/STG+" /end COMPU_VTAB
/begin COMPU_METHOD FORMULA_0936 "FORMULA_0936" RAT_FUNC "%4.1" "%" COEFFS 0 128 0 0 0 100 /end COMPU_METHOD
/begin COMPU_METHOD FORMULA_0937 "FORMULA_0937" RAT_FUNC "%5.0" "ms" COEFFS 0 1.6 0 0 0 1 /end COMPU_METHOD
/begin COMPU_METHOD FORMULA_0938 "FORMULA_0938" TAB_VERB "%5.2" "-" COMPU_TAB_REF FORMULA_0938_VTAB /end COMPU_METHOD
/begin COMPU_VTAB FORMULA_0938_VTAB "FORMULA_0938_VTAB" TAB_VERB 4 0 "kein Abbruch" 1 "Ablauf-Timeout" 2 "CAN-Timeout" 16 "Doppelschaltung" DEFAULT_VALUE "undefiniert" /end COMPU_VTAB
/begin COMPU_METHOD FORMULA_0940 "FORMULA_0940" RAT_FUNC "%5.0" "Nm" COEFFS 0 1 0 0 0 1 /end COMPU_METHOD
/begin COMPU_METHOD FORMULA_0941 "FORMULA_0941" TAB_VERB "%7.2" "-" COMPU_TAB_REF FORMULA_0941_VTAB /end COMPU_METHOD
/begin COMPU_VTAB FORMULA_0941_VTAB "FORMULA_0941_VTAB" TAB_VERB 9 0 "kein Fehler" 1 "DME-St" 2 "mKupp" 4 "nZiel" 8 "nGetr" 16 "nBerech" 32 "Gang" 64 "nZielMax" 128 "nGetrMax" DEFAULT_VALUE "Mehrfach" /end COMPU_VTAB
/* ------------------ Abschnitt erzeugt aus smg_can.dat ------------------ */
/begin COMPU_METHOD FORMULA_0963 "FORMULA_0963" TAB_VERB "%3.0" "-" COMPU_TAB_REF FORMULA_0963_VTAB /end COMPU_METHOD
/begin COMPU_VTAB FORMULA_0963_VTAB "FORMULA_0963_VTAB" TAB_VERB 8 0 "keine" 1 "SMG1" 2 "SMG2" 3 "SMG1+2" 4 "SMG3" 5 "SMG1+3" 6 "SMG2+3" 7 "SMG1+2+3" /end COMPU_VTAB
/begin COMPU_METHOD FORMULA_0964 "FORMULA_0964" TAB_VERB "%5.2" "-" COMPU_TAB_REF FORMULA_0964_VTAB /end COMPU_METHOD
/begin COMPU_VTAB FORMULA_0964_VTAB "FORMULA_0964_VTAB" TAB_VERB 1 0 "kein Schaltwunsch" DEFAULT_VALUE "Schaltwusch" /end COMPU_VTAB
/begin COMPU_METHOD FORMULA_0965 "FORMULA_0965" TAB_VERB "%5.2" "-" COMPU_TAB_REF FORMULA_0965_VTAB /end COMPU_METHOD
/begin COMPU_VTAB FORMULA_0965_VTAB "FORMULA_0965_VTAB" TAB_VERB 1 0 "offen" DEFAULT_VALUE "Kraftschluss" /end COMPU_VTAB
/begin COMPU_METHOD FORMULA_0966 "FORMULA_0966" TAB_VERB "%5.2" "-" COMPU_TAB_REF FORMULA_0966_VTAB /end COMPU_METHOD
/begin COMPU_VTAB FORMULA_0966_VTAB "FORMULA_0966_VTAB" TAB_VERB 1 0 "FGR ein" DEFAULT_VALUE "FGR aus" /end COMPU_VTAB
/begin COMPU_METHOD FORMULA_0967 "FORMULA_0967" TAB_VERB "%5.2" "-" COMPU_TAB_REF FORMULA_0967_VTAB /end COMPU_METHOD
/begin COMPU_VTAB FORMULA_0967_VTAB "FORMULA_0967_VTAB" TAB_VERB 1 0 "HE aus" DEFAULT_VALUE "HE ein" /end COMPU_VTAB
/* ------------------ Abschnitt erzeugt aus smg_e2.dat ------------------ */
/begin COMPU_METHOD FORMULA_0970 "FORMULA_0970" TAB_VERB "%5.2" "-" COMPU_TAB_REF FORMULA_0970_VTAB /end COMPU_METHOD
/begin COMPU_VTAB FORMULA_0970_VTAB "FORMULA_0970_VTAB" TAB_VERB 5 0 "kein Fehler" 1 "DME-Status" 2 "Motor-Eingr" 4 "nGetr" 8 "Gang" DEFAULT_VALUE "Mehrfachfehler" /end COMPU_VTAB
/begin COMPU_METHOD FORMULA_0971 "FORMULA_0971" TAB_VERB "%5.2" "-" COMPU_TAB_REF FORMULA_0971_VTAB /end COMPU_METHOD
/begin COMPU_VTAB FORMULA_0971_VTAB "FORMULA_0971_VTAB" TAB_VERB 5 0 "Inaktiv" 1 "Abregeln" 2 "Schalten" 3 "Aufregeln" 4 "Ende" /end COMPU_VTAB
/begin COMPU_METHOD FORMULA_0972 "FORMULA_0972" TAB_VERB "%3.0" "-" COMPU_TAB_REF FORMULA_0972_VTAB /end COMPU_METHOD
/begin COMPU_VTAB FORMULA_0972_VTAB "FORMULA_0972_VTAB" TAB_VERB 1 0 "Schub" DEFAULT_VALUE "Zug" /end COMPU_VTAB
/begin COMPU_METHOD FORMULA_0973 "FORMULA_0973" TAB_VERB "%3.0" "-" COMPU_TAB_REF FORMULA_0973_VTAB /end COMPU_METHOD
/begin COMPU_VTAB FORMULA_0973_VTAB "FORMULA_0973_VTAB" TAB_VERB 1 0 "Frei" DEFAULT_VALUE "Sperre" /end COMPU_VTAB
/* ------------------ Abschnitt erzeugt aus start_rl.dat ------------------ */
/begin COMPU_METHOD FORMULA_0974 "FORMULA_0974" TAB_VERB "%3.0" "-" COMPU_TAB_REF FORMULA_0974_VTAB /end COMPU_METHOD
/begin COMPU_VTAB FORMULA_0974_VTAB "FORMULA_0974_VTAB" TAB_VERB 3 0 "aus" 1 "an" 2 "Sperre SH_TO_UB" /end COMPU_VTAB
/begin COMPU_METHOD FORMULA_0986 "FORMULA_0986" RAT_FUNC "%7.2" "min" COEFFS 0 60 0 0 0 1 /end COMPU_METHOD
/* ------------------ Abschnitt erzeugt aus tan.dat ------------------ */
/begin COMPU_METHOD FORMULA_0987 "FORMULA_0987" RAT_FUNC "%8.3" "�C" COEFFS 0 40 10926 0 0 1 /end COMPU_METHOD
/begin COMPU_METHOD FORMULA_0988 "FORMULA_0988" RAT_FUNC "%7.2" "s" COEFFS 0 0 6553.5 0 1 0 /end COMPU_METHOD
/begin COMPU_METHOD FORMULA_0989 "FORMULA_0989" TAB_VERB "%3.0" "-" COMPU_TAB_REF FORMULA_0989_VTAB /end COMPU_METHOD
/begin COMPU_VTAB FORMULA_0989_VTAB "FORMULA_0989_VTAB" TAB_VERB 5 0 "O.K." 1 "Fehler HFM" 2 "Fehler TMOT" 4 "Fehler TUMG" 8 "Fehler time_ms" DEFAULT_VALUE "undef" /end COMPU_VTAB
/begin COMPU_METHOD FORMULA_0990 "FORMULA_0990" TAB_VERB "%3.0" "-" COMPU_TAB_REF FORMULA_0990_VTAB /end COMPU_METHOD
/begin COMPU_VTAB FORMULA_0990_VTAB "FORMULA_0990_VTAB" TAB_VERB 3 0 "kein Ersatzwert" 1 "HFM1 ist Ersatzwert" 2 "HFM2 ist Ersatzwert" DEFAULT_VALUE "undef" /end COMPU_VTAB
/begin COMPU_METHOD FORMULA_0991 "FORMULA_0991" TAB_VERB "%3.0" "-" COMPU_TAB_REF FORMULA_0991_VTAB /end COMPU_METHOD
/begin COMPU_VTAB FORMULA_0991_VTAB "FORMULA_0991_VTAB" TAB_VERB 3 0 "Bedingungen" 1 "O.K." 16 "Fehler" DEFAULT_VALUE "undef" /end COMPU_VTAB
/begin COMPU_METHOD FORMULA_0992 "FORMULA_0992" TAB_VERB "%3.0" "-" COMPU_TAB_REF FORMULA_0992_VTAB /end COMPU_METHOD
/begin COMPU_VTAB FORMULA_0992_VTAB "FORMULA_0992_VTAB" TAB_VERB 3 0 "Fehlt" 1 "O.K." 16 "Fehler" DEFAULT_VALUE "undef" /end COMPU_VTAB
/* ------------------ Abschnitt erzeugt aus time_rel_diag.dat ------------------ */
/begin COMPU_METHOD FORMULA_0998 "FORMULA_0998" TAB_VERB "%5.2" "-" COMPU_TAB_REF FORMULA_0998_VTAB /end COMPU_METHOD
/begin COMPU_VTAB FORMULA_0998_VTAB "FORMULA_0998_VTAB" TAB_VERB 5 1 "Diag. Standzeit aktiv" 2 "Diag. lfd. Betrieb aktiv" 3 "Diag. Std.zt/lfd. Betrieb aktiv" 64 "Diag. abgelaufen" 128 "Diag gesp. Bedg. n. erf." DEFAULT_VALUE "undef." /end COMPU_VTAB
/begin COMPU_METHOD FORMULA_0999 "FORMULA_0999" TAB_VERB "%5.2" "-" COMPU_TAB_REF FORMULA_0999_VTAB /end COMPU_METHOD
/begin COMPU_VTAB FORMULA_0999_VTAB "FORMULA_0999_VTAB" TAB_VERB 13 0 "Initialisierung" 1 "Error Slow MS" 2 "Error Fast MS" 3 "Error Slow-Fast MS" 4 "Error Slow ML" 5 "Error Slow MS/Slow ML" 6 "Error Fast MS/Slow ML" 7 "Error Slow-Fast MS/Slow ML" 8 "Error Fast ML" 9 "Error Slow MS/Fast ML" 10 "Error Fast MS/Fast ML" 64 "time_rel_st i.O." 128 "Timeout CAN-Telegramm" DEFAULT_VALUE "undef." /end COMPU_VTAB
/begin COMPU_METHOD FORMULA_1000 "FORMULA_1000" RAT_FUNC "%7.0" "s" COEFFS 0 1 0 0 0 1 /end COMPU_METHOD
/* ------------------ Abschnitt erzeugt aus tka.dat ------------------ */
/begin COMPU_METHOD FORMULA_1003 "FORMULA_1003" TAB_VERB "%6.1" "-" COMPU_TAB_REF FORMULA_1003_VTAB /end COMPU_METHOD
/begin COMPU_VTAB FORMULA_1003_VTAB "FORMULA_1003_VTAB" TAB_VERB 10 0 "-" 1 "Diag. aktiv" 2 "Diag.bed. n. erf." 4 "TKA-Diag. i.O." 17 "Motor kalt" 33 "Thermostat offen" 65 "unplaus. tka haengt" 129 "unplaus. tka>tmot" 16385 "KS nach UB" 32769 "KS nach Masse" /end COMPU_VTAB
/* ------------------ Abschnitt erzeugt aus tmot.dat ------------------ */
/begin COMPU_METHOD FORMULA_1004 "FORMULA_1004" TAB_VERB "%5.2" "-" COMPU_TAB_REF FORMULA_1004_VTAB /end COMPU_METHOD
/begin COMPU_VTAB FORMULA_1004_VTAB "FORMULA_1004_VTAB" TAB_VERB 1 0 "tmot" DEFAULT_VALUE "tka" /end COMPU_VTAB
/begin COMPU_METHOD FORMULA_1005 "FORMULA_1005" TAB_VERB "%5.2" "-" COMPU_TAB_REF FORMULA_1005_VTAB /end COMPU_METHOD
/begin COMPU_VTAB FORMULA_1005_VTAB "FORMULA_1005_VTAB" TAB_VERB 1 0 "keine Sperre" DEFAULT_VALUE "Sperre" /end COMPU_VTAB
/begin COMPU_METHOD FORMULA_1006 "FORMULA_1006" TAB_VERB "%5.2" "-" COMPU_TAB_REF FORMULA_1006_VTAB /end COMPU_METHOD
/begin COMPU_VTAB FORMULA_1006_VTAB "FORMULA_1006_VTAB" TAB_VERB 1 0 "keine Sperre" DEFAULT_VALUE "Sperre" /end COMPU_VTAB
/begin COMPU_METHOD FORMULA_1007 "FORMULA_1007" TAB_VERB "%5.2" "-" COMPU_TAB_REF FORMULA_1007_VTAB /end COMPU_METHOD
/begin COMPU_VTAB FORMULA_1007_VTAB "FORMULA_1007_VTAB" TAB_VERB 1 0 "keine Sperre" DEFAULT_VALUE "Sperre" /end COMPU_VTAB
/begin COMPU_METHOD FORMULA_1008 "FORMULA_1008" TAB_VERB "%5.2" "-" COMPU_TAB_REF FORMULA_1008_VTAB /end COMPU_METHOD
/begin COMPU_VTAB FORMULA_1008_VTAB "FORMULA_1008_VTAB" TAB_VERB 1 0 "keine Sperre" DEFAULT_VALUE "Sperre" /end COMPU_VTAB
/begin COMPU_METHOD FORMULA_1009 "FORMULA_1009" TAB_VERB "%5.2" "-" COMPU_TAB_REF FORMULA_1009_VTAB /end COMPU_METHOD
/begin COMPU_VTAB FORMULA_1009_VTAB "FORMULA_1009_VTAB" TAB_VERB 1 0 "keine Erkennung" DEFAULT_VALUE "OK-erkannt" /end COMPU_VTAB
/begin COMPU_METHOD FORMULA_1010 "FORMULA_1010" TAB_VERB "%5.2" "-" COMPU_TAB_REF FORMULA_1010_VTAB /end COMPU_METHOD
/begin COMPU_VTAB FORMULA_1010_VTAB "FORMULA_1010_VTAB" TAB_VERB 1 0 "keine Erkennung" DEFAULT_VALUE "OK-erkannt" /end COMPU_VTAB
/begin COMPU_METHOD FORMULA_1011 "FORMULA_1011" TAB_VERB "%5.2" "-" COMPU_TAB_REF FORMULA_1011_VTAB /end COMPU_METHOD
/begin COMPU_VTAB FORMULA_1011_VTAB "FORMULA_1011_VTAB" TAB_VERB 1 0 "keine Erkennung" DEFAULT_VALUE "OK-erkannt" /end COMPU_VTAB
/begin COMPU_METHOD FORMULA_1012 "FORMULA_1012" TAB_VERB "%5.2" "-" COMPU_TAB_REF FORMULA_1012_VTAB /end COMPU_METHOD
/begin COMPU_VTAB FORMULA_1012_VTAB "FORMULA_1012_VTAB" TAB_VERB 1 0 "keine INIT" DEFAULT_VALUE "initialisiert" /end COMPU_VTAB
/begin COMPU_METHOD FORMULA_1013 "FORMULA_1013" RAT_FUNC "%9.2" "kgs/h" COEFFS 0 100 0 0 0 1 /end COMPU_METHOD
/begin COMPU_METHOD FORMULA_1014 "FORMULA_1014" RAT_FUNC "%11.4" "Kelvin" COEFFS 0 10240 0 0 0 1 /end COMPU_METHOD
/* ------------------ Abschnitt erzeugt aus toel.dat ------------------ */
/begin COMPU_METHOD FORMULA_1022 "FORMULA_1022" RAT_FUNC "%11.4" "�C" COEFFS 0 10000 2732000 0 0 1 /end COMPU_METHOD
/begin COMPU_METHOD FORMULA_1023 "FORMULA_1023" RAT_FUNC "%9.4" "Kelvin" COEFFS 0 10000 0 0 0 1 /end COMPU_METHOD
/begin COMPU_METHOD FORMULA_1025 "FORMULA_1025" RAT_FUNC "%7.2" "Anteil [0..1]" COEFFS 0 100 0 0 0 1 /end COMPU_METHOD
/* ------------------ Abschnitt erzeugt aus toel_modell.dat ------------------ */
/begin COMPU_METHOD FORMULA_1026 "FORMULA_1026" RAT_FUNC "%8.3" "kg" COEFFS 0 512 0 0 0 1 /end COMPU_METHOD
/* ------------------ Abschnitt erzeugt aus tpu_ign.dat ------------------ */
/begin COMPU_METHOD FORMULA_1027 "FORMULA_1027" RAT_FUNC "%3.0" "us" COEFFS 0 0.875 0 0 0 1 /end COMPU_METHOD
/* ------------------ Abschnitt erzeugt aus tsgrw.dat ------------------ */
/begin COMPU_METHOD FORMULA_1028 "FORMULA_1028" RAT_FUNC "%6.1" "�C" COEFFS 0 40 10928 0 0 1 /end COMPU_METHOD
/begin COMPU_METHOD FORMULA_1029 "FORMULA_1029" TAB_VERB "%3.0" "-" COMPU_TAB_REF FORMULA_1029_VTAB /end COMPU_METHOD
/begin COMPU_VTAB FORMULA_1029_VTAB "FORMULA_1029_VTAB" TAB_VERB 2 0 "Konstante" 1 "Modell" /end COMPU_VTAB
/begin COMPU_METHOD FORMULA_1030 "FORMULA_1030" RAT_FUNC "%8.3" "Kelvin" COEFFS 0 40 0 0 0 1 /end COMPU_METHOD
/* ------------------ Abschnitt erzeugt aus tumg.dat ------------------ */
/begin COMPU_METHOD FORMULA_1031 "FORMULA_1031" TAB_VERB "%5.2" "-" COMPU_TAB_REF FORMULA_1031_VTAB /end COMPU_METHOD
/begin COMPU_VTAB FORMULA_1031_VTAB "FORMULA_1031_VTAB" TAB_VERB 8 0 "Warte auf Diag.-Bed./CAN" 1 "Diagnose Kaltstart" 2 "Diagnose Modell" 4 "Warte auf Bed. FS-Eintrag" 8 "Diagnosebedingung n.i.O." 16 "Diagnose i. O." 32 "Diagnose n.i.O." 128 "Diagnose gesperrt" DEFAULT_VALUE "undef" /end COMPU_VTAB
/begin COMPU_METHOD FORMULA_1032 "FORMULA_1032" TAB_VERB "%5.2" "-" COMPU_TAB_REF FORMULA_1032_VTAB /end COMPU_METHOD
/begin COMPU_VTAB FORMULA_1032_VTAB "FORMULA_1032_VTAB" TAB_VERB 8 0 "Initialisierung" 1 "Fahrt" 2 "Aufheizen" 3 "Fahrt Aufheizen" 4 "Dynamik" 5 "Fahrt Dynamik" 6 "Aufheizen Dynamik" 7 "Fahrt Aufheizen Dynamik" DEFAULT_VALUE "undef." /end COMPU_VTAB
/begin COMPU_METHOD FORMULA_1033 "FORMULA_1033" TAB_VERB "%5.2" "-" COMPU_TAB_REF FORMULA_1033_VTAB /end COMPU_METHOD
/begin COMPU_VTAB FORMULA_1033_VTAB "FORMULA_1033_VTAB" TAB_VERB 3 0 "kein Vergleichswert" 1 "TUMG_OBD_KALTSTART" 2 "TUMG_OBD_MODELL" DEFAULT_VALUE "undef" /end COMPU_VTAB
/begin COMPU_METHOD FORMULA_1034 "FORMULA_1034" TAB_VERB "%3.0" "-" COMPU_TAB_REF FORMULA_1034_VTAB /end COMPU_METHOD
/begin COMPU_VTAB FORMULA_1034_VTAB "FORMULA_1034_VTAB" TAB_VERB 3 0 "OBD aus" 1 "OBD kontinuierlich" 2 "OBD einmalig" /end COMPU_VTAB
/* ------------------ Abschnitt erzeugt aus tz.dat ------------------ */
/begin COMPU_METHOD FORMULA_1035 "FORMULA_1035" RAT_FUNC "%7.2" "ms" COEFFS 0 10000 0 0 0 8 /end COMPU_METHOD
/begin COMPU_METHOD FORMULA_1036 "FORMULA_1036" RAT_FUNC "%7.2" "Grad/10ms" COEFFS 0 160 0 0 0 1 /end COMPU_METHOD
/begin COMPU_METHOD FORMULA_1037 "FORMULA_1037" TAB_VERB "%3.0" "-" COMPU_TAB_REF FORMULA_1037_VTAB /end COMPU_METHOD
/begin COMPU_VTAB FORMULA_1037_VTAB "FORMULA_1037_VTAB" TAB_VERB 2 0 "inaktiv" 1 "aktiv" DEFAULT_VALUE "ungueltig" /end COMPU_VTAB
/begin COMPU_METHOD FORMULA_1038 "FORMULA_1038" RAT_FUNC "%6.1" "A" COEFFS 0 1000 0 0 0 1 /end COMPU_METHOD
/begin COMPU_METHOD FORMULA_1039 "FORMULA_1039" RAT_FUNC "%3.0" "seg" COEFFS 0 1 0 0 0 2 /end COMPU_METHOD
/begin COMPU_METHOD FORMULA_1040 "FORMULA_1040" RAT_FUNC "%6.1" "�/Segment" COEFFS 0 10 0 0 0 1 /end COMPU_METHOD
/begin COMPU_METHOD FORMULA_1041 "FORMULA_1041" RAT_FUNC "%3.0" "seg" COEFFS 0 -1 1 0 0 -1 /end COMPU_METHOD
/begin COMPU_METHOD FORMULA_1042 "FORMULA_1042" RAT_FUNC "%4.1" "�KW/seg" COEFFS 0 10 0 0 0 1 /end COMPU_METHOD
/begin COMPU_METHOD FORMULA_1043 "FORMULA_1043" RAT_FUNC "%5.2" "-/segment" COEFFS 0 256 0 0 0 1 /end COMPU_METHOD
/* ------------------ Abschnitt erzeugt aus uext.dat ------------------ */
/begin COMPU_METHOD FORMULA_1045 "FORMULA_1045" RAT_FUNC "%7.2" "V" COEFFS 0 30720 0 0 0 200 /end COMPU_METHOD
/* ------------------ Abschnitt erzeugt aus vr.dat ------------------ */
/begin COMPU_METHOD FORMULA_1046 "FORMULA_1046" TAB_VERB "%5.0" "-" COMPU_TAB_REF FORMULA_1046_VTAB /end COMPU_METHOD
/begin COMPU_VTAB FORMULA_1046_VTAB "FORMULA_1046_VTAB" TAB_VERB 2 0 "Alle Aus" 1023 "Alle Aktiv" DEFAULT_VALUE "Mindestens Einer Aus" /end COMPU_VTAB
/begin COMPU_METHOD FORMULA_1047 "FORMULA_1047" TAB_VERB "%5.0" "-" COMPU_TAB_REF FORMULA_1047_VTAB /end COMPU_METHOD
/begin COMPU_VTAB FORMULA_1047_VTAB "FORMULA_1047_VTAB" TAB_VERB 1 0 "Zyl. 1 aktiv." DEFAULT_VALUE "Zyl. 1 aus." /end COMPU_VTAB
/begin COMPU_METHOD FORMULA_1048 "FORMULA_1048" TAB_VERB "%5.0" "-" COMPU_TAB_REF FORMULA_1048_VTAB /end COMPU_METHOD
/begin COMPU_VTAB FORMULA_1048_VTAB "FORMULA_1048_VTAB" TAB_VERB 1 0 "Zyl. 2 aktiv." DEFAULT_VALUE "Zyl. 2 aus." /end COMPU_VTAB
/begin COMPU_METHOD FORMULA_1049 "FORMULA_1049" TAB_VERB "%5.0" "-" COMPU_TAB_REF FORMULA_1049_VTAB /end COMPU_METHOD
/begin COMPU_VTAB FORMULA_1049_VTAB "FORMULA_1049_VTAB" TAB_VERB 1 0 "Zyl. 3 aktiv." DEFAULT_VALUE "Zyl. 3 aus." /end COMPU_VTAB
/begin COMPU_METHOD FORMULA_1050 "FORMULA_1050" TAB_VERB "%5.0" "-" COMPU_TAB_REF FORMULA_1050_VTAB /end COMPU_METHOD
/begin COMPU_VTAB FORMULA_1050_VTAB "FORMULA_1050_VTAB" TAB_VERB 1 0 "Zyl. 4 aktiv." DEFAULT_VALUE "Zyl. 4 aus." /end COMPU_VTAB
/begin COMPU_METHOD FORMULA_1051 "FORMULA_1051" TAB_VERB "%5.0" "-" COMPU_TAB_REF FORMULA_1051_VTAB /end COMPU_METHOD
/begin COMPU_VTAB FORMULA_1051_VTAB "FORMULA_1051_VTAB" TAB_VERB 1 0 "Zyl. 5 aktiv." DEFAULT_VALUE "Zyl. 5 aus." /end COMPU_VTAB
/begin COMPU_METHOD FORMULA_1052 "FORMULA_1052" TAB_VERB "%5.0" "-" COMPU_TAB_REF FORMULA_1052_VTAB /end COMPU_METHOD
/begin COMPU_VTAB FORMULA_1052_VTAB "FORMULA_1052_VTAB" TAB_VERB 1 0 "Zyl. 6 aktiv." DEFAULT_VALUE "Zyl. 6 aus." /end COMPU_VTAB
/begin COMPU_METHOD FORMULA_1053 "FORMULA_1053" TAB_VERB "%5.0" "-" COMPU_TAB_REF FORMULA_1053_VTAB /end COMPU_METHOD
/begin COMPU_VTAB FORMULA_1053_VTAB "FORMULA_1053_VTAB" TAB_VERB 1 0 "Zyl. 7 aktiv." DEFAULT_VALUE "Zyl. 7 aus." /end COMPU_VTAB
/begin COMPU_METHOD FORMULA_1054 "FORMULA_1054" TAB_VERB "%5.0" "-" COMPU_TAB_REF FORMULA_1054_VTAB /end COMPU_METHOD
/begin COMPU_VTAB FORMULA_1054_VTAB "FORMULA_1054_VTAB" TAB_VERB 1 0 "Zyl. 8 aktiv." DEFAULT_VALUE "Zyl. 8 aus." /end COMPU_VTAB
/begin COMPU_METHOD FORMULA_1055 "FORMULA_1055" TAB_VERB "%5.0" "-" COMPU_TAB_REF FORMULA_1055_VTAB /end COMPU_METHOD
/begin COMPU_VTAB FORMULA_1055_VTAB "FORMULA_1055_VTAB" TAB_VERB 1 0 "Zyl. 9 aktiv." DEFAULT_VALUE "Zyl. 9 aus." /end COMPU_VTAB
/begin COMPU_METHOD FORMULA_1056 "FORMULA_1056" TAB_VERB "%5.0" "-" COMPU_TAB_REF FORMULA_1056_VTAB /end COMPU_METHOD
/begin COMPU_VTAB FORMULA_1056_VTAB "FORMULA_1056_VTAB" TAB_VERB 1 0 "Zyl. 10 aktiv." DEFAULT_VALUE "Zyl. 10 aus." /end COMPU_VTAB
/* ------------------ Abschnitt erzeugt aus zoelp.dat ------------------ */
/begin COMPU_METHOD FORMULA_1062 "FORMULA_1062" TAB_VERB "%5.2" "-" COMPU_TAB_REF FORMULA_1062_VTAB /end COMPU_METHOD
/begin COMPU_VTAB FORMULA_1062_VTAB "FORMULA_1062_VTAB" TAB_VERB 5 0 "aus" 1 "an" 2 "an manuel" 4 "an FG" 8 "an EXD" DEFAULT_VALUE "ungueltig" /end COMPU_VTAB
/begin COMPU_METHOD FORMULA_1063 "FORMULA_1063" RAT_FUNC "%4.1" "A" COEFFS 0 10 0 0 0 1 /end COMPU_METHOD
/begin COMPU_METHOD FORMULA_1064 "FORMULA_1064" TAB_VERB "%5.2" "-" COMPU_TAB_REF FORMULA_1064_VTAB /end COMPU_METHOD
/begin COMPU_VTAB FORMULA_1064_VTAB "FORMULA_1064_VTAB" TAB_VERB 4 0 "inaktiv" 1 "aktiv" 5 "B1 aktiv man" 17 "B2 aktiv man" DEFAULT_VALUE "ungueltig" /end COMPU_VTAB
/begin COMPU_METHOD FORMULA_1065 "FORMULA_1065" TAB_VERB "%5.2" "-" COMPU_TAB_REF FORMULA_1065_VTAB /end COMPU_METHOD
/begin COMPU_VTAB FORMULA_1065_VTAB "FORMULA_1065_VTAB" TAB_VERB 2 1 "normal" -1 "um" DEFAULT_VALUE "ungueltig" /end COMPU_VTAB
/* ------------------ Abschnitt erzeugt aus sys_zust.dat ------------------ */ /* ------------------ Abschnitt erzeugt aus tpu_code.dat ------------------ */ /* ------------------ Abschnitt erzeugt aus tpu_kw.dat ------------------ */
/begin CHARACTERISTIC K_TPU_KW_N_MIN "Unterdrehzahl. | EN: Under-speed" VALUE 0x79B40 TKW_VV_VV_UW 100.0 FORMULA_0413 4.0000 10000.0000 /end CHARACTERISTIC
/begin CHARACTERISTIC K_TPU_KW_SYNC_ZAHN "KW Interruptzahn zur NW Sync. | EN: Crankshaft interrupt tooth for camshaft sync" VALUE 0x79B42 TKW_VV_VV_UB 100.0 FORMULA_0003 0.0 59.0000 /end CHARACTERISTIC
/* ------------------ Abschnitt erzeugt aus version.dat ------------------ */
/begin CHARACTERISTIC K_DATENKENNUNG_1_1of5_ "Datenkennsatzkennung Nr. 1" VALUE 0x70262 TKW_VV_VV_UB 100.0 FORMULA_0414 0.0 255.0 /end CHARACTERISTIC
/begin CHARACTERISTIC K_DATENKENNUNG_1_2of5_ "Datenkennsatzkennung Nr. 1" VALUE 0x70263 TKW_VV_VV_UB 100.0 FORMULA_0414 0.0 255.0 /end CHARACTERISTIC
/begin CHARACTERISTIC K_DATENKENNUNG_1_3of5_ "Datenkennsatzkennung Nr. 1 [V912: differs from V452 160E]" VALUE 0x70264 TKW_VV_VV_UB 100.0 FORMULA_0414 0.0 255.0 /end CHARACTERISTIC
/begin CHARACTERISTIC K_DATENKENNUNG_1_4of5_ "Datenkennsatzkennung Nr. 1" VALUE 0x70265 TKW_VV_VV_UB 100.0 FORMULA_0414 0.0 255.0 /end CHARACTERISTIC
/begin CHARACTERISTIC K_DATENKENNUNG_1_5of5_ "Datenkennsatzkennung Nr. 1" VALUE 0x70266 TKW_VV_VV_UB 100.0 FORMULA_0414 0.0 255.0 /end CHARACTERISTIC
/begin CHARACTERISTIC K_DATENKENNUNG_2_1of5_ "Datenkennsatzkennung Nr. 2" VALUE 0x70273 TKW_VV_VV_UB 100.0 FORMULA_0414 0.0 255.0 /end CHARACTERISTIC
/begin CHARACTERISTIC K_DATENKENNUNG_2_2of5_ "Datenkennsatzkennung Nr. 2" VALUE 0x70274 TKW_VV_VV_UB 100.0 FORMULA_0414 0.0 255.0 /end CHARACTERISTIC
/begin CHARACTERISTIC K_DATENKENNUNG_2_3of5_ "Datenkennsatzkennung Nr. 2 [V912: differs from V452 160E]" VALUE 0x70275 TKW_VV_VV_UB 100.0 FORMULA_0414 0.0 255.0 /end CHARACTERISTIC
/begin CHARACTERISTIC K_DATENKENNUNG_2_4of5_ "Datenkennsatzkennung Nr. 2" VALUE 0x70276 TKW_VV_VV_UB 100.0 FORMULA_0414 0.0 255.0 /end CHARACTERISTIC
/begin CHARACTERISTIC K_DATENKENNUNG_2_5of5_ "Datenkennsatzkennung Nr. 2" VALUE 0x70277 TKW_VV_VV_UB 100.0 FORMULA_0414 0.0 255.0 /end CHARACTERISTIC
/begin CHARACTERISTIC K_DATENKENNUNG_3_1of5_ "Datenkennsatzkennung Nr. 3" VALUE 0x70284 TKW_VV_VV_UB 100.0 FORMULA_0414 0.0 255.0 /end CHARACTERISTIC
/begin CHARACTERISTIC K_DATENKENNUNG_3_2of5_ "Datenkennsatzkennung Nr. 3" VALUE 0x70285 TKW_VV_VV_UB 100.0 FORMULA_0414 0.0 255.0 /end CHARACTERISTIC
/begin CHARACTERISTIC K_DATENKENNUNG_3_4of5_ "Datenkennsatzkennung Nr. 3" VALUE 0x70287 TKW_VV_VV_UB 100.0 FORMULA_0414 0.0 255.0 /end CHARACTERISTIC
/begin CHARACTERISTIC K_DATENKENNUNG_3_5of5_ "Datenkennsatzkennung Nr. 3" VALUE 0x70288 TKW_VV_VV_UB 100.0 FORMULA_0414 0.0 255.0 /end CHARACTERISTIC
/begin CHARACTERISTIC K_VERS_PROG "Programmversion | EN: Program version [V912: differs from V452 160E]" VALUE 0x70250 TKW_VV_VV_UW 100.0 FORMULA_0010 0.0 65535.0000 /end CHARACTERISTIC
/begin CHARACTERISTIC K_VERS_PROZ "Prozessorkennung | EN: Processor ID" VALUE 0x70252 TKW_VV_VV_UB 100.0 FORMULA_0417 0.0 255.0 /end CHARACTERISTIC
/begin CHARACTERISTIC K_VERS_NAME "Applikateur | EN: Calibrator ID" VALUE 0x70253 TKW_VV_VV_UB 100.0 FORMULA_0415 0.0 255.0 /end CHARACTERISTIC
/begin CHARACTERISTIC K_VERS_DATEN "Datenversion | EN: Data version" VALUE 0x70254 TKW_VV_VV_UW 100.0 FORMULA_0010 0.0 65535.0000 /end CHARACTERISTIC
/* ------------------ Abschnitt erzeugt aus aq.dat ------------------ */
/begin CHARACTERISTIC K_AQ_DR_REL_GRAD_TAU "TAU fuer dr_rel Gradienten" VALUE 0x702C2 TKW_VV_VV_UB 100.0 FORMULA_0478 0.0051 1.2800 /end CHARACTERISTIC
/begin CHARACTERISTIC K_AQ_DK0_DK_IST_SCHW "DkIst-Schwelle fuer DK0-Erkennung | EN: DkIst-Schwelle fuer DK0 -Erkennung" VALUE 0x702C3 TKW_VV_VV_UB 100.0 FORMULA_0479 0.0 25.5000 /end CHARACTERISTIC
/begin CHARACTERISTIC K_AQ_RF_RG_KORR_FAK "Korrektur der Restgasmenge" VALUE 0x702C4 TKW_VV_VV_UW 100.0 FORMULA_0075 0.0 4.0000 FORMAT "%6.3" /end CHARACTERISTIC
/begin CHARACTERISTIC K_AQ_LLS_ABW_T_MIN "Zeitschwelle fuer LLS eingeregelt | EN: Zeitschwelle fuer LLS eingeregelt" VALUE 0x702C6 TKW_VV_VV_UB 100.0 FORMULA_0352 0.0 1.2750 /end CHARACTERISTIC
/begin CHARACTERISTIC K_AQ_DK_ABW_T_MIN "Zeitschwelle fuer DK eingeregelt | EN: Zeitschwelle fuer DK eingeregelt" VALUE 0x702C7 TKW_VV_VV_UB 100.0 FORMULA_0352 0.0 1.2750 /end CHARACTERISTIC
/begin CHARACTERISTIC K_AQ_DK0_LLS_AQ_SCHW "AqLLS-Schwelle fuer DK0-Erkennung | EN: AqLLS-Schwelle fuer DK0 -Erkennung" VALUE 0x702C8 TKW_VV_VV_UW 100.0 FORMULA_0147 0.0 6500.0000 FORMAT "%4.1" /end CHARACTERISTIC
/begin CHARACTERISTIC KL_AQ_ABS_LLS "Oeffnungquerschnitt LLS (Bank) | EN: Idle air valve (LLS) opening cross-section (per bank)" CURVE 0x702CA TKL_SW_VV_UW 100.0 FORMULA_0147 0.0 6500.0000
 /begin AXIS_DESCR STD_AXIS wdk FORMULA_0001 8 -10.0000 120.0000 FORMAT "%4.1" /end AXIS_DESCR
 FORMAT "%4.1" /end CHARACTERISTIC
/begin CHARACTERISTIC KL_AQ_ABS_DK "Oeffnungsquerschnitt DK (Bank) | EN: Throttle opening cross-section (per bank)" CURVE 0x702EC TKL_SW_VV_UW 100.0 FORMULA_0147 0.0 6500.0000
 /begin AXIS_DESCR STD_AXIS wdk FORMULA_0001 8 -10.0000 120.0000 FORMAT "%4.1" /end AXIS_DESCR
 FORMAT "%4.1" /end CHARACTERISTIC
/begin CHARACTERISTIC KL_AQ_IST_RF_TAU "Tau fuer aq_rf Filter | EN: Tau fuer aq_rf Filter" CURVE 0x7030E TKL_SW_VV_UW 100.0 FORMULA_0477 0.0050 327.6700
 /begin AXIS_DESCR STD_AXIS egas_aq_soll_grad FORMULA_0020 5 -30000.0000 30000.0000 /end AXIS_DESCR
 FORMAT "%5.2" /end CHARACTERISTIC
/begin CHARACTERISTIC KL_AQ_ABS_LLS_ABW_MAX "Schwelle fuer LLS eingeregelt | EN: Threshold for idle air valve settled" CURVE 0x70324 TKL_UW_VV_UW 100.0 FORMULA_0147 0.0 6500.0000
 /begin AXIS_DESCR STD_AXIS aq_soll_lls FORMULA_0147 4 0.0 6500.0000 FORMAT "%4.1" /end AXIS_DESCR
 FORMAT "%4.1" /end CHARACTERISTIC
/begin CHARACTERISTIC KL_AQ_ABS_DK_ABW_MAX "Schwelle fuer DK eingeregelt | EN: Threshold for throttle position settled" CURVE 0x70336 TKL_UW_VV_UW 100.0 FORMULA_0147 0.0 6500.0000
 /begin AXIS_DESCR STD_AXIS aq_soll_dk FORMULA_0147 4 0.0 6500.0000 FORMAT "%4.1" /end AXIS_DESCR
 FORMAT "%4.1" /end CHARACTERISTIC
/begin CHARACTERISTIC KL_AQ_RF_MAX_ROH "maximale rel. Fuellung fuer die AQ-Berchnung " CURVE 0x70348 TKL_SW_VV_SW 100.0 FORMULA_0007 0.0 2.0000 /begin AXIS_DESCR STD_AXIS FORMULA_0006 20 0.0 10000.0000 /end AXIS_DESCR FORMAT "%6.3" /end CHARACTERISTIC
/* ------------------ Abschnitt erzeugt aus diag_tr.dat ------------------ */
/begin CHARACTERISTIC K_DIAG_TR_MAX_ERR "erlaubte Fehler bis zum Eintrag als SG-Interner | EN: Permitted faults before entry as ECU-internal" VALUE 0x70C5C TKW_VV_VV_UB 100.0 FORMULA_0003 0.0 255.0000 /end CHARACTERISTIC
/* ------------------ Abschnitt erzeugt aus j.dat ------------------ */
/begin CHARACTERISTIC K_J_MOTOR "Traegheitsmoment Motor | EN: Moment of inertia, engine" VALUE 0x73482 TKW_VV_VV_UW 100.0 FORMULA_0290 0.0010 120.0000 FORMAT "%5.2" /end CHARACTERISTIC
/begin CHARACTERISTIC K_J_AC "Traegheitsmoment AC | EN: Moment of inertia, A/C compressor" VALUE 0x73484 TKW_VV_VV_UW 100.0 FORMULA_0290 0.0 120.0000 FORMAT "%5.2" /end CHARACTERISTIC
/begin CHARACTERISTIC K_J_FZG_SMG_R "Traegheitsmoment Fzg - SMG | EN: Moment of inertia, vehicle - SMG" VALUE 0x73486 TKW_VV_VV_UW 100.0 FORMULA_0290 0.0 120.0000 FORMAT "%5.2" /end CHARACTERISTIC
/begin CHARACTERISTIC K_J_FZG_SMG_N "Traegheitsmoment Fzg - SMG | EN: Moment of inertia, vehicle - SMG" VALUE 0x73488 TKW_VV_VV_UW 100.0 FORMULA_0290 0.0 120.0000 FORMAT "%5.2" /end CHARACTERISTIC
/begin CHARACTERISTIC K_J_FZG_SMG_1 "Traegheitsmoment Fzg - SMG | EN: Moment of inertia, vehicle - SMG" VALUE 0x7348A TKW_VV_VV_UW 100.0 FORMULA_0290 0.0 120.0000 FORMAT "%5.2" /end CHARACTERISTIC
/begin CHARACTERISTIC K_J_FZG_SMG_2 "Traegheitsmoment Fzg - SMG | EN: Moment of inertia, vehicle - SMG" VALUE 0x7348C TKW_VV_VV_UW 100.0 FORMULA_0290 0.0 120.0000 FORMAT "%5.2" /end CHARACTERISTIC
/begin CHARACTERISTIC K_J_FZG_SMG_3 "Traegheitsmoment Fzg - SMG | EN: Moment of inertia, vehicle - SMG" VALUE 0x7348E TKW_VV_VV_UW 100.0 FORMULA_0290 0.0 120.0000 FORMAT "%5.2" /end CHARACTERISTIC
/begin CHARACTERISTIC K_J_FZG_SMG_4 "Traegheitsmoment Fzg - SMG | EN: Moment of inertia, vehicle - SMG" VALUE 0x73490 TKW_VV_VV_UW 100.0 FORMULA_0290 0.0 120.0000 FORMAT "%5.2" /end CHARACTERISTIC
/begin CHARACTERISTIC K_J_FZG_SMG_5 "Traegheitsmoment Fzg - SMG | EN: Moment of inertia, vehicle - SMG" VALUE 0x73492 TKW_VV_VV_UW 100.0 FORMULA_0290 0.0 120.0000 FORMAT "%5.2" /end CHARACTERISTIC
/begin CHARACTERISTIC K_J_FZG_SMG_6 "Traegheitsmoment Fzg - SMG | EN: Moment of inertia, vehicle - SMG" VALUE 0x73494 TKW_VV_VV_UW 100.0 FORMULA_0290 0.0 120.0000 FORMAT "%5.2" /end CHARACTERISTIC
/begin CHARACTERISTIC K_J_FZG_SMG_7 "Traegheitsmoment Fzg - SMG | EN: Moment of inertia, vehicle - SMG" VALUE 0x73496 TKW_VV_VV_UW 100.0 FORMULA_0290 0.0 120.0000 FORMAT "%5.2" /end CHARACTERISTIC
/begin CHARACTERISTIC K_J_FZG_HSG_R "Traegheitsmoment Fzg - SMG | EN: Moment of inertia, vehicle - SMG" VALUE 0x73498 TKW_VV_VV_UW 100.0 FORMULA_0290 0.0 120.0000 FORMAT "%5.2" /end CHARACTERISTIC
/begin CHARACTERISTIC K_J_FZG_HSG_N "Traegheitsmoment Fzg - SMG | EN: Moment of inertia, vehicle - SMG" VALUE 0x7349A TKW_VV_VV_UW 100.0 FORMULA_0290 0.0 120.0000 FORMAT "%5.2" /end CHARACTERISTIC
/begin CHARACTERISTIC K_J_FZG_HSG_1 "Traegheitsmoment Fzg - SMG | EN: Moment of inertia, vehicle - SMG" VALUE 0x7349C TKW_VV_VV_UW 100.0 FORMULA_0290 0.0 120.0000 FORMAT "%5.2" /end CHARACTERISTIC
/begin CHARACTERISTIC K_J_FZG_HSG_2 "Traegheitsmoment Fzg - SMG | EN: Moment of inertia, vehicle - SMG" VALUE 0x7349E TKW_VV_VV_UW 100.0 FORMULA_0290 0.0 120.0000 FORMAT "%5.2" /end CHARACTERISTIC
/begin CHARACTERISTIC K_J_FZG_HSG_3 "Traegheitsmoment Fzg - SMG | EN: Moment of inertia, vehicle - SMG" VALUE 0x734A0 TKW_VV_VV_UW 100.0 FORMULA_0290 0.0 120.0000 FORMAT "%5.2" /end CHARACTERISTIC
/begin CHARACTERISTIC K_J_FZG_HSG_4 "Traegheitsmoment Fzg - SMG | EN: Moment of inertia, vehicle - SMG" VALUE 0x734A2 TKW_VV_VV_UW 100.0 FORMULA_0290 0.0 120.0000 FORMAT "%5.2" /end CHARACTERISTIC
/begin CHARACTERISTIC K_J_FZG_HSG_5 "Traegheitsmoment Fzg - SMG | EN: Moment of inertia, vehicle - SMG" VALUE 0x734A4 TKW_VV_VV_UW 100.0 FORMULA_0290 0.0 120.0000 FORMAT "%5.2" /end CHARACTERISTIC
/begin CHARACTERISTIC K_J_FZG_HSG_6 "Traegheitsmoment Fzg - SMG | EN: Moment of inertia, vehicle - SMG" VALUE 0x734A6 TKW_VV_VV_UW 100.0 FORMULA_0290 0.0 120.0000 FORMAT "%5.2" /end CHARACTERISTIC
/begin CHARACTERISTIC K_J_FZG_HSG_7 "Traegheitsmoment Fzg - SMG | EN: Moment of inertia, vehicle - SMG" VALUE 0x734A8 TKW_VV_VV_UW 100.0 FORMULA_0290 0.0 120.0000 FORMAT "%5.2" /end CHARACTERISTIC
/begin CHARACTERISTIC K_J_FZG_DKG_R "Traegheitsmoment Fzg - SMG | EN: Moment of inertia, vehicle - SMG" VALUE 0x734AA TKW_VV_VV_UW 100.0 FORMULA_0290 0.0 120.0000 FORMAT "%5.2" /end CHARACTERISTIC
/begin CHARACTERISTIC K_J_FZG_DKG_N "Traegheitsmoment Fzg - SMG | EN: Moment of inertia, vehicle - SMG" VALUE 0x734AC TKW_VV_VV_UW 100.0 FORMULA_0290 0.0 120.0000 FORMAT "%5.2" /end CHARACTERISTIC
/begin CHARACTERISTIC K_J_FZG_DKG_1 "Traegheitsmoment Fzg - SMG | EN: Moment of inertia, vehicle - SMG" VALUE 0x734AE TKW_VV_VV_UW 100.0 FORMULA_0290 0.0 120.0000 FORMAT "%5.2" /end CHARACTERISTIC
/begin CHARACTERISTIC K_J_FZG_DKG_2 "Traegheitsmoment Fzg - SMG | EN: Moment of inertia, vehicle - SMG" VALUE 0x734B0 TKW_VV_VV_UW 100.0 FORMULA_0290 0.0 120.0000 FORMAT "%5.2" /end CHARACTERISTIC
/begin CHARACTERISTIC K_J_FZG_DKG_3 "Traegheitsmoment Fzg - SMG | EN: Moment of inertia, vehicle - SMG" VALUE 0x734B2 TKW_VV_VV_UW 100.0 FORMULA_0290 0.0 120.0000 FORMAT "%5.2" /end CHARACTERISTIC
/begin CHARACTERISTIC K_J_FZG_DKG_4 "Traegheitsmoment Fzg - SMG | EN: Moment of inertia, vehicle - SMG" VALUE 0x734B4 TKW_VV_VV_UW 100.0 FORMULA_0290 0.0 120.0000 FORMAT "%5.2" /end CHARACTERISTIC
/begin CHARACTERISTIC K_J_FZG_DKG_5 "Traegheitsmoment Fzg - SMG | EN: Moment of inertia, vehicle - SMG" VALUE 0x734B6 TKW_VV_VV_UW 100.0 FORMULA_0290 0.0 120.0000 FORMAT "%5.2" /end CHARACTERISTIC
/begin CHARACTERISTIC K_J_FZG_DKG_6 "Traegheitsmoment Fzg - SMG | EN: Moment of inertia, vehicle - SMG" VALUE 0x734B8 TKW_VV_VV_UW 100.0 FORMULA_0290 0.0 120.0000 FORMAT "%5.2" /end CHARACTERISTIC
/begin CHARACTERISTIC K_J_FZG_DKG_7 "Traegheitsmoment Fzg - SMG | EN: Moment of inertia, vehicle - SMG" VALUE 0x734BA TKW_VV_VV_UW 100.0 FORMULA_0290 0.0 120.0000 FORMAT "%5.2" /end CHARACTERISTIC
/* ------------------ Abschnitt erzeugt aus mzyl_sek.dat ------------------ */
/begin CHARACTERISTIC K_MZYL_SEK_AQ_ABS_SSP "Oeffnungquersch. bei SSP ein" VALUE 0x78616 TKW_VV_VV_UW 100.0 FORMULA_0147 0.0 50.0000 FORMAT "%4.1" /end CHARACTERISTIC
/begin CHARACTERISTIC K_MZYL_SEK_SSP_DIAG_CFG "Einfluss SSP Diagnose" VALUE 0x78618 TKW_VV_VV_UB 100.0 FORMULA_0836 0.0 255.0 /end CHARACTERISTIC
/begin CHARACTERISTIC K_MZYL_SEK_MVAC_ABREG "Faktor fuer Abregelung" VALUE 0x7861A TKW_VV_VV_UW 100.0 FORMULA_0837 0.0 1.0000 FORMAT "%6.3" /end CHARACTERISTIC
/begin CHARACTERISTIC K_MZYL_SEK_MVAC_BANK_FAK_1of2_ "Bankspezifische Gewichtung" VALUE 0x7861C TKW_VV_VV_UW 100.0 FORMULA_0075 0.0 4.0000 FORMAT "%6.3" /end CHARACTERISTIC
/begin CHARACTERISTIC K_MZYL_SEK_MVAC_BANK_FAK_2of2_ "Bankspezifische Gewichtung" VALUE 0x7861E TKW_VV_VV_UW 100.0 FORMULA_0075 0.0 4.0000 FORMAT "%6.3" /end CHARACTERISTIC
/begin CHARACTERISTIC K_MZYL_SEK_SSP_BANK_FAK_1of2_ "Bankspezifische Gewichtung" VALUE 0x78620 TKW_VV_VV_UW 100.0 FORMULA_0075 0.0 4.0000 FORMAT "%6.3" /end CHARACTERISTIC
/begin CHARACTERISTIC K_MZYL_SEK_SSP_BANK_FAK_2of2_ "Bankspezifische Gewichtung" VALUE 0x78622 TKW_VV_VV_UW 100.0 FORMULA_0075 0.0 4.0000 FORMAT "%6.3" /end CHARACTERISTIC
/begin CHARACTERISTIC KL_MZYL_SEK_MVAC_N_FAK "Faktor ueber Drehzahl" CURVE 0x78624 TKL_SW_VV_UW 100.0 FORMULA_0075 0.0 4.0000 /begin AXIS_DESCR STD_AXIS FORMULA_0006 8 0.0 10000.0000 /end AXIS_DESCR FORMAT "%6.3" /end CHARACTERISTIC
/begin CHARACTERISTIC KF_MZYL_SEK_MVAC_AQ_ABS "Querschnitt Mastervak" MAP 0x78646 TKF_SW_SW_UW 100.0 FORMULA_0835 0.0 65.0000
 /begin AXIS_DESCR STD_AXIS pdif FORMULA_0077 4 -2000.0000 2000.0000 FORMAT "%4.1" /end AXIS_DESCR
 /begin AXIS_DESCR STD_AXIS FORMULA_0140 6 -5000.0000 5000.0000 /end AXIS_DESCR
 FORMAT "%5.2" /end CHARACTERISTIC
/* ------------------ Abschnitt erzeugt aus schalter_ign.dat ------------------ */
/begin CHARACTERISTIC K_SCHALTER_KS_M_AUF "Schwelle fuer kein Kraftschluss | EN: Schwelle fuer kein Kraftschluss" VALUE 0x78758 TKW_VV_VV_SW 100.0 FORMULA_0009 -100.0000 1000.0000 FORMAT "%4.1" /end CHARACTERISTIC
/begin CHARACTERISTIC K_SCHALTER_KS_M_ZU "Schwelle fuer Kraftschluss | EN: Schwelle fuer Kraftschluss" VALUE 0x7875A TKW_VV_VV_SW 100.0 FORMULA_0009 -100.0000 1000.0000 FORMAT "%4.1" /end CHARACTERISTIC
/begin CHARACTERISTIC K_SCHALTER_BLS_ENTPRELLUNG_E2 "Fehlerentprellschwelle fuer BLS E2 | EN: Fehlerentprellschwelle fuer BLS E2" VALUE 0x7A9A6 TKW_VV_VV_UB 100.0 FORMULA_0003 0.0 255.0000 /end CHARACTERISTIC
/* ------------------ Abschnitt erzeugt aus sl_zwd.dat ------------------ */
/begin CHARACTERISTIC K_SL_ZWD_TV_MIN "Minimal ausgegebenes Tv" VALUE 0x78922 TKW_VV_VV_SW 100.0 FORMULA_0146 0.0 100.0000 FORMAT "%4.1" /end CHARACTERISTIC
/begin CHARACTERISTIC K_SL_ZWD_TV_MAX "Maximal ausgegebenes Tv" VALUE 0x78924 TKW_VV_VV_SW 100.0 FORMULA_0146 0.0 100.0000 FORMAT "%4.1" /end CHARACTERISTIC
/begin CHARACTERISTIC K_SL_ZWD_TV_SLP_TEST "Testtastverhaeltniss wenn SLP" VALUE 0x78926 TKW_VV_VV_SW 100.0 FORMULA_0146 0.0 100.0000 FORMAT "%4.1" /end CHARACTERISTIC
/* ------------------ Abschnitt erzeugt aus smg_e2.dat ------------------ */
/begin CHARACTERISTIC K_SMG_E2_ST_ERR_MAX "max. Fehler fuer Statusvergleich | EN: max. Fehler fuer Statusvergleich" VALUE 0x7A9A8 TKW_VV_VV_UB 100.0 FORMULA_0003 0.0 12.0000 /end CHARACTERISTIC
/begin CHARACTERISTIC K_SMG_MOT_NL_T_MAX_E2 "max. TZ-Nachlaufzeit Ebene 2 | EN: max. TZ-Nachlaufzeit Ebene 2" VALUE 0x7A9AA TKW_VV_VV_UW 100.0 FORMULA_0117 0.0 325.0000 FORMAT "%5.2" /end CHARACTERISTIC
/begin CHARACTERISTIC K_SMG_NGETR_MAX_E2 "max. Getriebedrehzahl Ebene 2 | EN: max. Getriebedrehzahl Ebene 2" VALUE 0x7A9AC TKW_VV_VV_SW 100.0 FORMULA_0006 0.0 20000.0000 /end CHARACTERISTIC
/begin CHARACTERISTIC K_SMG_NGETR_DIFF_E2 "max. Differenz MotGetr Ebene 2 | EN: Unidentified constant read directly by IGN 0x11b18c (chapter unknown)" VALUE 0x7A9AE TKW_VV_VV_SW 100.0 FORMULA_0006 0.0 10000.0000 /end CHARACTERISTIC
/* ------------------ Abschnitt erzeugt aus start_rl.dat ------------------ */
/begin CHARACTERISTIC K_START_RL_BEGINN "Maximale Motordrehzahl beim Anlassbeginn | EN: Maximale Motordrehzahl beim Anlassbeginn" VALUE 0x792F2 TKW_VV_VV_SW 100.0 FORMULA_0006 0.0 10000.0000 /end CHARACTERISTIC
/* ------------------ Abschnitt erzeugt aus tdme.dat ------------------ */
/begin CHARACTERISTIC K_TDME_DIAG_MIN "Unter Grenze Steuergeraetetemperatur | EN: Lower limit, ECU temperature" VALUE 0x7961A TKW_VV_VV_SW 100.0 FORMULA_0987 -50.0000 170.0000 FORMAT "%6.3" /end CHARACTERISTIC
/begin CHARACTERISTIC K_TDME_DIAG_MAX "Obere Grenze Steuergeraetetemperatur | EN: Upper limit, ECU temperature" VALUE 0x7961C TKW_VV_VV_SW 100.0 FORMULA_0987 -50.0000 170.0000 FORMAT "%6.3" /end CHARACTERISTIC
/begin CHARACTERISTIC K_TDME_SCHWELLE_ZAEHLER "Schwelle fuer Langzeitueberwachung | EN: Threshold for long-term monitoring" VALUE 0x7961E TKW_VV_VV_SW 100.0 FORMULA_0023 -50.0000 170.0000 FORMAT "%4.1" /end CHARACTERISTIC
/begin CHARACTERISTIC K_TDME_TAU "Filterkonstante fuer die Steuergeraetetemperatur | EN: Filter constant for ECU temperature" VALUE 0x79620 TKW_VV_VV_UB 100.0 FORMULA_0679 0.1004 25.6000 /end CHARACTERISTIC
/begin CHARACTERISTIC KL_TDME_NTC "Kennlinie Steuergeraetetemperatur | EN: ECU temperature curve" CURVE 0x79622 TKL_SW_VV_SW 100.0 FORMULA_0987 -50.0000 170.0000 /begin AXIS_DESCR STD_AXIS FORMULA_0123 8 0.0 1023.0000 /end AXIS_DESCR FORMAT "%6.3" /end CHARACTERISTIC
/* ------------------ Abschnitt erzeugt aus toel_modell.dat ------------------ */
/begin CHARACTERISTIC K_TOEL_MODELL_LM_INTEGRATOR_DT "Tau fuer toel_modell_lm-Integrator | EN: Tau fuer toel_modell_lm-Integrator" VALUE 0x79A1A TKW_VV_VV_UW 100.0 FORMULA_0988 0.1000 6553.5000 FORMAT "%5.2" /end CHARACTERISTIC
/begin CHARACTERISTIC K_TOEL_MODELL_N_T1 "PT1-Filterzeitkonstante fuer toel_modell_n_filt" VALUE 0x79A1C TKW_VV_VV_UB 100.0 FORMULA_0679 0.1004 25.6000 /end CHARACTERISTIC
/begin CHARACTERISTIC K_TOEL_MODELL_AEBEGR "Aenderungsbegrenzung fuer toel_modell | EN: Aenderungsbegrenzung toel_modell" VALUE 0x79A1E TKW_VV_VV_UW 100.0 FORMULA_0076 0.0 1000.0000 FORMAT "%4.1" /end CHARACTERISTIC
/begin CHARACTERISTIC K_TOEL_MODELL_BEGR_OFFS "Temperaturfenster Begrenzung | EN: Grenzwertueberwachung toel_modell_aufheiz" VALUE 0x79A20 TKW_VV_VV_SW 100.0 FORMULA_0076 -1000.0000 1000.0000 FORMAT "%4.1" /end CHARACTERISTIC
/begin CHARACTERISTIC K_TOEL_MODELL_T_MS "Schwelle Motor steht" VALUE 0x79A22 TKW_VV_VV_UW 100.0 FORMULA_0986 0.0167 1092.2500 FORMAT "%5.2" /end CHARACTERISTIC
/begin CHARACTERISTIC K_TOEL_MODELL_TMOT_GRD_F "toel_modell-Gradient f(Kuehlwassertemp.)" VALUE 0x79A24 TKW_VV_VV_SW 100.0 FORMULA_0497 0.0 1.0000 FORMAT "%5.2" /end CHARACTERISTIC
/begin CHARACTERISTIC KL_TOEL_MODELL_N "n-Einfluss Motorreibung" CURVE 0x79A26 TKL_SW_VV_SW 100.0 FORMULA_1023 0.0 0.0600 /begin AXIS_DESCR STD_AXIS Motordrehzahl FORMULA_0006 6 0.0 10000.0000 /end AXIS_DESCR FORMAT "%7.4" /end CHARACTERISTIC
/begin CHARACTERISTIC KL_TOEL_MODELL_DN "gefilterter n-Einfluss Motorreibung" CURVE 0x79A40 TKL_SW_VV_SW 100.0 FORMULA_1023 -0.0400 0.0400 /begin AXIS_DESCR STD_AXIS FORMULA_0006 6 -10000.0000 10000.0000 /end AXIS_DESCR FORMAT "%7.4" /end CHARACTERISTIC
/begin CHARACTERISTIC KF_TOEL_MODELL_V_TAN_MW "Oelkuehlungsoffset" MAP 0x79A5A TKF_SW_SW_SW 100.0 FORMULA_0076 -50.0000 50.0000 /begin AXIS_DESCR STD_AXIS FORMULA_0078 7 -80.0000 360.0000 FORMAT "%4.1" /end AXIS_DESCR /begin AXIS_DESCR STD_AXIS FORMULA_0023 7 -50.0000 170.0000 FORMAT "%4.1" /end AXIS_DESCR FORMAT "%4.1" /end CHARACTERISTIC
/begin CHARACTERISTIC KF_TOEL_MODELL_WICHT "Wichtungsfaktor toel_modell_kalt" MAP 0x79ADA TKF_SW_SW_UW 100.0 FORMULA_1025 0.0 100.0000 /begin AXIS_DESCR STD_AXIS FORMULA_1026 6 0.0 63.9980 FORMAT "%6.3" /end AXIS_DESCR /begin AXIS_DESCR STD_AXIS FORMULA_0023 6 -50.0000 170.0000 FORMAT "%4.1" /end AXIS_DESCR FORMAT "%5.2" /end CHARACTERISTIC
/* ------------------ Abschnitt erzeugt aus tpu_code_ign.dat ------------------ */ /* ------------------ Abschnitt erzeugt aus tpu_ign.dat ------------------ */
/begin CHARACTERISTIC K_TPU_IGN_MISS_FIRE_TIME "Ini Schliesszeit fuer die Ausgabe von Fehlzuendungen. | EN: Initial dwell time for output of misfires" VALUE 0x79B3C TKW_VV_VV_UB 100.0 FORMULA_1027 0.0 291.4285 /end CHARACTERISTIC
/begin CHARACTERISTIC K_TPU_IGN_MIN_SCI_POS "Ini minimalen Winkelabstand vorm Zuendwinkel. | EN: Initial minimum angle distance before ignition angle" VALUE 0x79B3E TKW_VV_VV_SW 100.0 FORMULA_0710 -360.0000 359.9000 FORMAT "%4.1" /end CHARACTERISTIC
/* ------------------ Abschnitt erzeugt aus tsgrw.dat ------------------ */
/begin CHARACTERISTIC K_TSGRW_TU "Tuning Saugrohrwandtemperatur | EN: Tuning of intake-manifold wall temperature" VALUE 0x79B44 TKW_VV_VV_SW 100.0 FORMULA_1028 -50.0000 170.0000 FORMAT "%4.1" /end CHARACTERISTIC
/begin CHARACTERISTIC K_TSGRW_CFG "Schalter welches TSGRW | EN: Switch selecting intake-manifold wall temperature source" VALUE 0x79B46 TKW_VV_VV_UB 100.0 FORMULA_1029 0.0 255.0 BIT_MASK 0x1 /end CHARACTERISTIC
/begin CHARACTERISTIC K_TSGRW_TAU "Filterkonstante fuer die Saugrohrwandtemperatur | EN: Filter constant for intake-manifold wall temperature" VALUE 0x79B47 TKW_VV_VV_UB 100.0 FORMULA_0679 0.1004 25.6000 /end CHARACTERISTIC
/begin CHARACTERISTIC K_TSGRW_TAU_MS "Filterkonstante fuer die Saugrohrwandtemperatur bei stehendem Motor | EN: Filter constant for intake-manifold wall temperature with engine stopped" VALUE 0x79B48 TKW_VV_VV_UB 100.0 FORMULA_0679 0.1004 25.6000 /end CHARACTERISTIC
/begin CHARACTERISTIC KL_TSGRW_OFFS "Kennlinie Offset | EN: Offset curve" CURVE 0x79B4A TKL_SW_VV_SW 100.0 FORMULA_1030 -800.0000 800.0000 /begin AXIS_DESCR STD_AXIS rf FORMULA_0007 5 0.0 2.0000 FORMAT "%6.3" /end AXIS_DESCR FORMAT "%6.3" /end CHARACTERISTIC
/begin CHARACTERISTIC KL_TSGRW_F "Verhaeltnisfaktor | EN: Ratio factor" CURVE 0x79B60 TKL_SW_VV_UW 100.0 FORMULA_0024 0.0 1.9999 /begin AXIS_DESCR STD_AXIS FORMULA_0023 4 -50.0000 170.0000 FORMAT "%4.1" /end AXIS_DESCR FORMAT "%7.4" /end CHARACTERISTIC
/* ------------------ Abschnitt erzeugt aus tumg.dat ------------------ */
/begin CHARACTERISTIC K_TUMG_OBD_CFG "Schalter Diagnose-Art | EN: 0x00 OBD aus 0x01 OBD kont i- nuierlich 0x02 OBD ei n- malig Schalter Diagnose-Art" VALUE 0x79B74 TKW_VV_VV_UB 100.0 FORMULA_1034 0.0 255.0 /end CHARACTERISTIC
/begin CHARACTERISTIC K_TUMG_OBD_T_POWER_ON "Wartezeit nach Power On | EN: Wartezeit nach Power On" VALUE 0x79B76 TKW_VV_VV_UW 100.0 FORMULA_0021 0.0 655.0000 FORMAT "%5.2" /end CHARACTERISTIC
/begin CHARACTERISTIC K_TUMG_OBD_ML_SUM_MIN "min. Integral-ML-Strom seit Start Modellberechung" VALUE 0x79B78 TKW_VV_VV_SW 100.0 FORMULA_0112 -100.0000 1400.0000 FORMAT "%4.1" /end CHARACTERISTIC
/begin CHARACTERISTIC K_TUMG_OBD_N_MIN "min. Motordrehzahl fuer Modellberechnung" VALUE 0x79B7A TKW_VV_VV_SW 100.0 FORMULA_0006 0.0 10000.0000 /end CHARACTERISTIC
/begin CHARACTERISTIC K_TUMG_OBD_TMOT_MIN "Mindest-Motortemperatur fuer Diagnose" VALUE 0x79B7C TKW_VV_VV_SW 100.0 FORMULA_0023 -50.0000 170.0000 FORMAT "%4.1" /end CHARACTERISTIC
/begin CHARACTERISTIC K_TUMG_OBD_V_MIN "min. Fahrzeuggeschwindigkeit fuer Modellberechnung" VALUE 0x79B7E TKW_VV_VV_SW 100.0 FORMULA_0078 -80.0000 360.0000 FORMAT "%4.1" /end CHARACTERISTIC
/begin CHARACTERISTIC K_TUMG_OBD_V_MAX "max. Fahrzeuggeschwindigkeit fuer Modellberechnung" VALUE 0x79B80 TKW_VV_VV_SW 100.0 FORMULA_0078 -80.0000 360.0000 FORMAT "%4.1" /end CHARACTERISTIC
/begin CHARACTERISTIC K_TUMG_OBD_ML_MIN "min. Luftmassenstrom fuer Modellberechnung" VALUE 0x79B82 TKW_VV_VV_SW 100.0 FORMULA_0112 -100.0000 1400.0000 FORMAT "%4.1" /end CHARACTERISTIC
/begin CHARACTERISTIC K_TUMG_OBD_ML_MAX "max. Luftmassenstrom fuer Modellberechnung" VALUE 0x79B84 TKW_VV_VV_SW 100.0 FORMULA_0112 -100.0000 1400.0000 FORMAT "%4.1" /end CHARACTERISTIC
/begin CHARACTERISTIC K_TUMG_OBD_TAN_MAX "max. zulaessige Ansaugtemperatur fuer Modellfreigabe" VALUE 0x79B86 TKW_VV_VV_SW 100.0 FORMULA_0023 -50.0000 170.0000 FORMAT "%4.1" /end CHARACTERISTIC
/begin CHARACTERISTIC K_TUMG_OBD_TKA_MIN "min. Kuehleraustrittstemperatur fuer Modellfreigabe" VALUE 0x79B88 TKW_VV_VV_SW 100.0 FORMULA_0023 -50.0000 170.0000 FORMAT "%4.1" /end CHARACTERISTIC
/begin CHARACTERISTIC K_TUMG_OBD_TIME_ML_MIN "min. Motorlaufzeit fuer stabile Bedingungen | EN: min. Motorlaufzeit fuer stabile B e-dingungen" VALUE 0x79B8A TKW_VV_VV_UW 100.0 FORMULA_0062 0.0 65535.0000 /end CHARACTERISTIC
/begin CHARACTERISTIC K_TUMG_OBD_TIME_MS_MIN "min. Motorstandzeit fuer Kaltstarterkennung | EN: min. Motorstandzeit fuer Kaltstarte r-kennung" VALUE 0x79B8C TKW_VV_VV_UW 100.0 FORMULA_0627 0.0 1092.2500 /end CHARACTERISTIC
/begin CHARACTERISTIC K_TUMG_OBD_TMOT_START_MAX "max. Motortemperatur bei Start der Kaltstarterkennung | EN: max. Motortemperatur bei Start der Kaltstarterkennung" VALUE 0x79B8E TKW_VV_VV_SW 100.0 FORMULA_0023 -50.0000 170.0000 FORMAT "%4.1" /end CHARACTERISTIC
/begin CHARACTERISTIC K_TUMG_OBD_TMOT_TAN_DELTA_MAX "max. Differenz zwischen tmot und tan fuer Kaltstart | EN: max. Differenz zwischen tmot und tan fuer Kaltstart" VALUE 0x79B90 TKW_VV_VV_SW 100.0 FORMULA_0076 -1000.0000 1000.0000 FORMAT "%4.1" /end CHARACTERISTIC
/begin CHARACTERISTIC K_TUMG_OBD_TAN_MIN "min. tan fuer Kaltstarterkennung" VALUE 0x79B92 TKW_VV_VV_SW 100.0 FORMULA_0023 -50.0000 170.0000 FORMAT "%4.1" /end CHARACTERISTIC
/begin CHARACTERISTIC K_TUMG_OBD_TMOT_KALT_MAX "max. Motortemperatur fuer Kaltstarterkennung | EN: max. Motortemperatur fuer Kaltsta r-terkennung" VALUE 0x79B94 TKW_VV_VV_SW 100.0 FORMULA_0023 -50.0000 170.0000 FORMAT "%4.1" /end CHARACTERISTIC
/begin CHARACTERISTIC K_TUMG_OBD_ML_TMOT_ZK "Tau fuer tumg_obd_model_offset1" VALUE 0x79B96 TKW_VV_VV_UW 100.0 FORMULA_0988 0.1000 6553.5000 FORMAT "%5.2" /end CHARACTERISTIC
/begin CHARACTERISTIC K_TUMG_OBD_MODEL_DELTA_MIN "min. Toleranz zwischen tumg und Modelltemperatur | EN: min. Toleranz zwischen tumg und Modelltemperatur" VALUE 0x79B98 TKW_VV_VV_SW 100.0 FORMULA_0076 -1000.0000 1000.0000 FORMAT "%4.1" /end CHARACTERISTIC
/begin CHARACTERISTIC K_TUMG_OBD_MODEL_DELTA_MAX "max. Toleranz zwischen tumg und Modelltemperatur | EN: max. Toleranz zwischen tumg und Modelltemperatur" VALUE 0x79B9A TKW_VV_VV_SW 100.0 FORMULA_0076 -1000.0000 1000.0000 FORMAT "%4.1" /end CHARACTERISTIC
/begin CHARACTERISTIC K_TUMG_OBD_TIME_SA_MAX "Zeit seit SA" VALUE 0x79B9C TKW_VV_VV_UL 100.0 FORMULA_0152 0.0 655.0000 FORMAT "%5.2" /end CHARACTERISTIC
/begin CHARACTERISTIC K_TUMG_OBD_MODEL_TAU "Tau fuer tumg_obd_model pt1-Filterung" VALUE 0x79BA0 TKW_VV_VV_UW 100.0 FORMULA_0988 0.1000 6553.5000 FORMAT "%5.2" /end CHARACTERISTIC
/begin CHARACTERISTIC K_TUMG_OBD_TAN_SLOW_TAU "Tau fuer pt1-Filterung von tan" VALUE 0x79BA2 TKW_VV_VV_UW 100.0 FORMULA_0988 0.1000 6553.5000 FORMAT "%5.2" /end CHARACTERISTIC
/begin CHARACTERISTIC K_TUMG_OBD_TAN_FAST_TAU "Tau fuer pt1-Filterung von tan" VALUE 0x79BA4 TKW_VV_VV_UW 100.0 FORMULA_0988 0.1000 6553.5000 FORMAT "%5.2" /end CHARACTERISTIC
/begin CHARACTERISTIC K_TUMG_OBD_TAN_FIL_DELTA_MAX "max. Delta zwischen tan-Filterwerten" VALUE 0x79BA6 TKW_VV_VV_SW 100.0 FORMULA_0076 -1000.0000 1000.0000 FORMAT "%4.1" /end CHARACTERISTIC
/begin CHARACTERISTIC KL_TUMG_OBD_V "Tau fuer tumg_obd_model_offset2 | EN: Time constant for tumg_obd_model_offset2" CURVE 0x79BA8 TKL_SW_VV_UW 100.0 FORMULA_0988 0.1000 6553.5000 /begin AXIS_DESCR STD_AXIS FORMULA_0078 8 -80.0000 360.0000 FORMAT "%4.1" /end AXIS_DESCR FORMAT "%5.2" /end CHARACTERISTIC
/begin CHARACTERISTIC KL_TUMG_OBD_MOD_TIME_ML_MIN "min. Motorlaufzeit fuer stabile Bedingungen" CURVE 0x79BCA TKL_SW_VV_UW 100.0 FORMULA_0062 0.0 65535.0000 /begin AXIS_DESCR STD_AXIS FORMULA_0023 4 -50.0000 170.0000 FORMAT "%4.1" /end AXIS_DESCR /end CHARACTERISTIC
/begin CHARACTERISTIC KL_TUMG_OBD_MAX_ERROR "Zaehler fuer Fehlerentprellung" CURVE 0x79BDC TKL_SW_VV_UB 100.0 FORMULA_0003 0.0 255.0000
 /begin AXIS_DESCR STD_AXIS tumg_obd_tan_filter_delta FORMULA_0076 2 -1000.0000 1000.0000 FORMAT "%4.1" /end AXIS_DESCR
/end CHARACTERISTIC
/begin CHARACTERISTIC KF_TUMG_OBD_MODEL_UPDATE_T_MIN "zeitliche Entprellung fuer Modellberechnung" MAP 0x79BE4 TKF_SW_SW_UW 100.0 FORMULA_0073 0.0 6553.5000
 /begin AXIS_DESCR STD_AXIS tumg_obd_abs_diff FORMULA_0076 6 -1000.0000 1000.0000 FORMAT "%4.1" /end AXIS_DESCR
 /begin AXIS_DESCR STD_AXIS FORMULA_0112 3 -100.0000 1400.0000 FORMAT "%4.1" /end AXIS_DESCR
 FORMAT "%4.1" /end CHARACTERISTIC
/begin CHARACTERISTIC KF_TUMG_OBD_TMOT_ML "tumg_obd-Kennfeld tmot-ml-Offset" MAP 0x79C1C TKF_SW_SW_SW 100.0 FORMULA_0076 -1000.0000 1000.0000 /begin AXIS_DESCR STD_AXIS FORMULA_0112 7 -100.0000 1400.0000 FORMAT "%4.1" /end AXIS_DESCR /begin AXIS_DESCR STD_AXIS FORMULA_0023 8 -50.0000 170.0000 FORMAT "%4.1" /end AXIS_DESCR FORMAT "%4.1" /end CHARACTERISTIC
/begin CHARACTERISTIC KF_TUMG_OBD_TKA_V "tumg_obd-Kennfeld tka-v-Offset" MAP 0x79CAC TKF_SW_SW_SW 100.0 FORMULA_0076 -1000.0000 1000.0000 /begin AXIS_DESCR STD_AXIS FORMULA_0078 8 -80.0000 360.0000 FORMAT "%4.1" /end AXIS_DESCR /begin AXIS_DESCR STD_AXIS FORMULA_0023 9 -50.0000 170.0000 FORMAT "%4.1" /end AXIS_DESCR FORMAT "%4.1" /end CHARACTERISTIC
/* ------------------ Abschnitt erzeugt aus tz.dat ------------------ */
/begin CHARACTERISTIC K_TZ_SZ_CONTROL "Kontrollbits Bit1 -> Zyl1 (1: ueber K_TZ_SZ_MCS 0: ueber Funktion) | EN: Kontrollbits Bit1 - > Zyl1 (1: ueber K_TZ_SZ_MCS 0: ueber Funktion)" VALUE 0x79D60 TKW_VV_VV_UW 100.0 FORMULA_0083 0.0 65535.0000 FORMAT "%5.2" /end CHARACTERISTIC
/begin CHARACTERISTIC K_TZ_DIAG_MAX_BESTR_TPU "Schwelle fuer Fehlereintrag Dauerbestromung TPU" VALUE 0x79D62 TKW_VV_VV_UB 100.0 FORMULA_1039 0.0 255.0000 /end CHARACTERISTIC
/begin CHARACTERISTIC K_TZ_MAX "fruehester Zuendwinkel | EN: fruehester Zuendwinkel | [Code V452 IGN 0x667F4] Earliest allowed ignition, last limit in the chain (60 degKW)." VALUE 0x79D64 TKW_VV_VV_SW 100.0 FORMULA_0111 -50.0000 60.0000 FORMAT "%4.1" /end CHARACTERISTIC
/begin CHARACTERISTIC K_TZ_ZWB_B1 "Aenderungsbegrenzung Bereich 1 | EN: Aenderungsbegrenzung B e-reich 1 | [Code V452 IGN 0x660D0/0x667F4] Ignition change limit per segment (symmetric, advance and retard) for range rf below K_TZ_RF_ZWB. Applied to base + TKORR before all offsets; bypassed in start/some states." VALUE 0x79D66 TKW_VV_VV_SW 100.0 FORMULA_1040 0.0 50.0000 FORMAT "%4.1" /end CHARACTERISTIC
/begin CHARACTERISTIC K_TZ_ZWB_B2 "Aenderungsbegrenzung Bereich 2 | EN: Aenderungsbegrenzung B e-reich 2 | [Code V452 IGN 0x660D0/0x667F4] Ignition change limit per segment (symmetric, advance and retard) for range rf above K_TZ_RF_ZWB and n above idle + K_TZ_DN_ZWB. Applied to base + TKORR before all offsets; bypassed in start/some states." VALUE 0x79D68 TKW_VV_VV_SW 100.0 FORMULA_1040 0.0 50.0000 FORMAT "%4.1" /end CHARACTERISTIC
/begin CHARACTERISTIC K_TZ_ZWB_B3 "Aenderungsbegrenzung Bereich 3 | EN: Aenderungsbegrenzung B e-reich 3 | [Code V452 IGN 0x660D0/0x667F4] Ignition change limit per segment (symmetric, advance and retard) for range n at/below llr_n_soll + K_TZ_DN_ZWB. Applied to base + TKORR before all offsets; bypassed in start/some states." VALUE 0x79D6A TKW_VV_VV_SW 100.0 FORMULA_1040 0.0 50.0000 FORMAT "%4.1" /end CHARACTERISTIC
/begin CHARACTERISTIC K_TZ_KH_ZWB_B1 "Aenderungsbegrenzung Bereich 1 im KH | EN: Aenderungsbegrenzung B e-reich 1 im KH | [Code V452 IGN 0x660D0] As K_TZ_ZWB_B1 but during catalyst heating." VALUE 0x79D6C TKW_VV_VV_SW 100.0 FORMULA_1040 0.0 50.0000 FORMAT "%4.1" /end CHARACTERISTIC
/begin CHARACTERISTIC K_TZ_KH_ZWB_B2 "Aenderungsbegrenzung Bereich 2 im KH | EN: Aenderungsbegrenzung B e-reich 2 im KH | [Code V452 IGN 0x660D0] As K_TZ_ZWB_B2 but during catalyst heating." VALUE 0x79D6E TKW_VV_VV_SW 100.0 FORMULA_1040 0.0 50.0000 FORMAT "%4.1" /end CHARACTERISTIC
/begin CHARACTERISTIC K_TZ_KH_ZWB_B3 "Aenderungsbegrenzung Bereich 3 im KH | EN: Aenderungsbegrenzung B e-reich 3 im KH | [Code V452 IGN 0x660D0] As K_TZ_ZWB_B3 but during catalyst heating." VALUE 0x79D70 TKW_VV_VV_SW 100.0 FORMULA_1040 0.0 50.0000 FORMAT "%4.1" /end CHARACTERISTIC
/begin CHARACTERISTIC K_TZ_RF_ZWB "RF Umschaltschwelle fuer ZWB | EN: RF Umschaltschwelle fuer ZWB | [Code V452 IGN 0x660D0] rf threshold selecting K_TZ_ZWB_B1 (below) / B2 (above)." VALUE 0x79D72 TKW_VV_VV_SW 100.0 FORMULA_0007 0.0 2.0000 FORMAT "%6.3" /end CHARACTERISTIC
/begin CHARACTERISTIC K_TZ_KH_RF_ZWB "RF Umschaltschwelle fuer ZWB im KH | EN: RF Umschaltschwelle fuer ZWB im KH | [Code V452 IGN 0x660D0] rf threshold for the KH (cat heating) change limits." VALUE 0x79D74 TKW_VV_VV_SW 100.0 FORMULA_0007 0.0 2.0000 FORMAT "%6.3" /end CHARACTERISTIC
/begin CHARACTERISTIC K_TZ_DN_ZWB "Drehzahl Hysterese fuer ZWB | EN: Drehzahl Hysterese fuer ZWB | [Code V452 IGN 0x660D0] n hysteresis above the idle target speed llr_n_soll for selecting the change-limit range." VALUE 0x79D76 TKW_VV_VV_SW 100.0 FORMULA_0006 0.0 10000.0000 /end CHARACTERISTIC
/begin CHARACTERISTIC K_TZ_MCS "Zuendwinkelkorrektur ueber MCS | EN: Zuendwinkelkorrektur ueber MCS | [Code V452 IGN 0x667F4] Global ignition offset added to both banks after the rate limit (0 here). Not reduced by anything except the final limits." VALUE 0x79D78 TKW_VV_VV_SW 100.0 FORMULA_0111 -50.0000 60.0000 FORMAT "%4.1" /end CHARACTERISTIC
/begin CHARACTERISTIC K_TZ_MCS_Z_ZYL1 "zyl.selektive Zuendwinkelkorrektur ueber MCS | [Code V452 IGN 0x667F4] Cylinder-1 ignition offset, added per cylinder after K_TZ_MCS (cylinder index = bank x 5 + k). Only ZYL1 is referenced directly; the others are read as an array." VALUE 0x79D7A TKW_VV_VV_SW 100.0 FORMULA_0111 -50.0000 60.0000 FORMAT "%4.1" /end CHARACTERISTIC
/begin CHARACTERISTIC K_TZ_MCS_Z_ZYL2 "zyl.selektive Zuendwinkelkorrektur ueber MCS | [Code V452 IGN 0x667F4] Cylinder-2 ignition offset, added per cylinder after K_TZ_MCS (cylinder index = bank x 5 + k). Only ZYL1 is referenced directly; the others are read as an array." VALUE 0x79D7C TKW_VV_VV_SW 100.0 FORMULA_0111 -50.0000 60.0000 FORMAT "%4.1" /end CHARACTERISTIC
/begin CHARACTERISTIC K_TZ_MCS_Z_ZYL3 "zyl.selektive Zuendwinkelkorrektur ueber MCS | [Code V452 IGN 0x667F4] Cylinder-3 ignition offset, added per cylinder after K_TZ_MCS (cylinder index = bank x 5 + k). Only ZYL1 is referenced directly; the others are read as an array." VALUE 0x79D7E TKW_VV_VV_SW 100.0 FORMULA_0111 -50.0000 60.0000 FORMAT "%4.1" /end CHARACTERISTIC
/begin CHARACTERISTIC K_TZ_MCS_Z_ZYL4 "zyl.selektive Zuendwinkelkorrektur ueber MCS | [Code V452 IGN 0x667F4] Cylinder-4 ignition offset, added per cylinder after K_TZ_MCS (cylinder index = bank x 5 + k). Only ZYL1 is referenced directly; the others are read as an array." VALUE 0x79D80 TKW_VV_VV_SW 100.0 FORMULA_0111 -50.0000 60.0000 FORMAT "%4.1" /end CHARACTERISTIC
/begin CHARACTERISTIC K_TZ_MCS_Z_ZYL5 "zyl.selektive Zuendwinkelkorrektur ueber MCS | [Code V452 IGN 0x667F4] Cylinder-5 ignition offset, added per cylinder after K_TZ_MCS (cylinder index = bank x 5 + k). Only ZYL1 is referenced directly; the others are read as an array." VALUE 0x79D82 TKW_VV_VV_SW 100.0 FORMULA_0111 -50.0000 60.0000 FORMAT "%4.1" /end CHARACTERISTIC
/begin CHARACTERISTIC K_TZ_MCS_Z_ZYL6 "zyl.selektive Zuendwinkelkorrektur ueber MCS | [Code V452 IGN 0x667F4] Cylinder-6 ignition offset, added per cylinder after K_TZ_MCS (cylinder index = bank x 5 + k). Only ZYL1 is referenced directly; the others are read as an array." VALUE 0x79D84 TKW_VV_VV_SW 100.0 FORMULA_0111 -50.0000 60.0000 FORMAT "%4.1" /end CHARACTERISTIC
/begin CHARACTERISTIC K_TZ_MCS_Z_ZYL7 "zyl.selektive Zuendwinkelkorrektur ueber MCS | [Code V452 IGN 0x667F4] Cylinder-7 ignition offset, added per cylinder after K_TZ_MCS (cylinder index = bank x 5 + k). Only ZYL1 is referenced directly; the others are read as an array." VALUE 0x79D86 TKW_VV_VV_SW 100.0 FORMULA_0111 -50.0000 60.0000 FORMAT "%4.1" /end CHARACTERISTIC
/begin CHARACTERISTIC K_TZ_MCS_Z_ZYL8 "zyl.selektive Zuendwinkelkorrektur ueber MCS | [Code V452 IGN 0x667F4] Cylinder-8 ignition offset, added per cylinder after K_TZ_MCS (cylinder index = bank x 5 + k). Only ZYL1 is referenced directly; the others are read as an array." VALUE 0x79D88 TKW_VV_VV_SW 100.0 FORMULA_0111 -50.0000 60.0000 FORMAT "%4.1" /end CHARACTERISTIC
/begin CHARACTERISTIC K_TZ_MCS_Z_ZYL9 "zyl.selektive Zuendwinkelkorrektur ueber MCS | [Code V452 IGN 0x667F4] Cylinder-9 ignition offset, added per cylinder after K_TZ_MCS (cylinder index = bank x 5 + k). Only ZYL1 is referenced directly; the others are read as an array." VALUE 0x79D8A TKW_VV_VV_SW 100.0 FORMULA_0111 -50.0000 60.0000 FORMAT "%4.1" /end CHARACTERISTIC
/begin CHARACTERISTIC K_TZ_MCS_Z_ZYL10 "zyl.selektive Zuendwinkelkorrektur ueber MCS | [Code V452 IGN 0x667F4] Cylinder-10 ignition offset, added per cylinder after K_TZ_MCS (cylinder index = bank x 5 + k). Only ZYL1 is referenced directly; the others are read as an array." VALUE 0x79D8C TKW_VV_VV_SW 100.0 FORMULA_0111 -50.0000 60.0000 FORMAT "%4.1" /end CHARACTERISTIC
/begin CHARACTERISTIC K_TZ_UB_ERSATZ "Ub-Ersatzwert fuer Schliesszeitberechnung | EN: Ub-Ersatzwert fuer Schlies s-zeitberechnung" VALUE 0x79D8E TKW_VV_VV_SW 100.0 FORMULA_0008 0.0 28.0000 FORMAT "%4.1" /end CHARACTERISTIC
/begin CHARACTERISTIC K_TZ_KL15_NACHLAUF "Kl15 Nachlauf der Zuendung" VALUE 0x79D90 TKW_VV_VV_UB 100.0 FORMULA_0774 0.0 255.0000 /end CHARACTERISTIC
/begin CHARACTERISTIC K_TZ_ION_COIL "Auswahl integrierte Ionen-Zuendspulen." VALUE 0x79D92 TKW_VV_VV_UW 100.0 FORMULA_0010 0.0 65535.0000 /end CHARACTERISTIC
/begin CHARACTERISTIC K_TZ_SZ_MAX "Spulenstrom bei KH | EN: Maximaler Spulenstrom" VALUE 0x79D94 TKW_VV_VV_SW 100.0 FORMULA_1038 0.0 30.0000 FORMAT "%4.1" /end CHARACTERISTIC
/begin CHARACTERISTIC K_TZ_ABSCH_CTR "Abchalten der Zuendung nach Anzahl von Segmenten " VALUE 0x79D96 TKW_VV_VV_UB 100.0 FORMULA_0774 0.0 255.0000 /end CHARACTERISTIC
/begin CHARACTERISTIC K_TZ_DBGR_DR_REL_TAU "Druckbegrenzung DR_Rel Filter Tau" VALUE 0x79D97 TKW_VV_VV_UB 100.0 FORMULA_0478 0.0051 1.2800 /end CHARACTERISTIC
/begin CHARACTERISTIC K_TZ_DBGR_DR_REL "Triggerschwelle DBGR abh. von dr_rel | [Code V452 IGN 0x66D4C] Minimum dr_rel (higher bank) for the tip-in retard." VALUE 0x79D98 TKW_VV_VV_SW 100.0 FORMULA_0115 0.0 199.9938 FORMAT "%5.2" /end CHARACTERISTIC
/begin CHARACTERISTIC K_TZ_DBGR_ANZ_SEG "Anz. Segmente bis ruecksetzen | EN: Anz. Segmente bis rueckse t-zen | [Code V452 IGN 0x66D4C] Hold time (segments) of the tip-in retard before it ramps back." VALUE 0x79D9A TKW_VV_VV_UB 100.0 FORMULA_1041 1.0000 256.0000 /end CHARACTERISTIC
/begin CHARACTERISTIC K_TZ_DBGR_AUFREG "Aufregelrampe Druckbegrenzung | EN: Aufregelrampe Druckbegren-zung | [Code V452 IGN 0x66D4C] Recovery step per segment of the tip-in retard." VALUE 0x79D9B TKW_VV_VV_UB 100.0 FORMULA_1042 0.0 25.5000 /end CHARACTERISTIC
/begin CHARACTERISTIC K_TZ_SZ_I_VERSCHL_OFFS "SZ-Offset bei Kerzenverschleiss" VALUE 0x79D9C TKW_VV_VV_SW 100.0 FORMULA_1038 0.0 5.0000 FORMAT "%4.1" /end CHARACTERISTIC
/begin CHARACTERISTIC K_TZ_SZ_AUSS_DELAY "Delay fuer Abschaltung der Stromanhebung | EN: Delay fuer Abschaltung der Stromanhebung" VALUE 0x79D9E TKW_VV_VV_UW 100.0 FORMULA_0117 0.0 5.0000 FORMAT "%5.2" /end CHARACTERISTIC
/begin CHARACTERISTIC K_TZ_SZ_MCS "Festwert fuer Schliesszeit | EN: Festwert fuer Schliesszeit" VALUE 0x79DA0 TKW_VV_VV_SW 100.0 FORMULA_1035 0.0 5.0000 FORMAT "%5.2" /end CHARACTERISTIC
/begin CHARACTERISTIC K_TZ_I_BEGR "Begrenzter Spulenstrom bei SA oder Zuendaussetzer | EN: Begrenzter Spulenstrom bei SA oder Zuendaussetzer" VALUE 0x79DA2 TKW_VV_VV_SW 100.0 FORMULA_1038 0.0 30.0000 FORMAT "%4.1" /end CHARACTERISTIC
/begin CHARACTERISTIC K_TZ_I_SA_DELAY "Delay fuer SA Abschaltung | EN: Delay fuer SA Abschaltung" VALUE 0x79DA4 TKW_VV_VV_UW 100.0 FORMULA_0117 0.0 5.0000 FORMAT "%5.2" /end CHARACTERISTIC
/begin CHARACTERISTIC K_TZ_GRAD_TAU "Filterkonstante fuer tz_grad | EN: Filterkonstante fuer tz_grad" VALUE 0x79DA6 TKW_VV_VV_UB 100.0 FORMULA_1043 0.0040 0.9960 /end CHARACTERISTIC
/begin CHARACTERISTIC K_TZ_DBGR_TMOT "Schwelle fuer DBGR-Fkt. aktive | EN: Schwelle fuer DBGR -Fkt. aktive | [Code V452 IGN 0x66D4C] Coolant temperature above which the tip-in retard is active (-40.9 degC = always)." VALUE 0x79DA8 TKW_VV_VV_SW 100.0 FORMULA_0023 -50.0000 170.0000 FORMAT "%4.1" /end CHARACTERISTIC
/begin CHARACTERISTIC K_TZ_NZ_N_MAX "Maximale Drehzahl bei der noch Nachzuender ausgegeben werden. | EN: Maximale Drehzahl bei der noch Nachzuender ausgeg e- ben werden." VALUE 0x79DAA TKW_VV_VV_SW 100.0 FORMULA_0006 0.0 10000.0000 /end CHARACTERISTIC
/begin CHARACTERISTIC K_TZ_NZ_CHARGE "Bestromungszeit fuer Nachzuendpulse." VALUE 0x79DAC TKW_VV_VV_SW 100.0 FORMULA_1035 0.0 5.0000 FORMAT "%5.2" /end CHARACTERISTIC
/begin CHARACTERISTIC K_TZ_NZ_DIS_CHARGE "Funkenbrenndauerbegrenzung vor Nachzuendpulsen." VALUE 0x79DAE TKW_VV_VV_SW 100.0 FORMULA_1035 0.0 5.0000 FORMAT "%5.2" /end CHARACTERISTIC
/begin CHARACTERISTIC K_TZ_NZ_ANZ_B1 "Anzahl der maximal ausgegebenen Nachzuendpulse." VALUE 0x79DB0 TKW_VV_VV_UB 100.0 FORMULA_0003 0.0 10.0000 /end CHARACTERISTIC
/begin CHARACTERISTIC K_TZ_NZ_ANZ_B2 "Anzahl der maximal ausgegebenen Nachzuendpulse." VALUE 0x79DB1 TKW_VV_VV_UB 100.0 FORMULA_0003 0.0 10.0000 /end CHARACTERISTIC
/begin CHARACTERISTIC KL_TZ_START_N "Start Zuendwinkel = f{ n } | EN: Start ignition angle vs engine speed | [Code V452 IGN 0x66284] Start ignition over n; start state only (no engine-running state bits). Sum with KL_TZ_START_TMOT, both banks." CURVE 0x79DB2 TKL_SW_VV_SW 100.0 FORMULA_0111 -50.0000 60.0000 /begin AXIS_DESCR STD_AXIS FORMULA_0006 3 0.0 10000.0000 /end AXIS_DESCR FORMAT "%4.1" /end CHARACTERISTIC
/begin CHARACTERISTIC KL_TZ_START_TMOT "Offset Start Zuendwinkel = f{ tmot } | EN: Ignition-angle offset at start vs engine temperature | [Code V452 IGN 0x66284] Start ignition offset over coolant temperature, added to KL_TZ_START_N." CURVE 0x79DC0 TKL_SW_VV_SW 100.0 FORMULA_0111 -50.0000 60.0000 /begin AXIS_DESCR STD_AXIS FORMULA_0023 3 -50.0000 170.0000 FORMAT "%4.1" /end AXIS_DESCR FORMAT "%4.1" /end CHARACTERISTIC
/begin CHARACTERISTIC KL_TZ_DBGR_TRIGGER "Triggerschwelle fuer dr_rel Grad. | EN: Ignition-angle offset at start vs engine temperature | [Code V452 IGN 0x66D4C] dr_rel gradient threshold for the tip-in retard KL_TZ_DBGR_OFFS." CURVE 0x79DCE TKL_SW_VV_SW 100.0 FORMULA_0276 -655000.0000 655000.0000 /begin AXIS_DESCR STD_AXIS FORMULA_0006 4 0.0 10000.0000 /end AXIS_DESCR /end CHARACTERISTIC
/begin CHARACTERISTIC KL_TZ_DBGR_OFFS "Druckbegrenzungsoffset | [Code V452 IGN 0x66D4C] Tip-in retard (Druckbegrenzung) over n. Triggered when the dr_rel gradient > KL_TZ_DBGR_TRIGGER and dr_rel > K_TZ_DBGR_DR_REL and tmot > K_TZ_DBGR_TMOT; held K_TZ_DBGR_ANZ_SEG segments, then ramps back by K_TZ_DBGR_AUFREG per segment. Combined with knock adaptation by min() (the larger retard wins, not added)." CURVE 0x79DE0 TKL_SW_VV_SW 100.0 FORMULA_0111 -50.0000 60.0000 /begin AXIS_DESCR STD_AXIS FORMULA_0006 7 0.0 10000.0000 /end AXIS_DESCR FORMAT "%4.1" /end CHARACTERISTIC
/begin CHARACTERISTIC KL_TZ_SZ_LAM_OFFS "Schliesszeitoffset aus Lambda | EN: Dwell-time offset from lambda" CURVE 0x79DFE TKL_UW_VV_SW 100.0 FORMULA_1038 0.0 30.0000 /begin AXIS_DESCR STD_AXIS FORMULA_0025 7 0.0 3.9990 FORMAT "%6.3" /end AXIS_DESCR FORMAT "%4.1" /end CHARACTERISTIC
/begin CHARACTERISTIC KL_TZ_SZ_TMOT_OFFS "Schliesszeitoffset aus TMOT | EN: Dwell-time offset from engine temperature" CURVE 0x79E1C TKL_SW_VV_SW 100.0 FORMULA_1038 0.0 30.0000 /begin AXIS_DESCR STD_AXIS FORMULA_0023 6 -50.0000 170.0000 FORMAT "%4.1" /end AXIS_DESCR FORMAT "%4.1" /end CHARACTERISTIC
/begin CHARACTERISTIC KL_TZ_SZ_START_OFFS "Schliesszeitoffset aus TMOT | EN: Dwell-time offset during start" CURVE 0x79E36 TKL_SW_VV_SW 100.0 FORMULA_1038 0.0 30.0000
 /begin AXIS_DESCR STD_AXIS tmot_start FORMULA_0023 6 -50.0000 170.0000 FORMAT "%4.1" /end AXIS_DESCR
 FORMAT "%4.1" /end CHARACTERISTIC
/begin CHARACTERISTIC KL_TZ_SZ_STARTOFFS_TIME "Zeit fuer Schliesszeitoffset im Start | EN: Zeit fuer Schliesszeitoffset im Start" CURVE 0x79E50 TKL_SW_VV_UW 100.0 FORMULA_0021 0.0 655.0000
 /begin AXIS_DESCR STD_AXIS tmot_start FORMULA_0023 6 -50.0000 170.0000 FORMAT "%4.1" /end AXIS_DESCR
 FORMAT "%5.2" /end CHARACTERISTIC
/begin CHARACTERISTIC KF_TZ_LL "Leerlauf Zuendwinkel = f{n,rf} | EN: Idle ignition angle vs engine speed and charge | [Code V452 IGN 0x66284] Idle ignition (n x rf), per bank. Used in the idle states only; then KL_TZ_TKORR_LL is added." MAP 0x79E6A TKF_SW_SW_SW 100.0 FORMULA_0111 -50.0000 60.0000 /begin AXIS_DESCR STD_AXIS FORMULA_0006 10 0.0 10000.0000 /end AXIS_DESCR /begin AXIS_DESCR STD_AXIS FORMULA_0007 4 0.0 2.0000 FORMAT "%6.3" /end AXIS_DESCR FORMAT "%4.1" /end CHARACTERISTIC
/begin CHARACTERISTIC KF_TZ_GRUND "Grundkennfeld Zuendwinkel fuer TL | EN: Base ignition-angle map for part load | [Code V452 IGN 0x66284] Part-load base ignition (n x rf). Part load: per bank with rf_b1/rf_b2. Full load: read with rf_m as the base of the TL->VL blend. Final chain (0x667F4) per cylinder: base + KL_TZ_TKORR -> rate limit K_TZ_ZWB -> + K_TZ_MCS + K_TZ_MCS_Z_ZYLi -> + min(knock adaptation, DBGR) -> + knock control -> torque cut -> max(KF_TZ_MIN) -> min(K_TZ_MAX)." MAP 0x79ED8 TKF_SW_SW_SW 100.0 FORMULA_0111 -50.0000 60.0000 /begin AXIS_DESCR STD_AXIS FORMULA_0006 18 0.0 10000.0000 /end AXIS_DESCR /begin AXIS_DESCR STD_AXIS rf FORMULA_0007 12 0.0 2.0000 FORMAT "%6.3" /end AXIS_DESCR FORMAT "%4.1" /end CHARACTERISTIC
/begin CHARACTERISTIC KF_TZ_VL "Vollast Zuendwinkel | EN: Full-load ignition angle | [Code V452 IGN 0x66284] Full-load ignition (n x pumg = ambient pressure rows 700/960/1030 mbar). Only in full-load state. tz = KF_TZ_GRUND(n,rf_m) + (KF_TZ_VL - KF_TZ_GRUND) x tz_tl_vl_fak, with tz_tl_vl_fak = (md_wunsch_rel - KL_ZUST_MD_TL_VL)/(100 % - KL_ZUST_MD_TL_VL): 0 at 90 % torque demand, 1.0 at 100 %. Same value for both banks. Then reduced by knock adaptation (incl. KF_KA_OFFS_VL), knock control and floored by KF_TZ_MIN." MAP 0x7A0C6 TKF_SW_SW_SW 100.0 FORMULA_0111 -50.0000 60.0000 /begin AXIS_DESCR STD_AXIS FORMULA_0006 18 0.0 10000.0000 /end AXIS_DESCR /begin AXIS_DESCR STD_AXIS FORMULA_0077 3 400.0000 1200.0000 FORMAT "%4.1" /end AXIS_DESCR FORMAT "%4.1" /end CHARACTERISTIC
/begin CHARACTERISTIC KL_TZ_TKORR_LL "tmot-Zuendwinkelkorrektur fuer LL | [Code V452 IGN 0x660D0/0x667F4] Coolant-temperature correction added to the base angle at idle." CURVE 0x7A15E TKL_SW_VV_SW 100.0 FORMULA_0111 -50.0000 60.0000 /begin AXIS_DESCR STD_AXIS FORMULA_0023 6 -50.0000 170.0000 FORMAT "%4.1" /end AXIS_DESCR FORMAT "%4.1" /end CHARACTERISTIC
/begin CHARACTERISTIC KL_TZ_TKORR_TL "tmot-Zuendwinkelkorrektur fuer TL | [Code V452 IGN 0x660D0/0x667F4] Coolant-temperature correction added to the base angle in part load (all 0 here). 0 in full load." CURVE 0x7A178 TKL_SW_VV_SW 100.0 FORMULA_0111 -50.0000 60.0000 /begin AXIS_DESCR STD_AXIS FORMULA_0023 6 -50.0000 170.0000 FORMAT "%4.1" /end AXIS_DESCR FORMAT "%4.1" /end CHARACTERISTIC
/begin CHARACTERISTIC KL_TZ_PHASE "Zuendwinkel Schaubabschaltern = f{ n } | EN: Ignition angle during shift cut vs engine speed | [Code V452 IGN 0x667F4] Phase offset added only for the output timing (tz_zyl + tz_phase); not part of the ignition value used by knock/torque." CURVE 0x7A192 TKL_SW_VV_SW 100.0 FORMULA_0111 -50.0000 60.0000 /begin AXIS_DESCR STD_AXIS FORMULA_0006 4 0.0 10000.0000 /end AXIS_DESCR FORMAT "%4.1" /end CHARACTERISTIC
/begin CHARACTERISTIC KL_TZ_MIN_TMOT "Offset spaetest zulaessiger Zuendwinkel | EN: Offset of latest permitted ignition angle | [Code V452 IGN 0x66284] Coolant-temperature offset added to KF_TZ_MIN (all 0 here)." CURVE 0x7A1A4 TKL_SW_VV_SW 100.0 FORMULA_0111 -50.0000 60.0000 /begin AXIS_DESCR STD_AXIS FORMULA_0023 4 -50.0000 170.0000 FORMAT "%4.1" /end AXIS_DESCR FORMAT "%4.1" /end CHARACTERISTIC
/begin CHARACTERISTIC KF_TZ_I "Stromkennfeld fuer die SZ-Berechnung | EN: Coil-current map for dwell calculation" MAP 0x7A1B6 TKF_SW_SW_SW 100.0 FORMULA_1038 0.0 30.0000 /begin AXIS_DESCR STD_AXIS FORMULA_0006 5 0.0 10000.0000 /end AXIS_DESCR /begin AXIS_DESCR STD_AXIS rf FORMULA_0007 7 0.0 2.0000 FORMAT "%6.3" /end AXIS_DESCR FORMAT "%4.1" /end CHARACTERISTIC
/begin CHARACTERISTIC KF_TZ_MIN "spaetest zulaessiger Zuendwinkel | EN: Coil-current map for dwell calculation | [Code V452 IGN 0x66284/0x667F4] Latest allowed ignition (n x rf_b) + KL_TZ_MIN_TMOT = tz_min_b. Applied AFTER knock adaptation, knock control and torque intervention: no retard can go later than this. It also caps the knock-control step (0x454BC). At high load it is the real limit on total retard (e.g. 5000 rpm rf 0.9: 18 degKW)." MAP 0x7A216 TKF_SW_SW_SW 100.0 FORMULA_0111 -50.0000 60.0000 /begin AXIS_DESCR STD_AXIS FORMULA_0006 8 0.0 10000.0000 /end AXIS_DESCR /begin AXIS_DESCR STD_AXIS rf FORMULA_0007 6 0.0 2.0000 FORMAT "%6.3" /end AXIS_DESCR FORMAT "%4.1" /end CHARACTERISTIC
/begin CHARACTERISTIC KF_TZ_I_SZ "Schliesszeit Kennfeld | EN: Dwell time map" MAP 0x7A294 TKF_SW_SW_SW 100.0 FORMULA_1035 0.0 26.2136 /begin AXIS_DESCR STD_AXIS tz_sz_i FORMULA_1038 5 0.0 30.0000 FORMAT "%4.1" /end AXIS_DESCR /begin AXIS_DESCR STD_AXIS FORMULA_0008 7 0.0 28.0000 FORMAT "%4.1" /end AXIS_DESCR FORMAT "%5.2" /end CHARACTERISTIC
/* ------------------ Abschnitt erzeugt aus uext.dat ------------------ */
/begin CHARACTERISTIC K_UEXT_TAU "Filterkonstante Versorgungsspannung | EN: Filter constant, supply voltage" VALUE 0x7A306 TKW_VV_VV_UB 100.0 FORMULA_0478 0.0051 1.2800 /end CHARACTERISTIC
/begin CHARACTERISTIC K_UEXT_DIAG_MIN "Untere Grenze Versorgungsspannung | EN: Lower limit, supply voltage" VALUE 0x7A308 TKW_VV_VV_UW 100.0 FORMULA_1045 4.0000 5.0000 FORMAT "%5.2" /end CHARACTERISTIC
/begin CHARACTERISTIC K_UEXT_DIAG_MAX "Obere Grenze Versorgungsspannung | EN: Upper limit, supply voltage" VALUE 0x7A30A TKW_VV_VV_UW 100.0 FORMULA_1045 5.0000 6.0000 FORMAT "%5.2" /end CHARACTERISTIC
/begin CHARACTERISTIC K_UEXT_ERSATZ "Ersatzwert Versorgungsspannung | EN: Substitute value, supply voltage" VALUE 0x7A30C TKW_VV_VV_UW 100.0 FORMULA_1045 4.0000 6.0000 FORMAT "%5.2" /end CHARACTERISTIC
/* ------------------ Abschnitt erzeugt aus uintern.dat ------------------ */
/begin CHARACTERISTIC K_UINTERN_AD_1_8_MAX "Maximaler AD-Wert interne Versorgungsspannung | EN: Maximum A/D value, internal supply voltage" VALUE 0x7A30E TKW_VV_VV_SW 100.0 FORMULA_0123 0.0 1023.0000 /end CHARACTERISTIC
/begin CHARACTERISTIC K_UINTERN_AD_1_8_MIN "Minimaler AD-Wert interne Versorgungsspannung | EN: Minimum A/D value, internal supply voltage" VALUE 0x7A310 TKW_VV_VV_SW 100.0 FORMULA_0123 0.0 1023.0000 /end CHARACTERISTIC
/begin CHARACTERISTIC K_UINTERN_AD_2_55_MAX "Maximaler AD-Wert interne Versorgungsspannung | EN: Maximum A/D value, internal supply voltage" VALUE 0x7A312 TKW_VV_VV_SW 100.0 FORMULA_0123 0.0 1023.0000 /end CHARACTERISTIC
/begin CHARACTERISTIC K_UINTERN_AD_2_55_MIN "Minimaler AD-Wert interne Versorgungsspannung | EN: Minimum A/D value, internal supply voltage" VALUE 0x7A314 TKW_VV_VV_SW 100.0 FORMULA_0123 0.0 1023.0000 /end CHARACTERISTIC
/begin CHARACTERISTIC K_UINTERN_AD_3_3_MAX "Maximaler AD-Wert interne Versorgungsspannung | EN: Maximum A/D value, internal supply voltage" VALUE 0x7A316 TKW_VV_VV_SW 100.0 FORMULA_0123 0.0 1023.0000 /end CHARACTERISTIC
/begin CHARACTERISTIC K_UINTERN_AD_3_3_MIN "Minimaler AD-Wert interne Versorgungsspannung | EN: Minimum A/D value, internal supply voltage" VALUE 0x7A318 TKW_VV_VV_SW 100.0 FORMULA_0123 0.0 1023.0000 /end CHARACTERISTIC
/begin CHARACTERISTIC K_UINTERN_FEHLER_ZAEHLER "Maximalwert des Fehlerfilters | EN: Maximum value of fault filter" VALUE 0x7A31A TKW_VV_VV_UW 100.0 FORMULA_0010 0.0 65535.0000 /end CHARACTERISTIC
/* ------------------ Abschnitt erzeugt aus zoelp.dat ------------------ */
/begin CHARACTERISTIC K_ZOELP_CFG "Konfig ZOELP | EN: Konfig ZOELP" VALUE 0x7A522 TKW_VV_VV_UB 100.0 FORMULA_1064 0.0 255.0 /end CHARACTERISTIC
/begin CHARACTERISTIC K_ZOELP_AN "Querbeschleunigungsschwelle fuer OELP an | EN: Querbeschleunigungsschwelle fuer OELP an" VALUE 0x7A524 TKW_VV_VV_SW 100.0 FORMULA_0132 -20.0000 20.0000 FORMAT "%5.2" /end CHARACTERISTIC
/begin CHARACTERISTIC K_ZOELP_HYS "Querbeschleunigungshysterese fuer OELP an | EN: Querbeschleunigungshysterese fuer OELP an" VALUE 0x7A526 TKW_VV_VV_SW 100.0 FORMULA_0132 -20.0000 20.0000 FORMAT "%5.2" /end CHARACTERISTIC
/begin CHARACTERISTIC K_ZOELP_UM "Vorzeichenumkehr fuer can_ay | EN: Vorzeichenumkehr fuer can_ay" VALUE 0x7A528 TKW_VV_VV_SB 100.0 FORMULA_1065 -128.0 127.0 /end CHARACTERISTIC
/begin CHARACTERISTIC K_ZOELP_MAN_T_AN "ZOELP an Zeit im manuellem Betrieb | EN: ZOELP an Zeit im manuellem Betrieb" VALUE 0x7A529 TKW_VV_VV_UB 100.0 FORMULA_0501 0.0 25.5000 /end CHARACTERISTIC
/begin CHARACTERISTIC K_ZOELP_MAN_T_AUS "ZOELP aus Zeit im manuellem Betrieb | EN: ZOELP aus Zeit im manuellem Betrieb" VALUE 0x7A52A TKW_VV_VV_UB 100.0 FORMULA_0501 0.0 25.5000 /end CHARACTERISTIC
/begin CHARACTERISTIC K_ZOELP_FG_T_AN "Freigaengigkeits Anzeit | EN: Freigaengigkeits Anzeit" VALUE 0x7A52B TKW_VV_VV_UB 100.0 FORMULA_0501 0.0 25.5000 /end CHARACTERISTIC
/begin CHARACTERISTIC K_ZOELP_FG_T_AUS "Freigaengigkeits Auszeit | EN: Freigaengigkeits Auszeit" VALUE 0x7A52C TKW_VV_VV_UW 100.0 FORMULA_0073 0.0 6553.5000 FORMAT "%4.1" /end CHARACTERISTIC
/begin CHARACTERISTIC K_ZOELP_DIAG_TIME_WAIT "Wartezeit der Diagnose nach Pumpe an | EN: Wartezeit der Diagnose nach Pumpe an" VALUE 0x7A52E TKW_VV_VV_UB 100.0 FORMULA_0501 0.0 25.5000 /end CHARACTERISTIC
/begin CHARACTERISTIC K_ZOELP_TOEL "Freigaengigkeits und Diagnose-Schwelle abh. von toel | EN: Freigaengigkeits und Diagnose-Schwelle abh. von toel" VALUE 0x7A530 TKW_VV_VV_SW 100.0 FORMULA_0023 -50.0000 170.0000 FORMAT "%4.1" /end CHARACTERISTIC
/begin CHARACTERISTIC K_ZOELP_FG_N "Freigaengigkeits Schwelle abh. von n | EN: Freigaengigkeits Schwelle abh. von n" VALUE 0x7A532 TKW_VV_VV_SW 100.0 FORMULA_0006 0.0 10000.0000 /end CHARACTERISTIC
/begin CHARACTERISTIC K_ZOELP_DIAG_KURZSCHLUSS "Pumpenstromschwelle fuer Kurzschluss | EN: Pumpenstromschwelle fuer Kurzschluss" VALUE 0x7A534 TKW_VV_VV_UB 100.0 FORMULA_1063 0.0 25.0000 /end CHARACTERISTIC
/begin CHARACTERISTIC K_ZOELP_DIAG_KLEMMEN "Pumpenstromschwelle fuer Klemmen | EN: Pumpenstromschwelle fuer Klemmen" VALUE 0x7A535 TKW_VV_VV_UB 100.0 FORMULA_1063 0.0 25.0000 /end CHARACTERISTIC
/begin CHARACTERISTIC K_ZOELP_DIAG_KABELBRUCH "Pumpenstromschwelle fuer Kabelbruch (Openload) | EN: Pumpenstromschwelle fuer Kabelbruch (Openload)" VALUE 0x7A536 TKW_VV_VV_UB 100.0 FORMULA_1063 0.0 25.0000 /end CHARACTERISTIC
/begin FUNCTION SMG-Ebene_2 ""
 /begin DEF_CHARACTERISTIC K_SMG_E2_ST_ERR_MAX K_SMG_MOT_NL_T_MAX_E2 K_SMG_NGETR_DIFF_E2 K_SMG_NGETR_MAX_E2 /end DEF_CHARACTERISTIC
 /begin REF_CHARACTERISTIC /end REF_CHARACTERISTIC
 /begin IN_MEASUREMENT /end IN_MEASUREMENT
 /begin OUT_MEASUREMENT /end OUT_MEASUREMENT
/end FUNCTION
/begin FUNCTION SPI_INJ "" /begin DEF_CHARACTERISTIC /end DEF_CHARACTERISTIC /begin REF_CHARACTERISTIC /end REF_CHARACTERISTIC /begin IN_MEASUREMENT /end IN_MEASUREMENT /begin OUT_MEASUREMENT /end OUT_MEASUREMENT /end FUNCTION
/begin FUNCTION Saugrohtwandtemperatur ""
 /begin DEF_CHARACTERISTIC KL_TSGRW_F KL_TSGRW_OFFS K_TSGRW_CFG K_TSGRW_TAU K_TSGRW_TAU_MS K_TSGRW_TU /end DEF_CHARACTERISTIC
 /begin REF_CHARACTERISTIC /end REF_CHARACTERISTIC
 /begin IN_MEASUREMENT /end IN_MEASUREMENT
 /begin OUT_MEASUREMENT /end OUT_MEASUREMENT
/end FUNCTION
/begin FUNCTION Schalter ""
 /begin DEF_CHARACTERISTIC K_SCHALTER_BLS_ENTPRELLUNG_E2 K_SCHALTER_KS_M_AUF K_SCHALTER_KS_M_ZU /end DEF_CHARACTERISTIC
 /begin REF_CHARACTERISTIC /end REF_CHARACTERISTIC
 /begin IN_MEASUREMENT /end IN_MEASUREMENT
 /begin OUT_MEASUREMENT /end OUT_MEASUREMENT
/end FUNCTION
/begin FUNCTION Startrelais "" /begin DEF_CHARACTERISTIC K_START_RL_BEGINN /end DEF_CHARACTERISTIC /begin REF_CHARACTERISTIC /end REF_CHARACTERISTIC /begin IN_MEASUREMENT /end IN_MEASUREMENT /begin OUT_MEASUREMENT /end OUT_MEASUREMENT /end FUNCTION
/begin FUNCTION Steuergeraetetemperatur ""
 /begin DEF_CHARACTERISTIC KL_TDME_NTC K_TDME_DIAG_MAX K_TDME_DIAG_MIN K_TDME_SCHWELLE_ZAEHLER K_TDME_TAU /end DEF_CHARACTERISTIC
 /begin REF_CHARACTERISTIC /end REF_CHARACTERISTIC
 /begin IN_MEASUREMENT /end IN_MEASUREMENT
 /begin OUT_MEASUREMENT /end OUT_MEASUREMENT
/end FUNCTION
/begin FUNCTION Systemvariablen "" /begin DEF_CHARACTERISTIC /end DEF_CHARACTERISTIC /begin REF_CHARACTERISTIC /end REF_CHARACTERISTIC /begin IN_MEASUREMENT /end IN_MEASUREMENT /begin OUT_MEASUREMENT /end OUT_MEASUREMENT /end FUNCTION
/begin FUNCTION TD "" /begin DEF_CHARACTERISTIC /end DEF_CHARACTERISTIC /begin REF_CHARACTERISTIC /end REF_CHARACTERISTIC /begin IN_MEASUREMENT /end IN_MEASUREMENT /begin OUT_MEASUREMENT /end OUT_MEASUREMENT /end FUNCTION
/begin FUNCTION TPU ""
 /begin DEF_CHARACTERISTIC K_TPU_IGN_MIN_SCI_POS K_TPU_IGN_MISS_FIRE_TIME K_TPU_KW_N_MIN K_TPU_KW_SYNC_ZAHN /end DEF_CHARACTERISTIC
 /begin REF_CHARACTERISTIC /end REF_CHARACTERISTIC
 /begin IN_MEASUREMENT /end IN_MEASUREMENT
 /begin OUT_MEASUREMENT /end OUT_MEASUREMENT
/end FUNCTION
/begin FUNCTION Traegheitsmoment ""
 /begin DEF_CHARACTERISTIC K_J_AC K_J_FZG_DKG_1 K_J_FZG_DKG_2 K_J_FZG_DKG_3 K_J_FZG_DKG_4 K_J_FZG_DKG_5 K_J_FZG_DKG_6 K_J_FZG_DKG_7 K_J_FZG_DKG_N K_J_FZG_DKG_R K_J_FZG_HSG_1 K_J_FZG_HSG_2 K_J_FZG_HSG_3 K_J_FZG_HSG_4 K_J_FZG_HSG_5 K_J_FZG_HSG_6 K_J_FZG_HSG_7 K_J_FZG_HSG_N K_J_FZG_HSG_R K_J_FZG_SMG_1 K_J_FZG_SMG_2 K_J_FZG_SMG_3 K_J_FZG_SMG_4 K_J_FZG_SMG_5 K_J_FZG_SMG_6 K_J_FZG_SMG_7 K_J_FZG_SMG_N K_J_FZG_SMG_R K_J_MOTOR /end DEF_CHARACTERISTIC
 /begin REF_CHARACTERISTIC /end REF_CHARACTERISTIC
 /begin IN_MEASUREMENT /end IN_MEASUREMENT
 /begin OUT_MEASUREMENT /end OUT_MEASUREMENT
/end FUNCTION
/begin FUNCTION Version ""
 /begin DEF_CHARACTERISTIC K_DATENKENNUNG_1_1of5_ K_DATENKENNUNG_1_2of5_ K_DATENKENNUNG_1_3of5_ K_DATENKENNUNG_1_4of5_ K_DATENKENNUNG_1_5of5_ K_DATENKENNUNG_2_1of5_ K_DATENKENNUNG_2_2of5_ K_DATENKENNUNG_2_3of5_ K_DATENKENNUNG_2_4of5_ K_DATENKENNUNG_2_5of5_ K_DATENKENNUNG_3_1of5_ K_DATENKENNUNG_3_2of5_ K_DATENKENNUNG_3_4of5_ K_DATENKENNUNG_3_5of5_ K_VERS_DATEN K_VERS_NAME K_VERS_PROG K_VERS_PROZ /end DEF_CHARACTERISTIC
 /begin REF_CHARACTERISTIC /end REF_CHARACTERISTIC
 /begin IN_MEASUREMENT /end IN_MEASUREMENT
 /begin OUT_MEASUREMENT /end OUT_MEASUREMENT
/end FUNCTION
/begin FUNCTION Versorgungsspannungen ""
 /begin DEF_CHARACTERISTIC K_UEXT_DIAG_MAX K_UEXT_DIAG_MIN K_UEXT_ERSATZ K_UEXT_TAU K_UINTERN_AD_1_8_MAX K_UINTERN_AD_1_8_MIN K_UINTERN_AD_2_55_MAX K_UINTERN_AD_2_55_MIN K_UINTERN_AD_3_3_MAX K_UINTERN_AD_3_3_MIN K_UINTERN_FEHLER_ZAEHLER /end DEF_CHARACTERISTIC
 /begin REF_CHARACTERISTIC /end REF_CHARACTERISTIC
 /begin IN_MEASUREMENT /end IN_MEASUREMENT
 /begin OUT_MEASUREMENT /end OUT_MEASUREMENT
/end FUNCTION
/begin FUNCTION Zuendung ""
 /begin DEF_CHARACTERISTIC KF_TZ_GRUND KF_TZ_I KF_TZ_I_SZ KF_TZ_LL KF_TZ_MIN KF_TZ_VL KL_TZ_DBGR_OFFS KL_TZ_DBGR_TRIGGER KL_TZ_MIN_TMOT KL_TZ_PHASE KL_TZ_START_N KL_TZ_START_TMOT KL_TZ_SZ_LAM_OFFS KL_TZ_SZ_STARTOFFS_TIME KL_TZ_SZ_START_OFFS KL_TZ_SZ_TMOT_OFFS KL_TZ_TKORR_LL KL_TZ_TKORR_TL K_TZ_ABSCH_CTR K_TZ_DBGR_ANZ_SEG K_TZ_DBGR_AUFREG K_TZ_DBGR_DR_REL K_TZ_DBGR_DR_REL_TAU K_TZ_DBGR_TMOT K_TZ_DIAG_MAX_BESTR_TPU K_TZ_DN_ZWB K_TZ_GRAD_TAU K_TZ_ION_COIL K_TZ_I_BEGR K_TZ_I_SA_DELAY K_TZ_KH_RF_ZWB K_TZ_KH_ZWB_B1 K_TZ_KH_ZWB_B2 K_TZ_KH_ZWB_B3 K_TZ_KL15_NACHLAUF K_TZ_MAX K_TZ_MCS K_TZ_MCS_Z_ZYL1 K_TZ_MCS_Z_ZYL10 K_TZ_MCS_Z_ZYL2 K_TZ_MCS_Z_ZYL3 K_TZ_MCS_Z_ZYL4 K_TZ_MCS_Z_ZYL5 K_TZ_MCS_Z_ZYL6 K_TZ_MCS_Z_ZYL7 K_TZ_MCS_Z_ZYL8 K_TZ_MCS_Z_ZYL9 K_TZ_NZ_ANZ_B1 K_TZ_NZ_ANZ_B2 K_TZ_NZ_CHARGE K_TZ_NZ_DIS_CHARGE K_TZ_NZ_N_MAX K_TZ_RF_ZWB K_TZ_SZ_AUSS_DELAY K_TZ_SZ_CONTROL K_TZ_SZ_I_VERSCHL_OFFS K_TZ_SZ_MAX K_TZ_SZ_MCS K_TZ_UB_ERSATZ K_TZ_ZWB_B1 K_TZ_ZWB_B2 K_TZ_ZWB_B3 /end DEF_CHARACTERISTIC
 /begin REF_CHARACTERISTIC /end REF_CHARACTERISTIC
 /begin IN_MEASUREMENT /end IN_MEASUREMENT
 /begin OUT_MEASUREMENT /end OUT_MEASUREMENT
/end FUNCTION
/begin FUNCTION Zustand "" /begin DEF_CHARACTERISTIC /end DEF_CHARACTERISTIC /begin REF_CHARACTERISTIC /end REF_CHARACTERISTIC /begin IN_MEASUREMENT /end IN_MEASUREMENT /begin OUT_MEASUREMENT /end OUT_MEASUREMENT /end FUNCTION
/begin FUNCTION aq ""
 /begin DEF_CHARACTERISTIC KL_AQ_ABS_DK KL_AQ_ABS_DK_ABW_MAX KL_AQ_ABS_LLS KL_AQ_ABS_LLS_ABW_MAX KL_AQ_IST_RF_TAU KL_AQ_RF_MAX_ROH K_AQ_DK0_DK_IST_SCHW K_AQ_DK0_LLS_AQ_SCHW K_AQ_DK_ABW_T_MIN K_AQ_DR_REL_GRAD_TAU K_AQ_LLS_ABW_T_MIN K_AQ_RF_RG_KORR_FAK /end DEF_CHARACTERISTIC
 /begin REF_CHARACTERISTIC /end REF_CHARACTERISTIC
 /begin IN_MEASUREMENT /end IN_MEASUREMENT
 /begin OUT_MEASUREMENT /end OUT_MEASUREMENT
/end FUNCTION
/begin FUNCTION diag_tr_ign "" /begin DEF_CHARACTERISTIC K_DIAG_TR_MAX_ERR /end DEF_CHARACTERISTIC /begin REF_CHARACTERISTIC /end REF_CHARACTERISTIC /begin IN_MEASUREMENT /end IN_MEASUREMENT /begin OUT_MEASUREMENT /end OUT_MEASUREMENT /end FUNCTION
/begin FUNCTION ioncom "" /begin DEF_CHARACTERISTIC /end DEF_CHARACTERISTIC /begin REF_CHARACTERISTIC /end REF_CHARACTERISTIC /begin IN_MEASUREMENT /end IN_MEASUREMENT /begin OUT_MEASUREMENT /end OUT_MEASUREMENT /end FUNCTION
/begin FUNCTION mzyl_sek ""
 /begin DEF_CHARACTERISTIC KF_MZYL_SEK_MVAC_AQ_ABS KL_MZYL_SEK_MVAC_N_FAK K_MZYL_SEK_AQ_ABS_SSP K_MZYL_SEK_MVAC_ABREG K_MZYL_SEK_MVAC_BANK_FAK_1of2_ K_MZYL_SEK_MVAC_BANK_FAK_2of2_ K_MZYL_SEK_SSP_BANK_FAK_1of2_ K_MZYL_SEK_SSP_BANK_FAK_2of2_ K_MZYL_SEK_SSP_DIAG_CFG /end DEF_CHARACTERISTIC
 /begin REF_CHARACTERISTIC /end REF_CHARACTERISTIC
 /begin IN_MEASUREMENT /end IN_MEASUREMENT
 /begin OUT_MEASUREMENT /end OUT_MEASUREMENT
/end FUNCTION
/begin FUNCTION qadc_conf "" /begin DEF_CHARACTERISTIC /end DEF_CHARACTERISTIC /begin REF_CHARACTERISTIC /end REF_CHARACTERISTIC /begin IN_MEASUREMENT /end IN_MEASUREMENT /begin OUT_MEASUREMENT /end OUT_MEASUREMENT /end FUNCTION
/begin FUNCTION sl_zwd "" /begin DEF_CHARACTERISTIC K_SL_ZWD_TV_MAX K_SL_ZWD_TV_MIN K_SL_ZWD_TV_SLP_TEST /end DEF_CHARACTERISTIC /begin REF_CHARACTERISTIC /end REF_CHARACTERISTIC /begin IN_MEASUREMENT /end IN_MEASUREMENT /begin OUT_MEASUREMENT /end OUT_MEASUREMENT /end FUNCTION
/begin FUNCTION spi "" /begin DEF_CHARACTERISTIC /end DEF_CHARACTERISTIC /begin REF_CHARACTERISTIC /end REF_CHARACTERISTIC /begin IN_MEASUREMENT /end IN_MEASUREMENT /begin OUT_MEASUREMENT /end OUT_MEASUREMENT /end FUNCTION
/begin FUNCTION toel_modell ""
 /begin DEF_CHARACTERISTIC KF_TOEL_MODELL_V_TAN_MW KF_TOEL_MODELL_WICHT KL_TOEL_MODELL_DN KL_TOEL_MODELL_N K_TOEL_MODELL_AEBEGR K_TOEL_MODELL_BEGR_OFFS K_TOEL_MODELL_LM_INTEGRATOR_DT K_TOEL_MODELL_N_T1 K_TOEL_MODELL_TMOT_GRD_F K_TOEL_MODELL_T_MS /end DEF_CHARACTERISTIC
 /begin REF_CHARACTERISTIC /end REF_CHARACTERISTIC
 /begin IN_MEASUREMENT /end IN_MEASUREMENT
 /begin OUT_MEASUREMENT /end OUT_MEASUREMENT
/end FUNCTION
/begin FUNCTION tumg-Diagnose ""
 /begin DEF_CHARACTERISTIC KF_TUMG_OBD_MODEL_UPDATE_T_MIN KF_TUMG_OBD_TKA_V KF_TUMG_OBD_TMOT_ML KL_TUMG_OBD_MAX_ERROR KL_TUMG_OBD_MOD_TIME_ML_MIN KL_TUMG_OBD_V K_TUMG_OBD_CFG K_TUMG_OBD_ML_MAX K_TUMG_OBD_ML_MIN K_TUMG_OBD_ML_SUM_MIN K_TUMG_OBD_ML_TMOT_ZK K_TUMG_OBD_MODEL_DELTA_MAX K_TUMG_OBD_MODEL_DELTA_MIN K_TUMG_OBD_MODEL_TAU K_TUMG_OBD_N_MIN K_TUMG_OBD_TAN_FAST_TAU K_TUMG_OBD_TAN_FIL_DELTA_MAX K_TUMG_OBD_TAN_MAX K_TUMG_OBD_TAN_MIN K_TUMG_OBD_TAN_SLOW_TAU K_TUMG_OBD_TIME_ML_MIN K_TUMG_OBD_TIME_MS_MIN K_TUMG_OBD_TIME_SA_MAX K_TUMG_OBD_TKA_MIN K_TUMG_OBD_TMOT_KALT_MAX K_TUMG_OBD_TMOT_MIN K_TUMG_OBD_TMOT_START_MAX K_TUMG_OBD_TMOT_TAN_DELTA_MAX K_TUMG_OBD_T_POWER_ON K_TUMG_OBD_V_MAX K_TUMG_OBD_V_MIN /end DEF_CHARACTERISTIC
 /begin REF_CHARACTERISTIC /end REF_CHARACTERISTIC
 /begin IN_MEASUREMENT /end IN_MEASUREMENT
 /begin OUT_MEASUREMENT /end OUT_MEASUREMENT
/end FUNCTION
/begin FUNCTION zoelp ""
 /begin DEF_CHARACTERISTIC K_ZOELP_AN K_ZOELP_CFG K_ZOELP_DIAG_KABELBRUCH K_ZOELP_DIAG_KLEMMEN K_ZOELP_DIAG_KURZSCHLUSS K_ZOELP_DIAG_TIME_WAIT K_ZOELP_FG_N K_ZOELP_FG_T_AN K_ZOELP_FG_T_AUS K_ZOELP_HYS K_ZOELP_MAN_T_AN K_ZOELP_MAN_T_AUS K_ZOELP_TOEL K_ZOELP_UM /end DEF_CHARACTERISTIC
 /begin REF_CHARACTERISTIC /end REF_CHARACTERISTIC
 /begin IN_MEASUREMENT /end IN_MEASUREMENT
 /begin OUT_MEASUREMENT /end OUT_MEASUREMENT
/end FUNCTION
/begin RECORD_LAYOUT TKW_VV_VV_UB FNC_VALUES 1 UBYTE COLUMN_DIR DIRECT /end RECORD_LAYOUT
/begin RECORD_LAYOUT TKW_VV_VV_SB FNC_VALUES 1 SBYTE COLUMN_DIR DIRECT /end RECORD_LAYOUT
/begin RECORD_LAYOUT TKW_VV_VV_UW FNC_VALUES 1 UWORD COLUMN_DIR DIRECT /end RECORD_LAYOUT
/begin RECORD_LAYOUT TKW_VV_VV_SW FNC_VALUES 1 SWORD COLUMN_DIR DIRECT /end RECORD_LAYOUT
/begin RECORD_LAYOUT TKW_VV_VV_UL FNC_VALUES 1 ULONG COLUMN_DIR DIRECT /end RECORD_LAYOUT
/begin RECORD_LAYOUT TKL_UW_VV_UW NO_AXIS_PTS_X 1 UBYTE RESERVED 2 BYTE AXIS_PTS_X 3 UWORD INDEX_INCR DIRECT FNC_VALUES 4 UWORD COLUMN_DIR DIRECT /end RECORD_LAYOUT
/begin RECORD_LAYOUT TKL_UW_VV_SW NO_AXIS_PTS_X 1 UBYTE RESERVED 2 BYTE AXIS_PTS_X 3 UWORD INDEX_INCR DIRECT FNC_VALUES 4 SWORD COLUMN_DIR DIRECT /end RECORD_LAYOUT
/begin RECORD_LAYOUT TKL_SW_VV_UB NO_AXIS_PTS_X 1 UBYTE RESERVED 2 BYTE AXIS_PTS_X 3 SWORD INDEX_INCR DIRECT FNC_VALUES 4 UBYTE COLUMN_DIR DIRECT /end RECORD_LAYOUT
/begin RECORD_LAYOUT TKL_SW_VV_UW NO_AXIS_PTS_X 1 UBYTE RESERVED 2 BYTE AXIS_PTS_X 3 SWORD INDEX_INCR DIRECT FNC_VALUES 4 UWORD COLUMN_DIR DIRECT /end RECORD_LAYOUT
/begin RECORD_LAYOUT TKL_SW_VV_SW NO_AXIS_PTS_X 1 UBYTE RESERVED 2 BYTE AXIS_PTS_X 3 SWORD INDEX_INCR DIRECT FNC_VALUES 4 SWORD COLUMN_DIR DIRECT /end RECORD_LAYOUT
/begin RECORD_LAYOUT TKF_SW_SW_UW NO_AXIS_PTS_X 1 UBYTE NO_AXIS_PTS_Y 2 UBYTE AXIS_PTS_X 3 SWORD INDEX_INCR DIRECT AXIS_PTS_Y 4 SWORD INDEX_INCR DIRECT FNC_VALUES 5 UWORD COLUMN_DIR DIRECT /end RECORD_LAYOUT
/begin RECORD_LAYOUT TKF_SW_SW_SW NO_AXIS_PTS_X 1 UBYTE NO_AXIS_PTS_Y 2 UBYTE AXIS_PTS_X 3 SWORD INDEX_INCR DIRECT AXIS_PTS_Y 4 SWORD INDEX_INCR DIRECT FNC_VALUES 5 SWORD COLUMN_DIR DIRECT /end RECORD_LAYOUT
/* ---- V452-specific parameters (names assigned during V452 reverse engineering) ---- */
/begin CHARACTERISTIC K_N_GETR_HS_DIAG_ABTR_MIN "[V452-new, name assigned] Gearbox input speed diagnosis (fn 0x556D4): release only if n_getr_abtrieb >= this value" VALUE 0x786A8 TKW_VV_VV_SW 12000.0 FORMULA_0006 -12000.0000 12000.0000 /end CHARACTERISTIC
/begin CHARACTERISTIC K_N_GETR_HS_DIAG_N_MAX "[V452-new, name assigned] Gearbox input speed diagnosis (fn 0x556D4): release only if engine speed n <= this value" VALUE 0x786AA TKW_VV_VV_SW 12000.0 FORMULA_0006 -12000.0000 12000.0000 /end CHARACTERISTIC
/* ---- added 04.11.2026: further code-read calibration ---- */
/begin CHARACTERISTIC UNK_SK_SELFTEST_KL_08894 "Safety-concept lookup self-test reference table (fixed test vectors from ROM). Not tuning data - DO NOT MODIFY. [Added V452 04.11.2026]" CURVE 0x78894 TKL_SW_VV_SW 32767.0 FORMULA_USER1 -32768.0 32767.0
 /begin AXIS_DESCR STD_AXIS NO_INPUT_QUANTITY FORMULA_USER1 5 -32768.0 32767.0 /end AXIS_DESCR
/end CHARACTERISTIC
/begin CHARACTERISTIC UNK_SK_SELFTEST_KF_088AA "Safety-concept lookup self-test reference table (fixed test vectors from ROM). Not tuning data - DO NOT MODIFY. [Added V452 04.11.2026]" MAP 0x788AA TKF_SW_SW_SW 32767.0 FORMULA_USER1 -32768.0 32767.0
 /begin AXIS_DESCR STD_AXIS NO_INPUT_QUANTITY FORMULA_USER1 4 -32768.0 32767.0 /end AXIS_DESCR
 /begin AXIS_DESCR STD_AXIS NO_INPUT_QUANTITY FORMULA_USER1 4 -32768.0 32767.0 /end AXIS_DESCR
/end CHARACTERISTIC
/begin CHARACTERISTIC UNK_SK_SELFTEST_KF_088DC "Safety-concept lookup self-test reference table (fixed test vectors from ROM). Not tuning data - DO NOT MODIFY. [Added V452 04.11.2026]" MAP 0x788DC TKF_SW_SW_SW 32767.0 FORMULA_USER1 -32768.0 32767.0
 /begin AXIS_DESCR STD_AXIS NO_INPUT_QUANTITY FORMULA_USER1 4 -32768.0 32767.0 /end AXIS_DESCR
 /begin AXIS_DESCR STD_AXIS NO_INPUT_QUANTITY FORMULA_USER1 4 -32768.0 32767.0 /end AXIS_DESCR
/end CHARACTERISTIC
/end MODULE
/end PROJECT
