/begin PROJECT MSS65-ign-V452 "MSS65 IGN - V452.01-B204.00, data set 0569Q60Z160E"
/begin HEADER "" VERSION "V452.01-B204.00" /end HEADER
/begin MODULE _MSS65-ign "MSS65 IGN - V452.01-B204.00, calibration xxxxxxxx"
/begin MOD_COMMON "" BYTE_ORDER MSB_FIRST /* Default byteorder (Motorola) */ /end MOD_COMMON
/* ------------------ Abschnitt erzeugt aus adapt_common.dat ------------------ */
/begin COMPU_METHOD FORMULA_0000 "FORMULA_0000" RAT_FUNC "%7.0" "-" COEFFS 0 1 0 0 0 1 /end COMPU_METHOD
/begin COMPU_METHOD FORMULA_0001 "FORMULA_0001" RAT_FUNC "%6.1" "%" COEFFS 0 10 0 0 0 1 /end COMPU_METHOD
/begin COMPU_METHOD FORMULA_0003 "FORMULA_0003" RAT_FUNC "%3.0" "-" COEFFS 0 1 0 0 0 1 /end COMPU_METHOD
/begin COMPU_METHOD FORMULA_0006 "FORMULA_0006" RAT_FUNC "%5.0" "Upm" COEFFS 0 1 0 0 0 1 /end COMPU_METHOD
/begin COMPU_METHOD FORMULA_0007 "FORMULA_0007" RAT_FUNC "%8.3" "-" COEFFS 0 10000 0 0 0 1 /end COMPU_METHOD
/begin COMPU_METHOD FORMULA_0008 "FORMULA_0008" RAT_FUNC "%6.1" "V" COEFFS 0 10 0 0 0 1 /end COMPU_METHOD
/begin COMPU_METHOD FORMULA_0009 "FORMULA_0009" RAT_FUNC "%6.1" "Nm" COEFFS 0 10 0 0 0 1 /end COMPU_METHOD
/begin COMPU_METHOD FORMULA_0010 "FORMULA_0010" RAT_FUNC "%5.0" "-" COEFFS 0 1 0 0 0 1 /end COMPU_METHOD
/begin COMPU_METHOD FORMULA_0011 "FORMULA_0011" TAB_VERB "%5.0" "-" COMPU_TAB_REF FORMULA_0011_VTAB /end COMPU_METHOD
/begin COMPU_VTAB FORMULA_0011_VTAB "FORMULA_0011_VTAB" TAB_VERB 15 0 "kein Fehler" 1 "Egasueberwachung" 2 "Momentenueberwachung" 4 "Einspritzueberwachung" 8 "SMG-Ueberwachung" 16 "Systemfehler" 32 "Stackueberwachung" 64 "Resetanzahl" 128 "Gemischfehler" 256 "Klopfregelung" 512 "CRC-Check" 1024 "Taskueberwachung" 2048 "Prozessueberwachung" 4096 "Pedalwertgeber" 8192 "Mastervac" DEFAULT_VALUE "undef" /end COMPU_VTAB
/begin COMPU_METHOD FORMULA_0021 "FORMULA_0021" RAT_FUNC "%7.2" "s" COEFFS 0 100 0 0 0 1 /end COMPU_METHOD
/* ------------------ Abschnitt erzeugt aus adapt_glob.dat ------------------ */
/begin COMPU_METHOD FORMULA_0023 "FORMULA_0023" RAT_FUNC "%6.1" "�C" COEFFS 0 10 2732 0 0 1 /end COMPU_METHOD
/begin COMPU_METHOD FORMULA_0025 "FORMULA_0025" RAT_FUNC "%8.3" "-" COEFFS 0 16384 0 0 0 1 /end COMPU_METHOD
/begin COMPU_METHOD FORMULA_0033 "FORMULA_0033" RAT_FUNC "%5.2" "-" COEFFS 0 1 0 0 0 1 /end COMPU_METHOD
/begin COMPU_METHOD FORMULA_0062 "FORMULA_0062" RAT_FUNC "%5.0" "s" COEFFS 0 1 0 0 0 1 /end COMPU_METHOD
/begin COMPU_METHOD FORMULA_0073 "FORMULA_0073" RAT_FUNC "%6.1" "s" COEFFS 0 10 0 0 0 1 /end COMPU_METHOD
/begin COMPU_METHOD FORMULA_0075 "FORMULA_0075" RAT_FUNC "%8.3" "-" COEFFS 0 1024 0 0 0 1 /end COMPU_METHOD
/begin COMPU_METHOD FORMULA_0076 "FORMULA_0076" RAT_FUNC "%6.1" "Kelvin" COEFFS 0 10 0 0 0 1 /end COMPU_METHOD
/begin COMPU_METHOD FORMULA_0078 "FORMULA_0078" RAT_FUNC "%6.1" "km/h" COEFFS 0 16 0 0 0 1 /end COMPU_METHOD
/begin COMPU_METHOD FORMULA_0111 "FORMULA_0111" RAT_FUNC "%6.1" "�KW" COEFFS 0 10 0 0 0 1 /end COMPU_METHOD
/begin COMPU_METHOD FORMULA_0112 "FORMULA_0112" RAT_FUNC "%6.1" "kg/h" COEFFS 0 10 0 0 0 1 /end COMPU_METHOD
/begin COMPU_METHOD FORMULA_0123 "FORMULA_0123" RAT_FUNC "%5.0" "digit" COEFFS 0 1 0 0 0 1 /end COMPU_METHOD
/begin COMPU_METHOD FORMULA_0149 "FORMULA_0149" RAT_FUNC "%9.2" "min" COEFFS 0 60 0 0 0 1 /end COMPU_METHOD
/begin COMPU_METHOD FORMULA_0152 "FORMULA_0152" RAT_FUNC "%9.2" "s" COEFFS 0 100 0 0 0 1 /end COMPU_METHOD
/begin COMPU_METHOD FORMULA_0172 "FORMULA_0172" TAB_VERB "%3.0" "-" COMPU_TAB_REF FORMULA_0172_VTAB /end COMPU_METHOD
/begin COMPU_VTAB FORMULA_0172_VTAB "FORMULA_0172_VTAB" TAB_VERB 1 0 "kein Fehler" /end COMPU_VTAB
/begin COMPU_METHOD FORMULA_0184 "FORMULA_0184" TAB_VERB "%5.0" "-" COMPU_TAB_REF FORMULA_0184_VTAB /end COMPU_METHOD
/begin COMPU_VTAB FORMULA_0184_VTAB "FORMULA_0184_VTAB" TAB_VERB 1 0 "alle ein" /end COMPU_VTAB
/begin COMPU_METHOD FORMULA_0267 "FORMULA_0267" TAB_VERB "%3.0" "-" COMPU_TAB_REF FORMULA_0267_VTAB /end COMPU_METHOD
/begin COMPU_VTAB FORMULA_0267_VTAB "FORMULA_0267_VTAB" TAB_VERB 6 0 "O.K." 1 "Kanalfilter" 2 "Kanalfehler" 3 "PWG2_Fehler" 4 "PWG1_Fehler" 5 "Totalausfall" DEFAULT_VALUE "undefiniert" /end COMPU_VTAB
/begin COMPU_METHOD FORMULA_0317 "FORMULA_0317" RAT_FUNC "%5.2" "s" COEFFS 0 100 0 0 0 1 /end COMPU_METHOD
/begin COMPU_METHOD FORMULA_0333 "FORMULA_0333" RAT_FUNC "%7.2" "�C" COEFFS 0 20 5463 0 0 1 /end COMPU_METHOD
/begin COMPU_METHOD FORMULA_0340 "FORMULA_0340" RAT_FUNC "%11.4" "�C" COEFFS 0 10240 2797056 0 0 1 /end COMPU_METHOD
/* ------------------ Abschnitt erzeugt aus pctrl.dat ------------------ */
/begin COMPU_METHOD FORMULA_0352 "FORMULA_0352" RAT_FUNC "%5.2" "s" COEFFS 0 200 0 0 0 1 /end COMPU_METHOD
/begin COMPU_METHOD FORMULA_0353 "FORMULA_0353" RAT_FUNC "%3.0" "ms" COEFFS 0 1 0 0 0 10 /end COMPU_METHOD
/* ------------------ Abschnitt erzeugt aus ram_chk.dat ------------------ */
/begin COMPU_METHOD FORMULA_0355 "FORMULA_0355" RAT_FUNC "%7.2" "kHz" COEFFS 0 100 0 0 0 1 /end COMPU_METHOD
/begin COMPU_METHOD FORMULA_0356 "FORMULA_0356" RAT_FUNC "%3.0" "us" COEFFS 0 1 0 0 0 1 /end COMPU_METHOD
/begin COMPU_METHOD FORMULA_0357 "FORMULA_0357" TAB_VERB "%5.2" "-" COMPU_TAB_REF FORMULA_0357_VTAB /end COMPU_METHOD
/begin COMPU_VTAB FORMULA_0357_VTAB "FORMULA_0357_VTAB" TAB_VERB 2 0 "Aus" 1 "Ein" /end COMPU_VTAB
/* ------------------ Abschnitt erzeugt aus sk.dat ------------------ */
/begin COMPU_METHOD FORMULA_0362 "FORMULA_0362" TAB_VERB "%3.0" "-" COMPU_TAB_REF FORMULA_0362_VTAB /end COMPU_METHOD
/begin COMPU_VTAB FORMULA_0362_VTAB "FORMULA_0362_VTAB" TAB_VERB 1 0 "Inaktiv" DEFAULT_VALUE "Aktiv" /end COMPU_VTAB
/begin COMPU_METHOD FORMULA_0363 "FORMULA_0363" TAB_VERB "%5.2" "-" COMPU_TAB_REF FORMULA_0363_VTAB /end COMPU_METHOD
/begin COMPU_VTAB FORMULA_0363_VTAB "FORMULA_0363_VTAB" TAB_VERB 2 0 "SK aus" 1 "SK aktiv" /end COMPU_VTAB
/begin COMPU_METHOD FORMULA_0364 "FORMULA_0364" TAB_VERB "%3.0" "-" COMPU_TAB_REF FORMULA_0364_VTAB /end COMPU_METHOD
/begin COMPU_VTAB FORMULA_0364_VTAB "FORMULA_0364_VTAB" TAB_VERB 5 0 "Aus" 1 "MVAC" 2 "ELUP" 3 "MVAC+ELUP" 6 "System" /end COMPU_VTAB
/begin COMPU_METHOD FORMULA_0365 "FORMULA_0365" TAB_VERB "%3.0" "-" COMPU_TAB_REF FORMULA_0365_VTAB /end COMPU_METHOD
/begin COMPU_VTAB FORMULA_0365_VTAB "FORMULA_0365_VTAB" TAB_VERB 8 0 "Inaktiv" 1 "D-CRC" 2 "P-CRC" 3 "PD-CRC" 4 "B-CRC" 5 "BD-CRC" 6 "BP-CRC" 7 "BPD-CRC" /end COMPU_VTAB
/begin COMPU_METHOD FORMULA_0366 "FORMULA_0366" TAB_VERB "%3.0" "-" COMPU_TAB_REF FORMULA_0366_VTAB /end COMPU_METHOD
/begin COMPU_VTAB FORMULA_0366_VTAB "FORMULA_0366_VTAB" TAB_VERB 8 0 "alle an" 3 "LA" 12 "LAA" 15 "LA+LAA" 48 "Mager" 51 "LA+Mager" 60 "LAA+Mager" 63 "LA+LAA+Mager" /end COMPU_VTAB
/begin COMPU_METHOD FORMULA_0367 "FORMULA_0367" TAB_VERB "%3.0" "-" COMPU_TAB_REF FORMULA_0367_VTAB /end COMPU_METHOD
/begin COMPU_VTAB FORMULA_0367_VTAB "FORMULA_0367_VTAB" TAB_VERB 8 0 "alle an" 1 "LA" 2 "LAA" 3 "LA+LAA" 4 "Mager" 5 "LA+Mager" 6 "LAA+Mager" 7 "LA+LAA+Mager" /end COMPU_VTAB
/begin COMPU_METHOD FORMULA_0368 "FORMULA_0368" TAB_VERB "%3.0" "-" COMPU_TAB_REF FORMULA_0368_VTAB /end COMPU_METHOD
/begin COMPU_VTAB FORMULA_0368_VTAB "FORMULA_0368_VTAB" TAB_VERB 2 0 "aktiv" 1 "gesperrt" /end COMPU_VTAB
/* ------------------ Abschnitt erzeugt aus sk_e2_glob.dat ------------------ */
/begin COMPU_METHOD FORMULA_0369 "FORMULA_0369" TAB_VERB "%5.0" "-" COMPU_TAB_REF FORMULA_0369_VTAB /end COMPU_METHOD
/begin COMPU_VTAB FORMULA_0369_VTAB "FORMULA_0369_VTAB" TAB_VERB 23 0 "kein Fehler" 5 "Motortemperatur" 6 "Oeltemperatur" 10 "SMG-Schaltablauf" 11 "SMG-Eingriff" 12 "SMG-Sollmoment" 13 "SMG-nGetr" 14 "SMG-Gang" 20 "LLR-Plausi" 21 "Minimalmoment" 22 "Maximalmoment" 23 "Istmoment" 24 "Schleppmoment" 25 "Soll-Istvergleich" 26 "rel. Fahrerwunsch" 30 "Luftmasse" 40 "Drehzahl" 50 "Pedalwert" 60 "Bremslichtschalter" 80 "Komplementvergleich" 85 "Fehler Testrechnung" 86 "Timeout Testrechnung" 90 "Maxdrehzahl" /end COMPU_VTAB
/* ------------------ Abschnitt erzeugt aus sw_confg.dat ------------------ */
/begin COMPU_METHOD FORMULA_0371 "FORMULA_0371" TAB_VERB "%7.2" "-" COMPU_TAB_REF FORMULA_0371_VTAB /end COMPU_METHOD
/begin COMPU_VTAB FORMULA_0371_VTAB "FORMULA_0371_VTAB" TAB_VERB 5 8192 "S65" 8448 "S65FLACH" 8704 "S65V" 256 "S15" 16384 "S85" DEFAULT_VALUE "undefiniert" /end COMPU_VTAB
/begin COMPU_METHOD FORMULA_0372 "FORMULA_0372" TAB_VERB "%5.2" "-" COMPU_TAB_REF FORMULA_0372_VTAB /end COMPU_METHOD
/begin COMPU_VTAB FORMULA_0372_VTAB "FORMULA_0372_VTAB" TAB_VERB 7 16 "E60" 17 "E63" 18 "E64" 32 "E65" 64 "E85" 128 "E90" 129 "E91" DEFAULT_VALUE "undefiniert" /end COMPU_VTAB
/begin COMPU_METHOD FORMULA_0373 "FORMULA_0373" TAB_VERB "%5.2" "-" COMPU_TAB_REF FORMULA_0373_VTAB /end COMPU_METHOD
/begin COMPU_VTAB FORMULA_0373_VTAB "FORMULA_0373_VTAB" TAB_VERB 3 16 "HS" 64 "SMG" 128 "DKG" DEFAULT_VALUE "undefiniert" /end COMPU_VTAB
/begin COMPU_METHOD FORMULA_0374 "FORMULA_0374" TAB_VERB "%5.2" "-" COMPU_TAB_REF FORMULA_0374_VTAB /end COMPU_METHOD
/begin COMPU_VTAB FORMULA_0374_VTAB "FORMULA_0374_VTAB" TAB_VERB 5 1 "ECE" 2 "US" 4 "Golfstaaten" 8 "ZA" 16 "JAPAN" DEFAULT_VALUE "undefiniert" /end COMPU_VTAB
/begin COMPU_METHOD FORMULA_0375 "FORMULA_0375" TAB_VERB "%5.2" "-" COMPU_TAB_REF FORMULA_0375_VTAB /end COMPU_METHOD
/begin COMPU_VTAB FORMULA_0375_VTAB "FORMULA_0375_VTAB" TAB_VERB 6 16 "EU3" 17 "EU4" 1 "D4" 32 "LEV" 33 "LEV2" 34 "ULEV" DEFAULT_VALUE "undefiniert" /end COMPU_VTAB
/begin COMPU_METHOD FORMULA_0376 "FORMULA_0376" TAB_VERB "%5.2" "-" COMPU_TAB_REF FORMULA_0376_VTAB /end COMPU_METHOD
/begin COMPU_VTAB FORMULA_0376_VTAB "FORMULA_0376_VTAB" TAB_VERB 3 1 "MIL_OFF" 2 "MIL_FSP" 4 "MIL_ON" DEFAULT_VALUE "undefiniert" /end COMPU_VTAB
/begin COMPU_METHOD FORMULA_0377 "FORMULA_0377" TAB_VERB "%5.2" "-" COMPU_TAB_REF FORMULA_0377_VTAB /end COMPU_METHOD
/begin COMPU_VTAB FORMULA_0377_VTAB "FORMULA_0377_VTAB" TAB_VERB 2 128 "Serienstand" 1 "Entwicklung" DEFAULT_VALUE "undefiniert" /end COMPU_VTAB
/begin COMPU_METHOD FORMULA_0378 "FORMULA_0378" TAB_VERB "%5.2" "-" COMPU_TAB_REF FORMULA_0378_VTAB /end COMPU_METHOD
/begin COMPU_VTAB FORMULA_0378_VTAB "FORMULA_0378_VTAB" TAB_VERB 2 1 "CAN 11H" 2 "CAN 12H" DEFAULT_VALUE "undefiniert" /end COMPU_VTAB
/begin COMPU_METHOD FORMULA_0379 "FORMULA_0379" TAB_VERB "%5.2" "-" COMPU_TAB_REF FORMULA_0379_VTAB /end COMPU_METHOD
/begin COMPU_VTAB FORMULA_0379_VTAB "FORMULA_0379_VTAB" TAB_VERB 3 0 "Fz-Betrieb" 1 "Pruefstand" 2 "Rolle" /end COMPU_VTAB
/begin COMPU_METHOD FORMULA_0380 "FORMULA_0380" TAB_VERB "%5.2" "-" COMPU_TAB_REF FORMULA_0380_VTAB /end COMPU_METHOD
/begin COMPU_VTAB FORMULA_0380_VTAB "FORMULA_0380_VTAB" TAB_VERB 4 0 "auto Erkennung" 1 "ApplDFlash, rest auto" 2 "ETH aus, rest auto" 3 "ApplDFlash, ETH aus" DEFAULT_VALUE "ungueltig" /end COMPU_VTAB
/begin COMPU_METHOD FORMULA_0381 "FORMULA_0381" TAB_VERB "%5.2" "-" COMPU_TAB_REF FORMULA_0381_VTAB /end COMPU_METHOD
/begin COMPU_VTAB FORMULA_0381_VTAB "FORMULA_0381_VTAB" TAB_VERB 2 0 "Teves" 1 "Bosch" /end COMPU_VTAB
/begin COMPU_METHOD FORMULA_0382 "FORMULA_0382" TAB_VERB "%5.2" "-" COMPU_TAB_REF FORMULA_0382_VTAB /end COMPU_METHOD
/begin COMPU_VTAB FORMULA_0382_VTAB "FORMULA_0382_VTAB" TAB_VERB 3 0 "Aus" 1 "dSPACE" 2 "noLoop" /end COMPU_VTAB
/* ------------------ Abschnitt erzeugt aus adapt.dat ------------------ */
/begin COMPU_METHOD FORMULA_0418 "FORMULA_0418" RAT_FUNC "%8.3" "V" COEFFS 0 1024 0 0 0 5 /end COMPU_METHOD
/begin COMPU_METHOD FORMULA_0419 "FORMULA_0419" RAT_FUNC "%8.3" "V" COEFFS 0 2048 0 0 0 5 /end COMPU_METHOD
/begin COMPU_METHOD FORMULA_0435 "FORMULA_0435" RAT_FUNC "%6.1" "%" COEFFS 0 32768 0 0 0 100 /end COMPU_METHOD
/begin COMPU_METHOD FORMULA_0450 "FORMULA_0450" RAT_FUNC "%8.3" "%" COEFFS 0 640 0 0 0 1 /end COMPU_METHOD
/begin COMPU_METHOD FORMULA_0456 "FORMULA_0456" RAT_FUNC "%8.1" "s" COEFFS 0 10 0 0 0 1 /end COMPU_METHOD
/begin COMPU_METHOD FORMULA_0478 "FORMULA_0478" RAT_FUNC "%6.3" "s" COEFFS 0 0 1.28 0 1 0 /end COMPU_METHOD
/begin COMPU_METHOD FORMULA_0497 "FORMULA_0497" RAT_FUNC "%7.2" "-" COEFFS 0 100 0 0 0 1 /end COMPU_METHOD
/begin COMPU_METHOD FORMULA_0501 "FORMULA_0501" RAT_FUNC "%4.1" "s" COEFFS 0 10 0 0 0 1 /end COMPU_METHOD
/begin COMPU_METHOD FORMULA_0590 "FORMULA_0590" RAT_FUNC "%3.0" "ms" COEFFS 0 1 0 0 0 5 /end COMPU_METHOD
/begin COMPU_METHOD FORMULA_0636 "FORMULA_0636" RAT_FUNC "%6.1" "%" COEFFS 0 640 0 0 0 1 /end COMPU_METHOD
/begin COMPU_METHOD FORMULA_0679 "FORMULA_0679" RAT_FUNC "%5.2" "s" COEFFS 0 0 25.6 0 1 0 /end COMPU_METHOD
/begin COMPU_METHOD FORMULA_0704 "FORMULA_0704" RAT_FUNC "%5.2" "-" COEFFS 0 128 0 0 0 1 /end COMPU_METHOD
/begin COMPU_METHOD FORMULA_0755 "FORMULA_0755" RAT_FUNC "%6.1" "Nm/s" COEFFS 0 10 0 0 0 1 /end COMPU_METHOD
/* ------------------ Abschnitt erzeugt aus md_basis.dat ------------------ */
/begin COMPU_METHOD FORMULA_0784 "FORMULA_0784" RAT_FUNC "%6.1" "Nm" COEFFS 0 100 0 0 0 1 /end COMPU_METHOD
/begin COMPU_METHOD FORMULA_0786 "FORMULA_0786" RAT_FUNC "%7.2" "10E-4" COEFFS 0 100 0 0 0 1 /end COMPU_METHOD
/* ------------------ Abschnitt erzeugt aus md_e2.dat ------------------ */
/begin COMPU_METHOD FORMULA_0801 "FORMULA_0801" TAB_VERB "%5.2" "-" COMPU_TAB_REF FORMULA_0801_VTAB /end COMPU_METHOD
/begin COMPU_VTAB FORMULA_0801_VTAB "FORMULA_0801_VTAB" TAB_VERB 6 0 "kein Fehler" 1 "Minmoment" 2 "Maxmoment" 4 "ind.Istmoment" 8 "Schleppmoment" 16 "Soll/Istvgl." DEFAULT_VALUE "Mehrfach" /end COMPU_VTAB
/begin COMPU_METHOD FORMULA_0802 "FORMULA_0802" TAB_VERB "%5.2" "-" COMPU_TAB_REF FORMULA_0802_VTAB /end COMPU_METHOD
/begin COMPU_VTAB FORMULA_0802_VTAB "FORMULA_0802_VTAB" TAB_VERB 3 0 "Inaktiv" 1 "MSR" 2 "ASC" DEFAULT_VALUE "undef" /end COMPU_VTAB
/begin COMPU_METHOD FORMULA_0803 "FORMULA_0803" RAT_FUNC "%5.0" "Nm" COEFFS 0 10 0 0 0 1 /end COMPU_METHOD
/* ------------------ Abschnitt erzeugt aus pwg.dat ------------------ */
/begin COMPU_METHOD FORMULA_0888 "FORMULA_0888" RAT_FUNC "%8.3" "%/V" COEFFS 0 100 0 0 0 1 /end COMPU_METHOD
/begin COMPU_METHOD FORMULA_0889 "FORMULA_0889" TAB_VERB "%5.2" "-" COMPU_TAB_REF FORMULA_0889_VTAB /end COMPU_METHOD
/begin COMPU_VTAB FORMULA_0889_VTAB "FORMULA_0889_VTAB" TAB_VERB 1 0 "keine Erfassung" DEFAULT_VALUE "Druckerfassung" /end COMPU_VTAB
/begin COMPU_METHOD FORMULA_0890 "FORMULA_0890" TAB_VERB "%5.2" "-" COMPU_TAB_REF FORMULA_0890_VTAB /end COMPU_METHOD
/begin COMPU_VTAB FORMULA_0890_VTAB "FORMULA_0890_VTAB" TAB_VERB 1 0 "kein Berganfahren" DEFAULT_VALUE "Berganfahren" /end COMPU_VTAB
/begin COMPU_METHOD FORMULA_0891 "FORMULA_0891" TAB_VERB "%5.2" "-" COMPU_TAB_REF FORMULA_0891_VTAB /end COMPU_METHOD
/begin COMPU_VTAB FORMULA_0891_VTAB "FORMULA_0891_VTAB" TAB_VERB 1 0 "keine v-Begrenzung" DEFAULT_VALUE "v-Begrenzung" /end COMPU_VTAB
/begin COMPU_METHOD FORMULA_0892 "FORMULA_0892" TAB_VERB "%5.2" "-" COMPU_TAB_REF FORMULA_0892_VTAB /end COMPU_METHOD
/begin COMPU_VTAB FORMULA_0892_VTAB "FORMULA_0892_VTAB" TAB_VERB 1 0 "keine Begrenzung" DEFAULT_VALUE "Begrenzung" /end COMPU_VTAB
/begin COMPU_METHOD FORMULA_0893 "FORMULA_0893" RAT_FUNC "%5.0" "ms" COEFFS 0 1 0 0 0 5 /end COMPU_METHOD
/begin COMPU_METHOD FORMULA_0894 "FORMULA_0894" TAB_VERB "%5.2" "-" COMPU_TAB_REF FORMULA_0894_VTAB /end COMPU_METHOD
/begin COMPU_VTAB FORMULA_0894_VTAB "FORMULA_0894_VTAB" TAB_VERB 1 0 "O.K." DEFAULT_VALUE "Filter" /end COMPU_VTAB
/begin COMPU_METHOD FORMULA_0895 "FORMULA_0895" TAB_VERB "%5.2" "-" COMPU_TAB_REF FORMULA_0895_VTAB /end COMPU_METHOD
/begin COMPU_VTAB FORMULA_0895_VTAB "FORMULA_0895_VTAB" TAB_VERB 1 0 "O.K." DEFAULT_VALUE "Fehler" /end COMPU_VTAB
/begin COMPU_METHOD FORMULA_0896 "FORMULA_0896" TAB_VERB "%5.2" "-" COMPU_TAB_REF FORMULA_0896_VTAB /end COMPU_METHOD
/begin COMPU_VTAB FORMULA_0896_VTAB "FORMULA_0896_VTAB" TAB_VERB 1 0 "O.K." DEFAULT_VALUE "Fehler" /end COMPU_VTAB
/begin COMPU_METHOD FORMULA_0897 "FORMULA_0897" TAB_VERB "%5.2" "-" COMPU_TAB_REF FORMULA_0897_VTAB /end COMPU_METHOD
/begin COMPU_VTAB FORMULA_0897_VTAB "FORMULA_0897_VTAB" TAB_VERB 1 0 "O.K." DEFAULT_VALUE "Fehler" /end COMPU_VTAB
/begin COMPU_METHOD FORMULA_0898 "FORMULA_0898" TAB_VERB "%5.2" "-" COMPU_TAB_REF FORMULA_0898_VTAB /end COMPU_METHOD
/begin COMPU_VTAB FORMULA_0898_VTAB "FORMULA_0898_VTAB" TAB_VERB 1 0 "O.K." DEFAULT_VALUE "Fehler" /end COMPU_VTAB
/begin COMPU_METHOD FORMULA_0899 "FORMULA_0899" TAB_VERB "%5.2" "-" COMPU_TAB_REF FORMULA_0899_VTAB /end COMPU_METHOD
/begin COMPU_VTAB FORMULA_0899_VTAB "FORMULA_0899_VTAB" TAB_VERB 1 0 "O.K." DEFAULT_VALUE "Fehler" /end COMPU_VTAB
/begin COMPU_METHOD FORMULA_0900 "FORMULA_0900" TAB_VERB "%5.2" "-" COMPU_TAB_REF FORMULA_0900_VTAB /end COMPU_METHOD
/begin COMPU_VTAB FORMULA_0900_VTAB "FORMULA_0900_VTAB" TAB_VERB 1 0 "O.K." DEFAULT_VALUE "Bremse" /end COMPU_VTAB
/begin COMPU_METHOD FORMULA_0901 "FORMULA_0901" TAB_VERB "%5.2" "-" COMPU_TAB_REF FORMULA_0901_VTAB /end COMPU_METHOD
/begin COMPU_VTAB FORMULA_0901_VTAB "FORMULA_0901_VTAB" TAB_VERB 1 0 "O.K." DEFAULT_VALUE "Sperre" /end COMPU_VTAB
/begin COMPU_METHOD FORMULA_0902 "FORMULA_0902" RAT_FUNC "%9.4" "-" COEFFS 0 65536 0 0 0 1 /end COMPU_METHOD
/begin COMPU_METHOD FORMULA_0903 "FORMULA_0903" TAB_VERB "%5.2" "-" COMPU_TAB_REF FORMULA_0903_VTAB /end COMPU_METHOD
/begin COMPU_VTAB FORMULA_0903_VTAB "FORMULA_0903_VTAB" TAB_VERB 1 0 "Inaktiv" DEFAULT_VALUE "Aktiv" /end COMPU_VTAB
/begin COMPU_METHOD FORMULA_0904 "FORMULA_0904" TAB_VERB "%3.0" "-" COMPU_TAB_REF FORMULA_0904_VTAB /end COMPU_METHOD
/begin COMPU_VTAB FORMULA_0904_VTAB "FORMULA_0904_VTAB" TAB_VERB 3 0 "Begr. ueber v" 1 "Begr. ueber Druck" 2 "keine Begrenzung" /end COMPU_VTAB
/begin COMPU_METHOD FORMULA_0905 "FORMULA_0905" RAT_FUNC "%9.4" "s" COEFFS 0 0 327.68 0 1 0 /end COMPU_METHOD
/begin COMPU_METHOD FORMULA_0906 "FORMULA_0906" RAT_FUNC "%7.2" "1/s" COEFFS 0 1024 0 0 0 200 /end COMPU_METHOD
/begin COMPU_METHOD FORMULA_0907 "FORMULA_0907" RAT_FUNC "%5.0" "bar" COEFFS 0 1 0 0 0 1 /end COMPU_METHOD
/begin COMPU_METHOD FORMULA_0980 "FORMULA_0980" RAT_FUNC "%7.2" "Kelvin" COEFFS 0 20 0 0 0 1 /end COMPU_METHOD
/begin COMPU_METHOD FORMULA_0986 "FORMULA_0986" RAT_FUNC "%7.2" "min" COEFFS 0 60 0 0 0 1 /end COMPU_METHOD
/* ------------------ Abschnitt erzeugt aus tan.dat ------------------ */
/begin COMPU_METHOD FORMULA_0987 "FORMULA_0987" RAT_FUNC "%8.3" "�C" COEFFS 0 40 10926 0 0 1 /end COMPU_METHOD
/begin COMPU_METHOD FORMULA_0997 "FORMULA_0997" RAT_FUNC "%5.0" "Kelvin/s" COEFFS 0 1 0 0 0 1 /end COMPU_METHOD
/* ------------------ Abschnitt erzeugt aus time_rel_diag.dat ------------------ */
/begin COMPU_METHOD FORMULA_0998 "FORMULA_0998" TAB_VERB "%5.2" "-" COMPU_TAB_REF FORMULA_0998_VTAB /end COMPU_METHOD
/begin COMPU_VTAB FORMULA_0998_VTAB "FORMULA_0998_VTAB" TAB_VERB 5 1 "Diag. Standzeit aktiv" 2 "Diag. lfd. Betrieb aktiv" 3 "Diag. Std.zt/lfd. Betrieb aktiv" 64 "Diag. abgelaufen" 128 "Diag gesp. Bedg. n. erf." DEFAULT_VALUE "undef." /end COMPU_VTAB
/begin COMPU_METHOD FORMULA_0999 "FORMULA_0999" TAB_VERB "%5.2" "-" COMPU_TAB_REF FORMULA_0999_VTAB /end COMPU_METHOD
/begin COMPU_VTAB FORMULA_0999_VTAB "FORMULA_0999_VTAB" TAB_VERB 13 0 "Initialisierung" 1 "Error Slow MS" 2 "Error Fast MS" 3 "Error Slow-Fast MS" 4 "Error Slow ML" 5 "Error Slow MS/Slow ML" 6 "Error Fast MS/Slow ML" 7 "Error Slow-Fast MS/Slow ML" 8 "Error Fast ML" 9 "Error Slow MS/Fast ML" 10 "Error Fast MS/Fast ML" 64 "time_rel_st i.O." 128 "Timeout CAN-Telegramm" DEFAULT_VALUE "undef." /end COMPU_VTAB
/begin COMPU_METHOD FORMULA_1000 "FORMULA_1000" RAT_FUNC "%7.0" "s" COEFFS 0 1 0 0 0 1 /end COMPU_METHOD
/begin COMPU_METHOD FORMULA_1001 "FORMULA_1001" TAB_VERB "%5.2" "-" COMPU_TAB_REF FORMULA_1001_VTAB /end COMPU_METHOD
/begin COMPU_VTAB FORMULA_1001_VTAB "FORMULA_1001_VTAB" TAB_VERB 2 0 "Diag. aus" 1 "Diag. aktiv" DEFAULT_VALUE "undef" /end COMPU_VTAB
/begin COMPU_METHOD FORMULA_1002 "FORMULA_1002" RAT_FUNC "%5.0" "min" COEFFS 0 1 0 0 0 1 /end COMPU_METHOD
/* ------------------ Abschnitt erzeugt aus tmot.dat ------------------ */
/begin COMPU_METHOD FORMULA_1004 "FORMULA_1004" TAB_VERB "%5.2" "-" COMPU_TAB_REF FORMULA_1004_VTAB /end COMPU_METHOD
/begin COMPU_VTAB FORMULA_1004_VTAB "FORMULA_1004_VTAB" TAB_VERB 1 0 "tmot" DEFAULT_VALUE "tka" /end COMPU_VTAB
/begin COMPU_METHOD FORMULA_1005 "FORMULA_1005" TAB_VERB "%5.2" "-" COMPU_TAB_REF FORMULA_1005_VTAB /end COMPU_METHOD
/begin COMPU_VTAB FORMULA_1005_VTAB "FORMULA_1005_VTAB" TAB_VERB 1 0 "keine Sperre" DEFAULT_VALUE "Sperre" /end COMPU_VTAB
/begin COMPU_METHOD FORMULA_1006 "FORMULA_1006" TAB_VERB "%5.2" "-" COMPU_TAB_REF FORMULA_1006_VTAB /end COMPU_METHOD
/begin COMPU_VTAB FORMULA_1006_VTAB "FORMULA_1006_VTAB" TAB_VERB 1 0 "keine Sperre" DEFAULT_VALUE "Sperre" /end COMPU_VTAB
/begin COMPU_METHOD FORMULA_1007 "FORMULA_1007" TAB_VERB "%5.2" "-" COMPU_TAB_REF FORMULA_1007_VTAB /end COMPU_METHOD
/begin COMPU_VTAB FORMULA_1007_VTAB "FORMULA_1007_VTAB" TAB_VERB 1 0 "keine Sperre" DEFAULT_VALUE "Sperre" /end COMPU_VTAB
/begin COMPU_METHOD FORMULA_1008 "FORMULA_1008" TAB_VERB "%5.2" "-" COMPU_TAB_REF FORMULA_1008_VTAB /end COMPU_METHOD
/begin COMPU_VTAB FORMULA_1008_VTAB "FORMULA_1008_VTAB" TAB_VERB 1 0 "keine Sperre" DEFAULT_VALUE "Sperre" /end COMPU_VTAB
/begin COMPU_METHOD FORMULA_1009 "FORMULA_1009" TAB_VERB "%5.2" "-" COMPU_TAB_REF FORMULA_1009_VTAB /end COMPU_METHOD
/begin COMPU_VTAB FORMULA_1009_VTAB "FORMULA_1009_VTAB" TAB_VERB 1 0 "keine Erkennung" DEFAULT_VALUE "OK-erkannt" /end COMPU_VTAB
/begin COMPU_METHOD FORMULA_1010 "FORMULA_1010" TAB_VERB "%5.2" "-" COMPU_TAB_REF FORMULA_1010_VTAB /end COMPU_METHOD
/begin COMPU_VTAB FORMULA_1010_VTAB "FORMULA_1010_VTAB" TAB_VERB 1 0 "keine Erkennung" DEFAULT_VALUE "OK-erkannt" /end COMPU_VTAB
/begin COMPU_METHOD FORMULA_1011 "FORMULA_1011" TAB_VERB "%5.2" "-" COMPU_TAB_REF FORMULA_1011_VTAB /end COMPU_METHOD
/begin COMPU_VTAB FORMULA_1011_VTAB "FORMULA_1011_VTAB" TAB_VERB 1 0 "keine Erkennung" DEFAULT_VALUE "OK-erkannt" /end COMPU_VTAB
/begin COMPU_METHOD FORMULA_1012 "FORMULA_1012" TAB_VERB "%5.2" "-" COMPU_TAB_REF FORMULA_1012_VTAB /end COMPU_METHOD
/begin COMPU_VTAB FORMULA_1012_VTAB "FORMULA_1012_VTAB" TAB_VERB 1 0 "keine INIT" DEFAULT_VALUE "initialisiert" /end COMPU_VTAB
/begin COMPU_METHOD FORMULA_1013 "FORMULA_1013" RAT_FUNC "%9.2" "kgs/h" COEFFS 0 100 0 0 0 1 /end COMPU_METHOD
/begin COMPU_METHOD FORMULA_1014 "FORMULA_1014" RAT_FUNC "%11.4" "Kelvin" COEFFS 0 10240 0 0 0 1 /end COMPU_METHOD
/begin COMPU_METHOD FORMULA_1015 "FORMULA_1015" RAT_FUNC "%7.2" "Kelvin" COEFFS 0 40 0 0 0 1 /end COMPU_METHOD
/begin COMPU_METHOD FORMULA_1016 "FORMULA_1016" RAT_FUNC "%7.2" "Kelvin/s" COEFFS 0 4 0 0 0 1 /end COMPU_METHOD
/begin COMPU_METHOD FORMULA_1017 "FORMULA_1017" RAT_FUNC "%7.2" "K/100ms" COEFFS 0 40 0 0 0 1 /end COMPU_METHOD
/begin COMPU_METHOD FORMULA_1018 "FORMULA_1018" TAB_VERB "%3.0" "-" COMPU_TAB_REF FORMULA_1018_VTAB /end COMPU_METHOD
/begin COMPU_VTAB FORMULA_1018_VTAB "FORMULA_1018_VTAB" TAB_VERB 2 0 "OBD aus" 1 "OBD ein" /end COMPU_VTAB
/begin COMPU_METHOD FORMULA_1019 "FORMULA_1019" RAT_FUNC "%6.1" "s" COEFFS 0 100 0 0 0 1 /end COMPU_METHOD
/begin COMPU_METHOD FORMULA_1020 "FORMULA_1020" TAB_VERB "%5.2" "-" COMPU_TAB_REF FORMULA_1020_VTAB /end COMPU_METHOD
/begin COMPU_VTAB FORMULA_1020_VTAB "FORMULA_1020_VTAB" TAB_VERB 2 0 "toel" 1 "Oz_tempr" /end COMPU_VTAB
/begin COMPU_METHOD FORMULA_1021 "FORMULA_1021" RAT_FUNC "%4.1" "Kelvin" COEFFS 0 10 0 0 0 1 /end COMPU_METHOD
/* ------------------ Abschnitt erzeugt aus toel.dat ------------------ */
/begin COMPU_METHOD FORMULA_1022 "FORMULA_1022" RAT_FUNC "%11.4" "�C" COEFFS 0 10000 2732000 0 0 1 /end COMPU_METHOD
/begin COMPU_METHOD FORMULA_1023 "FORMULA_1023" RAT_FUNC "%9.4" "Kelvin" COEFFS 0 10000 0 0 0 1 /end COMPU_METHOD
/begin COMPU_METHOD FORMULA_1024 "FORMULA_1024" RAT_FUNC "%7.2" "min" COEFFS 0 1 0 0 0 1 /end COMPU_METHOD
/begin COMPU_METHOD FORMULA_1025 "FORMULA_1025" RAT_FUNC "%7.2" "Anteil [0..1]" COEFFS 0 100 0 0 0 1 /end COMPU_METHOD
/* ------------------ Abschnitt erzeugt aus pctrl.dat ------------------ */
/begin CHARACTERISTIC K_PCTRL_TIMEOUT "Timeout der Prozessorueberwachung | EN: Timeout der Prozessorueberwachung" VALUE 0x786AC TKW_VV_VV_UB 100.0 FORMULA_0353 0.0 2550.0000 /end CHARACTERISTIC
/begin CHARACTERISTIC K_PCTRL_TASK_ZYKL "Task-Ueberwachungszyklus | EN: Task-Ueberwachungszyklus" VALUE 0x786AD TKW_VV_VV_UB 100.0 FORMULA_0352 0.0 1.2750 /end CHARACTERISTIC
/begin CHARACTERISTIC K_PCTRL_PROZ_ZYKL "Prozess-Ueberwachungszyklus | EN: Prozess-Ueberwachungszyklus" VALUE 0x786AE TKW_VV_VV_UB 100.0 FORMULA_0352 0.0 1.2750 /end CHARACTERISTIC
/begin MEASUREMENT pctrl_t_old_ipk "vorheriger Timer Wert aus der IPK" ULONG FORMULA_0000 0 0 0.0 4294967295.0000 ECU_ADDRESS 0x3FC178 /end MEASUREMENT
/begin MEASUREMENT pctrl_task_tb "Timerwert Task-Ueberwachungszyklus" UBYTE FORMULA_0352 0 0 0.0 1.2750 ECU_ADDRESS 0x3FC17C /end MEASUREMENT
/begin MEASUREMENT pctrl_proz_tb "Timerwert Prozess-Ueberwachungszyklus" UBYTE FORMULA_0352 0 0 0.0 1.2750 ECU_ADDRESS 0x3FC17D /end MEASUREMENT
/begin MEASUREMENT pctrl_tout "Timeout Zaehler" UBYTE FORMULA_0353 0 0 0.0 2550.0000 ECU_ADDRESS 0x3FC17E /end MEASUREMENT
/begin MEASUREMENT pctrl_task "Taskueberwachung" UBYTE FORMULA_0003 0 0 0.0 255.0000 ECU_ADDRESS 0x3FC17F /end MEASUREMENT
/begin MEASUREMENT pctrl_task_err "Fehler Taskueberwachung" UBYTE FORMULA_0003 0 0 0.0 255.0000 ECU_ADDRESS 0x3FC180 /end MEASUREMENT
/begin MEASUREMENT pctrl_proz "Prozessueberwachung" UWORD FORMULA_0010 0 0 0.0 65535.0000 ECU_ADDRESS 0x3FC182 /end MEASUREMENT
/begin MEASUREMENT pctrl_proz_err "Fehler Prozessueberwachung" UWORD FORMULA_0010 0 0 0.0 65535.0000 ECU_ADDRESS 0x3FC184 /end MEASUREMENT
/* ------------------ Abschnitt erzeugt aus ram_chk.dat ------------------ */
/begin CHARACTERISTIC K_RAM_CHK_T "Zeit fuer den Ramcheck pro Aufruf" VALUE 0x78756 TKW_VV_VV_UB 100.0 FORMULA_0356 1.0000 255.0000 /end CHARACTERISTIC
/begin CHARACTERISTIC K_RAM_CHK_CFG "Ramcheck Config | EN: Ramcheck Config" VALUE 0x78757 TKW_VV_VV_UB 100.0 FORMULA_0357 0.0 255.0 /end CHARACTERISTIC
/begin MEASUREMENT ram_chk_rptr "aktueller RAM_CHK Zeiger" ULONG FORMULA_0000 0 0 0.0 4294967295.0000 ECU_ADDRESS 0x3FC1B8 /end MEASUREMENT
/begin MEASUREMENT ram_chk_freq "Ueberprufeungsfreuquenz RAM" UWORD FORMULA_0355 0 0 0.0 655.3500 ECU_ADDRESS 0x3FC1BC /end MEASUREMENT
/* ------------------ Abschnitt erzeugt aus sk.dat ------------------ */
/begin CHARACTERISTIC K_SK_CFG "SK-Cfg" VALUE 0x7875C TKW_VV_VV_UB 100.0 FORMULA_0363 0.0 255.0 /end CHARACTERISTIC
/begin CHARACTERISTIC K_SK_MAX_RESETS "max. Anzahl von Resets pro SG-Lauf | EN: Maximum number of resets per ECU run" VALUE 0x7875D TKW_VV_VV_UB 100.0 FORMULA_0003 0.0 255.0000 /end CHARACTERISTIC
/begin CHARACTERISTIC K_SK_FM_GEMISCH_TEST "SK Gemischtestmaske | EN: Safety-concept mixture test mask" VALUE 0x7875E TKW_VV_VV_UB 100.0 FORMULA_0003 0.0 255.0000 /end CHARACTERISTIC
/begin CHARACTERISTIC K_SK_FM_KR_TEST "SK KR-Testmaske" VALUE 0x7875F TKW_VV_VV_UB 100.0 FORMULA_0003 0.0 255.0000 /end CHARACTERISTIC
/begin CHARACTERISTIC K_SK_FM_EGAS_TEST "SK Egastestmaske | EN: Safety-concept E-gas test mask" VALUE 0x78760 TKW_VV_VV_UB 100.0 FORMULA_0003 0.0 255.0000 /end CHARACTERISTIC
/begin CHARACTERISTIC K_SK_ZYL_OFF_MAX "Anzahl der abg. Zyl. pro Bank | EN: Number of cylinders cut per bank" VALUE 0x78761 TKW_VV_VV_UB 100.0 FORMULA_0003 0.0 255.0000 /end CHARACTERISTIC
/begin CHARACTERISTIC K_SK_FM_FAIL_ZYL_TEST "SK TI-Testmaske (1=Aus) | EN: Safety-concept injection test mask (1=off)" VALUE 0x78762 TKW_VV_VV_UW 100.0 FORMULA_0010 0.0 65535.0000 /end CHARACTERISTIC
/begin CHARACTERISTIC K_SK_FM_SMG_TEST "SK SMG-Testmaske | EN: Safety-concept SMG test mask" VALUE 0x78764 TKW_VV_VV_UB 100.0 FORMULA_0003 0.0 255.0000 /end CHARACTERISTIC
/begin CHARACTERISTIC K_SK_FM_MD_TEST "SK Md-Testmaske | EN: Safety-concept torque test mask" VALUE 0x78765 TKW_VV_VV_UB 100.0 FORMULA_0003 0.0 255.0000 /end CHARACTERISTIC
/begin CHARACTERISTIC K_SK_FM_LAM_TEST "SK LAM-Testmaske | EN: Safety-concept lambda test mask" VALUE 0x78766 TKW_VV_VV_UB 100.0 FORMULA_0003 0.0 255.0000 /end CHARACTERISTIC
/begin CHARACTERISTIC K_SK_FM_MVAC_TEST "SK MVAC-Testmaske" VALUE 0x78767 TKW_VV_VV_UB 100.0 FORMULA_0364 0.0 255.0 /end CHARACTERISTIC
/begin CHARACTERISTIC K_SK_MAX_OS_ERR "erlaubte OS-Fehler bis zum Reset | EN: Permitted operating-system faults before reset" VALUE 0x78768 TKW_VV_VV_UB 100.0 FORMULA_0003 0.0 255.0000 /end CHARACTERISTIC
/begin CHARACTERISTIC K_SK_TASK_ERR "Maske Taskueberwachung | EN: Task monitoring mask" VALUE 0x78769 TKW_VV_VV_UB 100.0 FORMULA_0003 0.0 255.0000 /end CHARACTERISTIC
/begin CHARACTERISTIC K_SK_CRC32 "CRC32-Aktivierung" VALUE 0x7876A TKW_VV_VV_UB 100.0 FORMULA_0365 0.0 255.0 /end CHARACTERISTIC
/begin CHARACTERISTIC K_SK_PKS_NOTLAUF "PKS-Aktivierung | EN: Fuel-pressure-control activation" VALUE 0x7876B TKW_VV_VV_UB 100.0 FORMULA_0003 0.0 255.0000 /end CHARACTERISTIC
/begin CHARACTERISTIC K_SK_LLRA_SPERRE "LLRA-Sperre | EN: Idle-controller adaptation lock" VALUE 0x7876C TKW_VV_VV_UB 100.0 FORMULA_0003 0.0 255.0000 /end CHARACTERISTIC
/begin CHARACTERISTIC K_SK_FRA_SPERRE "FRA-Sperre | EN: Charge-adaptation lock" VALUE 0x7876D TKW_VV_VV_UB 100.0 FORMULA_0003 0.0 255.0000 /end CHARACTERISTIC
/begin CHARACTERISTIC K_SK_KH_SPERRE "KH-Sperre | EN: Catalyst-heating lock" VALUE 0x7876E TKW_VV_VV_UB 100.0 FORMULA_0003 0.0 255.0000 /end CHARACTERISTIC
/begin CHARACTERISTIC K_SK_FGR_SPERRE "FGR-Sperre | EN: Cruise control lock" VALUE 0x7876F TKW_VV_VV_UB 100.0 FORMULA_0003 0.0 255.0000 /end CHARACTERISTIC
/begin CHARACTERISTIC K_SK_MD_TI_EINGR "Freigabe Teilfeuern | EN: Enable partial firing (cylinder cut-out)" VALUE 0x78770 TKW_VV_VV_UB 100.0 FORMULA_0003 0.0 255.0000 /end CHARACTERISTIC
/begin CHARACTERISTIC K_SK_MD_VL_SPERRE "VL-Sperre | EN: Full-load lock" VALUE 0x78771 TKW_VV_VV_UB 100.0 FORMULA_0003 0.0 255.0000 /end CHARACTERISTIC
/begin CHARACTERISTIC K_SK_MD_BEGR_DK_OFFEN "Begrenzung bei offenen Klappen | EN: Limitation with open flaps" VALUE 0x78772 TKW_VV_VV_UB 100.0 FORMULA_0003 0.0 255.0000 /end CHARACTERISTIC
/begin CHARACTERISTIC K_SK_LAM_EINGR_TI "LA-Eingriff bei Teilfeuerung" VALUE 0x78773 TKW_VV_VV_UB 100.0 FORMULA_0366 0.0 255.0 /end CHARACTERISTIC
/begin CHARACTERISTIC K_SK_T_RESET_DELAY_OS "Resetdelay fuer Betriebssystem Fehler | EN: Reset delay for operating-system fault [s]" VALUE 0x78774 TKW_VV_VV_UB 100.0 FORMULA_0317 0.0 2.0000 /end CHARACTERISTIC
/begin CHARACTERISTIC K_SK_EGAS_OFF_TIME "Zeit bis Egasabschaltung | EN: Time until throttle (E-gas) shut-off [s]" VALUE 0x78776 TKW_VV_VV_UW 100.0 FORMULA_0021 0.0 5.0000 FORMAT "%5.2" /end CHARACTERISTIC
/begin CHARACTERISTIC K_SK_PROZ_ERR "Maske Prozessueberwachung | EN: Process monitoring mask" VALUE 0x78778 TKW_VV_VV_UW 100.0 FORMULA_0010 0.0 65535.0000 /end CHARACTERISTIC
/begin CHARACTERISTIC K_SK_MD_BEGR_MVAC_SYS "Begrenzung bei MVAC-Systemfehler | EN: Limitation with brake-booster vacuum system fault" VALUE 0x7877A TKW_VV_VV_UB 100.0 FORMULA_0003 0.0 255.0000 /end CHARACTERISTIC
/begin CHARACTERISTIC K_SK_MD_BEGR_RESET "Begrenzung ab dem 1.Reset | EN: Limitation from the 1st reset" VALUE 0x7877B TKW_VV_VV_UB 100.0 FORMULA_0003 0.0 255.0000 /end CHARACTERISTIC
/begin CHARACTERISTIC K_SK_EGAS_OFF_1of16_ "DK2 DK1 LLS2 LLS1 | EN: DK2 DK1 LLS2 LLS1" VALUE 0x7877C TKW_VV_VV_UB 100.0 FORMULA_0003 0.0 255.0000 /end CHARACTERISTIC
/begin CHARACTERISTIC K_SK_EGAS_OFF_2of16_ "DK2 DK1 LLS2 LLS1 | EN: DK2 DK1 LLS2 LLS1" VALUE 0x7877D TKW_VV_VV_UB 100.0 FORMULA_0003 0.0 255.0000 /end CHARACTERISTIC
/begin CHARACTERISTIC K_SK_EGAS_OFF_3of16_ "DK2 DK1 LLS2 LLS1 | EN: DK2 DK1 LLS2 LLS1" VALUE 0x7877E TKW_VV_VV_UB 100.0 FORMULA_0003 0.0 255.0000 /end CHARACTERISTIC
/begin CHARACTERISTIC K_SK_EGAS_OFF_4of16_ "DK2 DK1 LLS2 LLS1 | EN: DK2 DK1 LLS2 LLS1" VALUE 0x7877F TKW_VV_VV_UB 100.0 FORMULA_0003 0.0 255.0000 /end CHARACTERISTIC
/begin CHARACTERISTIC K_SK_EGAS_OFF_5of16_ "DK2 DK1 LLS2 LLS1 | EN: DK2 DK1 LLS2 LLS1" VALUE 0x78780 TKW_VV_VV_UB 100.0 FORMULA_0003 0.0 255.0000 /end CHARACTERISTIC
/begin CHARACTERISTIC K_SK_EGAS_OFF_6of16_ "DK2 DK1 LLS2 LLS1" VALUE 0x78781 TKW_VV_VV_UB 100.0 FORMULA_0003 0.0 255.0000 /end CHARACTERISTIC
/begin CHARACTERISTIC K_SK_EGAS_OFF_7of16_ "DK2 DK1 LLS2 LLS1 | EN: DK2 DK1 LLS2 LLS1" VALUE 0x78782 TKW_VV_VV_UB 100.0 FORMULA_0003 0.0 255.0000 /end CHARACTERISTIC
/begin CHARACTERISTIC K_SK_EGAS_OFF_8of16_ "DK2 DK1 LLS2 LLS1" VALUE 0x78783 TKW_VV_VV_UB 100.0 FORMULA_0003 0.0 255.0000 /end CHARACTERISTIC
/begin CHARACTERISTIC K_SK_EGAS_OFF_9of16_ "DK2 DK1 LLS2 LLS1" VALUE 0x78784 TKW_VV_VV_UB 100.0 FORMULA_0003 0.0 255.0000 /end CHARACTERISTIC
/begin CHARACTERISTIC K_SK_EGAS_OFF_10of16_ "DK2 DK1 LLS2 LLS1" VALUE 0x78785 TKW_VV_VV_UB 100.0 FORMULA_0003 0.0 255.0000 /end CHARACTERISTIC
/begin CHARACTERISTIC K_SK_EGAS_OFF_11of16_ "DK2 DK1 LLS2 LLS1" VALUE 0x78786 TKW_VV_VV_UB 100.0 FORMULA_0003 0.0 255.0000 /end CHARACTERISTIC
/begin CHARACTERISTIC K_SK_EGAS_OFF_12of16_ "DK2 DK1 LLS2 LLS1" VALUE 0x78787 TKW_VV_VV_UB 100.0 FORMULA_0003 0.0 255.0000 /end CHARACTERISTIC
/begin CHARACTERISTIC K_SK_EGAS_OFF_13of16_ "DK2 DK1 LLS2 LLS1" VALUE 0x78788 TKW_VV_VV_UB 100.0 FORMULA_0003 0.0 255.0000 /end CHARACTERISTIC
/begin CHARACTERISTIC K_SK_EGAS_OFF_14of16_ "DK2 DK1 LLS2 LLS1 | EN: DK2 DK1 LLS2 LLS1" VALUE 0x78789 TKW_VV_VV_UB 100.0 FORMULA_0003 0.0 255.0000 /end CHARACTERISTIC
/begin CHARACTERISTIC K_SK_EGAS_OFF_15of16_ "DK2 DK1 LLS2 LLS1 | EN: DK2 DK1 LLS2 LLS1" VALUE 0x7878A TKW_VV_VV_UB 100.0 FORMULA_0003 0.0 255.0000 /end CHARACTERISTIC
/begin CHARACTERISTIC K_SK_EGAS_OFF_16of16_ "DK2 DK1 LLS2 LLS1 | EN: DK2 DK1 LLS2 LLS1" VALUE 0x7878B TKW_VV_VV_UB 100.0 FORMULA_0003 0.0 255.0000 /end CHARACTERISTIC
/begin CHARACTERISTIC K_SK_MD_BEGR_EGAS_1of64_ "WDK2 WDK1 DK2 DK1 LLS2 LLS1 | EN: WDK2 WDK1 DK2 DK1 LLS2 LLS1" VALUE 0x7878C TKW_VV_VV_UB 100.0 FORMULA_0003 0.0 255.0000 /end CHARACTERISTIC
/begin CHARACTERISTIC K_SK_MD_BEGR_EGAS_2of64_ "WDK2 WDK1 DK2 DK1 LLS2 LLS1 | EN: WDK2 WDK1 DK2 DK1 LLS2 LLS1" VALUE 0x7878D TKW_VV_VV_UB 100.0 FORMULA_0003 0.0 255.0000 /end CHARACTERISTIC
/begin CHARACTERISTIC K_SK_MD_BEGR_EGAS_3of64_ "WDK2 WDK1 DK2 DK1 LLS2 LLS1 | EN: WDK2 WDK1 DK2 DK1 LLS2 LLS1" VALUE 0x7878E TKW_VV_VV_UB 100.0 FORMULA_0003 0.0 255.0000 /end CHARACTERISTIC
/begin CHARACTERISTIC K_SK_MD_BEGR_EGAS_4of64_ "WDK2 WDK1 DK2 DK1 LLS2 LLS1 | EN: WDK2 WDK1 DK2 DK1 LLS2 LLS1" VALUE 0x7878F TKW_VV_VV_UB 100.0 FORMULA_0003 0.0 255.0000 /end CHARACTERISTIC
/begin CHARACTERISTIC K_SK_MD_BEGR_EGAS_5of64_ "WDK2 WDK1 DK2 DK1 LLS2 LLS1 | EN: WDK2 WDK1 DK2 DK1 LLS2 LLS1" VALUE 0x78790 TKW_VV_VV_UB 100.0 FORMULA_0003 0.0 255.0000 /end CHARACTERISTIC
/begin CHARACTERISTIC K_SK_MD_BEGR_EGAS_6of64_ "WDK2 WDK1 DK2 DK1 LLS2 LLS1 | EN: WDK2 WDK1 DK2 DK1 LLS2 LLS1" VALUE 0x78791 TKW_VV_VV_UB 100.0 FORMULA_0003 0.0 255.0000 /end CHARACTERISTIC
/begin CHARACTERISTIC K_SK_MD_BEGR_EGAS_7of64_ "WDK2 WDK1 DK2 DK1 LLS2 LLS1 | EN: WDK2 WDK1 DK2 DK1 LLS2 LLS1" VALUE 0x78792 TKW_VV_VV_UB 100.0 FORMULA_0003 0.0 255.0000 /end CHARACTERISTIC
/begin CHARACTERISTIC K_SK_MD_BEGR_EGAS_8of64_ "WDK2 WDK1 DK2 DK1 LLS2 LLS1 | EN: WDK2 WDK1 DK2 DK1 LLS2 LLS1" VALUE 0x78793 TKW_VV_VV_UB 100.0 FORMULA_0003 0.0 255.0000 /end CHARACTERISTIC
/begin CHARACTERISTIC K_SK_MD_BEGR_EGAS_9of64_ "WDK2 WDK1 DK2 DK1 LLS2 LLS1 | EN: WDK2 WDK1 DK2 DK1 LLS2 LLS1" VALUE 0x78794 TKW_VV_VV_UB 100.0 FORMULA_0003 0.0 255.0000 /end CHARACTERISTIC
/begin CHARACTERISTIC K_SK_MD_BEGR_EGAS_10of64_ "WDK2 WDK1 DK2 DK1 LLS2 LLS1 | EN: WDK2 WDK1 DK2 DK1 LLS2 LLS1" VALUE 0x78795 TKW_VV_VV_UB 100.0 FORMULA_0003 0.0 255.0000 /end CHARACTERISTIC
/begin CHARACTERISTIC K_SK_MD_BEGR_EGAS_11of64_ "WDK2 WDK1 DK2 DK1 LLS2 LLS1 | EN: WDK2 WDK1 DK2 DK1 LLS2 LLS1" VALUE 0x78796 TKW_VV_VV_UB 100.0 FORMULA_0003 0.0 255.0000 /end CHARACTERISTIC
/begin CHARACTERISTIC K_SK_MD_BEGR_EGAS_12of64_ "WDK2 WDK1 DK2 DK1 LLS2 LLS1 | EN: WDK2 WDK1 DK2 DK1 LLS2 LLS1" VALUE 0x78797 TKW_VV_VV_UB 100.0 FORMULA_0003 0.0 255.0000 /end CHARACTERISTIC
/begin CHARACTERISTIC K_SK_MD_BEGR_EGAS_13of64_ "WDK2 WDK1 DK2 DK1 LLS2 LLS1 | EN: WDK2 WDK1 DK2 DK1 LLS2 LLS1" VALUE 0x78798 TKW_VV_VV_UB 100.0 FORMULA_0003 0.0 255.0000 /end CHARACTERISTIC
/begin CHARACTERISTIC K_SK_MD_BEGR_EGAS_14of64_ "WDK2 WDK1 DK2 DK1 LLS2 LLS1 | EN: WDK2 WDK1 DK2 DK1 LLS2 LLS1" VALUE 0x78799 TKW_VV_VV_UB 100.0 FORMULA_0003 0.0 255.0000 /end CHARACTERISTIC
/begin CHARACTERISTIC K_SK_MD_BEGR_EGAS_15of64_ "WDK2 WDK1 DK2 DK1 LLS2 LLS1 | EN: WDK2 WDK1 DK2 DK1 LLS2 LLS1" VALUE 0x7879A TKW_VV_VV_UB 100.0 FORMULA_0003 0.0 255.0000 /end CHARACTERISTIC
/begin CHARACTERISTIC K_SK_MD_BEGR_EGAS_16of64_ "WDK2 WDK1 DK2 DK1 LLS2 LLS1 | EN: WDK2 WDK1 DK2 DK1 LLS2 LLS1" VALUE 0x7879B TKW_VV_VV_UB 100.0 FORMULA_0003 0.0 255.0000 /end CHARACTERISTIC
/begin CHARACTERISTIC K_SK_MD_BEGR_EGAS_17of64_ "WDK2 WDK1 DK2 DK1 LLS2 LLS1" VALUE 0x7879C TKW_VV_VV_UB 100.0 FORMULA_0003 0.0 255.0000 /end CHARACTERISTIC
/begin CHARACTERISTIC K_SK_MD_BEGR_EGAS_18of64_ "WDK2 WDK1 DK2 DK1 LLS2 LLS1" VALUE 0x7879D TKW_VV_VV_UB 100.0 FORMULA_0003 0.0 255.0000 /end CHARACTERISTIC
/begin CHARACTERISTIC K_SK_MD_BEGR_EGAS_19of64_ "WDK2 WDK1 DK2 DK1 LLS2 LLS1" VALUE 0x7879E TKW_VV_VV_UB 100.0 FORMULA_0003 0.0 255.0000 /end CHARACTERISTIC
/begin CHARACTERISTIC K_SK_MD_BEGR_EGAS_20of64_ "WDK2 WDK1 DK2 DK1 LLS2 LLS1" VALUE 0x7879F TKW_VV_VV_UB 100.0 FORMULA_0003 0.0 255.0000 /end CHARACTERISTIC
/begin CHARACTERISTIC K_SK_MD_BEGR_EGAS_21of64_ "WDK2 WDK1 DK2 DK1 LLS2 LLS1" VALUE 0x787A0 TKW_VV_VV_UB 100.0 FORMULA_0003 0.0 255.0000 /end CHARACTERISTIC
/begin CHARACTERISTIC K_SK_MD_BEGR_EGAS_22of64_ "WDK2 WDK1 DK2 DK1 LLS2 LLS1" VALUE 0x787A1 TKW_VV_VV_UB 100.0 FORMULA_0003 0.0 255.0000 /end CHARACTERISTIC
/begin CHARACTERISTIC K_SK_MD_BEGR_EGAS_23of64_ "WDK2 WDK1 DK2 DK1 LLS2 LLS1" VALUE 0x787A2 TKW_VV_VV_UB 100.0 FORMULA_0003 0.0 255.0000 /end CHARACTERISTIC
/begin CHARACTERISTIC K_SK_MD_BEGR_EGAS_24of64_ "WDK2 WDK1 DK2 DK1 LLS2 LLS1" VALUE 0x787A3 TKW_VV_VV_UB 100.0 FORMULA_0003 0.0 255.0000 /end CHARACTERISTIC
/begin CHARACTERISTIC K_SK_MD_BEGR_EGAS_25of64_ "WDK2 WDK1 DK2 DK1 LLS2 LLS1 | EN: WDK2 WDK1 DK2 DK1 LLS2 LLS1" VALUE 0x787A4 TKW_VV_VV_UB 100.0 FORMULA_0003 0.0 255.0000 /end CHARACTERISTIC
/begin CHARACTERISTIC K_SK_MD_BEGR_EGAS_26of64_ "WDK2 WDK1 DK2 DK1 LLS2 LLS1 | EN: WDK2 WDK1 DK2 DK1 LLS2 LLS1" VALUE 0x787A5 TKW_VV_VV_UB 100.0 FORMULA_0003 0.0 255.0000 /end CHARACTERISTIC
/begin CHARACTERISTIC K_SK_MD_BEGR_EGAS_27of64_ "WDK2 WDK1 DK2 DK1 LLS2 LLS1 | EN: WDK2 WDK1 DK2 DK1 LLS2 LLS1" VALUE 0x787A6 TKW_VV_VV_UB 100.0 FORMULA_0003 0.0 255.0000 /end CHARACTERISTIC
/begin CHARACTERISTIC K_SK_MD_BEGR_EGAS_28of64_ "WDK2 WDK1 DK2 DK1 LLS2 LLS1 | EN: WDK2 WDK1 DK2 DK1 LLS2 LLS1" VALUE 0x787A7 TKW_VV_VV_UB 100.0 FORMULA_0003 0.0 255.0000 /end CHARACTERISTIC
/begin CHARACTERISTIC K_SK_MD_BEGR_EGAS_29of64_ "WDK2 WDK1 DK2 DK1 LLS2 LLS1" VALUE 0x787A8 TKW_VV_VV_UB 100.0 FORMULA_0003 0.0 255.0000 /end CHARACTERISTIC
/begin CHARACTERISTIC K_SK_MD_BEGR_EGAS_30of64_ "WDK2 WDK1 DK2 DK1 LLS2 LLS1" VALUE 0x787A9 TKW_VV_VV_UB 100.0 FORMULA_0003 0.0 255.0000 /end CHARACTERISTIC
/begin CHARACTERISTIC K_SK_MD_BEGR_EGAS_31of64_ "WDK2 WDK1 DK2 DK1 LLS2 LLS1" VALUE 0x787AA TKW_VV_VV_UB 100.0 FORMULA_0003 0.0 255.0000 /end CHARACTERISTIC
/begin CHARACTERISTIC K_SK_MD_BEGR_EGAS_32of64_ "WDK2 WDK1 DK2 DK1 LLS2 LLS1" VALUE 0x787AB TKW_VV_VV_UB 100.0 FORMULA_0003 0.0 255.0000 /end CHARACTERISTIC
/begin CHARACTERISTIC K_SK_MD_BEGR_EGAS_33of64_ "WDK2 WDK1 DK2 DK1 LLS2 LLS1" VALUE 0x787AC TKW_VV_VV_UB 100.0 FORMULA_0003 0.0 255.0000 /end CHARACTERISTIC
/begin CHARACTERISTIC K_SK_MD_BEGR_EGAS_34of64_ "WDK2 WDK1 DK2 DK1 LLS2 LLS1" VALUE 0x787AD TKW_VV_VV_UB 100.0 FORMULA_0003 0.0 255.0000 /end CHARACTERISTIC
/begin CHARACTERISTIC K_SK_MD_BEGR_EGAS_35of64_ "WDK2 WDK1 DK2 DK1 LLS2 LLS1" VALUE 0x787AE TKW_VV_VV_UB 100.0 FORMULA_0003 0.0 255.0000 /end CHARACTERISTIC
/begin CHARACTERISTIC K_SK_MD_BEGR_EGAS_36of64_ "WDK2 WDK1 DK2 DK1 LLS2 LLS1" VALUE 0x787AF TKW_VV_VV_UB 100.0 FORMULA_0003 0.0 255.0000 /end CHARACTERISTIC
/begin CHARACTERISTIC K_SK_MD_BEGR_EGAS_37of64_ "WDK2 WDK1 DK2 DK1 LLS2 LLS1" VALUE 0x787B0 TKW_VV_VV_UB 100.0 FORMULA_0003 0.0 255.0000 /end CHARACTERISTIC
/begin CHARACTERISTIC K_SK_MD_BEGR_EGAS_38of64_ "WDK2 WDK1 DK2 DK1 LLS2 LLS1" VALUE 0x787B1 TKW_VV_VV_UB 100.0 FORMULA_0003 0.0 255.0000 /end CHARACTERISTIC
/begin CHARACTERISTIC K_SK_MD_BEGR_EGAS_39of64_ "WDK2 WDK1 DK2 DK1 LLS2 LLS1" VALUE 0x787B2 TKW_VV_VV_UB 100.0 FORMULA_0003 0.0 255.0000 /end CHARACTERISTIC
/begin CHARACTERISTIC K_SK_MD_BEGR_EGAS_40of64_ "WDK2 WDK1 DK2 DK1 LLS2 LLS1" VALUE 0x787B3 TKW_VV_VV_UB 100.0 FORMULA_0003 0.0 255.0000 /end CHARACTERISTIC
/begin CHARACTERISTIC K_SK_MD_BEGR_EGAS_41of64_ "WDK2 WDK1 DK2 DK1 LLS2 LLS1 | EN: WDK2 WDK1 DK2 DK1 LLS2 LLS1" VALUE 0x787B4 TKW_VV_VV_UB 100.0 FORMULA_0003 0.0 255.0000 /end CHARACTERISTIC
/begin CHARACTERISTIC K_SK_MD_BEGR_EGAS_42of64_ "WDK2 WDK1 DK2 DK1 LLS2 LLS1 | EN: WDK2 WDK1 DK2 DK1 LLS2 LLS1" VALUE 0x787B5 TKW_VV_VV_UB 100.0 FORMULA_0003 0.0 255.0000 /end CHARACTERISTIC
/begin CHARACTERISTIC K_SK_MD_BEGR_EGAS_43of64_ "WDK2 WDK1 DK2 DK1 LLS2 LLS1 | EN: WDK2 WDK1 DK2 DK1 LLS2 LLS1" VALUE 0x787B6 TKW_VV_VV_UB 100.0 FORMULA_0003 0.0 255.0000 /end CHARACTERISTIC
/begin CHARACTERISTIC K_SK_MD_BEGR_EGAS_44of64_ "WDK2 WDK1 DK2 DK1 LLS2 LLS1 | EN: WDK2 WDK1 DK2 DK1 LLS2 LLS1" VALUE 0x787B7 TKW_VV_VV_UB 100.0 FORMULA_0003 0.0 255.0000 /end CHARACTERISTIC
/begin CHARACTERISTIC K_SK_MD_BEGR_EGAS_45of64_ "WDK2 WDK1 DK2 DK1 LLS2 LLS1" VALUE 0x787B8 TKW_VV_VV_UB 100.0 FORMULA_0003 0.0 255.0000 /end CHARACTERISTIC
/begin CHARACTERISTIC K_SK_MD_BEGR_EGAS_46of64_ "WDK2 WDK1 DK2 DK1 LLS2 LLS1" VALUE 0x787B9 TKW_VV_VV_UB 100.0 FORMULA_0003 0.0 255.0000 /end CHARACTERISTIC
/begin CHARACTERISTIC K_SK_MD_BEGR_EGAS_47of64_ "WDK2 WDK1 DK2 DK1 LLS2 LLS1" VALUE 0x787BA TKW_VV_VV_UB 100.0 FORMULA_0003 0.0 255.0000 /end CHARACTERISTIC
/begin CHARACTERISTIC K_SK_MD_BEGR_EGAS_48of64_ "WDK2 WDK1 DK2 DK1 LLS2 LLS1" VALUE 0x787BB TKW_VV_VV_UB 100.0 FORMULA_0003 0.0 255.0000 /end CHARACTERISTIC
/begin CHARACTERISTIC K_SK_MD_BEGR_EGAS_49of64_ "WDK2 WDK1 DK2 DK1 LLS2 LLS1" VALUE 0x787BC TKW_VV_VV_UB 100.0 FORMULA_0003 0.0 255.0000 /end CHARACTERISTIC
/begin CHARACTERISTIC K_SK_MD_BEGR_EGAS_50of64_ "WDK2 WDK1 DK2 DK1 LLS2 LLS1" VALUE 0x787BD TKW_VV_VV_UB 100.0 FORMULA_0003 0.0 255.0000 /end CHARACTERISTIC
/begin CHARACTERISTIC K_SK_MD_BEGR_EGAS_51of64_ "WDK2 WDK1 DK2 DK1 LLS2 LLS1" VALUE 0x787BE TKW_VV_VV_UB 100.0 FORMULA_0003 0.0 255.0000 /end CHARACTERISTIC
/begin CHARACTERISTIC K_SK_MD_BEGR_EGAS_52of64_ "WDK2 WDK1 DK2 DK1 LLS2 LLS1" VALUE 0x787BF TKW_VV_VV_UB 100.0 FORMULA_0003 0.0 255.0000 /end CHARACTERISTIC
/begin CHARACTERISTIC K_SK_MD_BEGR_EGAS_53of64_ "WDK2 WDK1 DK2 DK1 LLS2 LLS1" VALUE 0x787C0 TKW_VV_VV_UB 100.0 FORMULA_0003 0.0 255.0000 /end CHARACTERISTIC
/begin CHARACTERISTIC K_SK_MD_BEGR_EGAS_54of64_ "WDK2 WDK1 DK2 DK1 LLS2 LLS1" VALUE 0x787C1 TKW_VV_VV_UB 100.0 FORMULA_0003 0.0 255.0000 /end CHARACTERISTIC
/begin CHARACTERISTIC K_SK_MD_BEGR_EGAS_55of64_ "WDK2 WDK1 DK2 DK1 LLS2 LLS1" VALUE 0x787C2 TKW_VV_VV_UB 100.0 FORMULA_0003 0.0 255.0000 /end CHARACTERISTIC
/begin CHARACTERISTIC K_SK_MD_BEGR_EGAS_56of64_ "WDK2 WDK1 DK2 DK1 LLS2 LLS1" VALUE 0x787C3 TKW_VV_VV_UB 100.0 FORMULA_0003 0.0 255.0000 /end CHARACTERISTIC
/begin CHARACTERISTIC K_SK_MD_BEGR_EGAS_57of64_ "WDK2 WDK1 DK2 DK1 LLS2 LLS1" VALUE 0x787C4 TKW_VV_VV_UB 100.0 FORMULA_0003 0.0 255.0000 /end CHARACTERISTIC
/begin CHARACTERISTIC K_SK_MD_BEGR_EGAS_58of64_ "WDK2 WDK1 DK2 DK1 LLS2 LLS1" VALUE 0x787C5 TKW_VV_VV_UB 100.0 FORMULA_0003 0.0 255.0000 /end CHARACTERISTIC
/begin CHARACTERISTIC K_SK_MD_BEGR_EGAS_59of64_ "WDK2 WDK1 DK2 DK1 LLS2 LLS1" VALUE 0x787C6 TKW_VV_VV_UB 100.0 FORMULA_0003 0.0 255.0000 /end CHARACTERISTIC
/begin CHARACTERISTIC K_SK_MD_BEGR_EGAS_60of64_ "WDK2 WDK1 DK2 DK1 LLS2 LLS1" VALUE 0x787C7 TKW_VV_VV_UB 100.0 FORMULA_0003 0.0 255.0000 /end CHARACTERISTIC
/begin CHARACTERISTIC K_SK_MD_BEGR_EGAS_61of64_ "WDK2 WDK1 DK2 DK1 LLS2 LLS1" VALUE 0x787C8 TKW_VV_VV_UB 100.0 FORMULA_0003 0.0 255.0000 /end CHARACTERISTIC
/begin CHARACTERISTIC K_SK_MD_BEGR_EGAS_62of64_ "WDK2 WDK1 DK2 DK1 LLS2 LLS1" VALUE 0x787C9 TKW_VV_VV_UB 100.0 FORMULA_0003 0.0 255.0000 /end CHARACTERISTIC
/begin CHARACTERISTIC K_SK_MD_BEGR_EGAS_63of64_ "WDK2 WDK1 DK2 DK1 LLS2 LLS1" VALUE 0x787CA TKW_VV_VV_UB 100.0 FORMULA_0003 0.0 255.0000 /end CHARACTERISTIC
/begin CHARACTERISTIC K_SK_MD_BEGR_EGAS_64of64_ "WDK2 WDK1 DK2 DK1 LLS2 LLS1 | EN: WDK2 WDK1 DK2 DK1 LLS2 LLS1" VALUE 0x787CB TKW_VV_VV_UB 100.0 FORMULA_0003 0.0 255.0000 /end CHARACTERISTIC
/begin CHARACTERISTIC K_SK_MD_BEGR_TI_1of16_ "B2 B1 Z2 Z1" VALUE 0x787CC TKW_VV_VV_UB 100.0 FORMULA_0003 0.0 255.0000 /end CHARACTERISTIC
/begin CHARACTERISTIC K_SK_MD_BEGR_TI_2of16_ "B2 B1 Z2 Z1 | EN: B2 B1 Z2 Z1" VALUE 0x787CD TKW_VV_VV_UB 100.0 FORMULA_0003 0.0 255.0000 /end CHARACTERISTIC
/begin CHARACTERISTIC K_SK_MD_BEGR_TI_3of16_ "B2 B1 Z2 Z1 | EN: B2 B1 Z2 Z1" VALUE 0x787CE TKW_VV_VV_UB 100.0 FORMULA_0003 0.0 255.0000 /end CHARACTERISTIC
/begin CHARACTERISTIC K_SK_MD_BEGR_TI_4of16_ "B2 B1 Z2 Z1 | EN: B2 B1 Z2 Z1" VALUE 0x787CF TKW_VV_VV_UB 100.0 FORMULA_0003 0.0 255.0000 /end CHARACTERISTIC
/begin CHARACTERISTIC K_SK_MD_BEGR_TI_5of16_ "B2 B1 Z2 Z1 | EN: B2 B1 Z2 Z1" VALUE 0x787D0 TKW_VV_VV_UB 100.0 FORMULA_0003 0.0 255.0000 /end CHARACTERISTIC
/begin CHARACTERISTIC K_SK_MD_BEGR_TI_6of16_ "B2 B1 Z2 Z1 | EN: B2 B1 Z2 Z1" VALUE 0x787D1 TKW_VV_VV_UB 100.0 FORMULA_0003 0.0 255.0000 /end CHARACTERISTIC
/begin CHARACTERISTIC K_SK_MD_BEGR_TI_7of16_ "B2 B1 Z2 Z1 | EN: B2 B1 Z2 Z1" VALUE 0x787D2 TKW_VV_VV_UB 100.0 FORMULA_0003 0.0 255.0000 /end CHARACTERISTIC
/begin CHARACTERISTIC K_SK_MD_BEGR_TI_8of16_ "B2 B1 Z2 Z1 | EN: B2 B1 Z2 Z1" VALUE 0x787D3 TKW_VV_VV_UB 100.0 FORMULA_0003 0.0 255.0000 /end CHARACTERISTIC
/begin CHARACTERISTIC K_SK_MD_BEGR_TI_9of16_ "B2 B1 Z2 Z1 | EN: B2 B1 Z2 Z1" VALUE 0x787D4 TKW_VV_VV_UB 100.0 FORMULA_0003 0.0 255.0000 /end CHARACTERISTIC
/begin CHARACTERISTIC K_SK_MD_BEGR_TI_10of16_ "B2 B1 Z2 Z1 | EN: B2 B1 Z2 Z1" VALUE 0x787D5 TKW_VV_VV_UB 100.0 FORMULA_0003 0.0 255.0000 /end CHARACTERISTIC
/begin CHARACTERISTIC K_SK_MD_BEGR_TI_11of16_ "B2 B1 Z2 Z1 | EN: B2 B1 Z2 Z1" VALUE 0x787D6 TKW_VV_VV_UB 100.0 FORMULA_0003 0.0 255.0000 /end CHARACTERISTIC
/begin CHARACTERISTIC K_SK_MD_BEGR_TI_12of16_ "B2 B1 Z2 Z1 | EN: B2 B1 Z2 Z1" VALUE 0x787D7 TKW_VV_VV_UB 100.0 FORMULA_0003 0.0 255.0000 /end CHARACTERISTIC
/begin CHARACTERISTIC K_SK_MD_BEGR_TI_13of16_ "B2 B1 Z2 Z1 | EN: B2 B1 Z2 Z1" VALUE 0x787D8 TKW_VV_VV_UB 100.0 FORMULA_0003 0.0 255.0000 /end CHARACTERISTIC
/begin CHARACTERISTIC K_SK_MD_BEGR_TI_14of16_ "B2 B1 Z2 Z1 | EN: B2 B1 Z2 Z1" VALUE 0x787D9 TKW_VV_VV_UB 100.0 FORMULA_0003 0.0 255.0000 /end CHARACTERISTIC
/begin CHARACTERISTIC K_SK_MD_BEGR_TI_15of16_ "B2 B1 Z2 Z1 | EN: B2 B1 Z2 Z1" VALUE 0x787DA TKW_VV_VV_UB 100.0 FORMULA_0003 0.0 255.0000 /end CHARACTERISTIC
/begin CHARACTERISTIC K_SK_MD_BEGR_TI_16of16_ "B2 B1 Z2 Z1 | EN: B2 B1 Z2 Z1" VALUE 0x787DB TKW_VV_VV_UB 100.0 FORMULA_0003 0.0 255.0000 /end CHARACTERISTIC
/begin CHARACTERISTIC K_SK_TI_OFF_EGAS_1of64_ "TI2 TI1 DK2 DK1 LLS2 LLS1 | EN: TI2 TI1 DK2 DK1 LLS2 LLS1" VALUE 0x787DC TKW_VV_VV_UB 100.0 FORMULA_0003 0.0 255.0000 /end CHARACTERISTIC
/begin CHARACTERISTIC K_SK_TI_OFF_EGAS_2of64_ "TI2 TI1 DK2 DK1 LLS2 LLS1 | EN: TI2 TI1 DK2 DK1 LLS2 LLS1" VALUE 0x787DD TKW_VV_VV_UB 100.0 FORMULA_0003 0.0 255.0000 /end CHARACTERISTIC
/begin CHARACTERISTIC K_SK_TI_OFF_EGAS_3of64_ "TI2 TI1 DK2 DK1 LLS2 LLS1 | EN: TI2 TI1 DK2 DK1 LLS2 LLS1" VALUE 0x787DE TKW_VV_VV_UB 100.0 FORMULA_0003 0.0 255.0000 /end CHARACTERISTIC
/begin CHARACTERISTIC K_SK_TI_OFF_EGAS_4of64_ "TI2 TI1 DK2 DK1 LLS2 LLS1 | EN: TI2 TI1 DK2 DK1 LLS2 LLS1" VALUE 0x787DF TKW_VV_VV_UB 100.0 FORMULA_0003 0.0 255.0000 /end CHARACTERISTIC
/begin CHARACTERISTIC K_SK_TI_OFF_EGAS_5of64_ "TI2 TI1 DK2 DK1 LLS2 LLS1 | EN: TI2 TI1 DK2 DK1 LLS2 LLS1" VALUE 0x787E0 TKW_VV_VV_UB 100.0 FORMULA_0003 0.0 255.0000 /end CHARACTERISTIC
/begin CHARACTERISTIC K_SK_TI_OFF_EGAS_6of64_ "TI2 TI1 DK2 DK1 LLS2 LLS1 | EN: TI2 TI1 DK2 DK1 LLS2 LLS1" VALUE 0x787E1 TKW_VV_VV_UB 100.0 FORMULA_0003 0.0 255.0000 /end CHARACTERISTIC
/begin CHARACTERISTIC K_SK_TI_OFF_EGAS_7of64_ "TI2 TI1 DK2 DK1 LLS2 LLS1 | EN: TI2 TI1 DK2 DK1 LLS2 LLS1" VALUE 0x787E2 TKW_VV_VV_UB 100.0 FORMULA_0003 0.0 255.0000 /end CHARACTERISTIC
/begin CHARACTERISTIC K_SK_TI_OFF_EGAS_8of64_ "TI2 TI1 DK2 DK1 LLS2 LLS1 | EN: TI2 TI1 DK2 DK1 LLS2 LLS1" VALUE 0x787E3 TKW_VV_VV_UB 100.0 FORMULA_0003 0.0 255.0000 /end CHARACTERISTIC
/begin CHARACTERISTIC K_SK_TI_OFF_EGAS_9of64_ "TI2 TI1 DK2 DK1 LLS2 LLS1 | EN: TI2 TI1 DK2 DK1 LLS2 LLS1" VALUE 0x787E4 TKW_VV_VV_UB 100.0 FORMULA_0003 0.0 255.0000 /end CHARACTERISTIC
/begin CHARACTERISTIC K_SK_TI_OFF_EGAS_10of64_ "TI2 TI1 DK2 DK1 LLS2 LLS1 | EN: TI2 TI1 DK2 DK1 LLS2 LLS1" VALUE 0x787E5 TKW_VV_VV_UB 100.0 FORMULA_0003 0.0 255.0000 /end CHARACTERISTIC
/begin CHARACTERISTIC K_SK_TI_OFF_EGAS_11of64_ "TI2 TI1 DK2 DK1 LLS2 LLS1 | EN: TI2 TI1 DK2 DK1 LLS2 LLS1" VALUE 0x787E6 TKW_VV_VV_UB 100.0 FORMULA_0003 0.0 255.0000 /end CHARACTERISTIC
/begin CHARACTERISTIC K_SK_TI_OFF_EGAS_12of64_ "TI2 TI1 DK2 DK1 LLS2 LLS1 | EN: TI2 TI1 DK2 DK1 LLS2 LLS1" VALUE 0x787E7 TKW_VV_VV_UB 100.0 FORMULA_0003 0.0 255.0000 /end CHARACTERISTIC
/begin CHARACTERISTIC K_SK_TI_OFF_EGAS_13of64_ "TI2 TI1 DK2 DK1 LLS2 LLS1 | EN: TI2 TI1 DK2 DK1 LLS2 LLS1" VALUE 0x787E8 TKW_VV_VV_UB 100.0 FORMULA_0003 0.0 255.0000 /end CHARACTERISTIC
/begin CHARACTERISTIC K_SK_TI_OFF_EGAS_14of64_ "TI2 TI1 DK2 DK1 LLS2 LLS1 | EN: TI2 TI1 DK2 DK1 LLS2 LLS1" VALUE 0x787E9 TKW_VV_VV_UB 100.0 FORMULA_0003 0.0 255.0000 /end CHARACTERISTIC
/begin CHARACTERISTIC K_SK_TI_OFF_EGAS_15of64_ "TI2 TI1 DK2 DK1 LLS2 LLS1 | EN: TI2 TI1 DK2 DK1 LLS2 LLS1" VALUE 0x787EA TKW_VV_VV_UB 100.0 FORMULA_0003 0.0 255.0000 /end CHARACTERISTIC
/begin CHARACTERISTIC K_SK_TI_OFF_EGAS_16of64_ "TI2 TI1 DK2 DK1 LLS2 LLS1 | EN: TI2 TI1 DK2 DK1 LLS2 LLS1" VALUE 0x787EB TKW_VV_VV_UB 100.0 FORMULA_0003 0.0 255.0000 /end CHARACTERISTIC
/begin CHARACTERISTIC K_SK_TI_OFF_EGAS_17of64_ "TI2 TI1 DK2 DK1 LLS2 LLS1 | EN: TI2 TI1 DK2 DK1 LLS2 LLS1" VALUE 0x787EC TKW_VV_VV_UB 100.0 FORMULA_0003 0.0 255.0000 /end CHARACTERISTIC
/begin CHARACTERISTIC K_SK_TI_OFF_EGAS_18of64_ "TI2 TI1 DK2 DK1 LLS2 LLS1 | EN: TI2 TI1 DK2 DK1 LLS2 LLS1" VALUE 0x787ED TKW_VV_VV_UB 100.0 FORMULA_0003 0.0 255.0000 /end CHARACTERISTIC
/begin CHARACTERISTIC K_SK_TI_OFF_EGAS_19of64_ "TI2 TI1 DK2 DK1 LLS2 LLS1 | EN: TI2 TI1 DK2 DK1 LLS2 LLS1" VALUE 0x787EE TKW_VV_VV_UB 100.0 FORMULA_0003 0.0 255.0000 /end CHARACTERISTIC
/begin CHARACTERISTIC K_SK_TI_OFF_EGAS_20of64_ "TI2 TI1 DK2 DK1 LLS2 LLS1 | EN: TI2 TI1 DK2 DK1 LLS2 LLS1" VALUE 0x787EF TKW_VV_VV_UB 100.0 FORMULA_0003 0.0 255.0000 /end CHARACTERISTIC
/begin CHARACTERISTIC K_SK_TI_OFF_EGAS_21of64_ "TI2 TI1 DK2 DK1 LLS2 LLS1 | EN: TI2 TI1 DK2 DK1 LLS2 LLS1" VALUE 0x787F0 TKW_VV_VV_UB 100.0 FORMULA_0003 0.0 255.0000 /end CHARACTERISTIC
/begin CHARACTERISTIC K_SK_TI_OFF_EGAS_22of64_ "TI2 TI1 DK2 DK1 LLS2 LLS1 | EN: TI2 TI1 DK2 DK1 LLS2 LLS1" VALUE 0x787F1 TKW_VV_VV_UB 100.0 FORMULA_0003 0.0 255.0000 /end CHARACTERISTIC
/begin CHARACTERISTIC K_SK_TI_OFF_EGAS_23of64_ "TI2 TI1 DK2 DK1 LLS2 LLS1 | EN: TI2 TI1 DK2 DK1 LLS2 LLS1" VALUE 0x787F2 TKW_VV_VV_UB 100.0 FORMULA_0003 0.0 255.0000 /end CHARACTERISTIC
/begin CHARACTERISTIC K_SK_TI_OFF_EGAS_24of64_ "TI2 TI1 DK2 DK1 LLS2 LLS1 | EN: TI2 TI1 DK2 DK1 LLS2 LLS1" VALUE 0x787F3 TKW_VV_VV_UB 100.0 FORMULA_0003 0.0 255.0000 /end CHARACTERISTIC
/begin CHARACTERISTIC K_SK_TI_OFF_EGAS_25of64_ "TI2 TI1 DK2 DK1 LLS2 LLS1 | EN: TI2 TI1 DK2 DK1 LLS2 LLS1" VALUE 0x787F4 TKW_VV_VV_UB 100.0 FORMULA_0003 0.0 255.0000 /end CHARACTERISTIC
/begin CHARACTERISTIC K_SK_TI_OFF_EGAS_26of64_ "TI2 TI1 DK2 DK1 LLS2 LLS1 | EN: TI2 TI1 DK2 DK1 LLS2 LLS1" VALUE 0x787F5 TKW_VV_VV_UB 100.0 FORMULA_0003 0.0 255.0000 /end CHARACTERISTIC
/begin CHARACTERISTIC K_SK_TI_OFF_EGAS_27of64_ "TI2 TI1 DK2 DK1 LLS2 LLS1 | EN: TI2 TI1 DK2 DK1 LLS2 LLS1" VALUE 0x787F6 TKW_VV_VV_UB 100.0 FORMULA_0003 0.0 255.0000 /end CHARACTERISTIC
/begin CHARACTERISTIC K_SK_TI_OFF_EGAS_28of64_ "TI2 TI1 DK2 DK1 LLS2 LLS1 | EN: TI2 TI1 DK2 DK1 LLS2 LLS1" VALUE 0x787F7 TKW_VV_VV_UB 100.0 FORMULA_0003 0.0 255.0000 /end CHARACTERISTIC
/begin CHARACTERISTIC K_SK_TI_OFF_EGAS_29of64_ "TI2 TI1 DK2 DK1 LLS2 LLS1 | EN: TI2 TI1 DK2 DK1 LLS2 LLS1" VALUE 0x787F8 TKW_VV_VV_UB 100.0 FORMULA_0003 0.0 255.0000 /end CHARACTERISTIC
/begin CHARACTERISTIC K_SK_TI_OFF_EGAS_30of64_ "TI2 TI1 DK2 DK1 LLS2 LLS1 | EN: TI2 TI1 DK2 DK1 LLS2 LLS1" VALUE 0x787F9 TKW_VV_VV_UB 100.0 FORMULA_0003 0.0 255.0000 /end CHARACTERISTIC
/begin CHARACTERISTIC K_SK_TI_OFF_EGAS_31of64_ "TI2 TI1 DK2 DK1 LLS2 LLS1 | EN: TI2 TI1 DK2 DK1 LLS2 LLS1" VALUE 0x787FA TKW_VV_VV_UB 100.0 FORMULA_0003 0.0 255.0000 /end CHARACTERISTIC
/begin CHARACTERISTIC K_SK_TI_OFF_EGAS_32of64_ "TI2 TI1 DK2 DK1 LLS2 LLS1 | EN: TI2 TI1 DK2 DK1 LLS2 LLS1" VALUE 0x787FB TKW_VV_VV_UB 100.0 FORMULA_0003 0.0 255.0000 /end CHARACTERISTIC
/begin CHARACTERISTIC K_SK_TI_OFF_EGAS_33of64_ "TI2 TI1 DK2 DK1 LLS2 LLS1 | EN: TI2 TI1 DK2 DK1 LLS2 LLS1" VALUE 0x787FC TKW_VV_VV_UB 100.0 FORMULA_0003 0.0 255.0000 /end CHARACTERISTIC
/begin CHARACTERISTIC K_SK_TI_OFF_EGAS_34of64_ "TI2 TI1 DK2 DK1 LLS2 LLS1 | EN: TI2 TI1 DK2 DK1 LLS2 LLS1" VALUE 0x787FD TKW_VV_VV_UB 100.0 FORMULA_0003 0.0 255.0000 /end CHARACTERISTIC
/begin CHARACTERISTIC K_SK_TI_OFF_EGAS_35of64_ "TI2 TI1 DK2 DK1 LLS2 LLS1 | EN: TI2 TI1 DK2 DK1 LLS2 LLS1" VALUE 0x787FE TKW_VV_VV_UB 100.0 FORMULA_0003 0.0 255.0000 /end CHARACTERISTIC
/begin CHARACTERISTIC K_SK_TI_OFF_EGAS_36of64_ "TI2 TI1 DK2 DK1 LLS2 LLS1 | EN: TI2 TI1 DK2 DK1 LLS2 LLS1" VALUE 0x787FF TKW_VV_VV_UB 100.0 FORMULA_0003 0.0 255.0000 /end CHARACTERISTIC
/begin CHARACTERISTIC K_SK_TI_OFF_EGAS_37of64_ "TI2 TI1 DK2 DK1 LLS2 LLS1 | EN: TI2 TI1 DK2 DK1 LLS2 LLS1" VALUE 0x78800 TKW_VV_VV_UB 100.0 FORMULA_0003 0.0 255.0000 /end CHARACTERISTIC
/begin CHARACTERISTIC K_SK_TI_OFF_EGAS_38of64_ "TI2 TI1 DK2 DK1 LLS2 LLS1 | EN: TI2 TI1 DK2 DK1 LLS2 LLS1" VALUE 0x78801 TKW_VV_VV_UB 100.0 FORMULA_0003 0.0 255.0000 /end CHARACTERISTIC
/begin CHARACTERISTIC K_SK_TI_OFF_EGAS_39of64_ "TI2 TI1 DK2 DK1 LLS2 LLS1 | EN: TI2 TI1 DK2 DK1 LLS2 LLS1" VALUE 0x78802 TKW_VV_VV_UB 100.0 FORMULA_0003 0.0 255.0000 /end CHARACTERISTIC
/begin CHARACTERISTIC K_SK_TI_OFF_EGAS_40of64_ "TI2 TI1 DK2 DK1 LLS2 LLS1 | EN: TI2 TI1 DK2 DK1 LLS2 LLS1" VALUE 0x78803 TKW_VV_VV_UB 100.0 FORMULA_0003 0.0 255.0000 /end CHARACTERISTIC
/begin CHARACTERISTIC K_SK_TI_OFF_EGAS_41of64_ "TI2 TI1 DK2 DK1 LLS2 LLS1 | EN: TI2 TI1 DK2 DK1 LLS2 LLS1" VALUE 0x78804 TKW_VV_VV_UB 100.0 FORMULA_0003 0.0 255.0000 /end CHARACTERISTIC
/begin CHARACTERISTIC K_SK_TI_OFF_EGAS_42of64_ "TI2 TI1 DK2 DK1 LLS2 LLS1 | EN: TI2 TI1 DK2 DK1 LLS2 LLS1" VALUE 0x78805 TKW_VV_VV_UB 100.0 FORMULA_0003 0.0 255.0000 /end CHARACTERISTIC
/begin CHARACTERISTIC K_SK_TI_OFF_EGAS_43of64_ "TI2 TI1 DK2 DK1 LLS2 LLS1 | EN: TI2 TI1 DK2 DK1 LLS2 LLS1" VALUE 0x78806 TKW_VV_VV_UB 100.0 FORMULA_0003 0.0 255.0000 /end CHARACTERISTIC
/begin CHARACTERISTIC K_SK_TI_OFF_EGAS_44of64_ "TI2 TI1 DK2 DK1 LLS2 LLS1 | EN: TI2 TI1 DK2 DK1 LLS2 LLS1" VALUE 0x78807 TKW_VV_VV_UB 100.0 FORMULA_0003 0.0 255.0000 /end CHARACTERISTIC
/begin CHARACTERISTIC K_SK_TI_OFF_EGAS_45of64_ "TI2 TI1 DK2 DK1 LLS2 LLS1 | EN: TI2 TI1 DK2 DK1 LLS2 LLS1" VALUE 0x78808 TKW_VV_VV_UB 100.0 FORMULA_0003 0.0 255.0000 /end CHARACTERISTIC
/begin CHARACTERISTIC K_SK_TI_OFF_EGAS_46of64_ "TI2 TI1 DK2 DK1 LLS2 LLS1 | EN: TI2 TI1 DK2 DK1 LLS2 LLS1" VALUE 0x78809 TKW_VV_VV_UB 100.0 FORMULA_0003 0.0 255.0000 /end CHARACTERISTIC
/begin CHARACTERISTIC K_SK_TI_OFF_EGAS_47of64_ "TI2 TI1 DK2 DK1 LLS2 LLS1 | EN: TI2 TI1 DK2 DK1 LLS2 LLS1" VALUE 0x7880A TKW_VV_VV_UB 100.0 FORMULA_0003 0.0 255.0000 /end CHARACTERISTIC
/begin CHARACTERISTIC K_SK_TI_OFF_EGAS_48of64_ "TI2 TI1 DK2 DK1 LLS2 LLS1 | EN: TI2 TI1 DK2 DK1 LLS2 LLS1" VALUE 0x7880B TKW_VV_VV_UB 100.0 FORMULA_0003 0.0 255.0000 /end CHARACTERISTIC
/begin CHARACTERISTIC K_SK_TI_OFF_EGAS_49of64_ "TI2 TI1 DK2 DK1 LLS2 LLS1 | EN: TI2 TI1 DK2 DK1 LLS2 LLS1" VALUE 0x7880C TKW_VV_VV_UB 100.0 FORMULA_0003 0.0 255.0000 /end CHARACTERISTIC
/begin CHARACTERISTIC K_SK_TI_OFF_EGAS_50of64_ "TI2 TI1 DK2 DK1 LLS2 LLS1 | EN: TI2 TI1 DK2 DK1 LLS2 LLS1" VALUE 0x7880D TKW_VV_VV_UB 100.0 FORMULA_0003 0.0 255.0000 /end CHARACTERISTIC
/begin CHARACTERISTIC K_SK_TI_OFF_EGAS_51of64_ "TI2 TI1 DK2 DK1 LLS2 LLS1 | EN: TI2 TI1 DK2 DK1 LLS2 LLS1" VALUE 0x7880E TKW_VV_VV_UB 100.0 FORMULA_0003 0.0 255.0000 /end CHARACTERISTIC
/begin CHARACTERISTIC K_SK_TI_OFF_EGAS_52of64_ "TI2 TI1 DK2 DK1 LLS2 LLS1 | EN: TI2 TI1 DK2 DK1 LLS2 LLS1" VALUE 0x7880F TKW_VV_VV_UB 100.0 FORMULA_0003 0.0 255.0000 /end CHARACTERISTIC
/begin CHARACTERISTIC K_SK_TI_OFF_EGAS_53of64_ "TI2 TI1 DK2 DK1 LLS2 LLS1 | EN: TI2 TI1 DK2 DK1 LLS2 LLS1" VALUE 0x78810 TKW_VV_VV_UB 100.0 FORMULA_0003 0.0 255.0000 /end CHARACTERISTIC
/begin CHARACTERISTIC K_SK_TI_OFF_EGAS_54of64_ "TI2 TI1 DK2 DK1 LLS2 LLS1 | EN: TI2 TI1 DK2 DK1 LLS2 LLS1" VALUE 0x78811 TKW_VV_VV_UB 100.0 FORMULA_0003 0.0 255.0000 /end CHARACTERISTIC
/begin CHARACTERISTIC K_SK_TI_OFF_EGAS_55of64_ "TI2 TI1 DK2 DK1 LLS2 LLS1 | EN: TI2 TI1 DK2 DK1 LLS2 LLS1" VALUE 0x78812 TKW_VV_VV_UB 100.0 FORMULA_0003 0.0 255.0000 /end CHARACTERISTIC
/begin CHARACTERISTIC K_SK_TI_OFF_EGAS_56of64_ "TI2 TI1 DK2 DK1 LLS2 LLS1 | EN: TI2 TI1 DK2 DK1 LLS2 LLS1" VALUE 0x78813 TKW_VV_VV_UB 100.0 FORMULA_0003 0.0 255.0000 /end CHARACTERISTIC
/begin CHARACTERISTIC K_SK_TI_OFF_EGAS_57of64_ "TI2 TI1 DK2 DK1 LLS2 LLS1 | EN: TI2 TI1 DK2 DK1 LLS2 LLS1" VALUE 0x78814 TKW_VV_VV_UB 100.0 FORMULA_0003 0.0 255.0000 /end CHARACTERISTIC
/begin CHARACTERISTIC K_SK_TI_OFF_EGAS_58of64_ "TI2 TI1 DK2 DK1 LLS2 LLS1 | EN: TI2 TI1 DK2 DK1 LLS2 LLS1" VALUE 0x78815 TKW_VV_VV_UB 100.0 FORMULA_0003 0.0 255.0000 /end CHARACTERISTIC
/begin CHARACTERISTIC K_SK_TI_OFF_EGAS_59of64_ "TI2 TI1 DK2 DK1 LLS2 LLS1 | EN: TI2 TI1 DK2 DK1 LLS2 LLS1" VALUE 0x78816 TKW_VV_VV_UB 100.0 FORMULA_0003 0.0 255.0000 /end CHARACTERISTIC
/begin CHARACTERISTIC K_SK_TI_OFF_EGAS_60of64_ "TI2 TI1 DK2 DK1 LLS2 LLS1 | EN: TI2 TI1 DK2 DK1 LLS2 LLS1" VALUE 0x78817 TKW_VV_VV_UB 100.0 FORMULA_0003 0.0 255.0000 /end CHARACTERISTIC
/begin CHARACTERISTIC K_SK_TI_OFF_EGAS_61of64_ "TI2 TI1 DK2 DK1 LLS2 LLS1 | EN: TI2 TI1 DK2 DK1 LLS2 LLS1" VALUE 0x78818 TKW_VV_VV_UB 100.0 FORMULA_0003 0.0 255.0000 /end CHARACTERISTIC
/begin CHARACTERISTIC K_SK_TI_OFF_EGAS_62of64_ "TI2 TI1 DK2 DK1 LLS2 LLS1 | EN: TI2 TI1 DK2 DK1 LLS2 LLS1" VALUE 0x78819 TKW_VV_VV_UB 100.0 FORMULA_0003 0.0 255.0000 /end CHARACTERISTIC
/begin CHARACTERISTIC K_SK_TI_OFF_EGAS_63of64_ "TI2 TI1 DK2 DK1 LLS2 LLS1 | EN: TI2 TI1 DK2 DK1 LLS2 LLS1" VALUE 0x7881A TKW_VV_VV_UB 100.0 FORMULA_0003 0.0 255.0000 /end CHARACTERISTIC
/begin CHARACTERISTIC K_SK_TI_OFF_EGAS_64of64_ "TI2 TI1 DK2 DK1 LLS2 LLS1 | EN: TI2 TI1 DK2 DK1 LLS2 LLS1" VALUE 0x7881B TKW_VV_VV_UB 100.0 FORMULA_0003 0.0 255.0000 /end CHARACTERISTIC
/begin CHARACTERISTIC K_SK_MD_BEGR_SMG_1of16_ "CANErr CANSk STAT SABR | EN: CANErr CANSk STAT SABR" VALUE 0x7881C TKW_VV_VV_UB 100.0 FORMULA_0003 0.0 255.0000 /end CHARACTERISTIC
/begin CHARACTERISTIC K_SK_MD_BEGR_SMG_2of16_ "CANErr CANSk STAT SABR | EN: CANErr CANSk STAT SABR" VALUE 0x7881D TKW_VV_VV_UB 100.0 FORMULA_0003 0.0 255.0000 /end CHARACTERISTIC
/begin CHARACTERISTIC K_SK_MD_BEGR_SMG_3of16_ "CANErr CANSk STAT SABR | EN: CANErr CANSk STAT SABR" VALUE 0x7881E TKW_VV_VV_UB 100.0 FORMULA_0003 0.0 255.0000 /end CHARACTERISTIC
/begin CHARACTERISTIC K_SK_MD_BEGR_SMG_4of16_ "CANErr CANSk STAT SABR | EN: CANErr CANSk STAT SABR" VALUE 0x7881F TKW_VV_VV_UB 100.0 FORMULA_0003 0.0 255.0000 /end CHARACTERISTIC
/begin CHARACTERISTIC K_SK_MD_BEGR_SMG_5of16_ "CANErr CANSk STAT SABR | EN: CANErr CANSk STAT SABR" VALUE 0x78820 TKW_VV_VV_UB 100.0 FORMULA_0003 0.0 255.0000 /end CHARACTERISTIC
/begin CHARACTERISTIC K_SK_MD_BEGR_SMG_6of16_ "CANErr CANSk STAT SABR | EN: CANErr CANSk STAT SABR" VALUE 0x78821 TKW_VV_VV_UB 100.0 FORMULA_0003 0.0 255.0000 /end CHARACTERISTIC
/begin CHARACTERISTIC K_SK_MD_BEGR_SMG_7of16_ "CANErr CANSk STAT SABR | EN: CANErr CANSk STAT SABR" VALUE 0x78822 TKW_VV_VV_UB 100.0 FORMULA_0003 0.0 255.0000 /end CHARACTERISTIC
/begin CHARACTERISTIC K_SK_MD_BEGR_SMG_8of16_ "CANErr CANSk STAT SABR | EN: CANErr CANSk STAT SABR" VALUE 0x78823 TKW_VV_VV_UB 100.0 FORMULA_0003 0.0 255.0000 /end CHARACTERISTIC
/begin CHARACTERISTIC K_SK_MD_BEGR_SMG_9of16_ "CANErr CANSk STAT SABR | EN: CANErr CANSk STAT SABR" VALUE 0x78824 TKW_VV_VV_UB 100.0 FORMULA_0003 0.0 255.0000 /end CHARACTERISTIC
/begin CHARACTERISTIC K_SK_MD_BEGR_SMG_10of16_ "CANErr CANSk STAT SABR | EN: CANErr CANSk STAT SABR" VALUE 0x78825 TKW_VV_VV_UB 100.0 FORMULA_0003 0.0 255.0000 /end CHARACTERISTIC
/begin CHARACTERISTIC K_SK_MD_BEGR_SMG_11of16_ "CANErr CANSk STAT SABR | EN: CANErr CANSk STAT SABR" VALUE 0x78826 TKW_VV_VV_UB 100.0 FORMULA_0003 0.0 255.0000 /end CHARACTERISTIC
/begin CHARACTERISTIC K_SK_MD_BEGR_SMG_12of16_ "CANErr CANSk STAT SABR | EN: CANErr CANSk STAT SABR" VALUE 0x78827 TKW_VV_VV_UB 100.0 FORMULA_0003 0.0 255.0000 /end CHARACTERISTIC
/begin CHARACTERISTIC K_SK_MD_BEGR_SMG_13of16_ "CANErr CANSk STAT SABR | EN: CANErr CANSk STAT SABR" VALUE 0x78828 TKW_VV_VV_UB 100.0 FORMULA_0003 0.0 255.0000 /end CHARACTERISTIC
/begin CHARACTERISTIC K_SK_MD_BEGR_SMG_14of16_ "CANErr CANSk STAT SABR | EN: CANErr CANSk STAT SABR" VALUE 0x78829 TKW_VV_VV_UB 100.0 FORMULA_0003 0.0 255.0000 /end CHARACTERISTIC
/begin CHARACTERISTIC K_SK_MD_BEGR_SMG_15of16_ "CANErr CANSk STAT SABR | EN: CANErr CANSk STAT SABR" VALUE 0x7882A TKW_VV_VV_UB 100.0 FORMULA_0003 0.0 255.0000 /end CHARACTERISTIC
/begin CHARACTERISTIC K_SK_MD_BEGR_SMG_16of16_ "CANErr CANSk STAT SABR | EN: CANErr CANSk STAT SABR" VALUE 0x7882B TKW_VV_VV_UB 100.0 FORMULA_0003 0.0 255.0000 /end CHARACTERISTIC
/begin CHARACTERISTIC K_SK_MD_BEGR_MD_1of16_ "SollIst Mdmin EtaRf LLR | EN: SollIst Mdmin EtaRf LLR" VALUE 0x7882C TKW_VV_VV_UB 100.0 FORMULA_0003 0.0 255.0000 /end CHARACTERISTIC
/begin CHARACTERISTIC K_SK_MD_BEGR_MD_2of16_ "SollIst Mdmin EtaRf LLR" VALUE 0x7882D TKW_VV_VV_UB 100.0 FORMULA_0003 0.0 255.0000 /end CHARACTERISTIC
/begin CHARACTERISTIC K_SK_MD_BEGR_MD_3of16_ "SollIst Mdmin EtaRf LLR" VALUE 0x7882E TKW_VV_VV_UB 100.0 FORMULA_0003 0.0 255.0000 /end CHARACTERISTIC
/begin CHARACTERISTIC K_SK_MD_BEGR_MD_4of16_ "SollIst Mdmin EtaRf LLR | EN: SollIst Mdmin EtaRf LLR" VALUE 0x7882F TKW_VV_VV_UB 100.0 FORMULA_0003 0.0 255.0000 /end CHARACTERISTIC
/begin CHARACTERISTIC K_SK_MD_BEGR_MD_5of16_ "SollIst Mdmin EtaRf LLR | EN: SollIst Mdmin EtaRf LLR" VALUE 0x78830 TKW_VV_VV_UB 100.0 FORMULA_0003 0.0 255.0000 /end CHARACTERISTIC
/begin CHARACTERISTIC K_SK_MD_BEGR_MD_6of16_ "SollIst Mdmin EtaRf LLR | EN: SollIst Mdmin EtaRf LLR" VALUE 0x78831 TKW_VV_VV_UB 100.0 FORMULA_0003 0.0 255.0000 /end CHARACTERISTIC
/begin CHARACTERISTIC K_SK_MD_BEGR_MD_7of16_ "SollIst Mdmin EtaRf LLR | EN: SollIst Mdmin EtaRf LLR" VALUE 0x78832 TKW_VV_VV_UB 100.0 FORMULA_0003 0.0 255.0000 /end CHARACTERISTIC
/begin CHARACTERISTIC K_SK_MD_BEGR_MD_8of16_ "SollIst Mdmin EtaRf LLR | EN: SollIst Mdmin EtaRf LLR" VALUE 0x78833 TKW_VV_VV_UB 100.0 FORMULA_0003 0.0 255.0000 /end CHARACTERISTIC
/begin CHARACTERISTIC K_SK_MD_BEGR_MD_9of16_ "SollIst Mdmin EtaRf LLR | EN: SollIst Mdmin EtaRf LLR" VALUE 0x78834 TKW_VV_VV_UB 100.0 FORMULA_0003 0.0 255.0000 /end CHARACTERISTIC
/begin CHARACTERISTIC K_SK_MD_BEGR_MD_10of16_ "SollIst Mdmin EtaRf LLR | EN: SollIst Mdmin EtaRf LLR" VALUE 0x78835 TKW_VV_VV_UB 100.0 FORMULA_0003 0.0 255.0000 /end CHARACTERISTIC
/begin CHARACTERISTIC K_SK_MD_BEGR_MD_11of16_ "SollIst Mdmin EtaRf LLR | EN: SollIst Mdmin EtaRf LLR" VALUE 0x78836 TKW_VV_VV_UB 100.0 FORMULA_0003 0.0 255.0000 /end CHARACTERISTIC
/begin CHARACTERISTIC K_SK_MD_BEGR_MD_12of16_ "SollIst Mdmin EtaRf LLR | EN: SollIst Mdmin EtaRf LLR" VALUE 0x78837 TKW_VV_VV_UB 100.0 FORMULA_0003 0.0 255.0000 /end CHARACTERISTIC
/begin CHARACTERISTIC K_SK_MD_BEGR_MD_13of16_ "SollIst Mdmin EtaRf LLR | EN: SollIst Mdmin EtaRf LLR" VALUE 0x78838 TKW_VV_VV_UB 100.0 FORMULA_0003 0.0 255.0000 /end CHARACTERISTIC
/begin CHARACTERISTIC K_SK_MD_BEGR_MD_14of16_ "SollIst Mdmin EtaRf LLR | EN: SollIst Mdmin EtaRf LLR" VALUE 0x78839 TKW_VV_VV_UB 100.0 FORMULA_0003 0.0 255.0000 /end CHARACTERISTIC
/begin CHARACTERISTIC K_SK_MD_BEGR_MD_15of16_ "SollIst Mdmin EtaRf LLR | EN: SollIst Mdmin EtaRf LLR" VALUE 0x7883A TKW_VV_VV_UB 100.0 FORMULA_0003 0.0 255.0000 /end CHARACTERISTIC
/begin CHARACTERISTIC K_SK_MD_BEGR_MD_16of16_ "SollIst Mdmin EtaRf LLR | EN: SollIst Mdmin EtaRf LLR" VALUE 0x7883B TKW_VV_VV_UB 100.0 FORMULA_0003 0.0 255.0000 /end CHARACTERISTIC
/begin CHARACTERISTIC K_SK_MD_BEGR_GEMISCH_1of32_ "VAN KATS FPLAU LAVK PKS | EN: VAN KATS FPLAU LAVK PKS" VALUE 0x7883C TKW_VV_VV_UB 100.0 FORMULA_0003 0.0 255.0000 /end CHARACTERISTIC
/begin CHARACTERISTIC K_SK_MD_BEGR_GEMISCH_2of32_ "VAN KATS FPLAU LAVK PKS | EN: VAN KATS FPLAU LAVK PKS" VALUE 0x7883D TKW_VV_VV_UB 100.0 FORMULA_0003 0.0 255.0000 /end CHARACTERISTIC
/begin CHARACTERISTIC K_SK_MD_BEGR_GEMISCH_3of32_ "VAN KATS FPLAU LAVK PKS | EN: VAN KATS FPLAU LAVK PKS" VALUE 0x7883E TKW_VV_VV_UB 100.0 FORMULA_0003 0.0 255.0000 /end CHARACTERISTIC
/begin CHARACTERISTIC K_SK_MD_BEGR_GEMISCH_4of32_ "VAN KATS FPLAU LAVK PKS | EN: VAN KATS FPLAU LAVK PKS" VALUE 0x7883F TKW_VV_VV_UB 100.0 FORMULA_0003 0.0 255.0000 /end CHARACTERISTIC
/begin CHARACTERISTIC K_SK_MD_BEGR_GEMISCH_5of32_ "VAN KATS FPLAU LAVK PKS" VALUE 0x78840 TKW_VV_VV_UB 100.0 FORMULA_0003 0.0 255.0000 /end CHARACTERISTIC
/begin CHARACTERISTIC K_SK_MD_BEGR_GEMISCH_6of32_ "VAN KATS FPLAU LAVK PKS" VALUE 0x78841 TKW_VV_VV_UB 100.0 FORMULA_0003 0.0 255.0000 /end CHARACTERISTIC
/begin CHARACTERISTIC K_SK_MD_BEGR_GEMISCH_7of32_ "VAN KATS FPLAU LAVK PKS" VALUE 0x78842 TKW_VV_VV_UB 100.0 FORMULA_0003 0.0 255.0000 /end CHARACTERISTIC
/begin CHARACTERISTIC K_SK_MD_BEGR_GEMISCH_8of32_ "VAN KATS FPLAU LAVK PKS" VALUE 0x78843 TKW_VV_VV_UB 100.0 FORMULA_0003 0.0 255.0000 /end CHARACTERISTIC
/begin CHARACTERISTIC K_SK_MD_BEGR_GEMISCH_9of32_ "VAN KATS FPLAU LAVK PKS" VALUE 0x78844 TKW_VV_VV_UB 100.0 FORMULA_0003 0.0 255.0000 /end CHARACTERISTIC
/begin CHARACTERISTIC K_SK_MD_BEGR_GEMISCH_10of32_ "VAN KATS FPLAU LAVK PKS" VALUE 0x78845 TKW_VV_VV_UB 100.0 FORMULA_0003 0.0 255.0000 /end CHARACTERISTIC
/begin CHARACTERISTIC K_SK_MD_BEGR_GEMISCH_11of32_ "VAN KATS FPLAU LAVK PKS" VALUE 0x78846 TKW_VV_VV_UB 100.0 FORMULA_0003 0.0 255.0000 /end CHARACTERISTIC
/begin CHARACTERISTIC K_SK_MD_BEGR_GEMISCH_12of32_ "VAN KATS FPLAU LAVK PKS" VALUE 0x78847 TKW_VV_VV_UB 100.0 FORMULA_0003 0.0 255.0000 /end CHARACTERISTIC
/begin CHARACTERISTIC K_SK_MD_BEGR_GEMISCH_13of32_ "VAN KATS FPLAU LAVK PKS" VALUE 0x78848 TKW_VV_VV_UB 100.0 FORMULA_0003 0.0 255.0000 /end CHARACTERISTIC
/begin CHARACTERISTIC K_SK_MD_BEGR_GEMISCH_14of32_ "VAN KATS FPLAU LAVK PKS" VALUE 0x78849 TKW_VV_VV_UB 100.0 FORMULA_0003 0.0 255.0000 /end CHARACTERISTIC
/begin CHARACTERISTIC K_SK_MD_BEGR_GEMISCH_15of32_ "VAN KATS FPLAU LAVK PKS" VALUE 0x7884A TKW_VV_VV_UB 100.0 FORMULA_0003 0.0 255.0000 /end CHARACTERISTIC
/begin CHARACTERISTIC K_SK_MD_BEGR_GEMISCH_16of32_ "VAN KATS FPLAU LAVK PKS" VALUE 0x7884B TKW_VV_VV_UB 100.0 FORMULA_0003 0.0 255.0000 /end CHARACTERISTIC
/begin CHARACTERISTIC K_SK_MD_BEGR_GEMISCH_17of32_ "VAN KATS FPLAU LAVK PKS | EN: VAN KATS FPLAU LAVK PKS" VALUE 0x7884C TKW_VV_VV_UB 100.0 FORMULA_0003 0.0 255.0000 /end CHARACTERISTIC
/begin CHARACTERISTIC K_SK_MD_BEGR_GEMISCH_18of32_ "VAN KATS FPLAU LAVK PKS | EN: VAN KATS FPLAU LAVK PKS" VALUE 0x7884D TKW_VV_VV_UB 100.0 FORMULA_0003 0.0 255.0000 /end CHARACTERISTIC
/begin CHARACTERISTIC K_SK_MD_BEGR_GEMISCH_19of32_ "VAN KATS FPLAU LAVK PKS | EN: VAN KATS FPLAU LAVK PKS" VALUE 0x7884E TKW_VV_VV_UB 100.0 FORMULA_0003 0.0 255.0000 /end CHARACTERISTIC
/begin CHARACTERISTIC K_SK_MD_BEGR_GEMISCH_20of32_ "VAN KATS FPLAU LAVK PKS | EN: VAN KATS FPLAU LAVK PKS" VALUE 0x7884F TKW_VV_VV_UB 100.0 FORMULA_0003 0.0 255.0000 /end CHARACTERISTIC
/begin CHARACTERISTIC K_SK_MD_BEGR_GEMISCH_21of32_ "VAN KATS FPLAU LAVK PKS | EN: VAN KATS FPLAU LAVK PKS" VALUE 0x78850 TKW_VV_VV_UB 100.0 FORMULA_0003 0.0 255.0000 /end CHARACTERISTIC
/begin CHARACTERISTIC K_SK_MD_BEGR_GEMISCH_22of32_ "VAN KATS FPLAU LAVK PKS | EN: VAN KATS FPLAU LAVK PKS" VALUE 0x78851 TKW_VV_VV_UB 100.0 FORMULA_0003 0.0 255.0000 /end CHARACTERISTIC
/begin CHARACTERISTIC K_SK_MD_BEGR_GEMISCH_23of32_ "VAN KATS FPLAU LAVK PKS | EN: VAN KATS FPLAU LAVK PKS" VALUE 0x78852 TKW_VV_VV_UB 100.0 FORMULA_0003 0.0 255.0000 /end CHARACTERISTIC
/begin CHARACTERISTIC K_SK_MD_BEGR_GEMISCH_24of32_ "VAN KATS FPLAU LAVK PKS | EN: VAN KATS FPLAU LAVK PKS" VALUE 0x78853 TKW_VV_VV_UB 100.0 FORMULA_0003 0.0 255.0000 /end CHARACTERISTIC
/begin CHARACTERISTIC K_SK_MD_BEGR_GEMISCH_25of32_ "VAN KATS FPLAU LAVK PKS | EN: VAN KATS FPLAU LAVK PKS" VALUE 0x78854 TKW_VV_VV_UB 100.0 FORMULA_0003 0.0 255.0000 /end CHARACTERISTIC
/begin CHARACTERISTIC K_SK_MD_BEGR_GEMISCH_26of32_ "VAN KATS FPLAU LAVK PKS | EN: VAN KATS FPLAU LAVK PKS" VALUE 0x78855 TKW_VV_VV_UB 100.0 FORMULA_0003 0.0 255.0000 /end CHARACTERISTIC
/begin CHARACTERISTIC K_SK_MD_BEGR_GEMISCH_27of32_ "VAN KATS FPLAU LAVK PKS | EN: VAN KATS FPLAU LAVK PKS" VALUE 0x78856 TKW_VV_VV_UB 100.0 FORMULA_0003 0.0 255.0000 /end CHARACTERISTIC
/begin CHARACTERISTIC K_SK_MD_BEGR_GEMISCH_28of32_ "VAN KATS FPLAU LAVK PKS | EN: VAN KATS FPLAU LAVK PKS" VALUE 0x78857 TKW_VV_VV_UB 100.0 FORMULA_0003 0.0 255.0000 /end CHARACTERISTIC
/begin CHARACTERISTIC K_SK_MD_BEGR_GEMISCH_29of32_ "VAN KATS FPLAU LAVK PKS | EN: VAN KATS FPLAU LAVK PKS" VALUE 0x78858 TKW_VV_VV_UB 100.0 FORMULA_0003 0.0 255.0000 /end CHARACTERISTIC
/begin CHARACTERISTIC K_SK_MD_BEGR_GEMISCH_30of32_ "VAN KATS FPLAU LAVK PKS | EN: VAN KATS FPLAU LAVK PKS" VALUE 0x78859 TKW_VV_VV_UB 100.0 FORMULA_0003 0.0 255.0000 /end CHARACTERISTIC
/begin CHARACTERISTIC K_SK_MD_BEGR_GEMISCH_31of32_ "VAN KATS FPLAU LAVK PKS | EN: VAN KATS FPLAU LAVK PKS" VALUE 0x7885A TKW_VV_VV_UB 100.0 FORMULA_0003 0.0 255.0000 /end CHARACTERISTIC
/begin CHARACTERISTIC K_SK_MD_BEGR_GEMISCH_32of32_ "VAN KATS FPLAU LAVK PKS | EN: VAN KATS FPLAU LAVK PKS" VALUE 0x7885B TKW_VV_VV_UB 100.0 FORMULA_0003 0.0 255.0000 /end CHARACTERISTIC
/begin CHARACTERISTIC K_SK_MD_BEGR_KR_1of8_ "nc nc SpVe" VALUE 0x7885C TKW_VV_VV_UB 100.0 FORMULA_0003 0.0 255.0000 /end CHARACTERISTIC
/begin CHARACTERISTIC K_SK_MD_BEGR_KR_2of8_ "nc nc SpVe" VALUE 0x7885D TKW_VV_VV_UB 100.0 FORMULA_0003 0.0 255.0000 /end CHARACTERISTIC
/begin CHARACTERISTIC K_SK_MD_BEGR_KR_3of8_ "nc nc SpVe" VALUE 0x7885E TKW_VV_VV_UB 100.0 FORMULA_0003 0.0 255.0000 /end CHARACTERISTIC
/begin CHARACTERISTIC K_SK_MD_BEGR_KR_4of8_ "nc nc SpVe" VALUE 0x7885F TKW_VV_VV_UB 100.0 FORMULA_0003 0.0 255.0000 /end CHARACTERISTIC
/begin CHARACTERISTIC K_SK_MD_BEGR_KR_5of8_ "nc nc SpVe" VALUE 0x78860 TKW_VV_VV_UB 100.0 FORMULA_0003 0.0 255.0000 /end CHARACTERISTIC
/begin CHARACTERISTIC K_SK_MD_BEGR_KR_6of8_ "nc nc SpVe" VALUE 0x78861 TKW_VV_VV_UB 100.0 FORMULA_0003 0.0 255.0000 /end CHARACTERISTIC
/begin CHARACTERISTIC K_SK_MD_BEGR_KR_7of8_ "nc nc SpVe" VALUE 0x78862 TKW_VV_VV_UB 100.0 FORMULA_0003 0.0 255.0000 /end CHARACTERISTIC
/begin CHARACTERISTIC K_SK_MD_BEGR_KR_8of8_ "nc nc SpVe" VALUE 0x78863 TKW_VV_VV_UB 100.0 FORMULA_0003 0.0 255.0000 /end CHARACTERISTIC
/begin CHARACTERISTIC K_SK_LAM_EINGR_1of32_ "Gemisch Boff Zoff DK LLS | EN: Gemisch Boff Zoff DK LLS" VALUE 0x78864 TKW_VV_VV_UB 100.0 FORMULA_0367 0.0 255.0 /end CHARACTERISTIC
/begin CHARACTERISTIC K_SK_LAM_EINGR_2of32_ "Gemisch Boff Zoff DK LLS | EN: Gemisch Boff Zoff DK LLS" VALUE 0x78865 TKW_VV_VV_UB 100.0 FORMULA_0367 0.0 255.0 /end CHARACTERISTIC
/begin CHARACTERISTIC K_SK_LAM_EINGR_3of32_ "Gemisch Boff Zoff DK LLS | EN: Gemisch Boff Zoff DK LLS" VALUE 0x78866 TKW_VV_VV_UB 100.0 FORMULA_0367 0.0 255.0 /end CHARACTERISTIC
/begin CHARACTERISTIC K_SK_LAM_EINGR_4of32_ "Gemisch Boff Zoff DK LLS | EN: Gemisch Boff Zoff DK LLS" VALUE 0x78867 TKW_VV_VV_UB 100.0 FORMULA_0367 0.0 255.0 /end CHARACTERISTIC
/begin CHARACTERISTIC K_SK_LAM_EINGR_5of32_ "Gemisch Boff Zoff DK LLS | EN: Gemisch Boff Zoff DK LLS" VALUE 0x78868 TKW_VV_VV_UB 100.0 FORMULA_0367 0.0 255.0 /end CHARACTERISTIC
/begin CHARACTERISTIC K_SK_LAM_EINGR_6of32_ "Gemisch Boff Zoff DK LLS | EN: Gemisch Boff Zoff DK LLS" VALUE 0x78869 TKW_VV_VV_UB 100.0 FORMULA_0367 0.0 255.0 /end CHARACTERISTIC
/begin CHARACTERISTIC K_SK_LAM_EINGR_7of32_ "Gemisch Boff Zoff DK LLS | EN: Gemisch Boff Zoff DK LLS" VALUE 0x7886A TKW_VV_VV_UB 100.0 FORMULA_0367 0.0 255.0 /end CHARACTERISTIC
/begin CHARACTERISTIC K_SK_LAM_EINGR_8of32_ "Gemisch Boff Zoff DK LLS | EN: Gemisch Boff Zoff DK LLS" VALUE 0x7886B TKW_VV_VV_UB 100.0 FORMULA_0367 0.0 255.0 /end CHARACTERISTIC
/begin CHARACTERISTIC K_SK_LAM_EINGR_9of32_ "Gemisch Boff Zoff DK LLS | EN: Gemisch Boff Zoff DK LLS" VALUE 0x7886C TKW_VV_VV_UB 100.0 FORMULA_0367 0.0 255.0 /end CHARACTERISTIC
/begin CHARACTERISTIC K_SK_LAM_EINGR_10of32_ "Gemisch Boff Zoff DK LLS | EN: Gemisch Boff Zoff DK LLS" VALUE 0x7886D TKW_VV_VV_UB 100.0 FORMULA_0367 0.0 255.0 /end CHARACTERISTIC
/begin CHARACTERISTIC K_SK_LAM_EINGR_11of32_ "Gemisch Boff Zoff DK LLS | EN: Gemisch Boff Zoff DK LLS" VALUE 0x7886E TKW_VV_VV_UB 100.0 FORMULA_0367 0.0 255.0 /end CHARACTERISTIC
/begin CHARACTERISTIC K_SK_LAM_EINGR_12of32_ "Gemisch Boff Zoff DK LLS | EN: Gemisch Boff Zoff DK LLS" VALUE 0x7886F TKW_VV_VV_UB 100.0 FORMULA_0367 0.0 255.0 /end CHARACTERISTIC
/begin CHARACTERISTIC K_SK_LAM_EINGR_13of32_ "Gemisch Boff Zoff DK LLS | EN: Gemisch Boff Zoff DK LLS" VALUE 0x78870 TKW_VV_VV_UB 100.0 FORMULA_0367 0.0 255.0 /end CHARACTERISTIC
/begin CHARACTERISTIC K_SK_LAM_EINGR_14of32_ "Gemisch Boff Zoff DK LLS | EN: Gemisch Boff Zoff DK LLS" VALUE 0x78871 TKW_VV_VV_UB 100.0 FORMULA_0367 0.0 255.0 /end CHARACTERISTIC
/begin CHARACTERISTIC K_SK_LAM_EINGR_15of32_ "Gemisch Boff Zoff DK LLS | EN: Gemisch Boff Zoff DK LLS" VALUE 0x78872 TKW_VV_VV_UB 100.0 FORMULA_0367 0.0 255.0 /end CHARACTERISTIC
/begin CHARACTERISTIC K_SK_LAM_EINGR_16of32_ "Gemisch Boff Zoff DK LLS | EN: Gemisch Boff Zoff DK LLS" VALUE 0x78873 TKW_VV_VV_UB 100.0 FORMULA_0367 0.0 255.0 /end CHARACTERISTIC
/begin CHARACTERISTIC K_SK_LAM_EINGR_17of32_ "Gemisch Boff Zoff DK LLS | EN: Gemisch Boff Zoff DK LLS" VALUE 0x78874 TKW_VV_VV_UB 100.0 FORMULA_0367 0.0 255.0 /end CHARACTERISTIC
/begin CHARACTERISTIC K_SK_LAM_EINGR_18of32_ "Gemisch Boff Zoff DK LLS | EN: Gemisch Boff Zoff DK LLS" VALUE 0x78875 TKW_VV_VV_UB 100.0 FORMULA_0367 0.0 255.0 /end CHARACTERISTIC
/begin CHARACTERISTIC K_SK_LAM_EINGR_19of32_ "Gemisch Boff Zoff DK LLS | EN: Gemisch Boff Zoff DK LLS" VALUE 0x78876 TKW_VV_VV_UB 100.0 FORMULA_0367 0.0 255.0 /end CHARACTERISTIC
/begin CHARACTERISTIC K_SK_LAM_EINGR_20of32_ "Gemisch Boff Zoff DK LLS | EN: Gemisch Boff Zoff DK LLS" VALUE 0x78877 TKW_VV_VV_UB 100.0 FORMULA_0367 0.0 255.0 /end CHARACTERISTIC
/begin CHARACTERISTIC K_SK_LAM_EINGR_21of32_ "Gemisch Boff Zoff DK LLS | EN: Gemisch Boff Zoff DK LLS" VALUE 0x78878 TKW_VV_VV_UB 100.0 FORMULA_0367 0.0 255.0 /end CHARACTERISTIC
/begin CHARACTERISTIC K_SK_LAM_EINGR_22of32_ "Gemisch Boff Zoff DK LLS | EN: Gemisch Boff Zoff DK LLS" VALUE 0x78879 TKW_VV_VV_UB 100.0 FORMULA_0367 0.0 255.0 /end CHARACTERISTIC
/begin CHARACTERISTIC K_SK_LAM_EINGR_23of32_ "Gemisch Boff Zoff DK LLS | EN: Gemisch Boff Zoff DK LLS" VALUE 0x7887A TKW_VV_VV_UB 100.0 FORMULA_0367 0.0 255.0 /end CHARACTERISTIC
/begin CHARACTERISTIC K_SK_LAM_EINGR_24of32_ "Gemisch Boff Zoff DK LLS | EN: Gemisch Boff Zoff DK LLS" VALUE 0x7887B TKW_VV_VV_UB 100.0 FORMULA_0367 0.0 255.0 /end CHARACTERISTIC
/begin CHARACTERISTIC K_SK_LAM_EINGR_25of32_ "Gemisch Boff Zoff DK LLS | EN: Gemisch Boff Zoff DK LLS" VALUE 0x7887C TKW_VV_VV_UB 100.0 FORMULA_0367 0.0 255.0 /end CHARACTERISTIC
/begin CHARACTERISTIC K_SK_LAM_EINGR_26of32_ "Gemisch Boff Zoff DK LLS | EN: Gemisch Boff Zoff DK LLS" VALUE 0x7887D TKW_VV_VV_UB 100.0 FORMULA_0367 0.0 255.0 /end CHARACTERISTIC
/begin CHARACTERISTIC K_SK_LAM_EINGR_27of32_ "Gemisch Boff Zoff DK LLS | EN: Gemisch Boff Zoff DK LLS" VALUE 0x7887E TKW_VV_VV_UB 100.0 FORMULA_0367 0.0 255.0 /end CHARACTERISTIC
/begin CHARACTERISTIC K_SK_LAM_EINGR_28of32_ "Gemisch Boff Zoff DK LLS | EN: Gemisch Boff Zoff DK LLS" VALUE 0x7887F TKW_VV_VV_UB 100.0 FORMULA_0367 0.0 255.0 /end CHARACTERISTIC
/begin CHARACTERISTIC K_SK_LAM_EINGR_29of32_ "Gemisch Boff Zoff DK LLS | EN: Gemisch Boff Zoff DK LLS" VALUE 0x78880 TKW_VV_VV_UB 100.0 FORMULA_0367 0.0 255.0 /end CHARACTERISTIC
/begin CHARACTERISTIC K_SK_LAM_EINGR_30of32_ "Gemisch Boff Zoff DK LLS | EN: Gemisch Boff Zoff DK LLS" VALUE 0x78881 TKW_VV_VV_UB 100.0 FORMULA_0367 0.0 255.0 /end CHARACTERISTIC
/begin CHARACTERISTIC K_SK_LAM_EINGR_31of32_ "Gemisch Boff Zoff DK LLS | EN: Gemisch Boff Zoff DK LLS" VALUE 0x78882 TKW_VV_VV_UB 100.0 FORMULA_0367 0.0 255.0 /end CHARACTERISTIC
/begin CHARACTERISTIC K_SK_LAM_EINGR_32of32_ "Gemisch Boff Zoff DK LLS | EN: Gemisch Boff Zoff DK LLS" VALUE 0x78883 TKW_VV_VV_UB 100.0 FORMULA_0367 0.0 255.0 /end CHARACTERISTIC
/begin CHARACTERISTIC K_SK_MD_BEGR_PWG_1of6_ "pwg_mode | EN: pwg_mode" VALUE 0x78884 TKW_VV_VV_UB 100.0 FORMULA_0003 0.0 255.0000 /end CHARACTERISTIC
/begin CHARACTERISTIC K_SK_MD_BEGR_PWG_2of6_ "pwg_mode | EN: pwg_mode" VALUE 0x78885 TKW_VV_VV_UB 100.0 FORMULA_0003 0.0 255.0000 /end CHARACTERISTIC
/begin CHARACTERISTIC K_SK_MD_BEGR_PWG_3of6_ "pwg_mode | EN: pwg_mode" VALUE 0x78886 TKW_VV_VV_UB 100.0 FORMULA_0003 0.0 255.0000 /end CHARACTERISTIC
/begin CHARACTERISTIC K_SK_MD_BEGR_PWG_4of6_ "pwg_mode | EN: pwg_mode" VALUE 0x78887 TKW_VV_VV_UB 100.0 FORMULA_0003 0.0 255.0000 /end CHARACTERISTIC
/begin CHARACTERISTIC K_SK_MD_BEGR_PWG_5of6_ "pwg_mode | EN: pwg_mode" VALUE 0x78888 TKW_VV_VV_UB 100.0 FORMULA_0003 0.0 255.0000 /end CHARACTERISTIC
/begin CHARACTERISTIC K_SK_MD_BEGR_PWG_6of6_ "pwg_mode | EN: pwg_mode" VALUE 0x78889 TKW_VV_VV_UB 100.0 FORMULA_0003 0.0 255.0000 /end CHARACTERISTIC
/begin CHARACTERISTIC K_SK_MD_BEGR_MVAC_1of4_ "ELUP MVAC | EN: ELUP MVAC" VALUE 0x7888A TKW_VV_VV_UB 100.0 FORMULA_0003 0.0 255.0000 /end CHARACTERISTIC
/begin CHARACTERISTIC K_SK_MD_BEGR_MVAC_2of4_ "ELUP MVAC | EN: ELUP MVAC" VALUE 0x7888B TKW_VV_VV_UB 100.0 FORMULA_0003 0.0 255.0000 /end CHARACTERISTIC
/begin CHARACTERISTIC K_SK_MD_BEGR_MVAC_3of4_ "ELUP MVAC | EN: ELUP MVAC" VALUE 0x7888C TKW_VV_VV_UB 100.0 FORMULA_0003 0.0 255.0000 /end CHARACTERISTIC
/begin CHARACTERISTIC K_SK_MD_BEGR_MVAC_4of4_ "ELUP MVAC | EN: ELUP MVAC" VALUE 0x7888D TKW_VV_VV_UB 100.0 FORMULA_0003 0.0 255.0000 /end CHARACTERISTIC
/begin CHARACTERISTIC K_SK_MVAC_KH_1of4_ "ELUP MVAC | EN: ELUP MVAC" VALUE 0x7888E TKW_VV_VV_UB 100.0 FORMULA_0368 0.0 255.0 /end CHARACTERISTIC
/begin CHARACTERISTIC K_SK_MVAC_KH_2of4_ "ELUP MVAC | EN: ELUP MVAC" VALUE 0x7888F TKW_VV_VV_UB 100.0 FORMULA_0368 0.0 255.0 /end CHARACTERISTIC
/begin CHARACTERISTIC K_SK_MVAC_KH_3of4_ "ELUP MVAC | EN: ELUP MVAC" VALUE 0x78890 TKW_VV_VV_UB 100.0 FORMULA_0368 0.0 255.0 /end CHARACTERISTIC
/begin CHARACTERISTIC K_SK_MVAC_KH_4of4_ "ELUP MVAC | EN: ELUP MVAC" VALUE 0x78891 TKW_VV_VV_UB 100.0 FORMULA_0368 0.0 255.0 /end CHARACTERISTIC
/begin MEASUREMENT sk_fail_st_zyl "Zusammenfassung Ausblender" UWORD FORMULA_0184 0 0 0.0 65535.0 ECU_ADDRESS 0x3FC1EE /end MEASUREMENT
/begin MEASUREMENT sk_fm_gemisch "Eingang Gemisch-Matrix" UBYTE FORMULA_0172 0 0 0.0 255.0 ECU_ADDRESS 0x3FC1F0 /end MEASUREMENT
/begin MEASUREMENT sk_fm_kr "Eingang KR-Matrix" UBYTE FORMULA_0172 0 0 0.0 255.0 ECU_ADDRESS 0x3FC1F1 /end MEASUREMENT
/begin MEASUREMENT sk_fm_ti "Eingang TI-Matrix" UBYTE FORMULA_0172 0 0 0.0 255.0 ECU_ADDRESS 0x3FC1F2 /end MEASUREMENT
/begin MEASUREMENT sk_fm_egas_exd "Abschaltung ueber Exd" UBYTE FORMULA_0362 0 0 0.0 255.0 ECU_ADDRESS 0x3FC1F3 /end MEASUREMENT
/begin MEASUREMENT sk_tr_error_cnt "Fehlerzaehler Testrechnung" UBYTE FORMULA_0003 0 0 0.0 255.0000 ECU_ADDRESS 0x3FC1F6 /end MEASUREMENT
/begin MEASUREMENT sk_fm_lam_1of2_ "Eingang LAM-Matrix" UBYTE FORMULA_0172 0 0 0.0 255.0 ECU_ADDRESS 0x3FC1F7 /end MEASUREMENT
/begin MEASUREMENT sk_fm_lam_2of2_ "Eingang LAM-Matrix" UBYTE FORMULA_0172 0 0 0.0 255.0 ECU_ADDRESS 0x3FC1F8 /end MEASUREMENT
/begin MEASUREMENT sk_md_begr_st "Ausloeser MD-Begrenzung" UWORD FORMULA_0011 0 0 0.0 65535.0 ECU_ADDRESS 0x3FC1FA /end MEASUREMENT
/begin MEASUREMENT sk_ti_off_st "Ausloeser TI-Abschaltung" UWORD FORMULA_0011 0 0 0.0 65535.0 ECU_ADDRESS 0x3FC1FC /end MEASUREMENT
/begin MEASUREMENT sk_egas_off_time_b1 "Zeit bis Egasabschaltung" UWORD FORMULA_0021 0 0 0.0 5.0000 ECU_ADDRESS 0x3FC1FE /end MEASUREMENT
/begin MEASUREMENT sk_egas_off_time_b2 "Zeit bis Egasabschaltung" UWORD FORMULA_0021 0 0 0.0 5.0000 ECU_ADDRESS 0x3FC200 /end MEASUREMENT
/begin MEASUREMENT sk_ti_zyl_off_cnt "Anzahl der Ausblender" UBYTE FORMULA_0003 0 0 0.0 12.0000 ECU_ADDRESS 0x3FC202 /end MEASUREMENT
/begin MEASUREMENT sk_t_reset_delay_os "Timer fuer Verzoegerung sk_reset bei OS Fehlern" UWORD FORMULA_0021 0 0 0.0 655.0000 ECU_ADDRESS 0x3FC204 /end MEASUREMENT
/begin MEASUREMENT sk_ursache "Urache fuer SK-Eingriff" UWORD FORMULA_0011 0 0 0.0 65535.0 ECU_ADDRESS 0x3FE75E /end MEASUREMENT
/begin MEASUREMENT sk_reset_cnt "Resetzaehler seit Kl15 ein" UBYTE FORMULA_0003 0 0 0.0 10.0000 ECU_ADDRESS 0x3FE760 /end MEASUREMENT
/begin MEASUREMENT sk_md_begr_ni "SK-Begrenzungsstufe - no Init" UBYTE FORMULA_0172 0 0 0.0 255.0 ECU_ADDRESS 0x3FE761 /end MEASUREMENT
/begin MEASUREMENT sk_egas_off_ni "SK-Egasstufe - no Init" UBYTE FORMULA_0172 0 0 0.0 255.0 ECU_ADDRESS 0x3FE762 /end MEASUREMENT
/* ------------------ Abschnitt erzeugt aus sk_e2_glob.dat ------------------ */
/begin CHARACTERISTIC K_SK_E2_KOMP_ERR_MAX "max. Fehler fuer Komplementvergleich | EN: Maximum faults for complement comparison" VALUE 0x78892 TKW_VV_VV_UB 100.0 FORMULA_0003 0.0 255.0000 /end CHARACTERISTIC
/begin CHARACTERISTIC K_SK_MAX_RESETS_E2 "max. Anzahl von Resets pro SG-Lauf Ebene 2 | EN: Maximum number of resets per ECU run, level 2" VALUE 0x78893 TKW_VV_VV_UB 100.0 FORMULA_0003 0.0 255.0000 /end CHARACTERISTIC
/begin MEASUREMENT sk_e2_byte "Counter Byte-Komplement" UBYTE FORMULA_0003 0 0 0.0 255.0000 ECU_ADDRESS 0x3FC805 /end MEASUREMENT
/begin MEASUREMENT sk_e2_word "Counter Word-Komplement" UBYTE FORMULA_0003 0 0 0.0 255.0000 ECU_ADDRESS 0x3FC806 /end MEASUREMENT
/begin MEASUREMENT sk_e2_long "Counter Long-Komplement" UBYTE FORMULA_0003 0 0 0.0 255.0000 ECU_ADDRESS 0x3FC807 /end MEASUREMENT
/begin MEASUREMENT sk_e2_byte_err "Fehler Byte-Komplement" UBYTE FORMULA_0003 0 0 0.0 255.0000 ECU_ADDRESS 0x3FC808 /end MEASUREMENT
/begin MEASUREMENT sk_e2_word_err "Fehler Word-Komplement" UBYTE FORMULA_0003 0 0 0.0 255.0000 ECU_ADDRESS 0x3FC809 /end MEASUREMENT
/begin MEASUREMENT sk_e2_long_err "Fehler Long-Komplement" UBYTE FORMULA_0003 0 0 0.0 255.0000 ECU_ADDRESS 0x3FC80A /end MEASUREMENT
/begin MEASUREMENT sk_e2_komp_err "Anzahl der Komplement-Fehler" UBYTE FORMULA_0003 0 0 0.0 255.0000 ECU_ADDRESS 0x3FC80B /end MEASUREMENT
/begin MEASUREMENT sk_e2_fehler "aktueller Ebene2-Fehler" UWORD FORMULA_0369 0 0 0.0 65535.0 ECU_ADDRESS 0x3FE764 /end MEASUREMENT
/begin MEASUREMENT sk_reset_cnt_e2 "Resetzaehler Ebene 2" UBYTE FORMULA_0003 0 0 0.0 10.0000 ECU_ADDRESS 0x3FE766 /end MEASUREMENT
/* ------------------ Abschnitt erzeugt aus sw_confg.dat ------------------ */
/begin CHARACTERISTIC cfg.motortyp "Konfigurationsparameter: Motortyp | EN: Konfigurationsparameter: Motortyp" VALUE 0x792F4 TKW_VV_VV_UW 100.0 FORMULA_0371 0.0 65535.0 FORMAT "%5.2" /end CHARACTERISTIC
/begin CHARACTERISTIC cfg.baureihe "Konfigurationsparameter: Fz Baureihe" VALUE 0x792F6 TKW_VV_VV_UB 100.0 FORMULA_0372 0.0 255.0 /end CHARACTERISTIC
/begin CHARACTERISTIC cfg.getriebetyp "Konfigurationsparameter: Getriebetyp | EN: Konfigurationsparameter: Getriebetyp" VALUE 0x792F7 TKW_VV_VV_UB 100.0 FORMULA_0373 0.0 255.0 /end CHARACTERISTIC
/begin CHARACTERISTIC cfg.la_variante "Konfigurationsparameter: LA-Variante | EN: Konfigurationsparameter: LA-Variante" VALUE 0x792F8 TKW_VV_VV_UB 100.0 FORMULA_0374 0.0 255.0 /end CHARACTERISTIC
/begin CHARACTERISTIC cfg.abgas "Konfigurationsparameter: ABGAS-Variante" VALUE 0x792F9 TKW_VV_VV_UB 100.0 FORMULA_0375 0.0 255.0 /end CHARACTERISTIC
/begin CHARACTERISTIC cfg.diagnose "Konfigurationsparameter: Diagnose | EN: Konfigurationsparameter: Diagnose" VALUE 0x792FA TKW_VV_VV_UB 100.0 FORMULA_0376 0.0 255.0 /end CHARACTERISTIC
/begin CHARACTERISTIC cfg.status "Konfigurationsparameter: SG Status | EN: Konfigurationsparameter: SG Status" VALUE 0x792FB TKW_VV_VV_UB 100.0 FORMULA_0377 0.0 255.0 /end CHARACTERISTIC
/begin CHARACTERISTIC cfg.canstand "Konfigurationsparameter: CAN Stand | EN: Konfigurationsparameter: CAN Stand" VALUE 0x792FC TKW_VV_VV_UB 100.0 FORMULA_0378 0.0 255.0 /end CHARACTERISTIC
/begin CHARACTERISTIC cfg.betriebsmode "Konfigurationsparameter: SG Typ | EN: Konfigurationsparameter: SG Typ" VALUE 0x792FD TKW_VV_VV_UB 100.0 FORMULA_0379 0.0 255.0 /end CHARACTERISTIC
/begin CHARACTERISTIC cfg.sg_mode "Steuergeraete Mode | EN: Steuergeraete Mode" VALUE 0x792FE TKW_VV_VV_UB 100.0 FORMULA_0380 0.0 255.0 BIT_MASK 0xF /end CHARACTERISTIC
/begin CHARACTERISTIC cfg.peripherie "Konfigurationsparameter: Motorperipherie" VALUE 0x792FF TKW_VV_VV_UB 100.0 FORMULA_0033 0.0 255.0000 /end CHARACTERISTIC
/begin CHARACTERISTIC cfg.dsc_typ "Konfigurationsparameter: DSC" VALUE 0x79300 TKW_VV_VV_UB 100.0 FORMULA_0381 0.0 255.0 /end CHARACTERISTIC
/begin CHARACTERISTIC cfg.canmess "Konfigurationsparameter: CAN-Messtechnik | EN: Konfigurationsparameter: CAN-Messtechnik" VALUE 0x79301 TKW_VV_VV_UB 100.0 FORMULA_0357 0.0 255.0 /end CHARACTERISTIC
/begin CHARACTERISTIC cfg.hil "Konfigurationsparameter: HIL-Betrieb | EN: Konfigurationsparameter: HIL-Betrieb" VALUE 0x79302 TKW_VV_VV_UB 100.0 FORMULA_0382 0.0 255.0 /end CHARACTERISTIC
/begin CHARACTERISTIC cfg.ipm "Konfigurationsparameter: IPM | EN: Konfigurationsparameter: IPM" VALUE 0x79303 TKW_VV_VV_UB 100.0 FORMULA_0357 0.0 255.0 /end CHARACTERISTIC
/begin MEASUREMENT cfg_boot_st "Bootstaus" ULONG FORMULA_0000 0 0 0.0 4294967295.0000 ECU_ADDRESS 0x3F8010 /end MEASUREMENT
/begin MEASUREMENT vers_boot "Booterversion" UWORD FORMULA_0010 0 0 0.0 65535.0000 ECU_ADDRESS 0x3F8014 /end MEASUREMENT
/begin MEASUREMENT vers_boot_index "Booterversionsindex" UWORD FORMULA_0010 0 0 0.0 65535.0000 ECU_ADDRESS 0x3F8016 /end MEASUREMENT
/begin MEASUREMENT sys_exc_lr "Linkregister nach Exception" ULONG FORMULA_0000 0 0 0.0 4294967295.0000 ECU_ADDRESS 0x3F8018 /end MEASUREMENT
/* ------------------ Abschnitt erzeugt aus md_e2.dat ------------------ */
/begin CHARACTERISTIC K_MD_E2_ERR_MAX "max. Zeit fuer Vergleichsfehler | EN: Max. Zeit für Vergleichsfehler" VALUE 0x7A55C TKW_VV_VV_UB 100.0 FORMULA_0501 0.0 25.5000 /end CHARACTERISTIC
/begin CHARACTERISTIC K_MD_E2_TAU_SOLL "Filter Sollmoment Ebene 2 | EN: s 0.1p  25.6*x Filter Sollmoment Ebene2" VALUE 0x7A55D TKW_VV_VV_UB 100.0 FORMULA_0679 0.1004 25.6000 /end CHARACTERISTIC
/begin CHARACTERISTIC K_MD_E2_FW_REL_SCHW "max. Abweichung rel. Fahrerwunsch | EN: Max. Abweichung rel- Fahrerwunsch" VALUE 0x7A55E TKW_VV_VV_SW 100.0 FORMULA_0001 -10.0000 120.0000 FORMAT "%4.1" /end CHARACTERISTIC
/begin CHARACTERISTIC K_MD_VERBR_MAX_E2 "max. Verbrauchermoment | EN: max. Verbrauchermoment Ebene2" VALUE 0x7A560 TKW_VV_VV_SW 100.0 FORMULA_0009 -100.0000 1000.0000 FORMAT "%4.1" /end CHARACTERISTIC
/begin CHARACTERISTIC K_MD_LLR_AD_MAX_E2 "max. Leerlaufadaption | EN: Max. Leerlaufadaption" VALUE 0x7A562 TKW_VV_VV_SW 100.0 FORMULA_0009 -100.0000 1000.0000 FORMAT "%4.1" /end CHARACTERISTIC
/begin CHARACTERISTIC K_MD_E2_MIN_SCHW "max. Abweichung Minmoment | EN: Max. Abweichung Minmoment" VALUE 0x7A564 TKW_VV_VV_SW 100.0 FORMULA_0009 -100.0000 1000.0000 FORMAT "%4.1" /end CHARACTERISTIC
/begin CHARACTERISTIC K_MD_E2_MAX_SCHW "max. Abweichung Maxmoment | EN: Max. Abweichung Maxmoment" VALUE 0x7A566 TKW_VV_VV_SW 100.0 FORMULA_0009 -100.0000 1000.0000 FORMAT "%4.1" /end CHARACTERISTIC
/begin CHARACTERISTIC K_MD_E2_IST_SCHW "max. Abweichung Istmoment | EN: Max. Abweichung Istmoment" VALUE 0x7A568 TKW_VV_VV_SW 100.0 FORMULA_0009 -100.0000 1000.0000 FORMAT "%4.1" /end CHARACTERISTIC
/begin CHARACTERISTIC K_MD_E2_SCHLEPP_SCHW "max. Abweichung Schleppmoment | EN: Max. Abweichung Schleppmoment" VALUE 0x7A56A TKW_VV_VV_SW 100.0 FORMULA_0009 -100.0000 1000.0000 FORMAT "%4.1" /end CHARACTERISTIC
/begin CHARACTERISTIC K_MD_HYP_DN_E2 "Offset auf Leerlaufdrehzahl | EN: Offset auf Leerlaufdrehzahl" VALUE 0x7A56C TKW_VV_VV_SW 100.0 FORMULA_0006 0.0 10000.0000 /end CHARACTERISTIC
/begin CHARACTERISTIC K_MD_HYP_VERH_E2 "Hyperbelfaktor | EN: Hyperbelfaktor" VALUE 0x7A56E TKW_VV_VV_UB 100.0 FORMULA_0704 0.0 1.9921 /end CHARACTERISTIC
/begin CHARACTERISTIC K_MD_TAU_START_OFF_E2 "Filter Startoffset | EN: Filter Startoffset" VALUE 0x7A56F TKW_VV_VV_UB 100.0 FORMULA_0679 0.1004 25.6000 /end CHARACTERISTIC
/begin CHARACTERISTIC K_MD_START_OFF_E2 "Startoffset | EN: Startoffset" VALUE 0x7A570 TKW_VV_VV_SW 100.0 FORMULA_0009 -100.0000 1000.0000 FORMAT "%4.1" /end CHARACTERISTIC
/begin CHARACTERISTIC K_MD_MSR_MAX_E2 "max. MSR-Moment Ebene 2 | EN: max. MSR-Moment Ebene2" VALUE 0x7A572 TKW_VV_VV_SW 100.0 FORMULA_0009 -100.0000 1000.0000 FORMAT "%4.1" /end CHARACTERISTIC
/begin CHARACTERISTIC K_MD_ETA_LA_E2 "LA-Faktor | EN: LA-Faktor" VALUE 0x7A574 TKW_VV_VV_UW 100.0 FORMULA_0075 0.0 4.0000 FORMAT "%6.3" /end CHARACTERISTIC
/begin CHARACTERISTIC K_MD_ZYL_ANZ_E2 "Zylinderanzahl Ebene 2 | EN: Zylinderanzahl Ebene2" VALUE 0x7A576 TKW_VV_VV_UB 100.0 FORMULA_0003 0.0 255.0000 /end CHARACTERISTIC
/begin CHARACTERISTIC K_MD_ZYL_MASK_B1 "Zylindermaske Bank 1 - Ebene 2 | EN: Zylindermaske Bank1 Ebene2" VALUE 0x7A578 TKW_VV_VV_UW 100.0 FORMULA_0010 0.0 65535.0000 /end CHARACTERISTIC
/begin CHARACTERISTIC K_MD_ZYL_MASK_B2 "Zylindermaske Bank 2 - Ebene 2 | EN: Zylindermaske Bank2 Ebene2" VALUE 0x7A57A TKW_VV_VV_UW 100.0 FORMULA_0010 0.0 65535.0000 /end CHARACTERISTIC
/begin CHARACTERISTIC K_MD_ETA_ZW_MIN_E2 "minimales ETA Ebene 2 | EN: minimales ETA Ebene2" VALUE 0x7A57C TKW_VV_VV_UW 100.0 FORMULA_0435 0.0 150.0000 FORMAT "%4.1" /end CHARACTERISTIC
/begin CHARACTERISTIC K_MD_POLYNOM_A_E2 "Polynom A Ebene 2 | EN: Polynom A Ebene2" VALUE 0x7A57E TKW_VV_VV_SW 100.0 FORMULA_0786 -320.0000 320.0000 FORMAT "%5.2" /end CHARACTERISTIC
/begin CHARACTERISTIC K_MD_POLYNOM_B_E2 "Polynom B Ebene 2 | EN: Polynom B Ebene2" VALUE 0x7A580 TKW_VV_VV_SW 100.0 FORMULA_0786 -320.0000 320.0000 FORMAT "%5.2" /end CHARACTERISTIC
/begin CHARACTERISTIC K_MD_E2_N_MIN "min. Drehzahlschwelle | EN: Min. Drehzahlschwelle" VALUE 0x7A582 TKW_VV_VV_SW 100.0 FORMULA_0006 0.0 10000.0000 /end CHARACTERISTIC
/begin CHARACTERISTIC K_MD_IND_REIB_ABREG_E2 "Abregelrampe fuer Reibmoment nach Start - Ebene 2 | EN: Abregelrampre für Reibmoment nach Start- Ebene2" VALUE 0x7A584 TKW_VV_VV_SW 100.0 FORMULA_0755 -100.0000 1000.0000 FORMAT "%4.1" /end CHARACTERISTIC
/begin CHARACTERISTIC KL_MD_RF_MAX_E2 "maximale rel. F�llung | EN: Maximum relative charge" CURVE 0x7A586 TKL_SW_VV_SW 100.0 FORMULA_0007 0.0 2.0000 /begin AXIS_DESCR STD_AXIS n FORMULA_0006 10 0.0 10000.0000 /end AXIS_DESCR FORMAT "%6.3" /end CHARACTERISTIC
/begin CHARACTERISTIC KL_MD_IND_REIB_OFFSET_E2 "Offset fuer Reibmoment nach Start - Ebene 2 | EN: Offset for friction torque after start - level 2" CURVE 0x7A5B0 TKL_SW_VV_SW 100.0 FORMULA_0784 0.0 320.0000
 /begin AXIS_DESCR STD_AXIS tmot_e2 FORMULA_0023 2 -50.0000 170.0000 FORMAT "%4.1" /end AXIS_DESCR
 FORMAT "%4.1" /end CHARACTERISTIC
/begin CHARACTERISTIC KL_MD_FAHRER_FAK_E2 "v-Progression - Ebene 2 | EN: v-Progression - Ebene 2" CURVE 0x7A5BA TKL_SW_VV_SW 100.0 FORMULA_0075 0.0 3.0000
 /begin AXIS_DESCR STD_AXIS v_vorne FORMULA_0078 4 -80.0000 360.0000 FORMAT "%4.1" /end AXIS_DESCR
 FORMAT "%6.3" /end CHARACTERISTIC
/begin CHARACTERISTIC KF_MD_IND_OPT_E2 "optimales Moment bei LA 1 | EN: Optimum torque at lambda 1, level 2" MAP 0x7A5CC TKF_SW_SW_SW 100.0 FORMULA_0009 -100.0000 1000.0000 /begin AXIS_DESCR STD_AXIS n_e2 FORMULA_0006 10 0.0 10000.0000 /end AXIS_DESCR /begin AXIS_DESCR STD_AXIS rf_e2 FORMULA_0007 10 0.0 2.0000 FORMAT "%6.3" /end AXIS_DESCR FORMAT "%4.1" /end CHARACTERISTIC
/begin CHARACTERISTIC KF_MD_IND_LW_VERLUSTE_E2 "Ladungswechselverluste | EN: Gas-exchange losses, level 2" MAP 0x7A6BE TKF_SW_SW_SW 100.0 FORMULA_0009 -100.0000 1000.0000 /begin AXIS_DESCR STD_AXIS n FORMULA_0006 4 0.0 10000.0000 /end AXIS_DESCR /begin AXIS_DESCR STD_AXIS rf_m FORMULA_0007 4 0.0 2.0000 FORMAT "%6.3" /end AXIS_DESCR FORMAT "%4.1" /end CHARACTERISTIC
/begin CHARACTERISTIC KF_MD_IND_MIN_SCHUB_E2 "min. Schubmoment | EN: Friction torque, level 2" MAP 0x7A6F0 TKF_SW_SW_SW 100.0 FORMULA_0009 -100.0000 1000.0000 /begin AXIS_DESCR STD_AXIS n_e2 FORMULA_0006 4 0.0 10000.0000 /end AXIS_DESCR
 /begin AXIS_DESCR STD_AXIS tmot_e2 FORMULA_0023 4 -50.0000 170.0000 FORMAT "%4.1" /end AXIS_DESCR
 FORMAT "%4.1" /end CHARACTERISTIC
/begin CHARACTERISTIC KF_MD_IND_REIB_E2 "Reibverluste Ebene 2 | EN: Reibmoment Ebene2" MAP 0x7A722 TKF_SW_SW_SW 100.0 FORMULA_0009 -100.0000 1000.0000
 /begin AXIS_DESCR STD_AXIS tmot_e2 FORMULA_0023 4 -50.0000 170.0000 FORMAT "%4.1" /end AXIS_DESCR
 /begin AXIS_DESCR STD_AXIS toel_e2 FORMULA_0023 4 -50.0000 170.0000 FORMAT "%4.1" /end AXIS_DESCR
 FORMAT "%4.1" /end CHARACTERISTIC
/begin CHARACTERISTIC KF_MD_ZW_OPT_E2 "Optimaler Z�ndhaken | EN: Optimum ignition angle, level 2 [degKW x/10]" MAP 0x7A754 TKF_SW_SW_SW 100.0 FORMULA_0111 -50.0000 60.0000 /begin AXIS_DESCR STD_AXIS n FORMULA_0006 10 0.0 10000.0000 /end AXIS_DESCR /begin AXIS_DESCR STD_AXIS rf_m FORMULA_0007 6 0.0 2.0000 FORMAT "%6.3" /end AXIS_DESCR FORMAT "%4.1" /end CHARACTERISTIC
/begin CHARACTERISTIC KF_MD_KUPP_OFF_E2 "Abweichung Istmoment Ebene 2 | EN: Deviation of actual torque, level 2" MAP 0x7A7EE TKF_SW_SW_SW 100.0 FORMULA_0009 -100.0000 1000.0000 /begin AXIS_DESCR STD_AXIS n_e2 FORMULA_0006 6 0.0 10000.0000 /end AXIS_DESCR
 /begin AXIS_DESCR STD_AXIS md_kupp_wunsch_e2 FORMULA_0009 6 -100.0000 1000.0000 FORMAT "%4.1" /end AXIS_DESCR
 FORMAT "%4.1" /end CHARACTERISTIC
/begin CHARACTERISTIC KF_MD_SMG_BEGR_OFF_E2 "max. Offset auf FW Ebene 2 | EN: Maximum offset on driver demand, level 2" MAP 0x7A850 TKF_SW_SW_SW 100.0 FORMULA_0803 -100.0000 1000.0000
 /begin AXIS_DESCR STD_AXIS md_kupp_wunsch_e2 FORMULA_0803 3 -100.0000 1000.0000 /end AXIS_DESCR
 /begin AXIS_DESCR STD_AXIS n_diff FORMULA_0006 3 0.0 10000.0000 /end AXIS_DESCR
/end CHARACTERISTIC
/begin CHARACTERISTIC KF_MD_FAHRER_KOMFORT_E2 "Fahrerwunsch - Komfort Ebene 2 | EN: Driver demand - Komfort, level 2 (monitoring copy) [rel. torque %]" MAP 0x7A870 TKF_SW_SW_SW 100.0 FORMULA_0001 0.0 100.0000 /begin AXIS_DESCR STD_AXIS n_e2 FORMULA_0006 6 0.0 10000.0000 /end AXIS_DESCR
 /begin AXIS_DESCR STD_AXIS pwg_soll_e2 FORMULA_0001 6 -10.0000 120.0000 FORMAT "%4.1" /end AXIS_DESCR
 FORMAT "%4.1" /end CHARACTERISTIC
/begin CHARACTERISTIC KF_MD_FAHRER_NORMAL_E2 "Fahrerwunsch - Normal Ebene 2 | EN: Driver demand - Normal, level 2 (monitoring copy) [rel. torque %]" MAP 0x7A8D2 TKF_SW_SW_SW 100.0 FORMULA_0001 0.0 100.0000 /begin AXIS_DESCR STD_AXIS n_e2 FORMULA_0006 6 0.0 10000.0000 /end AXIS_DESCR
 /begin AXIS_DESCR STD_AXIS pwg_soll_e2 FORMULA_0001 6 -10.0000 120.0000 FORMAT "%4.1" /end AXIS_DESCR
 FORMAT "%4.1" /end CHARACTERISTIC
/begin CHARACTERISTIC KF_MD_FAHRER_SPORT_E2 "Fahrerwunsch - Sport Ebene 2 | EN: Driver demand - Sport, level 2 (monitoring copy) [rel. torque %]" MAP 0x7A934 TKF_SW_SW_SW 100.0 FORMULA_0001 0.0 100.0000 /begin AXIS_DESCR STD_AXIS n_e2 FORMULA_0006 6 0.0 10000.0000 /end AXIS_DESCR
 /begin AXIS_DESCR STD_AXIS pwg_soll_e2 FORMULA_0001 6 -10.0000 120.0000 FORMAT "%4.1" /end AXIS_DESCR
 FORMAT "%4.1" /end CHARACTERISTIC
/begin MEASUREMENT md_e2_fehler "Fehlerstatus Ebene 2" UBYTE FORMULA_0801 0 0 0.0 255.0 ECU_ADDRESS 0x3FC7A6 /end MEASUREMENT
/begin MEASUREMENT md_e2_min_err "Minimalmoment fehlerhaft" UBYTE FORMULA_0501 0 0 0.0 25.5000 ECU_ADDRESS 0x3FC7A7 /end MEASUREMENT
/begin MEASUREMENT md_e2_max_err "Maximalmoment fehlerhaft" UBYTE FORMULA_0501 0 0 0.0 25.5000 ECU_ADDRESS 0x3FC7A8 /end MEASUREMENT
/begin MEASUREMENT md_e2_ist_err "Istmoment fehlerhaft" UBYTE FORMULA_0501 0 0 0.0 25.5000 ECU_ADDRESS 0x3FC7A9 /end MEASUREMENT
/begin MEASUREMENT md_e2_schlepp_err "Schleppmoment fehlerhaft" UBYTE FORMULA_0501 0 0 0.0 25.5000 ECU_ADDRESS 0x3FC7AA /end MEASUREMENT
/begin MEASUREMENT md_e2_istsoll_err "Fehler Soll-Istvergleich" UBYTE FORMULA_0501 0 0 0.0 25.5000 ECU_ADDRESS 0x3FC7AB /end MEASUREMENT
/begin MEASUREMENT md_e2_fw_rel_err "Fahrerwunsch fehlerhaft" UBYTE FORMULA_0501 0 0 0.0 25.5000 ECU_ADDRESS 0x3FC7AC /end MEASUREMENT
/begin MEASUREMENT md_fw_rel_e2 "rel. Fahrerwunsch Ebene 2" SWORD FORMULA_0001 0 0 -10.0000 120.0000 ECU_ADDRESS 0x3FC7AE /end MEASUREMENT
/begin MEASUREMENT md_fw_rel_diff "Differenz rel. Fahrerwunsch" SWORD FORMULA_0001 0 0 -10.0000 120.0000 ECU_ADDRESS 0x3FC7B0 /end MEASUREMENT
/begin MEASUREMENT md_ind_opt_e2 "Indiziertes Istmoment" SWORD FORMULA_0009 0 0 -100.0000 1000.0000 ECU_ADDRESS 0x3FC7B2 /end MEASUREMENT
/begin MEASUREMENT md_ind_opt_diff "Differenz zum ind. Istmoment" SWORD FORMULA_0009 0 0 -100.0000 1000.0000 ECU_ADDRESS 0x3FC7B4 /end MEASUREMENT
/begin MEASUREMENT md_ind_max_e2 "Indiziertes Maxmoment" SWORD FORMULA_0009 0 0 -100.0000 1000.0000 ECU_ADDRESS 0x3FC7B6 /end MEASUREMENT
/begin MEASUREMENT md_kupp_max_e2 "Maxmoment" SWORD FORMULA_0009 0 0 -100.0000 1000.0000 ECU_ADDRESS 0x3FC7B8 /end MEASUREMENT
/begin MEASUREMENT md_kupp_max_diff "Differenz zum Maxmoment" SWORD FORMULA_0009 0 0 -100.0000 1000.0000 ECU_ADDRESS 0x3FC7BA /end MEASUREMENT
/begin MEASUREMENT md_ind_min_e2 "Indiziertes Minmoment" SWORD FORMULA_0009 0 0 -100.0000 1000.0000 ECU_ADDRESS 0x3FC7BC /end MEASUREMENT
/begin MEASUREMENT md_kupp_min_e2 "Minmoment" SWORD FORMULA_0009 0 0 -100.0000 1000.0000 ECU_ADDRESS 0x3FC7BE /end MEASUREMENT
/begin MEASUREMENT md_kupp_min_diff "Differenz zum Minmoment" SWORD FORMULA_0009 0 0 -100.0000 1000.0000 ECU_ADDRESS 0x3FC7C0 /end MEASUREMENT
/begin MEASUREMENT md_ind_lw_e2 "Ladungswechselverluste" SWORD FORMULA_0009 0 0 -100.0000 1000.0000 ECU_ADDRESS 0x3FC7C2 /end MEASUREMENT
/begin MEASUREMENT md_ind_reib_e2 "Reibverluste" SWORD FORMULA_0009 0 0 -100.0000 1000.0000 ECU_ADDRESS 0x3FC7C4 /end MEASUREMENT
/begin MEASUREMENT md_ind_reib_offset_e2 "Reibverluste (Offset) - Ebene 2" SWORD FORMULA_0784 0 0 -100.0000 200.0000 ECU_ADDRESS 0x3FC7C6 /end MEASUREMENT
/begin MEASUREMENT md_ind_schlepp_e2 "Schleppmoment" SWORD FORMULA_0009 0 0 -100.0000 1000.0000 ECU_ADDRESS 0x3FC7C8 /end MEASUREMENT
/begin MEASUREMENT md_ind_schlepp_diff "Differenz zum Schleppmoment" SWORD FORMULA_0009 0 0 -100.0000 1000.0000 ECU_ADDRESS 0x3FC7CA /end MEASUREMENT
/begin MEASUREMENT md_kupp_wunsch_e2 "Wunschmoment" SWORD FORMULA_0009 0 0 -100.0000 1000.0000 ECU_ADDRESS 0x3FC7CC /end MEASUREMENT
/begin MEASUREMENT md_start_offset_e2 "Startmoment" SWORD FORMULA_0009 0 0 -100.0000 1000.0000 ECU_ADDRESS 0x3FC7CE /end MEASUREMENT
/begin MEASUREMENT md_zw_opt_e2 "Zuendwinkelbestwert Ebene 2" SWORD FORMULA_0111 0 0 -50.0000 60.0000 ECU_ADDRESS 0x3FC7D0 /end MEASUREMENT
/begin MEASUREMENT md_eta_ausblend_e2 "ETA-Ausblend Ebene 2" UWORD FORMULA_0435 0 0 0.0 150.0000 ECU_ADDRESS 0x3FC7D2 /end MEASUREMENT
/begin MEASUREMENT md_eta_zw_ne_e2 "ETA nach Eingriff Ebene 2" UWORD FORMULA_0435 0 0 0.0 150.0000 ECU_ADDRESS 0x3FC7D4 /end MEASUREMENT
/begin MEASUREMENT md_kupp_ist_e2 "Istmoment Ebene 2" SWORD FORMULA_0009 0 0 -100.0000 1000.0000 ECU_ADDRESS 0x3FC7D6 /end MEASUREMENT
/begin MEASUREMENT md_kupp_off_e2 "zulaessige Abweichung Ebene 2" SWORD FORMULA_0009 0 0 -100.0000 1000.0000 ECU_ADDRESS 0x3FC7D8 /end MEASUREMENT
/begin MEASUREMENT md_kupp_soll_e2 "Sollmoment Ebene 2" SWORD FORMULA_0009 0 0 -100.0000 1000.0000 ECU_ADDRESS 0x3FC7DA /end MEASUREMENT
/begin MEASUREMENT md_kupp_ist_soll_e2 "IstSollabweichung Ebene 2" SWORD FORMULA_0009 0 0 -100.0000 1000.0000 ECU_ADDRESS 0x3FC7DC /end MEASUREMENT
/begin MEASUREMENT md_kupp_msr_e2 "MSR-Sollvorgabe Ebene 2" SWORD FORMULA_0009 0 0 -100.0000 1000.0000 ECU_ADDRESS 0x3FC7DE /end MEASUREMENT
/begin MEASUREMENT md_dsc_freig_st_e2 "DSC-Freigabe Ebene 2" UBYTE FORMULA_0802 0 0 0.0 255.0 ECU_ADDRESS 0x3FC7E0 /end MEASUREMENT
/begin MEASUREMENT md_fw_fgr_e2 "rel. Wunschmoment vom FGR Ebene 2" SWORD FORMULA_0001 0 0 0.0 100.0000 ECU_ADDRESS 0x3FC7E2 /end MEASUREMENT
/begin MEASUREMENT md_fw_fgr_ "Komplement rel. Wunschmoment vom FGR" SWORD FORMULA_0001 0 0 0.0 100.0000 ECU_ADDRESS 0x3FC7E4 /end MEASUREMENT
/* ------------------ Abschnitt erzeugt aus pwg.dat ------------------ */
/begin CHARACTERISTIC K_PWG_A0_MIN_E2 "Unter Adaptionschwelle Ebene 2 | EN: Unter Adaptionschwelle Ebene 2" VALUE 0x7A99A TKW_VV_VV_SW 100.0 FORMULA_0418 0.0 5.0000 FORMAT "%6.3" /end CHARACTERISTIC
/begin CHARACTERISTIC K_PWG_NORM_E2 "Normierung Potentiometerspannung Ebene 2 | EN: Normierung Potentiometerspannung Ebene 2" VALUE 0x7A99C TKW_VV_VV_SW 100.0 FORMULA_0888 0.0 100.0000 FORMAT "%6.3" /end CHARACTERISTIC
/begin CHARACTERISTIC K_PWG_NORM_HS_E2 "Normierung Potentiometerspannung fuer Handschalter Ebene 2 | EN: Normierung Potentiometerspannung für Handschalter Ebene 2" VALUE 0x7A99E TKW_VV_VV_SW 100.0 FORMULA_0888 0.0 100.0000 FORMAT "%6.3" /end CHARACTERISTIC
/begin CHARACTERISTIC K_PWG_DELTA_E2 "Zulaessige Differenz zur Ebene 2 | EN: Zulaessige Differenz zur Ebene 2" VALUE 0x7A9A0 TKW_VV_VV_SW 100.0 FORMULA_0001 0.0 120.0000 FORMAT "%4.1" /end CHARACTERISTIC
/begin CHARACTERISTIC K_PWG_ERR_MAX_E2 "max. Fehler fuer Vergleich | EN: max. Fehler fuer Vergleich" VALUE 0x7A9A2 TKW_VV_VV_UB 100.0 FORMULA_0003 0.0 255.0000 /end CHARACTERISTIC
/begin CHARACTERISTIC K_PWG_SMG_ANFAHREN_FAK_E2 "max. Faktor fuer 2. Ganganfahrt Ebene 2 | EN: max. Faktor fuer 2. Gan ganfahrt Ebene 2" VALUE 0x7A9A4 TKW_VV_VV_UW 100.0 FORMULA_0075 0.0 2.0000 FORMAT "%6.3" /end CHARACTERISTIC
/begin CHARACTERISTIC K_PWG_BLS_CFG "Einschalten der Diagnose | EN: 0 Begr. ueber v 0x1 Begr. ueber Druck 0x2 keine Begrenzung Einschalten der Diagnose" VALUE 0x786B0 TKW_VV_VV_UB 100.0 FORMULA_0904 0.0 255.0 /end CHARACTERISTIC
/begin CHARACTERISTIC K_PWG_BLS_T_BRP_FEHLER "Begrenzungsverzoegerung-Bremsdruck | EN: Limitation delay - brake pressure [ms]" VALUE 0x786B1 TKW_VV_VV_UB 100.0 FORMULA_0590 0.0 1275.0000 /end CHARACTERISTIC
/begin CHARACTERISTIC K_PWG_BLS_T_V_FEHLER "Begrenzungsverzoegerung-Bremsdruck | EN: Limitation delay - brake pressure [ms]" VALUE 0x786B2 TKW_VV_VV_UB 100.0 FORMULA_0590 0.0 1275.0000 /end CHARACTERISTIC
/begin CHARACTERISTIC K_PWG_BLS_V_VORNE_MAX "Geschwindigkeitschwelle fuer Begrenzung | EN: Speed threshold for limitation [Km/h]" VALUE 0x786B4 TKW_VV_VV_SW 100.0 FORMULA_0078 -80.0000 360.0000 FORMAT "%4.1" /end CHARACTERISTIC
/begin CHARACTERISTIC K_PWG_BLS_V_MIN "Geschwindigkeitsschwelle Berganfahrt ermoeglichen | EN: Speed threshold to enable hill start [Km/h]" VALUE 0x786B6 TKW_VV_VV_SW 100.0 FORMULA_0078 -80.0000 360.0000 FORMAT "%4.1" /end CHARACTERISTIC
/begin CHARACTERISTIC K_PWG_BLS_PWG_MAX "Pedalwertschwelle Berganfahrt ermoeglichen | EN: Pedal threshold to enable hill start [%]" VALUE 0x786B8 TKW_VV_VV_UW 100.0 FORMULA_0636 0.0 100.0000 FORMAT "%4.1" /end CHARACTERISTIC
/begin CHARACTERISTIC K_PWG_BLS_V_MAX "Geschwindigkeitsschwelle Berganfahrt sperren | EN: Speed threshold to block hill start [Km/h]" VALUE 0x786BA TKW_VV_VV_SW 100.0 FORMULA_0078 -80.0000 360.0000 FORMAT "%4.1" /end CHARACTERISTIC
/begin CHARACTERISTIC K_PWG_BLS_PWG_MIN "Pedalwertschwelle Berganfahrt sperren | EN: Pedal threshold to block hill start [%]" VALUE 0x786BC TKW_VV_VV_UW 100.0 FORMULA_0636 0.0 100.0000 FORMAT "%4.1" /end CHARACTERISTIC
/begin CHARACTERISTIC K_PWG_BLS_N_MAX_FSP "Drehzahlschwelle fuer Fehlerspeichereintrag bei Leistungsreduktion | EN: Engine-speed threshold for fault entry during power reduction [Upm]" VALUE 0x786BE TKW_VV_VV_SW 100.0 FORMULA_0006 0.0 10000.0000 /end CHARACTERISTIC
/begin CHARACTERISTIC K_PWG_BLS_HS_VERZ "Verzoergerungszeit der Begrenzung beim Handschalter | EN: Verzoegerungszeit der Begre n-zung beim Handschalter" VALUE 0x786C0 TKW_VV_VV_UW 100.0 FORMULA_0893 0.0 327675.0000 /end CHARACTERISTIC
/begin CHARACTERISTIC K_PWG1_DIAG_MIN "Unter Diagnoseschwelle-Pedalwertgeber 1 | EN: Unter Diagnoseschwelle -Pedalwertgeber 1" VALUE 0x786C2 TKW_VV_VV_SW 100.0 FORMULA_0418 0.0 5.0000 FORMAT "%6.3" /end CHARACTERISTIC
/begin CHARACTERISTIC K_PWG1_DIAG_MAX "Obere Diagnoseschwelle-Pedalwertgeber 1 | EN: Obere Diagnoseschwelle-Pedalwertgeber 1" VALUE 0x786C4 TKW_VV_VV_SW 100.0 FORMULA_0418 0.0 5.0000 FORMAT "%6.3" /end CHARACTERISTIC
/begin CHARACTERISTIC K_PWG1_NORM "Normierung Potentiometerspannung - %-Pedalwert 1 | EN: Normierung Potentiometerspannung - %- Pedalwert 1" VALUE 0x786C6 TKW_VV_VV_SW 100.0 FORMULA_0888 0.0 100.0000 FORMAT "%6.3" /end CHARACTERISTIC
/begin CHARACTERISTIC K_PWG1_NORM_HS "Normierung Potentiometerspannung fuer Handschalter- %-Pedalwert 1 | EN: Normierung Potentiometerspannung - %- Pedalwert 1" VALUE 0x786C8 TKW_VV_VV_SW 100.0 FORMULA_0888 0.0 100.0000 FORMAT "%6.3" /end CHARACTERISTIC
/begin CHARACTERISTIC K_PWG_TAU "Filterkonstante fuer den absoluten Spannungswert | EN: Filterkonstante fuer den absol u-ten Spannungswert" VALUE 0x786CA TKW_VV_VV_UB 100.0 FORMULA_0478 0.0051 1.2800 /end CHARACTERISTIC
/begin CHARACTERISTIC K_PWG_TAU_FEHLER "Filterkonstante fuer den absoluten Spannungswert im Fehlerfall | EN: Filterkonstante fuer den absol u-ten Spannungswert im Fehlerfall" VALUE 0x786CB TKW_VV_VV_UB 100.0 FORMULA_0478 0.0051 1.2800 /end CHARACTERISTIC
/begin CHARACTERISTIC K_PWG1_A0_MIN "Unter Adaptionschwelle Pedalwertgeber 1 | EN: Unter Adaptionschwelle Peda l-wertgeber 1" VALUE 0x786CC TKW_VV_VV_SW 100.0 FORMULA_0418 0.0 5.0000 FORMAT "%6.3" /end CHARACTERISTIC
/begin CHARACTERISTIC K_PWG1_A0_MAX "Obere Adaptionschwelle Pedalwertgeber 1 | EN: Upper adaptation threshold, pedal sensor 1 [V]" VALUE 0x786CE TKW_VV_VV_SW 100.0 FORMULA_0418 0.0 5.0000 FORMAT "%6.3" /end CHARACTERISTIC
/begin CHARACTERISTIC K_PWG_A0_TAU "Filterkonstante fuer die LL-Winkel Abwaertsadaption 1 | EN: Filter constant for idle-angle downward adaptation 1 [s]" VALUE 0x786D0 TKW_VV_VV_UB 100.0 FORMULA_0679 0.1004 25.6000 /end CHARACTERISTIC
/begin CHARACTERISTIC K_PWG1_INC_A0_ADAPT "Freischalten der Aufwaertsadaption | EN: Enable upward adaptation [V]" VALUE 0x786D2 TKW_VV_VV_SW 100.0 FORMULA_0418 0.0 5.0000 FORMAT "%6.3" /end CHARACTERISTIC
/begin CHARACTERISTIC K_PWG_A0_ZAEHLER "Zaehler fuer die Aufwaertsadaption | EN: Counter for upward adaptation" VALUE 0x786D4 TKW_VV_VV_UB 100.0 FORMULA_0003 1.0000 255.0000 /end CHARACTERISTIC
/begin CHARACTERISTIC K_PWG1_A0_INITINC "Aufwertsadaption der LL-Potentiometerspannung beim Start | EN: Upward adaptation of idle potentiometer voltage at start [V]" VALUE 0x786D6 TKW_VV_VV_SW 100.0 FORMULA_0418 0.0 5.0000 FORMAT "%6.3" /end CHARACTERISTIC
/begin CHARACTERISTIC K_PWG_AB_RAMPE "Dauer der Abregelrampe bei Leistungsbegrenzung | EN: Duration of ramp-down during power limitation [s]" VALUE 0x786D8 TKW_VV_VV_UW 100.0 FORMULA_0905 0.0051 327.6800 FORMAT "%7.4" /end CHARACTERISTIC
/begin CHARACTERISTIC K_PWG_SK_NULLAGE "Diagnose Schwelle | EN: Diagnosis threshold [%]" VALUE 0x786DA TKW_VV_VV_SW 100.0 FORMULA_0001 -10.0000 120.0000 FORMAT "%4.1" /end CHARACTERISTIC
/begin CHARACTERISTIC K_PWG_KD "Pedalwert fuer Kick Down | EN: Pedal value for kick-down [%]" VALUE 0x786DC TKW_VV_VV_SW 100.0 FORMULA_0001 -10.0000 150.0000 FORMAT "%4.1" /end CHARACTERISTIC
/begin CHARACTERISTIC K_PWG_SOLL_2GANG_MAX "max. Pedalwert 2. Ganganfahrt | EN: Maximum pedal value for 2nd-gear pull-away [%]" VALUE 0x786DE TKW_VV_VV_SW 100.0 FORMULA_0001 -10.0000 120.0000 FORMAT "%4.1" /end CHARACTERISTIC
/begin CHARACTERISTIC K_PWG_SOLL_2GANG_VMAX "max. Gewschwindigkeit 2. Ganganfahrt | EN: Maximum vehicle speed for 2nd-gear pull-away [Km/h]" VALUE 0x786E0 TKW_VV_VV_SW 100.0 FORMULA_0078 -80.0000 360.0000 FORMAT "%4.1" /end CHARACTERISTIC
/begin CHARACTERISTIC K_PWG_SOLL_2GANG_FAK "max. Faktor fuer 2. Ganganfahrt | EN: Maximum factor for 2nd-gear pull-away" VALUE 0x786E2 TKW_VV_VV_UW 100.0 FORMULA_0075 0.0 2.0000 FORMAT "%6.3" /end CHARACTERISTIC
/begin CHARACTERISTIC K_PWG_SOLL_2GANG_AUF "Schrittweite fuer 2. Ganganfahrt | EN: Step size for 2nd-gear pull-away [1/s]" VALUE 0x786E4 TKW_VV_VV_UW 100.0 FORMULA_0906 0.1000 12799.8046 FORMAT "%5.2" /end CHARACTERISTIC
/begin CHARACTERISTIC K_PWG_SOLL_2GANG_AB "Schrittweite fuer 2. Ganganfahrt" VALUE 0x786E6 TKW_VV_VV_UW 100.0 FORMULA_0906 0.0 12799.8046 FORMAT "%5.2" /end CHARACTERISTIC
/begin CHARACTERISTIC KL_PWG_MAX_DIFF "MAX PWG-Abweichung | EN: Maximum pedal-sensor deviation" CURVE 0x786E8 TKL_SW_VV_SW 100.0 FORMULA_0001 0.0 120.0000 /begin AXIS_DESCR STD_AXIS pwg1_2 FORMULA_0001 3 0.0 120.0000 FORMAT "%4.1" /end AXIS_DESCR FORMAT "%4.1" /end CHARACTERISTIC
/begin CHARACTERISTIC KL_PWG_SOLL_NOTLAUF "Pedalwert im Fehlerfall | EN: Pedal value in fault case" CURVE 0x786F6 TKL_SW_VV_SW 100.0 FORMULA_0001 0.0 100.0000 /begin AXIS_DESCR STD_AXIS pwg FORMULA_0001 10 0.0 120.0000 FORMAT "%4.1" /end AXIS_DESCR FORMAT "%4.1" /end CHARACTERISTIC
/begin CHARACTERISTIC KL_PWG_SOLL "Messwert in Pedalwert | EN: Measured value to pedal value" CURVE 0x78720 TKL_SW_VV_SW 100.0 FORMULA_0001 0.0 100.0000 /begin AXIS_DESCR STD_AXIS pwg FORMULA_0001 2 0.0 120.0000 FORMAT "%4.1" /end AXIS_DESCR FORMAT "%4.1" /end CHARACTERISTIC
/begin CHARACTERISTIC KL_PWG_BLS_BRP "Begrenzung Bremsdruck | EN: Brake pressure limit" CURVE 0x7872A TKL_UW_VV_UW 100.0 FORMULA_0636 0.0 100.0000 /begin AXIS_DESCR STD_AXIS can_brp FORMULA_0907 5 0.0 255.0000 /end AXIS_DESCR FORMAT "%4.1" /end CHARACTERISTIC
/begin CHARACTERISTIC KL_PWG_BLS_V "Begrenzung Geschwindigkeit | EN: Vehicle speed limit" CURVE 0x78740 TKL_SW_VV_UW 100.0 FORMULA_0636 0.0 100.0000
 /begin AXIS_DESCR STD_AXIS v_vorne FORMULA_0078 5 -80.0000 360.0000 FORMAT "%4.1" /end AXIS_DESCR
 FORMAT "%4.1" /end CHARACTERISTIC
/begin MEASUREMENT pwg_soll_e2 "Ausgegebener Pedalwert Ebene 2" SWORD FORMULA_0001 0 0 -10.0000 120.0000 ECU_ADDRESS 0x3FC7FE /end MEASUREMENT
/begin MEASUREMENT pwg_err_e2 "Anzahl der Vergleichs-Fehler" UBYTE FORMULA_0003 0 0 0.0 255.0000 ECU_ADDRESS 0x3FC800 /end MEASUREMENT
/begin MEASUREMENT pwg_bls_st "Bremsenbegrenzungstatus" UBYTE FORMULA_0033 0 0 0.0 255.0000 ECU_ADDRESS 0x3FC18A /end MEASUREMENT
/begin MEASUREMENT pwg_bls_st_druckerfassung "PWG_BLS-Status" UBYTE FORMULA_0889 0 0 0.0 255.0 ECU_ADDRESS 0x3FC18A BIT_MASK 0x1 /end MEASUREMENT
/begin MEASUREMENT pwg_bls_st_berganfahren "PWG_BLS-Status" UBYTE FORMULA_0890 0 0 0.0 255.0 ECU_ADDRESS 0x3FC18A BIT_MASK 0x2 /end MEASUREMENT
/begin MEASUREMENT pwg_bls_st_v_begrenzung "PWG_BLS-Status" UBYTE FORMULA_0891 0 0 0.0 255.0 ECU_ADDRESS 0x3FC18A BIT_MASK 0x4 /end MEASUREMENT
/begin MEASUREMENT pwg_bls_st_begrenzung "PWG_BLS-Status" UBYTE FORMULA_0892 0 0 0.0 255.0 ECU_ADDRESS 0x3FC18A BIT_MASK 0x80 /end MEASUREMENT
/begin MEASUREMENT pwg_bls_t_brp "Begrenzungsverzoegerung-Bremsdruck" UBYTE FORMULA_0590 0 0 0.0 1275.0000 ECU_ADDRESS 0x3FC18B /end MEASUREMENT
/begin MEASUREMENT pwg_bls_t_v "Begrenzungsverzoegerung-Geschwindigkeit" UBYTE FORMULA_0590 0 0 0.0 1275.0000 ECU_ADDRESS 0x3FC18C /end MEASUREMENT
/begin MEASUREMENT pwg_bls_hs_verz "Verzoergerungszeit der Begrenzung beim Handschalter" UWORD FORMULA_0893 0 0 0.0 327675.0000 ECU_ADDRESS 0x3FC18E /end MEASUREMENT
/begin MEASUREMENT pwg_st_ed "Fehler-Status der PWG-Erfassung" UBYTE FORMULA_0003 0 0 0.0 255.0000 ECU_ADDRESS 0x3FC190 BIT_MASK 0x3F /end MEASUREMENT
/begin MEASUREMENT pwg_st_ed_kanal_filter "Fehler-Status der PWG-Erfassung" UBYTE FORMULA_0894 0 0 0.0 255.0 ECU_ADDRESS 0x3FC190 BIT_MASK 0x1 /end MEASUREMENT
/begin MEASUREMENT pwg_st_ed_kanal_fehler "Fehler-Status der PWG-Erfassung" UBYTE FORMULA_0895 0 0 0.0 255.0 ECU_ADDRESS 0x3FC190 BIT_MASK 0x2 /end MEASUREMENT
/begin MEASUREMENT pwg_st_ed_pwg2_fehler "Fehler-Status der PWG-Erfassung" UBYTE FORMULA_0896 0 0 0.0 255.0 ECU_ADDRESS 0x3FC190 BIT_MASK 0x4 /end MEASUREMENT
/begin MEASUREMENT pwg_st_ed_pwg1_fehler "Fehler-Status der PWG-Erfassung" UBYTE FORMULA_0897 0 0 0.0 255.0 ECU_ADDRESS 0x3FC190 BIT_MASK 0x8 /end MEASUREMENT
/begin MEASUREMENT pwg_st_ed_uext2_fehler "Fehler-Status der PWG-Erfassung" UBYTE FORMULA_0898 0 0 0.0 255.0 ECU_ADDRESS 0x3FC190 BIT_MASK 0x10 /end MEASUREMENT
/begin MEASUREMENT pwg_st_ed_uext1_fehler "Fehler-Status der PWG-Erfassung" UBYTE FORMULA_0899 0 0 0.0 255.0 ECU_ADDRESS 0x3FC190 BIT_MASK 0x20 /end MEASUREMENT
/begin MEASUREMENT pwg_abschalt "Im Fehlerfall Abschaltung durch die Bremse" UBYTE FORMULA_0003 0 0 0.0 255.0000 ECU_ADDRESS 0x3FC191 BIT_MASK 0x3 /end MEASUREMENT
/begin MEASUREMENT pwg_abschalt_bremse "Status der Sicherheitsabschaltung" UBYTE FORMULA_0900 0 0 0.0 255.0 ECU_ADDRESS 0x3FC191 BIT_MASK 0x1 /end MEASUREMENT
/begin MEASUREMENT pwg_abschalt_sperre "Status der Sicherheitsabschaltung" UBYTE FORMULA_0901 0 0 0.0 255.0 ECU_ADDRESS 0x3FC191 BIT_MASK 0x2 /end MEASUREMENT
/begin MEASUREMENT pwg_ab_rampe "Abregelrampe im Fehlerfall" UWORD FORMULA_0902 0 0 0.0 0.9999 ECU_ADDRESS 0x3FC192 /end MEASUREMENT
/begin MEASUREMENT pwg_max_diff "Maximal zulaessige Differenz der Pedalwertgeber" SWORD FORMULA_0001 0 0 0.0 120.0000 ECU_ADDRESS 0x3FC194 /end MEASUREMENT
/begin MEASUREMENT pwg1_ad "Eingelesener AD-Wert fuer Pedalwertgeber 1" SWORD FORMULA_0123 0 0 0.0 1023.0000 ECU_ADDRESS 0x3FC196 /end MEASUREMENT
/begin MEASUREMENT pwg2_ad "Eingelesener AD-Wert fuer Pedalwertgeber 2" SWORD FORMULA_0123 0 0 0.0 1023.0000 ECU_ADDRESS 0x3FC198 /end MEASUREMENT
/begin MEASUREMENT pwg1_abs_roh "Ungefilterter mit UEXT-korrigierter Messwert PWG1" SWORD FORMULA_0418 0 0 0.0 5.0000 ECU_ADDRESS 0x3FC19A /end MEASUREMENT
/begin MEASUREMENT pwg2_abs_roh "Ungefilterter mit UEXT-korrigierter Messwert PWG2" SWORD FORMULA_0419 0 0 0.0 5.0000 ECU_ADDRESS 0x3FC19C /end MEASUREMENT
/begin MEASUREMENT pwg1_roh "Relativer Rohwert PWG1" SWORD FORMULA_0001 0 0 -10.0000 120.0000 ECU_ADDRESS 0x3FC19E /end MEASUREMENT
/begin MEASUREMENT pwg2_roh "Relativer Rohwert PWG2" SWORD FORMULA_0001 0 0 -10.0000 120.0000 ECU_ADDRESS 0x3FC1A0 /end MEASUREMENT
/begin MEASUREMENT pwg_filter "Gefilterter Messwert der Pedalwerterfassung" UWORD FORMULA_0450 0 0 0.0 102.3984 ECU_ADDRESS 0x3FC1A2 /end MEASUREMENT
/begin MEASUREMENT pwg_begrenz "Durch Bremse begrenzter PWG" UWORD FORMULA_0450 0 0 0.0 102.3984 ECU_ADDRESS 0x3FC1A4 /end MEASUREMENT
/begin MEASUREMENT pwg "Erfasster gefilterter relativer Pedalwert" SWORD FORMULA_0001 0 0 -10.0000 120.0000 ECU_ADDRESS 0x3FC1A6 /end MEASUREMENT
/begin MEASUREMENT pwg1_a0_zaehler "Zaehlervariable fuer die Aufwaertsadaption 1" UBYTE FORMULA_0003 0 0 0.0 255.0000 ECU_ADDRESS 0x3FC1A8 /end MEASUREMENT
/begin MEASUREMENT pwg2_a0_zaehler "Zaehlervariable fuer die Aufwaertsadaption 2" UBYTE FORMULA_0003 0 0 0.0 255.0000 ECU_ADDRESS 0x3FC1A9 /end MEASUREMENT
/begin MEASUREMENT pwg_soll_2gang_st "Status 2. Ganganfahrt" UBYTE FORMULA_0903 0 0 0.0 255.0 ECU_ADDRESS 0x3FC1AA /end MEASUREMENT
/begin MEASUREMENT pwg_soll_2gang_fak "Faktor 2. Ganganfahrt" UWORD FORMULA_0075 0 0 0.0 4.0000 ECU_ADDRESS 0x3FC1AC /end MEASUREMENT
/begin MEASUREMENT pwg_mode_ign "redundanter Ausgabezustand der Pedalwertgebererfassung" UBYTE FORMULA_0267 0 0 0.0 255.0 ECU_ADDRESS 0x3FE75D /end MEASUREMENT
/* ------------------ Abschnitt erzeugt aus sk_ign.dat ------------------ */
/begin CHARACTERISTIC KL_SK_LLR_N_SOLL "Solldrehzahl durch SK-Stufe | EN: Target engine speed from safety-concept stage" CURVE 0x7890E TKL_UB_VV_SW 100.0 FORMULA_0006 0.0 10000.0000 /begin AXIS_DESCR STD_AXIS Stufe FORMULA_0003 6 0.0 255.0000 /end AXIS_DESCR /end CHARACTERISTIC
/begin MEASUREMENT sk_tr_retry "Retry-Counter" UBYTE FORMULA_0003 0 0 0.0 255.0000 ECU_ADDRESS 0x3FC206 /end MEASUREMENT
/begin MEASUREMENT sk_tr_timeout "Timeout - keine neue TR" UBYTE FORMULA_0317 0 0 0.0 2.5500 ECU_ADDRESS 0x3FC207 /end MEASUREMENT
/begin MEASUREMENT sk_tr_wait "Wartezeit Testrechnung" UBYTE FORMULA_0317 0 0 0.0 2.5500 ECU_ADDRESS 0x3FC208 /end MEASUREMENT
/begin MEASUREMENT sk_llr_n_soll_ign "SK-Leerlaufdrehzahl" SWORD FORMULA_0006 0 0 0.0 10000.0000 ECU_ADDRESS 0x3FC20A /end MEASUREMENT
/* ------------------ Abschnitt erzeugt aus time_rel_diag.dat ------------------ */
/begin CHARACTERISTIC K_TIME_REL_OBD_CFG "Konfiguration Relativzeitdiagnose | EN: 0 Diag. aus 1 Diag. aktiv ELSE undef Konfiguration Relativzeitdiagn o- se" VALUE 0x79644 TKW_VV_VV_UB 100.0 FORMULA_1001 0.0 255.0 /end CHARACTERISTIC
/begin CHARACTERISTIC K_TIME_REL_OBD_MAX_FEHLER "Fehlerschwelle | EN: Fehlerschwelle" VALUE 0x79645 TKW_VV_VV_UB 100.0 FORMULA_0033 0.0 255.0000 /end CHARACTERISTIC
/begin CHARACTERISTIC K_TIME_REL_OBD_T_MAX "Maximaler Fortschritt time_rel im lfd. Betrieb | EN: Maximaler Fortschritt time_rel im lfd. Betrieb" VALUE 0x79646 TKW_VV_VV_UW 100.0 FORMULA_0062 0.0 65535.0000 /end CHARACTERISTIC
/begin CHARACTERISTIC K_TIME_REL_OBD_T_MIN "Minimaler Fortschritt time_rel im lfd. Betrieb | EN: Minimaler Fortschritt time_rel im lfd. Betrieb" VALUE 0x79648 TKW_VV_VV_UW 100.0 FORMULA_0062 0.0 65535.0000 /end CHARACTERISTIC
/begin CHARACTERISTIC K_TIME_REL_OBD_T_ML "Min. Laufzeit Motor fuer Diagnose | EN: Min. Laufzeit Motor fuer Diagn o-se" VALUE 0x7964C TKW_VV_VV_UL 100.0 FORMULA_0152 0.0 3600.0000 FORMAT "%5.2" /end CHARACTERISTIC
/begin CHARACTERISTIC K_TIME_REL_OBD_TMOT_ABSTELL "Minimale Abstelltemp. d. Motors fuer Diagnose | EN: Minimale Abstelltemp. d. Motors fuer Diagnose" VALUE 0x79650 TKW_VV_VV_SW 100.0 FORMULA_0023 -50.0000 170.0000 FORMAT "%4.1" /end CHARACTERISTIC
/begin CHARACTERISTIC K_TIME_REL_OBD_TMOT_START_SLOW "minimales tmot fuer Standzeitdiagnose SLOW | EN: minimales tmot fuer Standzeitd i-agnose SLOW" VALUE 0x79652 TKW_VV_VV_SW 100.0 FORMULA_0023 -50.0000 170.0000 FORMAT "%4.1" /end CHARACTERISTIC
/begin CHARACTERISTIC K_TIME_REL_OBD_TMOT_START_FAST "minimales tmot fuer Standzeitdiagnose FAST | EN: minimales tmot fuer Standzeitd i-agnose FAST" VALUE 0x79654 TKW_VV_VV_SW 100.0 FORMULA_0023 -50.0000 170.0000 FORMAT "%4.1" /end CHARACTERISTIC
/begin CHARACTERISTIC K_TIME_REL_OBD_UB_MIN "Schwelle U-Batt. Diagnose | EN: Schwelle U-Batt. Diagnose" VALUE 0x79656 TKW_VV_VV_SW 100.0 FORMULA_0008 0.0 28.0000 FORMAT "%4.1" /end CHARACTERISTIC
/begin CHARACTERISTIC K_TIME_REL_OBD_ZERO_CNT_MAX "time_rel-Reset-Zaehler Maxwert | EN: time_rel-Reset-Zaehler Maxwert" VALUE 0x79658 TKW_VV_VV_UB 100.0 FORMULA_0003 0.0 255.0000 /end CHARACTERISTIC
/begin CHARACTERISTIC K_TIME_REL_OBD_TMOT_DELTA_MIN "tmot-Mindestabkuehlung bei MS | EN: tmot-Mindestabkuehlung bei MS" VALUE 0x7965A TKW_VV_VV_SW 100.0 FORMULA_0076 -1000.0000 1000.0000 FORMAT "%4.1" /end CHARACTERISTIC
/begin CHARACTERISTIC KF_TIME_REL_OBD_MIN_STANDZEIT "Minimale Standzeit des Motors | EN: Minimum engine-off (soak) time" MAP 0x7965C TKF_SW_SW_UW 100.0 FORMULA_0986 0.0 1092.2500
 /begin AXIS_DESCR STD_AXIS zust_tmot_start FORMULA_0023 6 -50.0000 170.0000 FORMAT "%4.1" /end AXIS_DESCR
 /begin AXIS_DESCR STD_AXIS tmot_abstell_nv FORMULA_0023 6 -50.0000 170.0000 FORMAT "%4.1" /end AXIS_DESCR
 FORMAT "%5.2" /end CHARACTERISTIC
/begin CHARACTERISTIC KF_TIME_REL_OBD_MAX_STANDZEIT "Maximale Standzeit des Motors | EN: Maximum engine-off (soak) time" MAP 0x796BE TKF_SW_SW_UW 100.0 FORMULA_1002 0.0 65535.0000
 /begin AXIS_DESCR STD_AXIS zust_tmot_start FORMULA_0023 4 -50.0000 170.0000 FORMAT "%4.1" /end AXIS_DESCR
 /begin AXIS_DESCR STD_AXIS tmot_abstell_nv FORMULA_0023 4 -50.0000 170.0000 FORMAT "%4.1" /end AXIS_DESCR
/end CHARACTERISTIC
/begin MEASUREMENT time_rel_obd_st "Steuervariable fuer Diagnose" UBYTE FORMULA_0998 0 0 0.0 255.0 ECU_ADDRESS 0x3FC3F4 /end MEASUREMENT
/begin MEASUREMENT time_rel_st "Statusvariable" UBYTE FORMULA_0999 0 0 0.0 255.0 ECU_ADDRESS 0x3FC3F5 /end MEASUREMENT
/begin MEASUREMENT time_rel_delta "Delta time_rel seit Start" ULONG FORMULA_1000 0 0 0.0 4294967295.0000 ECU_ADDRESS 0x3FC3F8 /end MEASUREMENT
/begin MEASUREMENT time_rel_motor_start "Relativzeit bei Motorstart" ULONG FORMULA_0149 0 0 0.0 71582788.2500 ECU_ADDRESS 0x3FC3FC /end MEASUREMENT
/* ------------------ Abschnitt erzeugt aus tmot.dat ------------------ */
/begin CHARACTERISTIC K_TMOT_ERR_MAX_E2 "max. Fehler fuer Vergleich | EN: max. Fehler fuer Vergleich" VALUE 0x7A9B8 TKW_VV_VV_UB 100.0 FORMULA_0003 0.0 255.0000 /end CHARACTERISTIC
/begin CHARACTERISTIC K_TMOT_MIN_E2 "min. Kuehlmitteltemperatur | EN: min. Kuehlmitteltemperatur" VALUE 0x7A9BA TKW_VV_VV_SW 100.0 FORMULA_0023 -50.0000 170.0000 FORMAT "%4.1" /end CHARACTERISTIC
/begin CHARACTERISTIC K_TMOT_MAX_E2 "max. Kuehlmitteltemperatur | EN: max. Kuehlmitteltemperatur" VALUE 0x7A9BC TKW_VV_VV_SW 100.0 FORMULA_0023 -50.0000 170.0000 FORMAT "%4.1" /end CHARACTERISTIC
/begin CHARACTERISTIC K_TMOT_MAX_NEG_GRAD_E2 "Gradientenschwelle Ebene 2 | EN: Neg. Gradientenschwelle Ebene2" VALUE 0x7A9BE TKW_VV_VV_SW 100.0 FORMULA_0997 -32768.0000 0.0 /end CHARACTERISTIC
/begin CHARACTERISTIC K_TMOT_MAX_POS_GRAD_E2 "Gradientenschwelle Ebene 2 | EN: Pos. Gradientenschwelle Ebene2" VALUE 0x7A9C0 TKW_VV_VV_SW 100.0 FORMULA_0997 0.0 32767.0000 /end CHARACTERISTIC
/begin CHARACTERISTIC K_TMOT_DIAG_MIN "Unter Grenze Motortemperatur | EN: Unter Grenze Motortemperatur" VALUE 0x79740 TKW_VV_VV_SW 100.0 FORMULA_0987 -50.0000 170.0000 FORMAT "%6.3" /end CHARACTERISTIC
/begin CHARACTERISTIC K_TMOT_DIAG_MAX "Obere Grenze Motortemperatur | EN: Obere Grenze Motortemperatur" VALUE 0x79742 TKW_VV_VV_SW 100.0 FORMULA_0987 -50.0000 170.0000 FORMAT "%6.3" /end CHARACTERISTIC
/begin CHARACTERISTIC K_TMOT_DIAG_TAN "TAN-Schwelle zur Plausibilitaetsueberpruefung | EN: TAN-Schwelle zur Plausibilitaetsu e-berpruefung" VALUE 0x79744 TKW_VV_VV_SW 100.0 FORMULA_0023 -50.0000 170.0000 FORMAT "%4.1" /end CHARACTERISTIC
/begin CHARACTERISTIC K_TMOT_DIAG_TKA "TKA-Schwelle zur Plausibilitaetsueberpruefung | EN: TKA-Schwelle zur Plausibilitaetsueberpruefung" VALUE 0x79746 TKW_VV_VV_SW 100.0 FORMULA_0023 -50.0000 170.0000 FORMAT "%4.1" /end CHARACTERISTIC
/begin CHARACTERISTIC K_TMOT_SK_DELTA "Sicherheitskritische Differenz zu tka und toel" VALUE 0x79748 TKW_VV_VV_SW 100.0 FORMULA_1015 -819.2000 819.1750 FORMAT "%5.2" /end CHARACTERISTIC
/begin CHARACTERISTIC K_TMOT_MAX_NEG_GRADIENT "Gradientenschwelle bei laufendem Motor | EN: Neg. Gradientenschwelle bei laufen-dem Motor" VALUE 0x7974A TKW_VV_VV_SW 100.0 FORMULA_1016 -8192.0000 0.0 FORMAT "%5.2" /end CHARACTERISTIC
/begin CHARACTERISTIC K_TMOT_DIAG_GRAD_MAX "Max. Gradient ueber 100ms | EN: Max. Gradient über 100ms" VALUE 0x7974C TKW_VV_VV_SW 100.0 FORMULA_1017 0.0 819.1750 FORMAT "%5.2" /end CHARACTERISTIC
/begin CHARACTERISTIC K_TMOT_DIAG_TIME "Ansprechzeit der Plausibilitaet gegenueber Masse | EN: Ansprechzeit der Plausibilitaet geg e-nueber Masse" VALUE 0x7974E TKW_VV_VV_UW 100.0 FORMULA_0021 0.0 655.3500 FORMAT "%5.2" /end CHARACTERISTIC
/begin CHARACTERISTIC K_TMOT_TAU "Filterkonstante fuer die Kuehlwassererfassung | EN: Filterkonstante fuer die Kuehlwasse r-erfassung" VALUE 0x79750 TKW_VV_VV_UB 100.0 FORMULA_0679 0.1004 25.6000 /end CHARACTERISTIC
/begin CHARACTERISTIC K_TMOT_DIAG_GRAD_TAU "Filterkonstante fuer die Gradientenberechnung | EN: Filterkonstante fü r die  Gradientenberechnung" VALUE 0x79751 TKW_VV_VV_UB 100.0 FORMULA_0679 0.1004 25.6000 /end CHARACTERISTIC
/begin CHARACTERISTIC K_TMOT_MODELL_TAU_KRAFT "Filterkonstante Kraftstoffenergieeintrag | EN: Filterkonstante Kraftstoffenergieei n-trag" VALUE 0x79752 TKW_VV_VV_UB 100.0 FORMULA_0679 0.1004 25.6000 /end CHARACTERISTIC
/begin CHARACTERISTIC K_TMOT_MODELL_TAU_UMG "Filterkonstante Umgebungswaermeabfuhr | EN: Filterkonstante Umgebungswaermeabfuhr" VALUE 0x79753 TKW_VV_VV_UB 100.0 FORMULA_0679 0.1004 25.6000 /end CHARACTERISTIC
/begin CHARACTERISTIC K_TMOT_MODELL_TAU_KUEHLER "Filterkonstante Kuehlerwaermeabfuhr" VALUE 0x79754 TKW_VV_VV_UB 100.0 FORMULA_0679 0.1004 25.6000 /end CHARACTERISTIC
/begin CHARACTERISTIC K_TMOT_MODELL_SA_ML_F "ML-Reduzierung bei SA" VALUE 0x79756 TKW_VV_VV_UW 100.0 FORMULA_0075 0.0 1.0000 FORMAT "%6.3" /end CHARACTERISTIC
/begin CHARACTERISTIC K_TMOT_MODELL_TI_F "Kraftstoffenergieeintragsfaktor | EN: Kraftstoffenergieeintragsfaktor" VALUE 0x79758 TKW_VV_VV_UW 100.0 FORMULA_0075 0.0010 63.9990 FORMAT "%6.3" /end CHARACTERISTIC
/begin CHARACTERISTIC K_TMOT_MODELL_F_MOTOR "Faktor fuer Motorabwaerme | EN: Faktor fuer Motorabwaerme" VALUE 0x7975A TKW_VV_VV_UW 100.0 FORMULA_0075 0.0 1.0000 FORMAT "%6.3" /end CHARACTERISTIC
/begin CHARACTERISTIC K_TMOT_MODELL_C_MOTOR "Waermekapazitaet Motor | EN: Waermekapazitaet Motor" VALUE 0x7975C TKW_VV_VV_UW 100.0 FORMULA_0075 0.0010 4.0000 FORMAT "%6.3" /end CHARACTERISTIC
/begin CHARACTERISTIC K_TMOT_MODELL_F_KW "Faktor Kuehlwasserabwaerme" VALUE 0x7975E TKW_VV_VV_UW 100.0 FORMULA_0075 0.0 4.0000 FORMAT "%6.3" /end CHARACTERISTIC
/begin CHARACTERISTIC K_TMOT_MODELL_GAIN "Integratorkonstante | EN: Integratorkonstante" VALUE 0x79760 TKW_VV_VV_UW 100.0 FORMULA_0075 0.0 1.0000 FORMAT "%6.3" /end CHARACTERISTIC
/begin CHARACTERISTIC K_TMOT_MODELL_LAM_MIN "Min. Lambdabegrenzung | EN: Min. Lambdabegrenzung" VALUE 0x79762 TKW_VV_VV_UW 100.0 FORMULA_0025 0.5000 1.5000 FORMAT "%6.3" /end CHARACTERISTIC
/begin CHARACTERISTIC K_TMOT_MODELL_LAM_MAX "Max. Lambdabegrenzung" VALUE 0x79764 TKW_VV_VV_UW 100.0 FORMULA_0025 0.5000 1.5000 FORMAT "%6.3" /end CHARACTERISTIC
/begin CHARACTERISTIC K_TMOT_MODELL_THERM_MIN "Thermostat oeffnet" VALUE 0x79766 TKW_VV_VV_SW 100.0 FORMULA_0333 -50.0000 170.0000 FORMAT "%5.2" /end CHARACTERISTIC
/begin CHARACTERISTIC K_TMOT_MODELL_THERM_DELTA "Thermostatregelbereich" VALUE 0x79768 TKW_VV_VV_SW 100.0 FORMULA_0980 0.0500 1000.0000 FORMAT "%5.2" /end CHARACTERISTIC
/begin CHARACTERISTIC K_TMOT_MODELL_START_MIN "Kaltstarterkennung" VALUE 0x7976A TKW_VV_VV_SW 100.0 FORMULA_0023 -50.0000 170.0000 FORMAT "%4.1" /end CHARACTERISTIC
/begin CHARACTERISTIC K_TMOT_MODELL_TMOT_MODELL_ML "Umschaltschwelle auf tmot | EN: Umschaltschwelle auf tmot" VALUE 0x7976C TKW_VV_VV_SW 100.0 FORMULA_0023 -50.0000 170.0000 FORMAT "%4.1" /end CHARACTERISTIC
/begin CHARACTERISTIC K_TMOT_OBD_CFG "Einschalten der Diagnose | EN: Einschalten der Diagnose" VALUE 0x7976E TKW_VV_VV_UB 100.0 FORMULA_1018 0.0 255.0 /end CHARACTERISTIC
/begin CHARACTERISTIC K_TMOT_OBD_T_SA_MAX "Maximale Zeit im Schub | EN: Maximale Zeit im Schub" VALUE 0x79770 TKW_VV_VV_UW 100.0 FORMULA_1019 0.0 655.3500 FORMAT "%4.1" /end CHARACTERISTIC
/begin CHARACTERISTIC K_TMOT_OBD_TMOT_MIN "Min. Temperatur fuer OBD-Diagnose" VALUE 0x79772 TKW_VV_VV_SW 100.0 FORMULA_0023 -50.0000 170.0000 FORMAT "%4.1" /end CHARACTERISTIC
/begin CHARACTERISTIC K_TMOT_OBD_T_ML_MIN "Der Motor muss fuer gewisse Zeit laufen" VALUE 0x79774 TKW_VV_VV_UW 100.0 FORMULA_0021 0.0 655.3500 FORMAT "%5.2" /end CHARACTERISTIC
/begin CHARACTERISTIC K_TMOT_OBD_TMOT_MODELL_MAX "Max. Modelltemperatur fuer OBD-Diagnose" VALUE 0x79776 TKW_VV_VV_SW 100.0 FORMULA_0023 -50.0000 170.0000 FORMAT "%4.1" /end CHARACTERISTIC
/begin CHARACTERISTIC K_TMOT_OBD_BLOCKHEATER_DIFF "Erkennung eines Blockheaters | EN: Erkennung eines Blockheaters" VALUE 0x79778 TKW_VV_VV_SW 100.0 FORMULA_0076 -1000.0000 1000.0000 FORMAT "%4.1" /end CHARACTERISTIC
/begin CHARACTERISTIC K_TMOT_OBD_DIFF_MAX "Maximale zulaessige Differenz Messwert-Modell | EN: Maximale zulaessige Differenz Messwert-Modell" VALUE 0x7977A TKW_VV_VV_SW 100.0 FORMULA_0076 -1000.0000 1000.0000 FORMAT "%4.1" /end CHARACTERISTIC
/begin CHARACTERISTIC K_TMOT_OBD_DIFF_HIGH "Maximale zulaessige Differenz Messwert-Modell" VALUE 0x7977C TKW_VV_VV_SW 100.0 FORMULA_0076 -1000.0000 1000.0000 FORMAT "%4.1" /end CHARACTERISTIC
/begin CHARACTERISTIC K_TMOT_OBD_TKA_THERM_1_DELTA "Kuehlererwaermung seit Start bei Sensorfehler" VALUE 0x7977E TKW_VV_VV_SW 100.0 FORMULA_0076 -1000.0000 1000.0000 FORMAT "%4.1" /end CHARACTERISTIC
/begin CHARACTERISTIC K_TMOT_OBD_THERM_2_START "Max. Starttemperatur fuer Thermostatdiagnose" VALUE 0x79780 TKW_VV_VV_SW 100.0 FORMULA_0023 -50.0000 170.0000 FORMAT "%4.1" /end CHARACTERISTIC
/begin CHARACTERISTIC K_TMOT_OBD_TKA_THERM_2_DELTA "Kuehlererwaermung seit Start bei Thermostatoeffnung" VALUE 0x79782 TKW_VV_VV_SW 100.0 FORMULA_0076 -1000.0000 1000.0000 FORMAT "%4.1" /end CHARACTERISTIC
/begin CHARACTERISTIC K_TMOT_OBD_THERM_2 "Zu erreichende Motortemperatur bei Thermostatoeffnung" VALUE 0x79784 TKW_VV_VV_SW 100.0 FORMULA_0023 -50.0000 170.0000 FORMAT "%4.1" /end CHARACTERISTIC
/begin CHARACTERISTIC K_TMOT_MODELL_ERSATZ "Obergrenze Ersatzwert | EN: Obergrenze Ersatzwert" VALUE 0x79786 TKW_VV_VV_SW 100.0 FORMULA_0023 -50.0000 170.0000 FORMAT "%4.1" /end CHARACTERISTIC
/begin CHARACTERISTIC K_TMOT_MODELL_TKA_ERSATZ_DELTA "Obergrenzendelta zum Kuehleraustritt bei heissem tka | EN: Obergrenzendelta zum Kuehleraustritt bei heissem tka" VALUE 0x79788 TKW_VV_VV_SW 100.0 FORMULA_0076 -1000.0000 1000.0000 FORMAT "%4.1" /end CHARACTERISTIC
/begin CHARACTERISTIC K_TMOT_CFG_TOEL "CC-Toel Konfig | EN: Check-control oil-temperature configuration" VALUE 0x7978A TKW_VV_VV_UB 100.0 FORMULA_1020 0.0 255.0 /end CHARACTERISTIC
/begin CHARACTERISTIC K_TMOT_ELU_ERR_CC_HIGH_TMOT_1 "CC-Meldung gelb ueber Tmot und Elu-Fehler | EN: Yellow check-control message over coolant temp and electric-fan fault" VALUE 0x7978C TKW_VV_VV_SW 100.0 FORMULA_0023 -50.0000 170.0000 FORMAT "%4.1" /end CHARACTERISTIC
/begin CHARACTERISTIC K_TMOT_CC_HIGH_TMOT_2 "CC-Meldung rot ueber Tmot | EN: Red check-control message over coolant temperature" VALUE 0x7978E TKW_VV_VV_SW 100.0 FORMULA_0023 -50.0000 170.0000 FORMAT "%4.1" /end CHARACTERISTIC
/begin CHARACTERISTIC K_TMOT_CC_HIGH_TOEL_1 "CC-Meldung gelb ueber Toel | EN: Yellow check-control message over oil temperature" VALUE 0x79790 TKW_VV_VV_SW 100.0 FORMULA_0023 -50.0000 180.0000 FORMAT "%4.1" /end CHARACTERISTIC
/begin CHARACTERISTIC K_TMOT_CC_HIGH_TOEL_2 "CC-Meldung rot ueber Toel | EN: Red check-control message over oil temperature" VALUE 0x79792 TKW_VV_VV_SW 100.0 FORMULA_0023 -50.0000 180.0000 FORMAT "%4.1" /end CHARACTERISTIC
/begin CHARACTERISTIC K_TMOT_CC_HIGH_HYS "Hysterese fuer CC-Meldungen | EN: Hysteresis for check-control messages" VALUE 0x79794 TKW_VV_VV_UB 100.0 FORMULA_1021 0.0 25.5000 /end CHARACTERISTIC
/begin CHARACTERISTIC K_TMOT_CC_HIGH_ZWS_OFF "Offset fuer Zwangsschaltung | EN: Offset for forced (gear) shift" VALUE 0x79795 TKW_VV_VV_UB 100.0 FORMULA_1021 0.0 25.5000 /end CHARACTERISTIC
/begin CHARACTERISTIC K_TMOT_OBD_HIGH "Maximale Motortemperatur nach Standzeit" VALUE 0x79796 TKW_VV_VV_SW 100.0 FORMULA_0987 -50.0000 170.0000 FORMAT "%6.3" /end CHARACTERISTIC
/begin CHARACTERISTIC K_TMOT_OBD_HIGH_TIME "Standzeit fuer high-Diagnose | EN: Standzeit fuer high-Diagnose" VALUE 0x79798 TKW_VV_VV_UW 100.0 FORMULA_0986 0.0 1092.2500 FORMAT "%5.2" /end CHARACTERISTIC
/begin CHARACTERISTIC KL_TMOT_NTC "Kennlinie Motortemperatur | EN: Engine temperature curve" CURVE 0x7979A TKL_SW_VV_SW 100.0 FORMULA_0987 -50.0000 170.0000 /begin AXIS_DESCR STD_AXIS tmot_ad FORMULA_0123 10 0.0 1023.0000 /end AXIS_DESCR FORMAT "%6.3" /end CHARACTERISTIC
/begin CHARACTERISTIC KL_TMOT_OBD_MODELL_DELTA "Schwankung der Modelltemperatur | EN: Fluctuation of model temperature" CURVE 0x797C4 TKL_SW_VV_SW 100.0 FORMULA_0076 -1000.0000 1000.0000
 /begin AXIS_DESCR STD_AXIS zust_tmot_start FORMULA_0023 8 -50.0000 170.0000 FORMAT "%4.1" /end AXIS_DESCR
 FORMAT "%4.1" /end CHARACTERISTIC
/begin CHARACTERISTIC KL_TMOT_OBD_DELTA "Schwankung der Motortemperatur | EN: Fluctuation of engine temperature" CURVE 0x797E6 TKL_SW_VV_SW 100.0 FORMULA_0076 -1000.0000 1000.0000
 /begin AXIS_DESCR STD_AXIS zust_tmot_start FORMULA_0023 8 -50.0000 170.0000 FORMAT "%4.1" /end AXIS_DESCR
 FORMAT "%4.1" /end CHARACTERISTIC
/begin CHARACTERISTIC KL_TMOT_CC_HIGH_TMOT_1 "Schwelle fuer gelbe CC-Msg | EN: Threshold for yellow check-control message" CURVE 0x79808 TKL_UW_VV_SW 100.0 FORMULA_0023 -50.0000 170.0000 /begin AXIS_DESCR STD_AXIS time_ml FORMULA_0021 4 0.0 655.0000 FORMAT "%5.2" /end AXIS_DESCR FORMAT "%4.1" /end CHARACTERISTIC
/begin CHARACTERISTIC KL_TMOT_OBD_DIFF_T_DELTA "Max. Zeit in der maximale Messwert-Modell-Differenz ueberschritten" CURVE 0x7981A TKL_SW_VV_UW 100.0 FORMULA_0073 0.0 6553.5000
 /begin AXIS_DESCR STD_AXIS zust_tmot_start FORMULA_0023 4 -50.0000 170.0000 FORMAT "%4.1" /end AXIS_DESCR
 FORMAT "%4.1" /end CHARACTERISTIC
/begin CHARACTERISTIC KF_TMOT_OBD_ML_GES_MW "Mittelwertschwelle der Luftmasse | EN: Mean-value threshold of air mass" MAP 0x7982C TKF_SW_SW_SW 100.0 FORMULA_0112 -100.0000 1400.0000
 /begin AXIS_DESCR STD_AXIS tmot_start FORMULA_0023 8 -50.0000 170.0000 FORMAT "%4.1" /end AXIS_DESCR
 /begin AXIS_DESCR STD_AXIS toel FORMULA_0023 8 -50.0000 170.0000 FORMAT "%4.1" /end AXIS_DESCR
 FORMAT "%4.1" /end CHARACTERISTIC
/begin CHARACTERISTIC KF_TMOT_MODELL_ML_WICHT "Luftmassenwichtung | EN: Air-mass weighting" MAP 0x798CE TKF_SW_SW_SW 100.0 FORMULA_0112 -100.0000 1400.0000
 /begin AXIS_DESCR STD_AXIS tmot_or_tka FORMULA_0023 7 -50.0000 170.0000 FORMAT "%4.1" /end AXIS_DESCR
 /begin AXIS_DESCR STD_AXIS ml_ges FORMULA_0112 7 -100.0000 1400.0000 FORMAT "%4.1" /end AXIS_DESCR
 FORMAT "%4.1" /end CHARACTERISTIC
/begin MEASUREMENT tmot_e2 "Motortemperatur-Kuehlwasser Ebene 2" SWORD FORMULA_0023 0 0 -50.0000 170.0000 ECU_ADDRESS 0x3FC83C /end MEASUREMENT
/begin MEASUREMENT tmot_err_e2 "Anzahl der Vergleichs-Fehler" UBYTE FORMULA_0003 0 0 0.0 255.0000 ECU_ADDRESS 0x3FC840 /end MEASUREMENT
/begin MEASUREMENT tmot_ad "Eingelesener Spannungswert fuer Kuehlwassertemperatur" SWORD FORMULA_0123 0 0 0.0 1023.0000 ECU_ADDRESS 0x3FC40C /end MEASUREMENT
/begin MEASUREMENT tmot_roh "Ungefilterter Messwert der Kuehlwassertemperatur" SWORD FORMULA_0987 0 0 -50.0000 170.0000 ECU_ADDRESS 0x3FC40E /end MEASUREMENT
/begin MEASUREMENT tmot_diag_grad_filter "Gradientenuberwachung ueber 100ms" SWORD FORMULA_0987 0 0 -50.0000 170.0000 ECU_ADDRESS 0x3FC410 /end MEASUREMENT
/begin MEASUREMENT tmot_filter "Gefilterter Messwert der Kuehlwassertemperatur" SWORD FORMULA_0987 0 0 -50.0000 170.0000 ECU_ADDRESS 0x3FC412 /end MEASUREMENT
/begin MEASUREMENT tmot_modell_st "TMOT_MODELL-Status" UBYTE FORMULA_0033 0 0 0.0 255.0000 ECU_ADDRESS 0x3FC414 /end MEASUREMENT
/begin MEASUREMENT tmot_modell_st_ml_wicht "TMOT_MODELL-Status" UBYTE FORMULA_1004 0 0 0.0 255.0 ECU_ADDRESS 0x3FC414 BIT_MASK 0x1 /end MEASUREMENT
/begin MEASUREMENT tmot_modell_temp_kraft_roh "Ungefilterter Kraftstoffenergieeintrag" SWORD FORMULA_0076 0 0 -1000.0000 1000.0000 ECU_ADDRESS 0x3FC416 /end MEASUREMENT
/begin MEASUREMENT tmot_modell_temp_kraft "Gefilterter Kraftstoffenergieeintrag" SWORD FORMULA_0076 0 0 -1000.0000 1000.0000 ECU_ADDRESS 0x3FC418 /end MEASUREMENT
/begin MEASUREMENT tmot_modell_tumg_roh "Ungefilterter Umgebungsenergieabtrag" SWORD FORMULA_0076 0 0 -1000.0000 1000.0000 ECU_ADDRESS 0x3FC41A /end MEASUREMENT
/begin MEASUREMENT tmot_modell_tumg "Gefilterter Umgebungsenergieabtrag" SWORD FORMULA_0076 0 0 -1000.0000 1000.0000 ECU_ADDRESS 0x3FC41C /end MEASUREMENT
/begin MEASUREMENT tmot_modell_temp_kuehler_roh "Ungefilterter Kuehlsystemenergieabtrag" SWORD FORMULA_0076 0 0 -1000.0000 1000.0000 ECU_ADDRESS 0x3FC41E /end MEASUREMENT
/begin MEASUREMENT tmot_modell_temp_kuehler "Gefilterter Kuehlsystemenergieabtrag" SWORD FORMULA_0076 0 0 -1000.0000 1000.0000 ECU_ADDRESS 0x3FC420 /end MEASUREMENT
/begin MEASUREMENT tmot_modell_f_therm "Faktor Thermostateinfluss" UWORD FORMULA_0075 0 0 0.0 4.0000 ECU_ADDRESS 0x3FC422 /end MEASUREMENT
/begin MEASUREMENT tmot_modell_f_kw "Faktor Kuehlwassereinfluss" UWORD FORMULA_0075 0 0 0.0 4.0000 ECU_ADDRESS 0x3FC424 /end MEASUREMENT
/begin MEASUREMENT tmot_modell_delta "Abweichung Modell-Messwert" SWORD FORMULA_0076 0 0 -1000.0000 1000.0000 ECU_ADDRESS 0x3FC426 /end MEASUREMENT
/begin MEASUREMENT tmot_modell_ml_wicht "Gewichtete Gesamtluftmasse" SWORD FORMULA_0112 0 0 -100.0000 1400.0000 ECU_ADDRESS 0x3FC428 /end MEASUREMENT
/begin MEASUREMENT tmot_modell_lam_ist_mw "Begrenztes IST-Lambda" UWORD FORMULA_0025 0 0 0.0 3.9990 ECU_ADDRESS 0x3FC42A /end MEASUREMENT
/begin MEASUREMENT tmot_obd_st "TMOT_OBD-Status" UBYTE FORMULA_0033 0 0 0.0 255.0000 ECU_ADDRESS 0x3FC42C /end MEASUREMENT
/begin MEASUREMENT tmot_obd_st_ml_sperre "TMOT_OBD-Status" UBYTE FORMULA_1005 0 0 0.0 255.0 ECU_ADDRESS 0x3FC42C BIT_MASK 0x1 /end MEASUREMENT
/begin MEASUREMENT tmot_obd_st_sa_sperre "TMOT_OBD-Status" UBYTE FORMULA_1006 0 0 0.0 255.0 ECU_ADDRESS 0x3FC42C BIT_MASK 0x2 /end MEASUREMENT
/begin MEASUREMENT tmot_obd_st_fehlerz_sperre "TMOT_OBD-Status" UBYTE FORMULA_1007 0 0 0.0 255.0 ECU_ADDRESS 0x3FC42C BIT_MASK 0x4 /end MEASUREMENT
/begin MEASUREMENT tmot_obd_st_block_sperre "TMOT_OBD-Status" UBYTE FORMULA_1008 0 0 0.0 255.0 ECU_ADDRESS 0x3FC42C BIT_MASK 0x8 /end MEASUREMENT
/begin MEASUREMENT tmot_obd_st_plausibel "TMOT_OBD-Status" UBYTE FORMULA_1009 0 0 0.0 255.0 ECU_ADDRESS 0x3FC42C BIT_MASK 0x10 /end MEASUREMENT
/begin MEASUREMENT tmot_obd_st_haengt_nicht "TMOT_OBD-Status" UBYTE FORMULA_1010 0 0 0.0 255.0 ECU_ADDRESS 0x3FC42C BIT_MASK 0x20 /end MEASUREMENT
/begin MEASUREMENT tmot_obd_st_thermo_ok "TMOT_OBD-Status" UBYTE FORMULA_1011 0 0 0.0 255.0 ECU_ADDRESS 0x3FC42C BIT_MASK 0x40 /end MEASUREMENT
/begin MEASUREMENT tmot_obd_st_init "TMOT_OBD-Status" UBYTE FORMULA_1012 0 0 0.0 255.0 ECU_ADDRESS 0x3FC42C BIT_MASK 0x80 /end MEASUREMENT
/begin MEASUREMENT tmot_obd_ml_ges_int "Integral der Luftmasse" ULONG FORMULA_1013 0 0 0.0 42949672.9500 ECU_ADDRESS 0x3FC430 /end MEASUREMENT
/begin MEASUREMENT tmot_obd_ml_ges_time "Zeitdauer der Integration" ULONG FORMULA_0456 0 0 0.0 429496729.5000 ECU_ADDRESS 0x3FC434 /end MEASUREMENT
/begin MEASUREMENT tmot_obd_ml_ges_mw "Lastmittelwert seit Start" SWORD FORMULA_0112 0 0 -100.0000 1400.0000 ECU_ADDRESS 0x3FC438 /end MEASUREMENT
/begin MEASUREMENT tmot_obd_modell_abw "Differenz Messwert-Modell" SLONG FORMULA_1014 0 0 -1000.0000 1000.0000 ECU_ADDRESS 0x3FC43C /end MEASUREMENT
/begin MEASUREMENT tmot_obd_diff_t_delta "Max. Zeit in der maximale Messwert-Modell-Differenz ueberschritten" UWORD FORMULA_0073 0 0 0.0 6553.5000 ECU_ADDRESS 0x3FC440 /end MEASUREMENT
/begin MEASUREMENT tmot_obd_diff_t_delta_io "Zeit Messwert-Modell-Differenz o.k." UWORD FORMULA_0073 0 0 0.0 6553.5000 ECU_ADDRESS 0x3FC442 /end MEASUREMENT
/begin MEASUREMENT tmot_obd_diff_t_delta_nio "Zeit Messwert-Modell_Differenz nicht o.k." UWORD FORMULA_0073 0 0 0.0 6553.5000 ECU_ADDRESS 0x3FC444 /end MEASUREMENT
/begin MEASUREMENT tmot_obd_modell_min "Max. OBD-Modelltemperatur" SLONG FORMULA_0340 0 0 -50.0000 170.0000 ECU_ADDRESS 0x3FC448 /end MEASUREMENT
/begin MEASUREMENT tmot_obd_modell_max "Max. OBD-Modelltemperatur" SLONG FORMULA_0340 0 0 -50.0000 170.0000 ECU_ADDRESS 0x3FC44C /end MEASUREMENT
/begin MEASUREMENT tmot_obd_modell_delta "Delta OBD-Modelltemperatur" SLONG FORMULA_1014 0 0 -1000.0000 1000.0000 ECU_ADDRESS 0x3FC450 /end MEASUREMENT
/begin MEASUREMENT tmot_obd_min "Max. OBD-Kuehlwassertemperatur" SWORD FORMULA_0023 0 0 -50.0000 170.0000 ECU_ADDRESS 0x3FC454 /end MEASUREMENT
/begin MEASUREMENT tmot_obd_max "Max. OBD-Kuehlwassertemperatur" SWORD FORMULA_0023 0 0 -50.0000 170.0000 ECU_ADDRESS 0x3FC456 /end MEASUREMENT
/begin MEASUREMENT tmot_obd_delta "Delta OBD-Kuehlwassertemperatur" SWORD FORMULA_0076 0 0 -1000.0000 1000.0000 ECU_ADDRESS 0x3FC458 /end MEASUREMENT
/* ------------------ Abschnitt erzeugt aus toel.dat ------------------ */
/begin CHARACTERISTIC K_TOEL_N_T1 "PT1-Filterzeitkonstante fur toel_n_filt | EN: PT1 filter time constant for toel_n_filt" VALUE 0x7994E TKW_VV_VV_UB 100.0 FORMULA_0003 1.0000 255.0000 /end CHARACTERISTIC
/begin CHARACTERISTIC K_TOEL_AEBEGR "Aenderungsbegrenzung fuer toel | EN: Rate limit for oil temperature" VALUE 0x79950 TKW_VV_VV_SW 100.0 FORMULA_0076 -1000.0000 1000.0000 FORMAT "%4.1" /end CHARACTERISTIC
/begin CHARACTERISTIC K_TOEL_BEGR_OFFS "Temperaturfenster Begrenzung | EN: Temperature window limitation" VALUE 0x79952 TKW_VV_VV_SW 100.0 FORMULA_0076 -1000.0000 1000.0000 FORMAT "%4.1" /end CHARACTERISTIC
/begin CHARACTERISTIC K_TOEL_KOMBI_WSTATE "Wartezeit f. gueltige Zeit von Kombi | EN: Wait time for valid time from instrument cluster [s]" VALUE 0x79954 TKW_VV_VV_UW 100.0 FORMULA_0021 0.0 655.0000 FORMAT "%5.2" /end CHARACTERISTIC
/begin CHARACTERISTIC K_TOEL_T_MS "Motor steht-Schwelle | EN: Engine-stopped threshold [min]" VALUE 0x79956 TKW_VV_VV_UW 100.0 FORMULA_1024 1.0000 65535.0000 FORMAT "%5.2" /end CHARACTERISTIC
/begin CHARACTERISTIC K_TOEL_WANNE_GRD_F "toel-Gradient f(Wannentemp.) | EN: Oil-temperature gradient vs sump temperature" VALUE 0x79958 TKW_VV_VV_SW 100.0 FORMULA_0497 0.0 1.0000 FORMAT "%5.2" /end CHARACTERISTIC
/begin CHARACTERISTIC K_TOEL_TMOT_GRD_F "toel-Gradient f(Kuehlwassertemp.) | EN: Oil-temperature gradient vs coolant temperature" VALUE 0x7995A TKW_VV_VV_SW 100.0 FORMULA_0497 0.0 1.0000 FORMAT "%5.2" /end CHARACTERISTIC
/begin CHARACTERISTIC KL_TOEL_WICHT "Oelwannentemp.-Einfluss | EN: Oil-sump temperature influence" CURVE 0x7995C TKL_SW_VV_SW 100.0 FORMULA_1025 0.0 1.0000
 /begin AXIS_DESCR STD_AXIS toel_wanne FORMULA_0023 2 -50.0000 170.0000 FORMAT "%4.1" /end AXIS_DESCR
 FORMAT "%5.2" /end CHARACTERISTIC
/begin CHARACTERISTIC KL_TOEL_N "n-Einfluss Motorreibung | EN: Engine-speed influence, engine friction" CURVE 0x79966 TKL_SW_VV_SW 100.0 FORMULA_1023 0.0 0.0600 /begin AXIS_DESCR STD_AXIS Motordrehzahl FORMULA_0006 6 0.0 10000.0000 /end AXIS_DESCR FORMAT "%7.4" /end CHARACTERISTIC
/begin CHARACTERISTIC KL_TOEL_DN "gefilterter n-Einfluss Motorreibung | EN: Filtered engine-speed influence, engine friction" CURVE 0x79980 TKL_SW_VV_SW 100.0 FORMULA_1023 -0.0400 0.0400 /begin AXIS_DESCR STD_AXIS n FORMULA_0006 6 -10000.0000 10000.0000 /end AXIS_DESCR FORMAT "%7.4" /end CHARACTERISTIC
/begin CHARACTERISTIC KF_TOEL_V_TAN_MW "Oelkuehlungsoffset | EN: Oil cooling offset" MAP 0x7999A TKF_SW_SW_SW 100.0 FORMULA_0076 -50.0000 50.0000
 /begin AXIS_DESCR STD_AXIS v_vorne FORMULA_0078 7 -80.0000 360.0000 FORMAT "%4.1" /end AXIS_DESCR
 /begin AXIS_DESCR STD_AXIS tan_mw FORMULA_0023 7 -50.0000 170.0000 FORMAT "%4.1" /end AXIS_DESCR
 FORMAT "%4.1" /end CHARACTERISTIC
/begin CHARACTERISTIC K_TOEL_ERR_MAX_E2 "max. Fehler fuer Vergleich | EN: Max.Fehler für Vergleich" VALUE 0x7A9C2 TKW_VV_VV_UB 100.0 FORMULA_0003 0.0 255.0000 /end CHARACTERISTIC
/begin CHARACTERISTIC K_TOEL_MIN_E2 "min. Oeltemperatur | EN: Minimum oil temperature [°C]" VALUE 0x7A9C4 TKW_VV_VV_SW 100.0 FORMULA_0023 -50.0000 170.0000 FORMAT "%4.1" /end CHARACTERISTIC
/begin CHARACTERISTIC K_TOEL_MAX_E2 "max. Oeltemperatur | EN: Maximum oil temperature [°C]" VALUE 0x7A9C6 TKW_VV_VV_SW 100.0 FORMULA_0023 -50.0000 210.0000 FORMAT "%4.1" /end CHARACTERISTIC
/begin CHARACTERISTIC K_TOEL_DELTA_E2 "Abweichung zur Motortemperatur | EN: Deviation from engine temperature [°C]" VALUE 0x7A9C8 TKW_VV_VV_SW 100.0 FORMULA_0023 -50.0000 170.0000 FORMAT "%4.1" /end CHARACTERISTIC
/begin CHARACTERISTIC K_TOEL_MAX_NEG_GRAD_E2 "Gradientenschwelle Ebene 2 | EN: Gradient threshold, level 2" VALUE 0x7A9CA TKW_VV_VV_SW 100.0 FORMULA_0997 -32768.0000 0.0 /end CHARACTERISTIC
/begin CHARACTERISTIC K_TOEL_MAX_POS_GRAD_E2 "Gradientenschwelle Ebene 2 | EN: Gradient threshold, level 2" VALUE 0x7A9CC TKW_VV_VV_SW 100.0 FORMULA_0997 0.0 32767.0000 /end CHARACTERISTIC
/begin MEASUREMENT toel_kalt_neu "Oeltemperatur aus Aufheizmodell mit Toel-Gradient" SLONG FORMULA_1022 0 0 -50.0000 150.0000 ECU_ADDRESS 0x3FC45C /end MEASUREMENT
/begin MEASUREMENT toel_dt "Summe Toel-Gradient" SWORD FORMULA_1023 0 0 -3.0000 3.0000 ECU_ADDRESS 0x3FC460 /end MEASUREMENT
/begin MEASUREMENT toel_dt_dn "Toel-Gradient aus dn" SWORD FORMULA_1023 0 0 -3.0000 3.0000 ECU_ADDRESS 0x3FC462 /end MEASUREMENT
/begin MEASUREMENT toel_dt_n "Toel-Gradient aus n" SWORD FORMULA_1023 0 0 -3.0000 3.0000 ECU_ADDRESS 0x3FC464 /end MEASUREMENT
/begin MEASUREMENT toel_dt_tmot "Toel-Gradient aus tmot" SWORD FORMULA_1023 0 0 -3.0000 3.0000 ECU_ADDRESS 0x3FC466 /end MEASUREMENT
/begin MEASUREMENT toel_dt_wanne "Toel-Gradient aus toel_wanne" SWORD FORMULA_1023 0 0 -3.0000 3.0000 ECU_ADDRESS 0x3FC468 /end MEASUREMENT
/begin MEASUREMENT toel_n_filt "PT1-gefilterte Motordrehzahl" SWORD FORMULA_0006 0 0 0.0 10000.0000 ECU_ADDRESS 0x3FC46A /end MEASUREMENT
/begin MEASUREMENT toel_kalt "begrenzte Oeltemperatur aus Aufheizmodell" SLONG FORMULA_1022 0 0 -50.0000 150.0000 ECU_ADDRESS 0x3FC46C /end MEASUREMENT
/begin MEASUREMENT toel_save_abst "Oeltemperatur speichern bei Abstellen" UBYTE FORMULA_0003 0 0 0.0 255.0000 ECU_ADDRESS 0x3FC470 /end MEASUREMENT
/begin MEASUREMENT toel_start "Oeltemperatur im Start" SWORD FORMULA_0023 0 0 -50.0000 170.0000 ECU_ADDRESS 0x3FC472 /end MEASUREMENT
/begin MEASUREMENT toel_warm "Oeltemperatur aus Heissmodell" SWORD FORMULA_0023 0 0 -50.0000 170.0000 ECU_ADDRESS 0x3FC474 /end MEASUREMENT
/begin MEASUREMENT toel_aufwaerm "Neue Soll-Oeltemperatur (vor Begrenzung)" SWORD FORMULA_0023 0 0 -50.0000 170.0000 ECU_ADDRESS 0x3FC476 /end MEASUREMENT
/begin MEASUREMENT toel_e2_err "Anzahl der Vergleichs-Fehler" UBYTE FORMULA_0003 0 0 0.0 255.0000 ECU_ADDRESS 0x3FC842 /end MEASUREMENT
/begin MEASUREMENT toel_e2 "Oeltemperatur Ebene 2" SWORD FORMULA_0023 0 0 -50.0000 170.0000 ECU_ADDRESS 0x3FC844 /end MEASUREMENT
/begin FUNCTION Momentenmanager-Ebene_2 ""
 /begin DEF_CHARACTERISTIC KF_MD_FAHRER_KOMFORT_E2 KF_MD_FAHRER_NORMAL_E2 KF_MD_FAHRER_SPORT_E2 KF_MD_IND_LW_VERLUSTE_E2 KF_MD_IND_MIN_SCHUB_E2 KF_MD_IND_OPT_E2 KF_MD_IND_REIB_E2 KF_MD_KUPP_OFF_E2 KF_MD_SMG_BEGR_OFF_E2 KF_MD_ZW_OPT_E2 KL_MD_FAHRER_FAK_E2 KL_MD_IND_REIB_OFFSET_E2 KL_MD_RF_MAX_E2 K_MD_E2_ERR_MAX K_MD_E2_FW_REL_SCHW K_MD_E2_IST_SCHW K_MD_E2_MAX_SCHW K_MD_E2_MIN_SCHW K_MD_E2_N_MIN K_MD_E2_SCHLEPP_SCHW K_MD_E2_TAU_SOLL K_MD_ETA_LA_E2 K_MD_ETA_ZW_MIN_E2 K_MD_HYP_DN_E2 K_MD_HYP_VERH_E2 K_MD_IND_REIB_ABREG_E2 K_MD_LLR_AD_MAX_E2 K_MD_MSR_MAX_E2 K_MD_POLYNOM_A_E2 K_MD_POLYNOM_B_E2 K_MD_START_OFF_E2 K_MD_TAU_START_OFF_E2 K_MD_VERBR_MAX_E2 K_MD_ZYL_ANZ_E2 K_MD_ZYL_MASK_B1 K_MD_ZYL_MASK_B2 /end DEF_CHARACTERISTIC
 /begin REF_CHARACTERISTIC /end REF_CHARACTERISTIC
 /begin IN_MEASUREMENT /end IN_MEASUREMENT
 /begin OUT_MEASUREMENT md_dsc_freig_st_e2 md_e2_fehler md_e2_fw_rel_err md_e2_ist_err md_e2_istsoll_err md_e2_max_err md_e2_min_err md_e2_schlepp_err md_eta_ausblend_e2 md_eta_zw_ne_e2 md_fw_fgr_ md_fw_fgr_e2 md_fw_rel_diff md_fw_rel_e2 md_ind_lw_e2 md_ind_max_e2 md_ind_min_e2 md_ind_opt_diff md_ind_opt_e2 md_ind_reib_e2 md_ind_reib_offset_e2 md_ind_schlepp_diff md_ind_schlepp_e2 md_kupp_ist_e2 md_kupp_ist_soll_e2 md_kupp_max_diff md_kupp_max_e2 md_kupp_min_diff md_kupp_min_e2 md_kupp_msr_e2 md_kupp_off_e2 md_kupp_soll_e2 md_kupp_wunsch_e2 md_start_offset_e2 md_zw_opt_e2 /end OUT_MEASUREMENT
/end FUNCTION
/begin FUNCTION Motoroeltemperatur ""
 /begin DEF_CHARACTERISTIC KF_TOEL_V_TAN_MW KL_TOEL_DN KL_TOEL_N KL_TOEL_WICHT K_TOEL_AEBEGR K_TOEL_BEGR_OFFS K_TOEL_DELTA_E2 K_TOEL_ERR_MAX_E2 K_TOEL_KOMBI_WSTATE K_TOEL_MAX_E2 K_TOEL_MAX_NEG_GRAD_E2 K_TOEL_MAX_POS_GRAD_E2 K_TOEL_MIN_E2 K_TOEL_N_T1 K_TOEL_TMOT_GRD_F K_TOEL_T_MS K_TOEL_WANNE_GRD_F /end DEF_CHARACTERISTIC
 /begin REF_CHARACTERISTIC /end REF_CHARACTERISTIC
 /begin IN_MEASUREMENT /end IN_MEASUREMENT
 /begin OUT_MEASUREMENT toel_aufwaerm toel_dt toel_dt_dn toel_dt_n toel_dt_tmot toel_dt_wanne toel_e2 toel_e2_err toel_kalt toel_kalt_neu toel_n_filt toel_save_abst toel_start toel_warm /end OUT_MEASUREMENT
/end FUNCTION
/begin FUNCTION Motortemperatur ""
 /begin DEF_CHARACTERISTIC KF_TMOT_MODELL_ML_WICHT KF_TMOT_OBD_ML_GES_MW KL_TMOT_CC_HIGH_TMOT_1 KL_TMOT_NTC KL_TMOT_OBD_DELTA KL_TMOT_OBD_DIFF_T_DELTA KL_TMOT_OBD_MODELL_DELTA K_TMOT_CC_HIGH_HYS K_TMOT_CC_HIGH_TMOT_2 K_TMOT_CC_HIGH_TOEL_1 K_TMOT_CC_HIGH_TOEL_2 K_TMOT_CC_HIGH_ZWS_OFF K_TMOT_CFG_TOEL K_TMOT_DIAG_GRAD_MAX K_TMOT_DIAG_GRAD_TAU K_TMOT_DIAG_MAX K_TMOT_DIAG_MIN K_TMOT_DIAG_TAN K_TMOT_DIAG_TIME K_TMOT_DIAG_TKA K_TMOT_ELU_ERR_CC_HIGH_TMOT_1 K_TMOT_ERR_MAX_E2 K_TMOT_MAX_E2 K_TMOT_MAX_NEG_GRADIENT K_TMOT_MAX_NEG_GRAD_E2 K_TMOT_MAX_POS_GRAD_E2 K_TMOT_MIN_E2 K_TMOT_MODELL_C_MOTOR K_TMOT_MODELL_ERSATZ K_TMOT_MODELL_F_KW K_TMOT_MODELL_F_MOTOR K_TMOT_MODELL_GAIN K_TMOT_MODELL_LAM_MAX K_TMOT_MODELL_LAM_MIN K_TMOT_MODELL_SA_ML_F K_TMOT_MODELL_START_MIN K_TMOT_MODELL_TAU_KRAFT K_TMOT_MODELL_TAU_KUEHLER K_TMOT_MODELL_TAU_UMG K_TMOT_MODELL_THERM_DELTA K_TMOT_MODELL_THERM_MIN K_TMOT_MODELL_TI_F K_TMOT_MODELL_TKA_ERSATZ_DELTA K_TMOT_MODELL_TMOT_MODELL_ML K_TMOT_OBD_BLOCKHEATER_DIFF K_TMOT_OBD_CFG K_TMOT_OBD_DIFF_HIGH K_TMOT_OBD_DIFF_MAX K_TMOT_OBD_HIGH K_TMOT_OBD_HIGH_TIME K_TMOT_OBD_THERM_2 K_TMOT_OBD_THERM_2_START K_TMOT_OBD_TKA_THERM_1_DELTA K_TMOT_OBD_TKA_THERM_2_DELTA K_TMOT_OBD_TMOT_MIN K_TMOT_OBD_TMOT_MODELL_MAX K_TMOT_OBD_T_ML_MIN K_TMOT_OBD_T_SA_MAX K_TMOT_SK_DELTA K_TMOT_TAU /end DEF_CHARACTERISTIC
 /begin REF_CHARACTERISTIC /end REF_CHARACTERISTIC
 /begin IN_MEASUREMENT /end IN_MEASUREMENT
 /begin OUT_MEASUREMENT tmot_ad tmot_diag_grad_filter tmot_e2 tmot_err_e2 tmot_filter tmot_modell_delta tmot_modell_f_kw tmot_modell_f_therm tmot_modell_lam_ist_mw tmot_modell_ml_wicht tmot_modell_st tmot_modell_st_ml_wicht tmot_modell_temp_kraft tmot_modell_temp_kraft_roh tmot_modell_temp_kuehler tmot_modell_temp_kuehler_roh tmot_modell_tumg tmot_modell_tumg_roh tmot_obd_delta tmot_obd_diff_t_delta tmot_obd_diff_t_delta_io tmot_obd_diff_t_delta_nio tmot_obd_max tmot_obd_min tmot_obd_ml_ges_int tmot_obd_ml_ges_mw tmot_obd_ml_ges_time tmot_obd_modell_abw tmot_obd_modell_delta tmot_obd_modell_max tmot_obd_modell_min tmot_obd_st tmot_obd_st_block_sperre tmot_obd_st_fehlerz_sperre tmot_obd_st_haengt_nicht tmot_obd_st_init tmot_obd_st_ml_sperre tmot_obd_st_plausibel tmot_obd_st_sa_sperre tmot_obd_st_thermo_ok tmot_roh /end OUT_MEASUREMENT
/end FUNCTION
/begin FUNCTION PCTRL "" /begin DEF_CHARACTERISTIC K_PCTRL_PROZ_ZYKL K_PCTRL_TASK_ZYKL K_PCTRL_TIMEOUT /end DEF_CHARACTERISTIC /begin REF_CHARACTERISTIC /end REF_CHARACTERISTIC /begin IN_MEASUREMENT /end IN_MEASUREMENT
 /begin OUT_MEASUREMENT pctrl_proz pctrl_proz_err pctrl_proz_tb pctrl_t_old_ipk pctrl_task pctrl_task_err pctrl_task_tb pctrl_tout /end OUT_MEASUREMENT
/end FUNCTION
/begin FUNCTION Pedalwertgeber ""
 /begin DEF_CHARACTERISTIC KL_PWG_BLS_BRP KL_PWG_BLS_V KL_PWG_MAX_DIFF KL_PWG_SOLL KL_PWG_SOLL_NOTLAUF K_PWG1_A0_INITINC K_PWG1_A0_MAX K_PWG1_A0_MIN K_PWG1_DIAG_MAX K_PWG1_DIAG_MIN K_PWG1_INC_A0_ADAPT K_PWG1_NORM K_PWG1_NORM_HS K_PWG_A0_MIN_E2 K_PWG_A0_TAU K_PWG_A0_ZAEHLER K_PWG_AB_RAMPE K_PWG_BLS_CFG K_PWG_BLS_HS_VERZ K_PWG_BLS_N_MAX_FSP K_PWG_BLS_PWG_MAX K_PWG_BLS_PWG_MIN K_PWG_BLS_T_BRP_FEHLER K_PWG_BLS_T_V_FEHLER K_PWG_BLS_V_MAX K_PWG_BLS_V_MIN K_PWG_BLS_V_VORNE_MAX K_PWG_DELTA_E2 K_PWG_ERR_MAX_E2 K_PWG_KD K_PWG_NORM_E2 K_PWG_NORM_HS_E2 K_PWG_SK_NULLAGE K_PWG_SMG_ANFAHREN_FAK_E2 K_PWG_SOLL_2GANG_AB K_PWG_SOLL_2GANG_AUF K_PWG_SOLL_2GANG_FAK K_PWG_SOLL_2GANG_MAX K_PWG_SOLL_2GANG_VMAX K_PWG_TAU K_PWG_TAU_FEHLER /end DEF_CHARACTERISTIC
 /begin REF_CHARACTERISTIC /end REF_CHARACTERISTIC
 /begin IN_MEASUREMENT /end IN_MEASUREMENT
 /begin OUT_MEASUREMENT pwg pwg1_a0_zaehler pwg1_abs_roh pwg1_ad pwg1_roh pwg2_a0_zaehler pwg2_abs_roh pwg2_ad pwg2_roh pwg_ab_rampe pwg_abschalt pwg_abschalt_bremse pwg_abschalt_sperre pwg_begrenz pwg_bls_hs_verz pwg_bls_st pwg_bls_st_begrenzung pwg_bls_st_berganfahren pwg_bls_st_druckerfassung pwg_bls_st_v_begrenzung pwg_bls_t_brp pwg_bls_t_v pwg_err_e2 pwg_filter pwg_max_diff pwg_mode_ign pwg_soll_2gang_fak pwg_soll_2gang_st pwg_soll_e2 pwg_st_ed pwg_st_ed_kanal_fehler pwg_st_ed_kanal_filter pwg_st_ed_pwg1_fehler pwg_st_ed_pwg2_fehler pwg_st_ed_uext1_fehler pwg_st_ed_uext2_fehler /end OUT_MEASUREMENT
/end FUNCTION
/begin FUNCTION RTA "" /begin DEF_CHARACTERISTIC /end DEF_CHARACTERISTIC /begin REF_CHARACTERISTIC /end REF_CHARACTERISTIC /begin IN_MEASUREMENT /end IN_MEASUREMENT /begin OUT_MEASUREMENT /end OUT_MEASUREMENT /end FUNCTION
/begin FUNCTION RamCheck "" /begin DEF_CHARACTERISTIC K_RAM_CHK_CFG K_RAM_CHK_T /end DEF_CHARACTERISTIC /begin REF_CHARACTERISTIC /end REF_CHARACTERISTIC /begin IN_MEASUREMENT /end IN_MEASUREMENT /begin OUT_MEASUREMENT ram_chk_freq ram_chk_rptr /end OUT_MEASUREMENT /end FUNCTION
/begin FUNCTION Relativzeitdiagnose ""
 /begin DEF_CHARACTERISTIC KF_TIME_REL_OBD_MAX_STANDZEIT KF_TIME_REL_OBD_MIN_STANDZEIT K_TIME_REL_OBD_CFG K_TIME_REL_OBD_MAX_FEHLER K_TIME_REL_OBD_TMOT_ABSTELL K_TIME_REL_OBD_TMOT_DELTA_MIN K_TIME_REL_OBD_TMOT_START_FAST K_TIME_REL_OBD_TMOT_START_SLOW K_TIME_REL_OBD_T_MAX K_TIME_REL_OBD_T_MIN K_TIME_REL_OBD_T_ML K_TIME_REL_OBD_UB_MIN K_TIME_REL_OBD_ZERO_CNT_MAX /end DEF_CHARACTERISTIC
 /begin REF_CHARACTERISTIC /end REF_CHARACTERISTIC
 /begin IN_MEASUREMENT /end IN_MEASUREMENT
 /begin OUT_MEASUREMENT time_rel_delta time_rel_motor_start time_rel_obd_st time_rel_st /end OUT_MEASUREMENT
/end FUNCTION
/begin FUNCTION SG-Konfiguration ""
 /begin DEF_CHARACTERISTIC cfg.abgas cfg.baureihe cfg.betriebsmode cfg.canmess cfg.canstand cfg.diagnose cfg.dsc_typ cfg.getriebetyp cfg.hil cfg.ipm cfg.la_variante cfg.motortyp cfg.peripherie cfg.sg_mode cfg.status /end DEF_CHARACTERISTIC
 /begin REF_CHARACTERISTIC /end REF_CHARACTERISTIC
 /begin IN_MEASUREMENT /end IN_MEASUREMENT
 /begin OUT_MEASUREMENT cfg_boot_st sys_exc_lr vers_boot vers_boot_index /end OUT_MEASUREMENT
/end FUNCTION
/begin FUNCTION SK-Ebene_2 "" /begin DEF_CHARACTERISTIC K_SK_E2_KOMP_ERR_MAX K_SK_MAX_RESETS_E2 /end DEF_CHARACTERISTIC /begin REF_CHARACTERISTIC /end REF_CHARACTERISTIC /begin IN_MEASUREMENT /end IN_MEASUREMENT
 /begin OUT_MEASUREMENT sk_e2_byte sk_e2_byte_err sk_e2_fehler sk_e2_komp_err sk_e2_long sk_e2_long_err sk_e2_word sk_e2_word_err sk_reset_cnt_e2 /end OUT_MEASUREMENT
/end FUNCTION
/begin FUNCTION SK-Manager ""
 /begin DEF_CHARACTERISTIC KL_SK_LLR_N_SOLL K_SK_CFG K_SK_CRC32 K_SK_EGAS_OFF_10of16_ K_SK_EGAS_OFF_11of16_ K_SK_EGAS_OFF_12of16_ K_SK_EGAS_OFF_13of16_ K_SK_EGAS_OFF_14of16_ K_SK_EGAS_OFF_15of16_ K_SK_EGAS_OFF_16of16_ K_SK_EGAS_OFF_1of16_ K_SK_EGAS_OFF_2of16_ K_SK_EGAS_OFF_3of16_ K_SK_EGAS_OFF_4of16_ K_SK_EGAS_OFF_5of16_ K_SK_EGAS_OFF_6of16_ K_SK_EGAS_OFF_7of16_ K_SK_EGAS_OFF_8of16_ K_SK_EGAS_OFF_9of16_ K_SK_EGAS_OFF_TIME K_SK_FGR_SPERRE K_SK_FM_EGAS_TEST K_SK_FM_FAIL_ZYL_TEST K_SK_FM_GEMISCH_TEST K_SK_FM_KR_TEST K_SK_FM_LAM_TEST K_SK_FM_MD_TEST K_SK_FM_MVAC_TEST K_SK_FM_SMG_TEST K_SK_FRA_SPERRE K_SK_KH_SPERRE K_SK_LAM_EINGR_10of32_ K_SK_LAM_EINGR_11of32_ K_SK_LAM_EINGR_12of32_ K_SK_LAM_EINGR_13of32_ K_SK_LAM_EINGR_14of32_ K_SK_LAM_EINGR_15of32_ K_SK_LAM_EINGR_16of32_ K_SK_LAM_EINGR_17of32_ K_SK_LAM_EINGR_18of32_ K_SK_LAM_EINGR_19of32_ K_SK_LAM_EINGR_1of32_ K_SK_LAM_EINGR_20of32_ K_SK_LAM_EINGR_21of32_ K_SK_LAM_EINGR_22of32_ K_SK_LAM_EINGR_23of32_ K_SK_LAM_EINGR_24of32_ K_SK_LAM_EINGR_25of32_ K_SK_LAM_EINGR_26of32_ K_SK_LAM_EINGR_27of32_ K_SK_LAM_EINGR_28of32_ K_SK_LAM_EINGR_29of32_ K_SK_LAM_EINGR_2of32_ K_SK_LAM_EINGR_30of32_ K_SK_LAM_EINGR_31of32_ K_SK_LAM_EINGR_32of32_ K_SK_LAM_EINGR_3of32_ K_SK_LAM_EINGR_4of32_ K_SK_LAM_EINGR_5of32_ K_SK_LAM_EINGR_6of32_ K_SK_LAM_EINGR_7of32_ K_SK_LAM_EINGR_8of32_ K_SK_LAM_EINGR_9of32_ K_SK_LAM_EINGR_TI K_SK_LLRA_SPERRE K_SK_MAX_OS_ERR K_SK_MAX_RESETS K_SK_MD_BEGR_DK_OFFEN K_SK_MD_BEGR_EGAS_10of64_ K_SK_MD_BEGR_EGAS_11of64_ K_SK_MD_BEGR_EGAS_12of64_ K_SK_MD_BEGR_EGAS_13of64_ K_SK_MD_BEGR_EGAS_14of64_ K_SK_MD_BEGR_EGAS_15of64_ K_SK_MD_BEGR_EGAS_16of64_ K_SK_MD_BEGR_EGAS_17of64_ K_SK_MD_BEGR_EGAS_18of64_ K_SK_MD_BEGR_EGAS_19of64_ K_SK_MD_BEGR_EGAS_1of64_ K_SK_MD_BEGR_EGAS_20of64_ K_SK_MD_BEGR_EGAS_21of64_ K_SK_MD_BEGR_EGAS_22of64_ K_SK_MD_BEGR_EGAS_23of64_ K_SK_MD_BEGR_EGAS_24of64_ K_SK_MD_BEGR_EGAS_25of64_ K_SK_MD_BEGR_EGAS_26of64_ K_SK_MD_BEGR_EGAS_27of64_ K_SK_MD_BEGR_EGAS_28of64_ K_SK_MD_BEGR_EGAS_29of64_ K_SK_MD_BEGR_EGAS_2of64_ K_SK_MD_BEGR_EGAS_30of64_ K_SK_MD_BEGR_EGAS_31of64_ K_SK_MD_BEGR_EGAS_32of64_ K_SK_MD_BEGR_EGAS_33of64_ K_SK_MD_BEGR_EGAS_34of64_ K_SK_MD_BEGR_EGAS_35of64_ K_SK_MD_BEGR_EGAS_36of64_ K_SK_MD_BEGR_EGAS_37of64_ K_SK_MD_BEGR_EGAS_38of64_ K_SK_MD_BEGR_EGAS_39of64_ K_SK_MD_BEGR_EGAS_3of64_ K_SK_MD_BEGR_EGAS_40of64_ K_SK_MD_BEGR_EGAS_41of64_ K_SK_MD_BEGR_EGAS_42of64_ K_SK_MD_BEGR_EGAS_43of64_ K_SK_MD_BEGR_EGAS_44of64_ K_SK_MD_BEGR_EGAS_45of64_ K_SK_MD_BEGR_EGAS_46of64_ K_SK_MD_BEGR_EGAS_47of64_ K_SK_MD_BEGR_EGAS_48of64_ K_SK_MD_BEGR_EGAS_49of64_ K_SK_MD_BEGR_EGAS_4of64_ K_SK_MD_BEGR_EGAS_50of64_ K_SK_MD_BEGR_EGAS_51of64_ K_SK_MD_BEGR_EGAS_52of64_ K_SK_MD_BEGR_EGAS_53of64_ K_SK_MD_BEGR_EGAS_54of64_ K_SK_MD_BEGR_EGAS_55of64_ K_SK_MD_BEGR_EGAS_56of64_ K_SK_MD_BEGR_EGAS_57of64_ K_SK_MD_BEGR_EGAS_58of64_ K_SK_MD_BEGR_EGAS_59of64_ K_SK_MD_BEGR_EGAS_5of64_ K_SK_MD_BEGR_EGAS_60of64_ K_SK_MD_BEGR_EGAS_61of64_ K_SK_MD_BEGR_EGAS_62of64_ K_SK_MD_BEGR_EGAS_63of64_ K_SK_MD_BEGR_EGAS_64of64_ K_SK_MD_BEGR_EGAS_6of64_ K_SK_MD_BEGR_EGAS_7of64_ K_SK_MD_BEGR_EGAS_8of64_ K_SK_MD_BEGR_EGAS_9of64_ K_SK_MD_BEGR_GEMISCH_10of32_ K_SK_MD_BEGR_GEMISCH_11of32_ K_SK_MD_BEGR_GEMISCH_12of32_ K_SK_MD_BEGR_GEMISCH_13of32_ K_SK_MD_BEGR_GEMISCH_14of32_ K_SK_MD_BEGR_GEMISCH_15of32_ K_SK_MD_BEGR_GEMISCH_16of32_ K_SK_MD_BEGR_GEMISCH_17of32_ K_SK_MD_BEGR_GEMISCH_18of32_ K_SK_MD_BEGR_GEMISCH_19of32_ K_SK_MD_BEGR_GEMISCH_1of32_ K_SK_MD_BEGR_GEMISCH_20of32_ K_SK_MD_BEGR_GEMISCH_21of32_ K_SK_MD_BEGR_GEMISCH_22of32_ K_SK_MD_BEGR_GEMISCH_23of32_ K_SK_MD_BEGR_GEMISCH_24of32_ K_SK_MD_BEGR_GEMISCH_25of32_ K_SK_MD_BEGR_GEMISCH_26of32_ K_SK_MD_BEGR_GEMISCH_27of32_ K_SK_MD_BEGR_GEMISCH_28of32_ K_SK_MD_BEGR_GEMISCH_29of32_ K_SK_MD_BEGR_GEMISCH_2of32_ K_SK_MD_BEGR_GEMISCH_30of32_ K_SK_MD_BEGR_GEMISCH_31of32_ K_SK_MD_BEGR_GEMISCH_32of32_ K_SK_MD_BEGR_GEMISCH_3of32_ K_SK_MD_BEGR_GEMISCH_4of32_ K_SK_MD_BEGR_GEMISCH_5of32_ K_SK_MD_BEGR_GEMISCH_6of32_ K_SK_MD_BEGR_GEMISCH_7of32_ K_SK_MD_BEGR_GEMISCH_8of32_ K_SK_MD_BEGR_GEMISCH_9of32_ K_SK_MD_BEGR_KR_1of8_ K_SK_MD_BEGR_KR_2of8_ K_SK_MD_BEGR_KR_3of8_ K_SK_MD_BEGR_KR_4of8_ K_SK_MD_BEGR_KR_5of8_ K_SK_MD_BEGR_KR_6of8_ K_SK_MD_BEGR_KR_7of8_ K_SK_MD_BEGR_KR_8of8_ K_SK_MD_BEGR_MD_10of16_ K_SK_MD_BEGR_MD_11of16_ K_SK_MD_BEGR_MD_12of16_ K_SK_MD_BEGR_MD_13of16_ K_SK_MD_BEGR_MD_14of16_ K_SK_MD_BEGR_MD_15of16_ K_SK_MD_BEGR_MD_16of16_ K_SK_MD_BEGR_MD_1of16_ K_SK_MD_BEGR_MD_2of16_ K_SK_MD_BEGR_MD_3of16_ K_SK_MD_BEGR_MD_4of16_ K_SK_MD_BEGR_MD_5of16_ K_SK_MD_BEGR_MD_6of16_ K_SK_MD_BEGR_MD_7of16_ K_SK_MD_BEGR_MD_8of16_ K_SK_MD_BEGR_MD_9of16_ K_SK_MD_BEGR_MVAC_1of4_ K_SK_MD_BEGR_MVAC_2of4_ K_SK_MD_BEGR_MVAC_3of4_ K_SK_MD_BEGR_MVAC_4of4_ K_SK_MD_BEGR_MVAC_SYS K_SK_MD_BEGR_PWG_1of6_ K_SK_MD_BEGR_PWG_2of6_ K_SK_MD_BEGR_PWG_3of6_ K_SK_MD_BEGR_PWG_4of6_ K_SK_MD_BEGR_PWG_5of6_ K_SK_MD_BEGR_PWG_6of6_ K_SK_MD_BEGR_RESET K_SK_MD_BEGR_SMG_10of16_ K_SK_MD_BEGR_SMG_11of16_ K_SK_MD_BEGR_SMG_12of16_ K_SK_MD_BEGR_SMG_13of16_ K_SK_MD_BEGR_SMG_14of16_ K_SK_MD_BEGR_SMG_15of16_ K_SK_MD_BEGR_SMG_16of16_ K_SK_MD_BEGR_SMG_1of16_ K_SK_MD_BEGR_SMG_2of16_ K_SK_MD_BEGR_SMG_3of16_ K_SK_MD_BEGR_SMG_4of16_ K_SK_MD_BEGR_SMG_5of16_ K_SK_MD_BEGR_SMG_6of16_ K_SK_MD_BEGR_SMG_7of16_ K_SK_MD_BEGR_SMG_8of16_ K_SK_MD_BEGR_SMG_9of16_ K_SK_MD_BEGR_TI_10of16_ K_SK_MD_BEGR_TI_11of16_ K_SK_MD_BEGR_TI_12of16_ K_SK_MD_BEGR_TI_13of16_ K_SK_MD_BEGR_TI_14of16_ K_SK_MD_BEGR_TI_15of16_ K_SK_MD_BEGR_TI_16of16_ K_SK_MD_BEGR_TI_1of16_ K_SK_MD_BEGR_TI_2of16_ K_SK_MD_BEGR_TI_3of16_ K_SK_MD_BEGR_TI_4of16_ K_SK_MD_BEGR_TI_5of16_ K_SK_MD_BEGR_TI_6of16_ K_SK_MD_BEGR_TI_7of16_ K_SK_MD_BEGR_TI_8of16_ K_SK_MD_BEGR_TI_9of16_ K_SK_MD_TI_EINGR K_SK_MD_VL_SPERRE K_SK_MVAC_KH_1of4_ K_SK_MVAC_KH_2of4_ K_SK_MVAC_KH_3of4_ K_SK_MVAC_KH_4of4_ K_SK_PKS_NOTLAUF K_SK_PROZ_ERR K_SK_TASK_ERR K_SK_TI_OFF_EGAS_10of64_ K_SK_TI_OFF_EGAS_11of64_ K_SK_TI_OFF_EGAS_12of64_ K_SK_TI_OFF_EGAS_13of64_ K_SK_TI_OFF_EGAS_14of64_ K_SK_TI_OFF_EGAS_15of64_ K_SK_TI_OFF_EGAS_16of64_ K_SK_TI_OFF_EGAS_17of64_ K_SK_TI_OFF_EGAS_18of64_ K_SK_TI_OFF_EGAS_19of64_ K_SK_TI_OFF_EGAS_1of64_ K_SK_TI_OFF_EGAS_20of64_ K_SK_TI_OFF_EGAS_21of64_ K_SK_TI_OFF_EGAS_22of64_ K_SK_TI_OFF_EGAS_23of64_ K_SK_TI_OFF_EGAS_24of64_ K_SK_TI_OFF_EGAS_25of64_ K_SK_TI_OFF_EGAS_26of64_ K_SK_TI_OFF_EGAS_27of64_ K_SK_TI_OFF_EGAS_28of64_ K_SK_TI_OFF_EGAS_29of64_ K_SK_TI_OFF_EGAS_2of64_ K_SK_TI_OFF_EGAS_30of64_ K_SK_TI_OFF_EGAS_31of64_ K_SK_TI_OFF_EGAS_32of64_ K_SK_TI_OFF_EGAS_33of64_ K_SK_TI_OFF_EGAS_34of64_ K_SK_TI_OFF_EGAS_35of64_ K_SK_TI_OFF_EGAS_36of64_ K_SK_TI_OFF_EGAS_37of64_ K_SK_TI_OFF_EGAS_38of64_ K_SK_TI_OFF_EGAS_39of64_ K_SK_TI_OFF_EGAS_3of64_ K_SK_TI_OFF_EGAS_40of64_ K_SK_TI_OFF_EGAS_41of64_ K_SK_TI_OFF_EGAS_42of64_ K_SK_TI_OFF_EGAS_43of64_ K_SK_TI_OFF_EGAS_44of64_ K_SK_TI_OFF_EGAS_45of64_ K_SK_TI_OFF_EGAS_46of64_ K_SK_TI_OFF_EGAS_47of64_ K_SK_TI_OFF_EGAS_48of64_ K_SK_TI_OFF_EGAS_49of64_ K_SK_TI_OFF_EGAS_4of64_ K_SK_TI_OFF_EGAS_50of64_ K_SK_TI_OFF_EGAS_51of64_ K_SK_TI_OFF_EGAS_52of64_ K_SK_TI_OFF_EGAS_53of64_ K_SK_TI_OFF_EGAS_54of64_ K_SK_TI_OFF_EGAS_55of64_ K_SK_TI_OFF_EGAS_56of64_ K_SK_TI_OFF_EGAS_57of64_ K_SK_TI_OFF_EGAS_58of64_ K_SK_TI_OFF_EGAS_59of64_ K_SK_TI_OFF_EGAS_5of64_ K_SK_TI_OFF_EGAS_60of64_ K_SK_TI_OFF_EGAS_61of64_ K_SK_TI_OFF_EGAS_62of64_ K_SK_TI_OFF_EGAS_63of64_ K_SK_TI_OFF_EGAS_64of64_ K_SK_TI_OFF_EGAS_6of64_ K_SK_TI_OFF_EGAS_7of64_ K_SK_TI_OFF_EGAS_8of64_ K_SK_TI_OFF_EGAS_9of64_ K_SK_T_RESET_DELAY_OS K_SK_ZYL_OFF_MAX /end DEF_CHARACTERISTIC
 /begin REF_CHARACTERISTIC /end REF_CHARACTERISTIC
 /begin IN_MEASUREMENT /end IN_MEASUREMENT
 /begin OUT_MEASUREMENT sk_egas_off_ni sk_egas_off_time_b1 sk_egas_off_time_b2 sk_fail_st_zyl sk_fm_egas_exd sk_fm_gemisch sk_fm_kr sk_fm_lam_1of2_ sk_fm_lam_2of2_ sk_fm_ti sk_llr_n_soll_ign sk_md_begr_ni sk_md_begr_st sk_reset_cnt sk_t_reset_delay_os sk_ti_off_st sk_ti_zyl_off_cnt sk_tr_error_cnt sk_tr_retry sk_tr_timeout sk_tr_wait sk_ursache /end OUT_MEASUREMENT
/end FUNCTION
/begin RECORD_LAYOUT TKW_VV_VV_UB FNC_VALUES 1 UBYTE COLUMN_DIR DIRECT /end RECORD_LAYOUT
/begin RECORD_LAYOUT TKW_VV_VV_UW FNC_VALUES 1 UWORD COLUMN_DIR DIRECT /end RECORD_LAYOUT
/begin RECORD_LAYOUT TKW_VV_VV_SW FNC_VALUES 1 SWORD COLUMN_DIR DIRECT /end RECORD_LAYOUT
/begin RECORD_LAYOUT TKW_VV_VV_UL FNC_VALUES 1 ULONG COLUMN_DIR DIRECT /end RECORD_LAYOUT
/begin RECORD_LAYOUT TKL_UB_VV_SW NO_AXIS_PTS_X 1 UBYTE RESERVED 2 BYTE AXIS_PTS_X 3 UBYTE INDEX_INCR DIRECT FNC_VALUES 4 SWORD COLUMN_DIR DIRECT /end RECORD_LAYOUT
/begin RECORD_LAYOUT TKL_UW_VV_UW NO_AXIS_PTS_X 1 UBYTE RESERVED 2 BYTE AXIS_PTS_X 3 UWORD INDEX_INCR DIRECT FNC_VALUES 4 UWORD COLUMN_DIR DIRECT /end RECORD_LAYOUT
/begin RECORD_LAYOUT TKL_UW_VV_SW NO_AXIS_PTS_X 1 UBYTE RESERVED 2 BYTE AXIS_PTS_X 3 UWORD INDEX_INCR DIRECT FNC_VALUES 4 SWORD COLUMN_DIR DIRECT /end RECORD_LAYOUT
/begin RECORD_LAYOUT TKL_SW_VV_UW NO_AXIS_PTS_X 1 UBYTE RESERVED 2 BYTE AXIS_PTS_X 3 SWORD INDEX_INCR DIRECT FNC_VALUES 4 UWORD COLUMN_DIR DIRECT /end RECORD_LAYOUT
/begin RECORD_LAYOUT TKL_SW_VV_SW NO_AXIS_PTS_X 1 UBYTE RESERVED 2 BYTE AXIS_PTS_X 3 SWORD INDEX_INCR DIRECT FNC_VALUES 4 SWORD COLUMN_DIR DIRECT /end RECORD_LAYOUT
/begin RECORD_LAYOUT TKF_SW_SW_UW NO_AXIS_PTS_X 1 UBYTE NO_AXIS_PTS_Y 2 UBYTE AXIS_PTS_X 3 SWORD INDEX_INCR DIRECT AXIS_PTS_Y 4 SWORD INDEX_INCR DIRECT FNC_VALUES 5 UWORD COLUMN_DIR DIRECT /end RECORD_LAYOUT
/begin RECORD_LAYOUT TKF_SW_SW_SW NO_AXIS_PTS_X 1 UBYTE NO_AXIS_PTS_Y 2 UBYTE AXIS_PTS_X 3 SWORD INDEX_INCR DIRECT AXIS_PTS_Y 4 SWORD INDEX_INCR DIRECT FNC_VALUES 5 SWORD COLUMN_DIR DIRECT /end RECORD_LAYOUT
/end MODULE
/end PROJECT
