/begin PROJECT MSS65-ign-V452 "MSS65 IGN - V452.01-B204.00, data set 0569Q60Z160E"
/begin HEADER "" VERSION "V452.01-B204.00" /end HEADER
/begin MODULE _MSS65-ign "MSS65 IGN - V452.01-B204.00, calibration xxxxxxxx"
/begin MOD_COMMON "" BYTE_ORDER MSB_FIRST /* Default byteorder (Motorola) */ /end MOD_COMMON
/begin COMPU_METHOD FORMULA_0001 "FORMULA_0001" RAT_FUNC "%6.1" "%" COEFFS 0 10 0 0 0 1 /end COMPU_METHOD
/begin COMPU_METHOD FORMULA_0003 "FORMULA_0003" RAT_FUNC "%3.0" "-" COEFFS 0 1 0 0 0 1 /end COMPU_METHOD
/begin COMPU_METHOD FORMULA_0006 "FORMULA_0006" RAT_FUNC "%5.0" "Upm" COEFFS 0 1 0 0 0 1 /end COMPU_METHOD
/begin COMPU_METHOD FORMULA_0007 "FORMULA_0007" RAT_FUNC "%8.3" "-" COEFFS 0 10000 0 0 0 1 /end COMPU_METHOD
/begin COMPU_METHOD FORMULA_0009 "FORMULA_0009" RAT_FUNC "%6.1" "Nm" COEFFS 0 10 0 0 0 1 /end COMPU_METHOD
/begin COMPU_METHOD FORMULA_0010 "FORMULA_0010" RAT_FUNC "%5.0" "-" COEFFS 0 1 0 0 0 1 /end COMPU_METHOD
/begin COMPU_METHOD FORMULA_0017 "FORMULA_0017" RAT_FUNC "%9.2" "ms" COEFFS 0 7000 0 0 0 1 /end COMPU_METHOD
/begin COMPU_METHOD FORMULA_0021 "FORMULA_0021" RAT_FUNC "%7.2" "s" COEFFS 0 100 0 0 0 1 /end COMPU_METHOD
/* ------------------ Abschnitt erzeugt aus adapt_glob.dat ------------------ */
/begin COMPU_METHOD FORMULA_0023 "FORMULA_0023" RAT_FUNC "%6.1" "�C" COEFFS 0 10 2732 0 0 1 /end COMPU_METHOD
/begin COMPU_METHOD FORMULA_0025 "FORMULA_0025" RAT_FUNC "%8.3" "-" COEFFS 0 16384 0 0 0 1 /end COMPU_METHOD
/begin COMPU_METHOD FORMULA_0073 "FORMULA_0073" RAT_FUNC "%6.1" "s" COEFFS 0 10 0 0 0 1 /end COMPU_METHOD
/begin COMPU_METHOD FORMULA_0075 "FORMULA_0075" RAT_FUNC "%8.3" "-" COEFFS 0 1024 0 0 0 1 /end COMPU_METHOD
/begin COMPU_METHOD FORMULA_0076 "FORMULA_0076" RAT_FUNC "%6.1" "Kelvin" COEFFS 0 10 0 0 0 1 /end COMPU_METHOD
/begin COMPU_METHOD FORMULA_0078 "FORMULA_0078" RAT_FUNC "%6.1" "km/h" COEFFS 0 16 0 0 0 1 /end COMPU_METHOD
/begin COMPU_METHOD FORMULA_0111 "FORMULA_0111" RAT_FUNC "%6.1" "�KW" COEFFS 0 10 0 0 0 1 /end COMPU_METHOD
/begin COMPU_METHOD FORMULA_0113 "FORMULA_0113" RAT_FUNC "%6.1" "mg/asp" COEFFS 0 10 0 0 0 1 /end COMPU_METHOD
/begin COMPU_METHOD FORMULA_0114 "FORMULA_0114" RAT_FUNC "%5.0" "Upm/s" COEFFS 0 1 0 0 0 1 /end COMPU_METHOD
/begin COMPU_METHOD FORMULA_0117 "FORMULA_0117" RAT_FUNC "%7.2" "s" COEFFS 0 200 0 0 0 1 /end COMPU_METHOD
/begin COMPU_METHOD FORMULA_0122 "FORMULA_0122" TAB_VERB "%5.2" "-" COMPU_TAB_REF FORMULA_0122_VTAB /end COMPU_METHOD
/begin COMPU_VTAB FORMULA_0122_VTAB "FORMULA_0122_VTAB" TAB_VERB 2 0 "Inaktiv" 1 "Aktiv" /end COMPU_VTAB
/begin COMPU_METHOD FORMULA_0138 "FORMULA_0138" RAT_FUNC "%3.0" "bar" COEFFS 0 1 0 0 0 1 /end COMPU_METHOD
/begin COMPU_METHOD FORMULA_0141 "FORMULA_0141" RAT_FUNC "%7.2" "Grad" COEFFS 0 1 0 0 0 0.04395 /end COMPU_METHOD
/begin COMPU_METHOD FORMULA_0142 "FORMULA_0142" RAT_FUNC "%7.2" "Grad/s" COEFFS 0 1 0 0 0 0.04395 /end COMPU_METHOD
/begin COMPU_METHOD FORMULA_0268 "FORMULA_0268" TAB_VERB "%3.0" "-" COMPU_TAB_REF FORMULA_0268_VTAB /end COMPU_METHOD
/begin COMPU_VTAB FORMULA_0268_VTAB "FORMULA_0268_VTAB" TAB_VERB 5 0 "unbegrenzt" 1 "TZ-Begr" 2 "DK-Begr" 3 "TZ-DK-Begr" 15 "ungueltig" /end COMPU_VTAB
/begin COMPU_METHOD FORMULA_0295 "FORMULA_0295" RAT_FUNC "%9.4" "-" COEFFS 0 16384 0 0 0 1 /end COMPU_METHOD
/begin COMPU_METHOD FORMULA_0318 "FORMULA_0318" RAT_FUNC "%3.0" ".Gang" COEFFS 0 1 0 0 0 1 /end COMPU_METHOD
/* ------------------ Abschnitt erzeugt aus pctrl.dat ------------------ */
/begin COMPU_METHOD FORMULA_0352 "FORMULA_0352" RAT_FUNC "%5.2" "s" COEFFS 0 200 0 0 0 1 /end COMPU_METHOD
/begin COMPU_METHOD FORMULA_0363 "FORMULA_0363" TAB_VERB "%5.2" "-" COMPU_TAB_REF FORMULA_0363_VTAB /end COMPU_METHOD
/begin COMPU_VTAB FORMULA_0363_VTAB "FORMULA_0363_VTAB" TAB_VERB 2 0 "SK aus" 1 "SK aktiv" /end COMPU_VTAB
/begin COMPU_METHOD FORMULA_0422 "FORMULA_0422" RAT_FUNC "%7.2" "qmm" COEFFS 0 100 0 0 0 1 /end COMPU_METHOD
/begin COMPU_METHOD FORMULA_0435 "FORMULA_0435" RAT_FUNC "%6.1" "%" COEFFS 0 32768 0 0 0 100 /end COMPU_METHOD
/begin COMPU_METHOD FORMULA_0436 "FORMULA_0436" TAB_VERB "%3.0" "-" COMPU_TAB_REF FORMULA_0436_VTAB /end COMPU_METHOD
/begin COMPU_VTAB FORMULA_0436_VTAB "FORMULA_0436_VTAB" TAB_VERB 7 0 "kein Fehler" 1 "Md-Chk0" 2 "Md-Chk" 4 "MDmin-Chk" 8 "Rf-Chk" 16 "Eta-Chk" 32 "LLR-Chk" DEFAULT_VALUE "Mehrfach" /end COMPU_VTAB
/begin COMPU_METHOD FORMULA_0439 "FORMULA_0439" RAT_FUNC "%8.3" "0/oo" COEFFS 0 4194.304 0 0 0 1 /end COMPU_METHOD
/begin COMPU_METHOD FORMULA_0462 "FORMULA_0462" RAT_FUNC "%5.2" "s" COEFFS 0 0 2.56 0 1 0 /end COMPU_METHOD
/* ------------------ Abschnitt erzeugt aus aq.dat ------------------ */
/begin COMPU_METHOD FORMULA_0477 "FORMULA_0477" RAT_FUNC "%7.2" "s" COEFFS 0 0 327.67 0 1 0 /end COMPU_METHOD
/begin COMPU_METHOD FORMULA_0478 "FORMULA_0478" RAT_FUNC "%6.3" "s" COEFFS 0 0 1.28 0 1 0 /end COMPU_METHOD
/begin COMPU_METHOD FORMULA_0479 "FORMULA_0479" RAT_FUNC "%4.1" "%" COEFFS 0 10 0 0 0 1 /end COMPU_METHOD
/begin COMPU_METHOD FORMULA_0486 "FORMULA_0486" RAT_FUNC "%5.0" ".Gang" COEFFS 0 1 0 0 0 1 /end COMPU_METHOD
/begin COMPU_METHOD FORMULA_0497 "FORMULA_0497" RAT_FUNC "%7.2" "-" COEFFS 0 100 0 0 0 1 /end COMPU_METHOD
/begin COMPU_METHOD FORMULA_0501 "FORMULA_0501" RAT_FUNC "%4.1" "s" COEFFS 0 10 0 0 0 1 /end COMPU_METHOD
/begin COMPU_METHOD FORMULA_0571 "FORMULA_0571" RAT_FUNC "%5.0" "Nm/s" COEFFS 0 1 0 0 0 20 /end COMPU_METHOD
/begin COMPU_METHOD FORMULA_0596 "FORMULA_0596" RAT_FUNC "%7.2" "sec" COEFFS 0 200 0 0 0 1 /end COMPU_METHOD
/begin COMPU_METHOD FORMULA_0679 "FORMULA_0679" RAT_FUNC "%5.2" "s" COEFFS 0 0 25.6 0 1 0 /end COMPU_METHOD
/begin COMPU_METHOD FORMULA_0704 "FORMULA_0704" RAT_FUNC "%5.2" "-" COEFFS 0 128 0 0 0 1 /end COMPU_METHOD
/* ------------------ Abschnitt erzeugt aus llr.dat ------------------ */
/begin COMPU_METHOD FORMULA_0739 "FORMULA_0739" TAB_VERB "%3.0" "-" COMPU_TAB_REF FORMULA_0739_VTAB /end COMPU_METHOD
/begin COMPU_VTAB FORMULA_0739_VTAB "FORMULA_0739_VTAB" TAB_VERB 6 0 "Inaktiv" 1 "Aktiv" 2 "Filter LO" 3 "Filter HI" 4 "Fehler LO" 5 "Fehler HI" /end COMPU_VTAB
/begin COMPU_METHOD FORMULA_0740 "FORMULA_0740" TAB_VERB "%3.0" "-" COMPU_TAB_REF FORMULA_0740_VTAB /end COMPU_METHOD
/begin COMPU_VTAB FORMULA_0740_VTAB "FORMULA_0740_VTAB" TAB_VERB 5 0 "Inaktiv" 1 "Bed. niO" 5 "Aktiv" 6 "Ende" 7 "Abbruch" /end COMPU_VTAB
/begin COMPU_METHOD FORMULA_0741 "FORMULA_0741" TAB_VERB "%3.0" "-" COMPU_TAB_REF FORMULA_0741_VTAB /end COMPU_METHOD
/begin COMPU_VTAB FORMULA_0741_VTAB "FORMULA_0741_VTAB" TAB_VERB 2 0 "Normal" 1 "CSS" /end COMPU_VTAB
/begin COMPU_METHOD FORMULA_0742 "FORMULA_0742" RAT_FUNC "%7.2" "rad/s" COEFFS 0 100 0 0 0 1 /end COMPU_METHOD
/begin COMPU_METHOD FORMULA_0743 "FORMULA_0743" RAT_FUNC "%9.4" "Nm" COEFFS 0 2000 0 0 0 1 /end COMPU_METHOD
/begin COMPU_METHOD FORMULA_0744 "FORMULA_0744" TAB_VERB "%5.2" "-" COMPU_TAB_REF FORMULA_0744_VTAB /end COMPU_METHOD
/begin COMPU_VTAB FORMULA_0744_VTAB "FORMULA_0744_VTAB" TAB_VERB 4 0 "nie" 1 "MKS" 2 "OKS" 3 "beide" /end COMPU_VTAB
/begin COMPU_METHOD FORMULA_0745 "FORMULA_0745" TAB_VERB "%5.2" "-" COMPU_TAB_REF FORMULA_0745_VTAB /end COMPU_METHOD
/begin COMPU_VTAB FORMULA_0745_VTAB "FORMULA_0745_VTAB" TAB_VERB 4 0 "Keiner" 1 "Reib" 2 "Start" 3 "Reib+Start" /end COMPU_VTAB
/begin COMPU_METHOD FORMULA_0746 "FORMULA_0746" RAT_FUNC "%3.0" "Upm" COEFFS 0 1 0 0 0 1 /end COMPU_METHOD
/begin COMPU_METHOD FORMULA_0747 "FORMULA_0747" RAT_FUNC "%5.0" "Upm/s" COEFFS 0 1 0 0 0 10 /end COMPU_METHOD
/begin COMPU_METHOD FORMULA_0748 "FORMULA_0748" RAT_FUNC "%3.0" "Nm/s" COEFFS 0 1 0 0 0 1 /end COMPU_METHOD
/begin COMPU_METHOD FORMULA_0749 "FORMULA_0749" RAT_FUNC "%4.1" "Nm" COEFFS 0 10 0 0 0 1 /end COMPU_METHOD
/begin COMPU_METHOD FORMULA_0750 "FORMULA_0750" RAT_FUNC "%9.4" "Nm/s" COEFFS 0 2000 0 0 0 1 /end COMPU_METHOD
/begin COMPU_METHOD FORMULA_0751 "FORMULA_0751" RAT_FUNC "%6.1" "Nm/s" COEFFS 0 5 0 0 0 1 /end COMPU_METHOD
/* ------------------ Abschnitt erzeugt aus llr_ad.dat ------------------ */
/begin COMPU_METHOD FORMULA_0752 "FORMULA_0752" TAB_VERB "%5.2" "-" COMPU_TAB_REF FORMULA_0752_VTAB /end COMPU_METHOD
/begin COMPU_VTAB FORMULA_0752_VTAB "FORMULA_0752_VTAB" TAB_VERB 6 0 "Inaktiv" 1 "Aktiv" 3 "Wait" 5 "Normal" 9 "mit AC" 16 "Init" /end COMPU_VTAB
/begin COMPU_METHOD FORMULA_0753 "FORMULA_0753" TAB_VERB "%5.2" "-" COMPU_TAB_REF FORMULA_0753_VTAB /end COMPU_METHOD
/begin COMPU_VTAB FORMULA_0753_VTAB "FORMULA_0753_VTAB" TAB_VERB 4 0 "Aus" 1 "Ein" 2 "Ein o.TE" 255 "Init" /end COMPU_VTAB
/begin COMPU_METHOD FORMULA_0754 "FORMULA_0754" RAT_FUNC "%5.2" "s" COEFFS 0 0 256 0 1 0 /end COMPU_METHOD
/begin COMPU_METHOD FORMULA_0755 "FORMULA_0755" RAT_FUNC "%6.1" "Nm/s" COEFFS 0 10 0 0 0 1 /end COMPU_METHOD
/* ------------------ Abschnitt erzeugt aus lu.dat ------------------ */
/begin COMPU_METHOD FORMULA_0756 "FORMULA_0756" RAT_FUNC "%7.2" "0/oo" COEFFS 0 65.536 0 0 0 1 /end COMPU_METHOD
/begin COMPU_METHOD FORMULA_0757 "FORMULA_0757" RAT_FUNC "%9.4" "ms" COEFFS 0 7000 0 0 0 1 /end COMPU_METHOD
/begin COMPU_METHOD FORMULA_0758 "FORMULA_0758" RAT_FUNC "%9.4" "1/2*U" COEFFS 0 4048 0 0 0 1 /end COMPU_METHOD
/begin COMPU_METHOD FORMULA_0759 "FORMULA_0759" TAB_VERB "%7.2" "-" COMPU_TAB_REF FORMULA_0759_VTAB /end COMPU_METHOD
/begin COMPU_VTAB FORMULA_0759_VTAB "FORMULA_0759_VTAB" TAB_VERB 1 0 "ok" DEFAULT_VALUE "Auss" /end COMPU_VTAB
/begin COMPU_METHOD FORMULA_0760 "FORMULA_0760" TAB_VERB "%7.2" "-" COMPU_TAB_REF FORMULA_0760_VTAB /end COMPU_METHOD
/begin COMPU_VTAB FORMULA_0760_VTAB "FORMULA_0760_VTAB" TAB_VERB 1 0 "ok" DEFAULT_VALUE "Auss" /end COMPU_VTAB
/begin COMPU_METHOD FORMULA_0761 "FORMULA_0761" TAB_VERB "%7.2" "-" COMPU_TAB_REF FORMULA_0761_VTAB /end COMPU_METHOD
/begin COMPU_VTAB FORMULA_0761_VTAB "FORMULA_0761_VTAB" TAB_VERB 1 0 "ok" DEFAULT_VALUE "Auss" /end COMPU_VTAB
/begin COMPU_METHOD FORMULA_0762 "FORMULA_0762" TAB_VERB "%7.2" "-" COMPU_TAB_REF FORMULA_0762_VTAB /end COMPU_METHOD
/begin COMPU_VTAB FORMULA_0762_VTAB "FORMULA_0762_VTAB" TAB_VERB 1 0 "ok" DEFAULT_VALUE "Auss" /end COMPU_VTAB
/begin COMPU_METHOD FORMULA_0763 "FORMULA_0763" TAB_VERB "%7.2" "-" COMPU_TAB_REF FORMULA_0763_VTAB /end COMPU_METHOD
/begin COMPU_VTAB FORMULA_0763_VTAB "FORMULA_0763_VTAB" TAB_VERB 1 0 "ok" DEFAULT_VALUE "Auss" /end COMPU_VTAB
/begin COMPU_METHOD FORMULA_0764 "FORMULA_0764" TAB_VERB "%7.2" "-" COMPU_TAB_REF FORMULA_0764_VTAB /end COMPU_METHOD
/begin COMPU_VTAB FORMULA_0764_VTAB "FORMULA_0764_VTAB" TAB_VERB 1 0 "ok" DEFAULT_VALUE "Auss" /end COMPU_VTAB
/begin COMPU_METHOD FORMULA_0765 "FORMULA_0765" TAB_VERB "%7.2" "-" COMPU_TAB_REF FORMULA_0765_VTAB /end COMPU_METHOD
/begin COMPU_VTAB FORMULA_0765_VTAB "FORMULA_0765_VTAB" TAB_VERB 1 0 "ok" DEFAULT_VALUE "Auss" /end COMPU_VTAB
/begin COMPU_METHOD FORMULA_0766 "FORMULA_0766" TAB_VERB "%7.2" "-" COMPU_TAB_REF FORMULA_0766_VTAB /end COMPU_METHOD
/begin COMPU_VTAB FORMULA_0766_VTAB "FORMULA_0766_VTAB" TAB_VERB 1 0 "ok" DEFAULT_VALUE "Auss" /end COMPU_VTAB
/begin COMPU_METHOD FORMULA_0767 "FORMULA_0767" TAB_VERB "%7.2" "-" COMPU_TAB_REF FORMULA_0767_VTAB /end COMPU_METHOD
/begin COMPU_VTAB FORMULA_0767_VTAB "FORMULA_0767_VTAB" TAB_VERB 1 0 "ok" DEFAULT_VALUE "Auss" /end COMPU_VTAB
/begin COMPU_METHOD FORMULA_0768 "FORMULA_0768" TAB_VERB "%7.2" "-" COMPU_TAB_REF FORMULA_0768_VTAB /end COMPU_METHOD
/begin COMPU_VTAB FORMULA_0768_VTAB "FORMULA_0768_VTAB" TAB_VERB 1 0 "ok" DEFAULT_VALUE "Auss" /end COMPU_VTAB
/begin COMPU_METHOD FORMULA_0769 "FORMULA_0769" TAB_VERB "%5.2" "-" COMPU_TAB_REF FORMULA_0769_VTAB /end COMPU_METHOD
/begin COMPU_VTAB FORMULA_0769_VTAB "FORMULA_0769_VTAB" TAB_VERB 2 0 "kein Kraftschluss" 1 "Kraftschluss" /end COMPU_VTAB
/begin COMPU_METHOD FORMULA_0770 "FORMULA_0770" TAB_VERB "%5.2" "-" COMPU_TAB_REF FORMULA_0770_VTAB /end COMPU_METHOD
/begin COMPU_VTAB FORMULA_0770_VTAB "FORMULA_0770_VTAB" TAB_VERB 2 0 "KKOS ein" 1 "KKOS aus" /end COMPU_VTAB
/begin COMPU_METHOD FORMULA_0771 "FORMULA_0771" TAB_VERB "%5.2" "-" COMPU_TAB_REF FORMULA_0771_VTAB /end COMPU_METHOD
/begin COMPU_VTAB FORMULA_0771_VTAB "FORMULA_0771_VTAB" TAB_VERB 2 0 "gesperrt" 1 "frei" /end COMPU_VTAB
/begin COMPU_METHOD FORMULA_0772 "FORMULA_0772" TAB_VERB "%5.2" "-" COMPU_TAB_REF FORMULA_0772_VTAB /end COMPU_METHOD
/begin COMPU_VTAB FORMULA_0772_VTAB "FORMULA_0772_VTAB" TAB_VERB 17 0 "KEINER" 1 "N_MIN" 2 "N_MAX" 3 "RF_MIN" 4 "SA_BEREIT" 5 "KLIMAKOMP" 6 "SCHLECHTWEG" 7 "DSC_REGELT" 8 "TI_AUSBLEND" 9 "RF_DELTA" 10 "MD_WUNSCH_POS" 11 "MD_WUNSCH_NEG" 12 "TZ_DELTA" 13 "KRAFTSCHLUSS" 14 "NULLZEIT" 15 "VANOS_EXD" 16 "SEMGENTTASK" DEFAULT_VALUE "UNDEF." /end COMPU_VTAB
/begin COMPU_METHOD FORMULA_0773 "FORMULA_0773" RAT_FUNC "%6.1" "Nm/Segm" COEFFS 0 10 0 0 0 1 /end COMPU_METHOD
/begin COMPU_METHOD FORMULA_0774 "FORMULA_0774" RAT_FUNC "%3.0" "Segm" COEFFS 0 1 0 0 0 1 /end COMPU_METHOD
/begin COMPU_METHOD FORMULA_0775 "FORMULA_0775" TAB_VERB "%5.2" "-" COMPU_TAB_REF FORMULA_0775_VTAB /end COMPU_METHOD
/begin COMPU_VTAB FORMULA_0775_VTAB "FORMULA_0775_VTAB" TAB_VERB 4 0 "AUS" 1 "IDLE" 2 "AKTIV" 4 "ADAP" DEFAULT_VALUE "UNDEF." /end COMPU_VTAB
/begin COMPU_METHOD FORMULA_0776 "FORMULA_0776" RAT_FUNC "%11.4" "ms" COEFFS 0 7000 0 0 0 1 /end COMPU_METHOD
/begin COMPU_METHOD FORMULA_0777 "FORMULA_0777" RAT_FUNC "%3.0" "KW-Zahn" COEFFS 0 1 0 0 0 1 /end COMPU_METHOD
/begin COMPU_METHOD FORMULA_0778 "FORMULA_0778" RAT_FUNC "%5.0" "2*U" COEFFS 0 1 0 0 0 1 /end COMPU_METHOD
/begin COMPU_METHOD FORMULA_0779 "FORMULA_0779" TAB_VERB "%5.2" "-" COMPU_TAB_REF FORMULA_0779_VTAB /end COMPU_METHOD
/begin COMPU_VTAB FORMULA_0779_VTAB "FORMULA_0779_VTAB" TAB_VERB 2 0 "OHNE LU" 1 "MIT LU" DEFAULT_VALUE "undef." /end COMPU_VTAB
/begin COMPU_METHOD FORMULA_0780 "FORMULA_0780" RAT_FUNC "%5.2" "-" COEFFS 0 32 0 0 0 1 /end COMPU_METHOD
/begin COMPU_METHOD FORMULA_0781 "FORMULA_0781" RAT_FUNC "%6.1" "�/Segm" COEFFS 0 10 0 0 0 1 /end COMPU_METHOD
/begin COMPU_METHOD FORMULA_0782 "FORMULA_0782" RAT_FUNC "%9.4" "1/2U" COEFFS 0 4048 0 0 0 1 /end COMPU_METHOD
/begin COMPU_METHOD FORMULA_0783 "FORMULA_0783" RAT_FUNC "%5.0" "Segm." COEFFS 0 1 0 0 0 1 /end COMPU_METHOD
/* ------------------ Abschnitt erzeugt aus md_basis.dat ------------------ */
/begin COMPU_METHOD FORMULA_0784 "FORMULA_0784" RAT_FUNC "%6.1" "Nm" COEFFS 0 100 0 0 0 1 /end COMPU_METHOD
/begin COMPU_METHOD FORMULA_0785 "FORMULA_0785" RAT_FUNC "%7.2" "Nm/s" COEFFS 0 10 0 0 0 1 /end COMPU_METHOD
/begin COMPU_METHOD FORMULA_0786 "FORMULA_0786" RAT_FUNC "%7.2" "10E-4" COEFFS 0 100 0 0 0 1 /end COMPU_METHOD
/begin COMPU_METHOD FORMULA_0787 "FORMULA_0787" TAB_VERB "%5.2" "-" COMPU_TAB_REF FORMULA_0787_VTAB /end COMPU_METHOD
/begin COMPU_VTAB FORMULA_0787_VTAB "FORMULA_0787_VTAB" TAB_VERB 2 0 "ohne KR" 1 "mit KR" /end COMPU_VTAB
/begin COMPU_METHOD FORMULA_0788 "FORMULA_0788" TAB_VERB "%3.0" "-" COMPU_TAB_REF FORMULA_0788_VTAB /end COMPU_METHOD
/begin COMPU_VTAB FORMULA_0788_VTAB "FORMULA_0788_VTAB" TAB_VERB 7 0 "ohne Korr" 1 "TZ bei KH" 2 "RF bei KH" 3 "bei KH" 4 "TZ immer" 8 "RF immer" 12 "immer" /end COMPU_VTAB
/begin COMPU_METHOD FORMULA_0789 "FORMULA_0789" RAT_FUNC "%5.2" "1/sec" COEFFS 0 1024 0 0 0 200 /end COMPU_METHOD
/begin COMPU_METHOD FORMULA_0790 "FORMULA_0790" TAB_VERB "%3.0" "-" COMPU_TAB_REF FORMULA_0790_VTAB /end COMPU_METHOD
/begin COMPU_VTAB FORMULA_0790_VTAB "FORMULA_0790_VTAB" TAB_VERB 2 0 "aus" 1 "ein" /end COMPU_VTAB
/begin COMPU_METHOD FORMULA_0791 "FORMULA_0791" RAT_FUNC "%5.0" "�/sec" COEFFS 0 1 0 0 0 20 /end COMPU_METHOD
/begin COMPU_METHOD FORMULA_0792 "FORMULA_0792" RAT_FUNC "%7.2" "-" COEFFS 0 128 0 0 0 1 /end COMPU_METHOD
/begin COMPU_METHOD FORMULA_0793 "FORMULA_0793" RAT_FUNC "%6.1" "ms" COEFFS 0 10 0 0 0 1 /end COMPU_METHOD
/* ------------------ Abschnitt erzeugt aus md_can.dat ------------------ */
/begin COMPU_METHOD FORMULA_0794 "FORMULA_0794" TAB_VERB "%5.2" "-" COMPU_TAB_REF FORMULA_0794_VTAB /end COMPU_METHOD
/begin COMPU_VTAB FORMULA_0794_VTAB "FORMULA_0794_VTAB" TAB_VERB 9 0 "Freigabe" 1 "Fehler" 2 "Start" 4 "Beschl." 8 "VL" 16 "WH" 32 "Tmot" 64 "Nmax" 128 "TEFC" DEFAULT_VALUE "Mehrfach" /end COMPU_VTAB
/begin COMPU_METHOD FORMULA_0795 "FORMULA_0795" TAB_VERB "%5.2" "-" COMPU_TAB_REF FORMULA_0795_VTAB /end COMPU_METHOD
/begin COMPU_VTAB FORMULA_0795_VTAB "FORMULA_0795_VTAB" TAB_VERB 7 0 "kein Fehler" 1 "CAN-Err" 2 "DME-Err" 4 "MD-Err" 8 "ELU-Err" 16 "Kuehl-Err" 32 "Bereit-Err" DEFAULT_VALUE "Mehrfach" /end COMPU_VTAB
/begin COMPU_METHOD FORMULA_0796 "FORMULA_0796" TAB_VERB "%5.2" "-" COMPU_TAB_REF FORMULA_0796_VTAB /end COMPU_METHOD
/begin COMPU_VTAB FORMULA_0796_VTAB "FORMULA_0796_VTAB" TAB_VERB 9 0 "aus" 1 "nLL-Anhebung" 2 "Klima-Anf." 3 "nLL+Klima" 4 "Reserve" 6 "Klima+Res" 7 "nLL+Klima+Res" 8 "nLL-ZH" 24 "nLL-ZH+Res" /end COMPU_VTAB
/begin COMPU_METHOD FORMULA_0797 "FORMULA_0797" TAB_VERB "%5.2" "-" COMPU_TAB_REF FORMULA_0797_VTAB /end COMPU_METHOD
/begin COMPU_VTAB FORMULA_0797_VTAB "FORMULA_0797_VTAB" TAB_VERB 5 0 "Inaktiv" 1 "Wait on" 2 "Filter on" 4 "Wait off" 8 "Filter off" DEFAULT_VALUE "undef" /end COMPU_VTAB
/begin COMPU_METHOD FORMULA_0798 "FORMULA_0798" TAB_VERB "%3.0" "-" COMPU_TAB_REF FORMULA_0798_VTAB /end COMPU_METHOD
/begin COMPU_VTAB FORMULA_0798_VTAB "FORMULA_0798_VTAB" TAB_VERB 2 0 "gesperrt" 1 "frei" DEFAULT_VALUE "ungueltig" /end COMPU_VTAB
/begin COMPU_METHOD FORMULA_0799 "FORMULA_0799" RAT_FUNC "%3.0" "Nm/s" COEFFS 0 1 0 0 0 10 /end COMPU_METHOD
/begin COMPU_METHOD FORMULA_0800 "FORMULA_0800" RAT_FUNC "%3.0" "Nm/s" COEFFS 0 -1 0 0 0 10 /end COMPU_METHOD
/begin COMPU_METHOD FORMULA_0803 "FORMULA_0803" RAT_FUNC "%5.0" "Nm" COEFFS 0 10 0 0 0 1 /end COMPU_METHOD
/* ------------------ Abschnitt erzeugt aus md_filter.dat ------------------ */
/begin COMPU_METHOD FORMULA_0804 "FORMULA_0804" TAB_VERB "%3.0" "-" COMPU_TAB_REF FORMULA_0804_VTAB /end COMPU_METHOD
/begin COMPU_VTAB FORMULA_0804_VTAB "FORMULA_0804_VTAB" TAB_VERB 6 0 "Inaktiv" 1 "SA aktiv" 2 "LSD" 4 "Dash" 3 "LSD+SA" 5 "Dash+SA" /end COMPU_VTAB
/begin COMPU_METHOD FORMULA_0805 "FORMULA_0805" TAB_VERB "%3.0" "-" COMPU_TAB_REF FORMULA_0805_VTAB /end COMPU_METHOD
/begin COMPU_VTAB FORMULA_0805_VTAB "FORMULA_0805_VTAB" TAB_VERB 1 0 "Inaktiv" DEFAULT_VALUE "Aktiv" /end COMPU_VTAB
/begin COMPU_METHOD FORMULA_0806 "FORMULA_0806" TAB_VERB "%3.0" "-" COMPU_TAB_REF FORMULA_0806_VTAB /end COMPU_METHOD
/begin COMPU_VTAB FORMULA_0806_VTAB "FORMULA_0806_VTAB" TAB_VERB 1 0 "Inaktiv" DEFAULT_VALUE "Aktiv" /end COMPU_VTAB
/begin COMPU_METHOD FORMULA_0807 "FORMULA_0807" TAB_VERB "%3.0" "-" COMPU_TAB_REF FORMULA_0807_VTAB /end COMPU_METHOD
/begin COMPU_VTAB FORMULA_0807_VTAB "FORMULA_0807_VTAB" TAB_VERB 2 0 "Filter aus" 1 "Filter ein" /end COMPU_VTAB
/begin COMPU_METHOD FORMULA_0808 "FORMULA_0808" TAB_VERB "%3.0" "-" COMPU_TAB_REF FORMULA_0808_VTAB /end COMPU_METHOD
/begin COMPU_VTAB FORMULA_0808_VTAB "FORMULA_0808_VTAB" TAB_VERB 3 -1 "fallend" 0 "konstant" 1 "steigend" DEFAULT_VALUE "undef" /end COMPU_VTAB
/begin COMPU_METHOD FORMULA_0809 "FORMULA_0809" TAB_VERB "%3.0" "-" COMPU_TAB_REF FORMULA_0809_VTAB /end COMPU_METHOD
/begin COMPU_VTAB FORMULA_0809_VTAB "FORMULA_0809_VTAB" TAB_VERB 3 0 "B1/unter 0Nm" 1 "B2/um 0Nm" 2 "B3/ueber 0Nm" DEFAULT_VALUE "undef" /end COMPU_VTAB
/begin COMPU_METHOD FORMULA_0810 "FORMULA_0810" RAT_FUNC "%7.0" "Nm/s" COEFFS 0 1 0 0 0 1 /end COMPU_METHOD
/begin COMPU_METHOD FORMULA_0811 "FORMULA_0811" RAT_FUNC "%5.0" "Nm/s" COEFFS 0 1 0 0 0 1 /end COMPU_METHOD
/begin COMPU_METHOD FORMULA_0812 "FORMULA_0812" RAT_FUNC "%8.1" "Nm" COEFFS 0 200 0 0 0 1 /end COMPU_METHOD
/begin COMPU_METHOD FORMULA_0813 "FORMULA_0813" TAB_VERB "%3.0" "-" COMPU_TAB_REF FORMULA_0813_VTAB /end COMPU_METHOD
/begin COMPU_VTAB FORMULA_0813_VTAB "FORMULA_0813_VTAB" TAB_VERB 3 0 "aus" 1 "bei KS" 2 "immer" /end COMPU_VTAB
/begin COMPU_METHOD FORMULA_0814 "FORMULA_0814" RAT_FUNC "%5.0" "-" COEFFS 0 -1 1 0 0 -1 /end COMPU_METHOD
/* ------------------ Abschnitt erzeugt aus md_kus.dat ------------------ */
/begin COMPU_METHOD FORMULA_0815 "FORMULA_0815" RAT_FUNC "%10.3" "Nm/Upm" COEFFS 0 1000 0 0 0 1 /end COMPU_METHOD
/begin COMPU_METHOD FORMULA_0816 "FORMULA_0816" RAT_FUNC "%7.2" "Nm/Upm" COEFFS 0 100 0 0 0 1 /end COMPU_METHOD
/* ------------------ Abschnitt erzeugt aus md_soll.dat ------------------ */
/begin COMPU_METHOD FORMULA_0817 "FORMULA_0817" TAB_VERB "%5.2" "-" COMPU_TAB_REF FORMULA_0817_VTAB /end COMPU_METHOD
/begin COMPU_VTAB FORMULA_0817_VTAB "FORMULA_0817_VTAB" TAB_VERB 2 0 "Inaktiv" 1 "Aktiv" /end COMPU_VTAB
/begin COMPU_METHOD FORMULA_0818 "FORMULA_0818" TAB_VERB "%5.2" "-" COMPU_TAB_REF FORMULA_0818_VTAB /end COMPU_METHOD
/begin COMPU_VTAB FORMULA_0818_VTAB "FORMULA_0818_VTAB" TAB_VERB 2 0 "Bezug=Sollmoment" 1 "Bezug=Istmoment" /end COMPU_VTAB
/begin COMPU_METHOD FORMULA_0819 "FORMULA_0819" RAT_FUNC "%10.3" "Nm/Upm" COEFFS 0 -1000 0 0 0 1 /end COMPU_METHOD
/begin COMPU_METHOD FORMULA_0820 "FORMULA_0820" RAT_FUNC "%10.3" "Nm/kmh" COEFFS 0 1000 0 0 0 1 /end COMPU_METHOD
/begin COMPU_METHOD FORMULA_0821 "FORMULA_0821" RAT_FUNC "%10.3" "Nm/kmh" COEFFS 0 -1000 0 0 0 1 /end COMPU_METHOD
/begin COMPU_METHOD FORMULA_0822 "FORMULA_0822" TAB_VERB "%5.2" "-" COMPU_TAB_REF FORMULA_0822_VTAB /end COMPU_METHOD
/begin COMPU_VTAB FORMULA_0822_VTAB "FORMULA_0822_VTAB" TAB_VERB 2 0 "Inaktiv" 128 "Erkannt" DEFAULT_VALUE "undef" /end COMPU_VTAB
/begin COMPU_METHOD FORMULA_0823 "FORMULA_0823" TAB_VERB "%5.2" "-" COMPU_TAB_REF FORMULA_0823_VTAB /end COMPU_METHOD
/begin COMPU_VTAB FORMULA_0823_VTAB "FORMULA_0823_VTAB" TAB_VERB 4 0 "Inaktiv" 1 "md_rf_soll" 2 "md_tz_soll" 4 "md_ind_wunsch_tz" /end COMPU_VTAB
/begin COMPU_METHOD FORMULA_0824 "FORMULA_0824" TAB_VERB "%5.2" "-" COMPU_TAB_REF FORMULA_0824_VTAB /end COMPU_METHOD
/begin COMPU_VTAB FORMULA_0824_VTAB "FORMULA_0824_VTAB" TAB_VERB 4 0 "immer aus" 1 "Eingr, LL, nicht LL-KH" 2 "immer ein" 3 "Eingr, LL, LL-KH" /end COMPU_VTAB
/begin COMPU_METHOD FORMULA_0825 "FORMULA_0825" TAB_VERB "%5.2" "-" COMPU_TAB_REF FORMULA_0825_VTAB /end COMPU_METHOD
/begin COMPU_VTAB FORMULA_0825_VTAB "FORMULA_0825_VTAB" TAB_VERB 7 0 "Inaktiv" 1 "EtaStat" 2 "EtaKh" 3 "EtaKr" 4 "EtaKrKh" 5 "EtaStat+ResKh" 6 "EtaKr+ResKh" /end COMPU_VTAB
/begin COMPU_METHOD FORMULA_0826 "FORMULA_0826" TAB_VERB "%5.2" "-" COMPU_TAB_REF FORMULA_0826_VTAB /end COMPU_METHOD
/begin COMPU_VTAB FORMULA_0826_VTAB "FORMULA_0826_VTAB" TAB_VERB 2 0 "Inaktiv" 1 "Aktiv" DEFAULT_VALUE "undef" /end COMPU_VTAB
/begin COMPU_METHOD FORMULA_0827 "FORMULA_0827" RAT_FUNC "%3.0" "Nm/s" COEFFS 0 1 0 0 0 20 /end COMPU_METHOD
/begin COMPU_METHOD FORMULA_0828 "FORMULA_0828" RAT_FUNC "%5.2" "Upm/s" COEFFS 0 1 0 0 0 200 /end COMPU_METHOD
/begin COMPU_METHOD FORMULA_0829 "FORMULA_0829" RAT_FUNC "%3.0" "Gang" COEFFS 0 1 0 0 0 1 /end COMPU_METHOD
/begin COMPU_METHOD FORMULA_0830 "FORMULA_0830" TAB_VERB "%5.2" "-" COMPU_TAB_REF FORMULA_0830_VTAB /end COMPU_METHOD
/begin COMPU_VTAB FORMULA_0830_VTAB "FORMULA_0830_VTAB" TAB_VERB 4 0 "Inaktiv" 1 "mit TE" 2 "mit MVAC" 3 "mit TE+MVAC" /end COMPU_VTAB
/begin COMPU_METHOD FORMULA_0831 "FORMULA_0831" RAT_FUNC "%7.2" "Upm/s" COEFFS 0 16 0 0 0 200 /end COMPU_METHOD
/begin COMPU_METHOD FORMULA_0832 "FORMULA_0832" RAT_FUNC "%6.1" "�/ASP" COEFFS 0 10 0 0 0 1 /end COMPU_METHOD
/begin COMPU_METHOD FORMULA_0833 "FORMULA_0833" RAT_FUNC "%8.3" "sec" COEFFS 0 1000 0 0 0 1 /end COMPU_METHOD
/begin COMPU_METHOD FORMULA_0834 "FORMULA_0834" RAT_FUNC "%7.2" "Nm/kmh" COEFFS 0 100 0 0 0 1 /end COMPU_METHOD
/* ------------------ Abschnitt erzeugt aus llr.dat ------------------ */
/begin CHARACTERISTIC K_LLR_CFG_N_NACHF "Konfiguration nachgef. nSoll" VALUE 0x7497C TKW_VV_VV_UB 100.0 FORMULA_0744 0.0 255.0 /end CHARACTERISTIC
/begin CHARACTERISTIC K_LLR_CFG_MIN "Konfiguration Begr Min-Moment" VALUE 0x7497D TKW_VV_VV_UB 100.0 FORMULA_0745 0.0 255.0 /end CHARACTERISTIC
/begin CHARACTERISTIC K_LLR_N_EINGEREGELT "Schwelle fuer n eingeregelt | EN: Schwelle fuer n eingeregelt" VALUE 0x7497E TKW_VV_VV_UB 100.0 FORMULA_0746 0.0 100.0000 /end CHARACTERISTIC
/begin CHARACTERISTIC K_LLR_N_SOLL_TAU "Filter Solldrehzahl | EN: Filter Solldrehzahl" VALUE 0x7497F TKW_VV_VV_UB 100.0 FORMULA_0679 0.1004 25.6000 /end CHARACTERISTIC
/begin CHARACTERISTIC K_LLR_N_OFFSET_B1 "Offset fuer Start IA_B1 | EN: Offset fuer Start IA_B1" VALUE 0x74980 TKW_VV_VV_SW 100.0 FORMULA_0006 0.0 10000.0000 /end CHARACTERISTIC
/begin CHARACTERISTIC K_LLR_N_OFFSET_B2 "Offset fuer Start IA_B2 | EN: Offset fuer Start IA_B2" VALUE 0x74982 TKW_VV_VV_SW 100.0 FORMULA_0006 0.0 10000.0000 /end CHARACTERISTIC
/begin CHARACTERISTIC K_LLR_PWG_ANFAHR "PWG-Schwelle" VALUE 0x74984 TKW_VV_VV_SW 100.0 FORMULA_0001 -10.0000 120.0000 FORMAT "%4.1" /end CHARACTERISTIC
/begin CHARACTERISTIC K_LLR_N_KATH_AUFR "Kath-Aufregelrampe" VALUE 0x74986 TKW_VV_VV_UW 100.0 FORMULA_0747 0.0 655350.0000 /end CHARACTERISTIC
/begin CHARACTERISTIC K_LLR_N_KATH_ABR "Kath-Abregelrampe" VALUE 0x74988 TKW_VV_VV_UW 100.0 FORMULA_0747 0.0 655350.0000 /end CHARACTERISTIC
/begin CHARACTERISTIC K_LLR_N_SOLL_AC_OFFSET "Offset durch Klima | EN: Offset durch Klima" VALUE 0x7498A TKW_VV_VV_SW 100.0 FORMULA_0006 0.0 10000.0000 /end CHARACTERISTIC
/begin CHARACTERISTIC K_LLR_N_SOLL_ZH_OFFSET "Offset durch Zusatzheizung | EN: Offset durch Zusatzheizung" VALUE 0x7498C TKW_VV_VV_SW 100.0 FORMULA_0006 0.0 10000.0000 /end CHARACTERISTIC
/begin CHARACTERISTIC K_LLR_N_SOLL_MIN "min. Solldrehzahl | EN: min. Solldrehzahl" VALUE 0x7498E TKW_VV_VV_SW 100.0 FORMULA_0006 0.0 10000.0000 /end CHARACTERISTIC
/begin CHARACTERISTIC K_LLR_N_SOLL_MAX "max. Solldrehzahl | EN: max. Solldrehzahl" VALUE 0x74990 TKW_VV_VV_SW 100.0 FORMULA_0006 0.0 10000.0000 /end CHARACTERISTIC
/begin CHARACTERISTIC K_LLR_N_SOLL_NF_FAKTOR "Faktor Nachf�hrsolldrehzahl | EN: Faktor Nachführsolldrehzahl" VALUE 0x74992 TKW_VV_VV_UW 100.0 FORMULA_0075 0.0 4.0000 FORMAT "%6.3" /end CHARACTERISTIC
/begin CHARACTERISTIC K_LLR_N_SOLL_NF_MAX "max. Nachf�hrsolldrehzahl | EN: max. Nachführsolldrehzahl" VALUE 0x74994 TKW_VV_VV_SW 100.0 FORMULA_0006 0.0 10000.0000 /end CHARACTERISTIC
/begin CHARACTERISTIC K_LLR_IA_B1_ABR "Absteuerrampe B1 | EN: Absteuerrampe B1" VALUE 0x74996 TKW_VV_VV_UB 100.0 FORMULA_0748 0.0 255.0000 /end CHARACTERISTIC
/begin CHARACTERISTIC K_LLR_IA_B2_ABR "Absteuerrampe B2 | EN: Absteuerrampe B2" VALUE 0x74997 TKW_VV_VV_UB 100.0 FORMULA_0748 0.0 255.0000 /end CHARACTERISTIC
/begin CHARACTERISTIC K_LLR_MD_OKS_MIN "min. I-Anteil oKS | EN: min. I-Anteil oKS" VALUE 0x74998 TKW_VV_VV_SW 100.0 FORMULA_0009 -150.0000 0.0 FORMAT "%4.1" /end CHARACTERISTIC
/begin CHARACTERISTIC K_LLR_MD_OKS_MAX "max. I-Anteil oKS | EN: max. I-Anteil oKS" VALUE 0x7499A TKW_VV_VV_SW 100.0 FORMULA_0009 0.0 150.0000 FORMAT "%4.1" /end CHARACTERISTIC
/begin CHARACTERISTIC K_LLR_MD_MKS_MIN "min. I-Anteil mKS | EN: min. I-Anteil mKS" VALUE 0x7499C TKW_VV_VV_SW 100.0 FORMULA_0009 -150.0000 0.0 FORMAT "%4.1" /end CHARACTERISTIC
/begin CHARACTERISTIC K_LLR_MD_MKS_MAX "max. I-Anteil mKS | EN: max. I-Anteil mKS" VALUE 0x7499E TKW_VV_VV_SW 100.0 FORMULA_0009 0.0 150.0000 FORMAT "%4.1" /end CHARACTERISTIC
/begin CHARACTERISTIC K_LLR_D_GRAD "Aktivieren D-Anteil | EN: Activate derivative share [Upm/s]" VALUE 0x749A0 TKW_VV_VV_SW 100.0 FORMULA_0114 -10000.0000 10000.0000 /end CHARACTERISTIC
/begin CHARACTERISTIC K_LLR_D_OFFSET "Aktivieren D-Anteil | EN: Activate derivative share [Upm]" VALUE 0x749A2 TKW_VV_VV_SW 100.0 FORMULA_0006 0.0 10000.0000 /end CHARACTERISTIC
/begin CHARACTERISTIC K_LLR_N_RESET "Resetschwelle | EN: Resetschwelle" VALUE 0x749A4 TKW_VV_VV_SW 100.0 FORMULA_0006 0.0 10000.0000 /end CHARACTERISTIC
/begin CHARACTERISTIC K_LLR_MD_D_MIN "min. D-Anteil | EN: Minimum derivative share [Nm]" VALUE 0x749A6 TKW_VV_VV_SW 100.0 FORMULA_0009 -100.0000 1000.0000 FORMAT "%4.1" /end CHARACTERISTIC
/begin CHARACTERISTIC K_LLR_MD_D_MAX "max. D-Anteil oKS | EN: Maximum derivative share, clutch open [Nm]" VALUE 0x749A8 TKW_VV_VV_SW 100.0 FORMULA_0009 -100.0000 1000.0000 FORMAT "%4.1" /end CHARACTERISTIC
/begin CHARACTERISTIC K_LLR_N_KATH_HYS "n-Sollsprung ohne Rampe beim KH" VALUE 0x749AA TKW_VV_VV_SW 100.0 FORMULA_0006 0.0 10000.0000 /end CHARACTERISTIC
/begin CHARACTERISTIC K_LLR_OMEGA_TAU "Omega-Tau | EN: Omega-Tau" VALUE 0x749AC TKW_VV_VV_UB 100.0 FORMULA_0478 0.0051 1.2800 /end CHARACTERISTIC
/begin CHARACTERISTIC K_LLR_MD_RES_AUFR "Rampe fuer Reserve | EN: Rampe fuer Reserve" VALUE 0x749AD TKW_VV_VV_UB 100.0 FORMULA_0748 0.0 255.0000 /end CHARACTERISTIC
/begin CHARACTERISTIC K_LLR_MD_RES_WAIT "Wartezeit fuer Reserve | EN: Wartezeit fuer Reserve" VALUE 0x749AE TKW_VV_VV_UW 100.0 FORMULA_0021 0.0 655.0000 FORMAT "%5.2" /end CHARACTERISTIC
/begin CHARACTERISTIC K_LLR_MD_TZ_TAU "Filter LLR TZ-Eingriff | EN: Filter LLR TZ-Eingriff" VALUE 0x749B0 TKW_VV_VV_UB 100.0 FORMULA_0679 0.1004 25.6000 /end CHARACTERISTIC
/begin CHARACTERISTIC K_LLR_MD_TZ_RUECK_HYS "Hysterese TZ-Rueckfuehrung | EN: Hysterese TZ-Rueckfuehrung" VALUE 0x749B1 TKW_VV_VV_UB 100.0 FORMULA_0749 0.1000 20.0000 /end CHARACTERISTIC
/begin CHARACTERISTIC K_LLR_MD_TZ_RUECK_POS "Positive TZ-Rueckfuehrung | EN: Positive TZ-Rueckfuehrung" VALUE 0x749B2 TKW_VV_VV_SW 100.0 FORMULA_0750 0.0 15.0000 FORMAT "%7.4" /end CHARACTERISTIC
/begin CHARACTERISTIC K_LLR_MD_TZ_RUECK_NEG "Negative TZ-Rueckfuehrung | EN: Negative TZ-Rueckfuehrung" VALUE 0x749B4 TKW_VV_VV_SW 100.0 FORMULA_0750 0.0 15.0000 FORMAT "%7.4" /end CHARACTERISTIC
/begin CHARACTERISTIC K_LLR_TIME_FILOFF "Sperrzeit fuer KH-Filter" VALUE 0x749B6 TKW_VV_VV_UW 100.0 FORMULA_0021 0.0 655.0000 FORMAT "%5.2" /end CHARACTERISTIC
/begin CHARACTERISTIC K_LLR_DIAG_TMOT "Tmot-Schwelle | EN: Tmot-Schwelle" VALUE 0x749B8 TKW_VV_VV_SW 100.0 FORMULA_0023 -50.0000 170.0000 FORMAT "%4.1" /end CHARACTERISTIC
/begin CHARACTERISTIC K_LLR_DIAG_TOEL "Toel-Schwelle | EN: Toel-Schwelle" VALUE 0x749BA TKW_VV_VV_SW 100.0 FORMULA_0023 -50.0000 170.0000 FORMAT "%4.1" /end CHARACTERISTIC
/begin CHARACTERISTIC K_LLR_DIAG_FRA_MIN "min. Leckluftadaption" VALUE 0x749BC TKW_VV_VV_SW 100.0 FORMULA_0422 -50.0000 0.0 FORMAT "%5.2" /end CHARACTERISTIC
/begin CHARACTERISTIC K_LLR_DIAG_FRA_MAX "max. Leckluftadaption" VALUE 0x749BE TKW_VV_VV_SW 100.0 FORMULA_0422 0.0 50.0000 FORMAT "%5.2" /end CHARACTERISTIC
/begin CHARACTERISTIC K_LLR_DIAG_MD_FAK "Faktor auf min. Moment" VALUE 0x749C0 TKW_VV_VV_UW 100.0 FORMULA_0075 0.0 4.0000 FORMAT "%6.3" /end CHARACTERISTIC
/begin CHARACTERISTIC K_LLR_DIAG_MD_ERR_ABR "Absteuerrampe Fehlerfall | EN: Absteuerrampe Fehlerfall" VALUE 0x749C2 TKW_VV_VV_UB 100.0 FORMULA_0748 0.0 255.0000 /end CHARACTERISTIC
/begin CHARACTERISTIC K_LLR_DIAG_T "Diagnosezeit | EN: Diagnosezeit" VALUE 0x749C3 TKW_VV_VV_UB 100.0 FORMULA_0501 0.0 25.5000 /end CHARACTERISTIC
/begin CHARACTERISTIC K_LLR_DIAG_T_IO "Diagnosezeit iO" VALUE 0x749C4 TKW_VV_VV_UB 100.0 FORMULA_0501 0.0 25.5000 /end CHARACTERISTIC
/begin CHARACTERISTIC K_LLR_DIAG_N_ZU_GROSS "Schwelle fuer n zu gross | EN: Schwelle fuer n zu gross" VALUE 0x749C5 TKW_VV_VV_UB 100.0 FORMULA_0746 0.0 250.0000 /end CHARACTERISTIC
/begin CHARACTERISTIC K_LLR_DIAG_N_ZU_KLEIN "Schwelle fuer n zu klein | EN: Schwelle fuer n zu klein" VALUE 0x749C6 TKW_VV_VV_UB 100.0 FORMULA_0746 0.0 250.0000 /end CHARACTERISTIC
/begin CHARACTERISTIC K_LLR_DIAG_CSS_TMOT "Tmot-Schwelle | EN: Tmot-Schwelle" VALUE 0x749C8 TKW_VV_VV_SW 100.0 FORMULA_0023 -50.0000 170.0000 FORMAT "%4.1" /end CHARACTERISTIC
/begin CHARACTERISTIC K_LLR_DIAG_CSS_TOEL "Toel-Schwelle | EN: Toel-Schwelle" VALUE 0x749CA TKW_VV_VV_SW 100.0 FORMULA_0023 -50.0000 170.0000 FORMAT "%4.1" /end CHARACTERISTIC
/begin CHARACTERISTIC K_LLR_DIAG_CSS_N_ZU_GROSS "Schwelle fuer n zu gross | EN: Schwelle fuer n zu gross" VALUE 0x749CC TKW_VV_VV_UB 100.0 FORMULA_0746 0.0 250.0000 /end CHARACTERISTIC
/begin CHARACTERISTIC K_LLR_DIAG_CSS_N_ZU_KLEIN "Schwelle fuer n zu klein | EN: Schwelle fuer n zu klein" VALUE 0x749CD TKW_VV_VV_UB 100.0 FORMULA_0746 0.0 250.0000 /end CHARACTERISTIC
/begin CHARACTERISTIC K_LLR_DIAG_CSS_T "Diagnosezeit | EN: Diagnosezeit" VALUE 0x749CE TKW_VV_VV_UB 100.0 FORMULA_0501 0.0 25.5000 /end CHARACTERISTIC
/begin CHARACTERISTIC K_LLR_DIAG_CSS_T_IO "Diagnosezeit iO" VALUE 0x749CF TKW_VV_VV_UB 100.0 FORMULA_0501 0.0 25.5000 /end CHARACTERISTIC
/begin CHARACTERISTIC KL_LLR_N_SOLL_TMOT "Leerlaufdrehzahl ueber Tmot | EN: Idle speed over engine temperature" CURVE 0x749D0 TKL_SW_VV_SW 100.0 FORMULA_0006 0.0 10000.0000
 /begin AXIS_DESCR STD_AXIS tmot FORMULA_0023 8 -50.0000 170.0000 FORMAT "%4.1" /end AXIS_DESCR
/end CHARACTERISTIC
/begin CHARACTERISTIC KL_LLR_N_SOLL_TOEL_OFF "Offset ueber Toel | EN: Offset over oil temperature" CURVE 0x749F2 TKL_SW_VV_SW 100.0 FORMULA_0006 0.0 10000.0000
 /begin AXIS_DESCR STD_AXIS toel FORMULA_0023 8 -50.0000 170.0000 FORMAT "%4.1" /end AXIS_DESCR
/end CHARACTERISTIC
/begin CHARACTERISTIC KL_LLR_D_FAK_TOEL "D-Anteil | EN: Derivative share" CURVE 0x74A14 TKL_SW_VV_UW 100.0 FORMULA_0075 0.0 4.0000
 /begin AXIS_DESCR STD_AXIS toel FORMULA_0023 8 -50.0000 170.0000 FORMAT "%4.1" /end AXIS_DESCR
 FORMAT "%6.3" /end CHARACTERISTIC
/begin CHARACTERISTIC KL_LLR_MD_RES_TMOT "Reserve ueber Tmot | EN: Reserve over engine temperature" CURVE 0x74A36 TKL_SW_VV_SW 100.0 FORMULA_0009 0.0 100.0000
 /begin AXIS_DESCR STD_AXIS tmot FORMULA_0023 8 -50.0000 170.0000 FORMAT "%4.1" /end AXIS_DESCR
 FORMAT "%4.1" /end CHARACTERISTIC
/begin CHARACTERISTIC KL_LLR_MD_TZ_OKS "LLR TZ-Eingriff | EN: Idle controller ignition intervention" CURVE 0x74A58 TKL_SW_VV_SW 100.0 FORMULA_0009 -40.0000 40.0000 /begin AXIS_DESCR STD_AXIS llr_n_diff FORMULA_0006 9 -500.0000 500.0000 /end AXIS_DESCR FORMAT "%4.1" /end CHARACTERISTIC
/begin CHARACTERISTIC KL_LLR_MD_TZ_MKS "LLR TZ-Eingriff | EN: LLR TZ-Eingriff" CURVE 0x74A7E TKL_SW_VV_SW 100.0 FORMULA_0009 -40.0000 40.0000 /begin AXIS_DESCR STD_AXIS llr_n_diff FORMULA_0006 9 -500.0000 500.0000 /end AXIS_DESCR FORMAT "%4.1" /end CHARACTERISTIC
/begin CHARACTERISTIC KL_LLR_MD_TZ_OKS_KH "LLR TZ-Eingriff bei KH | EN: LLR TZ-Eingriff bei KH" CURVE 0x74AA4 TKL_SW_VV_SW 100.0 FORMULA_0009 -40.0000 40.0000 /begin AXIS_DESCR STD_AXIS llr_n_diff FORMULA_0006 9 -500.0000 500.0000 /end AXIS_DESCR FORMAT "%4.1" /end CHARACTERISTIC
/begin CHARACTERISTIC KL_LLR_MD_TZ_MKS_KH "LLR TZ-Eingriff bei KH | EN: Idle controller ignition intervention during catalyst heating" CURVE 0x74ACA TKL_SW_VV_SW 100.0 FORMULA_0009 -40.0000 40.0000 /begin AXIS_DESCR STD_AXIS llr_n_diff FORMULA_0006 9 -500.0000 500.0000 /end AXIS_DESCR FORMAT "%4.1" /end CHARACTERISTIC
/begin CHARACTERISTIC KF_LLR_MD_I_POS_OKS "I-Anteil bei pos. Abweichung | EN: Integral share for positive deviation" MAP 0x74AF0 TKF_SW_SW_SW 100.0 FORMULA_0751 -50.0000 50.0000 /begin AXIS_DESCR STD_AXIS llr_n_diff FORMULA_0006 8 0.0 5000.0000 /end AXIS_DESCR /begin AXIS_DESCR STD_AXIS n_grad_asp FORMULA_0114 12 -10000.0000 10000.0000 /end AXIS_DESCR FORMAT "%4.1" /end CHARACTERISTIC
/begin CHARACTERISTIC KF_LLR_MD_I_NEG_OKS "I-Anteil bei neg. Abweichung | EN: Integral share for negative deviation" MAP 0x74BDA TKF_SW_SW_SW 100.0 FORMULA_0751 -50.0000 50.0000 /begin AXIS_DESCR STD_AXIS llr_n_diff FORMULA_0006 8 -5000.0000 0.0 /end AXIS_DESCR /begin AXIS_DESCR STD_AXIS n_grad_asp FORMULA_0114 12 -10000.0000 10000.0000 /end AXIS_DESCR FORMAT "%4.1" /end CHARACTERISTIC
/begin CHARACTERISTIC KF_LLR_MD_I_POS_MKS "I-Anteil bei pos. Abweichung | EN: Integral share for positive deviation" MAP 0x74CC4 TKF_SW_SW_SW 100.0 FORMULA_0751 -50.0000 50.0000 /begin AXIS_DESCR STD_AXIS llr_n_diff FORMULA_0006 8 0.0 5000.0000 /end AXIS_DESCR /begin AXIS_DESCR STD_AXIS n_grad_asp FORMULA_0114 12 -10000.0000 10000.0000 /end AXIS_DESCR FORMAT "%4.1" /end CHARACTERISTIC
/begin CHARACTERISTIC KF_LLR_MD_I_NEG_MKS "I-Anteil bei neg. Abweichung | EN: Integral share for negative deviation" MAP 0x74DAE TKF_SW_SW_SW 100.0 FORMULA_0751 -50.0000 50.0000 /begin AXIS_DESCR STD_AXIS llr_n_diff FORMULA_0006 8 -5000.0000 0.0 /end AXIS_DESCR /begin AXIS_DESCR STD_AXIS n_grad_asp FORMULA_0114 12 -10000.0000 10000.0000 /end AXIS_DESCR FORMAT "%4.1" /end CHARACTERISTIC
/begin CHARACTERISTIC KF_LLR_N_SOLL_KH_OFF "Offset ueber Katheizen und Kat | EN: I-Anteil bei neg. Abweichung" MAP 0x74E98 TKF_SW_SW_SW 100.0 FORMULA_0006 0.0 10000.0000
 /begin AXIS_DESCR STD_AXIS tmot FORMULA_0023 6 -50.0000 170.0000 FORMAT "%4.1" /end AXIS_DESCR
 /begin AXIS_DESCR STD_AXIS kat_obd_wert_nv FORMULA_0025 4 0.0 1.9000 FORMAT "%6.3" /end AXIS_DESCR
/end CHARACTERISTIC
/begin CHARACTERISTIC K_LLR_ERR_MAX_E2 "max. Fehler LLR Ebene 2 | EN: max. Fehler LLR Ebene 2" VALUE 0x7A53E TKW_VV_VV_UB 100.0 FORMULA_0003 0.0 255.0000 /end CHARACTERISTIC
/begin CHARACTERISTIC K_LLR_DMD_MAX_E2 "Rampe max. I-Anteil Ebene 2 | EN: Rampe max. I-Anteil Ebene 2" VALUE 0x7A53F TKW_VV_VV_UB 100.0 FORMULA_0748 0.0 255.0000 /end CHARACTERISTIC
/begin CHARACTERISTIC K_LLR_MD_MIN_E2 "min. I-Anteil Ebene 2 | EN: min. I-Anteil Ebene 2" VALUE 0x7A540 TKW_VV_VV_SW 100.0 FORMULA_0009 -150.0000 0.0 FORMAT "%4.1" /end CHARACTERISTIC
/begin CHARACTERISTIC K_LLR_MD_MAX_E2 "max. I-Anteil Ebene 2 | EN: Maximum integral share, level 2 [Nm]" VALUE 0x7A542 TKW_VV_VV_SW 100.0 FORMULA_0009 0.0 1000.0000 FORMAT "%4.1" /end CHARACTERISTIC
/begin CHARACTERISTIC K_LLR_N_DIFF_MAX_E2 "Schwelle Max-Rampe Ebene 2 | EN: Threshold for maximum ramp, level 2 [Upm]" VALUE 0x7A544 TKW_VV_VV_SW 100.0 FORMULA_0006 -5000.0000 5000.0000 /end CHARACTERISTIC
/begin CHARACTERISTIC K_LLR_N_SOLL_NF_FAKTOR_E2 "Faktor Nachf�hrsolldrehzahl Ebene 2 | EN: Factor for tracking target speed, level 2" VALUE 0x7A546 TKW_VV_VV_UW 100.0 FORMULA_0075 0.0 4.0000 FORMAT "%6.3" /end CHARACTERISTIC
/begin CHARACTERISTIC K_LLR_N_SOLL_NF_MAX_E2 "max. Nachf�hrsolldrehzahl Ebene 2 | EN: Maximum tracking target speed, level 2 [Upm]" VALUE 0x7A548 TKW_VV_VV_SW 100.0 FORMULA_0006 0.0 10000.0000 /end CHARACTERISTIC
/begin CHARACTERISTIC KL_LLR_N_SOLL_TMOT_E2 "Leerlaufdrehzahl Ebene 2 | EN: Idle speed, level 2 (monitoring)" CURVE 0x7A54A TKL_SW_VV_SW 100.0 FORMULA_0006 0.0 10000.0000
 /begin AXIS_DESCR STD_AXIS tmot FORMULA_0023 4 -50.0000 170.0000 FORMAT "%4.1" /end AXIS_DESCR
/end CHARACTERISTIC
/begin MEASUREMENT llr_diag_state "Diagnose Status" UBYTE FORMULA_0739 0 0 0.0 255.0 ECU_ADDRESS 0x3FBE39 /end MEASUREMENT
/begin MEASUREMENT llr_exd_state "Exd-State" UBYTE FORMULA_0740 0 0 0.0 255.0 ECU_ADDRESS 0x3FBE3A /end MEASUREMENT
/begin MEASUREMENT llr_diag_flags "Diagnose Flags" UBYTE FORMULA_0003 0 0 0.0 255.0000 ECU_ADDRESS 0x3FBE3B /end MEASUREMENT
/begin MEASUREMENT llr_diag_flags_css "Diagnose Flags" UBYTE FORMULA_0741 0 0 0.0 255.0 ECU_ADDRESS 0x3FBE3B BIT_MASK 0x1 /end MEASUREMENT
/begin MEASUREMENT llr_n_soll_tmot "Tmot-Einfluss" SWORD FORMULA_0006 0 0 0.0 10000.0000 ECU_ADDRESS 0x3FBE3C /end MEASUREMENT
/begin MEASUREMENT llr_n_soll_toel "Toel-Einfluss" SWORD FORMULA_0006 0 0 0.0 10000.0000 ECU_ADDRESS 0x3FBE3E /end MEASUREMENT
/begin MEASUREMENT llr_n_soll_kkos "Tmot, Toel und KKOS-Einfluss" SWORD FORMULA_0006 0 0 0.0 10000.0000 ECU_ADDRESS 0x3FBE40 /end MEASUREMENT
/begin MEASUREMENT llr_n_soll_exd "Exd-Solldrehzahl" SWORD FORMULA_0006 0 0 0.0 10000.0000 ECU_ADDRESS 0x3FBE42 /end MEASUREMENT
/begin MEASUREMENT llr_n_soll_kh "KH-Einfluss" SWORD FORMULA_0006 0 0 0.0 10000.0000 ECU_ADDRESS 0x3FBE44 /end MEASUREMENT
/begin MEASUREMENT llr_n_soll_kh_fil "KH-Einfluss gefiltert" SWORD FORMULA_0006 0 0 0.0 10000.0000 ECU_ADDRESS 0x3FBE46 /end MEASUREMENT
/begin MEASUREMENT llr_n_soll_fil "gefilt. Leerlaufsolldrehzahl" SWORD FORMULA_0006 0 0 0.0 10000.0000 ECU_ADDRESS 0x3FBE48 /end MEASUREMENT
/begin MEASUREMENT llr_n_soll_nachf "nachgef�hrte Leerlaufsolldrehzahl" SWORD FORMULA_0006 0 0 0.0 10000.0000 ECU_ADDRESS 0x3FBE4A /end MEASUREMENT
/begin MEASUREMENT llr_n_diff "Regeldifferenz" SWORD FORMULA_0006 0 0 -10000.0000 10000.0000 ECU_ADDRESS 0x3FBE4C /end MEASUREMENT
/begin MEASUREMENT llr_n_diff_nachf "nachgef. Regeldifferenz" SWORD FORMULA_0006 0 0 -10000.0000 10000.0000 ECU_ADDRESS 0x3FBE4E /end MEASUREMENT
/begin MEASUREMENT llr_md_i_min "min. I-Anteil" SWORD FORMULA_0009 0 0 -100.0000 0.0 ECU_ADDRESS 0x3FBE50 /end MEASUREMENT
/begin MEASUREMENT llr_md_i_max "max. I-Anteil" SWORD FORMULA_0009 0 0 -100.0000 0.0 ECU_ADDRESS 0x3FBE52 /end MEASUREMENT
/begin MEASUREMENT llr_md_p "P-Anteil (inaktiv)" SWORD FORMULA_0009 0 0 -50.0000 50.0000 ECU_ADDRESS 0x3FBE54 /end MEASUREMENT
/begin MEASUREMENT llr_md_i "I-Anteil" SWORD FORMULA_0009 0 0 -50.0000 50.0000 ECU_ADDRESS 0x3FBE56 /end MEASUREMENT
/begin MEASUREMENT llr_md_d_roh "einmaliger D-Anteil ohne Begr" SWORD FORMULA_0009 0 0 -50.0000 50.0000 ECU_ADDRESS 0x3FBE5C /end MEASUREMENT
/begin MEASUREMENT llr_md_d "einmaliger D-Anteil" SWORD FORMULA_0009 0 0 -50.0000 50.0000 ECU_ADDRESS 0x3FBE5E /end MEASUREMENT
/begin MEASUREMENT llr_md_res "LLR-Reserve" SWORD FORMULA_0009 0 0 0.0 100.0000 ECU_ADDRESS 0x3FBE60 /end MEASUREMENT
/begin MEASUREMENT llr_md_tz "LLR TZ-Eingriff" SWORD FORMULA_0009 0 0 -40.0000 40.0000 ECU_ADDRESS 0x3FBE62 /end MEASUREMENT
/begin MEASUREMENT llr_omega_grad_ist "Omega" SWORD FORMULA_0742 0 0 -327.6800 327.6700 ECU_ADDRESS 0x3FBE64 /end MEASUREMENT
/begin MEASUREMENT llr_md_schw_ist "Istmoment" SWORD FORMULA_0009 0 0 -100.0000 1000.0000 ECU_ADDRESS 0x3FBE66 /end MEASUREMENT
/begin MEASUREMENT llr_md_tz_fil "LLR TZ-Eingriff gefiltert" SWORD FORMULA_0009 0 0 -40.0000 40.0000 ECU_ADDRESS 0x3FBE68 /end MEASUREMENT
/begin MEASUREMENT llr_md_tz_rueck "LLR TZ-Rueckfuehrung" SWORD FORMULA_0743 0 0 -15.0000 15.0000 ECU_ADDRESS 0x3FBE6A /end MEASUREMENT
/begin MEASUREMENT llr_timer "interner LLR-Timer" UBYTE FORMULA_0352 0 0 0.0 1.2750 ECU_ADDRESS 0x3FBE6C /end MEASUREMENT
/begin MEASUREMENT llr_diag_timer "Diagnose-Timer" UBYTE FORMULA_0501 0 0 0.0 25.5000 ECU_ADDRESS 0x3FBE6D /end MEASUREMENT
/begin MEASUREMENT llr_diag_timer_io "Diagnose-Timer iO" UBYTE FORMULA_0501 0 0 0.0 25.5000 ECU_ADDRESS 0x3FBE6E /end MEASUREMENT
/begin MEASUREMENT llr_plausi_e2_err "Anzahl der Plausi-Fehler" UBYTE FORMULA_0003 0 0 0.0 255.0000 ECU_ADDRESS 0x3FC760 /end MEASUREMENT
/begin MEASUREMENT llr_n_soll_diff_e2 "Regeldifferenz Ebene 2" SWORD FORMULA_0006 0 0 0.0 10000.0000 ECU_ADDRESS 0x3FC762 /end MEASUREMENT
/begin MEASUREMENT llr_md_i_max_e2 "max. I-Anteil Ebene 2" SWORD FORMULA_0009 0 0 -100.0000 1000.0000 ECU_ADDRESS 0x3FC764 /end MEASUREMENT
/* ------------------ Abschnitt erzeugt aus llr_ad.dat ------------------ */
/begin CHARACTERISTIC K_LLR_AD_CFG "Konfiguration | EN: 0x0 Aus 0x1 Ein 0x2 Ein o.TE 0xff Init Konfiguration" VALUE 0x74EDE TKW_VV_VV_UB 100.0 FORMULA_0753 0.0 255.0 /end CHARACTERISTIC
/begin CHARACTERISTIC K_LLR_AD_I_TAU "Filterzeit | EN: Filterzeit" VALUE 0x74EDF TKW_VV_VV_UB 100.0 FORMULA_0754 1.0040 256.0000 /end CHARACTERISTIC
/begin CHARACTERISTIC K_LLR_AD_TMOT "Tmot-Schwelle | EN: Tmot-Schwelle" VALUE 0x74EE0 TKW_VV_VV_SW 100.0 FORMULA_0023 -50.0000 170.0000 FORMAT "%4.1" /end CHARACTERISTIC
/begin CHARACTERISTIC K_LLR_AD_TOEL "Toel-Schwelle | EN: Toel-Schwelle" VALUE 0x74EE2 TKW_VV_VV_SW 100.0 FORMULA_0023 -50.0000 170.0000 FORMAT "%4.1" /end CHARACTERISTIC
/begin CHARACTERISTIC K_LLR_AD_N_HYS_POS "positiver Offset | EN: positiver Offset" VALUE 0x74EE4 TKW_VV_VV_SW 100.0 FORMULA_0006 0.0 500.0000 /end CHARACTERISTIC
/begin CHARACTERISTIC K_LLR_AD_N_HYS_NEG "negativer Offset | EN: negativer Offset" VALUE 0x74EE6 TKW_VV_VV_SW 100.0 FORMULA_0006 -500.0000 0.0 /end CHARACTERISTIC
/begin CHARACTERISTIC K_LLR_AD_TIME_STABIL "Stabilisierzeit | EN: Stabilisierzeit" VALUE 0x74EE8 TKW_VV_VV_UW 100.0 FORMULA_0073 0.0 6553.5000 FORMAT "%4.1" /end CHARACTERISTIC
/begin CHARACTERISTIC K_LLR_AD_UMSCHALT_RAMPE "Umschaltrampe | EN: Umschaltrampe" VALUE 0x74EEA TKW_VV_VV_SW 100.0 FORMULA_0755 -3000.0000 25.0000 FORMAT "%4.1" /end CHARACTERISTIC
/begin CHARACTERISTIC K_LLR_AD_NORM_MIN "Minwert normal | EN: Minwert normal" VALUE 0x74EEC TKW_VV_VV_SW 100.0 FORMULA_0009 -25.0000 0.0 FORMAT "%4.1" /end CHARACTERISTIC
/begin CHARACTERISTIC K_LLR_AD_NORM_MAX "Maxwert normal | EN: Maxwert normal" VALUE 0x74EEE TKW_VV_VV_SW 100.0 FORMULA_0009 0.0 25.0000 FORMAT "%4.1" /end CHARACTERISTIC
/begin CHARACTERISTIC K_LLR_AD_AC_MIN "Minwert Klima | EN: Minwert Klima" VALUE 0x74EF0 TKW_VV_VV_SW 100.0 FORMULA_0009 -25.0000 0.0 FORMAT "%4.1" /end CHARACTERISTIC
/begin CHARACTERISTIC K_LLR_AD_AC_MAX "Maxwert Klima | EN: Maxwert Klima" VALUE 0x74EF2 TKW_VV_VV_SW 100.0 FORMULA_0009 0.0 25.0000 FORMAT "%4.1" /end CHARACTERISTIC
/begin CHARACTERISTIC K_LLR_AD_MD_GRAD "�nderungsbegrenzung | EN: Änderungsbegrenzung" VALUE 0x74EF4 TKW_VV_VV_SW 100.0 FORMULA_0755 -3000.0000 25.0000 FORMAT "%4.1" /end CHARACTERISTIC
/begin CHARACTERISTIC K_LLR_AD_I_ANTEIL_OFF "Restwert I-Anteil | EN: Restwert I-Anteil" VALUE 0x74EF6 TKW_VV_VV_SW 100.0 FORMULA_0009 -25.0000 0.0 FORMAT "%4.1" /end CHARACTERISTIC
/begin CHARACTERISTIC K_LLR_AD_MD_ZYKLUS_MAX "max. �nderung pro Zyklus | EN: max. Änderung pro Zyklus" VALUE 0x74EF8 TKW_VV_VV_SW 100.0 FORMULA_0009 0.0 25.0000 FORMAT "%4.1" /end CHARACTERISTIC
/begin CHARACTERISTIC K_LLR_AD_MD_NEUZUSTAND "Werte Neuzustand | EN: Werte Neuzustand" VALUE 0x74EFA TKW_VV_VV_SW 100.0 FORMULA_0009 -50.0000 50.0000 FORMAT "%4.1" /end CHARACTERISTIC
/begin MEASUREMENT llr_ad_zustand "Zustand" UBYTE FORMULA_0752 0 0 0.0 255.0 ECU_ADDRESS 0x3FBE74 /end MEASUREMENT
/begin MEASUREMENT llr_ad_flags "Zustand" UBYTE FORMULA_0003 0 0 0.0 255.0000 ECU_ADDRESS 0x3FBE75 /end MEASUREMENT
/begin MEASUREMENT llr_ad_i_smooth "Mittelwert I-Anteil" SWORD FORMULA_0009 0 0 -50.0000 50.0000 ECU_ADDRESS 0x3FBE76 /end MEASUREMENT
/begin MEASUREMENT llr_ad_md "aktueller Adaptionwert" SWORD FORMULA_0009 0 0 -50.0000 50.0000 ECU_ADDRESS 0x3FBE78 /end MEASUREMENT
/begin MEASUREMENT llr_ad_timer "Timer" UWORD FORMULA_0073 0 0 0.0 6553.5000 ECU_ADDRESS 0x3FBE7A /end MEASUREMENT
/* ------------------ Abschnitt erzeugt aus lu.dat ------------------ */
/begin CHARACTERISTIC K_LU_WIN_START_B1 "Start Messfenster." VALUE 0x74EFC TKW_VV_VV_UB 100.0 FORMULA_0777 0.0 34.0000 /end CHARACTERISTIC
/begin CHARACTERISTIC K_LU_WIN_START_B2 "Start Messfenster." VALUE 0x74EFD TKW_VV_VV_UB 100.0 FORMULA_0777 0.0 34.0000 /end CHARACTERISTIC
/begin CHARACTERISTIC K_LU_WIN_LEN_B1 "Messfensterlaenge" VALUE 0x74EFE TKW_VV_VV_UB 100.0 FORMULA_0777 1.0000 24.0000 /end CHARACTERISTIC
/begin CHARACTERISTIC K_LU_WIN_LEN_B2 "Messfensterlaenge" VALUE 0x74EFF TKW_VV_VV_UB 100.0 FORMULA_0777 1.0000 24.0000 /end CHARACTERISTIC
/begin CHARACTERISTIC K_LU_WIN_PERIOD_B1 "Zykluswiederholung Messfenster." VALUE 0x74F00 TKW_VV_VV_UB 100.0 FORMULA_0777 1.0000 24.0000 /end CHARACTERISTIC
/begin CHARACTERISTIC K_LU_WIN_PERIOD_B2 "Zykluswiederholung Messfenster." VALUE 0x74F01 TKW_VV_VV_UB 100.0 FORMULA_0777 1.0000 24.0000 /end CHARACTERISTIC
/begin CHARACTERISTIC K_LU_ACT_N_MIN "Minimaldrehzahl LU-Aktiv" VALUE 0x74F02 TKW_VV_VV_SW 100.0 FORMULA_0006 0.0 10000.0000 /end CHARACTERISTIC
/begin CHARACTERISTIC K_LU_ACT_N_MAX "Maximaldrehzahl LU-Aktiv" VALUE 0x74F04 TKW_VV_VV_SW 100.0 FORMULA_0006 0.0 10000.0000 /end CHARACTERISTIC
/begin CHARACTERISTIC K_LU_ADAP_ENDE "Ende der Adaptionsschwellwert-Anhebung" VALUE 0x74F06 TKW_VV_VV_UW 100.0 FORMULA_0778 0.0 65535.0000 /end CHARACTERISTIC
/begin CHARACTERISTIC K_LU_ADAP_DELAY "Verzoegerung Adaptionsstart" VALUE 0x74F08 TKW_VV_VV_UB 100.0 FORMULA_0501 0.0 25.5000 /end CHARACTERISTIC
/begin CHARACTERISTIC K_LU_ADAP_GANG_MIN "Minimaler Gang LU-Adaption" VALUE 0x74F09 TKW_VV_VV_SB 100.0 FORMULA_0318 -1.0000 10.0000 /end CHARACTERISTIC
/begin CHARACTERISTIC K_LU_ADAP_LIMIT "Obere Grenze fuer LU-Adaptionswerte" VALUE 0x74F0A TKW_VV_VV_SW 100.0 FORMULA_0439 0.0 7.8000 FORMAT "%6.3" /end CHARACTERISTIC
/begin CHARACTERISTIC K_LU_ADAP_N_MAX "Maximaldrehzahl LU-Adaption" VALUE 0x74F0C TKW_VV_VV_SW 100.0 FORMULA_0006 0.0 10000.0000 /end CHARACTERISTIC
/begin CHARACTERISTIC K_LU_ADAP_N_MIN "Minimaldrehzahl LU-Adaption" VALUE 0x74F0E TKW_VV_VV_SW 100.0 FORMULA_0006 0.0 10000.0000 /end CHARACTERISTIC
/begin CHARACTERISTIC K_LU_ADAP_OFFS_B2 "Offset Geberrad-Adaption Bank2" VALUE 0x74F10 TKW_VV_VV_SW 100.0 FORMULA_0439 -7.8000 7.8000 FORMAT "%6.3" /end CHARACTERISTIC
/begin CHARACTERISTIC K_LU_AUSKUPPL_DELAY "Ausblendung nach Auskuppeln" VALUE 0x74F12 TKW_VV_VV_UB 100.0 FORMULA_0501 0.0 25.5000 /end CHARACTERISTIC
/begin CHARACTERISTIC K_LU_CFG "Konfiguration Laufunruhe" VALUE 0x74F13 TKW_VV_VV_UB 100.0 FORMULA_0779 0.0 255.0 /end CHARACTERISTIC
/begin CHARACTERISTIC K_LU_DSC_DELAY "Ausblendung nach DSC-Eingriff" VALUE 0x74F14 TKW_VV_VV_UB 100.0 FORMULA_0501 0.0 25.5000 /end CHARACTERISTIC
/begin CHARACTERISTIC K_LU_KKOS_DELAY "Ausblendung nach Schaltvorgang Klimakompressor" VALUE 0x74F15 TKW_VV_VV_UB 100.0 FORMULA_0501 0.0 25.5000 /end CHARACTERISTIC
/begin CHARACTERISTIC K_LU_KUPPL_DELAY "Ausblendung nach Einkuppeln" VALUE 0x74F16 TKW_VV_VV_UB 100.0 FORMULA_0501 0.0 25.5000 /end CHARACTERISTIC
/begin CHARACTERISTIC K_LU_MD_DELAY "Ausblendung bei MD-Delta" VALUE 0x74F17 TKW_VV_VV_UB 100.0 FORMULA_0501 0.0 25.5000 /end CHARACTERISTIC
/begin CHARACTERISTIC K_LU_N_MIN "Minimaldrehzahl LU-Modulstart" VALUE 0x74F18 TKW_VV_VV_SW 100.0 FORMULA_0006 0.0 10000.0000 /end CHARACTERISTIC
/begin CHARACTERISTIC K_LU_SA_DELAY "Ausblendung nach Zustand Schubabschaltung" VALUE 0x74F1A TKW_VV_VV_UB 100.0 FORMULA_0501 0.0 25.5000 /end CHARACTERISTIC
/begin CHARACTERISTIC K_LU_SCHW_EV_ERR "Kompensation LU-Schwelle EV-FEHLER" VALUE 0x74F1C TKW_VV_VV_UB 100.0 FORMULA_0780 0.0 7.9687 /end CHARACTERISTIC
/begin CHARACTERISTIC K_LU_START_DELAY "Motorlaufzeit Freigabe LU" VALUE 0x74F1E TKW_VV_VV_UW 100.0 FORMULA_0021 0.0 655.0000 FORMAT "%5.2" /end CHARACTERISTIC
/begin CHARACTERISTIC K_LU_TZ_DELAY "Ausblendung bei TZ-Delta" VALUE 0x74F20 TKW_VV_VV_UB 100.0 FORMULA_0774 0.0 255.0000 /end CHARACTERISTIC
/begin CHARACTERISTIC K_LU_TZ_DELTA "max. Zul. TZ-Delta" VALUE 0x74F22 TKW_VV_VV_SW 100.0 FORMULA_0781 0.0 60.0000 FORMAT "%4.1" /end CHARACTERISTIC
/begin CHARACTERISTIC KL_LU_ADAP_FILT "Adaptionsfilterkonstante Geberrad" CURVE 0x74F24 TKL_UW_VV_UW 100.0 FORMULA_0782 0.0 1.0000 /begin AXIS_DESCR STD_AXIS lu_adap_cnt FORMULA_0778 3 0.0 65535.0000 /end AXIS_DESCR FORMAT "%7.4" /end CHARACTERISTIC
/begin CHARACTERISTIC KL_LU_MD_DELTA_POS "Max. zul. positives WDK-DELTA" CURVE 0x74F32 TKL_SW_VV_SW 100.0 FORMULA_0773 -100.0000 250.0000
 /begin AXIS_DESCR STD_AXIS md FORMULA_0009 8 -100.0000 1000.0000 FORMAT "%4.1" /end AXIS_DESCR
 FORMAT "%4.1" /end CHARACTERISTIC
/begin CHARACTERISTIC KL_LU_MD_DELTA_NEG "Max. zul. negatives WDK-DELTA" CURVE 0x74F54 TKL_SW_VV_SW 100.0 FORMULA_0773 -100.0000 100.0000
 /begin AXIS_DESCR STD_AXIS md FORMULA_0009 8 -100.0000 1000.0000 FORMAT "%4.1" /end AXIS_DESCR
 FORMAT "%4.1" /end CHARACTERISTIC
/begin CHARACTERISTIC KL_LU_RF_MIN "LU-RF-Schwelle" CURVE 0x74F76 TKL_SW_VV_SW 100.0 FORMULA_0007 0.0 2.0000 /begin AXIS_DESCR STD_AXIS n FORMULA_0006 8 0.0 10000.0000 /end AXIS_DESCR FORMAT "%6.3" /end CHARACTERISTIC
/begin CHARACTERISTIC KL_LU_SCHW_KATH "Katheizanpassung LU-Schwelle" CURVE 0x74F98 TKL_SW_VV_UW 100.0 FORMULA_0075 0.0 4.0000 /begin AXIS_DESCR STD_AXIS n FORMULA_0006 3 0.0 10000.0000 /end AXIS_DESCR FORMAT "%6.3" /end CHARACTERISTIC
/begin CHARACTERISTIC KL_LU_SCHW_TMOT "Temperaturkompensation LU-Schwelle" CURVE 0x74FA6 TKL_SW_VV_UW 100.0 FORMULA_0075 0.0 4.0000
 /begin AXIS_DESCR STD_AXIS tmot FORMULA_0023 4 -50.0000 170.0000 FORMAT "%4.1" /end AXIS_DESCR
 FORMAT "%6.3" /end CHARACTERISTIC
/begin CHARACTERISTIC KL_LU_START_DLY "Segment Verzoegerung nach Verlassen von OFF" CURVE 0x74FB8 TKL_SW_VV_SW 100.0 FORMULA_0783 0.0 32767.0000
 /begin AXIS_DESCR STD_AXIS tmot FORMULA_0023 3 -50.0000 170.0000 FORMAT "%4.1" /end AXIS_DESCR
/end CHARACTERISTIC
/begin CHARACTERISTIC KL_LU_START_TRIG_OFF "Ausblenden von md/tz-delta nach Start" CURVE 0x74FC6 TKL_SW_VV_UW 100.0 FORMULA_0021 0.0 655.0000
 /begin AXIS_DESCR STD_AXIS tmot FORMULA_0023 3 -50.0000 170.0000 FORMAT "%4.1" /end AXIS_DESCR
 FORMAT "%5.2" /end CHARACTERISTIC
/begin CHARACTERISTIC KF_LU_FAKTOR_B2 "LU-Faktor Bank2" MAP 0x74FD4 TKF_SW_SW_UW 100.0 FORMULA_0295 0.0 2.0000 /begin AXIS_DESCR STD_AXIS n FORMULA_0006 6 0.0 10000.0000 /end AXIS_DESCR /begin AXIS_DESCR STD_AXIS rf FORMULA_0007 6 0.0 2.0000 FORMAT "%6.3" /end AXIS_DESCR FORMAT "%7.4" /end CHARACTERISTIC
/begin CHARACTERISTIC KF_LU_OFFSET_ZYL1 "LU-Offset Zyl 1" MAP 0x75036 TKF_SW_SW_SW 100.0 FORMULA_0756 -500.0000 499.9847 /begin AXIS_DESCR STD_AXIS n FORMULA_0006 16 0.0 10000.0000 /end AXIS_DESCR /begin AXIS_DESCR STD_AXIS rf FORMULA_0007 8 0.0 2.0000 FORMAT "%6.3" /end AXIS_DESCR FORMAT "%5.2" /end CHARACTERISTIC
/begin CHARACTERISTIC KF_LU_OFFSET_ZYL2 "LU-Offset Zyl 2" MAP 0x75168 TKF_SW_SW_SW 100.0 FORMULA_0756 -500.0000 499.9847 /begin AXIS_DESCR STD_AXIS n FORMULA_0006 16 0.0 10000.0000 /end AXIS_DESCR /begin AXIS_DESCR STD_AXIS rf FORMULA_0007 8 0.0 2.0000 FORMAT "%6.3" /end AXIS_DESCR FORMAT "%5.2" /end CHARACTERISTIC
/begin CHARACTERISTIC KF_LU_OFFSET_ZYL3 "LU-Offset Zyl 3" MAP 0x7529A TKF_SW_SW_SW 100.0 FORMULA_0756 -500.0000 499.9847 /begin AXIS_DESCR STD_AXIS n FORMULA_0006 16 0.0 10000.0000 /end AXIS_DESCR /begin AXIS_DESCR STD_AXIS rf FORMULA_0007 8 0.0 2.0000 FORMAT "%6.3" /end AXIS_DESCR FORMAT "%5.2" /end CHARACTERISTIC
/begin CHARACTERISTIC KF_LU_OFFSET_ZYL4 "LU-Offset Zyl 4" MAP 0x753CC TKF_SW_SW_SW 100.0 FORMULA_0756 -500.0000 499.9847 /begin AXIS_DESCR STD_AXIS n FORMULA_0006 16 0.0 10000.0000 /end AXIS_DESCR /begin AXIS_DESCR STD_AXIS rf FORMULA_0007 8 0.0 2.0000 FORMAT "%6.3" /end AXIS_DESCR FORMAT "%5.2" /end CHARACTERISTIC
/begin CHARACTERISTIC KF_LU_OFFSET_ZYL5 "LU-Offset Zyl 5" MAP 0x754FE TKF_SW_SW_SW 100.0 FORMULA_0756 -500.0000 499.9847 /begin AXIS_DESCR STD_AXIS n FORMULA_0006 16 0.0 10000.0000 /end AXIS_DESCR /begin AXIS_DESCR STD_AXIS rf FORMULA_0007 8 0.0 2.0000 FORMAT "%6.3" /end AXIS_DESCR FORMAT "%5.2" /end CHARACTERISTIC
/begin CHARACTERISTIC KF_LU_OFFSET_ZYL6 "LU-Offset Zyl 6" MAP 0x75630 TKF_SW_SW_SW 100.0 FORMULA_0756 -500.0000 499.9847 /begin AXIS_DESCR STD_AXIS n FORMULA_0006 16 0.0 10000.0000 /end AXIS_DESCR /begin AXIS_DESCR STD_AXIS rf FORMULA_0007 8 0.0 2.0000 FORMAT "%6.3" /end AXIS_DESCR FORMAT "%5.2" /end CHARACTERISTIC
/begin CHARACTERISTIC KF_LU_OFFSET_ZYL7 "LU-Offset Zyl 7" MAP 0x75762 TKF_SW_SW_SW 100.0 FORMULA_0756 -500.0000 499.9847 /begin AXIS_DESCR STD_AXIS n FORMULA_0006 16 0.0 10000.0000 /end AXIS_DESCR /begin AXIS_DESCR STD_AXIS rf FORMULA_0007 8 0.0 2.0000 FORMAT "%6.3" /end AXIS_DESCR FORMAT "%5.2" /end CHARACTERISTIC
/begin CHARACTERISTIC KF_LU_OFFSET_ZYL8 "LU-Offset Zyl 8" MAP 0x75894 TKF_SW_SW_SW 100.0 FORMULA_0756 -500.0000 499.9847 /begin AXIS_DESCR STD_AXIS n FORMULA_0006 16 0.0 10000.0000 /end AXIS_DESCR /begin AXIS_DESCR STD_AXIS rf FORMULA_0007 8 0.0 2.0000 FORMAT "%6.3" /end AXIS_DESCR FORMAT "%5.2" /end CHARACTERISTIC
/begin CHARACTERISTIC KF_LU_OFFSET_ZYL9 "LU-Offset Zyl 9" MAP 0x759C6 TKF_SW_SW_SW 100.0 FORMULA_0756 -500.0000 499.9847 /begin AXIS_DESCR STD_AXIS n FORMULA_0006 16 0.0 10000.0000 /end AXIS_DESCR /begin AXIS_DESCR STD_AXIS rf FORMULA_0007 8 0.0 2.0000 FORMAT "%6.3" /end AXIS_DESCR FORMAT "%5.2" /end CHARACTERISTIC
/begin CHARACTERISTIC KF_LU_OFFSET_ZYL10 "LU-Offset Zyl 10" MAP 0x75AF8 TKF_SW_SW_SW 100.0 FORMULA_0756 -500.0000 499.9847 /begin AXIS_DESCR STD_AXIS n FORMULA_0006 16 0.0 10000.0000 /end AXIS_DESCR /begin AXIS_DESCR STD_AXIS rf FORMULA_0007 8 0.0 2.0000 FORMAT "%6.3" /end AXIS_DESCR FORMAT "%5.2" /end CHARACTERISTIC
/begin CHARACTERISTIC KF_LU_SCHWELLE "LU-Schwelle" MAP 0x75C2A TKF_SW_SW_SW 100.0 FORMULA_0756 0.0 499.9847 /begin AXIS_DESCR STD_AXIS n FORMULA_0006 10 0.0 10000.0000 /end AXIS_DESCR /begin AXIS_DESCR STD_AXIS rf FORMULA_0007 8 0.0 2.0000 FORMAT "%6.3" /end AXIS_DESCR FORMAT "%5.2" /end CHARACTERISTIC
/begin MEASUREMENT lu_zyl1 "relative Laufunruhe" SWORD FORMULA_0756 0 0 -500.0000 499.9847 ECU_ADDRESS 0x3FBE7C /end MEASUREMENT
/begin MEASUREMENT lu_zyl2 "relative Laufunruhe" SWORD FORMULA_0756 0 0 -500.0000 499.9847 ECU_ADDRESS 0x3FBE7E /end MEASUREMENT
/begin MEASUREMENT lu_zyl3 "relative Laufunruhe" SWORD FORMULA_0756 0 0 -500.0000 499.9847 ECU_ADDRESS 0x3FBE80 /end MEASUREMENT
/begin MEASUREMENT lu_zyl4 "relative Laufunruhe" SWORD FORMULA_0756 0 0 -500.0000 499.9847 ECU_ADDRESS 0x3FBE82 /end MEASUREMENT
/begin MEASUREMENT lu_zyl5 "relative Laufunruhe" SWORD FORMULA_0756 0 0 -500.0000 499.9847 ECU_ADDRESS 0x3FBE84 /end MEASUREMENT
/begin MEASUREMENT lu_zyl6 "relative Laufunruhe" SWORD FORMULA_0756 0 0 -500.0000 499.9847 ECU_ADDRESS 0x3FBE86 /end MEASUREMENT
/begin MEASUREMENT lu_zyl7 "relative Laufunruhe" SWORD FORMULA_0756 0 0 -500.0000 499.9847 ECU_ADDRESS 0x3FBE88 /end MEASUREMENT
/begin MEASUREMENT lu_zyl8 "relative Laufunruhe" SWORD FORMULA_0756 0 0 -500.0000 499.9847 ECU_ADDRESS 0x3FBE8A /end MEASUREMENT
/begin MEASUREMENT lu_zyl9 "relative Laufunruhe" SWORD FORMULA_0756 0 0 -500.0000 499.9847 ECU_ADDRESS 0x3FBE8C /end MEASUREMENT
/begin MEASUREMENT lu_zyl10 "relative Laufunruhe" SWORD FORMULA_0756 0 0 -500.0000 499.9847 ECU_ADDRESS 0x3FBE8E /end MEASUREMENT
/begin MEASUREMENT lu_abs "absolute Laufunruhe" SWORD FORMULA_0757 0 0 4.6810 4.6810 ECU_ADDRESS 0x3FBE90 /end MEASUREMENT
/begin MEASUREMENT lu_adap_delay "LU Adaptions-Verzoegerungszaehler" UBYTE FORMULA_0501 0 0 0.0 25.5000 ECU_ADDRESS 0x3FBE92 /end MEASUREMENT
/begin MEASUREMENT lu_adap_filt "Filterkonstante f�r Adaption" UWORD FORMULA_0758 0 0 0.0 1.0000 ECU_ADDRESS 0x3FBE94 /end MEASUREMENT
/begin MEASUREMENT lu_adap_schw "Schwellenanhebung waehrend der Adaption" SWORD FORMULA_0756 0 0 0.0 499.9847 ECU_ADDRESS 0x3FBE96 /end MEASUREMENT
/begin MEASUREMENT lu_auss_zyl "Erkannte LU-Aussetzer" UWORD FORMULA_0010 0 0 0.0 65535.0000 ECU_ADDRESS 0x3FBE98 /end MEASUREMENT
/begin MEASUREMENT lu_auss_zyl1 "Aussetzererkennung Zylinder 1" UWORD FORMULA_0759 0 0 0.0 65535.0 ECU_ADDRESS 0x3FBE98 BIT_MASK 0x1 /end MEASUREMENT
/begin MEASUREMENT lu_auss_zyl2 "Aussetzererkennung Zylinder 2" UWORD FORMULA_0760 0 0 0.0 65535.0 ECU_ADDRESS 0x3FBE98 BIT_MASK 0x2 /end MEASUREMENT
/begin MEASUREMENT lu_auss_zyl3 "Aussetzererkennung Zylinder 3" UWORD FORMULA_0761 0 0 0.0 65535.0 ECU_ADDRESS 0x3FBE98 BIT_MASK 0x4 /end MEASUREMENT
/begin MEASUREMENT lu_auss_zyl4 "Aussetzererkennung Zylinder 4" UWORD FORMULA_0762 0 0 0.0 65535.0 ECU_ADDRESS 0x3FBE98 BIT_MASK 0x8 /end MEASUREMENT
/begin MEASUREMENT lu_auss_zyl5 "Aussetzererkennung Zylinder 5" UWORD FORMULA_0763 0 0 0.0 65535.0 ECU_ADDRESS 0x3FBE98 BIT_MASK 0x10 /end MEASUREMENT
/begin MEASUREMENT lu_auss_zyl6 "Aussetzererkennung Zylinder 6" UWORD FORMULA_0764 0 0 0.0 65535.0 ECU_ADDRESS 0x3FBE98 BIT_MASK 0x20 /end MEASUREMENT
/begin MEASUREMENT lu_auss_zyl7 "Aussetzererkennung Zylinder 7" UWORD FORMULA_0765 0 0 0.0 65535.0 ECU_ADDRESS 0x3FBE98 BIT_MASK 0x40 /end MEASUREMENT
/begin MEASUREMENT lu_auss_zyl8 "Aussetzererkennung Zylinder 8" UWORD FORMULA_0766 0 0 0.0 65535.0 ECU_ADDRESS 0x3FBE98 BIT_MASK 0x80 /end MEASUREMENT
/begin MEASUREMENT lu_auss_zyl9 "Aussetzererkennung Zylinder 9" UWORD FORMULA_0767 0 0 0.0 65535.0 ECU_ADDRESS 0x3FBE98 BIT_MASK 0x100 /end MEASUREMENT
/begin MEASUREMENT lu_auss_zyl10 "Aussetzererkennung Zylinder 10" UWORD FORMULA_0768 0 0 0.0 65535.0 ECU_ADDRESS 0x3FBE98 BIT_MASK 0x200 /end MEASUREMENT
/begin MEASUREMENT lu_dyn "dynamische Laufunruhe" SWORD FORMULA_0757 0 0 4.6810 4.6810 ECU_ADDRESS 0x3FBE9A /end MEASUREMENT
/begin MEASUREMENT lu_faktor_b2 "LU-Faktor Bank2" UWORD FORMULA_0295 0 0 0.0 2.0000 ECU_ADDRESS 0x3FBE9C /end MEASUREMENT
/begin MEASUREMENT B_LU_KRAFTSCHLUSS_OLD "Merker Schalter Kraftschluss" UBYTE FORMULA_0769 0 0 0.0 255.0 ECU_ADDRESS 0x3FBE9E BIT_MASK 0x1 /end MEASUREMENT
/begin MEASUREMENT B_LU_KKOS_OLD "Merker Klimakompressor" UBYTE FORMULA_0770 0 0 0.0 255.0 ECU_ADDRESS 0x3FBE9E BIT_MASK 0x2 /end MEASUREMENT
/begin MEASUREMENT B_LU_TRIGGER_FREI "Freigabe md/tz-Trigger nach Motor start" UBYTE FORMULA_0771 0 0 0.0 255.0 ECU_ADDRESS 0x3FBE9E BIT_MASK 0x4 /end MEASUREMENT
/begin MEASUREMENT lu_idle_delay "LU Aktiv-Verzoegerungszaehler" UBYTE FORMULA_0501 0 0 0.0 25.5000 ECU_ADDRESS 0x3FBE9F /end MEASUREMENT
/begin MEASUREMENT lu_idle_trigger "Trigger fuer Idle-Mode" UBYTE FORMULA_0772 0 0 0.0 255.0 ECU_ADDRESS 0x3FBEA0 /end MEASUREMENT
/begin MEASUREMENT lu_kuppl_delay "LU Aktiv-Verzoegerung beim Auskuppeln" UBYTE FORMULA_0501 0 0 0.0 25.5000 ECU_ADDRESS 0x3FBEA1 /end MEASUREMENT
/begin MEASUREMENT lu_md_delta_pos "Max. Zul. positives md-Delta" SWORD FORMULA_0773 0 0 -100.0000 1000.0000 ECU_ADDRESS 0x3FBEA2 /end MEASUREMENT
/begin MEASUREMENT lu_md_delta_neg "Max. Zul. Negatives md-Delta" SWORD FORMULA_0773 0 0 -100.0000 1000.0000 ECU_ADDRESS 0x3FBEA4 /end MEASUREMENT
/begin MEASUREMENT lu_md_old "1Segment altes md_ind_wunsch_red_korr." SWORD FORMULA_0009 0 0 -100.0000 1000.0000 ECU_ADDRESS 0x3FBEA6 /end MEASUREMENT
/begin MEASUREMENT lu_merk_ti_done "Merker ob eingespritzt wurde" UWORD FORMULA_0010 0 0 0.0 65535.0000 ECU_ADDRESS 0x3FBEA8 /end MEASUREMENT
/begin MEASUREMENT lu_offset_zyl1 "Offset zur Schwingungskompensation" SWORD FORMULA_0756 0 0 -500.0000 499.9847 ECU_ADDRESS 0x3FBEAA /end MEASUREMENT
/begin MEASUREMENT lu_offset_zyl2 "Offset zur Schwingungskompensation" SWORD FORMULA_0756 0 0 -500.0000 499.9847 ECU_ADDRESS 0x3FBEAC /end MEASUREMENT
/begin MEASUREMENT lu_offset_zyl3 "Offset zur Schwingungskompensation" SWORD FORMULA_0756 0 0 -500.0000 499.9847 ECU_ADDRESS 0x3FBEAE /end MEASUREMENT
/begin MEASUREMENT lu_offset_zyl4 "Offset zur Schwingungskompensation" SWORD FORMULA_0756 0 0 -500.0000 499.9847 ECU_ADDRESS 0x3FBEB0 /end MEASUREMENT
/begin MEASUREMENT lu_offset_zyl5 "Offset zur Schwingungskompensation" SWORD FORMULA_0756 0 0 -500.0000 499.9847 ECU_ADDRESS 0x3FBEB2 /end MEASUREMENT
/begin MEASUREMENT lu_offset_zyl6 "Offset zur Schwingungskompensation" SWORD FORMULA_0756 0 0 -500.0000 499.9847 ECU_ADDRESS 0x3FBEB4 /end MEASUREMENT
/begin MEASUREMENT lu_offset_zyl7 "Offset zur Schwingungskompensation" SWORD FORMULA_0756 0 0 -500.0000 499.9847 ECU_ADDRESS 0x3FBEB6 /end MEASUREMENT
/begin MEASUREMENT lu_offset_zyl8 "Offset zur Schwingungskompensation" SWORD FORMULA_0756 0 0 -500.0000 499.9847 ECU_ADDRESS 0x3FBEB8 /end MEASUREMENT
/begin MEASUREMENT lu_offset_zyl9 "Offset zur Schwingungskompensation" SWORD FORMULA_0756 0 0 -500.0000 499.9847 ECU_ADDRESS 0x3FBEBA /end MEASUREMENT
/begin MEASUREMENT lu_offset_zyl10 "Offset zur Schwingungskompensation" SWORD FORMULA_0756 0 0 -500.0000 499.9847 ECU_ADDRESS 0x3FBEBC /end MEASUREMENT
/begin MEASUREMENT lu_rf_min "LU-RF-Untergrenze" SWORD FORMULA_0007 0 0 0.0 2.0000 ECU_ADDRESS 0x3FBEBE /end MEASUREMENT
/begin MEASUREMENT lu_schwelle "Schwelle der Laufunruhe fuer Aussetzererkennung" SWORD FORMULA_0756 0 0 -500.0000 499.9847 ECU_ADDRESS 0x3FBEC0 /end MEASUREMENT
/begin MEASUREMENT lu_segm_ausblend "LU Segmentausblendungszaehler" UBYTE FORMULA_0774 0 0 0.0 255.0000 ECU_ADDRESS 0x3FBEC2 /end MEASUREMENT
/begin MEASUREMENT lu_segm_idx_b1 "LU IRQ Segment-Nummer" UBYTE FORMULA_0774 0 0 0.0 30.0000 ECU_ADDRESS 0x3FBEC3 /end MEASUREMENT
/begin MEASUREMENT lu_segm_idx_b2 "LU IRQ Segment-Nummer" UBYTE FORMULA_0774 0 0 0.0 30.0000 ECU_ADDRESS 0x3FBEC4 /end MEASUREMENT
/begin MEASUREMENT lu_segm_idx_old "alter LU Segmentindex" UBYTE FORMULA_0003 0 0 0.0 30.0000 ECU_ADDRESS 0x3FBEC5 /end MEASUREMENT
/begin MEASUREMENT lu_st "Status LU" UBYTE FORMULA_0775 0 0 0.0 255.0 ECU_ADDRESS 0x3FBEC6 /end MEASUREMENT
/begin MEASUREMENT lu_sta "stationaere Laufunruhe" SWORD FORMULA_0757 0 0 4.6810 4.6810 ECU_ADDRESS 0x3FBEC8 /end MEASUREMENT
/begin MEASUREMENT lu_ti_st_soll_old "Alter Zustand der Einspritzausblendung" UWORD FORMULA_0010 0 0 0.0 65535.0000 ECU_ADDRESS 0x3FBECA /end MEASUREMENT
/begin MEASUREMENT lu_ts_fifo_1of8_ "Segmentzeiten-Ringspeicher" ULONG FORMULA_0776 0 0 0.0 1198.3724 ECU_ADDRESS 0x3FBECC /end MEASUREMENT
/begin MEASUREMENT lu_ts_fifo_2of8_ "Segmentzeiten-Ringspeicher" ULONG FORMULA_0776 0 0 0.0 1198.3724 ECU_ADDRESS 0x3FBED0 /end MEASUREMENT
/begin MEASUREMENT lu_ts_fifo_3of8_ "Segmentzeiten-Ringspeicher" ULONG FORMULA_0776 0 0 0.0 1198.3724 ECU_ADDRESS 0x3FBED4 /end MEASUREMENT
/begin MEASUREMENT lu_ts_fifo_4of8_ "Segmentzeiten-Ringspeicher" ULONG FORMULA_0776 0 0 0.0 1198.3724 ECU_ADDRESS 0x3FBED8 /end MEASUREMENT
/begin MEASUREMENT lu_ts_fifo_5of8_ "Segmentzeiten-Ringspeicher" ULONG FORMULA_0776 0 0 0.0 1198.3724 ECU_ADDRESS 0x3FBEDC /end MEASUREMENT
/begin MEASUREMENT lu_ts_fifo_6of8_ "Segmentzeiten-Ringspeicher" ULONG FORMULA_0776 0 0 0.0 1198.3724 ECU_ADDRESS 0x3FBEE0 /end MEASUREMENT
/begin MEASUREMENT lu_ts_fifo_7of8_ "Segmentzeiten-Ringspeicher" ULONG FORMULA_0776 0 0 0.0 1198.3724 ECU_ADDRESS 0x3FBEE4 /end MEASUREMENT
/begin MEASUREMENT lu_ts_fifo_8of8_ "Segmentzeiten-Ringspeicher" ULONG FORMULA_0776 0 0 0.0 1198.3724 ECU_ADDRESS 0x3FBEE8 /end MEASUREMENT
/begin MEASUREMENT lu_ts_pr "Zeiger auf lu_ts_fifo" UBYTE FORMULA_0003 0 0 0.0 30.0000 ECU_ADDRESS 0x3FBEEC /end MEASUREMENT
/begin MEASUREMENT lu_ts_roh_segm1 "Rohwerte Segmentzeiten" ULONG FORMULA_0776 0 0 0.0 1198.3724 ECU_ADDRESS 0x3FBEF0 /end MEASUREMENT
/begin MEASUREMENT lu_ts_roh_segm2 "Rohwerte Segmentzeiten" ULONG FORMULA_0776 0 0 0.0 1198.3724 ECU_ADDRESS 0x3FBEF4 /end MEASUREMENT
/begin MEASUREMENT lu_ts_roh_segm3 "Rohwerte Segmentzeiten" ULONG FORMULA_0776 0 0 0.0 1198.3724 ECU_ADDRESS 0x3FBEF8 /end MEASUREMENT
/begin MEASUREMENT lu_ts_roh_segm4 "Rohwerte Segmentzeiten" ULONG FORMULA_0776 0 0 0.0 1198.3724 ECU_ADDRESS 0x3FBEFC /end MEASUREMENT
/begin MEASUREMENT lu_ts_roh_segm5 "Rohwerte Segmentzeiten" ULONG FORMULA_0776 0 0 0.0 1198.3724 ECU_ADDRESS 0x3FBF00 /end MEASUREMENT
/begin MEASUREMENT lu_ts_roh_segm6 "Rohwerte Segmentzeiten" ULONG FORMULA_0776 0 0 0.0 1198.3724 ECU_ADDRESS 0x3FBF04 /end MEASUREMENT
/begin MEASUREMENT lu_ts_roh_segm7 "Rohwerte Segmentzeiten" ULONG FORMULA_0776 0 0 0.0 1198.3724 ECU_ADDRESS 0x3FBF08 /end MEASUREMENT
/begin MEASUREMENT lu_ts_roh_segm8 "Rohwerte Segmentzeiten" ULONG FORMULA_0776 0 0 0.0 1198.3724 ECU_ADDRESS 0x3FBF0C /end MEASUREMENT
/begin MEASUREMENT lu_ts_roh_segm9 "Rohwerte Segmentzeiten" ULONG FORMULA_0776 0 0 0.0 1198.3724 ECU_ADDRESS 0x3FBF10 /end MEASUREMENT
/begin MEASUREMENT lu_ts_roh_segm10 "Rohwerte Segmentzeiten" ULONG FORMULA_0776 0 0 0.0 1198.3724 ECU_ADDRESS 0x3FBF14 /end MEASUREMENT
/begin MEASUREMENT lu_tz_old "1Segment alter Zuendwinkel" SWORD FORMULA_0111 0 0 -50.0000 60.0000 ECU_ADDRESS 0x3FBF18 /end MEASUREMENT
/begin MEASUREMENT lu_win_time_b1 "Messfensterzeit." ULONG FORMULA_0017 0 0 0.0 1198.3724 ECU_ADDRESS 0x3FBF1C /end MEASUREMENT
/begin MEASUREMENT lu_win_time_b2 "Messfensterzeit." ULONG FORMULA_0017 0 0 0.0 1198.3724 ECU_ADDRESS 0x3FBF20 /end MEASUREMENT
/* ------------------ Abschnitt erzeugt aus md_basis.dat ------------------ */
/begin CHARACTERISTIC K_MD_HYP_VERH_START "Begrenzung Hyperbel ausserhalb Motor laeuft | EN: Begrenzung Hyperbel ausserhalb Motor laeuft" VALUE 0x75CF0 TKW_VV_VV_UB 100.0 FORMULA_0704 0.0 1.9921 /end CHARACTERISTIC
/begin CHARACTERISTIC K_MD_HYP_VERH_NO_KRAFTS "Best. Schnittpunkt Brenngrenze mit Hyp.bei NO_Krafts. | EN: Best. Schnittpunkt Brenngrenze mit Hyp.bei NO_Krafts." VALUE 0x75CF1 TKW_VV_VV_UB 100.0 FORMULA_0704 0.0 1.9921 /end CHARACTERISTIC
/begin CHARACTERISTIC K_MD_ETA_KR_KOMP "ETA-Kr mit/ohne KR" VALUE 0x75CF2 TKW_VV_VV_UB 100.0 FORMULA_0787 0.0 255.0 /end CHARACTERISTIC
/begin CHARACTERISTIC K_MD_CFG_RG_KORR "Cfg fuer RG-Korrektur | EN: Cfg fuer RG-Korrektur" VALUE 0x75CF3 TKW_VV_VV_UB 100.0 FORMULA_0788 0.0 255.0 /end CHARACTERISTIC
/begin CHARACTERISTIC K_MD_MAX_FAK "VL-Korrektur von Rf_max | EN: Full-load correction of rf_max" VALUE 0x75CF4 TKW_VV_VV_UW 100.0 FORMULA_0075 0.0 4.0000 FORMAT "%6.3" /end CHARACTERISTIC
/begin CHARACTERISTIC K_MD_ETA_ZW_MIN "minimales ETA | EN: Minimum efficiency [%]" VALUE 0x75CF6 TKW_VV_VV_UW 100.0 FORMULA_0435 0.0 150.0000 FORMAT "%4.1" /end CHARACTERISTIC
/begin CHARACTERISTIC K_MD_ETA_SK_MIN "minimales ETA bei SK-Ausblendern | EN: Minimum efficiency during safety-concept suppression [%]" VALUE 0x75CF8 TKW_VV_VV_UW 100.0 FORMULA_0435 0.0 150.0000 FORMAT "%4.1" /end CHARACTERISTIC
/begin CHARACTERISTIC K_MD_MAX_POWER_POS "Begrenzung Powerfaktor | EN: Power factor limit [1/sec]" VALUE 0x75CFA TKW_VV_VV_UB 100.0 FORMULA_0789 0.0 49.8046 /end CHARACTERISTIC
/begin CHARACTERISTIC K_MD_MAX_POWER_NEG "Begrenzung Powerfaktor | EN: Power factor limit [1/sec]" VALUE 0x75CFB TKW_VV_VV_UB 100.0 FORMULA_0789 0.0 49.8046 /end CHARACTERISTIC
/begin CHARACTERISTIC K_MD_PULS_EIN "Generator-Schalter" VALUE 0x75CFC TKW_VV_VV_UB 100.0 FORMULA_0790 0.0 255.0 /end CHARACTERISTIC
/begin CHARACTERISTIC K_MD_PULS_T "Generator-Periodendauer | EN: Generator period [s]" VALUE 0x75CFE TKW_VV_VV_UW 100.0 FORMULA_0117 0.0 325.0000 FORMAT "%5.2" /end CHARACTERISTIC
/begin CHARACTERISTIC K_MD_PULS_AMP "Generator-Amplitude | EN: Generator amplitude [Nm]" VALUE 0x75D00 TKW_VV_VV_SW 100.0 FORMULA_0009 -100.0000 100.0000 FORMAT "%4.1" /end CHARACTERISTIC
/begin CHARACTERISTIC K_MD_PULS_OFFS "Generator-Offset | EN: Generator offset [Nm]" VALUE 0x75D02 TKW_VV_VV_SW 100.0 FORMULA_0009 -100.0000 100.0000 FORMAT "%4.1" /end CHARACTERISTIC
/begin CHARACTERISTIC K_MD_PULS_RAMPE "Generator-Rampe | EN: Generator ramp [Nm/s]" VALUE 0x75D04 TKW_VV_VV_SW 100.0 FORMULA_0571 -20000.0000 20000.0000 /end CHARACTERISTIC
/begin CHARACTERISTIC K_MD_VERBR_MAX "max. Verbrauchermoment | EN: Maximum consumer torque [Nm]" VALUE 0x75D06 TKW_VV_VV_SW 100.0 FORMULA_0009 0.0 200.0000 FORMAT "%4.1" /end CHARACTERISTIC
/begin CHARACTERISTIC KL_MD_RF_MAX_ROH "maximale rel. F�llung | EN: Maximum relative charge" CURVE 0x75D08 TKL_SW_VV_SW 100.0 FORMULA_0007 0.0 2.0000 /begin AXIS_DESCR STD_AXIS n FORMULA_0006 20 0.0 10000.0000 /end AXIS_DESCR FORMAT "%6.3" /end CHARACTERISTIC
/begin CHARACTERISTIC KL_MD_MAX_N_OFFS "Drehzahloffset fuer rf_max | EN: Engine-speed offset for rf_max" CURVE 0x75D5A TKL_SW_VV_SW 100.0 FORMULA_0006 0.0 10000.0000
 /begin AXIS_DESCR STD_AXIS tan FORMULA_0023 6 -50.0000 170.0000 FORMAT "%4.1" /end AXIS_DESCR
/end CHARACTERISTIC
/begin CHARACTERISTIC KL_MD_MAX_TMOT "tmot-Korrektur fuer rf_max | EN: Engine-temperature correction for rf_max" CURVE 0x75D74 TKL_SW_VV_UW 100.0 FORMULA_0075 0.0 4.0000
 /begin AXIS_DESCR STD_AXIS tmot FORMULA_0023 6 -50.0000 170.0000 FORMAT "%4.1" /end AXIS_DESCR
 FORMAT "%6.3" /end CHARACTERISTIC
/begin CHARACTERISTIC KL_MD_MAX_FAK_POWER "maximale rel. F�llung | EN: Maximum relative charge" CURVE 0x75D8E TKL_SW_VV_UW 100.0 FORMULA_0075 0.0 4.0000 /begin AXIS_DESCR STD_AXIS n FORMULA_0006 18 0.0 10000.0000 /end AXIS_DESCR FORMAT "%6.3" /end CHARACTERISTIC
/begin CHARACTERISTIC KL_MD_KUPP_MAX_CAN "Popelfaktor fuer CAN-Ausgabe | EN: Scaling factor for CAN output" CURVE 0x75DD8 TKL_SW_VV_UW 100.0 FORMULA_0075 0.0 2.0000 /begin AXIS_DESCR STD_AXIS n FORMULA_0006 6 0.0 10000.0000 /end AXIS_DESCR FORMAT "%6.3" /end CHARACTERISTIC
/begin CHARACTERISTIC KL_MD_HYP_DN "Drehzahloffset fuer MD_MIN-Hyperbelast | EN: Engine-speed offset for MD_MIN hyperbola load" CURVE 0x75DF2 TKL_SW_VV_SW 100.0 FORMULA_0006 0.0 10000.0000
 /begin AXIS_DESCR STD_AXIS tmot FORMULA_0023 3 -50.0000 170.0000 FORMAT "%4.1" /end AXIS_DESCR
/end CHARACTERISTIC
/begin CHARACTERISTIC KL_MD_ETA_LA "LA-Wirkungsgrad | EN: Lambda efficiency" CURVE 0x75E00 TKL_UW_VV_UW 100.0 FORMULA_0435 0.0 150.0000 /begin AXIS_DESCR STD_AXIS la FORMULA_0025 8 0.0 3.9990 FORMAT "%6.3" /end AXIS_DESCR FORMAT "%4.1" /end CHARACTERISTIC
/begin CHARACTERISTIC KL_MD_ZW_LA "ZW-Einfluss durch Lambda | EN: Ignition-angle influence from lambda" CURVE 0x75E22 TKL_SW_VV_SW 100.0 FORMULA_0111 -50.0000 60.0000 /begin AXIS_DESCR STD_AXIS Lambda FORMULA_0025 6 0.0 1.9990 FORMAT "%6.3" /end AXIS_DESCR FORMAT "%4.1" /end CHARACTERISTIC
/begin CHARACTERISTIC KL_MD_ZW_TMOT_FAK "ZW-Korrektur ueber Tmot" CURVE 0x75E3C TKL_SW_VV_UW 100.0 FORMULA_0075 0.0 4.0000
 /begin AXIS_DESCR STD_AXIS tmot FORMULA_0023 6 -50.0000 170.0000 FORMAT "%4.1" /end AXIS_DESCR
 FORMAT "%6.3" /end CHARACTERISTIC
/begin CHARACTERISTIC KL_MD_IND_REIB_OFFSET "Offset fuer Reibmoment nach Start | EN: Offset for friction torque after start" CURVE 0x75E56 TKL_SW_VV_SW 100.0 FORMULA_0784 0.0 320.0000
 /begin AXIS_DESCR STD_AXIS tmot FORMULA_0023 4 -50.0000 170.0000 FORMAT "%4.1" /end AXIS_DESCR
 FORMAT "%4.1" /end CHARACTERISTIC
/begin CHARACTERISTIC KL_MD_IND_REIB_ABREG "Abregelrampe fuer Reibmoment nach Start | EN: Ramp-down for friction torque after start" CURVE 0x75E68 TKL_SW_VV_SW 100.0 FORMULA_0785 -100.0000 1000.0000
 /begin AXIS_DESCR STD_AXIS tmot FORMULA_0023 4 -50.0000 170.0000 FORMAT "%4.1" /end AXIS_DESCR
 FORMAT "%5.2" /end CHARACTERISTIC
/begin CHARACTERISTIC KL_MD_TAU_START_OFF "Filter fuer Startoffset | EN: Filter for start offset" CURVE 0x75E7A TKL_SW_VV_UW 100.0 FORMULA_0477 0.0050 327.6700
 /begin AXIS_DESCR STD_AXIS tmot FORMULA_0023 5 -50.0000 170.0000 FORMAT "%4.1" /end AXIS_DESCR
 FORMAT "%5.2" /end CHARACTERISTIC
/begin CHARACTERISTIC KL_MD_KR_DTZ_UP "KR-Begr up | EN: Knock-control limit, up" CURVE 0x75E90 TKL_SW_VV_SW 100.0 FORMULA_0791 0.0 5000.0000 /begin AXIS_DESCR STD_AXIS n FORMULA_0006 5 0.0 10000.0000 /end AXIS_DESCR /end CHARACTERISTIC
/begin CHARACTERISTIC KL_MD_KR_DTZ_DOWN "KR-Begr down | EN: Knock-control limit, down" CURVE 0x75EA6 TKL_SW_VV_SW 100.0 FORMULA_0791 0.0 5000.0000 /begin AXIS_DESCR STD_AXIS n FORMULA_0006 5 0.0 10000.0000 /end AXIS_DESCR /end CHARACTERISTIC
/begin CHARACTERISTIC KL_MD_IND_RF_MIN_OFFS "Rfmin-Offset | EN: Minimum relative charge offset" CURVE 0x75EBC TKL_SW_VV_SW 100.0 FORMULA_0009 -100.0000 1000.0000 /begin AXIS_DESCR STD_AXIS n FORMULA_0006 8 0.0 10000.0000 /end AXIS_DESCR FORMAT "%4.1" /end CHARACTERISTIC
/begin CHARACTERISTIC KL_MD_SCHW_TAU "Filterkonstante Md_Schw | EN: Filter constant Md_Schw" CURVE 0x75EDE TKL_UB_VV_UB 100.0 FORMULA_0478 0.0051 1.2800 /begin AXIS_DESCR STD_AXIS gang FORMULA_0318 8 0.0 10.0000 /end AXIS_DESCR /end CHARACTERISTIC
/begin CHARACTERISTIC KL_MD_HYP_VERH_KRAFTS "Best. Schnittpunkt Brenngrenze mit Hyp.bei Krafts." CURVE 0x75EF0 TKL_UW_VV_UW 100.0 FORMULA_0792 0.0 1.9921 /begin AXIS_DESCR STD_AXIS t FORMULA_0021 4 0.0 655.0000 FORMAT "%5.2" /end AXIS_DESCR FORMAT "%5.2" /end CHARACTERISTIC
/begin CHARACTERISTIC KF_MD_IND_OPT "optimales Moment bei LA 1 | EN: Optimum torque at lambda 1" MAP 0x75F02 TKF_SW_SW_SW 100.0 FORMULA_0009 -100.0000 1000.0000 /begin AXIS_DESCR STD_AXIS n FORMULA_0006 18 0.0 10000.0000 /end AXIS_DESCR /begin AXIS_DESCR STD_AXIS rf_m FORMULA_0007 12 0.0 2.0000 FORMAT "%6.3" /end AXIS_DESCR FORMAT "%4.1" /end CHARACTERISTIC
/begin CHARACTERISTIC KF_MD_IND_MIN_SCHUB "min. Schubmoment | EN: Minimum overrun torque" MAP 0x760F0 TKF_SW_SW_SW 100.0 FORMULA_0009 -100.0000 1000.0000 /begin AXIS_DESCR STD_AXIS n FORMULA_0006 8 0.0 10000.0000 /end AXIS_DESCR
 /begin AXIS_DESCR STD_AXIS tmot FORMULA_0023 6 -50.0000 170.0000 FORMAT "%4.1" /end AXIS_DESCR
 FORMAT "%4.1" /end CHARACTERISTIC
/begin CHARACTERISTIC KF_MD_IND_REIB "Reibmoment | EN: Friction torque" MAP 0x7616E TKF_SW_SW_SW 100.0 FORMULA_0009 -100.0000 1000.0000
 /begin AXIS_DESCR STD_AXIS tmot FORMULA_0023 8 -50.0000 170.0000 FORMAT "%4.1" /end AXIS_DESCR
 /begin AXIS_DESCR STD_AXIS toel FORMULA_0023 8 -50.0000 170.0000 FORMAT "%4.1" /end AXIS_DESCR
 FORMAT "%4.1" /end CHARACTERISTIC
/begin CHARACTERISTIC KF_MD_IND_LW_VERLUSTE "Ladungswechselverluste | EN: Gas-exchange (pumping) losses" MAP 0x76210 TKF_SW_SW_SW 100.0 FORMULA_0009 -100.0000 1000.0000 /begin AXIS_DESCR STD_AXIS n FORMULA_0006 10 0.0 10000.0000 /end AXIS_DESCR /begin AXIS_DESCR STD_AXIS rf_m FORMULA_0007 8 0.0 2.0000 FORMAT "%6.3" /end AXIS_DESCR FORMAT "%4.1" /end CHARACTERISTIC
/begin CHARACTERISTIC KF_MD_ZW_OPT "Optimaler Z�ndhaken | EN: Optimum ignition hook" MAP 0x762D6 TKF_SW_SW_SW 100.0 FORMULA_0111 -50.0000 60.0000 /begin AXIS_DESCR STD_AXIS n FORMULA_0006 18 0.0 10000.0000 /end AXIS_DESCR /begin AXIS_DESCR STD_AXIS rf_m FORMULA_0007 12 0.0 2.0000 FORMAT "%6.3" /end AXIS_DESCR FORMAT "%4.1" /end CHARACTERISTIC
/begin CHARACTERISTIC KF_MD_ZW_RG "Restgaseinfluss auf opt. Z�ndwinkel" MAP 0x764C4 TKF_SW_SW_SW 100.0 FORMULA_0793 0.0 100.0000 /begin AXIS_DESCR STD_AXIS n FORMULA_0006 8 0.0 10000.0000 /end AXIS_DESCR /begin AXIS_DESCR STD_AXIS rf_m FORMULA_0007 6 0.0 2.0000 FORMAT "%6.3" /end AXIS_DESCR FORMAT "%4.1" /end CHARACTERISTIC
/begin CHARACTERISTIC KF_MD_ZW_OFFSET "ZW-Offset ueber n und rf | EN: Ignition-angle offset over engine speed and charge" MAP 0x76542 TKF_SW_SW_SW 100.0 FORMULA_0111 -50.0000 60.0000 /begin AXIS_DESCR STD_AXIS n FORMULA_0006 4 0.0 10000.0000 /end AXIS_DESCR /begin AXIS_DESCR STD_AXIS rf_m FORMULA_0007 5 0.0 2.0000 FORMAT "%6.3" /end AXIS_DESCR FORMAT "%4.1" /end CHARACTERISTIC
/begin CHARACTERISTIC KF_MD_POLYNOM_A "A-Paramter Polynom f�r Z�ndhaken | EN: A parameter of polynomial for ignition hook (torque vs spark)" MAP 0x7657E TKF_SW_SW_SW 100.0 FORMULA_0786 -320.0000 320.0000 /begin AXIS_DESCR STD_AXIS n FORMULA_0006 18 0.0 10000.0000 /end AXIS_DESCR /begin AXIS_DESCR STD_AXIS rf_m FORMULA_0007 12 0.0 2.0000 FORMAT "%6.3" /end AXIS_DESCR FORMAT "%5.2" /end CHARACTERISTIC
/begin CHARACTERISTIC KF_MD_POLYNOM_A_KH "A-Paramter Polynom f�r Z�ndhaken im KH | EN: Polynomial A parameter for ignition-efficiency hook during cat heating" MAP 0x7676C TKF_SW_SW_SW 100.0 FORMULA_0786 -320.0000 320.0000 /begin AXIS_DESCR STD_AXIS n FORMULA_0006 18 0.0 10000.0000 /end AXIS_DESCR /begin AXIS_DESCR STD_AXIS rf_m FORMULA_0007 12 0.0 2.0000 FORMAT "%6.3" /end AXIS_DESCR FORMAT "%5.2" /end CHARACTERISTIC
/begin CHARACTERISTIC KF_MD_POLYNOM_B "B-Paramter Polynom f�r Z�ndhaken | EN: B parameter of polynomial for ignition hook" MAP 0x7695A TKF_SW_SW_SW 100.0 FORMULA_0786 -320.0000 320.0000 /begin AXIS_DESCR STD_AXIS n FORMULA_0006 6 0.0 10000.0000 /end AXIS_DESCR /begin AXIS_DESCR STD_AXIS rf_m FORMULA_0007 4 0.0 2.0000 FORMAT "%6.3" /end AXIS_DESCR FORMAT "%5.2" /end CHARACTERISTIC
/begin CHARACTERISTIC KF_MD_START_OFFSET "Vorsteuerung f�r Start | EN: Torque feed-forward for start" MAP 0x769A0 TKF_SW_SW_SW 100.0 FORMULA_0009 -100.0000 1000.0000 /begin AXIS_DESCR STD_AXIS n FORMULA_0006 8 0.0 10000.0000 /end AXIS_DESCR
 /begin AXIS_DESCR STD_AXIS tmot FORMULA_0023 6 -50.0000 170.0000 FORMAT "%4.1" /end AXIS_DESCR
 FORMAT "%4.1" /end CHARACTERISTIC
/begin CHARACTERISTIC KF_MD_VERBR_FZG "Verbraucheroffset Fzg | EN: Vehicle consumer (accessory) offset" MAP 0x76A1E TKF_SW_SW_SW 100.0 FORMULA_0009 -100.0000 1000.0000 /begin AXIS_DESCR STD_AXIS n FORMULA_0006 6 0.0 10000.0000 /end AXIS_DESCR
 /begin AXIS_DESCR STD_AXIS tmot FORMULA_0023 5 -50.0000 170.0000 FORMAT "%4.1" /end AXIS_DESCR
 FORMAT "%4.1" /end CHARACTERISTIC
/begin CHARACTERISTIC KF_MD_ETA_LA "LA-Wirkungsgrad | EN: Lambda efficiency" MAP 0x76A72 TKF_SW_SW_UW 100.0 FORMULA_0435 0.0 150.0000
 /begin AXIS_DESCR STD_AXIS tz_soll FORMULA_0111 8 -50.0000 60.0000 FORMAT "%4.1" /end AXIS_DESCR
 /begin AXIS_DESCR STD_AXIS la_soll FORMULA_0025 8 0.0 1.9999 FORMAT "%6.3" /end AXIS_DESCR
 FORMAT "%4.1" /end CHARACTERISTIC
/begin MEASUREMENT md_rf_min "rf_min" SWORD FORMULA_0007 0 0 0.0 2.0000 ECU_ADDRESS 0x3FBF58 /end MEASUREMENT
/begin MEASUREMENT md_rf_tl_vl "rf_max" SWORD FORMULA_0007 0 0 0.0 2.0000 ECU_ADDRESS 0x3FBF5A /end MEASUREMENT
/begin MEASUREMENT md_hyp_faktor "Hyp-Faktor" UBYTE FORMULA_0704 0 0 0.0 1.9921 ECU_ADDRESS 0x3FBF5C /end MEASUREMENT
/begin MEASUREMENT md_ind_min_schub "min. ind. Schubmoment" SWORD FORMULA_0009 0 0 -100.0000 1000.0000 ECU_ADDRESS 0x3FBF5E /end MEASUREMENT
/begin MEASUREMENT md_ind_rf_min "Moment bei Rfmin" SWORD FORMULA_0009 0 0 -100.0000 1000.0000 ECU_ADDRESS 0x3FBF60 /end MEASUREMENT
/begin MEASUREMENT md_ind_reib_roh "Reibverluste (Rohwert)" SWORD FORMULA_0009 0 0 -100.0000 1000.0000 ECU_ADDRESS 0x3FBF62 /end MEASUREMENT
/begin MEASUREMENT md_ind_reib_offset "Reibverluste (Offset)" SWORD FORMULA_0784 0 0 -100.0000 200.0000 ECU_ADDRESS 0x3FBF64 /end MEASUREMENT
/begin MEASUREMENT md_ind_reib_abreg "Reibverluste (Abregelung nach Start)" SWORD FORMULA_0785 0 0 -100.0000 1000.0000 ECU_ADDRESS 0x3FBF66 /end MEASUREMENT
/begin MEASUREMENT md_ind_reib "Reibverluste (Summe)" SWORD FORMULA_0009 0 0 -100.0000 1000.0000 ECU_ADDRESS 0x3FBF68 /end MEASUREMENT
/begin MEASUREMENT md_ind_lw_min "LW-Verluste bei MIN" SWORD FORMULA_0009 0 0 -100.0000 1000.0000 ECU_ADDRESS 0x3FBF6A /end MEASUREMENT
/begin MEASUREMENT md_ind_lw_max "LW-Verluste bei MAX" SWORD FORMULA_0009 0 0 -100.0000 1000.0000 ECU_ADDRESS 0x3FBF6C /end MEASUREMENT
/begin MEASUREMENT md_ind_lw_ist "LW-Verluste" SWORD FORMULA_0009 0 0 -100.0000 1000.0000 ECU_ADDRESS 0x3FBF6E /end MEASUREMENT
/begin MEASUREMENT md_ind_schlepp_max "Schleppmoment bei MAX" SWORD FORMULA_0009 0 0 -100.0000 1000.0000 ECU_ADDRESS 0x3FBF70 /end MEASUREMENT
/begin MEASUREMENT md_verbraucher "Verbraucher" SWORD FORMULA_0009 0 0 -100.0000 1000.0000 ECU_ADDRESS 0x3FBF72 /end MEASUREMENT
/begin MEASUREMENT md_verbr_fzg "Verbraucheroffset Fzg" SWORD FORMULA_0009 0 0 -100.0000 1000.0000 ECU_ADDRESS 0x3FBF74 /end MEASUREMENT
/begin MEASUREMENT md_start_offset "Offset beim Start" SWORD FORMULA_0009 0 0 -100.0000 1000.0000 ECU_ADDRESS 0x3FBF76 /end MEASUREMENT
/begin MEASUREMENT md_ind_min_roh "indiziertes Minimalmoment ohne Verbraucher" SWORD FORMULA_0009 0 0 -100.0000 1000.0000 ECU_ADDRESS 0x3FBF78 /end MEASUREMENT
/begin MEASUREMENT md_ind_min "indiziertes Minimalmoment" SWORD FORMULA_0009 0 0 -100.0000 1000.0000 ECU_ADDRESS 0x3FBF7A /end MEASUREMENT
/begin MEASUREMENT md_ind_max_roh "ind. Maximalmoment" SWORD FORMULA_0009 0 0 -100.0000 1000.0000 ECU_ADDRESS 0x3FBF7C /end MEASUREMENT
/begin MEASUREMENT md_ind_max "ind. Maximalmoment mit LA-Korr" SWORD FORMULA_0009 0 0 -100.0000 1000.0000 ECU_ADDRESS 0x3FBF7E /end MEASUREMENT
/begin MEASUREMENT md_ind_opt "Indiziertes Istmoment" SWORD FORMULA_0009 0 0 -100.0000 1000.0000 ECU_ADDRESS 0x3FBF80 /end MEASUREMENT
/begin MEASUREMENT md_ind_opt_la "ind. Istmoment mit LA-Einfluss" SWORD FORMULA_0009 0 0 -100.0000 1000.0000 ECU_ADDRESS 0x3FBF82 /end MEASUREMENT
/begin MEASUREMENT md_ind_opt_la_rg "ind. Istmoment mit LA-/RG-Einfluss" SWORD FORMULA_0009 0 0 -100.0000 1000.0000 ECU_ADDRESS 0x3FBF84 /end MEASUREMENT
/begin MEASUREMENT md_ind_ve "ind. Moment vor Eingriff" SWORD FORMULA_0009 0 0 -100.0000 1000.0000 ECU_ADDRESS 0x3FBF86 /end MEASUREMENT
/begin MEASUREMENT md_eta_la_vl "ETA-Lambda-VL" UWORD FORMULA_0435 0 0 0.0 150.0000 ECU_ADDRESS 0x3FBF88 /end MEASUREMENT
/begin MEASUREMENT md_eta_la_ist "ETA-Lambda-Ist" UWORD FORMULA_0435 0 0 0.0 150.0000 ECU_ADDRESS 0x3FBF8A /end MEASUREMENT
/begin MEASUREMENT md_eta_rg_lw "ETA-Restgas-Lastwechsel" UWORD FORMULA_0435 0 0 0.0 150.0000 ECU_ADDRESS 0x3FBF8E /end MEASUREMENT
/begin MEASUREMENT md_eta_rg_brenn "ETA-Restgas-Verbrennung" UWORD FORMULA_0435 0 0 0.0 150.0000 ECU_ADDRESS 0x3FBF90 /end MEASUREMENT
/begin MEASUREMENT md_eta_zw_min "Wirkungsgrad tz_min" UWORD FORMULA_0435 0 0 0.0 150.0000 ECU_ADDRESS 0x3FBF92 /end MEASUREMENT
/begin MEASUREMENT md_eta_zw_stat "Wirkungsgrad tz_stat" UWORD FORMULA_0435 0 0 0.0 150.0000 ECU_ADDRESS 0x3FBF94 /end MEASUREMENT
/begin MEASUREMENT md_eta_zw_kr "Wirkungsgrad dtz_sum" UWORD FORMULA_0435 0 0 0.0 150.0000 ECU_ADDRESS 0x3FBF96 /end MEASUREMENT
/begin MEASUREMENT md_eta_zw_kh "Wirkungsgrad tz_kh" UWORD FORMULA_0435 0 0 0.0 150.0000 ECU_ADDRESS 0x3FBF98 /end MEASUREMENT
/begin MEASUREMENT md_eta_zw_kh_kr "Wirkungsgrad tz_kh+kr" UWORD FORMULA_0435 0 0 0.0 150.0000 ECU_ADDRESS 0x3FBF9A /end MEASUREMENT
/begin MEASUREMENT md_eta_zw_ve "Wirkungsgrad tz_ve" UWORD FORMULA_0435 0 0 0.0 150.0000 ECU_ADDRESS 0x3FBF9C /end MEASUREMENT
/begin MEASUREMENT md_eta_zw_ne "Wirkungsgrad nach Eingriff" UWORD FORMULA_0435 0 0 0.0 150.0000 ECU_ADDRESS 0x3FBF9E /end MEASUREMENT
/begin MEASUREMENT md_eta_ausblend "ETA-Ausblend" UWORD FORMULA_0435 0 0 0.0 150.0000 ECU_ADDRESS 0x3FBFA0 /end MEASUREMENT
/begin MEASUREMENT md_eta_ausbl_sk "ETA-Ausblend ueber SK" UWORD FORMULA_0435 0 0 0.0 150.0000 ECU_ADDRESS 0x3FBFA2 /end MEASUREMENT
/begin MEASUREMENT md_eta_zw_soll "Sollwirkungsgrad" UWORD FORMULA_0435 0 0 0.0 150.0000 ECU_ADDRESS 0x3FBFA4 /end MEASUREMENT
/begin MEASUREMENT md_zw_opt "opt. Z�ndwinkel" SWORD FORMULA_0111 0 0 -50.0000 60.0000 ECU_ADDRESS 0x3FBFA6 /end MEASUREMENT
/begin MEASUREMENT md_zw_rg_delta "RG-Delta" SWORD FORMULA_0111 0 0 -50.0000 60.0000 ECU_ADDRESS 0x3FBFA8 /end MEASUREMENT
/begin MEASUREMENT md_zw_opt_rg "opt. ZW mit RG" SWORD FORMULA_0111 0 0 -50.0000 60.0000 ECU_ADDRESS 0x3FBFAA /end MEASUREMENT
/begin MEASUREMENT md_zw_tmot_delta "Tmot-Delta" SWORD FORMULA_0111 0 0 -50.0000 60.0000 ECU_ADDRESS 0x3FBFAC /end MEASUREMENT
/begin MEASUREMENT md_zw_opt_rg_tmot "opt. ZW mit RG Tmot" SWORD FORMULA_0111 0 0 -50.0000 60.0000 ECU_ADDRESS 0x3FBFAE /end MEASUREMENT
/begin MEASUREMENT md_zw_la_ist_delta "Lambda-Delta" SWORD FORMULA_0111 0 0 -50.0000 60.0000 ECU_ADDRESS 0x3FBFB0 /end MEASUREMENT
/begin MEASUREMENT md_zw_opt_rg_tmot_la "opt. ZW mit RG Tmot LA" SWORD FORMULA_0111 0 0 -50.0000 60.0000 ECU_ADDRESS 0x3FBFB2 /end MEASUREMENT
/begin MEASUREMENT md_polynom_a "Polynom_a" SWORD FORMULA_0786 0 0 -320.0000 320.0000 ECU_ADDRESS 0x3FBFB4 /end MEASUREMENT
/begin MEASUREMENT md_polynom_b "Polynom_b" SWORD FORMULA_0786 0 0 -320.0000 320.0000 ECU_ADDRESS 0x3FBFB6 /end MEASUREMENT
/begin MEASUREMENT md_kr_filter "gefilteter tz_kr pro Zyl" SWORD FORMULA_0111 0 0 -50.0000 60.0000 ECU_ADDRESS 0x3FBFB8 /end MEASUREMENT
/begin MEASUREMENT md_puls_timer "Generator-Timer" UWORD FORMULA_0117 0 0 0.0 325.0000 ECU_ADDRESS 0x3FBFBA /end MEASUREMENT
/begin MEASUREMENT md_kupp_wunsch_puls "Stollis Pulsgenerator" SWORD FORMULA_0009 0 0 -100.0000 1000.0000 ECU_ADDRESS 0x3FBFBC /end MEASUREMENT
/begin MEASUREMENT md_n_grad_fil "gef. Gradient" SWORD FORMULA_0114 0 0 -10000.0000 10000.0000 ECU_ADDRESS 0x3FBFBE /end MEASUREMENT
/begin MEASUREMENT md_kupp_ist_schw "schwules Istmoment" SWORD FORMULA_0009 0 0 -100.0000 1000.0000 ECU_ADDRESS 0x3FBFC0 /end MEASUREMENT
/begin MEASUREMENT md_kupp_max_mdrv "CAN-Maximalmoment bei MDrv" SWORD FORMULA_0009 0 0 -100.0000 1000.0000 ECU_ADDRESS 0x3FBFC2 /end MEASUREMENT
/begin MEASUREMENT md_kupp_min_schub "min. Kupplungsschubmoment" SWORD FORMULA_0009 0 0 -100.0000 1000.0000 ECU_ADDRESS 0x3FBFC4 /end MEASUREMENT
/* ------------------ Abschnitt erzeugt aus md_can.dat ------------------ */
/begin CHARACTERISTIC K_MD_ASC_ENABLE "ASC-Freigabe | EN: ASC enable" VALUE 0x76B14 TKW_VV_VV_UB 100.0 FORMULA_0798 0.0 255.0 /end CHARACTERISTIC
/begin CHARACTERISTIC K_MD_MSR_ENABLE "MSR-Freigabe" VALUE 0x76B15 TKW_VV_VV_UB 100.0 FORMULA_0798 0.0 255.0 /end CHARACTERISTIC
/begin CHARACTERISTIC K_MD_MSR_MAX "max. MSR-Vorgabe | EN: Maximum MSR (engine drag control) request [Nm]" VALUE 0x76B16 TKW_VV_VV_SW 100.0 FORMULA_0009 -100.0000 1000.0000 FORMAT "%4.1" /end CHARACTERISTIC
/begin CHARACTERISTIC K_MD_MSR_T_WAIT "Wartezeit vor MSR-Rampe | EN: Wait time before MSR ramp [s]" VALUE 0x76B18 TKW_VV_VV_UW 100.0 FORMULA_0117 0.0 10.0000 FORMAT "%5.2" /end CHARACTERISTIC
/begin CHARACTERISTIC K_MD_MSR_M_RAMPE "Steigung MSR-Rampe | EN: Slope of MSR ramp [Nm/s]" VALUE 0x76B1A TKW_VV_VV_SW 100.0 FORMULA_0571 -5000.0000 5000.0000 /end CHARACTERISTIC
/begin CHARACTERISTIC K_MD_ASC_AUSBLEND_HYS "Hysterese �ber Schleppmoment | EN: Hysteresis over drag torque [Nm]" VALUE 0x76B1C TKW_VV_VV_SW 100.0 FORMULA_0009 -100.0000 1000.0000 FORMAT "%4.1" /end CHARACTERISTIC
/begin CHARACTERISTIC K_MD_ASC_T_WAIT "Wartezeit vor ASC-Rampe | EN: Wait time before ASC ramp [s]" VALUE 0x76B1E TKW_VV_VV_UW 100.0 FORMULA_0117 0.0 10.0000 FORMAT "%5.2" /end CHARACTERISTIC
/begin CHARACTERISTIC K_MD_ASC_M_RAMPE "Steigung ASC-Rampe | EN: Slope of ASC ramp [Nm/s]" VALUE 0x76B20 TKW_VV_VV_SW 100.0 FORMULA_0571 -5000.0000 5000.0000 /end CHARACTERISTIC
/begin CHARACTERISTIC K_MD_ASC_M_AEBEGR "Aenderungsbegrenzung nach ASC-Eingr | EN: Rate limit after ASC intervention [Nm/s]" VALUE 0x76B22 TKW_VV_VV_SW 100.0 FORMULA_0571 -5000.0000 20000.0000 /end CHARACTERISTIC
/begin CHARACTERISTIC K_MD_CAN_ETA_ZW_OFF "ASC-Freigabe | EN: ASC enable [%]" VALUE 0x76B24 TKW_VV_VV_UW 100.0 FORMULA_0435 0.0 150.0000 FORMAT "%4.1" /end CHARACTERISTIC
/begin CHARACTERISTIC K_MD_CAN_BEGR_ST "MD-Begrenzungen default" VALUE 0x76B26 TKW_VV_VV_UB 100.0 FORMULA_0268 0.0 255.0 /end CHARACTERISTIC
/begin CHARACTERISTIC K_MD_KKOS_DYN_ST "Triggerschwelle fuer BA | EN: Trigger threshold for BA" VALUE 0x76B27 TKW_VV_VV_UB 100.0 FORMULA_0003 0.0 255.0000 /end CHARACTERISTIC
/begin CHARACTERISTIC K_MD_KKOS_TMOT_MAX "tmot fuer KKOS | EN: Engine temperature for A/C compressor [°C]" VALUE 0x76B28 TKW_VV_VV_SW 100.0 FORMULA_0023 -50.0000 170.0000 FORMAT "%4.1" /end CHARACTERISTIC
/begin CHARACTERISTIC K_MD_KKOS_TMOT_MAX_HYS "tmot fuer KKOS - Hys | EN: Engine temperature for A/C compressor - hysteresis" VALUE 0x76B2A TKW_VV_VV_SW 100.0 FORMULA_0076 -1000.0000 1000.0000 FORMAT "%4.1" /end CHARACTERISTIC
/begin CHARACTERISTIC K_MD_KKOS_ELU_TMOT_MAX "tmot fuer KKOS bei def. ELU | EN: Engine temperature for A/C cut with defective electric fan [°C]" VALUE 0x76B2C TKW_VV_VV_SW 100.0 FORMULA_0023 -50.0000 170.0000 FORMAT "%4.1" /end CHARACTERISTIC
/begin CHARACTERISTIC K_MD_KKOS_ELU_TMOT_MAX_HYS "tmot fuer KKOS bei def. ELU - Hys | EN: Engine temperature for A/C cut with defective electric fan - hysteresis" VALUE 0x76B2E TKW_VV_VV_SW 100.0 FORMULA_0076 -1000.0000 1000.0000 FORMAT "%4.1" /end CHARACTERISTIC
/begin CHARACTERISTIC K_MD_KKOS_N_MAX "nmax fuer KKOS | EN: Maximum engine speed for A/C compressor [Upm]" VALUE 0x76B30 TKW_VV_VV_SW 100.0 FORMULA_0006 0.0 10000.0000 /end CHARACTERISTIC
/begin CHARACTERISTIC K_MD_KKOS_N_MAX_HYS "nmax fuer KKOS - Hys | EN: Maximum engine speed for A/C compressor - hysteresis [Upm]" VALUE 0x76B32 TKW_VV_VV_SW 100.0 FORMULA_0006 0.0 10000.0000 /end CHARACTERISTIC
/begin CHARACTERISTIC K_MD_KKOS_N "Schwelle fuer BA-/VL | EN: Threshold for BA/full load [Upm]" VALUE 0x76B34 TKW_VV_VV_SW 100.0 FORMULA_0006 0.0 10000.0000 /end CHARACTERISTIC
/begin CHARACTERISTIC K_MD_KKOS_V_VL "Schwelle fuer VL | EN: Schwelle fuer VL" VALUE 0x76B36 TKW_VV_VV_SW 100.0 FORMULA_0078 -80.0000 360.0000 FORMAT "%4.1" /end CHARACTERISTIC
/begin CHARACTERISTIC K_MD_KKOS_V_VL_AUS "Schwelle fuer VL aus | EN: Schwelle fuer VL aus" VALUE 0x76B38 TKW_VV_VV_SW 100.0 FORMULA_0078 -80.0000 360.0000 FORMAT "%4.1" /end CHARACTERISTIC
/begin CHARACTERISTIC K_MD_KKOS_V_BA "Schwelle fuer Beschl. | EN: Schwelle fuer Beschl." VALUE 0x76B3A TKW_VV_VV_SW 100.0 FORMULA_0078 -80.0000 360.0000 FORMAT "%4.1" /end CHARACTERISTIC
/begin CHARACTERISTIC K_MD_KKOS_TIME_START "Schwelle Startfreigabe | EN: Schwelle Startfreigabe" VALUE 0x76B3C TKW_VV_VV_UW 100.0 FORMULA_0021 0.0 655.0000 FORMAT "%5.2" /end CHARACTERISTIC
/begin CHARACTERISTIC K_MD_KKOS_TIME_BA_VL "Schwelle BA-/VL-Freigabe | EN: Schwelle BA-/VL-Freigabe" VALUE 0x76B3E TKW_VV_VV_UW 100.0 FORMULA_0021 0.0 655.0000 FORMAT "%5.2" /end CHARACTERISTIC
/begin CHARACTERISTIC K_MD_KKOS_TIME_WH "Schwelle WH-Freigabe | EN: Schwelle WH-Freigabe" VALUE 0x76B40 TKW_VV_VV_UW 100.0 FORMULA_0021 0.0 655.0000 FORMAT "%5.2" /end CHARACTERISTIC
/begin CHARACTERISTIC K_MD_KKOS_START "Faktor Startoffset | EN: Faktor Startoffset" VALUE 0x76B42 TKW_VV_VV_UW 100.0 FORMULA_0075 0.0 4.0000 FORMAT "%6.3" /end CHARACTERISTIC
/begin CHARACTERISTIC K_MD_KKOS_TAU_ON "TAU KKOS-Aufregel | EN: TAU KKOS-Aufregel" VALUE 0x76B44 TKW_VV_VV_UB 100.0 FORMULA_0478 0.0051 1.2800 /end CHARACTERISTIC
/begin CHARACTERISTIC K_MD_KKOS_TAU_OFF "TAU KKOS-Aufregel | EN: TAU KKOS-Aufregel" VALUE 0x76B45 TKW_VV_VV_UB 100.0 FORMULA_0478 0.0051 1.2800 /end CHARACTERISTIC
/begin CHARACTERISTIC K_MD_KKOS_MIN "Einschaltschwelle | EN: Einschaltschwelle" VALUE 0x76B46 TKW_VV_VV_SW 100.0 FORMULA_0009 -100.0000 1000.0000 FORMAT "%4.1" /end CHARACTERISTIC
/begin CHARACTERISTIC K_MD_KKOS_MAX "KKOS-Begrenzung | EN: KKOS-Begrenzung" VALUE 0x76B48 TKW_VV_VV_SW 100.0 FORMULA_0009 -100.0000 1000.0000 FORMAT "%4.1" /end CHARACTERISTIC
/begin CHARACTERISTIC K_MD_KKOS_RES_RAMPE_ON "Steigung Res-Rampe an | EN: Steigung Res-Rampe an" VALUE 0x76B4A TKW_VV_VV_UB 100.0 FORMULA_0799 0.0 2550.0000 /end CHARACTERISTIC
/begin CHARACTERISTIC K_MD_KKOS_RES_RAMPE_OFF "Steigung Res-Rampe aus | EN: Nm/s  0p 0 -x*10 Steigung Res-Rampe aus" VALUE 0x76B4B TKW_VV_VV_UB 100.0 FORMULA_0800 0.0 -2550.0000 /end CHARACTERISTIC
/begin CHARACTERISTIC K_MD_KKOS_RES_T_MAX "Maxzeit fuer Reserve | EN: Maxzeit fuer Reserve" VALUE 0x76B4C TKW_VV_VV_UW 100.0 FORMULA_0021 0.0 655.0000 FORMAT "%5.2" /end CHARACTERISTIC
/begin CHARACTERISTIC K_MD_KKOS_ZH_TMOT "Motortemp. fuer ZH-Reserve | EN: Motortemp. fuer ZH-Reserve" VALUE 0x76B4E TKW_VV_VV_SW 100.0 FORMULA_0023 -50.0000 170.0000 FORMAT "%4.1" /end CHARACTERISTIC
/begin CHARACTERISTIC K_MD_KKOS_ZH_TUMG "Umgebungstemp. fuer ZH-Reserve | EN: Umgebungstemp. fuer ZH-Reserve" VALUE 0x76B50 TKW_VV_VV_SW 100.0 FORMULA_0023 -50.0000 170.0000 FORMAT "%4.1" /end CHARACTERISTIC
/begin CHARACTERISTIC K_MD_KKOS_ZH_RES_T_MAX "Maxzeit fuer ZH-Reserve | EN: Maxzeit fuer ZH-Reserve" VALUE 0x76B52 TKW_VV_VV_UW 100.0 FORMULA_0021 0.0 655.0000 FORMAT "%5.2" /end CHARACTERISTIC
/begin CHARACTERISTIC K_MD_KKOS_CAN_MAX "KKOS-Begrenzung | EN: KKOS-Begrenzung" VALUE 0x76B54 TKW_VV_VV_SW 100.0 FORMULA_0009 -100.0000 1000.0000 FORMAT "%4.1" /end CHARACTERISTIC
/begin CHARACTERISTIC K_MD_KKOS_ZH_RES_RAMPE "Steigung ZH-Reserve-Rampe | EN: Steigung ZH-Reserve-Rampe" VALUE 0x76B56 TKW_VV_VV_UB 100.0 FORMULA_0799 0.0 2550.0000 /end CHARACTERISTIC
/begin CHARACTERISTIC K_MD_LRW_TAU "TAU KKOS-Aufregel | EN: TAU KKOS-Aufregel" VALUE 0x76B57 TKW_VV_VV_UB 100.0 FORMULA_0462 0.0101 2.5600 /end CHARACTERISTIC
/begin CHARACTERISTIC K_MD_LRW_RES_DELTA "LRW-Begrenzung | EN: LRW-Begrenzung" VALUE 0x76B58 TKW_VV_VV_UB 100.0 FORMULA_0799 0.0 2550.0000 /end CHARACTERISTIC
/begin CHARACTERISTIC K_MD_GEN_FREISCHALT "Genarator-Freigabe | EN: 0 gesperrt 1 frei ELSE ungueltig Genarator-Freigabe" VALUE 0x76B59 TKW_VV_VV_UB 100.0 FORMULA_0798 0.0 255.0 /end CHARACTERISTIC
/begin CHARACTERISTIC K_MD_LRW_RES_V "LRW-v-Schwelle | EN: LRW-v-Schwelle" VALUE 0x76B5A TKW_VV_VV_SW 100.0 FORMULA_0078 -80.0000 360.0000 FORMAT "%4.1" /end CHARACTERISTIC
/begin CHARACTERISTIC K_MD_LRW_RES_V_HYS "LRW-v-Schwelle Hys | EN: LRW-v-Schwelle Hys" VALUE 0x76B5C TKW_VV_VV_SW 100.0 FORMULA_0078 -80.0000 360.0000 FORMAT "%4.1" /end CHARACTERISTIC
/begin CHARACTERISTIC K_MD_GEN_MAX "max. Generatormoment | EN: max. Generatormoment" VALUE 0x76B5E TKW_VV_VV_SW 100.0 FORMULA_0009 -100.0000 1000.0000 FORMAT "%4.1" /end CHARACTERISTIC
/begin CHARACTERISTIC KL_MD_KKOS_DELAY_ON "KKOS-Delay beim Einschalten | EN: A/C compressor delay on switch-on" CURVE 0x76B60 TKL_SW_VV_SW 100.0 FORMULA_0021 0.0 10.0000 /begin AXIS_DESCR STD_AXIS n FORMULA_0006 4 0.0 10000.0000 /end AXIS_DESCR FORMAT "%5.2" /end CHARACTERISTIC
/begin CHARACTERISTIC KL_MD_KKOS_DELAY_OFF "KKOS-Delay beim Ausschalten | EN: A/C compressor delay on switch-off" CURVE 0x76B72 TKL_SW_VV_SW 100.0 FORMULA_0021 0.0 10.0000 /begin AXIS_DESCR STD_AXIS n FORMULA_0006 4 0.0 10000.0000 /end AXIS_DESCR FORMAT "%5.2" /end CHARACTERISTIC
/begin CHARACTERISTIC KL_MD_KKOS_RES_MAX "KKOS-Reserve | EN: A/C compressor reserve" CURVE 0x76B84 TKL_SW_VV_SW 100.0 FORMULA_0009 -100.0000 1000.0000 /begin AXIS_DESCR STD_AXIS n FORMULA_0006 4 0.0 10000.0000 /end AXIS_DESCR FORMAT "%4.1" /end CHARACTERISTIC
/begin CHARACTERISTIC KL_MD_KKOS_ZH_RES_MAX "KKOS-Reserve | EN: A/C compressor reserve" CURVE 0x76B96 TKL_SW_VV_SW 100.0 FORMULA_0009 -100.0000 1000.0000 /begin AXIS_DESCR STD_AXIS n FORMULA_0006 4 0.0 10000.0000 /end AXIS_DESCR FORMAT "%4.1" /end CHARACTERISTIC
/begin CHARACTERISTIC KL_MD_LRW_FAK "Faktor auf LRW-Moment | EN: Factor on steering-angle torque" CURVE 0x76BA8 TKL_SW_VV_UW 100.0 FORMULA_0075 0.0 4.0000 /begin AXIS_DESCR STD_AXIS n FORMULA_0006 6 0.0 10000.0000 /end AXIS_DESCR FORMAT "%6.3" /end CHARACTERISTIC
/begin CHARACTERISTIC KL_MD_LRW_RES "LRW-Reserve | EN: LRW-Reserve" CURVE 0x76BC2 TKL_SW_VV_SW 100.0 FORMULA_0009 -100.0000 1000.0000
 /begin AXIS_DESCR STD_AXIS can_lrw FORMULA_0141 4 -1440.1536 1440.1096 FORMAT "%5.2" /end AXIS_DESCR
 FORMAT "%4.1" /end CHARACTERISTIC
/begin CHARACTERISTIC KF_MD_KKOS_KORR "Korrigiertes KKOS-Moment | EN: Corrected A/C compressor torque" MAP 0x76BD4 TKF_SW_SW_SW 100.0 FORMULA_0009 -100.0000 1000.0000 /begin AXIS_DESCR STD_AXIS n FORMULA_0006 5 0.0 10000.0000 /end AXIS_DESCR
 /begin AXIS_DESCR STD_AXIS kkos_in FORMULA_0009 5 -100.0000 1000.0000 FORMAT "%4.1" /end AXIS_DESCR
 FORMAT "%4.1" /end CHARACTERISTIC
/begin CHARACTERISTIC KF_MD_LRW "LRW-Moment | EN: LRW-Moment" MAP 0x76C1C TKF_SW_SW_SW 100.0 FORMULA_0009 -100.0000 1000.0000
 /begin AXIS_DESCR STD_AXIS can_lrw FORMULA_0141 6 -1440.1536 1440.1096 FORMAT "%5.2" /end AXIS_DESCR
 /begin AXIS_DESCR STD_AXIS can_lrw_v FORMULA_0142 6 -1440.1536 1440.1096 FORMAT "%5.2" /end AXIS_DESCR
 FORMAT "%4.1" /end CHARACTERISTIC
/begin MEASUREMENT md_kupp_asc_ml "ASC-Sollmoment Luft" SWORD FORMULA_0009 0 0 -100.0000 1000.0000 ECU_ADDRESS 0x3FBFC6 /end MEASUREMENT
/begin MEASUREMENT md_kupp_asc_tz "ASC-Sollmoment TZ" SWORD FORMULA_0009 0 0 -100.0000 1000.0000 ECU_ADDRESS 0x3FBFC8 /end MEASUREMENT
/begin MEASUREMENT md_kupp_msr_ml "MSR-Sollmoment Luft" SWORD FORMULA_0009 0 0 -100.0000 1000.0000 ECU_ADDRESS 0x3FBFCA /end MEASUREMENT
/begin MEASUREMENT md_kupp_msr_tz "MSR-Sollmoment TZ" SWORD FORMULA_0009 0 0 -100.0000 1000.0000 ECU_ADDRESS 0x3FBFCC /end MEASUREMENT
/begin MEASUREMENT md_dsc_t_wait "Wartezeit vor DSC-Rampe" UWORD FORMULA_0596 0 0 0.0 10.0000 ECU_ADDRESS 0x3FBFCE /end MEASUREMENT
/begin MEASUREMENT md_kkos_freig_st "KKOS-Freigabe" UBYTE FORMULA_0794 0 0 0.0 255.0 ECU_ADDRESS 0x3FBFD0 /end MEASUREMENT
/begin MEASUREMENT md_kkos_sperr_st "KKOS-Sperre" UBYTE FORMULA_0795 0 0 0.0 255.0 ECU_ADDRESS 0x3FBFD1 /end MEASUREMENT
/begin MEASUREMENT md_kkos_s "KKOS-Schalter" UBYTE FORMULA_0796 0 0 0.0 255.0 ECU_ADDRESS 0x3FBFD2 /end MEASUREMENT
/begin MEASUREMENT md_kkos_zust "KKOS-Zustand" UBYTE FORMULA_0797 0 0 0.0 255.0 ECU_ADDRESS 0x3FBFD3 /end MEASUREMENT
/begin MEASUREMENT md_kkos_time_ba "Zeit BA-Abschaltung" UWORD FORMULA_0021 0 0 0.0 10.0000 ECU_ADDRESS 0x3FBFD4 /end MEASUREMENT
/begin MEASUREMENT md_kkos_time_vl "Zeit VL-Abschaltung" UWORD FORMULA_0021 0 0 0.0 10.0000 ECU_ADDRESS 0x3FBFD6 /end MEASUREMENT
/begin MEASUREMENT md_kkos_time_wh "Zeit WH-Abschaltung" UWORD FORMULA_0021 0 0 0.0 10.0000 ECU_ADDRESS 0x3FBFD8 /end MEASUREMENT
/begin MEASUREMENT md_kkos_time_delay "Zeit Delay" UWORD FORMULA_0021 0 0 0.0 10.0000 ECU_ADDRESS 0x3FBFDA /end MEASUREMENT
/begin MEASUREMENT md_kkos "MD-Anf KKOS aus KF+Adapt" SWORD FORMULA_0009 0 0 -100.0000 1000.0000 ECU_ADDRESS 0x3FBFDC /end MEASUREMENT
/begin MEASUREMENT md_kkos_res_max "Maxwert fuer KKOS-Reserve" SWORD FORMULA_0009 0 0 -100.0000 1000.0000 ECU_ADDRESS 0x3FBFDE /end MEASUREMENT
/begin MEASUREMENT md_kkos_res "KKOS-Reserve" SWORD FORMULA_0009 0 0 -100.0000 1000.0000 ECU_ADDRESS 0x3FBFE0 /end MEASUREMENT
/begin MEASUREMENT md_kkos_time_res "MaxZeit fuer KKOS-Reserve" UWORD FORMULA_0021 0 0 0.0 10.0000 ECU_ADDRESS 0x3FBFE2 /end MEASUREMENT
/begin MEASUREMENT md_kkos_zh_res_max "Maxwert fuer KKOS-Reserve" SWORD FORMULA_0009 0 0 -100.0000 1000.0000 ECU_ADDRESS 0x3FBFE4 /end MEASUREMENT
/begin MEASUREMENT md_kkos_zh_res "KKOS-Reserve" SWORD FORMULA_0009 0 0 -100.0000 1000.0000 ECU_ADDRESS 0x3FBFE6 /end MEASUREMENT
/begin MEASUREMENT md_kkos_zh_time_res "MaxZeit fuer KKOS-Reserve" UWORD FORMULA_0021 0 0 0.0 10.0000 ECU_ADDRESS 0x3FBFE8 /end MEASUREMENT
/begin MEASUREMENT md_lrw "MD-Anf LRW aus KF" SWORD FORMULA_0009 0 0 -100.0000 1000.0000 ECU_ADDRESS 0x3FBFEA /end MEASUREMENT
/begin MEASUREMENT md_lrw_fil "MD-Anf LRW mit Filter" SWORD FORMULA_0009 0 0 -100.0000 1000.0000 ECU_ADDRESS 0x3FBFEC /end MEASUREMENT
/begin MEASUREMENT md_lrw_res "LRW-Reserve" SWORD FORMULA_0009 0 0 -100.0000 1000.0000 ECU_ADDRESS 0x3FBFEE /end MEASUREMENT
/begin MEASUREMENT md_gen_st "Generatorstatus" UBYTE FORMULA_0122 0 0 0.0 255.0 ECU_ADDRESS 0x3FBFF0 /end MEASUREMENT
/begin MEASUREMENT md_gen "Generatormoment" SWORD FORMULA_0009 0 0 -100.0000 1000.0000 ECU_ADDRESS 0x3FBFF2 /end MEASUREMENT
/begin MEASUREMENT md_exd_kkos_max "ExdKKOS Maxwert" SWORD FORMULA_0009 0 0 -100.0000 1000.0000 ECU_ADDRESS 0x3FBFF4 /end MEASUREMENT
/begin MEASUREMENT md_exd_kkos_timeout "ExdKKOS Timeout" UWORD FORMULA_0021 0 0 0.0 655.0000 ECU_ADDRESS 0x3FBFF6 /end MEASUREMENT
/* ------------------ Abschnitt erzeugt aus md_filter.dat ------------------ */
/begin CHARACTERISTIC K_MD_CFG_DYN_FIL "Filterkonfiguration" VALUE 0x76C7E TKW_VV_VV_UB 100.0 FORMULA_0813 0.0 255.0 /end CHARACTERISTIC
/begin CHARACTERISTIC K_MD_HYS_RICHTUNG "Hysterese fuer Richtungserkennung | EN: Hysteresis for direction detection [Nm/s]" VALUE 0x76C7F TKW_VV_VV_UB 100.0 FORMULA_0748 0.0 255.0000 /end CHARACTERISTIC
/begin CHARACTERISTIC K_MD_HYS_SA "Offset auf Schleppmoment inkl. EtaMin | EN: Offset on drag torque incl. EtaMin [Nm]" VALUE 0x76C80 TKW_VV_VV_SW 100.0 FORMULA_0009 -100.0000 1000.0000 FORMAT "%4.1" /end CHARACTERISTIC
/begin CHARACTERISTIC K_MD_HYS_SA_TZ "Offset auf tz_min | EN: Offset on tz_min (latest ignition) [°KW]" VALUE 0x76C82 TKW_VV_VV_SW 100.0 FORMULA_0111 -50.0000 60.0000 FORMAT "%4.1" /end CHARACTERISTIC
/begin CHARACTERISTIC K_MD_GRAD_SA "SaWe-Schrittweite fuer TZmin erreicht | EN: Switching step size when TZmin reached [Nm/s]" VALUE 0x76C84 TKW_VV_VV_SW 100.0 FORMULA_0571 -5000.0000 5000.0000 /end CHARACTERISTIC
/begin CHARACTERISTIC K_MD_GRAD_SA_CUF "SaWe-Schrittweite bei CUF | EN: Switching step size during fuel cut-off [Nm/s]" VALUE 0x76C86 TKW_VV_VV_SW 100.0 FORMULA_0571 -100000.0000 -1.0000 /end CHARACTERISTIC
/begin CHARACTERISTIC K_MD_GRAD_SA_VMA "SaWe-Schrittweite bei VMA | EN: Switching step size during VMA [Nm/s]" VALUE 0x76C88 TKW_VV_VV_SW 100.0 FORMULA_0571 1.0000 100000.0000 /end CHARACTERISTIC
/begin CHARACTERISTIC K_MD_GRAD_LSD_OKS "Gradient ohne Kraftschluss | EN: Gradient without drivetrain engaged [Nm/s]" VALUE 0x76C8A TKW_VV_VV_SW 100.0 FORMULA_0811 0.0 5000.0000 /end CHARACTERISTIC
/begin CHARACTERISTIC K_MD_GRAD_DP_OKS "Gradient ohne Kraftschluss | EN: Gradient without drivetrain engaged [Nm/s]" VALUE 0x76C8C TKW_VV_VV_SW 100.0 FORMULA_0811 -5000.0000 0.0 /end CHARACTERISTIC
/begin CHARACTERISTIC K_MD_DYN_FIL_RES_TAU "Tau der Momentenreserve | EN: Time constant of torque reserve [s]" VALUE 0x76C8E TKW_VV_VV_UB 100.0 FORMULA_0478 0.0051 1.2800 /end CHARACTERISTIC
/begin CHARACTERISTIC K_MD_TAU_FW_DPFIL "Filter fuer DP-Wichtung | EN: Filter for dashpot weighting [s]" VALUE 0x76C8F TKW_VV_VV_UB 100.0 FORMULA_0478 0.0051 1.2800 /end CHARACTERISTIC
/begin CHARACTERISTIC K_MD_ANFF_V_SCHW "Anfahrfilter v-Schwelle" VALUE 0x76C90 TKW_VV_VV_SW 100.0 FORMULA_0078 -80.0000 360.0000 FORMAT "%4.1" /end CHARACTERISTIC
/begin CHARACTERISTIC K_MD_ANFF_PWG_ON "Anfahrfilter Pwg-Schwelle On | EN: Anfahrfilter Pwg-Schwelle On" VALUE 0x76C92 TKW_VV_VV_SW 100.0 FORMULA_0001 -10.0000 120.0000 FORMAT "%4.1" /end CHARACTERISTIC
/begin CHARACTERISTIC K_MD_ANFF_PWG_OFF "Anfahrfilter Pwg-Schwelle Off | EN: Anfahrfilter Pwg-Schwelle Off" VALUE 0x76C94 TKW_VV_VV_SW 100.0 FORMULA_0001 -10.0000 120.0000 FORMAT "%4.1" /end CHARACTERISTIC
/begin CHARACTERISTIC KL_MD_FAK_LSD_B1 "LSD-Faktor Bereich 1 und LLMKS | EN: LSD-Faktor Bereich 1 und LLMKS" CURVE 0x76C96 TKL_SW_VV_UW 100.0 FORMULA_0075 0.0 20.0000
 /begin AXIS_DESCR STD_AXIS md_kupp_wunsch FORMULA_0009 6 -100.0000 1000.0000 FORMAT "%4.1" /end AXIS_DESCR
 FORMAT "%6.3" /end CHARACTERISTIC
/begin CHARACTERISTIC KL_MD_FAK_LSD_B2 "LSD-Faktor Bereich 2 | EN: LSD factor, range 2" CURVE 0x76CB0 TKL_SW_VV_UW 100.0 FORMULA_0075 0.0 20.0000
 /begin AXIS_DESCR STD_AXIS md_kupp_wunsch FORMULA_0009 6 -100.0000 1000.0000 FORMAT "%4.1" /end AXIS_DESCR
 FORMAT "%6.3" /end CHARACTERISTIC
/begin CHARACTERISTIC KL_MD_FAK_LSD_B3 "LSD-Faktor Bereich 3 | EN: LSD factor, range 3" CURVE 0x76CCA TKL_SW_VV_UW 100.0 FORMULA_0075 0.0 20.0000
 /begin AXIS_DESCR STD_AXIS md_kupp_wunsch FORMULA_0009 6 -100.0000 1000.0000 FORMAT "%4.1" /end AXIS_DESCR
 FORMAT "%6.3" /end CHARACTERISTIC
/begin CHARACTERISTIC KL_MD_FAK_DP_B1 "DP-Faktor Bereich 1 und LLMKS | EN: Dashpot factor, range 1 and idle with clutch closed" CURVE 0x76CE4 TKL_SW_VV_UW 100.0 FORMULA_0075 0.0 20.0000
 /begin AXIS_DESCR STD_AXIS md_kupp_wunsch FORMULA_0009 6 -100.0000 1000.0000 FORMAT "%4.1" /end AXIS_DESCR
 FORMAT "%6.3" /end CHARACTERISTIC
/begin CHARACTERISTIC KL_MD_FAK_DP_B2 "DP-Faktor Bereich 2 | EN: DP-Faktor Bereich 2" CURVE 0x76CFE TKL_SW_VV_UW 100.0 FORMULA_0075 0.0 20.0000
 /begin AXIS_DESCR STD_AXIS md_kupp_wunsch FORMULA_0009 6 -100.0000 1000.0000 FORMAT "%4.1" /end AXIS_DESCR
 FORMAT "%6.3" /end CHARACTERISTIC
/begin CHARACTERISTIC KL_MD_FAK_DP_B3 "DP-Faktor Bereich 3 | EN: Dashpot factor, range 3" CURVE 0x76D18 TKL_SW_VV_UW 100.0 FORMULA_0075 0.0 20.0000
 /begin AXIS_DESCR STD_AXIS md_kupp_wunsch FORMULA_0009 6 -100.0000 1000.0000 FORMAT "%4.1" /end AXIS_DESCR
 FORMAT "%6.3" /end CHARACTERISTIC
/begin CHARACTERISTIC KL_MD_FAK_LSD_ANFF "LSD-Faktor Anfahrfilter | EN: LSD factor, pull-away filter" CURVE 0x76D32 TKL_SW_VV_UW 100.0 FORMULA_0075 0.0 20.0000 /begin AXIS_DESCR STD_AXIS gang FORMULA_0486 4 -1.0000 10.0000 /end AXIS_DESCR FORMAT "%6.3" /end CHARACTERISTIC
/begin CHARACTERISTIC KF_MD_KUPP_GRENZ_LSD_U_OFFS "�bergang Bereich 1 nach 2 | EN: Übergang Bereich 1 nach 2" MAP 0x76D44 TKF_SW_SW_SW 100.0 FORMULA_0009 -100.0000 100.0000 /begin AXIS_DESCR STD_AXIS gang FORMULA_0486 7 -1.0000 10.0000 /end AXIS_DESCR /begin AXIS_DESCR STD_AXIS n FORMULA_0006 9 0.0 10000.0000 /end AXIS_DESCR FORMAT "%4.1" /end CHARACTERISTIC
/begin CHARACTERISTIC KF_MD_KUPP_GRENZ_LSD_O "�bergang Bereich 2 nach 3 | EN: Übergang Bereich 2 nach 3" MAP 0x76DE4 TKF_SW_SW_SW 100.0 FORMULA_0009 0.0 1000.0000 /begin AXIS_DESCR STD_AXIS gang FORMULA_0486 7 -1.0000 10.0000 /end AXIS_DESCR /begin AXIS_DESCR STD_AXIS n FORMULA_0006 9 0.0 10000.0000 /end AXIS_DESCR FORMAT "%4.1" /end CHARACTERISTIC
/begin CHARACTERISTIC KF_MD_GRAD_LSD_B1 "Gradient Bereich 1 | EN: Gradient, range 1" MAP 0x76E84 TKF_SW_SW_SW 100.0 FORMULA_0811 0.0 5000.0000 /begin AXIS_DESCR STD_AXIS gang FORMULA_0486 7 -1.0000 10.0000 /end AXIS_DESCR /begin AXIS_DESCR STD_AXIS n FORMULA_0006 9 0.0 10000.0000 /end AXIS_DESCR /end CHARACTERISTIC
/begin CHARACTERISTIC KF_MD_GRAD_LSD_B2 "Gradient Bereich 2 | EN: Gradient, range 2" MAP 0x76F24 TKF_SW_SW_SW 100.0 FORMULA_0811 0.0 5000.0000 /begin AXIS_DESCR STD_AXIS gang FORMULA_0486 7 -1.0000 10.0000 /end AXIS_DESCR /begin AXIS_DESCR STD_AXIS n FORMULA_0006 9 0.0 10000.0000 /end AXIS_DESCR /end CHARACTERISTIC
/begin CHARACTERISTIC KF_MD_GRAD_LSD_B3 "Gradient Bereich 3 | EN: Gradient, range 3" MAP 0x76FC4 TKF_SW_SW_SW 100.0 FORMULA_0811 0.0 5000.0000 /begin AXIS_DESCR STD_AXIS gang FORMULA_0486 7 -1.0000 10.0000 /end AXIS_DESCR /begin AXIS_DESCR STD_AXIS n FORMULA_0006 9 0.0 10000.0000 /end AXIS_DESCR /end CHARACTERISTIC
/begin CHARACTERISTIC KF_MD_GRAD_LSD_LLMKS "Gradient bei LLMKS | EN: Gradient at idle with clutch closed" MAP 0x77064 TKF_SW_SW_SW 100.0 FORMULA_0811 0.0 5000.0000 /begin AXIS_DESCR STD_AXIS gang FORMULA_0486 7 -1.0000 10.0000 /end AXIS_DESCR /begin AXIS_DESCR STD_AXIS n FORMULA_0006 9 0.0 10000.0000 /end AXIS_DESCR /end CHARACTERISTIC
/begin CHARACTERISTIC KF_MD_DELTA_DP_ON "Aktivierungsschwelle | EN: Activation threshold" MAP 0x77104 TKF_SW_SW_SW 100.0 FORMULA_0009 -100.0000 0.0 /begin AXIS_DESCR STD_AXIS gang FORMULA_0486 7 -1.0000 10.0000 /end AXIS_DESCR
 /begin AXIS_DESCR STD_AXIS md_kupp_wunsch FORMULA_0009 9 -100.0000 1000.0000 FORMAT "%4.1" /end AXIS_DESCR
 FORMAT "%4.1" /end CHARACTERISTIC
/begin CHARACTERISTIC KF_MD_KUPP_GRENZ_DP_U_OFFS "�bergang Bereich 1 nach 2 | EN: Transition range 1 to 2" MAP 0x771A4 TKF_SW_SW_SW 100.0 FORMULA_0009 -100.0000 100.0000 /begin AXIS_DESCR STD_AXIS gang FORMULA_0486 7 -1.0000 10.0000 /end AXIS_DESCR /begin AXIS_DESCR STD_AXIS n FORMULA_0006 9 0.0 10000.0000 /end AXIS_DESCR FORMAT "%4.1" /end CHARACTERISTIC
/begin CHARACTERISTIC KF_MD_KUPP_GRENZ_DP_O "�bergang Bereich 2 nach 3 | EN: Transition range 2 to 3" MAP 0x77244 TKF_SW_SW_SW 100.0 FORMULA_0009 0.0 1000.0000 /begin AXIS_DESCR STD_AXIS gang FORMULA_0486 7 -1.0000 10.0000 /end AXIS_DESCR /begin AXIS_DESCR STD_AXIS n FORMULA_0006 9 0.0 10000.0000 /end AXIS_DESCR FORMAT "%4.1" /end CHARACTERISTIC
/begin CHARACTERISTIC KF_MD_GRAD_DP_B1 "Gradient Bereich 1 | EN: Gradient, range 1" MAP 0x772E4 TKF_SW_SW_SW 100.0 FORMULA_0811 -5000.0000 0.0 /begin AXIS_DESCR STD_AXIS gang FORMULA_0486 7 -1.0000 10.0000 /end AXIS_DESCR /begin AXIS_DESCR STD_AXIS n FORMULA_0006 9 0.0 10000.0000 /end AXIS_DESCR /end CHARACTERISTIC
/begin CHARACTERISTIC KF_MD_GRAD_DP_B2 "Gradient Bereich 2 | EN: Gradient, range 2" MAP 0x77384 TKF_SW_SW_SW 100.0 FORMULA_0811 -5000.0000 0.0 /begin AXIS_DESCR STD_AXIS gang FORMULA_0486 7 -1.0000 10.0000 /end AXIS_DESCR /begin AXIS_DESCR STD_AXIS n FORMULA_0006 9 0.0 10000.0000 /end AXIS_DESCR /end CHARACTERISTIC
/begin CHARACTERISTIC KF_MD_GRAD_DP_B3 "Gradient Bereich 3 | EN: Gradient, range 3" MAP 0x77424 TKF_SW_SW_SW 100.0 FORMULA_0811 -5000.0000 0.0 /begin AXIS_DESCR STD_AXIS gang FORMULA_0486 7 -1.0000 10.0000 /end AXIS_DESCR /begin AXIS_DESCR STD_AXIS n FORMULA_0006 9 0.0 10000.0000 /end AXIS_DESCR /end CHARACTERISTIC
/begin CHARACTERISTIC KF_MD_GRAD_DP_LLMKS "Gradient bei LLMKS | EN: Gradient at idle with clutch closed" MAP 0x774C4 TKF_SW_SW_SW 100.0 FORMULA_0811 -5000.0000 0.0 /begin AXIS_DESCR STD_AXIS gang FORMULA_0486 7 -1.0000 10.0000 /end AXIS_DESCR /begin AXIS_DESCR STD_AXIS n FORMULA_0006 9 0.0 10000.0000 /end AXIS_DESCR /end CHARACTERISTIC
/begin CHARACTERISTIC KF_MD_FAK_GRAD_DP_B1 "DP-Wichtung Bereich 1 | EN: DP-Wichtung Bereich 1" MAP 0x77564 TKF_SW_SW_UW 100.0 FORMULA_0075 0.0 20.0000
 /begin AXIS_DESCR STD_AXIS md_kupp_wunsch_grad_max FORMULA_0571 4 -5000.0000 5000.0000 /end AXIS_DESCR
 /begin AXIS_DESCR STD_AXIS md_kupp_wunsch_fil_dp FORMULA_0009 4 -100.0000 1000.0000 FORMAT "%4.1" /end AXIS_DESCR
 FORMAT "%6.3" /end CHARACTERISTIC
/begin CHARACTERISTIC KF_MD_FAK_GRAD_DP_B2 "DP-Wichtung Bereich 2 | EN: Dashpot weighting, range 2" MAP 0x77596 TKF_SW_SW_UW 100.0 FORMULA_0075 0.0 20.0000
 /begin AXIS_DESCR STD_AXIS md_kupp_wunsch_grad_max FORMULA_0571 4 -5000.0000 5000.0000 /end AXIS_DESCR
 /begin AXIS_DESCR STD_AXIS md_kupp_wunsch_fil_dp FORMULA_0009 4 -100.0000 1000.0000 FORMAT "%4.1" /end AXIS_DESCR
 FORMAT "%6.3" /end CHARACTERISTIC
/begin CHARACTERISTIC KF_MD_FAK_GRAD_DP_B3 "DP-Wichtung Bereich 3 | EN: Dashpot weighting, range 3" MAP 0x775C8 TKF_SW_SW_UW 100.0 FORMULA_0075 0.0 20.0000
 /begin AXIS_DESCR STD_AXIS md_kupp_wunsch_grad_max FORMULA_0571 4 -5000.0000 5000.0000 /end AXIS_DESCR
 /begin AXIS_DESCR STD_AXIS md_kupp_wunsch_fil_dp FORMULA_0009 4 -100.0000 1000.0000 FORMAT "%4.1" /end AXIS_DESCR
 FORMAT "%6.3" /end CHARACTERISTIC
/begin CHARACTERISTIC KF_MD_DYN_FIL_RES "Momentenreserve | EN: Torque reserve" MAP 0x775FA TKF_SW_SW_SW 100.0 FORMULA_0009 0.0 1000.0000 /begin AXIS_DESCR STD_AXIS gang FORMULA_0486 7 -1.0000 10.0000 /end AXIS_DESCR
 /begin AXIS_DESCR STD_AXIS md_kupp_wunsch_filter FORMULA_0009 9 -100.0000 1000.0000 FORMAT "%4.1" /end AXIS_DESCR
 FORMAT "%4.1" /end CHARACTERISTIC
/begin CHARACTERISTIC KF_MD_DYN_FIL_RES_FAK "Momentenreserve | EN: Torque reserve" MAP 0x7769A TKF_SW_SW_UW 100.0 FORMULA_0075 0.0 4.0000
 /begin AXIS_DESCR STD_AXIS pwg_soll FORMULA_0001 7 -10.0000 120.0000 FORMAT "%4.1" /end AXIS_DESCR
 /begin AXIS_DESCR STD_AXIS md_kupp_wunsch_filter FORMULA_0009 7 -100.0000 1000.0000 FORMAT "%4.1" /end AXIS_DESCR
 FORMAT "%6.3" /end CHARACTERISTIC
/begin CHARACTERISTIC KF_MD_TAU_LSD_B3 "LSD-Filter Bereich 3 | EN: LSD-Filter Bereich 3" MAP 0x7771A TKF_SW_SW_UW 100.0 FORMULA_0075 0.0 4.0000 /begin AXIS_DESCR STD_AXIS gang FORMULA_0486 7 -1.0000 10.0000 /end AXIS_DESCR
 /begin AXIS_DESCR STD_AXIS md_kupp_wunsch FORMULA_0009 9 -100.0000 1000.0000 FORMAT "%4.1" /end AXIS_DESCR
 FORMAT "%6.3" /end CHARACTERISTIC
/begin CHARACTERISTIC KF_MD_SPORT_LSD "Wichtungsfaktor Sport | EN: Wichtungsfaktor Sport" MAP 0x777BA TKF_SW_SW_UW 100.0 FORMULA_0075 0.0 4.0000 /begin AXIS_DESCR STD_AXIS md_bereich FORMULA_0814 3 -32767.0000 32768.0000 /end AXIS_DESCR /begin AXIS_DESCR STD_AXIS gang FORMULA_0486 7 -1.0000 10.0000 /end AXIS_DESCR FORMAT "%6.3" /end CHARACTERISTIC
/begin CHARACTERISTIC KF_MD_SPORT_DP "Wichtungsfaktor Sport | EN: Weighting factor, Sport" MAP 0x777FA TKF_SW_SW_UW 100.0 FORMULA_0075 0.0 4.0000 /begin AXIS_DESCR STD_AXIS md_bereich FORMULA_0814 3 -32767.0000 32768.0000 /end AXIS_DESCR /begin AXIS_DESCR STD_AXIS gang FORMULA_0486 7 -1.0000 10.0000 /end AXIS_DESCR FORMAT "%6.3" /end CHARACTERISTIC
/begin CHARACTERISTIC KF_MD_KOMFORT_LSD "Wichtungsfaktor Komfort | EN: Weighting factor, Comfort" MAP 0x7783A TKF_SW_SW_UW 100.0 FORMULA_0075 0.0 4.0000 /begin AXIS_DESCR STD_AXIS md_bereich FORMULA_0814 3 -32767.0000 32768.0000 /end AXIS_DESCR /begin AXIS_DESCR STD_AXIS gang FORMULA_0486 7 -1.0000 10.0000 /end AXIS_DESCR FORMAT "%6.3" /end CHARACTERISTIC
/begin CHARACTERISTIC KF_MD_KOMFORT_DP "Wichtungsfaktor Komfort | EN: Weighting factor, Comfort" MAP 0x7787A TKF_SW_SW_UW 100.0 FORMULA_0075 0.0 4.0000 /begin AXIS_DESCR STD_AXIS md_bereich FORMULA_0814 3 -32767.0000 32768.0000 /end AXIS_DESCR /begin AXIS_DESCR STD_AXIS gang FORMULA_0486 7 -1.0000 10.0000 /end AXIS_DESCR FORMAT "%6.3" /end CHARACTERISTIC
/begin MEASUREMENT md_dyn_smg_timer "SMG-Timer" UBYTE FORMULA_0352 0 0 0.0 0.0500 ECU_ADDRESS 0x3FBFF8 /end MEASUREMENT
/begin MEASUREMENT md_dyn_st "Filterstatus" UBYTE FORMULA_0804 0 0 0.0 255.0 ECU_ADDRESS 0x3FBFF9 BIT_MASK 0xF /end MEASUREMENT
/begin MEASUREMENT md_dyn_st_tz_min "Filterstatus tz_min" UBYTE FORMULA_0805 0 0 0.0 255.0 ECU_ADDRESS 0x3FBFF9 BIT_MASK 0x10 /end MEASUREMENT
/begin MEASUREMENT md_dyn_st_anff "Filterstatus Anfahrfilter" UBYTE FORMULA_0806 0 0 0.0 255.0 ECU_ADDRESS 0x3FBFF9 BIT_MASK 0x20 /end MEASUREMENT
/begin MEASUREMENT md_dyn_flags "diverse Flags" UBYTE FORMULA_0003 0 0 0.0 255.0000 ECU_ADDRESS 0x3FBFFA /end MEASUREMENT
/begin MEASUREMENT md_dyn_freigabe "Freigabestatus" UBYTE FORMULA_0807 0 0 0.0 255.0 ECU_ADDRESS 0x3FBFFA BIT_MASK 0x1 /end MEASUREMENT
/begin MEASUREMENT md_richtung "Filterrichtung" SBYTE FORMULA_0808 0 0 -128.0 127.0 ECU_ADDRESS 0x3FBFFB /end MEASUREMENT
/begin MEASUREMENT md_bereich "Bereich" UBYTE FORMULA_0809 0 0 0.0 255.0 ECU_ADDRESS 0x3FBFFC /end MEASUREMENT
/begin MEASUREMENT md_grad_anf "Fahrergradient" SLONG FORMULA_0810 0 0 -5000.0000 5000.0000 ECU_ADDRESS 0x3FC000 /end MEASUREMENT
/begin MEASUREMENT md_grad_lsd "LSD-Maximalgradient" SWORD FORMULA_0811 0 0 -5000.0000 5000.0000 ECU_ADDRESS 0x3FC004 /end MEASUREMENT
/begin MEASUREMENT md_grad_dp "DP-Maximalgradient" SWORD FORMULA_0811 0 0 -5000.0000 5000.0000 ECU_ADDRESS 0x3FC006 /end MEASUREMENT
/begin MEASUREMENT md_grad_max "Maximalgradient" SWORD FORMULA_0811 0 0 -5000.0000 5000.0000 ECU_ADDRESS 0x3FC008 /end MEASUREMENT
/begin MEASUREMENT md_grad "Istgradient" SWORD FORMULA_0811 0 0 -5000.0000 5000.0000 ECU_ADDRESS 0x3FC00A /end MEASUREMENT
/begin MEASUREMENT md_kupp_grenz_lsd_u "untere Grenze fuer LSD-Bereichsauswahl" SWORD FORMULA_0009 0 0 -100.0000 1000.0000 ECU_ADDRESS 0x3FC00C /end MEASUREMENT
/begin MEASUREMENT md_kupp_grenz_lsd_o "obere Grenze fuer LSD-Bereichsauswahl" SWORD FORMULA_0009 0 0 -100.0000 1000.0000 ECU_ADDRESS 0x3FC00E /end MEASUREMENT
/begin MEASUREMENT md_kupp_grenz_dp_u "untere Grenze fuer DP-Bereichsauswahl" SWORD FORMULA_0009 0 0 -100.0000 1000.0000 ECU_ADDRESS 0x3FC010 /end MEASUREMENT
/begin MEASUREMENT md_kupp_grenz_dp_o "obere Grenze fuer DP-Bereichsauswahl" SWORD FORMULA_0009 0 0 -100.0000 1000.0000 ECU_ADDRESS 0x3FC012 /end MEASUREMENT
/begin MEASUREMENT md_kupp_grenz_u "untere Grenze fuer Bereichsauswahl" SWORD FORMULA_0009 0 0 -100.0000 1000.0000 ECU_ADDRESS 0x3FC014 /end MEASUREMENT
/begin MEASUREMENT md_kupp_grenz_o "obere Grenze fuer Bereichsauswahl" SWORD FORMULA_0009 0 0 -100.0000 1000.0000 ECU_ADDRESS 0x3FC016 /end MEASUREMENT
/begin MEASUREMENT md_kupp_wunsch_fil_roh "Filterwert" SLONG FORMULA_0812 0 0 -100.0000 1000.0000 ECU_ADDRESS 0x3FC018 /end MEASUREMENT
/begin MEASUREMENT md_dyn_fil_res_roh "Momentenreserve Dynamikfilter ohne Begr" SWORD FORMULA_0009 0 0 -100.0000 1000.0000 ECU_ADDRESS 0x3FC01C /end MEASUREMENT
/begin MEASUREMENT md_dyn_fil_res "Momentenreserve Dynamikfilter" SWORD FORMULA_0009 0 0 -100.0000 1000.0000 ECU_ADDRESS 0x3FC01E /end MEASUREMENT
/begin MEASUREMENT md_kupp_wunsch_grad_max "Maximalgradient" SWORD FORMULA_0571 0 0 -5000.0000 5000.0000 ECU_ADDRESS 0x3FC020 /end MEASUREMENT
/begin MEASUREMENT md_kupp_wunsch_fil_dp "gefilt. Fahrerwunsch fuer DP-Wichtung" SWORD FORMULA_0009 0 0 -100.0000 1000.0000 ECU_ADDRESS 0x3FC022 /end MEASUREMENT
/begin MEASUREMENT md_fak_zufall_lsd "LSD-Zufallszahl - nur Vergleich" UWORD FORMULA_0075 0 0 0.0 4.0000 ECU_ADDRESS 0x3FC024 /end MEASUREMENT
/begin MEASUREMENT md_fak_zufall_dp "DP-Zufallszahl - nur Vergleich" UWORD FORMULA_0075 0 0 0.0 4.0000 ECU_ADDRESS 0x3FC026 /end MEASUREMENT
/begin MEASUREMENT md_fak_fummel_lsd "LSD-Fummelfaktor - korrekt" UWORD FORMULA_0075 0 0 0.0 4.0000 ECU_ADDRESS 0x3FC028 /end MEASUREMENT
/begin MEASUREMENT md_fak_fummel_dp "DP-Fummelfaktor - korrekt" UWORD FORMULA_0075 0 0 0.0 4.0000 ECU_ADDRESS 0x3FC02A /end MEASUREMENT
/* ------------------ Abschnitt erzeugt aus md_sk.dat ------------------ */
/begin CHARACTERISTIC K_MD_SK_CFG "SK-Cfg" VALUE 0x77A70 TKW_VV_VV_UB 100.0 FORMULA_0363 0.0 255.0 /end CHARACTERISTIC
/begin CHARACTERISTIC K_MD_SK_TAU_PWG "Filter Pwg0-Ueberwachung | EN: Filter, pedal=0 monitoring [s]" VALUE 0x77A71 TKW_VV_VV_UB 100.0 FORMULA_0462 0.0101 2.5600 /end CHARACTERISTIC
/begin CHARACTERISTIC K_MD_SK_TAU_VERGL "Filter Vergleichsmoment | EN: Filter, comparison torque [s]" VALUE 0x77A72 TKW_VV_VV_UB 100.0 FORMULA_0462 0.0101 2.5600 /end CHARACTERISTIC
/begin CHARACTERISTIC K_MD_SK_PWGMIN "PWG-Schwelle fuer pwg=0 | EN: Pedal threshold for pedal=0 [%]" VALUE 0x77A73 TKW_VV_VV_UB 100.0 FORMULA_0479 0.0 25.0000 /end CHARACTERISTIC
/begin CHARACTERISTIC K_MD_SK_N_MIN "Drehzahlschwelle fuer Momentenueberwachung | EN: Engine-speed threshold for torque monitoring [Upm]" VALUE 0x77A74 TKW_VV_VV_SW 100.0 FORMULA_0006 0.0 10000.0000 /end CHARACTERISTIC
/begin CHARACTERISTIC K_MD_SK_NHYS "n_llr-Offset bei pwg=0 | EN: Idle speed offset at pedal=0 [Upm]" VALUE 0x77A76 TKW_VV_VV_SW 100.0 FORMULA_0006 0.0 10000.0000 /end CHARACTERISTIC
/begin CHARACTERISTIC K_MD_SK_FWMAX "max. Moment bei pwg=0 | EN: Maximum torque at pedal=0 [Nm]" VALUE 0x77A78 TKW_VV_VV_SW 100.0 FORMULA_0009 -100.0000 1000.0000 FORMAT "%4.1" /end CHARACTERISTIC
/begin CHARACTERISTIC K_MD_SK_TIMER_0 "max. Timer fuer pwg=0 | EN: Maximum timer for pedal=0 [s]" VALUE 0x77A7A TKW_VV_VV_UW 100.0 FORMULA_0021 0.0 655.0000 FORMAT "%5.2" /end CHARACTERISTIC
/begin CHARACTERISTIC K_MD_SK_TIMER_1 "max. Timer fuer pwg>0 | EN: Maximum timer for pedal>0 [s]" VALUE 0x77A7C TKW_VV_VV_UW 100.0 FORMULA_0021 0.0 655.0000 FORMAT "%5.2" /end CHARACTERISTIC
/begin CHARACTERISTIC K_MD_SK_N_MDMIN "Drehzahlschwelle fuer Momentenueberwachung MDmin | EN: Engine-speed threshold for torque monitoring MDmin [Upm]" VALUE 0x77A7E TKW_VV_VV_SW 100.0 FORMULA_0006 0.0 10000.0000 /end CHARACTERISTIC
/begin CHARACTERISTIC K_MD_SK_MAX_MDMIN "maximal zulaessiges MDmin | EN: Maximum permitted MDmin [Nm]" VALUE 0x77A80 TKW_VV_VV_SW 100.0 FORMULA_0009 -100.0000 1000.0000 FORMAT "%4.1" /end CHARACTERISTIC
/begin CHARACTERISTIC K_MD_SK_RF_MAX "max. rf zur Absicherung Momentenberechnung | EN: Maximum relative charge to secure torque calculation" VALUE 0x77A82 TKW_VV_VV_SW 100.0 FORMULA_0007 0.0 2.0000 FORMAT "%6.3" /end CHARACTERISTIC
/begin CHARACTERISTIC K_MD_SK_ETA_MIN "minimales ETA zur Absicherung Momentenberechnung | EN: Minimum efficiency to secure torque calculation [%]" VALUE 0x77A84 TKW_VV_VV_UW 100.0 FORMULA_0435 0.0 150.0000 FORMAT "%4.1" /end CHARACTERISTIC
/begin CHARACTERISTIC K_MD_SK_IND_MAX "max. indiziertes TZ-/DK-Moment | EN: Maximum indicated ignition/throttle torque [Nm]" VALUE 0x77A86 TKW_VV_VV_SW 100.0 FORMULA_0009 0.0 1000.0000 FORMAT "%4.1" /end CHARACTERISTIC
/begin CHARACTERISTIC K_MD_SK_LLR_MAX "maximaler LLR-Anteil | EN: Maximum idle controller share [Nm]" VALUE 0x77A88 TKW_VV_VV_SW 100.0 FORMULA_0009 -100.0000 1000.0000 FORMAT "%4.1" /end CHARACTERISTIC
/begin CHARACTERISTIC K_MD_SK_TIRED_MIN "Minimalwert fuer Einspritzausblendungen | EN: Minimum value for injection suppressions" VALUE 0x77A8A TKW_VV_VV_UB 100.0 FORMULA_0003 0.0 8.0000 /end CHARACTERISTIC
/begin CHARACTERISTIC K_MD_SK_TIRED_HYS "Hysterese fuer Hinzunahme eines Zylinders | EN: Hysteresis for re-enabling a cylinder" VALUE 0x77A8C TKW_VV_VV_UW 100.0 FORMULA_0075 0.0 4.0000 FORMAT "%6.3" /end CHARACTERISTIC
/begin CHARACTERISTIC K_MD_SK_BEGR_RAMPE "Rampenbegrentzer f�r MD-Begrentzung SK | EN: Ramp limiter for torque limitation, safety concept [Nm/s]" VALUE 0x77A8E TKW_VV_VV_SW 100.0 FORMULA_0755 0.0 3000.0000 FORMAT "%4.1" /end CHARACTERISTIC
/begin CHARACTERISTIC K_MD_SK_TIRED_ZYL_1of11_ "Ausblendmasken | EN: Ausblendmasken" VALUE 0x77A90 TKW_VV_VV_UW 100.0 FORMULA_0010 0.0 65535.0000 /end CHARACTERISTIC
/begin CHARACTERISTIC K_MD_SK_TIRED_ZYL_2of11_ "Ausblendmasken | EN: Ausblendmasken" VALUE 0x77A92 TKW_VV_VV_UW 100.0 FORMULA_0010 0.0 65535.0000 /end CHARACTERISTIC
/begin CHARACTERISTIC K_MD_SK_TIRED_ZYL_3of11_ "Ausblendmasken | EN: Ausblendmasken" VALUE 0x77A94 TKW_VV_VV_UW 100.0 FORMULA_0010 0.0 65535.0000 /end CHARACTERISTIC
/begin CHARACTERISTIC K_MD_SK_TIRED_ZYL_4of11_ "Ausblendmasken | EN: Ausblendmasken" VALUE 0x77A96 TKW_VV_VV_UW 100.0 FORMULA_0010 0.0 65535.0000 /end CHARACTERISTIC
/begin CHARACTERISTIC K_MD_SK_TIRED_ZYL_5of11_ "Ausblendmasken | EN: Ausblendmasken" VALUE 0x77A98 TKW_VV_VV_UW 100.0 FORMULA_0010 0.0 65535.0000 /end CHARACTERISTIC
/begin CHARACTERISTIC K_MD_SK_TIRED_ZYL_6of11_ "Ausblendmasken | EN: Ausblendmasken" VALUE 0x77A9A TKW_VV_VV_UW 100.0 FORMULA_0010 0.0 65535.0000 /end CHARACTERISTIC
/begin CHARACTERISTIC K_MD_SK_TIRED_ZYL_7of11_ "Ausblendmasken | EN: Ausblendmasken" VALUE 0x77A9C TKW_VV_VV_UW 100.0 FORMULA_0010 0.0 65535.0000 /end CHARACTERISTIC
/begin CHARACTERISTIC K_MD_SK_TIRED_ZYL_8of11_ "Ausblendmasken | EN: Ausblendmasken" VALUE 0x77A9E TKW_VV_VV_UW 100.0 FORMULA_0010 0.0 65535.0000 /end CHARACTERISTIC
/begin CHARACTERISTIC K_MD_SK_TIRED_ZYL_9of11_ "Ausblendmasken | EN: Ausblendmasken" VALUE 0x77AA0 TKW_VV_VV_UW 100.0 FORMULA_0010 0.0 65535.0000 /end CHARACTERISTIC
/begin CHARACTERISTIC K_MD_SK_TIRED_ZYL_10of11_ "Ausblendmasken | EN: Ausblendmasken" VALUE 0x77AA2 TKW_VV_VV_UW 100.0 FORMULA_0010 0.0 65535.0000 /end CHARACTERISTIC
/begin CHARACTERISTIC K_MD_SK_TIRED_ZYL_11of11_ "Ausblendmasken | EN: Ausblendmasken" VALUE 0x77AA4 TKW_VV_VV_UW 100.0 FORMULA_0010 0.0 65535.0000 /end CHARACTERISTIC
/begin CHARACTERISTIC K_MD_SK_WDK_KH_OFFS "Offset auf KL_MD_SK_WDK im KH | EN: Offset on KL_MD_SK_WDK during catalyst heating [%]" VALUE 0x77AA6 TKW_VV_VV_SW 100.0 FORMULA_0001 -10.0000 120.0000 FORMAT "%4.1" /end CHARACTERISTIC
/begin CHARACTERISTIC K_MD_SK_WDK_LLSFAIL_OFFS "Offset auf KL_MD_SK_WDK bei LLS-Off | EN: Offset auf KL_MD_SK_WDK bei LLS-Off" VALUE 0x77AA8 TKW_VV_VV_SW 100.0 FORMULA_0001 -10.0000 120.0000 FORMAT "%4.1" /end CHARACTERISTIC
/begin CHARACTERISTIC KL_MD_SK_WDK "Max. WDK-Position bei PWG=0 | EN: With idle air valve" CURVE 0x77AAA TKL_SW_VV_SW 100.0 FORMULA_0001 -10.0000 120.0000 /begin AXIS_DESCR STD_AXIS n FORMULA_0006 3 0.0 10000.0000 /end AXIS_DESCR FORMAT "%4.1" /end CHARACTERISTIC
/begin CHARACTERISTIC KL_MD_SK_WDK_TI_OFFS "Max. WDK-Position bei PWG=0 und TIoff | EN: Maximum throttle position at pedal=0 and injection off" CURVE 0x77AB8 TKL_UB_VV_SW 100.0 FORMULA_0001 -10.0000 120.0000 /begin AXIS_DESCR STD_AXIS ti_off FORMULA_0003 10 0.0 255.0000 /end AXIS_DESCR FORMAT "%4.1" /end CHARACTERISTIC
/begin CHARACTERISTIC KL_MD_SK_MD_BEGR "Momentenbegrenzung durch SK-Stufe | EN: Torque limit from safety-concept stage" CURVE 0x77AD8 TKL_UB_VV_SW 100.0 FORMULA_0009 -100.0000 1000.0000 /begin AXIS_DESCR STD_AXIS Stufe FORMULA_0003 6 0.0 255.0000 /end AXIS_DESCR FORMAT "%4.1" /end CHARACTERISTIC
/begin CHARACTERISTIC KL_MD_SK_GRAD_MAX "Momentenbegrenzung durch SK-Stufe | EN: Torque limit from safety-concept stage" CURVE 0x77AEC TKL_UB_VV_SW 100.0 FORMULA_0571 -5000.0000 5000.0000 /begin AXIS_DESCR STD_AXIS Stufe FORMULA_0003 6 0.0 255.0000 /end AXIS_DESCR /end CHARACTERISTIC
/begin CHARACTERISTIC KF_MD_SK_DIFF_MAX "Abweichung Istmoment | EN: Deviation of actual torque" MAP 0x77B00 TKF_SW_SW_SW 100.0 FORMULA_0009 -100.0000 1000.0000 /begin AXIS_DESCR STD_AXIS n FORMULA_0006 6 0.0 10000.0000 /end AXIS_DESCR
 /begin AXIS_DESCR STD_AXIS md_sk_vergl_soll FORMULA_0009 6 -100.0000 1000.0000 FORMAT "%4.1" /end AXIS_DESCR
 FORMAT "%4.1" /end CHARACTERISTIC
/begin MEASUREMENT md_sk_pwg "gefilteter Pedalwert" SWORD FORMULA_0001 0 0 -10.0000 120.0000 ECU_ADDRESS 0x3FC048 /end MEASUREMENT
/begin MEASUREMENT md_sk_timer_0 "SK-Timer bei pwg=0" UWORD FORMULA_0021 0 0 0.0 655.0000 ECU_ADDRESS 0x3FC04A /end MEASUREMENT
/begin MEASUREMENT md_sk_timer_1 "SK-Timer bei pwg>0" UWORD FORMULA_0021 0 0 0.0 655.0000 ECU_ADDRESS 0x3FC04C /end MEASUREMENT
/begin MEASUREMENT md_sk_fehler "SK-Fehlerinfo" UBYTE FORMULA_0436 0 0 0.0 255.0 ECU_ADDRESS 0x3FC04E /end MEASUREMENT
/begin MEASUREMENT md_sk_wdkmax_b1 "zulaesssiger DK-Winkel bei pwg=0" SWORD FORMULA_0001 0 0 -10.0000 120.0000 ECU_ADDRESS 0x3FC050 /end MEASUREMENT
/begin MEASUREMENT md_sk_wdkmax_b2 "zulaesssiger DK-Winkel bei pwg=0" SWORD FORMULA_0001 0 0 -10.0000 120.0000 ECU_ADDRESS 0x3FC052 /end MEASUREMENT
/begin MEASUREMENT md_sk_vergl_soll "Vergleichssollmoment" SWORD FORMULA_0009 0 0 -100.0000 1000.0000 ECU_ADDRESS 0x3FC054 /end MEASUREMENT
/begin MEASUREMENT md_sk_diff_max "max. zulaessige Abweichung" SWORD FORMULA_0009 0 0 -100.0000 1000.0000 ECU_ADDRESS 0x3FC056 /end MEASUREMENT
/begin MEASUREMENT md_sk_vergl_diff "Soll-/Istabweichung" SWORD FORMULA_0009 0 0 -100.0000 1000.0000 ECU_ADDRESS 0x3FC058 /end MEASUREMENT
/begin MEASUREMENT md_sk_wunsch_begr_ml "Begrenzung Luftmoment" SWORD FORMULA_0009 0 0 -100.0000 1000.0000 ECU_ADDRESS 0x3FC05A /end MEASUREMENT
/begin MEASUREMENT md_sk_wunsch_begr_tz "Begrenzung Z�ndungsmoment" SWORD FORMULA_0009 0 0 -100.0000 1000.0000 ECU_ADDRESS 0x3FC05C /end MEASUREMENT
/begin MEASUREMENT md_sk_grad_max "Begrenzung Dynamikfilter" SWORD FORMULA_0571 0 0 0.0 20000.0000 ECU_ADDRESS 0x3FC05E /end MEASUREMENT
/begin MEASUREMENT md_ind_ist_skmin "minimal erreichbares Istmoment bei tz_min" SWORD FORMULA_0009 0 0 -100.0000 1000.0000 ECU_ADDRESS 0x3FC060 /end MEASUREMENT
/begin MEASUREMENT md_sk_tired "Anzahl freigegebener Einspritzkanaele" UBYTE FORMULA_0003 0 0 0.0 10.0000 ECU_ADDRESS 0x3FC062 /end MEASUREMENT
/begin MEASUREMENT md_sk_verh "Verhaeltnis Sollmoment zu min.Istmoment" UWORD FORMULA_0075 0 0 0.0 4.0000 ECU_ADDRESS 0x3FC064 /end MEASUREMENT
/* ------------------ Abschnitt erzeugt aus md_soll.dat ------------------ */
/begin CHARACTERISTIC K_MD_CFG_MCS "Vorgaben per MCS" VALUE 0x77B62 TKW_VV_VV_UB 100.0 FORMULA_0823 0.0 255.0 /end CHARACTERISTIC
/begin CHARACTERISTIC K_MD_CFG_ZW_BEZUG "ZW-Bezug" VALUE 0x77B63 TKW_VV_VV_UB 100.0 FORMULA_0818 0.0 255.0 /end CHARACTERISTIC
/begin CHARACTERISTIC K_MD_CFG_TZ_EINGR "Freigabe Zuendwinkeleingriff | [Code V452 IGN 0x667F4] >= 2 (3 here): retard = min(DBGR offset, knock adaptation). < 2: cat-heating ignition offset kh_tz_offs also included in the min()." VALUE 0x77B64 TKW_VV_VV_UB 100.0 FORMULA_0824 0.0 255.0 /end CHARACTERISTIC
/begin CHARACTERISTIC K_MD_CFG_ETA_KOMP "Eta-Kompensation" VALUE 0x77B65 TKW_VV_VV_UB 100.0 FORMULA_0825 0.0 255.0 /end CHARACTERISTIC
/begin CHARACTERISTIC K_MD_CFG_FW_BLS "Einfluss Bremse auf Fahrerwunsch" VALUE 0x77B66 TKW_VV_VV_UB 100.0 FORMULA_0826 0.0 255.0 /end CHARACTERISTIC
/begin CHARACTERISTIC K_MD_BLS_BRP "Schwelle Bremsdruck | EN: Schwelle Bremsdruck" VALUE 0x77B67 TKW_VV_VV_UB 100.0 FORMULA_0138 0.0 255.0000 /end CHARACTERISTIC
/begin CHARACTERISTIC K_MD_BLS_N "Schwelle Bremsdruck | EN: Schwelle Bremsdruck" VALUE 0x77B68 TKW_VV_VV_SW 100.0 FORMULA_0006 0.0 10000.0000 /end CHARACTERISTIC
/begin CHARACTERISTIC K_MD_BLS_FW_REL "Schwelle Bremsdruck | EN: Schwelle Bremsdruck" VALUE 0x77B6A TKW_VV_VV_SW 100.0 FORMULA_0001 0.0 100.0000 FORMAT "%4.1" /end CHARACTERISTIC
/begin CHARACTERISTIC K_MD_BLS_N_VMA "Schwelle Drehzahl | EN: Schwelle Drehzahl" VALUE 0x77B6C TKW_VV_VV_SW 100.0 FORMULA_0006 0.0 10000.0000 /end CHARACTERISTIC
/begin CHARACTERISTIC K_MD_BLS_DN_VMA "Schwelle Drehzahlgradient | EN: Schwelle Drehzahlgradient" VALUE 0x77B6E TKW_VV_VV_SW 100.0 FORMULA_0114 -10000.0000 10000.0000 /end CHARACTERISTIC
/begin CHARACTERISTIC K_MD_BLS_GANG_VMA "Schwelle Gang | EN: Schwelle Gang" VALUE 0x77B70 TKW_VV_VV_SB 100.0 FORMULA_0318 -1.0000 10.0000 /end CHARACTERISTIC
/begin CHARACTERISTIC K_MD_BLS_BRP_VMA "Schwelle Bremsdruck | EN: Schwelle Bremsdruck" VALUE 0x77B71 TKW_VV_VV_UB 100.0 FORMULA_0138 0.0 255.0000 /end CHARACTERISTIC
/begin CHARACTERISTIC K_MD_ETA_EINGRIFF "ETA-Grenze | EN: ETA-Grenze" VALUE 0x77B72 TKW_VV_VV_UW 100.0 FORMULA_0435 0.0 150.0000 FORMAT "%4.1" /end CHARACTERISTIC
/begin CHARACTERISTIC K_MD_ETA_LA_KOMP_MAX "ETA-Grenze | EN: ETA-Grenze" VALUE 0x77B74 TKW_VV_VV_UW 100.0 FORMULA_0435 0.0 150.0000 FORMAT "%4.1" /end CHARACTERISTIC
/begin CHARACTERISTIC K_MD_RESERVE_TST "Test-Reserve | EN: Test-Reserve" VALUE 0x77B76 TKW_VV_VV_SW 100.0 FORMULA_0009 -100.0000 1000.0000 FORMAT "%4.1" /end CHARACTERISTIC
/begin CHARACTERISTIC K_MD_IND_WUNSCH_TZ_MCS "TZ-Vorgabe per MCS | EN: TZ-Vorgabe per MCS" VALUE 0x77B78 TKW_VV_VV_SW 100.0 FORMULA_0009 -100.0000 1000.0000 FORMAT "%4.1" /end CHARACTERISTIC
/begin CHARACTERISTIC K_MD_RF_SOLL_MCS "RF-Sollvorgabe" VALUE 0x77B7A TKW_VV_VV_SW 100.0 FORMULA_0007 0.0 2.0000 FORMAT "%6.3" /end CHARACTERISTIC
/begin CHARACTERISTIC K_MD_TZ_SOLL_MCS "TZ-Sollvorgabe | EN: TZ-Sollvorgabe" VALUE 0x77B7C TKW_VV_VV_SW 100.0 FORMULA_0111 -50.0000 60.0000 FORMAT "%4.1" /end CHARACTERISTIC
/begin CHARACTERISTIC K_MD_RES_KATH_FAK "Faktor Katheitzreserve | EN: Faktor Katheitzreserve" VALUE 0x77B7E TKW_VV_VV_UW 100.0 FORMULA_0075 0.0 4.0000 FORMAT "%6.3" /end CHARACTERISTIC
/begin CHARACTERISTIC K_MD_RES_KATH_TAU "TAU Katheitzreserve" VALUE 0x77B80 TKW_VV_VV_UB 100.0 FORMULA_0478 0.0051 1.2800 /end CHARACTERISTIC
/begin CHARACTERISTIC K_MD_TAU_IND_TZ_GRAD "TAU Sollmoment | EN: TAU Sollmoment" VALUE 0x77B81 TKW_VV_VV_UB 100.0 FORMULA_0478 0.0051 1.2800 /end CHARACTERISTIC
/begin CHARACTERISTIC K_MD_RES_MIN "Reserveschwelle | EN: Reserveschwelle" VALUE 0x77B82 TKW_VV_VV_UB 100.0 FORMULA_0749 0.0 25.0000 /end CHARACTERISTIC
/begin CHARACTERISTIC K_MD_RES_MIN_HYS "Reserveschwelle Hystherse | EN: Reserveschwelle Hystherse" VALUE 0x77B83 TKW_VV_VV_UB 100.0 FORMULA_0749 0.0 25.0000 /end CHARACTERISTIC
/begin CHARACTERISTIC K_MD_TAU_FW_GRAD "Filter fuer Fahrerwunsch | EN: Filter fuer Fahrerwunsch" VALUE 0x77B84 TKW_VV_VV_UB 100.0 FORMULA_0478 0.0051 1.2800 /end CHARACTERISTIC
/begin CHARACTERISTIC K_MD_RG_RF_FAKTOR "Faktor fuer Rf-Rg-Korrektur | EN: Faktor fuer Rf-Rg-Korrektur" VALUE 0x77B86 TKW_VV_VV_UW 100.0 FORMULA_0075 0.0 4.0000 FORMAT "%6.3" /end CHARACTERISTIC
/begin CHARACTERISTIC K_MD_KUPP_BEGR_MCS "Wochenendfzg-Momentenbegrenzung | EN: Wochenendfzg-Momentenbegrenzung" VALUE 0x77B88 TKW_VV_VV_SW 100.0 FORMULA_0009 -100.0000 1000.0000 FORMAT "%4.1" /end CHARACTERISTIC
/begin CHARACTERISTIC K_MD_BEZUG_HYS "Abschaltung der Eta-Bezugsrampe | EN: Abschaltung der Eta-Bezugsrampe" VALUE 0x77B8A TKW_VV_VV_UB 100.0 FORMULA_0749 0.0 10.0000 /end CHARACTERISTIC
/begin CHARACTERISTIC K_MD_BEZUG_RAMPE "Eta-Bezugsrampe | EN: Eta-Bezugsrampe" VALUE 0x77B8B TKW_VV_VV_UB 100.0 FORMULA_0827 0.0 5100.0000 /end CHARACTERISTIC
/begin CHARACTERISTIC K_MD_ETA_STAT_TAU "TAU stat. TZ | EN: TAU stat. TZ" VALUE 0x77B8C TKW_VV_VV_UB 100.0 FORMULA_0478 0.0051 1.2800 /end CHARACTERISTIC
/begin CHARACTERISTIC K_MD_ETA_KH_TAU "TAU KH-TZ" VALUE 0x77B8D TKW_VV_VV_UB 100.0 FORMULA_0478 0.0051 1.2800 /end CHARACTERISTIC
/begin CHARACTERISTIC K_MD_ETA_KH_TAU_LL "TAU KH-TZ | EN: TAU KH-TZ" VALUE 0x77B8E TKW_VV_VV_UB 100.0 FORMULA_0478 0.0051 1.2800 /end CHARACTERISTIC
/begin CHARACTERISTIC K_MD_ETA_STAT_TAU_LL "TAU md_tz_stat_mw | EN: TAU md_tz_stat_mw" VALUE 0x77B8F TKW_VV_VV_UB 100.0 FORMULA_0478 0.0051 1.2800 /end CHARACTERISTIC
/begin CHARACTERISTIC K_MD_ETA_LA_TAU "TAU LA | EN: TAU LA" VALUE 0x77B90 TKW_VV_VV_UB 100.0 FORMULA_0478 0.0051 1.2800 /end CHARACTERISTIC
/begin CHARACTERISTIC K_MD_VBEGR_HYS_AUS "n-Abschalthysterese | EN: n-Abschalthysterese" VALUE 0x77B92 TKW_VV_VV_SW 100.0 FORMULA_0078 -80.0000 360.0000 FORMAT "%4.1" /end CHARACTERISTIC
/begin CHARACTERISTIC K_MD_VBEGR_MD_HYS "Md-Abschalthysterese | EN: Md-Abschalthysterese" VALUE 0x77B94 TKW_VV_VV_SW 100.0 FORMULA_0009 -100.0000 1000.0000 FORMAT "%4.1" /end CHARACTERISTIC
/begin CHARACTERISTIC K_MD_NBEGR_HYS_AUS "n-Hysteres fuer Deaktivierung N-Begrenzung" VALUE 0x77B96 TKW_VV_VV_SW 100.0 FORMULA_0006 0.0 2000.0000 /end CHARACTERISTIC
/begin CHARACTERISTIC K_MD_NBEGR_MD_HYS "Aktivierhysterese | EN: Aktivierhysterese" VALUE 0x77B98 TKW_VV_VV_SW 100.0 FORMULA_0009 -100.0000 1000.0000 FORMAT "%4.1" /end CHARACTERISTIC
/begin CHARACTERISTIC K_MD_NBEGR_AKTIV "Schwelle fuer Nmax-Reduktion" VALUE 0x77B9A TKW_VV_VV_SW 100.0 FORMULA_0006 0.0 10000.0000 /end CHARACTERISTIC
/begin CHARACTERISTIC K_MD_NBEGR_N_DELTA "Begrenzung Abregelrampe | EN: Begrenzung Abregelrampe" VALUE 0x77B9C TKW_VV_VV_UB 100.0 FORMULA_0828 0.0 20000.0000 /end CHARACTERISTIC
/begin CHARACTERISTIC K_MD_NOISE_CFG "Noise-Cfg | EN: Noise configuration" VALUE 0x77B9D TKW_VV_VV_UB 100.0 FORMULA_0829 0.0 255.0000 /end CHARACTERISTIC
/begin CHARACTERISTIC K_MD_NOISE_T "Noisezeit | EN: Noise time [s]" VALUE 0x77B9E TKW_VV_VV_UW 100.0 FORMULA_0073 0.0 6553.5000 FORMAT "%4.1" /end CHARACTERISTIC
/begin CHARACTERISTIC K_MD_NOISE_V_MIN1 "Eintrittsbedingung | EN: Entry condition [km/h]" VALUE 0x77BA0 TKW_VV_VV_SW 100.0 FORMULA_0078 -80.0000 360.0000 FORMAT "%4.1" /end CHARACTERISTIC
/begin CHARACTERISTIC K_MD_NOISE_V_MAX1 "Eintrittsbedingung | EN: Entry condition [km/h]" VALUE 0x77BA2 TKW_VV_VV_SW 100.0 FORMULA_0078 -80.0000 360.0000 FORMAT "%4.1" /end CHARACTERISTIC
/begin CHARACTERISTIC K_MD_NOISE_V_MIN2 "Austrittsbedingung | EN: Exit condition [km/h]" VALUE 0x77BA4 TKW_VV_VV_SW 100.0 FORMULA_0078 -80.0000 360.0000 FORMAT "%4.1" /end CHARACTERISTIC
/begin CHARACTERISTIC K_MD_NOISE_V_MAX2 "Austrittsbedingung | EN: Exit condition [km/h]" VALUE 0x77BA6 TKW_VV_VV_SW 100.0 FORMULA_0078 -80.0000 360.0000 FORMAT "%4.1" /end CHARACTERISTIC
/begin CHARACTERISTIC K_MD_NOISE_V_MIN3 "Profilerkennung | EN: Profile detection [km/h]" VALUE 0x77BA8 TKW_VV_VV_SW 100.0 FORMULA_0078 -80.0000 360.0000 FORMAT "%4.1" /end CHARACTERISTIC
/begin CHARACTERISTIC K_MD_NOISE_V_MAX3 "Profilerkennung | EN: Profile detection [km/h]" VALUE 0x77BAA TKW_VV_VV_SW 100.0 FORMULA_0078 -80.0000 360.0000 FORMAT "%4.1" /end CHARACTERISTIC
/begin CHARACTERISTIC K_MD_NOISE_PWG_SOLL "Noiseschwelle PWG | EN: Noise threshold, pedal [%]" VALUE 0x77BAC TKW_VV_VV_SW 100.0 FORMULA_0001 -10.0000 120.0000 FORMAT "%4.1" /end CHARACTERISTIC
/begin CHARACTERISTIC K_MD_NOISE_RAMPE "Noiseschwelle PWG | EN: Noise threshold, pedal [Nm/s]" VALUE 0x77BAE TKW_VV_VV_SW 100.0 FORMULA_0811 -5000.0000 5000.0000 /end CHARACTERISTIC
/begin CHARACTERISTIC K_MD_NBEGR_A1 "Reglerfaktor A1 | EN: Reglerfaktor A1" VALUE 0x77BB0 TKW_VV_VV_SW 100.0 FORMULA_0497 -10.0000 10.0000 FORMAT "%5.2" /end CHARACTERISTIC
/begin CHARACTERISTIC K_MD_VBEGR_A1 "Reglerfaktor A1 | EN: Reglerfaktor A1" VALUE 0x77BB2 TKW_VV_VV_SW 100.0 FORMULA_0497 -10.0000 10.0000 FORMAT "%5.2" /end CHARACTERISTIC
/begin CHARACTERISTIC K_MD_RF_SOLL_SEK_CFG "Konfig uber Einrechnung sek. Fuellungseinfluss | EN: 0x0 Inaktiv 0x1 mit TE 0x2 mit MVAC 0x3 mit TE+MVAC Konfig uber Einrechnung sek. Fuellungseinfluss" VALUE 0x77BB4 TKW_VV_VV_UB 100.0 FORMULA_0830 0.0 255.0 /end CHARACTERISTIC
/begin CHARACTERISTIC K_MD_KUPP_GANG_RAMPE "Eta-Bezugsrampe | EN: Eta-Bezugsrampe" VALUE 0x77BB6 TKW_VV_VV_SW 100.0 FORMULA_0571 -5000.0000 5000.0000 /end CHARACTERISTIC
/begin CHARACTERISTIC KL_MD_RG_TAU "Filterkonstante RG-Komp" CURVE 0x77BB8 TKL_SW_VV_UB 100.0 FORMULA_0478 0.0051 1.2800 /begin AXIS_DESCR STD_AXIS n FORMULA_0006 4 0.0 10000.0000 /end AXIS_DESCR /end CHARACTERISTIC
/begin CHARACTERISTIC KL_MD_KUPP_MIN_ASC "min. Moment bei ASC-Eingriff | EN: Minimum torque during ASC intervention" CURVE 0x77BC6 TKL_SW_VV_SW 100.0 FORMULA_0009 -100.0000 1000.0000 /begin AXIS_DESCR STD_AXIS n FORMULA_0006 6 0.0 10000.0000 /end AXIS_DESCR FORMAT "%4.1" /end CHARACTERISTIC
/begin CHARACTERISTIC KL_MD_NBEGR_N_OFFSET "Abregelung Begrenzerdrehzahl" CURVE 0x77BE0 TKL_UW_VV_SW 100.0 FORMULA_0006 0.0 1000.0000
 /begin AXIS_DESCR STD_AXIS md_nbegr_t FORMULA_0117 4 0.0 325.0000 FORMAT "%5.2" /end AXIS_DESCR
/end CHARACTERISTIC
/begin CHARACTERISTIC KL_MD_BEGR_NOISE "Maximalmoment | EN: Maximum torque" CURVE 0x77BF2 TKL_SW_VV_SW 100.0 FORMULA_0009 -100.0000 1000.0000 /begin AXIS_DESCR STD_AXIS v_vorne FORMULA_0078 3 0.0 360.0000 FORMAT "%4.1" /end AXIS_DESCR FORMAT "%4.1" /end CHARACTERISTIC
/begin CHARACTERISTIC KL_MD_NBEGR_GANG "Einfluss ueber Gradient | EN: Influence over gradient" CURVE 0x77C00 TKL_SW_VV_UB 100.0 FORMULA_0318 0.0 10.0000 /begin AXIS_DESCR STD_AXIS dn FORMULA_0114 5 -10000.0000 10000.0000 /end AXIS_DESCR /end CHARACTERISTIC
/begin CHARACTERISTIC KL_MD_NBEGR_ABSTAND "n-Differenz fuer Aktivierung N-Begrenzung" CURVE 0x77C12 TKL_UB_VV_SW 100.0 FORMULA_0006 0.0 4000.0000 /begin AXIS_DESCR STD_AXIS gang FORMULA_0318 8 0.0 10.0000 /end AXIS_DESCR /end CHARACTERISTIC
/begin CHARACTERISTIC KL_MD_NBEGR_N_MAX "Begrenzung Abregeldrehzahl | EN: Limit of cut-off engine speed" CURVE 0x77C2C TKL_UB_VV_SW 100.0 FORMULA_0831 0.0 20000.0000 /begin AXIS_DESCR STD_AXIS gang FORMULA_0318 8 0.0 10.0000 /end AXIS_DESCR FORMAT "%5.2" /end CHARACTERISTIC
/begin CHARACTERISTIC KL_MD_NBEGR_RAMPE "Aenderungsbegrenzung | EN: Rate limit" CURVE 0x77C46 TKL_UB_VV_SW 100.0 FORMULA_0571 -5000.0000 10000.0000 /begin AXIS_DESCR STD_AXIS gang FORMULA_0318 8 0.0 10.0000 /end AXIS_DESCR /end CHARACTERISTIC
/begin CHARACTERISTIC KL_MD_NBEGR_KR_FAK "Faktor auf KR | EN: Factor on KR (gain)" CURVE 0x77C60 TKL_SW_VV_UW 100.0 FORMULA_0075 0.0 10.0000
 /begin AXIS_DESCR STD_AXIS md_nbegr_abstand FORMULA_0006 6 -4000.0000 4000.0000 /end AXIS_DESCR
 FORMAT "%6.3" /end CHARACTERISTIC
/begin CHARACTERISTIC KL_MD_NBEGR_TN_FAK "Faktor auf TN | EN: Factor on TN (integral time)" CURVE 0x77C7A TKL_SW_VV_UW 100.0 FORMULA_0075 0.0 4.0000
 /begin AXIS_DESCR STD_AXIS md_nbegr_abstand FORMULA_0006 6 -4000.0000 4000.0000 /end AXIS_DESCR
 FORMAT "%6.3" /end CHARACTERISTIC
/begin CHARACTERISTIC KL_MD_NBEGR_TV_FAK "Faktor auf TV | EN: Factor on TV (derivative time)" CURVE 0x77C94 TKL_SW_VV_UW 100.0 FORMULA_0075 0.0 4.0000
 /begin AXIS_DESCR STD_AXIS md_nbegr_abstand FORMULA_0006 6 -4000.0000 4000.0000 /end AXIS_DESCR
 FORMAT "%6.3" /end CHARACTERISTIC
/begin CHARACTERISTIC KL_MD_VBEGR_KR_FAK "Faktor auf KR | EN: Faktor auf KR" CURVE 0x77CAE TKL_SW_VV_UW 100.0 FORMULA_0075 0.0 10.0000
 /begin AXIS_DESCR STD_AXIS v_max_delta FORMULA_0078 5 -250.0000 250.0000 FORMAT "%4.1" /end AXIS_DESCR
 FORMAT "%6.3" /end CHARACTERISTIC
/begin CHARACTERISTIC KL_MD_VBEGR_TN_FAK "Faktor auf TN | EN: Factor on TN (integral time)" CURVE 0x77CC4 TKL_SW_VV_UW 100.0 FORMULA_0075 0.0 10.0000
 /begin AXIS_DESCR STD_AXIS v_max_delta FORMULA_0078 5 -250.0000 250.0000 FORMAT "%4.1" /end AXIS_DESCR
 FORMAT "%6.3" /end CHARACTERISTIC
/begin CHARACTERISTIC KL_MD_VBEGR_TV_FAK "Faktor auf TV | EN: Factor on TV (derivative time)" CURVE 0x77CDA TKL_SW_VV_UW 100.0 FORMULA_0075 0.0 10.0000
 /begin AXIS_DESCR STD_AXIS v_max_delta FORMULA_0078 5 -250.0000 250.0000 FORMAT "%4.1" /end AXIS_DESCR
 FORMAT "%6.3" /end CHARACTERISTIC
/begin CHARACTERISTIC KL_MD_VBEGR_ABSTAND "Abstand | EN: Distance" CURVE 0x77CF0 TKL_SW_VV_SW 100.0 FORMULA_0078 -80.0000 360.0000 /begin AXIS_DESCR STD_AXIS gang FORMULA_0486 4 0.0 10.0000 /end AXIS_DESCR FORMAT "%4.1" /end CHARACTERISTIC
/begin CHARACTERISTIC KL_MD_VBEGR_RAMPE "Aenderungsbegrenzung | EN: Rate limit" CURVE 0x77D02 TKL_SW_VV_SW 100.0 FORMULA_0571 -5000.0000 100000.0000 /begin AXIS_DESCR STD_AXIS gang FORMULA_0486 4 0.0 10.0000 /end AXIS_DESCR /end CHARACTERISTIC
/begin CHARACTERISTIC KL_MD_VBEGR_TAU "Aenderungsbegrenzung | EN: Rate limit" CURVE 0x77D14 TKL_SW_VV_UB 100.0 FORMULA_0478 0.0051 1.2800 /begin AXIS_DESCR STD_AXIS t FORMULA_0117 3 0.0 150.0000 FORMAT "%5.2" /end AXIS_DESCR /end CHARACTERISTIC
/begin CHARACTERISTIC KL_MD_VBEGR_KR_FAK_SK "Faktor bei Ausblender | EN: Vmax limiter factor vs number of cylinders shut off" CURVE 0x77D20 TKL_UB_VV_SW 100.0 FORMULA_0075 0.0 20.0000 /begin AXIS_DESCR STD_AXIS sk_ti_zyl_off_cnt FORMULA_0003 4 0.0 12.0000 /end AXIS_DESCR FORMAT "%6.3" /end CHARACTERISTIC
/begin CHARACTERISTIC KL_MD_VBEGR_TN_FAK_SK "Faktor bei Ausblender | EN: Factor during cylinder suppression" CURVE 0x77D2E TKL_UB_VV_SW 100.0 FORMULA_0075 0.0 20.0000 /begin AXIS_DESCR STD_AXIS sk_ti_zyl_off_cnt FORMULA_0003 4 0.0 12.0000 /end AXIS_DESCR FORMAT "%6.3" /end CHARACTERISTIC
/begin CHARACTERISTIC KL_MD_NBEGR_KR_FAK_SK "Faktor bei Ausblender | EN: Factor during cylinder suppression" CURVE 0x77D3C TKL_UB_VV_SW 100.0 FORMULA_0075 0.0 20.0000 /begin AXIS_DESCR STD_AXIS sk_ti_zyl_off_cnt FORMULA_0003 4 0.0 12.0000 /end AXIS_DESCR FORMAT "%6.3" /end CHARACTERISTIC
/begin CHARACTERISTIC KL_MD_NBEGR_TN_FAK_SK "Faktor bei Ausblender | EN: Factor during cylinder suppression" CURVE 0x77D4A TKL_UB_VV_SW 100.0 FORMULA_0075 0.0 20.0000 /begin AXIS_DESCR STD_AXIS sk_ti_zyl_off_cnt FORMULA_0003 4 0.0 12.0000 /end AXIS_DESCR FORMAT "%6.3" /end CHARACTERISTIC
/begin CHARACTERISTIC KL_MD_FAHRER_FAK_KOMFORT "v-Progression - Komfort | EN: Speed progression factor on pedal map - Komfort" CURVE 0x77D58 TKL_SW_VV_UW 100.0 FORMULA_0075 0.0 3.0000
 /begin AXIS_DESCR STD_AXIS v_vorne FORMULA_0078 8 -80.0000 360.0000 FORMAT "%4.1" /end AXIS_DESCR
 FORMAT "%6.3" /end CHARACTERISTIC
/begin CHARACTERISTIC KL_MD_FAHRER_FAK_NORMAL "v-Progression - Normal | EN: Speed progression factor on pedal map - Normal" CURVE 0x77D7A TKL_SW_VV_UW 100.0 FORMULA_0075 0.0 3.0000
 /begin AXIS_DESCR STD_AXIS v_vorne FORMULA_0078 8 -80.0000 360.0000 FORMAT "%4.1" /end AXIS_DESCR
 FORMAT "%6.3" /end CHARACTERISTIC
/begin CHARACTERISTIC KL_MD_FAHRER_FAK_SPORT "v-Progression - Sport | EN: Speed progression factor on pedal map - Sport" CURVE 0x77D9C TKL_SW_VV_UW 100.0 FORMULA_0075 0.0 3.0000
 /begin AXIS_DESCR STD_AXIS v_vorne FORMULA_0078 8 -80.0000 360.0000 FORMAT "%4.1" /end AXIS_DESCR
 FORMAT "%6.3" /end CHARACTERISTIC
/begin CHARACTERISTIC KL_MD_TZ_AEBG_AUF "Aenderungsbegrenzung im KH" CURVE 0x77DBE TKL_SW_VV_SW 100.0 FORMULA_0832 0.0 100.0000 /begin AXIS_DESCR STD_AXIS n FORMULA_0006 8 0.0 10000.0000 /end AXIS_DESCR FORMAT "%4.1" /end CHARACTERISTIC
/begin CHARACTERISTIC KL_MD_TZ_AEBG_AB "Aenderungsbegrenzung im KH" CURVE 0x77DE0 TKL_SW_VV_SW 100.0 FORMULA_0832 0.0 100.0000 /begin AXIS_DESCR STD_AXIS n FORMULA_0006 8 0.0 10000.0000 /end AXIS_DESCR FORMAT "%4.1" /end CHARACTERISTIC
/begin CHARACTERISTIC KL_MD_RES_MIN "min. Momentenreserve fuer OBD | EN: Minimum torque reserve for OBD" CURVE 0x77E02 TKL_SW_VV_SW 100.0 FORMULA_0009 -100.0000 1000.0000
 /begin AXIS_DESCR STD_AXIS md_res_kath FORMULA_0009 4 -100.0000 1000.0000 FORMAT "%4.1" /end AXIS_DESCR
 FORMAT "%4.1" /end CHARACTERISTIC
/begin CHARACTERISTIC KL_MD_KUPP_MAX_GANG "Gangbegrenzung | EN: Torque limit per gear" CURVE 0x77E14 TKL_SW_VV_SW 100.0 FORMULA_0009 -100.0000 1000.0000 /begin AXIS_DESCR STD_AXIS gang FORMULA_0486 9 -1.0000 10.0000 /end AXIS_DESCR FORMAT "%4.1" /end CHARACTERISTIC
/begin CHARACTERISTIC KF_MD_FAHRER_KOMFORT "Fahrerwunsch - Komfort | EN: Driver demand (pedal map) - Komfort (with M-Drive option), SMG/manual" MAP 0x77E3A TKF_SW_SW_SW 100.0 FORMULA_0001 0.0 100.0000 /begin AXIS_DESCR STD_AXIS n FORMULA_0006 12 0.0 10000.0000 /end AXIS_DESCR
 /begin AXIS_DESCR STD_AXIS pwg_soll FORMULA_0001 12 -10.0000 120.0000 FORMAT "%4.1" /end AXIS_DESCR
 FORMAT "%4.1" /end CHARACTERISTIC
/begin CHARACTERISTIC KF_MD_FAHRER_NORMAL "Fahrerwunsch - Normal | EN: Driver demand (pedal map) - Normal (with M-Drive option)" MAP 0x77F8C TKF_SW_SW_SW 100.0 FORMULA_0001 0.0 100.0000 /begin AXIS_DESCR STD_AXIS n FORMULA_0006 12 0.0 10000.0000 /end AXIS_DESCR
 /begin AXIS_DESCR STD_AXIS pwg_soll FORMULA_0001 12 -10.0000 120.0000 FORMAT "%4.1" /end AXIS_DESCR
 FORMAT "%4.1" /end CHARACTERISTIC
/begin CHARACTERISTIC KF_MD_FAHRER_SPORT "Fahrerwunsch - Sport | EN: Driver demand (pedal map) - Sport (with M-Drive option)" MAP 0x780DE TKF_SW_SW_SW 100.0 FORMULA_0001 0.0 100.0000 /begin AXIS_DESCR STD_AXIS n FORMULA_0006 12 0.0 10000.0000 /end AXIS_DESCR
 /begin AXIS_DESCR STD_AXIS pwg_soll FORMULA_0001 12 -10.0000 120.0000 FORMAT "%4.1" /end AXIS_DESCR
 FORMAT "%4.1" /end CHARACTERISTIC
/begin CHARACTERISTIC KF_MD_FAHRER_PST "Fahrerwunsch - Pruefstand | EN: Driver demand - test bench" MAP 0x78230 TKF_SW_SW_SW 100.0 FORMULA_0001 0.0 100.0000 /begin AXIS_DESCR STD_AXIS n FORMULA_0006 12 0.0 10000.0000 /end AXIS_DESCR
 /begin AXIS_DESCR STD_AXIS pwg_soll FORMULA_0001 12 -10.0000 120.0000 FORMAT "%4.1" /end AXIS_DESCR
 FORMAT "%4.1" /end CHARACTERISTIC
/begin CHARACTERISTIC KF_MD_SMG_BEGR_OFF "max. Offset auf Fahrerwunsch | EN: Maximum offset on driver demand" MAP 0x78382 TKF_SW_SW_SW 100.0 FORMULA_0803 0.0 1000.0000
 /begin AXIS_DESCR STD_AXIS md_kupp_wunsch_ges FORMULA_0803 5 -100.0000 1000.0000 /end AXIS_DESCR
 /begin AXIS_DESCR STD_AXIS n_diff FORMULA_0006 5 0.0 10000.0000 /end AXIS_DESCR
/end CHARACTERISTIC
/begin CHARACTERISTIC KF_MD_NBEGR_KR "Regelparameter KR | EN: Control parameter KR (gain)" MAP 0x783CA TKF_SW_SW_UW 100.0 FORMULA_0816 0.0 2.0000 /begin AXIS_DESCR STD_AXIS gang FORMULA_0486 8 -1.0000 10.0000 /end AXIS_DESCR /begin AXIS_DESCR STD_AXIS n FORMULA_0006 6 0.0 10000.0000 /end AXIS_DESCR FORMAT "%5.2" /end CHARACTERISTIC
/begin CHARACTERISTIC KF_MD_NBEGR_TN "Regelparameter TN | EN: Control parameter TN (integral time)" MAP 0x78448 TKF_SW_SW_UW 100.0 FORMULA_0833 0.0030 60.0000 /begin AXIS_DESCR STD_AXIS gang FORMULA_0486 8 -1.0000 10.0000 /end AXIS_DESCR /begin AXIS_DESCR STD_AXIS n FORMULA_0006 6 0.0 10000.0000 /end AXIS_DESCR FORMAT "%6.3" /end CHARACTERISTIC
/begin CHARACTERISTIC KF_MD_NBEGR_TV "Regelparameter TV | EN: Control parameter TV (derivative time)" MAP 0x784C6 TKF_SW_SW_UW 100.0 FORMULA_0833 0.0 20.0000 /begin AXIS_DESCR STD_AXIS gang FORMULA_0486 8 -1.0000 10.0000 /end AXIS_DESCR /begin AXIS_DESCR STD_AXIS n FORMULA_0006 6 0.0 10000.0000 /end AXIS_DESCR FORMAT "%6.3" /end CHARACTERISTIC
/begin CHARACTERISTIC KF_MD_VBEGR_KR "Regelparameter KR | EN: Control parameter KR (gain)" MAP 0x78544 TKF_SW_SW_UW 100.0 FORMULA_0834 0.0 40.0000 /begin AXIS_DESCR STD_AXIS gang FORMULA_0486 4 -1.0000 10.0000 /end AXIS_DESCR
 /begin AXIS_DESCR STD_AXIS v_vorne FORMULA_0078 6 -80.0000 360.0000 FORMAT "%4.1" /end AXIS_DESCR
 FORMAT "%5.2" /end CHARACTERISTIC
/begin CHARACTERISTIC KF_MD_VBEGR_TN "Regelparameter TN | EN: Control parameter TN (integral time)" MAP 0x7858A TKF_SW_SW_UW 100.0 FORMULA_0833 0.0030 60.0000 /begin AXIS_DESCR STD_AXIS gang FORMULA_0486 4 -1.0000 10.0000 /end AXIS_DESCR
 /begin AXIS_DESCR STD_AXIS v_vorne FORMULA_0078 6 -80.0000 360.0000 FORMAT "%4.1" /end AXIS_DESCR
 FORMAT "%6.3" /end CHARACTERISTIC
/begin CHARACTERISTIC KF_MD_VBEGR_TV "Regelparameter TV | EN: Control parameter TV (derivative time)" MAP 0x785D0 TKF_SW_SW_UW 100.0 FORMULA_0833 0.0 20.0000 /begin AXIS_DESCR STD_AXIS gang FORMULA_0486 4 -1.0000 10.0000 /end AXIS_DESCR
 /begin AXIS_DESCR STD_AXIS v_vorne FORMULA_0078 6 -80.0000 360.0000 FORMAT "%4.1" /end AXIS_DESCR
 FORMAT "%6.3" /end CHARACTERISTIC
/begin MEASUREMENT md_fw_fgr "rel. Wunschmoment vom FGR" SWORD FORMULA_0001 0 0 0.0 100.0000 ECU_ADDRESS 0x3FC07C /end MEASUREMENT
/begin MEASUREMENT md_kupp_min_asc "min. Moment fuer ASC-Eingriff" SWORD FORMULA_0009 0 0 -100.0000 1000.0000 ECU_ADDRESS 0x3FC07E /end MEASUREMENT
/begin MEASUREMENT md_kupp_wunsch_grad "Gradient Fahrerwunsch" SWORD FORMULA_0571 0 0 -5000.0000 5000.0000 ECU_ADDRESS 0x3FC080 /end MEASUREMENT
/begin MEASUREMENT md_kupp_wunsch_filter "Wunschmoment nach Dynamikfilter" SWORD FORMULA_0009 0 0 -100.0000 1000.0000 ECU_ADDRESS 0x3FC082 /end MEASUREMENT
/begin MEASUREMENT md_kupp_wunsch_ges "Wunschmoment nach Dynamikf./RPS" SWORD FORMULA_0009 0 0 -100.0000 1000.0000 ECU_ADDRESS 0x3FC084 /end MEASUREMENT
/begin MEASUREMENT md_kupp_wunsch_begr_eff "effektives Begrenzermoment" SWORD FORMULA_0009 0 0 -100.0000 1000.0000 ECU_ADDRESS 0x3FC086 /end MEASUREMENT
/begin MEASUREMENT md_kupp_wunsch_ml_komp "komp. Wunschmoment fuer den Luftpfad" SWORD FORMULA_0009 0 0 -100.0000 1000.0000 ECU_ADDRESS 0x3FC088 /end MEASUREMENT
/begin MEASUREMENT md_kupp_begrenzer "Wunschmomentbegrenzer" SWORD FORMULA_0009 0 0 -100.0000 1000.0000 ECU_ADDRESS 0x3FC08A /end MEASUREMENT
/begin MEASUREMENT md_eta_zw_komp "Eta-Kompensation" UWORD FORMULA_0435 0 0 0.0 150.0000 ECU_ADDRESS 0x3FC08C /end MEASUREMENT
/begin MEASUREMENT md_res_min "min. Momentenreserve fuer OBD" SWORD FORMULA_0009 0 0 -100.0000 1000.0000 ECU_ADDRESS 0x3FC08E /end MEASUREMENT
/begin MEASUREMENT md_res_max "max. Momentenreserve" SWORD FORMULA_0009 0 0 -100.0000 1000.0000 ECU_ADDRESS 0x3FC090 /end MEASUREMENT
/begin MEASUREMENT md_res_anf "angeforderte Momentenreserve" SWORD FORMULA_0009 0 0 -100.0000 1000.0000 ECU_ADDRESS 0x3FC092 /end MEASUREMENT
/begin MEASUREMENT md_res_kath_roh "Momentenreserve Katheizen Rohwert" SWORD FORMULA_0009 0 0 -100.0000 1000.0000 ECU_ADDRESS 0x3FC094 /end MEASUREMENT
/begin MEASUREMENT md_res_kath "Momentenreserve Katheizen" SWORD FORMULA_0009 0 0 -100.0000 1000.0000 ECU_ADDRESS 0x3FC096 /end MEASUREMENT
/begin MEASUREMENT md_res "Momentenreserve" SWORD FORMULA_0009 0 0 -100.0000 1000.0000 ECU_ADDRESS 0x3FC098 /end MEASUREMENT
/begin MEASUREMENT md_ind_wunsch_ges "ind. Wunschmoment" SWORD FORMULA_0009 0 0 -100.0000 1000.0000 ECU_ADDRESS 0x3FC09A /end MEASUREMENT
/begin MEASUREMENT md_ind_wunsch_ml "ind. Wunschmoment fuer den Luftpfad" SWORD FORMULA_0009 0 0 -100.0000 1000.0000 ECU_ADDRESS 0x3FC09C /end MEASUREMENT
/begin MEASUREMENT md_ind_wunsch_ml_komp "Luft-Wunschmoment nach Kompensation" SWORD FORMULA_0009 0 0 -100.0000 1000.0000 ECU_ADDRESS 0x3FC09E /end MEASUREMENT
/begin MEASUREMENT md_ind_wunsch_tz "ind. Wunschmoment fuer den Zuendwinkelpfad" SWORD FORMULA_0009 0 0 -100.0000 1000.0000 ECU_ADDRESS 0x3FC0A0 /end MEASUREMENT
/begin MEASUREMENT md_ind_wunsch_tz_grad "Gradient Sollmoment" SWORD FORMULA_0571 0 0 -5000.0000 5000.0000 ECU_ADDRESS 0x3FC0A2 /end MEASUREMENT
/begin MEASUREMENT md_eta_bezug "Bezugsmoment Eta-Berechnung" SWORD FORMULA_0009 0 0 -100.0000 1000.0000 ECU_ADDRESS 0x3FC0A4 /end MEASUREMENT
/begin MEASUREMENT md_mzyl_soll_asp "Soll-Mzyl" SWORD FORMULA_0113 0 0 -500.0000 1500.0000 ECU_ADDRESS 0x3FC0A6 /end MEASUREMENT
/begin MEASUREMENT md_rf_soll "Soll-rf" SWORD FORMULA_0007 0 0 0.0 2.0000 ECU_ADDRESS 0x3FC0A8 /end MEASUREMENT
/begin MEASUREMENT md_rf_soll_pt_rg_b1 "Soll-rf mit pt-,rg-Korr" SWORD FORMULA_0007 0 0 0.0 2.0000 ECU_ADDRESS 0x3FC0AA /end MEASUREMENT
/begin MEASUREMENT md_rf_soll_pt_rg_b2 "Soll-rf mit pt-,rg-Korr" SWORD FORMULA_0007 0 0 0.0 2.0000 ECU_ADDRESS 0x3FC0AC /end MEASUREMENT
/begin MEASUREMENT md_rf_soll_pt_rg_fr_b1 "Soll-rf mit pt-,rg-,fr-Korr" SWORD FORMULA_0007 0 0 0.0 2.0000 ECU_ADDRESS 0x3FC0AE /end MEASUREMENT
/begin MEASUREMENT md_rf_soll_pt_rg_fr_b2 "Soll-rf mit pt-,rg-,fr-Korr" SWORD FORMULA_0007 0 0 0.0 2.0000 ECU_ADDRESS 0x3FC0B0 /end MEASUREMENT
/begin MEASUREMENT md_rf_rg_korr_b1 "Korrekturwert �ber RG" UWORD FORMULA_0075 0 0 0.0 4.0000 ECU_ADDRESS 0x3FC0B2 /end MEASUREMENT
/begin MEASUREMENT md_rf_rg_korr_b2 "Korrekturwert �ber RG" UWORD FORMULA_0075 0 0 0.0 4.0000 ECU_ADDRESS 0x3FC0B4 /end MEASUREMENT
/begin MEASUREMENT md_tz_eingr_aktiv "TZ-Eingriff" UBYTE FORMULA_0817 0 0 0.0 255.0 ECU_ADDRESS 0x3FC0B6 BIT_MASK 0x1 /end MEASUREMENT
/begin MEASUREMENT md_tz_eingr_bezug "TZ-Bezugsmoment" UBYTE FORMULA_0818 0 0 0.0 255.0 ECU_ADDRESS 0x3FC0B7 /end MEASUREMENT
/begin MEASUREMENT md_tz_st "TZ-Status" UWORD FORMULA_0010 0 0 0.0 65535.0000 ECU_ADDRESS 0x3FC0B8 /end MEASUREMENT
/begin MEASUREMENT md_tz_soll_zyl1 "Soll-TZ" SWORD FORMULA_0111 0 0 -50.0000 60.0000 ECU_ADDRESS 0x3FC0BA /end MEASUREMENT
/begin MEASUREMENT md_tz_soll_zyl2 "Soll-TZ" SWORD FORMULA_0111 0 0 -50.0000 60.0000 ECU_ADDRESS 0x3FC0BC /end MEASUREMENT
/begin MEASUREMENT md_tz_soll_zyl3 "Soll-TZ" SWORD FORMULA_0111 0 0 -50.0000 60.0000 ECU_ADDRESS 0x3FC0BE /end MEASUREMENT
/begin MEASUREMENT md_tz_soll_zyl4 "Soll-TZ" SWORD FORMULA_0111 0 0 -50.0000 60.0000 ECU_ADDRESS 0x3FC0C0 /end MEASUREMENT
/begin MEASUREMENT md_tz_soll_zyl5 "Soll-TZ" SWORD FORMULA_0111 0 0 -50.0000 60.0000 ECU_ADDRESS 0x3FC0C2 /end MEASUREMENT
/begin MEASUREMENT md_tz_soll_zyl6 "Soll-TZ" SWORD FORMULA_0111 0 0 -50.0000 60.0000 ECU_ADDRESS 0x3FC0C4 /end MEASUREMENT
/begin MEASUREMENT md_tz_soll_zyl7 "Soll-TZ" SWORD FORMULA_0111 0 0 -50.0000 60.0000 ECU_ADDRESS 0x3FC0C6 /end MEASUREMENT
/begin MEASUREMENT md_tz_soll_zyl8 "Soll-TZ" SWORD FORMULA_0111 0 0 -50.0000 60.0000 ECU_ADDRESS 0x3FC0C8 /end MEASUREMENT
/begin MEASUREMENT md_tz_soll_zyl9 "Soll-TZ" SWORD FORMULA_0111 0 0 -50.0000 60.0000 ECU_ADDRESS 0x3FC0CA /end MEASUREMENT
/begin MEASUREMENT md_tz_soll_zyl10 "Soll-TZ" SWORD FORMULA_0111 0 0 -50.0000 60.0000 ECU_ADDRESS 0x3FC0CC /end MEASUREMENT
/begin MEASUREMENT md_kupp_nbegr "max. Moment bei Drehzahlbegrenzung" SWORD FORMULA_0009 0 0 -100.0000 1000.0000 ECU_ADDRESS 0x3FC0CE /end MEASUREMENT
/begin MEASUREMENT md_kupp_vbegr "Moment Geschwindigkeitsbegrenzung" SWORD FORMULA_0009 0 0 -100.0000 1000.0000 ECU_ADDRESS 0x3FC0D4 /end MEASUREMENT
/begin MEASUREMENT md_vbegr_t "Timer Geschwindigkeitsbegrenzung" UWORD FORMULA_0117 0 0 0.0 325.0000 ECU_ADDRESS 0x3FC0DC /end MEASUREMENT
/begin MEASUREMENT md_nbegr_gang "Ganginfo" UBYTE FORMULA_0318 0 0 0.0 10.0000 ECU_ADDRESS 0x3FC0DE /end MEASUREMENT
/begin MEASUREMENT md_nbegr_egas "Aenderungsbegrenztes n_begr_egas" SWORD FORMULA_0006 0 0 0.0 10000.0000 ECU_ADDRESS 0x3FC0E0 /end MEASUREMENT
/begin MEASUREMENT md_nbegr_n_offset "Abregelung Maxdrehzahl" SWORD FORMULA_0006 0 0 0.0 10000.0000 ECU_ADDRESS 0x3FC0E2 /end MEASUREMENT
/begin MEASUREMENT md_nbegr_soll "Solldrehzahl inkl. Abregelung" SWORD FORMULA_0006 0 0 0.0 10000.0000 ECU_ADDRESS 0x3FC0E4 /end MEASUREMENT
/begin MEASUREMENT md_nbegr_abstand "Abstand zur Begrenzerdrehzahl" SWORD FORMULA_0006 0 0 -1000.0000 1000.0000 ECU_ADDRESS 0x3FC0E6 /end MEASUREMENT
/begin MEASUREMENT md_nbegr_b0 "Reglerfaktor b0" ULONG FORMULA_0815 0 0 0.0 4294967.2950 ECU_ADDRESS 0x3FC0E8 /end MEASUREMENT
/begin MEASUREMENT md_nbegr_b1 "Reglerfaktor b1" ULONG FORMULA_0819 0 0 0.0 -4294967.2950 ECU_ADDRESS 0x3FC0EC /end MEASUREMENT
/begin MEASUREMENT md_nbegr_b2 "Reglerfaktor b2" ULONG FORMULA_0815 0 0 0.0 4294967.2950 ECU_ADDRESS 0x3FC0F0 /end MEASUREMENT
/begin MEASUREMENT md_vbegr_b0 "Reglerfaktor b0" ULONG FORMULA_0820 0 0 0.0 4294967.2950 ECU_ADDRESS 0x3FC0F4 /end MEASUREMENT
/begin MEASUREMENT md_vbegr_b1 "Reglerfaktor b1" ULONG FORMULA_0821 0 0 0.0 -4294967.2950 ECU_ADDRESS 0x3FC0F8 /end MEASUREMENT
/begin MEASUREMENT md_vbegr_b2 "Reglerfaktor b2" ULONG FORMULA_0820 0 0 0.0 4294967.2950 ECU_ADDRESS 0x3FC0FC /end MEASUREMENT
/begin MEASUREMENT md_v_max_delta "Regeldifferenz gefiltert" SWORD FORMULA_0078 0 0 -80.0000 360.0000 ECU_ADDRESS 0x3FC100 /end MEASUREMENT
/begin MEASUREMENT md_noise_st "Noisestatus" UBYTE FORMULA_0822 0 0 0.0 255.0 ECU_ADDRESS 0x3FC102 /end MEASUREMENT
/begin MEASUREMENT md_noise_t "Noisetime" UWORD FORMULA_0073 0 0 0.0 6553.5000 ECU_ADDRESS 0x3FC104 /end MEASUREMENT
/begin MEASUREMENT md_kupp_noise_max "max. Moment bei Noise" SWORD FORMULA_0009 0 0 -100.0000 1000.0000 ECU_ADDRESS 0x3FC106 /end MEASUREMENT
/begin MEASUREMENT md_kupp_smg_begr "max. Moment fuer SMG-Eingriff" SWORD FORMULA_0009 0 0 -100.0000 1000.0000 ECU_ADDRESS 0x3FC108 /end MEASUREMENT
/begin MEASUREMENT md_kupp_ti_begr "max. Moment bei Einspritzproblemen" SWORD FORMULA_0009 0 0 -100.0000 1000.0000 ECU_ADDRESS 0x3FC10A /end MEASUREMENT
/begin MEASUREMENT md_kupp_gang_max "max. Moment ueber Gang" SWORD FORMULA_0009 0 0 -100.0000 1000.0000 ECU_ADDRESS 0x3FC10C /end MEASUREMENT
/begin FUNCTION Laufunruhe ""
 /begin DEF_CHARACTERISTIC KF_LU_FAKTOR_B2 KF_LU_OFFSET_ZYL1 KF_LU_OFFSET_ZYL10 KF_LU_OFFSET_ZYL2 KF_LU_OFFSET_ZYL3 KF_LU_OFFSET_ZYL4 KF_LU_OFFSET_ZYL5 KF_LU_OFFSET_ZYL6 KF_LU_OFFSET_ZYL7 KF_LU_OFFSET_ZYL8 KF_LU_OFFSET_ZYL9 KF_LU_SCHWELLE KL_LU_ADAP_FILT KL_LU_MD_DELTA_NEG KL_LU_MD_DELTA_POS KL_LU_RF_MIN KL_LU_SCHW_KATH KL_LU_SCHW_TMOT KL_LU_START_DLY KL_LU_START_TRIG_OFF K_LU_ACT_N_MAX K_LU_ACT_N_MIN K_LU_ADAP_DELAY K_LU_ADAP_ENDE K_LU_ADAP_GANG_MIN K_LU_ADAP_LIMIT K_LU_ADAP_N_MAX K_LU_ADAP_N_MIN K_LU_ADAP_OFFS_B2 K_LU_AUSKUPPL_DELAY K_LU_CFG K_LU_DSC_DELAY K_LU_KKOS_DELAY K_LU_KUPPL_DELAY K_LU_MD_DELAY K_LU_N_MIN K_LU_SA_DELAY K_LU_SCHW_EV_ERR K_LU_START_DELAY K_LU_TZ_DELAY K_LU_TZ_DELTA K_LU_WIN_LEN_B1 K_LU_WIN_LEN_B2 K_LU_WIN_PERIOD_B1 K_LU_WIN_PERIOD_B2 K_LU_WIN_START_B1 K_LU_WIN_START_B2 /end DEF_CHARACTERISTIC
 /begin REF_CHARACTERISTIC /end REF_CHARACTERISTIC
 /begin IN_MEASUREMENT /end IN_MEASUREMENT
 /begin OUT_MEASUREMENT B_LU_KKOS_OLD B_LU_KRAFTSCHLUSS_OLD B_LU_TRIGGER_FREI lu_abs lu_adap_delay lu_adap_filt lu_adap_schw lu_auss_zyl lu_auss_zyl1 lu_auss_zyl10 lu_auss_zyl2 lu_auss_zyl3 lu_auss_zyl4 lu_auss_zyl5 lu_auss_zyl6 lu_auss_zyl7 lu_auss_zyl8 lu_auss_zyl9 lu_dyn lu_faktor_b2 lu_idle_delay lu_idle_trigger lu_kuppl_delay lu_md_delta_neg lu_md_delta_pos lu_md_old lu_merk_ti_done lu_offset_zyl1 lu_offset_zyl10 lu_offset_zyl2 lu_offset_zyl3 lu_offset_zyl4 lu_offset_zyl5 lu_offset_zyl6 lu_offset_zyl7 lu_offset_zyl8 lu_offset_zyl9 lu_rf_min lu_schwelle lu_segm_ausblend lu_segm_idx_b1 lu_segm_idx_b2 lu_segm_idx_old lu_st lu_sta lu_ti_st_soll_old lu_ts_fifo_1of8_ lu_ts_fifo_2of8_ lu_ts_fifo_3of8_ lu_ts_fifo_4of8_ lu_ts_fifo_5of8_ lu_ts_fifo_6of8_ lu_ts_fifo_7of8_ lu_ts_fifo_8of8_ lu_ts_pr lu_ts_roh_segm1 lu_ts_roh_segm10 lu_ts_roh_segm2 lu_ts_roh_segm3 lu_ts_roh_segm4 lu_ts_roh_segm5 lu_ts_roh_segm6 lu_ts_roh_segm7 lu_ts_roh_segm8 lu_ts_roh_segm9 lu_tz_old lu_win_time_b1 lu_win_time_b2 lu_zyl1 lu_zyl10 lu_zyl2 lu_zyl3 lu_zyl4 lu_zyl5 lu_zyl6 lu_zyl7 lu_zyl8 lu_zyl9 /end OUT_MEASUREMENT
/end FUNCTION
/begin FUNCTION Leerlaufregler ""
 /begin DEF_CHARACTERISTIC KF_LLR_MD_I_NEG_MKS KF_LLR_MD_I_NEG_OKS KF_LLR_MD_I_POS_MKS KF_LLR_MD_I_POS_OKS KF_LLR_N_SOLL_KH_OFF KL_LLR_D_FAK_TOEL KL_LLR_MD_RES_TMOT KL_LLR_MD_TZ_MKS KL_LLR_MD_TZ_MKS_KH KL_LLR_MD_TZ_OKS KL_LLR_MD_TZ_OKS_KH KL_LLR_N_SOLL_TMOT KL_LLR_N_SOLL_TMOT_E2 KL_LLR_N_SOLL_TOEL_OFF K_LLR_CFG_MIN K_LLR_CFG_N_NACHF K_LLR_DIAG_CSS_N_ZU_GROSS K_LLR_DIAG_CSS_N_ZU_KLEIN K_LLR_DIAG_CSS_T K_LLR_DIAG_CSS_TMOT K_LLR_DIAG_CSS_TOEL K_LLR_DIAG_CSS_T_IO K_LLR_DIAG_FRA_MAX K_LLR_DIAG_FRA_MIN K_LLR_DIAG_MD_ERR_ABR K_LLR_DIAG_MD_FAK K_LLR_DIAG_N_ZU_GROSS K_LLR_DIAG_N_ZU_KLEIN K_LLR_DIAG_T K_LLR_DIAG_TMOT K_LLR_DIAG_TOEL K_LLR_DIAG_T_IO K_LLR_DMD_MAX_E2 K_LLR_D_GRAD K_LLR_D_OFFSET K_LLR_ERR_MAX_E2 K_LLR_IA_B1_ABR K_LLR_IA_B2_ABR K_LLR_MD_D_MAX K_LLR_MD_D_MIN K_LLR_MD_MAX_E2 K_LLR_MD_MIN_E2 K_LLR_MD_MKS_MAX K_LLR_MD_MKS_MIN K_LLR_MD_OKS_MAX K_LLR_MD_OKS_MIN K_LLR_MD_RES_AUFR K_LLR_MD_RES_WAIT K_LLR_MD_TZ_RUECK_HYS K_LLR_MD_TZ_RUECK_NEG K_LLR_MD_TZ_RUECK_POS K_LLR_MD_TZ_TAU K_LLR_N_DIFF_MAX_E2 K_LLR_N_EINGEREGELT K_LLR_N_KATH_ABR K_LLR_N_KATH_AUFR K_LLR_N_KATH_HYS K_LLR_N_OFFSET_B1 K_LLR_N_OFFSET_B2 K_LLR_N_RESET K_LLR_N_SOLL_AC_OFFSET K_LLR_N_SOLL_MAX K_LLR_N_SOLL_MIN K_LLR_N_SOLL_NF_FAKTOR K_LLR_N_SOLL_NF_FAKTOR_E2 K_LLR_N_SOLL_NF_MAX K_LLR_N_SOLL_NF_MAX_E2 K_LLR_N_SOLL_TAU K_LLR_N_SOLL_ZH_OFFSET K_LLR_OMEGA_TAU K_LLR_PWG_ANFAHR K_LLR_TIME_FILOFF /end DEF_CHARACTERISTIC
 /begin REF_CHARACTERISTIC /end REF_CHARACTERISTIC
 /begin IN_MEASUREMENT /end IN_MEASUREMENT
 /begin OUT_MEASUREMENT llr_diag_flags llr_diag_flags_css llr_diag_state llr_diag_timer llr_diag_timer_io llr_exd_state llr_md_d llr_md_d_roh llr_md_i llr_md_i_max llr_md_i_max_e2 llr_md_i_min llr_md_p llr_md_res llr_md_schw_ist llr_md_tz llr_md_tz_fil llr_md_tz_rueck llr_n_diff llr_n_diff_nachf llr_n_soll_diff_e2 llr_n_soll_exd llr_n_soll_fil llr_n_soll_kh llr_n_soll_kh_fil llr_n_soll_kkos llr_n_soll_nachf llr_n_soll_tmot llr_n_soll_toel llr_omega_grad_ist llr_plausi_e2_err llr_timer /end OUT_MEASUREMENT
/end FUNCTION
/begin FUNCTION Leerlaufregleradaption ""
 /begin DEF_CHARACTERISTIC K_LLR_AD_AC_MAX K_LLR_AD_AC_MIN K_LLR_AD_CFG K_LLR_AD_I_ANTEIL_OFF K_LLR_AD_I_TAU K_LLR_AD_MD_GRAD K_LLR_AD_MD_NEUZUSTAND K_LLR_AD_MD_ZYKLUS_MAX K_LLR_AD_NORM_MAX K_LLR_AD_NORM_MIN K_LLR_AD_N_HYS_NEG K_LLR_AD_N_HYS_POS K_LLR_AD_TIME_STABIL K_LLR_AD_TMOT K_LLR_AD_TOEL K_LLR_AD_UMSCHALT_RAMPE /end DEF_CHARACTERISTIC
 /begin REF_CHARACTERISTIC /end REF_CHARACTERISTIC
 /begin IN_MEASUREMENT /end IN_MEASUREMENT
 /begin OUT_MEASUREMENT llr_ad_flags llr_ad_i_smooth llr_ad_md llr_ad_timer llr_ad_zustand /end OUT_MEASUREMENT
/end FUNCTION
/begin FUNCTION Momentenmanager ""
 /begin DEF_CHARACTERISTIC KF_MD_DELTA_DP_ON KF_MD_DYN_FIL_RES KF_MD_DYN_FIL_RES_FAK KF_MD_ETA_LA KF_MD_FAHRER_KOMFORT KF_MD_FAHRER_NORMAL KF_MD_FAHRER_PST KF_MD_FAHRER_SPORT KF_MD_FAK_GRAD_DP_B1 KF_MD_FAK_GRAD_DP_B2 KF_MD_FAK_GRAD_DP_B3 KF_MD_GRAD_DP_B1 KF_MD_GRAD_DP_B2 KF_MD_GRAD_DP_B3 KF_MD_GRAD_DP_LLMKS KF_MD_GRAD_LSD_B1 KF_MD_GRAD_LSD_B2 KF_MD_GRAD_LSD_B3 KF_MD_GRAD_LSD_LLMKS KF_MD_IND_LW_VERLUSTE KF_MD_IND_MIN_SCHUB KF_MD_IND_OPT KF_MD_IND_REIB KF_MD_KKOS_KORR KF_MD_KOMFORT_DP KF_MD_KOMFORT_LSD KF_MD_KUPP_GRENZ_DP_O KF_MD_KUPP_GRENZ_DP_U_OFFS KF_MD_KUPP_GRENZ_LSD_O KF_MD_KUPP_GRENZ_LSD_U_OFFS KF_MD_LRW KF_MD_NBEGR_KR KF_MD_NBEGR_TN KF_MD_NBEGR_TV KF_MD_POLYNOM_A KF_MD_POLYNOM_A_KH KF_MD_POLYNOM_B KF_MD_SK_DIFF_MAX KF_MD_SMG_BEGR_OFF KF_MD_SPORT_DP KF_MD_SPORT_LSD KF_MD_START_OFFSET KF_MD_TAU_LSD_B3 KF_MD_VBEGR_KR KF_MD_VBEGR_TN KF_MD_VBEGR_TV KF_MD_VERBR_FZG KF_MD_ZW_OFFSET KF_MD_ZW_OPT KF_MD_ZW_RG KL_MD_BEGR_NOISE KL_MD_ETA_LA KL_MD_FAHRER_FAK_KOMFORT KL_MD_FAHRER_FAK_NORMAL KL_MD_FAHRER_FAK_SPORT KL_MD_FAK_DP_B1 KL_MD_FAK_DP_B2 KL_MD_FAK_DP_B3 KL_MD_FAK_LSD_ANFF KL_MD_FAK_LSD_B1 KL_MD_FAK_LSD_B2 KL_MD_FAK_LSD_B3 KL_MD_HYP_DN KL_MD_HYP_VERH_KRAFTS KL_MD_IND_REIB_ABREG KL_MD_IND_REIB_OFFSET KL_MD_IND_RF_MIN_OFFS KL_MD_KKOS_DELAY_OFF KL_MD_KKOS_DELAY_ON KL_MD_KKOS_RES_MAX KL_MD_KKOS_ZH_RES_MAX KL_MD_KR_DTZ_DOWN KL_MD_KR_DTZ_UP KL_MD_KUPP_MAX_CAN KL_MD_KUPP_MAX_GANG KL_MD_KUPP_MIN_ASC KL_MD_LRW_FAK KL_MD_LRW_RES KL_MD_MAX_FAK_POWER KL_MD_MAX_N_OFFS KL_MD_MAX_TMOT KL_MD_NBEGR_ABSTAND KL_MD_NBEGR_GANG KL_MD_NBEGR_KR_FAK KL_MD_NBEGR_KR_FAK_SK KL_MD_NBEGR_N_MAX KL_MD_NBEGR_N_OFFSET KL_MD_NBEGR_RAMPE KL_MD_NBEGR_TN_FAK KL_MD_NBEGR_TN_FAK_SK KL_MD_NBEGR_TV_FAK KL_MD_RES_MIN KL_MD_RF_MAX_ROH KL_MD_RG_TAU KL_MD_SCHW_TAU KL_MD_SK_GRAD_MAX KL_MD_SK_MD_BEGR KL_MD_SK_WDK KL_MD_SK_WDK_TI_OFFS KL_MD_TAU_START_OFF KL_MD_TZ_AEBG_AB KL_MD_TZ_AEBG_AUF KL_MD_VBEGR_ABSTAND KL_MD_VBEGR_KR_FAK KL_MD_VBEGR_KR_FAK_SK KL_MD_VBEGR_RAMPE KL_MD_VBEGR_TAU KL_MD_VBEGR_TN_FAK KL_MD_VBEGR_TN_FAK_SK KL_MD_VBEGR_TV_FAK KL_MD_ZW_LA KL_MD_ZW_TMOT_FAK K_MD_ANFF_PWG_OFF K_MD_ANFF_PWG_ON K_MD_ANFF_V_SCHW K_MD_ASC_AUSBLEND_HYS K_MD_ASC_ENABLE K_MD_ASC_M_AEBEGR K_MD_ASC_M_RAMPE K_MD_ASC_T_WAIT K_MD_BEZUG_HYS K_MD_BEZUG_RAMPE K_MD_BLS_BRP K_MD_BLS_BRP_VMA K_MD_BLS_DN_VMA K_MD_BLS_FW_REL K_MD_BLS_GANG_VMA K_MD_BLS_N K_MD_BLS_N_VMA K_MD_CAN_BEGR_ST K_MD_CAN_ETA_ZW_OFF K_MD_CFG_DYN_FIL K_MD_CFG_ETA_KOMP K_MD_CFG_FW_BLS K_MD_CFG_MCS K_MD_CFG_RG_KORR K_MD_CFG_TZ_EINGR K_MD_CFG_ZW_BEZUG K_MD_DYN_FIL_RES_TAU K_MD_ETA_EINGRIFF K_MD_ETA_KH_TAU K_MD_ETA_KH_TAU_LL K_MD_ETA_KR_KOMP K_MD_ETA_LA_KOMP_MAX K_MD_ETA_LA_TAU K_MD_ETA_SK_MIN K_MD_ETA_STAT_TAU K_MD_ETA_STAT_TAU_LL K_MD_ETA_ZW_MIN K_MD_GEN_FREISCHALT K_MD_GEN_MAX K_MD_GRAD_DP_OKS K_MD_GRAD_LSD_OKS K_MD_GRAD_SA K_MD_GRAD_SA_CUF K_MD_GRAD_SA_VMA K_MD_HYP_VERH_NO_KRAFTS K_MD_HYP_VERH_START K_MD_HYS_RICHTUNG K_MD_HYS_SA K_MD_HYS_SA_TZ K_MD_IND_WUNSCH_TZ_MCS K_MD_KKOS_CAN_MAX K_MD_KKOS_DYN_ST K_MD_KKOS_ELU_TMOT_MAX K_MD_KKOS_ELU_TMOT_MAX_HYS K_MD_KKOS_MAX K_MD_KKOS_MIN K_MD_KKOS_N K_MD_KKOS_N_MAX K_MD_KKOS_N_MAX_HYS K_MD_KKOS_RES_RAMPE_OFF K_MD_KKOS_RES_RAMPE_ON K_MD_KKOS_RES_T_MAX K_MD_KKOS_START K_MD_KKOS_TAU_OFF K_MD_KKOS_TAU_ON K_MD_KKOS_TIME_BA_VL K_MD_KKOS_TIME_START K_MD_KKOS_TIME_WH K_MD_KKOS_TMOT_MAX K_MD_KKOS_TMOT_MAX_HYS K_MD_KKOS_V_BA K_MD_KKOS_V_VL K_MD_KKOS_V_VL_AUS K_MD_KKOS_ZH_RES_RAMPE K_MD_KKOS_ZH_RES_T_MAX K_MD_KKOS_ZH_TMOT K_MD_KKOS_ZH_TUMG K_MD_KUPP_BEGR_MCS K_MD_KUPP_GANG_RAMPE K_MD_LRW_RES_DELTA K_MD_LRW_RES_V K_MD_LRW_RES_V_HYS K_MD_LRW_TAU K_MD_MAX_FAK K_MD_MAX_POWER_NEG K_MD_MAX_POWER_POS K_MD_MSR_ENABLE K_MD_MSR_MAX K_MD_MSR_M_RAMPE K_MD_MSR_T_WAIT K_MD_NBEGR_A1 K_MD_NBEGR_AKTIV K_MD_NBEGR_HYS_AUS K_MD_NBEGR_MD_HYS K_MD_NBEGR_N_DELTA K_MD_NOISE_CFG K_MD_NOISE_PWG_SOLL K_MD_NOISE_RAMPE K_MD_NOISE_T K_MD_NOISE_V_MAX1 K_MD_NOISE_V_MAX2 K_MD_NOISE_V_MAX3 K_MD_NOISE_V_MIN1 K_MD_NOISE_V_MIN2 K_MD_NOISE_V_MIN3 K_MD_PULS_AMP K_MD_PULS_EIN K_MD_PULS_OFFS K_MD_PULS_RAMPE K_MD_PULS_T K_MD_RESERVE_TST K_MD_RES_KATH_FAK K_MD_RES_KATH_TAU K_MD_RES_MIN K_MD_RES_MIN_HYS K_MD_RF_SOLL_MCS K_MD_RF_SOLL_SEK_CFG K_MD_RG_RF_FAKTOR K_MD_SK_BEGR_RAMPE K_MD_SK_CFG K_MD_SK_ETA_MIN K_MD_SK_FWMAX K_MD_SK_IND_MAX K_MD_SK_LLR_MAX K_MD_SK_MAX_MDMIN K_MD_SK_NHYS K_MD_SK_N_MDMIN K_MD_SK_N_MIN K_MD_SK_PWGMIN K_MD_SK_RF_MAX K_MD_SK_TAU_PWG K_MD_SK_TAU_VERGL K_MD_SK_TIMER_0 K_MD_SK_TIMER_1 K_MD_SK_TIRED_HYS K_MD_SK_TIRED_MIN K_MD_SK_TIRED_ZYL_10of11_ K_MD_SK_TIRED_ZYL_11of11_ K_MD_SK_TIRED_ZYL_1of11_ K_MD_SK_TIRED_ZYL_2of11_ K_MD_SK_TIRED_ZYL_3of11_ K_MD_SK_TIRED_ZYL_4of11_ K_MD_SK_TIRED_ZYL_5of11_ K_MD_SK_TIRED_ZYL_6of11_ K_MD_SK_TIRED_ZYL_7of11_ K_MD_SK_TIRED_ZYL_8of11_ K_MD_SK_TIRED_ZYL_9of11_ K_MD_SK_WDK_KH_OFFS K_MD_SK_WDK_LLSFAIL_OFFS K_MD_TAU_FW_DPFIL K_MD_TAU_FW_GRAD K_MD_TAU_IND_TZ_GRAD K_MD_TZ_SOLL_MCS K_MD_VBEGR_A1 K_MD_VBEGR_HYS_AUS K_MD_VBEGR_MD_HYS K_MD_VERBR_MAX /end DEF_CHARACTERISTIC
 /begin REF_CHARACTERISTIC /end REF_CHARACTERISTIC
 /begin IN_MEASUREMENT /end IN_MEASUREMENT
 /begin OUT_MEASUREMENT md_bereich md_dsc_t_wait md_dyn_fil_res md_dyn_fil_res_roh md_dyn_flags md_dyn_freigabe md_dyn_smg_timer md_dyn_st md_dyn_st_anff md_dyn_st_tz_min md_eta_ausbl_sk md_eta_ausblend md_eta_bezug md_eta_la_ist md_eta_la_vl md_eta_rg_brenn md_eta_rg_lw md_eta_zw_kh md_eta_zw_kh_kr md_eta_zw_komp md_eta_zw_kr md_eta_zw_min md_eta_zw_ne md_eta_zw_soll md_eta_zw_stat md_eta_zw_ve md_exd_kkos_max md_exd_kkos_timeout md_fak_fummel_dp md_fak_fummel_lsd md_fak_zufall_dp md_fak_zufall_lsd md_fw_fgr md_gen md_gen_st md_grad md_grad_anf md_grad_dp md_grad_lsd md_grad_max md_hyp_faktor md_ind_ist_skmin md_ind_lw_ist md_ind_lw_max md_ind_lw_min md_ind_max md_ind_max_roh md_ind_min md_ind_min_roh md_ind_min_schub md_ind_opt md_ind_opt_la md_ind_opt_la_rg md_ind_reib md_ind_reib_abreg md_ind_reib_offset md_ind_reib_roh md_ind_rf_min md_ind_schlepp_max md_ind_ve md_ind_wunsch_ges md_ind_wunsch_ml md_ind_wunsch_ml_komp md_ind_wunsch_tz md_ind_wunsch_tz_grad md_kkos md_kkos_freig_st md_kkos_res md_kkos_res_max md_kkos_s md_kkos_sperr_st md_kkos_time_ba md_kkos_time_delay md_kkos_time_res md_kkos_time_vl md_kkos_time_wh md_kkos_zh_res md_kkos_zh_res_max md_kkos_zh_time_res md_kkos_zust md_kr_filter md_kupp_asc_ml md_kupp_asc_tz md_kupp_begrenzer md_kupp_gang_max md_kupp_grenz_dp_o md_kupp_grenz_dp_u md_kupp_grenz_lsd_o md_kupp_grenz_lsd_u md_kupp_grenz_o md_kupp_grenz_u md_kupp_ist_schw md_kupp_max_mdrv md_kupp_min_asc md_kupp_min_schub md_kupp_msr_ml md_kupp_msr_tz md_kupp_nbegr md_kupp_noise_max md_kupp_smg_begr md_kupp_ti_begr md_kupp_vbegr md_kupp_wunsch_begr_eff md_kupp_wunsch_fil_dp md_kupp_wunsch_fil_roh md_kupp_wunsch_filter md_kupp_wunsch_ges md_kupp_wunsch_grad md_kupp_wunsch_grad_max md_kupp_wunsch_ml_komp md_kupp_wunsch_puls md_lrw md_lrw_fil md_lrw_res md_mzyl_soll_asp md_n_grad_fil md_nbegr_abstand md_nbegr_b0 md_nbegr_b1 md_nbegr_b2 md_nbegr_egas md_nbegr_gang md_nbegr_n_offset md_nbegr_soll md_noise_st md_noise_t md_polynom_a md_polynom_b md_puls_timer md_res md_res_anf md_res_kath md_res_kath_roh md_res_max md_res_min md_rf_min md_rf_rg_korr_b1 md_rf_rg_korr_b2 md_rf_soll md_rf_soll_pt_rg_b1 md_rf_soll_pt_rg_b2 md_rf_soll_pt_rg_fr_b1 md_rf_soll_pt_rg_fr_b2 md_rf_tl_vl md_richtung md_sk_diff_max md_sk_fehler md_sk_grad_max md_sk_pwg md_sk_timer_0 md_sk_timer_1 md_sk_tired md_sk_vergl_diff md_sk_vergl_soll md_sk_verh md_sk_wdkmax_b1 md_sk_wdkmax_b2 md_sk_wunsch_begr_ml md_sk_wunsch_begr_tz md_start_offset md_tz_eingr_aktiv md_tz_eingr_bezug md_tz_soll_zyl1 md_tz_soll_zyl10 md_tz_soll_zyl2 md_tz_soll_zyl3 md_tz_soll_zyl4 md_tz_soll_zyl5 md_tz_soll_zyl6 md_tz_soll_zyl7 md_tz_soll_zyl8 md_tz_soll_zyl9 md_tz_st md_v_max_delta md_vbegr_b0 md_vbegr_b1 md_vbegr_b2 md_vbegr_t md_verbr_fzg md_verbraucher md_zw_la_ist_delta md_zw_opt md_zw_opt_rg md_zw_opt_rg_tmot md_zw_opt_rg_tmot_la md_zw_rg_delta md_zw_tmot_delta /end OUT_MEASUREMENT
/end FUNCTION
/begin RECORD_LAYOUT TKW_VV_VV_UB FNC_VALUES 1 UBYTE COLUMN_DIR DIRECT /end RECORD_LAYOUT
/begin RECORD_LAYOUT TKW_VV_VV_SB FNC_VALUES 1 SBYTE COLUMN_DIR DIRECT /end RECORD_LAYOUT
/begin RECORD_LAYOUT TKW_VV_VV_UW FNC_VALUES 1 UWORD COLUMN_DIR DIRECT /end RECORD_LAYOUT
/begin RECORD_LAYOUT TKW_VV_VV_SW FNC_VALUES 1 SWORD COLUMN_DIR DIRECT /end RECORD_LAYOUT
/begin RECORD_LAYOUT TKL_UB_VV_UB NO_AXIS_PTS_X 1 UBYTE RESERVED 2 BYTE AXIS_PTS_X 3 UBYTE INDEX_INCR DIRECT FNC_VALUES 4 UBYTE COLUMN_DIR DIRECT /end RECORD_LAYOUT
/begin RECORD_LAYOUT TKL_UB_VV_SW NO_AXIS_PTS_X 1 UBYTE RESERVED 2 BYTE AXIS_PTS_X 3 UBYTE INDEX_INCR DIRECT FNC_VALUES 4 SWORD COLUMN_DIR DIRECT /end RECORD_LAYOUT
/begin RECORD_LAYOUT TKL_UW_VV_UW NO_AXIS_PTS_X 1 UBYTE RESERVED 2 BYTE AXIS_PTS_X 3 UWORD INDEX_INCR DIRECT FNC_VALUES 4 UWORD COLUMN_DIR DIRECT /end RECORD_LAYOUT
/begin RECORD_LAYOUT TKL_UW_VV_SW NO_AXIS_PTS_X 1 UBYTE RESERVED 2 BYTE AXIS_PTS_X 3 UWORD INDEX_INCR DIRECT FNC_VALUES 4 SWORD COLUMN_DIR DIRECT /end RECORD_LAYOUT
/begin RECORD_LAYOUT TKL_SW_VV_UB NO_AXIS_PTS_X 1 UBYTE RESERVED 2 BYTE AXIS_PTS_X 3 SWORD INDEX_INCR DIRECT FNC_VALUES 4 UBYTE COLUMN_DIR DIRECT /end RECORD_LAYOUT
/begin RECORD_LAYOUT TKL_SW_VV_UW NO_AXIS_PTS_X 1 UBYTE RESERVED 2 BYTE AXIS_PTS_X 3 SWORD INDEX_INCR DIRECT FNC_VALUES 4 UWORD COLUMN_DIR DIRECT /end RECORD_LAYOUT
/begin RECORD_LAYOUT TKL_SW_VV_SW NO_AXIS_PTS_X 1 UBYTE RESERVED 2 BYTE AXIS_PTS_X 3 SWORD INDEX_INCR DIRECT FNC_VALUES 4 SWORD COLUMN_DIR DIRECT /end RECORD_LAYOUT
/begin RECORD_LAYOUT TKF_SW_SW_UW NO_AXIS_PTS_X 1 UBYTE NO_AXIS_PTS_Y 2 UBYTE AXIS_PTS_X 3 SWORD INDEX_INCR DIRECT AXIS_PTS_Y 4 SWORD INDEX_INCR DIRECT FNC_VALUES 5 UWORD COLUMN_DIR DIRECT /end RECORD_LAYOUT
/begin RECORD_LAYOUT TKF_SW_SW_SW NO_AXIS_PTS_X 1 UBYTE NO_AXIS_PTS_Y 2 UBYTE AXIS_PTS_X 3 SWORD INDEX_INCR DIRECT AXIS_PTS_Y 4 SWORD INDEX_INCR DIRECT FNC_VALUES 5 SWORD COLUMN_DIR DIRECT /end RECORD_LAYOUT
/end MODULE
/end PROJECT
