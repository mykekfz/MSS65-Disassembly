/begin PROJECT MSS65-ign-V452 "MSS65 IGN - V452.01-B204.00, data set 0569Q60Z160E"
/begin HEADER "" VERSION "V452.01-B204.00" /end HEADER
/begin MODULE _MSS65-ign "MSS65 IGN - V452.01-B204.00, calibration xxxxxxxx"
/begin MOD_COMMON "" BYTE_ORDER MSB_FIRST /* Default byteorder (Motorola) */ /end MOD_COMMON
/* ------------------ Abschnitt erzeugt aus adapt_common.dat ------------------ */
/begin COMPU_METHOD FORMULA_0000 "FORMULA_0000" RAT_FUNC "%7.0" "-" COEFFS 0 1 0 0 0 1 /end COMPU_METHOD
/begin COMPU_METHOD FORMULA_0003 "FORMULA_0003" RAT_FUNC "%3.0" "-" COEFFS 0 1 0 0 0 1 /end COMPU_METHOD
/begin COMPU_METHOD FORMULA_0006 "FORMULA_0006" RAT_FUNC "%5.0" "Upm" COEFFS 0 1 0 0 0 1 /end COMPU_METHOD
/begin COMPU_METHOD FORMULA_0007 "FORMULA_0007" RAT_FUNC "%8.3" "-" COEFFS 0 10000 0 0 0 1 /end COMPU_METHOD
/begin COMPU_METHOD FORMULA_0009 "FORMULA_0009" RAT_FUNC "%6.1" "Nm" COEFFS 0 10 0 0 0 1 /end COMPU_METHOD
/begin COMPU_METHOD FORMULA_0010 "FORMULA_0010" RAT_FUNC "%5.0" "-" COEFFS 0 1 0 0 0 1 /end COMPU_METHOD
/begin COMPU_METHOD FORMULA_0017 "FORMULA_0017" RAT_FUNC "%9.2" "ms" COEFFS 0 7000 0 0 0 1 /end COMPU_METHOD
/begin COMPU_METHOD FORMULA_0020 "FORMULA_0020" RAT_FUNC "%5.0" "qmm/s" COEFFS 0 1 0 0 0 20 /end COMPU_METHOD
/begin COMPU_METHOD FORMULA_0021 "FORMULA_0021" RAT_FUNC "%7.2" "s" COEFFS 0 100 0 0 0 1 /end COMPU_METHOD
/* ------------------ Abschnitt erzeugt aus adapt_glob.dat ------------------ */
/begin COMPU_METHOD FORMULA_0023 "FORMULA_0023" RAT_FUNC "%6.1" "�C" COEFFS 0 10 2732 0 0 1 /end COMPU_METHOD
/begin COMPU_METHOD FORMULA_0025 "FORMULA_0025" RAT_FUNC "%8.3" "-" COEFFS 0 16384 0 0 0 1 /end COMPU_METHOD
/begin COMPU_METHOD FORMULA_0033 "FORMULA_0033" RAT_FUNC "%5.2" "-" COEFFS 0 1 0 0 0 1 /end COMPU_METHOD
/begin COMPU_METHOD FORMULA_0062 "FORMULA_0062" RAT_FUNC "%5.0" "s" COEFFS 0 1 0 0 0 1 /end COMPU_METHOD
/begin COMPU_METHOD FORMULA_0073 "FORMULA_0073" RAT_FUNC "%6.1" "s" COEFFS 0 10 0 0 0 1 /end COMPU_METHOD
/begin COMPU_METHOD FORMULA_0075 "FORMULA_0075" RAT_FUNC "%8.3" "-" COEFFS 0 1024 0 0 0 1 /end COMPU_METHOD
/begin COMPU_METHOD FORMULA_0076 "FORMULA_0076" RAT_FUNC "%6.1" "Kelvin" COEFFS 0 10 0 0 0 1 /end COMPU_METHOD
/begin COMPU_METHOD FORMULA_0077 "FORMULA_0077" RAT_FUNC "%6.1" "mbar" COEFFS 0 16 0 0 0 1 /end COMPU_METHOD
/begin COMPU_METHOD FORMULA_0078 "FORMULA_0078" RAT_FUNC "%6.1" "km/h" COEFFS 0 16 0 0 0 1 /end COMPU_METHOD
/begin COMPU_METHOD FORMULA_0109 "FORMULA_0109" RAT_FUNC "%7.2" "-" COEFFS 0 10000 0 0 0 1 /end COMPU_METHOD
/begin COMPU_METHOD FORMULA_0111 "FORMULA_0111" RAT_FUNC "%6.1" "�KW" COEFFS 0 10 0 0 0 1 /end COMPU_METHOD
/begin COMPU_METHOD FORMULA_0114 "FORMULA_0114" RAT_FUNC "%5.0" "Upm/s" COEFFS 0 1 0 0 0 1 /end COMPU_METHOD
/begin COMPU_METHOD FORMULA_0115 "FORMULA_0115" RAT_FUNC "%7.2" "%" COEFFS 0 16384 0 0 0 100 /end COMPU_METHOD
/begin COMPU_METHOD FORMULA_0117 "FORMULA_0117" RAT_FUNC "%7.2" "s" COEFFS 0 200 0 0 0 1 /end COMPU_METHOD
/begin COMPU_METHOD FORMULA_0123 "FORMULA_0123" RAT_FUNC "%5.0" "digit" COEFFS 0 1 0 0 0 1 /end COMPU_METHOD
/begin COMPU_METHOD FORMULA_0132 "FORMULA_0132" RAT_FUNC "%7.2" "m/(s*s)" COEFFS 0 40 0 0 0 1 /end COMPU_METHOD
/begin COMPU_METHOD FORMULA_0204 "FORMULA_0204" RAT_FUNC "%8.3" "100/10ms" COEFFS 0 100 0 0 0 1 /end COMPU_METHOD
/begin COMPU_METHOD FORMULA_0243 "FORMULA_0243" RAT_FUNC "%10.3" "�KW" COEFFS 0 81920 0 0 0 1 /end COMPU_METHOD
/begin COMPU_METHOD FORMULA_0244 "FORMULA_0244" RAT_FUNC "%8.1" "�KW" COEFFS 0 10 0 0 0 1 /end COMPU_METHOD
/begin COMPU_METHOD FORMULA_0295 "FORMULA_0295" RAT_FUNC "%9.4" "-" COEFFS 0 16384 0 0 0 1 /end COMPU_METHOD
/begin COMPU_METHOD FORMULA_0318 "FORMULA_0318" RAT_FUNC "%3.0" ".Gang" COEFFS 0 1 0 0 0 1 /end COMPU_METHOD
/begin COMPU_METHOD FORMULA_0435 "FORMULA_0435" RAT_FUNC "%6.1" "%" COEFFS 0 32768 0 0 0 100 /end COMPU_METHOD
/begin COMPU_METHOD FORMULA_0443 "FORMULA_0443" RAT_FUNC "%7.2" "V" COEFFS 0 1 0 0 0 0.00080566 /end COMPU_METHOD
/begin COMPU_METHOD FORMULA_0449 "FORMULA_0449" RAT_FUNC "%7.2" "*" COEFFS 0 1024 0 0 0 1 /end COMPU_METHOD
/begin COMPU_METHOD FORMULA_0478 "FORMULA_0478" RAT_FUNC "%6.3" "s" COEFFS 0 0 1.28 0 1 0 /end COMPU_METHOD
/begin COMPU_METHOD FORMULA_0491 "FORMULA_0491" RAT_FUNC "%9.4" "-" COEFFS 0 8192 0 0 0 1 /end COMPU_METHOD
/begin COMPU_METHOD FORMULA_0497 "FORMULA_0497" RAT_FUNC "%7.2" "-" COEFFS 0 100 0 0 0 1 /end COMPU_METHOD
/begin COMPU_METHOD FORMULA_0499 "FORMULA_0499" RAT_FUNC "%8.3" "s" COEFFS 0 1000 0 0 0 1 /end COMPU_METHOD
/begin COMPU_METHOD FORMULA_0574 "FORMULA_0574" TAB_VERB "%3.0" "-" COMPU_TAB_REF FORMULA_0574_VTAB /end COMPU_METHOD
/begin COMPU_VTAB FORMULA_0574_VTAB "FORMULA_0574_VTAB" TAB_VERB 2 0 "Aus" 1 "Ein" DEFAULT_VALUE "undefiniert" /end COMPU_VTAB
/begin COMPU_METHOD FORMULA_0578 "FORMULA_0578" RAT_FUNC "%7.2" "%" COEFFS 0 40.95 0 0 0 1 /end COMPU_METHOD
/begin COMPU_METHOD FORMULA_0579 "FORMULA_0579" RAT_FUNC "%11.4" "-" COEFFS 0 1 0 0 0 1 /end COMPU_METHOD
/begin COMPU_METHOD FORMULA_0679 "FORMULA_0679" RAT_FUNC "%5.2" "s" COEFFS 0 0 25.6 0 1 0 /end COMPU_METHOD
/* ------------------ Abschnitt erzeugt aus ka.dat ------------------ */
/begin COMPU_METHOD FORMULA_0692 "FORMULA_0692" TAB_VERB "%5.0" "-" COMPU_TAB_REF FORMULA_0692_VTAB /end COMPU_METHOD
/begin COMPU_VTAB FORMULA_0692_VTAB "FORMULA_0692_VTAB" TAB_VERB 19 0 "kein Klopfschutz" 1 "K_KA_KS_CFG = Ein" 65 "K_KA_KS_CFG = Ein" 2 "K_KR_CFG = Aus" 66 "K_KR_CFG = Aus" 4 "Anschlag an tz_min" 8 "Doppelzuendung" 72 "Doppelzuendung" 16 "Klipping" 80 "Klipping" 32 "Fehlerspeicher" 96 "Fehlerspeicher" 112 "Fehlerspeicher" 40 "Fehlerspeicher" 104 "Fehlerspeicher" 120 "Fehlerspeicher" 64 "rf-Schwelle" 128 "Katheizen" 256 "Dynamik" DEFAULT_VALUE "Mehrfachanforderung" /end COMPU_VTAB
/begin COMPU_METHOD FORMULA_0693 "FORMULA_0693" TAB_VERB "%3.0" "-" COMPU_TAB_REF FORMULA_0693_VTAB /end COMPU_METHOD
/begin COMPU_VTAB FORMULA_0693_VTAB "FORMULA_0693_VTAB" TAB_VERB 4 0 "Ok" 1 "Bank 1" 2 "Bank 2" 3 "Bank 1+2" DEFAULT_VALUE "undefiniert" /end COMPU_VTAB
/begin COMPU_METHOD FORMULA_0694 "FORMULA_0694" TAB_VERB "%3.0" "-" COMPU_TAB_REF FORMULA_0694_VTAB /end COMPU_METHOD
/begin COMPU_VTAB FORMULA_0694_VTAB "FORMULA_0694_VTAB" TAB_VERB 2 0 "Klopfschutz Aus" 1 "Klopfschutz Ein" DEFAULT_VALUE "undefiniert" /end COMPU_VTAB
/begin COMPU_METHOD FORMULA_0695 "FORMULA_0695" TAB_VERB "%3.0" "-" COMPU_TAB_REF FORMULA_0695_VTAB /end COMPU_METHOD
/begin COMPU_VTAB FORMULA_0695_VTAB "FORMULA_0695_VTAB" TAB_VERB 2 0 "Aus" 1 "Reset" DEFAULT_VALUE "undefiniert" /end COMPU_VTAB
/begin COMPU_METHOD FORMULA_0696 "FORMULA_0696" RAT_FUNC "%9.4" "s" COEFFS 0 0 6553.6 0 1 0 /end COMPU_METHOD
/begin COMPU_METHOD FORMULA_0697 "FORMULA_0697" RAT_FUNC "%8.3" "�KW/Segm" COEFFS 0 20480 0 0 0 1 /end COMPU_METHOD
/* ------------------ Abschnitt erzeugt aus kh.dat ------------------ */
/begin COMPU_METHOD FORMULA_0698 "FORMULA_0698" RAT_FUNC "%7.2" "�KW" COEFFS 0 100 0 0 0 1 /end COMPU_METHOD
/begin COMPU_METHOD FORMULA_0699 "FORMULA_0699" TAB_VERB "%5.2" "-" COMPU_TAB_REF FORMULA_0699_VTAB /end COMPU_METHOD
/begin COMPU_VTAB FORMULA_0699_VTAB "FORMULA_0699_VTAB" TAB_VERB 3 1 "vkat" 2 "nkat" 4 "mess" DEFAULT_VALUE "ungueltig" /end COMPU_VTAB
/begin COMPU_METHOD FORMULA_0700 "FORMULA_0700" TAB_VERB "%5.2" "-" COMPU_TAB_REF FORMULA_0700_VTAB /end COMPU_METHOD
/begin COMPU_VTAB FORMULA_0700_VTAB "FORMULA_0700_VTAB" TAB_VERB 2 0 "absolut" 1 "Eta" DEFAULT_VALUE "undef" /end COMPU_VTAB
/begin COMPU_METHOD FORMULA_0701 "FORMULA_0701" RAT_FUNC "%7.2" "�KW/seg(144�KW)" COEFFS 0 100 0 0 0 1 /end COMPU_METHOD
/begin COMPU_METHOD FORMULA_0702 "FORMULA_0702" RAT_FUNC "%7.2" "s" COEFFS 0 0 164 0 1 0 /end COMPU_METHOD
/begin COMPU_METHOD FORMULA_0703 "FORMULA_0703" TAB_VERB "%5.2" "-" COMPU_TAB_REF FORMULA_0703_VTAB /end COMPU_METHOD
/begin COMPU_VTAB FORMULA_0703_VTAB "FORMULA_0703_VTAB" TAB_VERB 2 0 "Kennfeld" 1 "Restgas" DEFAULT_VALUE "undef." /end COMPU_VTAB
/begin COMPU_METHOD FORMULA_0704 "FORMULA_0704" RAT_FUNC "%5.2" "-" COEFFS 0 128 0 0 0 1 /end COMPU_METHOD
/begin COMPU_METHOD FORMULA_0705 "FORMULA_0705" RAT_FUNC "%9.4" "-/seg(144�KW)" COEFFS 0 16384 0 0 0 1 /end COMPU_METHOD
/begin COMPU_METHOD FORMULA_0706 "FORMULA_0706" RAT_FUNC "%6.1" "�KW/10ms" COEFFS 0 10 0 0 0 1 /end COMPU_METHOD
/begin COMPU_METHOD FORMULA_0707 "FORMULA_0707" RAT_FUNC "%6.1" "%/180�KW" COEFFS 0 32768 0 0 0 100 /end COMPU_METHOD
/* ------------------ Abschnitt erzeugt aus kis.dat ------------------ */
/begin COMPU_METHOD FORMULA_0708 "FORMULA_0708" TAB_VERB "%5.2" "-" COMPU_TAB_REF FORMULA_0708_VTAB /end COMPU_METHOD
/begin COMPU_VTAB FORMULA_0708_VTAB "FORMULA_0708_VTAB" TAB_VERB 2 0 "Aus" 1 "Senden" DEFAULT_VALUE "undefiniert" /end COMPU_VTAB
/begin COMPU_METHOD FORMULA_0709 "FORMULA_0709" TAB_VERB "%5.2" "-" COMPU_TAB_REF FORMULA_0709_VTAB /end COMPU_METHOD
/begin COMPU_VTAB FORMULA_0709_VTAB "FORMULA_0709_VTAB" TAB_VERB 2 0 "Low Active" 1 "High Active" DEFAULT_VALUE "undefiniert" /end COMPU_VTAB
/begin COMPU_METHOD FORMULA_0710 "FORMULA_0710" RAT_FUNC "%6.1" "�KW" COEFFS 0 65536 0 0 0 720 /end COMPU_METHOD
/* ------------------ Abschnitt erzeugt aus kr.dat ------------------ */
/begin COMPU_METHOD FORMULA_0711 "FORMULA_0711" TAB_VERB "%3.0" "-" COMPU_TAB_REF FORMULA_0711_VTAB /end COMPU_METHOD
/begin COMPU_VTAB FORMULA_0711_VTAB "FORMULA_0711_VTAB" TAB_VERB 8 0 "Aktiv" 1 "K_KR_CFG = Aus" 2 "rf-Schwelle" 4 "Doppelzuendung" 8 "tmot-Schwelle" 10 "rf + tmot-Schwelle" 16 "Fehlerspeicher" 32 "dtz ausserhalb" DEFAULT_VALUE "Mehrfachdeaktiviert" /end COMPU_VTAB
/begin COMPU_METHOD FORMULA_0712 "FORMULA_0712" TAB_VERB "%3.0" "-" COMPU_TAB_REF FORMULA_0712_VTAB /end COMPU_METHOD
/begin COMPU_VTAB FORMULA_0712_VTAB "FORMULA_0712_VTAB" TAB_VERB 4 0 "Ok" 1 "Bank 1" 2 "Bank 2" 3 "Bank 1+2" DEFAULT_VALUE "undefiniert" /end COMPU_VTAB
/begin COMPU_METHOD FORMULA_0713 "FORMULA_0713" TAB_VERB "%5.0" "-" COMPU_TAB_REF FORMULA_0713_VTAB /end COMPU_METHOD
/begin COMPU_VTAB FORMULA_0713_VTAB "FORMULA_0713_VTAB" TAB_VERB 1 0 "Kein Klopfen." DEFAULT_VALUE "Klopfen Erkannt." /end COMPU_VTAB
/begin COMPU_METHOD FORMULA_0714 "FORMULA_0714" TAB_VERB "%5.0" "-" COMPU_TAB_REF FORMULA_0714_VTAB /end COMPU_METHOD
/begin COMPU_VTAB FORMULA_0714_VTAB "FORMULA_0714_VTAB" TAB_VERB 1 0 "Kein Klopfen." DEFAULT_VALUE "Klopfen Erkannt." /end COMPU_VTAB
/begin COMPU_METHOD FORMULA_0715 "FORMULA_0715" TAB_VERB "%5.0" "-" COMPU_TAB_REF FORMULA_0715_VTAB /end COMPU_METHOD
/begin COMPU_VTAB FORMULA_0715_VTAB "FORMULA_0715_VTAB" TAB_VERB 1 0 "Kein Klopfen." DEFAULT_VALUE "Klopfen Erkannt." /end COMPU_VTAB
/begin COMPU_METHOD FORMULA_0716 "FORMULA_0716" TAB_VERB "%5.0" "-" COMPU_TAB_REF FORMULA_0716_VTAB /end COMPU_METHOD
/begin COMPU_VTAB FORMULA_0716_VTAB "FORMULA_0716_VTAB" TAB_VERB 1 0 "Kein Klopfen." DEFAULT_VALUE "Klopfen Erkannt." /end COMPU_VTAB
/begin COMPU_METHOD FORMULA_0717 "FORMULA_0717" TAB_VERB "%5.0" "-" COMPU_TAB_REF FORMULA_0717_VTAB /end COMPU_METHOD
/begin COMPU_VTAB FORMULA_0717_VTAB "FORMULA_0717_VTAB" TAB_VERB 1 0 "Kein Klopfen." DEFAULT_VALUE "Klopfen Erkannt." /end COMPU_VTAB
/begin COMPU_METHOD FORMULA_0718 "FORMULA_0718" TAB_VERB "%5.0" "-" COMPU_TAB_REF FORMULA_0718_VTAB /end COMPU_METHOD
/begin COMPU_VTAB FORMULA_0718_VTAB "FORMULA_0718_VTAB" TAB_VERB 1 0 "Kein Klopfen." DEFAULT_VALUE "Klopfen Erkannt." /end COMPU_VTAB
/begin COMPU_METHOD FORMULA_0719 "FORMULA_0719" TAB_VERB "%5.0" "-" COMPU_TAB_REF FORMULA_0719_VTAB /end COMPU_METHOD
/begin COMPU_VTAB FORMULA_0719_VTAB "FORMULA_0719_VTAB" TAB_VERB 1 0 "Kein Klopfen." DEFAULT_VALUE "Klopfen Erkannt." /end COMPU_VTAB
/begin COMPU_METHOD FORMULA_0720 "FORMULA_0720" TAB_VERB "%5.0" "-" COMPU_TAB_REF FORMULA_0720_VTAB /end COMPU_METHOD
/begin COMPU_VTAB FORMULA_0720_VTAB "FORMULA_0720_VTAB" TAB_VERB 1 0 "Kein Klopfen." DEFAULT_VALUE "Klopfen Erkannt." /end COMPU_VTAB
/begin COMPU_METHOD FORMULA_0721 "FORMULA_0721" TAB_VERB "%5.0" "-" COMPU_TAB_REF FORMULA_0721_VTAB /end COMPU_METHOD
/begin COMPU_VTAB FORMULA_0721_VTAB "FORMULA_0721_VTAB" TAB_VERB 1 0 "Kein Klopfen." DEFAULT_VALUE "Klopfen Erkannt." /end COMPU_VTAB
/begin COMPU_METHOD FORMULA_0722 "FORMULA_0722" TAB_VERB "%5.0" "-" COMPU_TAB_REF FORMULA_0722_VTAB /end COMPU_METHOD
/begin COMPU_VTAB FORMULA_0722_VTAB "FORMULA_0722_VTAB" TAB_VERB 1 0 "Kein Klopfen." DEFAULT_VALUE "Klopfen Erkannt." /end COMPU_VTAB
/begin COMPU_METHOD FORMULA_0723 "FORMULA_0723" TAB_VERB "%5.0" "-" COMPU_TAB_REF FORMULA_0723_VTAB /end COMPU_METHOD
/begin COMPU_VTAB FORMULA_0723_VTAB "FORMULA_0723_VTAB" TAB_VERB 1 0 "Kein Klopfen." DEFAULT_VALUE "Klopfen Erkannt." /end COMPU_VTAB
/begin COMPU_METHOD FORMULA_0724 "FORMULA_0724" TAB_VERB "%5.0" "-" COMPU_TAB_REF FORMULA_0724_VTAB /end COMPU_METHOD
/begin COMPU_VTAB FORMULA_0724_VTAB "FORMULA_0724_VTAB" TAB_VERB 1 0 "Zyl. 1 idle." DEFAULT_VALUE "Zyl. 1 aktiv." /end COMPU_VTAB
/begin COMPU_METHOD FORMULA_0725 "FORMULA_0725" TAB_VERB "%5.0" "-" COMPU_TAB_REF FORMULA_0725_VTAB /end COMPU_METHOD
/begin COMPU_VTAB FORMULA_0725_VTAB "FORMULA_0725_VTAB" TAB_VERB 1 0 "Zyl. 2 idle." DEFAULT_VALUE "Zyl. 2 aktiv." /end COMPU_VTAB
/begin COMPU_METHOD FORMULA_0726 "FORMULA_0726" TAB_VERB "%5.0" "-" COMPU_TAB_REF FORMULA_0726_VTAB /end COMPU_METHOD
/begin COMPU_VTAB FORMULA_0726_VTAB "FORMULA_0726_VTAB" TAB_VERB 1 0 "Zyl. 3 idle." DEFAULT_VALUE "Zyl. 3 aktiv." /end COMPU_VTAB
/begin COMPU_METHOD FORMULA_0727 "FORMULA_0727" TAB_VERB "%5.0" "-" COMPU_TAB_REF FORMULA_0727_VTAB /end COMPU_METHOD
/begin COMPU_VTAB FORMULA_0727_VTAB "FORMULA_0727_VTAB" TAB_VERB 1 0 "Zyl. 4 idle." DEFAULT_VALUE "Zyl. 4 aktiv." /end COMPU_VTAB
/begin COMPU_METHOD FORMULA_0728 "FORMULA_0728" TAB_VERB "%5.0" "-" COMPU_TAB_REF FORMULA_0728_VTAB /end COMPU_METHOD
/begin COMPU_VTAB FORMULA_0728_VTAB "FORMULA_0728_VTAB" TAB_VERB 1 0 "Zyl. 5 idle." DEFAULT_VALUE "Zyl. 5 aktiv." /end COMPU_VTAB
/begin COMPU_METHOD FORMULA_0729 "FORMULA_0729" TAB_VERB "%5.0" "-" COMPU_TAB_REF FORMULA_0729_VTAB /end COMPU_METHOD
/begin COMPU_VTAB FORMULA_0729_VTAB "FORMULA_0729_VTAB" TAB_VERB 1 0 "Zyl. 6 idle." DEFAULT_VALUE "Zyl. 6 aktiv." /end COMPU_VTAB
/begin COMPU_METHOD FORMULA_0730 "FORMULA_0730" TAB_VERB "%5.0" "-" COMPU_TAB_REF FORMULA_0730_VTAB /end COMPU_METHOD
/begin COMPU_VTAB FORMULA_0730_VTAB "FORMULA_0730_VTAB" TAB_VERB 1 0 "Zyl. 7 idle." DEFAULT_VALUE "Zyl. 7 aktiv." /end COMPU_VTAB
/begin COMPU_METHOD FORMULA_0731 "FORMULA_0731" TAB_VERB "%5.0" "-" COMPU_TAB_REF FORMULA_0731_VTAB /end COMPU_METHOD
/begin COMPU_VTAB FORMULA_0731_VTAB "FORMULA_0731_VTAB" TAB_VERB 1 0 "Zyl. 8 idle." DEFAULT_VALUE "Zyl. 8 aktiv." /end COMPU_VTAB
/begin COMPU_METHOD FORMULA_0732 "FORMULA_0732" TAB_VERB "%5.0" "-" COMPU_TAB_REF FORMULA_0732_VTAB /end COMPU_METHOD
/begin COMPU_VTAB FORMULA_0732_VTAB "FORMULA_0732_VTAB" TAB_VERB 1 0 "Zyl. 9 idle." DEFAULT_VALUE "Zyl. 9 aktiv." /end COMPU_VTAB
/begin COMPU_METHOD FORMULA_0733 "FORMULA_0733" TAB_VERB "%5.0" "-" COMPU_TAB_REF FORMULA_0733_VTAB /end COMPU_METHOD
/begin COMPU_VTAB FORMULA_0733_VTAB "FORMULA_0733_VTAB" TAB_VERB 1 0 "Zyl. 10 idle." DEFAULT_VALUE "Zyl. 10 aktiv." /end COMPU_VTAB
/begin COMPU_METHOD FORMULA_0734 "FORMULA_0734" RAT_FUNC "%7.2" "fS�" COEFFS 0 1 0 0 0 0.0022716 /end COMPU_METHOD
/begin COMPU_METHOD FORMULA_0735 "FORMULA_0735" RAT_FUNC "%6.3" "kHz" COEFFS 0 1 0 0 0 0.12207031 /end COMPU_METHOD
/* ------------------ Abschnitt erzeugt aus kus.dat ------------------ */
/begin COMPU_METHOD FORMULA_0736 "FORMULA_0736" TAB_VERB "%5.2" "-" COMPU_TAB_REF FORMULA_0736_VTAB /end COMPU_METHOD
/begin COMPU_VTAB FORMULA_0736_VTAB "FORMULA_0736_VTAB" TAB_VERB 2 0 "KUS gesperrt" 1 "KUS freigegeben" /end COMPU_VTAB
/begin COMPU_METHOD FORMULA_0737 "FORMULA_0737" TAB_VERB "%3.0" "-" COMPU_TAB_REF FORMULA_0737_VTAB /end COMPU_METHOD
/begin COMPU_VTAB FORMULA_0737_VTAB "FORMULA_0737_VTAB" TAB_VERB 2 0 "Aus" 1 "Aktiv" /end COMPU_VTAB
/begin COMPU_METHOD FORMULA_0738 "FORMULA_0738" RAT_FUNC "%7.2" "Upm/s" COEFFS 0 1 0 0 0 200 /end COMPU_METHOD
/* ------------------ Abschnitt erzeugt aus md_kus.dat ------------------ */
/begin COMPU_METHOD FORMULA_0815 "FORMULA_0815" RAT_FUNC "%10.3" "Nm/Upm" COEFFS 0 1000 0 0 0 1 /end COMPU_METHOD
/begin COMPU_METHOD FORMULA_0816 "FORMULA_0816" RAT_FUNC "%7.2" "Nm/Upm" COEFFS 0 100 0 0 0 1 /end COMPU_METHOD
/* ------------------ Abschnitt erzeugt aus tan.dat ------------------ */
/begin COMPU_METHOD FORMULA_0987 "FORMULA_0987" RAT_FUNC "%8.3" "�C" COEFFS 0 40 10926 0 0 1 /end COMPU_METHOD
/* ------------------ Abschnitt erzeugt aus tka.dat ------------------ */
/begin COMPU_METHOD FORMULA_1003 "FORMULA_1003" TAB_VERB "%6.1" "-" COMPU_TAB_REF FORMULA_1003_VTAB /end COMPU_METHOD
/begin COMPU_VTAB FORMULA_1003_VTAB "FORMULA_1003_VTAB" TAB_VERB 10 0 "-" 1 "Diag. aktiv" 2 "Diag.bed. n. erf." 4 "TKA-Diag. i.O." 17 "Motor kalt" 33 "Thermostat offen" 65 "unplaus. tka haengt" 129 "unplaus. tka>tmot" 16385 "KS nach UB" 32769 "KS nach Masse" /end COMPU_VTAB
/* ------------------ Abschnitt erzeugt aus vr.dat ------------------ */
/begin COMPU_METHOD FORMULA_1046 "FORMULA_1046" TAB_VERB "%5.0" "-" COMPU_TAB_REF FORMULA_1046_VTAB /end COMPU_METHOD
/begin COMPU_VTAB FORMULA_1046_VTAB "FORMULA_1046_VTAB" TAB_VERB 2 0 "Alle Aus" 1023 "Alle Aktiv" DEFAULT_VALUE "Mindestens Einer Aus" /end COMPU_VTAB
/begin COMPU_METHOD FORMULA_1047 "FORMULA_1047" TAB_VERB "%5.0" "-" COMPU_TAB_REF FORMULA_1047_VTAB /end COMPU_METHOD
/begin COMPU_VTAB FORMULA_1047_VTAB "FORMULA_1047_VTAB" TAB_VERB 1 0 "Zyl. 1 aktiv." DEFAULT_VALUE "Zyl. 1 aus." /end COMPU_VTAB
/begin COMPU_METHOD FORMULA_1048 "FORMULA_1048" TAB_VERB "%5.0" "-" COMPU_TAB_REF FORMULA_1048_VTAB /end COMPU_METHOD
/begin COMPU_VTAB FORMULA_1048_VTAB "FORMULA_1048_VTAB" TAB_VERB 1 0 "Zyl. 2 aktiv." DEFAULT_VALUE "Zyl. 2 aus." /end COMPU_VTAB
/begin COMPU_METHOD FORMULA_1049 "FORMULA_1049" TAB_VERB "%5.0" "-" COMPU_TAB_REF FORMULA_1049_VTAB /end COMPU_METHOD
/begin COMPU_VTAB FORMULA_1049_VTAB "FORMULA_1049_VTAB" TAB_VERB 1 0 "Zyl. 3 aktiv." DEFAULT_VALUE "Zyl. 3 aus." /end COMPU_VTAB
/begin COMPU_METHOD FORMULA_1050 "FORMULA_1050" TAB_VERB "%5.0" "-" COMPU_TAB_REF FORMULA_1050_VTAB /end COMPU_METHOD
/begin COMPU_VTAB FORMULA_1050_VTAB "FORMULA_1050_VTAB" TAB_VERB 1 0 "Zyl. 4 aktiv." DEFAULT_VALUE "Zyl. 4 aus." /end COMPU_VTAB
/begin COMPU_METHOD FORMULA_1051 "FORMULA_1051" TAB_VERB "%5.0" "-" COMPU_TAB_REF FORMULA_1051_VTAB /end COMPU_METHOD
/begin COMPU_VTAB FORMULA_1051_VTAB "FORMULA_1051_VTAB" TAB_VERB 1 0 "Zyl. 5 aktiv." DEFAULT_VALUE "Zyl. 5 aus." /end COMPU_VTAB
/begin COMPU_METHOD FORMULA_1052 "FORMULA_1052" TAB_VERB "%5.0" "-" COMPU_TAB_REF FORMULA_1052_VTAB /end COMPU_METHOD
/begin COMPU_VTAB FORMULA_1052_VTAB "FORMULA_1052_VTAB" TAB_VERB 1 0 "Zyl. 6 aktiv." DEFAULT_VALUE "Zyl. 6 aus." /end COMPU_VTAB
/begin COMPU_METHOD FORMULA_1053 "FORMULA_1053" TAB_VERB "%5.0" "-" COMPU_TAB_REF FORMULA_1053_VTAB /end COMPU_METHOD
/begin COMPU_VTAB FORMULA_1053_VTAB "FORMULA_1053_VTAB" TAB_VERB 1 0 "Zyl. 7 aktiv." DEFAULT_VALUE "Zyl. 7 aus." /end COMPU_VTAB
/begin COMPU_METHOD FORMULA_1054 "FORMULA_1054" TAB_VERB "%5.0" "-" COMPU_TAB_REF FORMULA_1054_VTAB /end COMPU_METHOD
/begin COMPU_VTAB FORMULA_1054_VTAB "FORMULA_1054_VTAB" TAB_VERB 1 0 "Zyl. 8 aktiv." DEFAULT_VALUE "Zyl. 8 aus." /end COMPU_VTAB
/begin COMPU_METHOD FORMULA_1055 "FORMULA_1055" TAB_VERB "%5.0" "-" COMPU_TAB_REF FORMULA_1055_VTAB /end COMPU_METHOD
/begin COMPU_VTAB FORMULA_1055_VTAB "FORMULA_1055_VTAB" TAB_VERB 1 0 "Zyl. 9 aktiv." DEFAULT_VALUE "Zyl. 9 aus." /end COMPU_VTAB
/begin COMPU_METHOD FORMULA_1056 "FORMULA_1056" TAB_VERB "%5.0" "-" COMPU_TAB_REF FORMULA_1056_VTAB /end COMPU_METHOD
/begin COMPU_VTAB FORMULA_1056_VTAB "FORMULA_1056_VTAB" TAB_VERB 1 0 "Zyl. 10 aktiv." DEFAULT_VALUE "Zyl. 10 aus." /end COMPU_VTAB
/begin COMPU_METHOD FORMULA_1057 "FORMULA_1057" RAT_FUNC "%9.4" "*" COEFFS 0 4096 0 0 0 1 /end COMPU_METHOD
/begin COMPU_METHOD FORMULA_1058 "FORMULA_1058" TAB_VERB "%5.2" "-" COMPU_TAB_REF FORMULA_1058_VTAB /end COMPU_METHOD
/begin COMPU_VTAB FORMULA_1058_VTAB "FORMULA_1058_VTAB" TAB_VERB 2 0 "Aus" 1 "Ein" DEFAULT_VALUE "undef." /end COMPU_VTAB
/begin COMPU_METHOD FORMULA_1059 "FORMULA_1059" TAB_VERB "%5.2" "-" COMPU_TAB_REF FORMULA_1059_VTAB /end COMPU_METHOD
/begin COMPU_VTAB FORMULA_1059_VTAB "FORMULA_1059_VTAB" TAB_VERB 2 0 "30V" 1 "60V" DEFAULT_VALUE "undef." /end COMPU_VTAB
/begin COMPU_METHOD FORMULA_1060 "FORMULA_1060" TAB_VERB "%5.2" "-" COMPU_TAB_REF FORMULA_1060_VTAB /end COMPU_METHOD
/begin COMPU_VTAB FORMULA_1060_VTAB "FORMULA_1060_VTAB" TAB_VERB 2 0 "aktiv" 1 "ohne" DEFAULT_VALUE "undef." /end COMPU_VTAB
/begin AXIS_PTS AXIS_N10 "Stuetzstellen ueber Drehzahl." 0x733FE n TAD_UB_VV_SW 10000.0 FORMULA_0006 10 0.0 10000.0000 /end AXIS_PTS
/begin AXIS_PTS AXIS_N12 "Stuetzstellen ueber Drehzahl." 0x73414 n TAD_UB_VV_SW 10000.0 FORMULA_0006 12 0.0 10000.0000 /end AXIS_PTS
/begin AXIS_PTS AXIS_N16 "Stuetzstellen ueber Drehzahl." 0x7342E n TAD_UB_VV_SW 10000.0 FORMULA_0006 16 0.0 10000.0000 /end AXIS_PTS
/begin AXIS_PTS AXIS_N_GRAD6 "Stuetzstellen ueber Drehzahlgradient pro Arbeitsspiel." 0x73450 n_grad_asp TAD_UB_VV_SW 20000.0 FORMULA_0114 6 -10000.0000 10000.0000 /end AXIS_PTS
/begin AXIS_PTS AXIS_RF10 "Stuetzstellen ueber rf." 0x7345E rf_m TAD_UB_VV_SW 2.0 FORMULA_0007 10 0.0 2.0000 FORMAT "%6.3" /end AXIS_PTS
/* ------------------ Abschnitt erzeugt aus iss.dat ------------------ */
/begin CHARACTERISTIC K_ISS_TIME_MS_MIN "Schwelle Aktivierung Offseterkennung bei Motor steht." VALUE 0x73478 TKW_VV_VV_UW 100.0 FORMULA_0062 0.0 65535.0000 /end CHARACTERISTIC
/begin CHARACTERISTIC K_ISS_KLIPPING_MAX "Max zul. mittlere Ionenwert im Klopffenster." VALUE 0x7347A TKW_VV_VV_SW 100.0 FORMULA_0578 -800.1953 800.1709 FORMAT "%5.2" /end CHARACTERISTIC
/begin CHARACTERISTIC K_ISS_ADC_MAX "Schwelle AD-Wert fuer Kurzschluss nach Masse." VALUE 0x7347C TKW_VV_VV_UW 100.0 FORMULA_0443 0.0 3.3000 FORMAT "%5.2" /end CHARACTERISTIC
/begin CHARACTERISTIC K_ISS_ADC_MIN "Schwelle AD-Wert fuer Openload oder Kurzschluss nach Ub." VALUE 0x7347E TKW_VV_VV_UW 100.0 FORMULA_0443 0.0 3.3000 FORMAT "%5.2" /end CHARACTERISTIC
/begin CHARACTERISTIC K_ISS_MAX_DELTA "Max zul. Schwelle fuer Kurzschluss nach Masse zwischen Zylindern. | EN: Max zul. Schwelle fuer Kurzschluss nach Masse zwischen Zylindern." VALUE 0x73480 TKW_VV_VV_UB 100.0 FORMULA_0003 0.0 255.0000 /end CHARACTERISTIC
/begin MEASUREMENT iss_klipping_cnt_zyl1 "Zaehler Klipping." UBYTE FORMULA_0003 0 0 0.0 255.0000 ECU_ADDRESS 0x3FB9D2 /end MEASUREMENT
/begin MEASUREMENT iss_klipping_cnt_zyl2 "Zaehler Klipping." UBYTE FORMULA_0003 0 0 0.0 255.0000 ECU_ADDRESS 0x3FB9D3 /end MEASUREMENT
/begin MEASUREMENT iss_klipping_cnt_zyl3 "Zaehler Klipping." UBYTE FORMULA_0003 0 0 0.0 255.0000 ECU_ADDRESS 0x3FB9D4 /end MEASUREMENT
/begin MEASUREMENT iss_klipping_cnt_zyl4 "Zaehler Klipping." UBYTE FORMULA_0003 0 0 0.0 255.0000 ECU_ADDRESS 0x3FB9D5 /end MEASUREMENT
/begin MEASUREMENT iss_klipping_cnt_zyl5 "Zaehler Klipping." UBYTE FORMULA_0003 0 0 0.0 255.0000 ECU_ADDRESS 0x3FB9D6 /end MEASUREMENT
/begin MEASUREMENT iss_klipping_cnt_zyl6 "Zaehler Klipping." UBYTE FORMULA_0003 0 0 0.0 255.0000 ECU_ADDRESS 0x3FB9D7 /end MEASUREMENT
/begin MEASUREMENT iss_klipping_cnt_zyl7 "Zaehler Klipping." UBYTE FORMULA_0003 0 0 0.0 255.0000 ECU_ADDRESS 0x3FB9D8 /end MEASUREMENT
/begin MEASUREMENT iss_klipping_cnt_zyl8 "Zaehler Klipping." UBYTE FORMULA_0003 0 0 0.0 255.0000 ECU_ADDRESS 0x3FB9D9 /end MEASUREMENT
/begin MEASUREMENT iss_klipping_cnt_zyl9 "Zaehler Klipping." UBYTE FORMULA_0003 0 0 0.0 255.0000 ECU_ADDRESS 0x3FB9DA /end MEASUREMENT
/begin MEASUREMENT iss_klipping_cnt_zyl10 "Zaehler Klipping." UBYTE FORMULA_0003 0 0 0.0 255.0000 ECU_ADDRESS 0x3FB9DB /end MEASUREMENT
/begin MEASUREMENT iss_adc_max_cnt_zyl1 "Zaehler Kurzschluss nach Masse." UBYTE FORMULA_0003 0 0 0.0 255.0000 ECU_ADDRESS 0x3FB9DC /end MEASUREMENT
/begin MEASUREMENT iss_adc_max_cnt_zyl2 "Zaehler Kurzschluss nach Masse." UBYTE FORMULA_0003 0 0 0.0 255.0000 ECU_ADDRESS 0x3FB9DD /end MEASUREMENT
/begin MEASUREMENT iss_adc_max_cnt_zyl3 "Zaehler Kurzschluss nach Masse." UBYTE FORMULA_0003 0 0 0.0 255.0000 ECU_ADDRESS 0x3FB9DE /end MEASUREMENT
/begin MEASUREMENT iss_adc_max_cnt_zyl4 "Zaehler Kurzschluss nach Masse." UBYTE FORMULA_0003 0 0 0.0 255.0000 ECU_ADDRESS 0x3FB9DF /end MEASUREMENT
/begin MEASUREMENT iss_adc_max_cnt_zyl5 "Zaehler Kurzschluss nach Masse." UBYTE FORMULA_0003 0 0 0.0 255.0000 ECU_ADDRESS 0x3FB9E0 /end MEASUREMENT
/begin MEASUREMENT iss_adc_max_cnt_zyl6 "Zaehler Kurzschluss nach Masse." UBYTE FORMULA_0003 0 0 0.0 255.0000 ECU_ADDRESS 0x3FB9E1 /end MEASUREMENT
/begin MEASUREMENT iss_adc_max_cnt_zyl7 "Zaehler Kurzschluss nach Masse." UBYTE FORMULA_0003 0 0 0.0 255.0000 ECU_ADDRESS 0x3FB9E2 /end MEASUREMENT
/begin MEASUREMENT iss_adc_max_cnt_zyl8 "Zaehler Kurzschluss nach Masse." UBYTE FORMULA_0003 0 0 0.0 255.0000 ECU_ADDRESS 0x3FB9E3 /end MEASUREMENT
/begin MEASUREMENT iss_adc_max_cnt_zyl9 "Zaehler Kurzschluss nach Masse." UBYTE FORMULA_0003 0 0 0.0 255.0000 ECU_ADDRESS 0x3FB9E4 /end MEASUREMENT
/begin MEASUREMENT iss_adc_max_cnt_zyl10 "Zaehler Kurzschluss nach Masse." UBYTE FORMULA_0003 0 0 0.0 255.0000 ECU_ADDRESS 0x3FB9E5 /end MEASUREMENT
/begin MEASUREMENT iss_adc_max "Kurzschluss nach Masse." UWORD FORMULA_0010 0 0 0.0 65535.0000 ECU_ADDRESS 0x3FB9E6 /end MEASUREMENT
/begin MEASUREMENT iss_adc_min "Openload oder Kurzschluss nach Ub." UWORD FORMULA_0010 0 0 0.0 65535.0000 ECU_ADDRESS 0x3FB9E8 /end MEASUREMENT
/begin MEASUREMENT iss_adc_b1 "Spannung ISS Siganl bei Motor steht." UWORD FORMULA_0010 0 0 0.0 65535.0000 ECU_ADDRESS 0x3FB9EA /end MEASUREMENT
/begin MEASUREMENT iss_adc_b2 "Spannung ISS Siganl bei Motor steht." UWORD FORMULA_0010 0 0 0.0 65535.0000 ECU_ADDRESS 0x3FB9EC /end MEASUREMENT
/begin MEASUREMENT iss_int_avg_zyl1 "Mittelwert vom Integral im Klopffenster." SWORD FORMULA_0443 0 0 0.0 3.3000 ECU_ADDRESS 0x3FB9EE /end MEASUREMENT
/begin MEASUREMENT iss_int_avg_zyl2 "Mittelwert vom Integral im Klopffenster." SWORD FORMULA_0443 0 0 0.0 3.3000 ECU_ADDRESS 0x3FB9F0 /end MEASUREMENT
/begin MEASUREMENT iss_int_avg_zyl3 "Mittelwert vom Integral im Klopffenster." SWORD FORMULA_0443 0 0 0.0 3.3000 ECU_ADDRESS 0x3FB9F2 /end MEASUREMENT
/begin MEASUREMENT iss_int_avg_zyl4 "Mittelwert vom Integral im Klopffenster." SWORD FORMULA_0443 0 0 0.0 3.3000 ECU_ADDRESS 0x3FB9F4 /end MEASUREMENT
/begin MEASUREMENT iss_int_avg_zyl5 "Mittelwert vom Integral im Klopffenster." SWORD FORMULA_0443 0 0 0.0 3.3000 ECU_ADDRESS 0x3FB9F6 /end MEASUREMENT
/begin MEASUREMENT iss_int_avg_zyl6 "Mittelwert vom Integral im Klopffenster." SWORD FORMULA_0443 0 0 0.0 3.3000 ECU_ADDRESS 0x3FB9F8 /end MEASUREMENT
/begin MEASUREMENT iss_int_avg_zyl7 "Mittelwert vom Integral im Klopffenster." SWORD FORMULA_0443 0 0 0.0 3.3000 ECU_ADDRESS 0x3FB9FA /end MEASUREMENT
/begin MEASUREMENT iss_int_avg_zyl8 "Mittelwert vom Integral im Klopffenster." SWORD FORMULA_0443 0 0 0.0 3.3000 ECU_ADDRESS 0x3FB9FC /end MEASUREMENT
/begin MEASUREMENT iss_int_avg_zyl9 "Mittelwert vom Integral im Klopffenster." SWORD FORMULA_0443 0 0 0.0 3.3000 ECU_ADDRESS 0x3FB9FE /end MEASUREMENT
/begin MEASUREMENT iss_int_avg_zyl10 "Mittelwert vom Integral im Klopffenster." SWORD FORMULA_0443 0 0 0.0 3.3000 ECU_ADDRESS 0x3FBA00 /end MEASUREMENT
/* ------------------ Abschnitt erzeugt aus ka.dat ------------------ */
/begin CHARACTERISTIC K_KA_KS_CFG "Freigabe Klopfschutz. | EN: 0 Klopf schutz Aus 0x1 Klopf- schutz Ein ELSE undef i- niert Freigabe Klopfschutz." VALUE 0x734BC TKW_VV_VV_UB 100.0 FORMULA_0694 0.0 1.0 /end CHARACTERISTIC
/begin CHARACTERISTIC K_KA_RESET_CFG "Reset Klopfadaption." VALUE 0x734BD TKW_VV_VV_UB 100.0 FORMULA_0695 0.0 1.0 /end CHARACTERISTIC
/begin CHARACTERISTIC K_KA_DIAG_T "Maximalzeit der Diagnose Bereichsueberwachung. | EN: Maximalzeit der Diagnose Bereichsueberwachung." VALUE 0x734BE TKW_VV_VV_UW 100.0 FORMULA_0073 0.0 6553.5000 FORMAT "%4.1" /end CHARACTERISTIC
/begin CHARACTERISTIC K_KA_TP_TAU "Tau Tiefpassfilter Klopfrueckziehwinkel." VALUE 0x734C0 TKW_VV_VV_UW 100.0 FORMULA_0696 0.1001 6553.6000 FORMAT "%7.4" /end CHARACTERISTIC
/begin CHARACTERISTIC K_KA_TREPP_F "Wichtungsfaktor." VALUE 0x734C2 TKW_VV_VV_UW 100.0 FORMULA_0491 0.0 7.9998 FORMAT "%7.4" /end CHARACTERISTIC
/begin CHARACTERISTIC K_KA_AQ_GRAD_SEGM_CNT "Anzahl Segmente Deaktivierung nach Dynamik. | EN: Anzahl Segmente Deaktivi erung nach Dynamik." VALUE 0x734C4 TKW_VV_VV_UW 100.0 FORMULA_0010 0.0 65535.0000 /end CHARACTERISTIC
/begin CHARACTERISTIC K_KA_AQ_GRAD_MAX "Trigger Dynamik Deaktivierung. | EN: Trigger Dynamik Deaktivierung." VALUE 0x734C6 TKW_VV_VV_SW 100.0 FORMULA_0020 -655360.0000 655340.0000 /end CHARACTERISTIC
/begin CHARACTERISTIC K_KA_TZ_MIN_HYST "tz_min Hysterese. | EN: tz_min Hysterese." VALUE 0x734C8 TKW_VV_VV_SW 100.0 FORMULA_0111 -50.0000 60.0000 FORMAT "%4.1" /end CHARACTERISTIC
/begin CHARACTERISTIC K_KA_ADAPT_MAX "Max KA Zuendwinkeleingriff. | [Code V452 IGN 0x40368] Upper limit of the learned (stored) adaptation value (+5 degKW). A positive learned value only cancels KF_KA_OFFS*; ka_dtz is never > 0." VALUE 0x734CA TKW_VV_VV_SW 100.0 FORMULA_0111 -50.0000 60.0000 FORMAT "%4.1" /end CHARACTERISTIC
/begin CHARACTERISTIC K_KA_DTZ_MAX "Max Klopfadaptionsrueckziehwinkel. | EN: Max Klopfadaptionsrueckzie h-winkel. | [Code V452 IGN 0x40368] Lower limit of the knock-adaptation retard ka_dtz (-15 degKW)." VALUE 0x734CC TKW_VV_VV_SW 100.0 FORMULA_0111 -50.0000 60.0000 FORMAT "%4.1" /end CHARACTERISTIC
/begin CHARACTERISTIC K_KA_FILT_KK_KA "Max Zuendwinkelgradient bei pos. ka_offs. | EN: 3 x/40960 Max Zuendwinkelgradient bei pos. ka_offs." VALUE 0x734CE TKW_VV_VV_SW 100.0 FORMULA_0697 0.0 1.0000 FORMAT "%6.3" /end CHARACTERISTIC
/begin CHARACTERISTIC K_KA_FILT_KK_KKA "Max Zuendwinkelgradient bei neg. ka_offs. | EN: 3 x/40960 Max Zuendwinkelgradient bei neg. ka_offs." VALUE 0x734D0 TKW_VV_VV_SW 100.0 FORMULA_0697 0.0 1.0000 FORMAT "%6.3" /end CHARACTERISTIC
/begin CHARACTERISTIC K_KA_FILT_LK "Max Zuendwinkelgradient bei leichtem Klopfer." VALUE 0x734D2 TKW_VV_VV_SW 100.0 FORMULA_0697 0.0 1.0000 FORMAT "%6.3" /end CHARACTERISTIC
/begin CHARACTERISTIC K_KA_FILT_SK "Max Zuendwinkelgradient bei starkem Klopfer." VALUE 0x734D4 TKW_VV_VV_SW 100.0 FORMULA_0697 0.0 1.0000 FORMAT "%6.3" /end CHARACTERISTIC
/begin CHARACTERISTIC K_KA_TZ_KS "Klopfschutzzuendwinkeloffset. | EN: Klopfschutzzuendwinkeloffset. | [Code V452 IGN 0x40368] Value used instead of the learned adaptation in a special state (branch at 0x40610) [EST: knock-protection mode]." VALUE 0x734D6 TKW_VV_VV_SW 100.0 FORMULA_0111 -50.0000 60.0000 FORMAT "%4.1" /end CHARACTERISTIC
/begin CHARACTERISTIC K_KA_KLIPPING_MAX "Klopfschutzschwelle fuer Klipping im Klopffenster. | EN: Klopfschutzschwelle fuer Klipping im Klopffenster." VALUE 0x734D8 TKW_VV_VV_UB 100.0 FORMULA_0003 0.0 255.0000 /end CHARACTERISTIC
/begin CHARACTERISTIC KL_KA_F_VL "Gewichtungsfaktor | EN: Weighting factor | [Code V452 IGN 0x40158/0x40368] Full-load weighting of the learned knock adaptation: ka_dtz = learned x (KL_KA_F_VL + KF_KA_F_K) + KF_KA_OFFS_VL, clamped to K_KA_DTZ_MAX..0 (can only retard). Setting it to 0 makes the engine ignore its learned knock retard at full load." CURVE 0x734DA TKL_SW_VV_UW 100.0 FORMULA_0075 0.0 63.9990 /begin AXIS_DESCR STD_AXIS n FORMULA_0006 18 0.0 10000.0000 /end AXIS_DESCR FORMAT "%6.3" /end CHARACTERISTIC
/begin CHARACTERISTIC KL_KA_PUMG_VL "Zuendwinkeloffset | EN: Ignition angle offset | [Code V452 IGN 0x3FA88/0x40368] Ambient-pressure offset added to the learned value at full load." CURVE 0x73524 TKL_SW_VV_SW 100.0 FORMULA_0111 -50.0000 60.0000
 /begin AXIS_DESCR STD_AXIS pumg FORMULA_0077 6 400.0000 1200.0000 FORMAT "%4.1" /end AXIS_DESCR
 FORMAT "%4.1" /end CHARACTERISTIC
/begin CHARACTERISTIC KL_KA_RF_MIN "Lastschwelle KA | EN: Load threshold 0-1 | [Code V452 IGN 0x40158/0x40368] Load threshold (over n) for knock-adaptation learning." CURVE 0x7353E TKL_SW_VV_SW 100.0 FORMULA_0007 0.0 2.0000 /begin AXIS_DESCR STD_AXIS n FORMULA_0006 10 0.0 10000.0000 /end AXIS_DESCR FORMAT "%6.3" /end CHARACTERISTIC
/begin CHARACTERISTIC GKL_KA_ADAPT_MIN "Min KA Zuendwinkeleingriff. | [Code V452 IGN 0x40004/0x40368] Lower limit of the learned (stored) adaptation value over n." CURVE 0x73568 TGL_VV_VV_SW 110.0 FORMULA_0111 -50.0000 60.0000 FORMAT "%4.1"
 /begin AXIS_DESCR COM_AXIS n FORMULA_0006 10 0.0 10000.0000 AXIS_PTS_REF AXIS_N10 /end AXIS_DESCR
/end CHARACTERISTIC
/begin CHARACTERISTIC KF_KA_OFFS_VL "Abstand Klopfgrenze | EN: Distance to knock limit | [Code V452 IGN 0x40158/0x40368] Full-load fixed safety retard per cylinder (n x cylinder), added to the weighted learned value. -2 degKW over most of the range here: active at WOT unless the learned value is positive enough to cancel it (result never > 0)." MAP 0x7357C TKF_SW_SW_SW 100.0 FORMULA_0111 -50.0000 60.0000 /begin AXIS_DESCR STD_AXIS n FORMULA_0006 18 0.0 10000.0000 /end AXIS_DESCR /begin AXIS_DESCR STD_AXIS Zyl FORMULA_0010 10 1.0000 10.0000 /end AXIS_DESCR FORMAT "%4.1" /end CHARACTERISTIC
/begin CHARACTERISTIC KF_KA_F_K "Korrekturwert vom Gewichtungsfaktor. | [Code V452 IGN 0x40158] Correction added to the weighting factor over n x summed knock retard of the bank (all 0 here)." MAP 0x7371E TKF_SW_SW_UW 100.0 FORMULA_0075 0.0 63.9990 /begin AXIS_DESCR STD_AXIS n FORMULA_0006 8 0.0 10000.0000 /end AXIS_DESCR
 /begin AXIS_DESCR STD_AXIS dtz FORMULA_0111 8 -3276.8000 3276.7000 FORMAT "%4.1" /end AXIS_DESCR
 FORMAT "%6.3" /end CHARACTERISTIC
/begin CHARACTERISTIC KF_KA_F "Gewichtungsfaktor | EN: Weighting factor | [Code V452 IGN 0x40158] Part-load weighting of the learned knock adaptation (n x rf), as KL_KA_F_VL." MAP 0x737C0 TKF_SW_SW_UW 100.0 FORMULA_0075 0.0 63.9990 /begin AXIS_DESCR STD_AXIS n FORMULA_0006 18 0.0 10000.0000 /end AXIS_DESCR /begin AXIS_DESCR STD_AXIS rf_m FORMULA_0007 12 0.0 2.0000 FORMAT "%6.3" /end AXIS_DESCR FORMAT "%6.3" /end CHARACTERISTIC
/begin CHARACTERISTIC KF_KA_OFFS "Abstand Klopfgrenze | EN: Distance to knock limit | [Code V452 IGN 0x40158] Part-load fixed retard offset (n x rf), same for all cylinders." MAP 0x739AE TKF_SW_SW_SW 100.0 FORMULA_0111 -50.0000 60.0000 /begin AXIS_DESCR STD_AXIS n FORMULA_0006 18 0.0 10000.0000 /end AXIS_DESCR /begin AXIS_DESCR STD_AXIS rf_m FORMULA_0007 12 0.0 2.0000 FORMAT "%6.3" /end AXIS_DESCR FORMAT "%4.1" /end CHARACTERISTIC
/begin CHARACTERISTIC KF_KA_T_KOMP "Temperaturkompensation Klopfadaption | EN: Temperature compensation of knock adaptation | [Code V452 IGN 0x3FA88/0x40368] Temperature compensation added to the learned value." MAP 0x73B9C TKF_SW_SW_SW 100.0 FORMULA_0111 -50.0000 60.0000
 /begin AXIS_DESCR STD_AXIS tmot FORMULA_0023 6 -50.0000 170.0000 FORMAT "%4.1" /end AXIS_DESCR
 /begin AXIS_DESCR STD_AXIS tan FORMULA_0023 6 -50.0000 170.0000 FORMAT "%4.1" /end AXIS_DESCR
 FORMAT "%4.1" /end CHARACTERISTIC
/begin MEASUREMENT ka_st_b1 "Klopfschutz." UWORD FORMULA_0692 0 0 0.0 65535.0 ECU_ADDRESS 0x3FBA04 /end MEASUREMENT
/begin MEASUREMENT ka_st_b2 "Klopfschutz." UWORD FORMULA_0692 0 0 0.0 65535.0 ECU_ADDRESS 0x3FBA06 /end MEASUREMENT
/begin MEASUREMENT ka_tz_diag_st "Status Diagnose Bereichsueberwachung von ka_tz_nv pro Bank" UBYTE FORMULA_0693 0 0 0.0 255.0 ECU_ADDRESS 0x3FBA08 /end MEASUREMENT
/begin MEASUREMENT ka_dtz_diag_st "Status Diagnose Bereichsueberwachung von ka_dtz pro Bank" UBYTE FORMULA_0693 0 0 0.0 255.0 ECU_ADDRESS 0x3FBA09 /end MEASUREMENT
/begin MEASUREMENT ka_tz_min_st "Status Anschlag an tz_min" UWORD FORMULA_0010 0 0 0.0 65535.0000 ECU_ADDRESS 0x3FBA0A /end MEASUREMENT
/begin MEASUREMENT ka_pumg "Zuendwinkeloffset durch Umgebungsdruck" SWORD FORMULA_0111 0 0 -50.0000 60.0000 ECU_ADDRESS 0x3FBA0C /end MEASUREMENT
/begin MEASUREMENT ka_adapt_tz_zyl_int "Limitierter Klopfadaptionrueckziehwinkel." SLONG FORMULA_0243 0 0 -50.0000 60.0000 ECU_ADDRESS 0x3FBA10 /end MEASUREMENT
/begin MEASUREMENT ka_adapt_tz_zyl_int_max "Maximaler Klopfadaptionrueckziehwinkel." SLONG FORMULA_0243 0 0 -50.0000 60.0000 ECU_ADDRESS 0x3FBA14 /end MEASUREMENT
/begin MEASUREMENT ka_adapt_tz_zyl_int_roh "Rohwert Klopfadaptionrueckziehwinkel." SLONG FORMULA_0243 0 0 -50.0000 60.0000 ECU_ADDRESS 0x3FBA18 /end MEASUREMENT
/begin MEASUREMENT ka_f "Gewichtungsfaktor der Klopfadaption." UWORD FORMULA_0075 0 0 0.0 63.9990 ECU_ADDRESS 0x3FBA1C /end MEASUREMENT
/begin MEASUREMENT ka_t_komp_b1 "Zuendwinkeloffset durch Temperatur" SWORD FORMULA_0111 0 0 -50.0000 60.0000 ECU_ADDRESS 0x3FBA1E /end MEASUREMENT
/begin MEASUREMENT ka_t_komp_b2 "Zuendwinkeloffset durch Temperatur" SWORD FORMULA_0111 0 0 -50.0000 60.0000 ECU_ADDRESS 0x3FBA20 /end MEASUREMENT
/begin MEASUREMENT ka_rf_min_b1 "Lastschwelle KA" SWORD FORMULA_0007 0 0 0.0 2.0000 ECU_ADDRESS 0x3FBA22 /end MEASUREMENT
/begin MEASUREMENT ka_rf_min_b2 "Lastschwelle KA" SWORD FORMULA_0007 0 0 0.0 2.0000 ECU_ADDRESS 0x3FBA24 /end MEASUREMENT
/begin MEASUREMENT ka_f_k_b1 "Korrekturwert vom Gewichtungsfaktor." UWORD FORMULA_0075 0 0 0.0 63.9990 ECU_ADDRESS 0x3FBA26 /end MEASUREMENT
/begin MEASUREMENT ka_f_k_b2 "Korrekturwert vom Gewichtungsfaktor." UWORD FORMULA_0075 0 0 0.0 63.9990 ECU_ADDRESS 0x3FBA28 /end MEASUREMENT
/begin MEASUREMENT ka_tz_diag_t_b1 "Zeit der Bereichsueberwachung von ka_tz_nv pro Bank" UWORD FORMULA_0073 0 0 0.0 6553.5000 ECU_ADDRESS 0x3FBA2A /end MEASUREMENT
/begin MEASUREMENT ka_tz_diag_t_b2 "Zeit der Bereichsueberwachung von ka_tz_nv pro Bank" UWORD FORMULA_0073 0 0 0.0 6553.5000 ECU_ADDRESS 0x3FBA2C /end MEASUREMENT
/begin MEASUREMENT ka_dtz_diag_t_b1 "Zeit der Bereichsueberwachung von ka_dtz pro Bank" UWORD FORMULA_0073 0 0 0.0 6553.5000 ECU_ADDRESS 0x3FBA2E /end MEASUREMENT
/begin MEASUREMENT ka_dtz_diag_t_b2 "Zeit der Bereichsueberwachung von ka_dtz pro Bank" UWORD FORMULA_0073 0 0 0.0 6553.5000 ECU_ADDRESS 0x3FBA30 /end MEASUREMENT
/begin MEASUREMENT ka_aq_grad_segm_cnt_b1 "Zaehler Segmente Deaktivierung nach Dynamik" UWORD FORMULA_0010 0 0 0.0 65535.0000 ECU_ADDRESS 0x3FBA32 /end MEASUREMENT
/begin MEASUREMENT ka_aq_grad_segm_cnt_b2 "Zaehler Segmente Deaktivierung nach Dynamik" UWORD FORMULA_0010 0 0 0.0 65535.0000 ECU_ADDRESS 0x3FBA34 /end MEASUREMENT
/begin MEASUREMENT ka_adapt_min "Min KA Zuendwinkeleingriff." SWORD FORMULA_0111 0 0 -50.0000 60.0000 ECU_ADDRESS 0x3FBA36 /end MEASUREMENT
/begin MEASUREMENT ka_offs_zyl1 "Offset zur Klopfgrenze" SWORD FORMULA_0111 0 0 -50.0000 60.0000 ECU_ADDRESS 0x3FBA38 /end MEASUREMENT
/begin MEASUREMENT ka_offs_zyl2 "Offset zur Klopfgrenze" SWORD FORMULA_0111 0 0 -50.0000 60.0000 ECU_ADDRESS 0x3FBA3A /end MEASUREMENT
/begin MEASUREMENT ka_offs_zyl3 "Offset zur Klopfgrenze" SWORD FORMULA_0111 0 0 -50.0000 60.0000 ECU_ADDRESS 0x3FBA3C /end MEASUREMENT
/begin MEASUREMENT ka_offs_zyl4 "Offset zur Klopfgrenze" SWORD FORMULA_0111 0 0 -50.0000 60.0000 ECU_ADDRESS 0x3FBA3E /end MEASUREMENT
/begin MEASUREMENT ka_offs_zyl5 "Offset zur Klopfgrenze" SWORD FORMULA_0111 0 0 -50.0000 60.0000 ECU_ADDRESS 0x3FBA40 /end MEASUREMENT
/begin MEASUREMENT ka_offs_zyl6 "Offset zur Klopfgrenze" SWORD FORMULA_0111 0 0 -50.0000 60.0000 ECU_ADDRESS 0x3FBA42 /end MEASUREMENT
/begin MEASUREMENT ka_offs_zyl7 "Offset zur Klopfgrenze" SWORD FORMULA_0111 0 0 -50.0000 60.0000 ECU_ADDRESS 0x3FBA44 /end MEASUREMENT
/begin MEASUREMENT ka_offs_zyl8 "Offset zur Klopfgrenze" SWORD FORMULA_0111 0 0 -50.0000 60.0000 ECU_ADDRESS 0x3FBA46 /end MEASUREMENT
/begin MEASUREMENT ka_offs_zyl9 "Offset zur Klopfgrenze" SWORD FORMULA_0111 0 0 -50.0000 60.0000 ECU_ADDRESS 0x3FBA48 /end MEASUREMENT
/begin MEASUREMENT ka_offs_zyl10 "Offset zur Klopfgrenze" SWORD FORMULA_0111 0 0 -50.0000 60.0000 ECU_ADDRESS 0x3FBA4A /end MEASUREMENT
/begin MEASUREMENT ka_dtz_zyl1 "Klopfadaptionrueckziehwinkel." SWORD FORMULA_0111 0 0 -50.0000 60.0000 ECU_ADDRESS 0x3FBA4C /end MEASUREMENT
/begin MEASUREMENT ka_dtz_zyl2 "Klopfadaptionrueckziehwinkel." SWORD FORMULA_0111 0 0 -50.0000 60.0000 ECU_ADDRESS 0x3FBA4E /end MEASUREMENT
/begin MEASUREMENT ka_dtz_zyl3 "Klopfadaptionrueckziehwinkel." SWORD FORMULA_0111 0 0 -50.0000 60.0000 ECU_ADDRESS 0x3FBA50 /end MEASUREMENT
/begin MEASUREMENT ka_dtz_zyl4 "Klopfadaptionrueckziehwinkel." SWORD FORMULA_0111 0 0 -50.0000 60.0000 ECU_ADDRESS 0x3FBA52 /end MEASUREMENT
/begin MEASUREMENT ka_dtz_zyl5 "Klopfadaptionrueckziehwinkel." SWORD FORMULA_0111 0 0 -50.0000 60.0000 ECU_ADDRESS 0x3FBA54 /end MEASUREMENT
/begin MEASUREMENT ka_dtz_zyl6 "Klopfadaptionrueckziehwinkel." SWORD FORMULA_0111 0 0 -50.0000 60.0000 ECU_ADDRESS 0x3FBA56 /end MEASUREMENT
/begin MEASUREMENT ka_dtz_zyl7 "Klopfadaptionrueckziehwinkel." SWORD FORMULA_0111 0 0 -50.0000 60.0000 ECU_ADDRESS 0x3FBA58 /end MEASUREMENT
/begin MEASUREMENT ka_dtz_zyl8 "Klopfadaptionrueckziehwinkel." SWORD FORMULA_0111 0 0 -50.0000 60.0000 ECU_ADDRESS 0x3FBA5A /end MEASUREMENT
/begin MEASUREMENT ka_dtz_zyl9 "Klopfadaptionrueckziehwinkel." SWORD FORMULA_0111 0 0 -50.0000 60.0000 ECU_ADDRESS 0x3FBA5C /end MEASUREMENT
/begin MEASUREMENT ka_dtz_zyl10 "Klopfadaptionrueckziehwinkel." SWORD FORMULA_0111 0 0 -50.0000 60.0000 ECU_ADDRESS 0x3FBA5E /end MEASUREMENT
/begin MEASUREMENT ka_dtz_tp_zyl1 "Tiefpassgefilterter Klopfregelrueckziehwinkel." SLONG FORMULA_0243 0 0 -50.0000 60.0000 ECU_ADDRESS 0x3FBA60 /end MEASUREMENT
/begin MEASUREMENT ka_dtz_tp_zyl2 "Tiefpassgefilterter Klopfregelrueckziehwinkel." SLONG FORMULA_0243 0 0 -50.0000 60.0000 ECU_ADDRESS 0x3FBA64 /end MEASUREMENT
/begin MEASUREMENT ka_dtz_tp_zyl3 "Tiefpassgefilterter Klopfregelrueckziehwinkel." SLONG FORMULA_0243 0 0 -50.0000 60.0000 ECU_ADDRESS 0x3FBA68 /end MEASUREMENT
/begin MEASUREMENT ka_dtz_tp_zyl4 "Tiefpassgefilterter Klopfregelrueckziehwinkel." SLONG FORMULA_0243 0 0 -50.0000 60.0000 ECU_ADDRESS 0x3FBA6C /end MEASUREMENT
/begin MEASUREMENT ka_dtz_tp_zyl5 "Tiefpassgefilterter Klopfregelrueckziehwinkel." SLONG FORMULA_0243 0 0 -50.0000 60.0000 ECU_ADDRESS 0x3FBA70 /end MEASUREMENT
/begin MEASUREMENT ka_dtz_tp_zyl6 "Tiefpassgefilterter Klopfregelrueckziehwinkel." SLONG FORMULA_0243 0 0 -50.0000 60.0000 ECU_ADDRESS 0x3FBA74 /end MEASUREMENT
/begin MEASUREMENT ka_dtz_tp_zyl7 "Tiefpassgefilterter Klopfregelrueckziehwinkel." SLONG FORMULA_0243 0 0 -50.0000 60.0000 ECU_ADDRESS 0x3FBA78 /end MEASUREMENT
/begin MEASUREMENT ka_dtz_tp_zyl8 "Tiefpassgefilterter Klopfregelrueckziehwinkel." SLONG FORMULA_0243 0 0 -50.0000 60.0000 ECU_ADDRESS 0x3FBA7C /end MEASUREMENT
/begin MEASUREMENT ka_dtz_tp_zyl9 "Tiefpassgefilterter Klopfregelrueckziehwinkel." SLONG FORMULA_0243 0 0 -50.0000 60.0000 ECU_ADDRESS 0x3FBA80 /end MEASUREMENT
/begin MEASUREMENT ka_dtz_tp_zyl10 "Tiefpassgefilterter Klopfregelrueckziehwinkel." SLONG FORMULA_0243 0 0 -50.0000 60.0000 ECU_ADDRESS 0x3FBA84 /end MEASUREMENT
/* ------------------ Abschnitt erzeugt aus kh.dat ------------------ */
/begin CHARACTERISTIC K_KH_TKAT_CFG "Konfigbyte zur Kat.Temperaturwahl fuer die Alterung | EN: 0x1 vkat 0x2 nkat 0x8 kat ELSE ungueltig Konfigbyte zur Kat.Temperaturwahl fuer die Alterung" VALUE 0x73BFE TKW_VV_VV_UB 100.0 FORMULA_0699 0.0 255.0 /end CHARACTERISTIC
/begin CHARACTERISTIC K_KH_TZ_CFG "Konfigbyte fuer TZ-Eingriff" VALUE 0x73BFF TKW_VV_VV_UB 100.0 FORMULA_0700 0.0 255.0 /end CHARACTERISTIC
/begin CHARACTERISTIC K_KH_TKAT_ENDE "Temperaturschwelle fuer Katheizende | EN: Temperaturschwelle fuer Katheizende" VALUE 0x73C00 TKW_VV_VV_SW 100.0 FORMULA_0023 -50.0000 1200.0000 FORMAT "%4.1" /end CHARACTERISTIC
/begin CHARACTERISTIC K_KH_RF_MAX "Lastschwelle fuer Katheizen aus | EN: Lastschwelle fuer Katheizen aus" VALUE 0x73C02 TKW_VV_VV_SW 100.0 FORMULA_0007 0.0 2.0000 FORMAT "%6.3" /end CHARACTERISTIC
/begin CHARACTERISTIC K_KH_RF_MAX_HYS "Lasthysterese fuer Katheizen aus | EN: Lasthysterese fuer Katheizen aus" VALUE 0x73C04 TKW_VV_VV_SW 100.0 FORMULA_0007 0.0 2.0000 FORMAT "%6.3" /end CHARACTERISTIC
/begin CHARACTERISTIC K_KH_N_MAX "Drehzalschwelle fuer Katheizen aus | EN: Drehzahlschwelle fuer Katheizen aus" VALUE 0x73C06 TKW_VV_VV_SW 100.0 FORMULA_0006 0.0 10000.0000 /end CHARACTERISTIC
/begin CHARACTERISTIC K_KH_N_MAX_HYS "Drehzalhysterese fuer Katheizen aus | EN: Drehzahlhysterese fuer Katheizen aus" VALUE 0x73C08 TKW_VV_VV_SW 100.0 FORMULA_0006 0.0 10000.0000 /end CHARACTERISTIC
/begin CHARACTERISTIC K_KH_TZ_AB "tz-Aenderungsbegr. Beginn KH" VALUE 0x73C0A TKW_VV_VV_SW 100.0 FORMULA_0701 -50.0000 50.0000 FORMAT "%5.2" /end CHARACTERISTIC
/begin CHARACTERISTIC K_KH_TZ_AUF "tz-Aenderungsbegr. Ende KH" VALUE 0x73C0C TKW_VV_VV_SW 100.0 FORMULA_0701 -50.0000 50.0000 FORMAT "%5.2" /end CHARACTERISTIC
/begin CHARACTERISTIC K_KH_TKAT_HYST "Hysterese fuer TKAT-Ende | EN: Temperaturschwelle fuer Katheizende" VALUE 0x73C0E TKW_VV_VV_SW 100.0 FORMULA_0076 0.0 1000.0000 FORMAT "%4.1" /end CHARACTERISTIC
/begin CHARACTERISTIC K_KH_VAN_TMOT_MAX "Katheizen Obergrenze | EN: Katheizen Obergrenze" VALUE 0x73C10 TKW_VV_VV_SW 100.0 FORMULA_0023 -50.0000 170.0000 FORMAT "%4.1" /end CHARACTERISTIC
/begin CHARACTERISTIC K_KH_VAN_AB_Einlass "Katheizen Abregelzeit | EN: Catalyst-heating ramp-down time" VALUE 0x73C12 TKW_VV_VV_SW 100.0 FORMULA_0702 164.0000 0.0100 FORMAT "%5.2" /end CHARACTERISTIC
/begin CHARACTERISTIC K_KH_VAN_AB_Auslass "Katheizen Abregelzeit | EN: Katheizen Abregelzeit" VALUE 0x73C14 TKW_VV_VV_SW 100.0 FORMULA_0702 164.0000 0.0100 FORMAT "%5.2" /end CHARACTERISTIC
/begin CHARACTERISTIC K_KH_VAN_CFG "Konfig Vanos Katheizen" VALUE 0x73C16 TKW_VV_VV_UB 100.0 FORMULA_0703 0.0 255.0 /end CHARACTERISTIC
/begin CHARACTERISTIC K_KH_VAN_VO_FAKT "Anteil AVAN an KH RG Ueberschneidung" VALUE 0x73C17 TKW_VV_VV_UB 100.0 FORMULA_0704 0.0 1.9921 /end CHARACTERISTIC
/begin CHARACTERISTIC K_KH_VAN_VO_I_MAX "Max. I-Anteil KH RG-Ueberschneidung" VALUE 0x73C18 TKW_VV_VV_SW 100.0 FORMULA_0111 0.0 80.0000 FORMAT "%4.1" /end CHARACTERISTIC
/begin CHARACTERISTIC K_KH_TZ_ABS_AB "Aenderungsbegr. Faktor Ende KH | EN: Aenderungsbegr. Faktor Ende KH" VALUE 0x73C1A TKW_VV_VV_UW 100.0 FORMULA_0705 0.0 2.0000 FORMAT "%7.4" /end CHARACTERISTIC
/begin CHARACTERISTIC K_KH_SMG_TMOT_MIN "min. Temperaturschwelle fuer SMG-KH | EN: min. Temperaturschwelle fuer SMG-KH" VALUE 0x73C1C TKW_VV_VV_SW 100.0 FORMULA_0023 -50.0000 150.0000 FORMAT "%4.1" /end CHARACTERISTIC
/begin CHARACTERISTIC K_KH_SMG_TMOT_MAX "Temperaturschwelle fuer SMG-KH | EN: Temperaturschwelle fuer SMG-KH" VALUE 0x73C1E TKW_VV_VV_SW 100.0 FORMULA_0023 -50.0000 150.0000 FORMAT "%4.1" /end CHARACTERISTIC
/begin CHARACTERISTIC K_KH_PKSR_PL_TMOT_MIN "tmot Sperrschwelle fuer Prueflauf | EN: tmot Sperrschwelle fuer Prueflauf" VALUE 0x73C20 TKW_VV_VV_SW 100.0 FORMULA_0023 -50.0000 170.0000 FORMAT "%4.1" /end CHARACTERISTIC
/begin CHARACTERISTIC KL_KH_VAN_DELAY_TMOT "Katheizdelay abhaengig von tmot | EN: Catalyst-heating delay depending on engine temperature" CURVE 0x73C22 TKL_SW_VV_UW 100.0 FORMULA_0021 0.0 655.0000
 /begin AXIS_DESCR STD_AXIS tmot FORMULA_0023 6 -50.0000 170.0000 FORMAT "%4.1" /end AXIS_DESCR
 FORMAT "%5.2" /end CHARACTERISTIC
/begin CHARACTERISTIC KL_KH_TZ_DELAY_TMOT "Katheizdelay TZ abhaengig von tmot" CURVE 0x73C3C TKL_SW_VV_UW 100.0 FORMULA_0021 0.0 655.0000
 /begin AXIS_DESCR STD_AXIS tmot FORMULA_0023 6 -50.0000 170.0000 FORMAT "%4.1" /end AXIS_DESCR
 FORMAT "%5.2" /end CHARACTERISTIC
/begin CHARACTERISTIC KL_KH_VAN_AUF_TMOT_E "Faktor zwischen KF_VAN_E und KF_VAN_KH_E | EN: Factor between KF_VAN_E and KF_VAN_KH_E (intake VANOS normal vs cat heating)" CURVE 0x73C56 TKL_SW_VV_SW 100.0 FORMULA_0702 164.0000 0.0100
 /begin AXIS_DESCR STD_AXIS tmot FORMULA_0023 4 -50.0000 170.0000 FORMAT "%4.1" /end AXIS_DESCR
 FORMAT "%5.2" /end CHARACTERISTIC
/begin CHARACTERISTIC KL_KH_VAN_AUF_TMOT_A "Faktor zwischen KF_VAN_A und KF_VAN_KH_A | EN: Factor between KF_VAN_A and KF_VAN_KH_A (exhaust VANOS normal vs cat heating)" CURVE 0x73C68 TKL_SW_VV_SW 100.0 FORMULA_0702 164.0000 0.0100
 /begin AXIS_DESCR STD_AXIS tmot FORMULA_0023 4 -50.0000 170.0000 FORMAT "%4.1" /end AXIS_DESCR
 FORMAT "%5.2" /end CHARACTERISTIC
/begin CHARACTERISTIC KL_KH_VAN_RG_REG_I "Katheiz Restgas I-Regler" CURVE 0x73C7A TKL_SW_VV_SW 100.0 FORMULA_0706 -80.0000 80.0000
 /begin AXIS_DESCR STD_AXIS van_kh_rg_delta FORMULA_0109 5 -0.5000 0.5000 FORMAT "%5.2" /end AXIS_DESCR
 FORMAT "%4.1" /end CHARACTERISTIC
/begin CHARACTERISTIC KL_KH_VAN_RG_REG_P "Katheiz Restgas P-Regler" CURVE 0x73C90 TKL_SW_VV_SW 100.0 FORMULA_0111 -80.0000 80.0000
 /begin AXIS_DESCR STD_AXIS van_kh_rg_delta FORMULA_0109 5 -0.5000 0.5000 FORMAT "%5.2" /end AXIS_DESCR
 FORMAT "%4.1" /end CHARACTERISTIC
/begin CHARACTERISTIC KL_KH_ALT_OFFSET "Katalterungsoffset | EN: Catalyst ageing offset" CURVE 0x73CA6 TKL_UW_VV_SW 100.0 FORMULA_0076 -1000.0000 1000.0000
 /begin AXIS_DESCR STD_AXIS kat_obd_wert_nv FORMULA_0025 7 0.0 3.9990 FORMAT "%6.3" /end AXIS_DESCR
 FORMAT "%4.1" /end CHARACTERISTIC
/begin CHARACTERISTIC KL_KH_TZ_ABS_INIT "Init Wert fuer den Faktor" CURVE 0x73CC4 TKL_SW_VV_UW 100.0 FORMULA_0295 0.0 2.0000
 /begin AXIS_DESCR STD_AXIS tmot FORMULA_0023 6 -50.0000 170.0000 FORMAT "%4.1" /end AXIS_DESCR
 FORMAT "%7.4" /end CHARACTERISTIC
/begin CHARACTERISTIC KL_KH_TZ_ABS_AUF_TMOT "Aenderungsbegr. Faktor Beginn KH" CURVE 0x73CDE TKL_SW_VV_UW 100.0 FORMULA_0705 0.0 2.0000
 /begin AXIS_DESCR STD_AXIS tmot FORMULA_0023 6 -50.0000 170.0000 FORMAT "%4.1" /end AXIS_DESCR
 FORMAT "%7.4" /end CHARACTERISTIC
/begin CHARACTERISTIC KL_KH_TZ_PUMG_F "Hohenkorrektur uber pumg" CURVE 0x73CF8 TKL_SW_VV_UB 100.0 FORMULA_0704 0.0 1.9921
 /begin AXIS_DESCR STD_AXIS pumg FORMULA_0077 5 400.0000 1200.0000 FORMAT "%4.1" /end AXIS_DESCR
/end CHARACTERISTIC
/begin CHARACTERISTIC KL_KH_T_MAX "Maximale KH-Zeit | EN: Maximum catalyst-heating time" CURVE 0x73D0A TKL_SW_VV_UW 100.0 FORMULA_0021 0.0 655.0000
 /begin AXIS_DESCR STD_AXIS zust_tmot_start FORMULA_0023 5 -50.0000 170.0000 FORMAT "%4.1" /end AXIS_DESCR
 FORMAT "%5.2" /end CHARACTERISTIC
/begin CHARACTERISTIC KF_KH_RG_OPT "RG-Gehalt fuer Vanos-KH" MAP 0x73D20 TKF_SW_SW_SW 100.0 FORMULA_0109 -0.5000 0.5000 /begin AXIS_DESCR STD_AXIS n FORMULA_0006 8 0.0 10000.0000 /end AXIS_DESCR /begin AXIS_DESCR STD_AXIS dr_rel FORMULA_0115 8 0.0 199.9938 FORMAT "%5.2" /end AXIS_DESCR FORMAT "%5.2" /end CHARACTERISTIC
/begin CHARACTERISTIC KF_KH_TZ_GRUND "Grundkennfeld Zuendwinkel fuer KH" MAP 0x73DC2 TKF_SW_SW_SW 100.0 FORMULA_0111 -50.0000 60.0000 /begin AXIS_DESCR STD_AXIS n FORMULA_0006 12 0.0 10000.0000 /end AXIS_DESCR /begin AXIS_DESCR STD_AXIS rf FORMULA_0007 10 0.0 2.0000 FORMAT "%6.3" /end AXIS_DESCR FORMAT "%4.1" /end CHARACTERISTIC
/begin CHARACTERISTIC KF_KH_TZ_LL "LL-Kennfeld Zuendwinkel fuer KH" MAP 0x73EE0 TKF_SW_SW_SW 100.0 FORMULA_0111 -50.0000 60.0000 /begin AXIS_DESCR STD_AXIS n FORMULA_0006 10 0.0 10000.0000 /end AXIS_DESCR /begin AXIS_DESCR STD_AXIS rf_m FORMULA_0007 4 0.0 2.0000 FORMAT "%6.3" /end AXIS_DESCR FORMAT "%4.1" /end CHARACTERISTIC
/begin CHARACTERISTIC KF_KH_TZ_ETA_GRUND "ETA Grund-KF fuer Katheizen" MAP 0x73F4E TKF_SW_SW_UW 100.0 FORMULA_0435 0.0 100.0000 /begin AXIS_DESCR STD_AXIS n FORMULA_0006 10 0.0 10000.0000 /end AXIS_DESCR
 /begin AXIS_DESCR STD_AXIS md_ind_wunsch_tz FORMULA_0009 10 -100.0000 1000.0000 FORMAT "%4.1" /end AXIS_DESCR
 FORMAT "%4.1" /end CHARACTERISTIC
/begin CHARACTERISTIC KF_KH_TZ_ETA_LL "ETA KF fuer Katheizen im LL" MAP 0x74040 TKF_SW_SW_UW 100.0 FORMULA_0435 0.0 100.0000 /begin AXIS_DESCR STD_AXIS n FORMULA_0006 10 0.0 10000.0000 /end AXIS_DESCR
 /begin AXIS_DESCR STD_AXIS md_ind_wunsch_tz FORMULA_0009 10 -100.0000 1000.0000 FORMAT "%4.1" /end AXIS_DESCR
 FORMAT "%4.1" /end CHARACTERISTIC
/begin CHARACTERISTIC KF_KH_TZ_ETA_AUF "Aenderungsbegrz. kh_tz_eta Aufwaerts" MAP 0x74132 TKF_SW_SW_UW 100.0 FORMULA_0707 0.0 100.0000 /begin AXIS_DESCR STD_AXIS n FORMULA_0006 6 0.0 10000.0000 /end AXIS_DESCR
 /begin AXIS_DESCR STD_AXIS md_ind_wunsch_tz FORMULA_0009 6 -100.0000 1000.0000 FORMAT "%4.1" /end AXIS_DESCR
 FORMAT "%4.1" /end CHARACTERISTIC
/begin CHARACTERISTIC KF_KH_TZ_ETA_AB "Aenderungsbegrz. kh_tz_eta Abwaerts" MAP 0x74194 TKF_SW_SW_UW 100.0 FORMULA_0707 0.0 100.0000 /begin AXIS_DESCR STD_AXIS n FORMULA_0006 6 0.0 10000.0000 /end AXIS_DESCR
 /begin AXIS_DESCR STD_AXIS md_ind_wunsch_tz FORMULA_0009 6 -100.0000 1000.0000 FORMAT "%4.1" /end AXIS_DESCR
 FORMAT "%4.1" /end CHARACTERISTIC
/begin CHARACTERISTIC KF_KH_VAN_TMOT_F "Faktor zwischen KF_VAN_A und KF_VAN_KH_A" MAP 0x741F6 TKF_SW_SW_UW 100.0 FORMULA_0295 0.0 2.0000
 /begin AXIS_DESCR STD_AXIS tmot FORMULA_0023 6 -50.0000 170.0000 FORMAT "%4.1" /end AXIS_DESCR
 /begin AXIS_DESCR STD_AXIS kat_obd_wert_nv FORMULA_0025 4 0.0 1.9000 FORMAT "%6.3" /end AXIS_DESCR
 FORMAT "%7.4" /end CHARACTERISTIC
/begin CHARACTERISTIC KF_KH_TZ_ABS_TMOT_F "Faktor zwischen KF_TZ_GRUND und KF_KH_TZ_GRUND" MAP 0x7423C TKF_SW_SW_UW 100.0 FORMULA_0295 0.0 2.0000
 /begin AXIS_DESCR STD_AXIS tmot FORMULA_0023 6 -50.0000 170.0000 FORMAT "%4.1" /end AXIS_DESCR
 /begin AXIS_DESCR STD_AXIS kat_obd_wert_nv FORMULA_0025 4 0.0 1.9000 FORMAT "%6.3" /end AXIS_DESCR
 FORMAT "%7.4" /end CHARACTERISTIC
/begin MEASUREMENT kh_tkat "Kattemperatur fuer die KH" SWORD FORMULA_0023 0 0 -50.0000 170.0000 ECU_ADDRESS 0x3FBA88 /end MEASUREMENT
/begin MEASUREMENT kh_tkat_alt_offset "Temperaturoffset Katalterung" SWORD FORMULA_0076 0 0 -1000.0000 1000.0000 ECU_ADDRESS 0x3FBA8A /end MEASUREMENT
/begin MEASUREMENT kh_tkat_alt "Katalterungtemperaturschwelle" SWORD FORMULA_0023 0 0 -50.0000 170.0000 ECU_ADDRESS 0x3FBA8C /end MEASUREMENT
/begin MEASUREMENT kh_tz_offs "Katheiz tz Offset" SWORD FORMULA_0111 0 0 -50.0000 60.0000 ECU_ADDRESS 0x3FBA8E /end MEASUREMENT
/begin MEASUREMENT kh_tz_offs_roh "Katheiz tz Offset vor Aenderungsbegr." SWORD FORMULA_0698 0 0 -50.0000 50.0000 ECU_ADDRESS 0x3FBA90 /end MEASUREMENT
/begin MEASUREMENT kh_time_on "Zeit seit Katheizen aktive" UWORD FORMULA_0021 0 0 0.0 655.0000 ECU_ADDRESS 0x3FBA92 /end MEASUREMENT
/begin MEASUREMENT kh_van_faktor_Einlass "Gewichtungsfaktor Katheizen" UWORD FORMULA_0295 0 0 0.0 2.0000 ECU_ADDRESS 0x3FBA94 /end MEASUREMENT
/begin MEASUREMENT kh_van_faktor_Auslass "Gewichtungsfaktor Katheizen" UWORD FORMULA_0295 0 0 0.0 2.0000 ECU_ADDRESS 0x3FBA96 /end MEASUREMENT
/begin MEASUREMENT kh_van_fakt_max "Max. Gewichtungsfaktor KH" UWORD FORMULA_0295 0 0 0.0 2.0000 ECU_ADDRESS 0x3FBA98 /end MEASUREMENT
/begin MEASUREMENT kh_van_rg_delta_b1 "Abweichung Katheiz Restgas" SWORD FORMULA_0109 0 0 -0.5000 0.5000 ECU_ADDRESS 0x3FBA9A /end MEASUREMENT
/begin MEASUREMENT kh_van_rg_delta_b2 "Abweichung Katheiz Restgas" SWORD FORMULA_0109 0 0 -0.5000 0.5000 ECU_ADDRESS 0x3FBA9C /end MEASUREMENT
/begin MEASUREMENT kh_van_rg_opt_b1 "Soll-Restgas fuer Vanos-KH" SWORD FORMULA_0109 0 0 -0.5000 0.5000 ECU_ADDRESS 0x3FBA9E /end MEASUREMENT
/begin MEASUREMENT kh_van_rg_opt_b2 "Soll-Restgas fuer Vanos-KH" SWORD FORMULA_0109 0 0 -0.5000 0.5000 ECU_ADDRESS 0x3FBAA0 /end MEASUREMENT
/begin MEASUREMENT kh_van_vo_b1 "Ueberschn. Katheiz Restgas" SWORD FORMULA_0111 0 0 -80.0000 80.0000 ECU_ADDRESS 0x3FBAA2 /end MEASUREMENT
/begin MEASUREMENT kh_van_vo_b2 "Ueberschn. Katheiz Restgas" SWORD FORMULA_0111 0 0 -80.0000 80.0000 ECU_ADDRESS 0x3FBAA4 /end MEASUREMENT
/begin MEASUREMENT kh_van_vo_i_b1 "I-Anteil Ueberschn. Katheiz Restgas" SWORD FORMULA_0111 0 0 -80.0000 80.0000 ECU_ADDRESS 0x3FBAA6 /end MEASUREMENT
/begin MEASUREMENT kh_van_vo_i_b2 "I-Anteil Ueberschn. Katheiz Restgas" SWORD FORMULA_0111 0 0 -80.0000 80.0000 ECU_ADDRESS 0x3FBAA8 /end MEASUREMENT
/begin MEASUREMENT kh_van_vo_p_b1 "P-Anteil Ueberschn. Katheiz Restgas" SWORD FORMULA_0111 0 0 -80.0000 80.0000 ECU_ADDRESS 0x3FBAAA /end MEASUREMENT
/begin MEASUREMENT kh_van_vo_p_b2 "P-Anteil Ueberschn. Katheiz Restgas" SWORD FORMULA_0111 0 0 -80.0000 80.0000 ECU_ADDRESS 0x3FBAAC /end MEASUREMENT
/begin MEASUREMENT kh_tz_roh "Rohzuendwinkel aus KF_KH_TZ_GRUND" SWORD FORMULA_0111 0 0 -50.0000 60.0000 ECU_ADDRESS 0x3FBAAE /end MEASUREMENT
/begin MEASUREMENT kh_tz_delta_roh "Delta TZ KF_TZ_GRUND - KF_KH_TZ_GRUND" SWORD FORMULA_0111 0 0 -50.0000 60.0000 ECU_ADDRESS 0x3FBAB0 /end MEASUREMENT
/begin MEASUREMENT kh_tz_fak "Gewichtungsfaktor TZ-Katheizen" UWORD FORMULA_0295 0 0 0.0 2.0000 ECU_ADDRESS 0x3FBAB2 /end MEASUREMENT
/begin MEASUREMENT kh_van_fakt_kf_mw "Mittelwert E/A - Gewichtungsfaktor Kennfeld-KH" UWORD FORMULA_0295 0 0 0.0 2.0000 ECU_ADDRESS 0x3FBAB4 /end MEASUREMENT
/begin MEASUREMENT kh_tz_eta "KH-Sollwirkungsgrad" UWORD FORMULA_0435 0 0 0.0 150.0000 ECU_ADDRESS 0x3FBAB6 /end MEASUREMENT
/begin MEASUREMENT kh_tz_eta_roh "KH-Sollwirkungsgrad nach Aenderungsbegr." UWORD FORMULA_0435 0 0 0.0 150.0000 ECU_ADDRESS 0x3FBAB8 /end MEASUREMENT
/* ------------------ Abschnitt erzeugt aus kis.dat ------------------ */
/begin CHARACTERISTIC K_KIS_CFG "KIS-Konfiguration | EN: KIS configuration" VALUE 0x74284 TKW_VV_VV_UB 100.0 FORMULA_0708 0.0 255.0 /end CHARACTERISTIC
/begin CHARACTERISTIC K_KIS_ACTIVE_PULSE "Aktiv Puls Konfiguration. | EN: Active pulse configuration" VALUE 0x74285 TKW_VV_VV_UB 100.0 FORMULA_0709 0.0 1.0 /end CHARACTERISTIC
/begin CHARACTERISTIC K_KIS_START "Pulsstart. | EN: Pulse start" VALUE 0x74286 TKW_VV_VV_UW 100.0 FORMULA_0710 0.0 719.9890 FORMAT "%4.1" /end CHARACTERISTIC
/begin CHARACTERISTIC K_KIS_LEN "Pulslaenge. | EN: Pulse length" VALUE 0x74288 TKW_VV_VV_UW 100.0 FORMULA_0710 0.0 719.9890 FORMAT "%4.1" /end CHARACTERISTIC
/begin CHARACTERISTIC K_KIS_PERIOD "Pulsperiode. | EN: Pulse period" VALUE 0x7428A TKW_VV_VV_UW 100.0 FORMULA_0710 0.0 719.9890 FORMAT "%4.1" /end CHARACTERISTIC
/begin CHARACTERISTIC K_KIS_TIME_OUT "Maximal Pulszeit. | EN: Maximum pulse time" VALUE 0x7428C TKW_VV_VV_UL 100.0 FORMULA_0017 0.0 1198.3724 FORMAT "%5.2" /end CHARACTERISTIC
/* ------------------ Abschnitt erzeugt aus kr.dat ------------------ */
/begin CHARACTERISTIC K_KR_CFG "Schalter Freigabe Klopfregelung. | EN: 0 Aus 0x1 Ein ELSE undefiniert Schalter Freigabe Klopfregelung. | [Code V452 IGN 0x44FA0/0x454BC] Knock control enable. 0 = knock control OFF: kr_dtz is reset to 0 every cycle and no knock retard is applied (knock adaptation then learns nothing). Keep 1." VALUE 0x74290 TKW_VV_VV_UB 100.0 FORMULA_0574 0.0 255.0 /end CHARACTERISTIC
/begin CHARACTERISTIC K_KR_FB_START "Frequenzbandstart." VALUE 0x74291 TKW_VV_VV_UB 100.0 FORMULA_0735 0.0 31.1279 /end CHARACTERISTIC
/begin CHARACTERISTIC K_KR_FB_LEN "Frequenzbandlaenge." VALUE 0x74292 TKW_VV_VV_UB 100.0 FORMULA_0735 0.1221 3.7841 /end CHARACTERISTIC
/begin CHARACTERISTIC K_KR_APPL_CFG "Schalter Freigabe Applikationshilfe. | EN: 0 Aus 0x1 Ein ELSE undefiniert Schalter Freigabe Applikationshilfe. | [Code V452 IGN 0x44FA0/0x454BC] Application aid: <>0 injects test retard K_KR_APPL_DTZ_ZYLi every K_KR_APPL_PER for K_KR_APPL_NUM_ZYLi times. Keep 0." VALUE 0x74293 TKW_VV_VV_UB 100.0 FORMULA_0574 0.0 255.0 /end CHARACTERISTIC
/begin CHARACTERISTIC K_KR_APPL_PER "Periode Applikationshilfe. | EN: Periode Applikationshilfe." VALUE 0x74294 TKW_VV_VV_UB 100.0 FORMULA_0003 0.0 255.0000 /end CHARACTERISTIC
/begin CHARACTERISTIC K_KR_DIAG_T "Maximalzeit der Bereichsueberwachungdiagnose. | EN: Maximalzeit der Bereichsueberwachungdiagnose." VALUE 0x74296 TKW_VV_VV_UW 100.0 FORMULA_0073 0.0 6553.5000 FORMAT "%4.1" /end CHARACTERISTIC
/begin CHARACTERISTIC K_KR_TMOT_MIN "Maximaltemperatur fuer KR-Freigabe | EN: Maximaltemperatur fuer KR-Freigabe | [Code V452 IGN 0x454BC] Knock control inhibited below this coolant temperature (50 degC)." VALUE 0x74298 TKW_VV_VV_SW 100.0 FORMULA_0023 -50.0000 170.0000 FORMAT "%4.1" /end CHARACTERISTIC
/begin CHARACTERISTIC K_KR_KLIPPING_MAX "Max zulaessiges Klipping im Klopffenster. | EN: Maximum permitted clipping in the knock window [V]" VALUE 0x7429A TKW_VV_VV_SW 100.0 FORMULA_0443 0.0 3.3000 FORMAT "%5.2" /end CHARACTERISTIC
/begin CHARACTERISTIC K_KR_APPL_NUM_ZYL1 "Anzahl Applikationszuendwinkelverstellung. | EN: Number of calibration ignition-angle adjustments" VALUE 0x7429C TKW_VV_VV_UB 100.0 FORMULA_0003 0.0 255.0000 /end CHARACTERISTIC
/begin CHARACTERISTIC K_KR_APPL_NUM_ZYL2 "Anzahl Applikationszuendwinkelverstellung. | EN: Number of calibration ignition-angle adjustments" VALUE 0x7429D TKW_VV_VV_UB 100.0 FORMULA_0003 0.0 255.0000 /end CHARACTERISTIC
/begin CHARACTERISTIC K_KR_APPL_NUM_ZYL3 "Anzahl Applikationszuendwinkelverstellung. | EN: Number of calibration ignition-angle adjustments" VALUE 0x7429E TKW_VV_VV_UB 100.0 FORMULA_0003 0.0 255.0000 /end CHARACTERISTIC
/begin CHARACTERISTIC K_KR_APPL_NUM_ZYL4 "Anzahl Applikationszuendwinkelverstellung. | EN: Number of calibration ignition-angle adjustments" VALUE 0x7429F TKW_VV_VV_UB 100.0 FORMULA_0003 0.0 255.0000 /end CHARACTERISTIC
/begin CHARACTERISTIC K_KR_APPL_NUM_ZYL5 "Anzahl Applikationszuendwinkelverstellung. | EN: Number of calibration ignition-angle adjustments" VALUE 0x742A0 TKW_VV_VV_UB 100.0 FORMULA_0003 0.0 255.0000 /end CHARACTERISTIC
/begin CHARACTERISTIC K_KR_APPL_NUM_ZYL6 "Anzahl Applikationszuendwinkelverstellung. | EN: Number of calibration ignition-angle adjustments" VALUE 0x742A1 TKW_VV_VV_UB 100.0 FORMULA_0003 0.0 255.0000 /end CHARACTERISTIC
/begin CHARACTERISTIC K_KR_APPL_NUM_ZYL7 "Anzahl Applikationszuendwinkelverstellung. | EN: Number of calibration ignition-angle adjustments" VALUE 0x742A2 TKW_VV_VV_UB 100.0 FORMULA_0003 0.0 255.0000 /end CHARACTERISTIC
/begin CHARACTERISTIC K_KR_APPL_NUM_ZYL8 "Anzahl Applikationszuendwinkelverstellung. | EN: Number of calibration ignition-angle adjustments" VALUE 0x742A3 TKW_VV_VV_UB 100.0 FORMULA_0003 0.0 255.0000 /end CHARACTERISTIC
/begin CHARACTERISTIC K_KR_APPL_NUM_ZYL9 "Anzahl Applikationszuendwinkelverstellung. | EN: Number of calibration ignition-angle adjustments" VALUE 0x742A4 TKW_VV_VV_UB 100.0 FORMULA_0003 0.0 255.0000 /end CHARACTERISTIC
/begin CHARACTERISTIC K_KR_APPL_NUM_ZYL10 "Anzahl Applikationszuendwinkelverstellung. | EN: Number of calibration ignition-angle adjustments" VALUE 0x742A5 TKW_VV_VV_UB 100.0 FORMULA_0003 0.0 255.0000 /end CHARACTERISTIC
/begin CHARACTERISTIC K_KR_APPL_DTZ_ZYL1 "Applikationszuendwinkeloffset. | EN: Calibration ignition angle offset" VALUE 0x742A6 TKW_VV_VV_SW 100.0 FORMULA_0111 -50.0000 60.0000 FORMAT "%4.1" /end CHARACTERISTIC
/begin CHARACTERISTIC K_KR_APPL_DTZ_ZYL2 "Applikationszuendwinkeloffset. | EN: Calibration ignition angle offset" VALUE 0x742A8 TKW_VV_VV_SW 100.0 FORMULA_0111 -50.0000 60.0000 FORMAT "%4.1" /end CHARACTERISTIC
/begin CHARACTERISTIC K_KR_APPL_DTZ_ZYL3 "Applikationszuendwinkeloffset. | EN: Calibration ignition angle offset" VALUE 0x742AA TKW_VV_VV_SW 100.0 FORMULA_0111 -50.0000 60.0000 FORMAT "%4.1" /end CHARACTERISTIC
/begin CHARACTERISTIC K_KR_APPL_DTZ_ZYL4 "Applikationszuendwinkeloffset. | EN: Calibration ignition angle offset" VALUE 0x742AC TKW_VV_VV_SW 100.0 FORMULA_0111 -50.0000 60.0000 FORMAT "%4.1" /end CHARACTERISTIC
/begin CHARACTERISTIC K_KR_APPL_DTZ_ZYL5 "Applikationszuendwinkeloffset. | EN: Calibration ignition angle offset" VALUE 0x742AE TKW_VV_VV_SW 100.0 FORMULA_0111 -50.0000 60.0000 FORMAT "%4.1" /end CHARACTERISTIC
/begin CHARACTERISTIC K_KR_APPL_DTZ_ZYL6 "Applikationszuendwinkeloffset. | EN: Calibration ignition angle offset" VALUE 0x742B0 TKW_VV_VV_SW 100.0 FORMULA_0111 -50.0000 60.0000 FORMAT "%4.1" /end CHARACTERISTIC
/begin CHARACTERISTIC K_KR_APPL_DTZ_ZYL7 "Applikationszuendwinkeloffset. | EN: Calibration ignition angle offset" VALUE 0x742B2 TKW_VV_VV_SW 100.0 FORMULA_0111 -50.0000 60.0000 FORMAT "%4.1" /end CHARACTERISTIC
/begin CHARACTERISTIC K_KR_APPL_DTZ_ZYL8 "Applikationszuendwinkeloffset. | EN: Calibration ignition angle offset" VALUE 0x742B4 TKW_VV_VV_SW 100.0 FORMULA_0111 -50.0000 60.0000 FORMAT "%4.1" /end CHARACTERISTIC
/begin CHARACTERISTIC K_KR_APPL_DTZ_ZYL9 "Applikationszuendwinkeloffset. | EN: Calibration ignition angle offset" VALUE 0x742B6 TKW_VV_VV_SW 100.0 FORMULA_0111 -50.0000 60.0000 FORMAT "%4.1" /end CHARACTERISTIC
/begin CHARACTERISTIC K_KR_APPL_DTZ_ZYL10 "Applikationszuendwinkeloffset. | EN: Calibration ignition angle offset" VALUE 0x742B8 TKW_VV_VV_SW 100.0 FORMULA_0111 -50.0000 60.0000 FORMAT "%4.1" /end CHARACTERISTIC
/begin CHARACTERISTIC GKL_KR_DTZ_MAX "Maximal zulaessiger Klopfregelungseingriff. | EN: Max. permitted knock-control retard over n | [Code V452 IGN 0x44FA0/0x454BC] Maximum knock-control retard over n (-7 ... -15 degKW). Clamps kr_dtz per cylinder (0x454BC). KF_TZ_MIN can limit earlier." CURVE 0x742D4 TGL_VV_VV_SW 110.0 FORMULA_0111 -50.0000 60.0000 FORMAT "%4.1"
 /begin AXIS_DESCR COM_AXIS n FORMULA_0006 10 0.0 10000.0000 AXIS_PTS_REF AXIS_N10 /end AXIS_DESCR
/end CHARACTERISTIC
/begin CHARACTERISTIC GKL_KR_RF_MIN "Mindestfuellung fuer KR-Freigabe. | EN: Minimum relative filling for knock-control release over n | [Code V452 IGN 0x45304/0x454BC] Minimum rf (over n) for knock control; below it no new knock retard." CURVE 0x742E8 TGL_VV_VV_SW 2.0 FORMULA_0007 0.0 2.0000 FORMAT "%6.3"
 /begin AXIS_DESCR COM_AXIS n FORMULA_0006 12 0.0 10000.0000 AXIS_PTS_REF AXIS_N12 /end AXIS_DESCR
/end CHARACTERISTIC
/begin CHARACTERISTIC KL_KR_FBS_AVG_NO "Anzahl der Arbeitsspiele fuer Mittelwertsbildung." CURVE 0x74300 TKL_SW_VV_UB 100.0 FORMULA_0003 0.0 255.0000
 /begin AXIS_DESCR STD_AXIS rf_dyn_delta FORMULA_0204 12 -200.0000 200.0000 FORMAT "%6.3" /end AXIS_DESCR
/end CHARACTERISTIC
/begin CHARACTERISTIC GKL_KR_FBS_AVG_OFF_MAX "Zulaessiges Delta zum Mittelwert Engeriespektrum der Klopffrequenz bei VL. | [Code V452 IGN 0x45304/0x454BC] Knock threshold: knock is detected when the cylinder's knock signal exceeds its running reference by more than this value." CURVE 0x74326 TGL_VV_VV_SW 74.4 FORMULA_0734 0.0 74.4334 FORMAT "%5.2"
 /begin AXIS_DESCR COM_AXIS n FORMULA_0006 16 0.0 10000.0000 AXIS_PTS_REF AXIS_N16 /end AXIS_DESCR
/end CHARACTERISTIC
/begin CHARACTERISTIC GKF_KR_KNOCK_TZ_OFFS "Offset des Klopffensters gegenueber dem Zuendwinkel." MAP 0x74346 TGF_VV_VV_SW 180.0 FORMULA_0710 0.0 180.0000 FORMAT "%4.1"
 /begin AXIS_DESCR COM_AXIS n FORMULA_0006 16 0.0 10000.0000 AXIS_PTS_REF AXIS_N16 /end AXIS_DESCR
 /begin AXIS_DESCR COM_AXIS rf_m FORMULA_0007 10 0.0 2.0000 AXIS_PTS_REF AXIS_RF10 /end AXIS_DESCR
/end CHARACTERISTIC
/begin CHARACTERISTIC GKF_KR_KNOCK_LAENGE "Laenge des Klopffensters." MAP 0x74486 TGF_VV_VV_SW 180.0 FORMULA_0710 0.0 180.0000 FORMAT "%4.1"
 /begin AXIS_DESCR COM_AXIS n FORMULA_0006 16 0.0 10000.0000 AXIS_PTS_REF AXIS_N16 /end AXIS_DESCR
 /begin AXIS_DESCR COM_AXIS rf_m FORMULA_0007 10 0.0 2.0000 AXIS_PTS_REF AXIS_RF10 /end AXIS_DESCR
/end CHARACTERISTIC
/begin CHARACTERISTIC GKF_KR_FBS_AVG_OFF_MAX "Zulaessiges Delta zum Mittelwert Engeriespektrum der Klopffrequenz." MAP 0x745C6 TGF_VV_VV_SW 74.4 FORMULA_0734 0.0 74.4334 FORMAT "%5.2"
 /begin AXIS_DESCR COM_AXIS n FORMULA_0006 16 0.0 10000.0000 AXIS_PTS_REF AXIS_N16 /end AXIS_DESCR
 /begin AXIS_DESCR COM_AXIS rf_m FORMULA_0007 10 0.0 2.0000 AXIS_PTS_REF AXIS_RF10 /end AXIS_DESCR
/end CHARACTERISTIC
/begin CHARACTERISTIC GKF_KR_ANZ_ASP_HOLD "Anzahl der Arbeitsspiele in Haltephase. | [Code V452 IGN 0x454BC] Combustion cycles to hold the retard after a knock (n x intensity) before recovery starts." MAP 0x74706 TGF_VV_VV_UB 255.0 FORMULA_0003 0.0 255.0000
 /begin AXIS_DESCR COM_AXIS n FORMULA_0006 12 0.0 10000.0000 AXIS_PTS_REF AXIS_N12 /end AXIS_DESCR
 /begin AXIS_DESCR COM_AXIS fbs FORMULA_0734 12 0.0 74.4334 AXIS_PTS_REF GKL_KR_AXIS_FBS /end AXIS_DESCR
/end CHARACTERISTIC
/begin CHARACTERISTIC GKF_KR_DTZ_AB "Klopfregelungseingriff in Abregelphase. | [Code V452 IGN 0x454BC] Retard step per detected knock (n x knock intensity above threshold). Step is also limited so the result stays above tz_min." MAP 0x74796 TGF_VV_VV_SW 110.0 FORMULA_0111 -50.0000 60.0000 FORMAT "%4.1"
 /begin AXIS_DESCR COM_AXIS n FORMULA_0006 12 0.0 10000.0000 AXIS_PTS_REF AXIS_N12 /end AXIS_DESCR
 /begin AXIS_DESCR COM_AXIS fbs FORMULA_0734 12 0.0 74.4334 AXIS_PTS_REF GKL_KR_AXIS_FBS /end AXIS_DESCR
/end CHARACTERISTIC
/begin CHARACTERISTIC GKF_KR_ANZ_ASP_AUF "Anzahl der Arbeitsspiele fuer Aufregelphase. | [Code V452 IGN 0x44FA0/0x454BC] Recovery: the accumulated retard is returned linearly over this many cycles (n x n gradient). Larger = slower recovery." MAP 0x748B6 TGF_VV_VV_UB 254.0 FORMULA_0003 1.0000 255.0000
 /begin AXIS_DESCR COM_AXIS n FORMULA_0006 12 0.0 10000.0000 AXIS_PTS_REF AXIS_N12 /end AXIS_DESCR
 /begin AXIS_DESCR COM_AXIS n_grad_asp FORMULA_0114 6 -10000.0000 10000.0000 AXIS_PTS_REF AXIS_N_GRAD6 /end AXIS_DESCR
/end CHARACTERISTIC
/begin MEASUREMENT kr_fbs_avg_no_b1 "Anzahl der Arbeitsspiele fuer Mittelwertsbildung." UBYTE FORMULA_0003 0 0 0.0 255.0000 ECU_ADDRESS 0x3FBC06 /end MEASUREMENT
/begin MEASUREMENT kr_fbs_avg_no_b2 "Anzahl der Arbeitsspiele fuer Mittelwertsbildung." UBYTE FORMULA_0003 0 0 0.0 255.0000 ECU_ADDRESS 0x3FBC07 /end MEASUREMENT
/begin MEASUREMENT kr_st_b1 "Status Klopfregelung." UBYTE FORMULA_0711 0 0 0.0 255.0 ECU_ADDRESS 0x3FBC08 /end MEASUREMENT
/begin MEASUREMENT kr_st_b2 "Status Klopfregelung." UBYTE FORMULA_0711 0 0 0.0 255.0 ECU_ADDRESS 0x3FBC09 /end MEASUREMENT
/begin MEASUREMENT kr_anz_asp_auf "Anzahl der Arbeitsspiele fuer Aufregelphase." UBYTE FORMULA_0003 0 0 1.0000 255.0000 ECU_ADDRESS 0x3FBC0A /end MEASUREMENT
/begin MEASUREMENT kr_anz_asp_hold "Anzahl der Arbeitsspiele in Haltephase." UBYTE FORMULA_0003 0 0 0.0 255.0000 ECU_ADDRESS 0x3FBC0B /end MEASUREMENT
/begin MEASUREMENT kr_diag_st "Status Diagnose Bereichsueberwachung" UBYTE FORMULA_0712 0 0 0.0 255.0 ECU_ADDRESS 0x3FBC0C /end MEASUREMENT
/begin MEASUREMENT kr_anz_asp_auf_bez_zyl1 "Bezugsanzahl der Arbeitsspiele fuer Aufregelphase." UBYTE FORMULA_0003 0 0 0.0 255.0000 ECU_ADDRESS 0x3FBC0D /end MEASUREMENT
/begin MEASUREMENT kr_anz_asp_auf_bez_zyl2 "Bezugsanzahl der Arbeitsspiele fuer Aufregelphase." UBYTE FORMULA_0003 0 0 0.0 255.0000 ECU_ADDRESS 0x3FBC0E /end MEASUREMENT
/begin MEASUREMENT kr_anz_asp_auf_bez_zyl3 "Bezugsanzahl der Arbeitsspiele fuer Aufregelphase." UBYTE FORMULA_0003 0 0 0.0 255.0000 ECU_ADDRESS 0x3FBC0F /end MEASUREMENT
/begin MEASUREMENT kr_anz_asp_auf_bez_zyl4 "Bezugsanzahl der Arbeitsspiele fuer Aufregelphase." UBYTE FORMULA_0003 0 0 0.0 255.0000 ECU_ADDRESS 0x3FBC10 /end MEASUREMENT
/begin MEASUREMENT kr_anz_asp_auf_bez_zyl5 "Bezugsanzahl der Arbeitsspiele fuer Aufregelphase." UBYTE FORMULA_0003 0 0 0.0 255.0000 ECU_ADDRESS 0x3FBC11 /end MEASUREMENT
/begin MEASUREMENT kr_anz_asp_auf_bez_zyl6 "Bezugsanzahl der Arbeitsspiele fuer Aufregelphase." UBYTE FORMULA_0003 0 0 0.0 255.0000 ECU_ADDRESS 0x3FBC12 /end MEASUREMENT
/begin MEASUREMENT kr_anz_asp_auf_bez_zyl7 "Bezugsanzahl der Arbeitsspiele fuer Aufregelphase." UBYTE FORMULA_0003 0 0 0.0 255.0000 ECU_ADDRESS 0x3FBC13 /end MEASUREMENT
/begin MEASUREMENT kr_anz_asp_auf_bez_zyl8 "Bezugsanzahl der Arbeitsspiele fuer Aufregelphase." UBYTE FORMULA_0003 0 0 0.0 255.0000 ECU_ADDRESS 0x3FBC14 /end MEASUREMENT
/begin MEASUREMENT kr_anz_asp_auf_bez_zyl9 "Bezugsanzahl der Arbeitsspiele fuer Aufregelphase." UBYTE FORMULA_0003 0 0 0.0 255.0000 ECU_ADDRESS 0x3FBC15 /end MEASUREMENT
/begin MEASUREMENT kr_anz_asp_auf_bez_zyl10 "Bezugsanzahl der Arbeitsspiele fuer Aufregelphase." UBYTE FORMULA_0003 0 0 0.0 255.0000 ECU_ADDRESS 0x3FBC16 /end MEASUREMENT
/begin MEASUREMENT kr_hold_count_zyl1 "Zaehler fuer Haltephase." UBYTE FORMULA_0003 0 0 0.0 255.0000 ECU_ADDRESS 0x3FBC17 /end MEASUREMENT
/begin MEASUREMENT kr_hold_count_zyl2 "Zaehler fuer Haltephase." UBYTE FORMULA_0003 0 0 0.0 255.0000 ECU_ADDRESS 0x3FBC18 /end MEASUREMENT
/begin MEASUREMENT kr_hold_count_zyl3 "Zaehler fuer Haltephase." UBYTE FORMULA_0003 0 0 0.0 255.0000 ECU_ADDRESS 0x3FBC19 /end MEASUREMENT
/begin MEASUREMENT kr_hold_count_zyl4 "Zaehler fuer Haltephase." UBYTE FORMULA_0003 0 0 0.0 255.0000 ECU_ADDRESS 0x3FBC1A /end MEASUREMENT
/begin MEASUREMENT kr_hold_count_zyl5 "Zaehler fuer Haltephase." UBYTE FORMULA_0003 0 0 0.0 255.0000 ECU_ADDRESS 0x3FBC1B /end MEASUREMENT
/begin MEASUREMENT kr_hold_count_zyl6 "Zaehler fuer Haltephase." UBYTE FORMULA_0003 0 0 0.0 255.0000 ECU_ADDRESS 0x3FBC1C /end MEASUREMENT
/begin MEASUREMENT kr_hold_count_zyl7 "Zaehler fuer Haltephase." UBYTE FORMULA_0003 0 0 0.0 255.0000 ECU_ADDRESS 0x3FBC1D /end MEASUREMENT
/begin MEASUREMENT kr_hold_count_zyl8 "Zaehler fuer Haltephase." UBYTE FORMULA_0003 0 0 0.0 255.0000 ECU_ADDRESS 0x3FBC1E /end MEASUREMENT
/begin MEASUREMENT kr_hold_count_zyl9 "Zaehler fuer Haltephase." UBYTE FORMULA_0003 0 0 0.0 255.0000 ECU_ADDRESS 0x3FBC1F /end MEASUREMENT
/begin MEASUREMENT kr_hold_count_zyl10 "Zaehler fuer Haltephase." UBYTE FORMULA_0003 0 0 0.0 255.0000 ECU_ADDRESS 0x3FBC20 /end MEASUREMENT
/begin MEASUREMENT kr_appl_cnt_zyl1 "Zaehler Klopfapplikation." UBYTE FORMULA_0003 0 0 0.0 255.0000 ECU_ADDRESS 0x3FBC21 /end MEASUREMENT
/begin MEASUREMENT kr_appl_cnt_zyl2 "Zaehler Klopfapplikation." UBYTE FORMULA_0003 0 0 0.0 255.0000 ECU_ADDRESS 0x3FBC22 /end MEASUREMENT
/begin MEASUREMENT kr_appl_cnt_zyl3 "Zaehler Klopfapplikation." UBYTE FORMULA_0003 0 0 0.0 255.0000 ECU_ADDRESS 0x3FBC23 /end MEASUREMENT
/begin MEASUREMENT kr_appl_cnt_zyl4 "Zaehler Klopfapplikation." UBYTE FORMULA_0003 0 0 0.0 255.0000 ECU_ADDRESS 0x3FBC24 /end MEASUREMENT
/begin MEASUREMENT kr_appl_cnt_zyl5 "Zaehler Klopfapplikation." UBYTE FORMULA_0003 0 0 0.0 255.0000 ECU_ADDRESS 0x3FBC25 /end MEASUREMENT
/begin MEASUREMENT kr_appl_cnt_zyl6 "Zaehler Klopfapplikation." UBYTE FORMULA_0003 0 0 0.0 255.0000 ECU_ADDRESS 0x3FBC26 /end MEASUREMENT
/begin MEASUREMENT kr_appl_cnt_zyl7 "Zaehler Klopfapplikation." UBYTE FORMULA_0003 0 0 0.0 255.0000 ECU_ADDRESS 0x3FBC27 /end MEASUREMENT
/begin MEASUREMENT kr_appl_cnt_zyl8 "Zaehler Klopfapplikation." UBYTE FORMULA_0003 0 0 0.0 255.0000 ECU_ADDRESS 0x3FBC28 /end MEASUREMENT
/begin MEASUREMENT kr_appl_cnt_zyl9 "Zaehler Klopfapplikation." UBYTE FORMULA_0003 0 0 0.0 255.0000 ECU_ADDRESS 0x3FBC29 /end MEASUREMENT
/begin MEASUREMENT kr_appl_cnt_zyl10 "Zaehler Klopfapplikation." UBYTE FORMULA_0003 0 0 0.0 255.0000 ECU_ADDRESS 0x3FBC2A /end MEASUREMENT
/begin MEASUREMENT kr_klipping_cnt_zyl1 "Zaehler Klipping im Klopffenster." UBYTE FORMULA_0003 0 0 0.0 255.0000 ECU_ADDRESS 0x3FBC2B /end MEASUREMENT
/begin MEASUREMENT kr_klipping_cnt_zyl2 "Zaehler Klipping im Klopffenster." UBYTE FORMULA_0003 0 0 0.0 255.0000 ECU_ADDRESS 0x3FBC2C /end MEASUREMENT
/begin MEASUREMENT kr_klipping_cnt_zyl3 "Zaehler Klipping im Klopffenster." UBYTE FORMULA_0003 0 0 0.0 255.0000 ECU_ADDRESS 0x3FBC2D /end MEASUREMENT
/begin MEASUREMENT kr_klipping_cnt_zyl4 "Zaehler Klipping im Klopffenster." UBYTE FORMULA_0003 0 0 0.0 255.0000 ECU_ADDRESS 0x3FBC2E /end MEASUREMENT
/begin MEASUREMENT kr_klipping_cnt_zyl5 "Zaehler Klipping im Klopffenster." UBYTE FORMULA_0003 0 0 0.0 255.0000 ECU_ADDRESS 0x3FBC2F /end MEASUREMENT
/begin MEASUREMENT kr_klipping_cnt_zyl6 "Zaehler Klipping im Klopffenster." UBYTE FORMULA_0003 0 0 0.0 255.0000 ECU_ADDRESS 0x3FBC30 /end MEASUREMENT
/begin MEASUREMENT kr_klipping_cnt_zyl7 "Zaehler Klipping im Klopffenster." UBYTE FORMULA_0003 0 0 0.0 255.0000 ECU_ADDRESS 0x3FBC31 /end MEASUREMENT
/begin MEASUREMENT kr_klipping_cnt_zyl8 "Zaehler Klipping im Klopffenster." UBYTE FORMULA_0003 0 0 0.0 255.0000 ECU_ADDRESS 0x3FBC32 /end MEASUREMENT
/begin MEASUREMENT kr_klipping_cnt_zyl9 "Zaehler Klipping im Klopffenster." UBYTE FORMULA_0003 0 0 0.0 255.0000 ECU_ADDRESS 0x3FBC33 /end MEASUREMENT
/begin MEASUREMENT kr_klipping_cnt_zyl10 "Zaehler Klipping im Klopffenster." UBYTE FORMULA_0003 0 0 0.0 255.0000 ECU_ADDRESS 0x3FBC34 /end MEASUREMENT
/begin MEASUREMENT kr_st_erk "Status Klopferkennung ueber Mittelwert." UWORD FORMULA_0713 0 0 0.0 4095.0 ECU_ADDRESS 0x3FBC36 /end MEASUREMENT
/begin MEASUREMENT kr_st_erk_zyl1 "Status Klopferkennung ueber Mittelwert 1." UWORD FORMULA_0714 0 0 0.0 1.0 ECU_ADDRESS 0x3FBC36 BIT_MASK 0x1 /end MEASUREMENT
/begin MEASUREMENT kr_st_erk_zyl2 "Status Klopferkennung ueber Mittelwert 2." UWORD FORMULA_0715 0 0 0.0 1.0 ECU_ADDRESS 0x3FBC36 BIT_MASK 0x2 /end MEASUREMENT
/begin MEASUREMENT kr_st_erk_zyl3 "Status Klopferkennung ueber Mittelwert 3." UWORD FORMULA_0716 0 0 0.0 1.0 ECU_ADDRESS 0x3FBC36 BIT_MASK 0x4 /end MEASUREMENT
/begin MEASUREMENT kr_st_erk_zyl4 "Status Klopferkennung ueber Mittelwert 4." UWORD FORMULA_0717 0 0 0.0 1.0 ECU_ADDRESS 0x3FBC36 BIT_MASK 0x8 /end MEASUREMENT
/begin MEASUREMENT kr_st_erk_zyl5 "Status Klopferkennung ueber Mittelwert 5." UWORD FORMULA_0718 0 0 0.0 1.0 ECU_ADDRESS 0x3FBC36 BIT_MASK 0x10 /end MEASUREMENT
/begin MEASUREMENT kr_st_erk_zyl6 "Status Klopferkennung ueber Mittelwert 6." UWORD FORMULA_0719 0 0 0.0 1.0 ECU_ADDRESS 0x3FBC36 BIT_MASK 0x20 /end MEASUREMENT
/begin MEASUREMENT kr_st_erk_zyl7 "Status Klopferkennung ueber Mittelwert 7." UWORD FORMULA_0720 0 0 0.0 1.0 ECU_ADDRESS 0x3FBC36 BIT_MASK 0x40 /end MEASUREMENT
/begin MEASUREMENT kr_st_erk_zyl8 "Status Klopferkennung ueber Mittelwert 8." UWORD FORMULA_0721 0 0 0.0 1.0 ECU_ADDRESS 0x3FBC36 BIT_MASK 0x80 /end MEASUREMENT
/begin MEASUREMENT kr_st_erk_zyl9 "Status Klopferkennung ueber Mittelwert 9." UWORD FORMULA_0722 0 0 0.0 1.0 ECU_ADDRESS 0x3FBC36 BIT_MASK 0x100 /end MEASUREMENT
/begin MEASUREMENT kr_st_erk_zyl10 "Status Klopferkennung ueber Mittelwert 10." UWORD FORMULA_0723 0 0 0.0 1.0 ECU_ADDRESS 0x3FBC36 BIT_MASK 0x200 /end MEASUREMENT
/begin MEASUREMENT kr_akt_st "Status Abregelung." UWORD FORMULA_0010 0 0 0.0 65535.0000 ECU_ADDRESS 0x3FBC38 /end MEASUREMENT
/begin MEASUREMENT kr_akt_st_zyl1 "Abregelung Zylinder 1 aktiv." UWORD FORMULA_0724 0 0 0.0 1.0 ECU_ADDRESS 0x3FBC38 BIT_MASK 0x1 /end MEASUREMENT
/begin MEASUREMENT kr_akt_st_zyl2 "Abregelung Zylinder 2 aktiv." UWORD FORMULA_0725 0 0 0.0 1.0 ECU_ADDRESS 0x3FBC38 BIT_MASK 0x2 /end MEASUREMENT
/begin MEASUREMENT kr_akt_st_zyl3 "Abregelung Zylinder 3 aktiv." UWORD FORMULA_0726 0 0 0.0 1.0 ECU_ADDRESS 0x3FBC38 BIT_MASK 0x4 /end MEASUREMENT
/begin MEASUREMENT kr_akt_st_zyl4 "Abregelung Zylinder 4 aktiv." UWORD FORMULA_0727 0 0 0.0 1.0 ECU_ADDRESS 0x3FBC38 BIT_MASK 0x8 /end MEASUREMENT
/begin MEASUREMENT kr_akt_st_zyl5 "Abregelung Zylinder 5 aktiv." UWORD FORMULA_0728 0 0 0.0 1.0 ECU_ADDRESS 0x3FBC38 BIT_MASK 0x10 /end MEASUREMENT
/begin MEASUREMENT kr_akt_st_zyl6 "Abregelung Zylinder 6 aktiv." UWORD FORMULA_0729 0 0 0.0 1.0 ECU_ADDRESS 0x3FBC38 BIT_MASK 0x20 /end MEASUREMENT
/begin MEASUREMENT kr_akt_st_zyl7 "Abregelung Zylinder 7 aktiv." UWORD FORMULA_0730 0 0 0.0 1.0 ECU_ADDRESS 0x3FBC38 BIT_MASK 0x40 /end MEASUREMENT
/begin MEASUREMENT kr_akt_st_zyl8 "Abregelung Zylinder 8 aktiv." UWORD FORMULA_0731 0 0 0.0 1.0 ECU_ADDRESS 0x3FBC38 BIT_MASK 0x80 /end MEASUREMENT
/begin MEASUREMENT kr_akt_st_zyl9 "Abregelung Zylinder 9 aktiv." UWORD FORMULA_0732 0 0 0.0 1.0 ECU_ADDRESS 0x3FBC38 BIT_MASK 0x100 /end MEASUREMENT
/begin MEASUREMENT kr_akt_st_zyl10 "Abregelung Zylinder 10 aktiv." UWORD FORMULA_0733 0 0 0.0 1.0 ECU_ADDRESS 0x3FBC38 BIT_MASK 0x200 /end MEASUREMENT
/begin MEASUREMENT kr_ab_st "Status Klopfregelung." UWORD FORMULA_0010 0 0 0.0 65535.0000 ECU_ADDRESS 0x3FBC3A /end MEASUREMENT
/begin MEASUREMENT kr_ab_st_zyl1 "Klopfregelung Zylinder 1 aktiv." UWORD FORMULA_0724 0 0 0.0 1.0 ECU_ADDRESS 0x3FBC3A BIT_MASK 0x1 /end MEASUREMENT
/begin MEASUREMENT kr_ab_st_zyl2 "Klopfregelung Zylinder 2 aktiv." UWORD FORMULA_0725 0 0 0.0 1.0 ECU_ADDRESS 0x3FBC3A BIT_MASK 0x2 /end MEASUREMENT
/begin MEASUREMENT kr_ab_st_zyl3 "Klopfregelung Zylinder 3 aktiv." UWORD FORMULA_0726 0 0 0.0 1.0 ECU_ADDRESS 0x3FBC3A BIT_MASK 0x4 /end MEASUREMENT
/begin MEASUREMENT kr_ab_st_zyl4 "Klopfregelung Zylinder 4 aktiv." UWORD FORMULA_0727 0 0 0.0 1.0 ECU_ADDRESS 0x3FBC3A BIT_MASK 0x8 /end MEASUREMENT
/begin MEASUREMENT kr_ab_st_zyl5 "Klopfregelung Zylinder 5 aktiv." UWORD FORMULA_0728 0 0 0.0 1.0 ECU_ADDRESS 0x3FBC3A BIT_MASK 0x10 /end MEASUREMENT
/begin MEASUREMENT kr_ab_st_zyl6 "Klopfregelung Zylinder 6 aktiv." UWORD FORMULA_0729 0 0 0.0 1.0 ECU_ADDRESS 0x3FBC3A BIT_MASK 0x20 /end MEASUREMENT
/begin MEASUREMENT kr_ab_st_zyl7 "Klopfregelung Zylinder 7 aktiv." UWORD FORMULA_0730 0 0 0.0 1.0 ECU_ADDRESS 0x3FBC3A BIT_MASK 0x40 /end MEASUREMENT
/begin MEASUREMENT kr_ab_st_zyl8 "Klopfregelung Zylinder 8 aktiv." UWORD FORMULA_0731 0 0 0.0 1.0 ECU_ADDRESS 0x3FBC3A BIT_MASK 0x80 /end MEASUREMENT
/begin MEASUREMENT kr_ab_st_zyl9 "Klopfregelung Zylinder 9 aktiv." UWORD FORMULA_0732 0 0 0.0 1.0 ECU_ADDRESS 0x3FBC3A BIT_MASK 0x100 /end MEASUREMENT
/begin MEASUREMENT kr_ab_st_zyl10 "Klopfregelung Zylinder 10 aktiv." UWORD FORMULA_0733 0 0 0.0 1.0 ECU_ADDRESS 0x3FBC3A BIT_MASK 0x200 /end MEASUREMENT
/begin MEASUREMENT kr_asp_cnt "KR Arbeitsspielzaehler." UWORD FORMULA_0010 0 0 0.0 65535.0000 ECU_ADDRESS 0x3FBC3C /end MEASUREMENT
/begin MEASUREMENT kr_dtz_max "Maximal zulaessiger Klopfregelungseingriff." SWORD FORMULA_0111 0 0 -50.0000 60.0000 ECU_ADDRESS 0x3FBC3E /end MEASUREMENT
/begin MEASUREMENT kr_int_avg_zyl1 "Mittelwert vom Integral im Klopffenster." SWORD FORMULA_0443 0 0 0.0 3.3000 ECU_ADDRESS 0x3FBC40 /end MEASUREMENT
/begin MEASUREMENT kr_int_avg_zyl2 "Mittelwert vom Integral im Klopffenster." SWORD FORMULA_0443 0 0 0.0 3.3000 ECU_ADDRESS 0x3FBC42 /end MEASUREMENT
/begin MEASUREMENT kr_int_avg_zyl3 "Mittelwert vom Integral im Klopffenster." SWORD FORMULA_0443 0 0 0.0 3.3000 ECU_ADDRESS 0x3FBC44 /end MEASUREMENT
/begin MEASUREMENT kr_int_avg_zyl4 "Mittelwert vom Integral im Klopffenster." SWORD FORMULA_0443 0 0 0.0 3.3000 ECU_ADDRESS 0x3FBC46 /end MEASUREMENT
/begin MEASUREMENT kr_int_avg_zyl5 "Mittelwert vom Integral im Klopffenster." SWORD FORMULA_0443 0 0 0.0 3.3000 ECU_ADDRESS 0x3FBC48 /end MEASUREMENT
/begin MEASUREMENT kr_int_avg_zyl6 "Mittelwert vom Integral im Klopffenster." SWORD FORMULA_0443 0 0 0.0 3.3000 ECU_ADDRESS 0x3FBC4A /end MEASUREMENT
/begin MEASUREMENT kr_int_avg_zyl7 "Mittelwert vom Integral im Klopffenster." SWORD FORMULA_0443 0 0 0.0 3.3000 ECU_ADDRESS 0x3FBC4C /end MEASUREMENT
/begin MEASUREMENT kr_int_avg_zyl8 "Mittelwert vom Integral im Klopffenster." SWORD FORMULA_0443 0 0 0.0 3.3000 ECU_ADDRESS 0x3FBC4E /end MEASUREMENT
/begin MEASUREMENT kr_int_avg_zyl9 "Mittelwert vom Integral im Klopffenster." SWORD FORMULA_0443 0 0 0.0 3.3000 ECU_ADDRESS 0x3FBC50 /end MEASUREMENT
/begin MEASUREMENT kr_int_avg_zyl10 "Mittelwert vom Integral im Klopffenster." SWORD FORMULA_0443 0 0 0.0 3.3000 ECU_ADDRESS 0x3FBC52 /end MEASUREMENT
/begin MEASUREMENT kr_int_avg_norm_zyl1 "Normierter Mittelwert vom Integral im Klopffenster." SWORD FORMULA_0443 0 0 0.0 3.3000 ECU_ADDRESS 0x3FBC54 /end MEASUREMENT
/begin MEASUREMENT kr_int_avg_norm_zyl2 "Normierter Mittelwert vom Integral im Klopffenster." SWORD FORMULA_0443 0 0 0.0 3.3000 ECU_ADDRESS 0x3FBC56 /end MEASUREMENT
/begin MEASUREMENT kr_int_avg_norm_zyl3 "Normierter Mittelwert vom Integral im Klopffenster." SWORD FORMULA_0443 0 0 0.0 3.3000 ECU_ADDRESS 0x3FBC58 /end MEASUREMENT
/begin MEASUREMENT kr_int_avg_norm_zyl4 "Normierter Mittelwert vom Integral im Klopffenster." SWORD FORMULA_0443 0 0 0.0 3.3000 ECU_ADDRESS 0x3FBC5A /end MEASUREMENT
/begin MEASUREMENT kr_int_avg_norm_zyl5 "Normierter Mittelwert vom Integral im Klopffenster." SWORD FORMULA_0443 0 0 0.0 3.3000 ECU_ADDRESS 0x3FBC5C /end MEASUREMENT
/begin MEASUREMENT kr_int_avg_norm_zyl6 "Normierter Mittelwert vom Integral im Klopffenster." SWORD FORMULA_0443 0 0 0.0 3.3000 ECU_ADDRESS 0x3FBC5E /end MEASUREMENT
/begin MEASUREMENT kr_int_avg_norm_zyl7 "Normierter Mittelwert vom Integral im Klopffenster." SWORD FORMULA_0443 0 0 0.0 3.3000 ECU_ADDRESS 0x3FBC60 /end MEASUREMENT
/begin MEASUREMENT kr_int_avg_norm_zyl8 "Normierter Mittelwert vom Integral im Klopffenster." SWORD FORMULA_0443 0 0 0.0 3.3000 ECU_ADDRESS 0x3FBC62 /end MEASUREMENT
/begin MEASUREMENT kr_int_avg_norm_zyl9 "Normierter Mittelwert vom Integral im Klopffenster." SWORD FORMULA_0443 0 0 0.0 3.3000 ECU_ADDRESS 0x3FBC64 /end MEASUREMENT
/begin MEASUREMENT kr_int_avg_norm_zyl10 "Normierter Mittelwert vom Integral im Klopffenster." SWORD FORMULA_0443 0 0 0.0 3.3000 ECU_ADDRESS 0x3FBC66 /end MEASUREMENT
/begin MEASUREMENT kr_fbs_avg_off_max_b1 "Zulaessiges Offset zum Mittelwert Engeriespektrum der Klopffrequenz." SWORD FORMULA_0734 0 0 0.0 74.4334 ECU_ADDRESS 0x3FBC68 /end MEASUREMENT
/begin MEASUREMENT kr_fbs_avg_off_max_b2 "Zulaessiges Offset zum Mittelwert Engeriespektrum der Klopffrequenz." SWORD FORMULA_0734 0 0 0.0 74.4334 ECU_ADDRESS 0x3FBC6A /end MEASUREMENT
/begin MEASUREMENT kr_rf_min_b1 "Mindestfuellung fuer KR-Freigabe." SWORD FORMULA_0007 0 0 0.0 2.0000 ECU_ADDRESS 0x3FBC6C /end MEASUREMENT
/begin MEASUREMENT kr_rf_min_b2 "Mindestfuellung fuer KR-Freigabe." SWORD FORMULA_0007 0 0 0.0 2.0000 ECU_ADDRESS 0x3FBC6E /end MEASUREMENT
/begin MEASUREMENT kr_knock_tz_offs_b1 "Offsets vom Klopffensters gegenueber dem Zuendwinkel." SWORD FORMULA_0710 0 0 -360.0000 359.9000 ECU_ADDRESS 0x3FBC70 /end MEASUREMENT
/begin MEASUREMENT kr_knock_tz_offs_b2 "Offsets vom Klopffensters gegenueber dem Zuendwinkel." SWORD FORMULA_0710 0 0 -360.0000 359.9000 ECU_ADDRESS 0x3FBC72 /end MEASUREMENT
/begin MEASUREMENT kr_knock_laenge_b1 "Laenge des Klopffensters." SWORD FORMULA_0710 0 0 -360.0000 359.9000 ECU_ADDRESS 0x3FBC74 /end MEASUREMENT
/begin MEASUREMENT kr_knock_laenge_b2 "Laenge des Klopffensters." SWORD FORMULA_0710 0 0 -360.0000 359.9000 ECU_ADDRESS 0x3FBC76 /end MEASUREMENT
/begin MEASUREMENT kr_dtz_mw_b1 "Mittelwert Klopfregelungseingriff." SWORD FORMULA_0111 0 0 -50.0000 60.0000 ECU_ADDRESS 0x3FBC78 /end MEASUREMENT
/begin MEASUREMENT kr_dtz_mw_b2 "Mittelwert Klopfregelungseingriff." SWORD FORMULA_0111 0 0 -50.0000 60.0000 ECU_ADDRESS 0x3FBC7A /end MEASUREMENT
/begin MEASUREMENT kr_dtz_diag_t_b1 "Zeit der Bereichsueberwachung von kr_dtz pro Bank" UWORD FORMULA_0073 0 0 0.0 6553.5000 ECU_ADDRESS 0x3FBC7C /end MEASUREMENT
/begin MEASUREMENT kr_dtz_diag_t_b2 "Zeit der Bereichsueberwachung von kr_dtz pro Bank" UWORD FORMULA_0073 0 0 0.0 6553.5000 ECU_ADDRESS 0x3FBC7E /end MEASUREMENT
/begin MEASUREMENT kr_fbs_avg_delta_zyl1 "Delta zum Mittelwert Engeriespektrum der Klopffrequenz." SWORD FORMULA_0734 0 0 0.0 74.4334 ECU_ADDRESS 0x3FBC80 /end MEASUREMENT
/begin MEASUREMENT kr_fbs_avg_delta_zyl2 "Delta zum Mittelwert Engeriespektrum der Klopffrequenz." SWORD FORMULA_0734 0 0 0.0 74.4334 ECU_ADDRESS 0x3FBC82 /end MEASUREMENT
/begin MEASUREMENT kr_fbs_avg_delta_zyl3 "Delta zum Mittelwert Engeriespektrum der Klopffrequenz." SWORD FORMULA_0734 0 0 0.0 74.4334 ECU_ADDRESS 0x3FBC84 /end MEASUREMENT
/begin MEASUREMENT kr_fbs_avg_delta_zyl4 "Delta zum Mittelwert Engeriespektrum der Klopffrequenz." SWORD FORMULA_0734 0 0 0.0 74.4334 ECU_ADDRESS 0x3FBC86 /end MEASUREMENT
/begin MEASUREMENT kr_fbs_avg_delta_zyl5 "Delta zum Mittelwert Engeriespektrum der Klopffrequenz." SWORD FORMULA_0734 0 0 0.0 74.4334 ECU_ADDRESS 0x3FBC88 /end MEASUREMENT
/begin MEASUREMENT kr_fbs_avg_delta_zyl6 "Delta zum Mittelwert Engeriespektrum der Klopffrequenz." SWORD FORMULA_0734 0 0 0.0 74.4334 ECU_ADDRESS 0x3FBC8A /end MEASUREMENT
/begin MEASUREMENT kr_fbs_avg_delta_zyl7 "Delta zum Mittelwert Engeriespektrum der Klopffrequenz." SWORD FORMULA_0734 0 0 0.0 74.4334 ECU_ADDRESS 0x3FBC8C /end MEASUREMENT
/begin MEASUREMENT kr_fbs_avg_delta_zyl8 "Delta zum Mittelwert Engeriespektrum der Klopffrequenz." SWORD FORMULA_0734 0 0 0.0 74.4334 ECU_ADDRESS 0x3FBC8E /end MEASUREMENT
/begin MEASUREMENT kr_fbs_avg_delta_zyl9 "Delta zum Mittelwert Engeriespektrum der Klopffrequenz." SWORD FORMULA_0734 0 0 0.0 74.4334 ECU_ADDRESS 0x3FBC90 /end MEASUREMENT
/begin MEASUREMENT kr_fbs_avg_delta_zyl10 "Delta zum Mittelwert Engeriespektrum der Klopffrequenz." SWORD FORMULA_0734 0 0 0.0 74.4334 ECU_ADDRESS 0x3FBC92 /end MEASUREMENT
/begin MEASUREMENT kr_fbs_avg_zyl1 "Mittelwert Engeriespektrum der Klopffrequenz." SWORD FORMULA_0734 0 0 0.0 74.4334 ECU_ADDRESS 0x3FBC94 /end MEASUREMENT
/begin MEASUREMENT kr_fbs_avg_zyl2 "Mittelwert Engeriespektrum der Klopffrequenz." SWORD FORMULA_0734 0 0 0.0 74.4334 ECU_ADDRESS 0x3FBC96 /end MEASUREMENT
/begin MEASUREMENT kr_fbs_avg_zyl3 "Mittelwert Engeriespektrum der Klopffrequenz." SWORD FORMULA_0734 0 0 0.0 74.4334 ECU_ADDRESS 0x3FBC98 /end MEASUREMENT
/begin MEASUREMENT kr_fbs_avg_zyl4 "Mittelwert Engeriespektrum der Klopffrequenz." SWORD FORMULA_0734 0 0 0.0 74.4334 ECU_ADDRESS 0x3FBC9A /end MEASUREMENT
/begin MEASUREMENT kr_fbs_avg_zyl5 "Mittelwert Engeriespektrum der Klopffrequenz." SWORD FORMULA_0734 0 0 0.0 74.4334 ECU_ADDRESS 0x3FBC9C /end MEASUREMENT
/begin MEASUREMENT kr_fbs_avg_zyl6 "Mittelwert Engeriespektrum der Klopffrequenz." SWORD FORMULA_0734 0 0 0.0 74.4334 ECU_ADDRESS 0x3FBC9E /end MEASUREMENT
/begin MEASUREMENT kr_fbs_avg_zyl7 "Mittelwert Engeriespektrum der Klopffrequenz." SWORD FORMULA_0734 0 0 0.0 74.4334 ECU_ADDRESS 0x3FBCA0 /end MEASUREMENT
/begin MEASUREMENT kr_fbs_avg_zyl8 "Mittelwert Engeriespektrum der Klopffrequenz." SWORD FORMULA_0734 0 0 0.0 74.4334 ECU_ADDRESS 0x3FBCA2 /end MEASUREMENT
/begin MEASUREMENT kr_fbs_avg_zyl9 "Mittelwert Engeriespektrum der Klopffrequenz." SWORD FORMULA_0734 0 0 0.0 74.4334 ECU_ADDRESS 0x3FBCA4 /end MEASUREMENT
/begin MEASUREMENT kr_fbs_avg_zyl10 "Mittelwert Engeriespektrum der Klopffrequenz." SWORD FORMULA_0734 0 0 0.0 74.4334 ECU_ADDRESS 0x3FBCA6 /end MEASUREMENT
/begin MEASUREMENT kr_dtz_zyl1 "Klopfreglungseingriff." SWORD FORMULA_0111 0 0 -50.0000 60.0000 ECU_ADDRESS 0x3FBCA8 /end MEASUREMENT
/begin MEASUREMENT kr_dtz_zyl2 "Klopfreglungseingriff." SWORD FORMULA_0111 0 0 -50.0000 60.0000 ECU_ADDRESS 0x3FBCAA /end MEASUREMENT
/begin MEASUREMENT kr_dtz_zyl3 "Klopfreglungseingriff." SWORD FORMULA_0111 0 0 -50.0000 60.0000 ECU_ADDRESS 0x3FBCAC /end MEASUREMENT
/begin MEASUREMENT kr_dtz_zyl4 "Klopfreglungseingriff." SWORD FORMULA_0111 0 0 -50.0000 60.0000 ECU_ADDRESS 0x3FBCAE /end MEASUREMENT
/begin MEASUREMENT kr_dtz_zyl5 "Klopfreglungseingriff." SWORD FORMULA_0111 0 0 -50.0000 60.0000 ECU_ADDRESS 0x3FBCB0 /end MEASUREMENT
/begin MEASUREMENT kr_dtz_zyl6 "Klopfreglungseingriff." SWORD FORMULA_0111 0 0 -50.0000 60.0000 ECU_ADDRESS 0x3FBCB2 /end MEASUREMENT
/begin MEASUREMENT kr_dtz_zyl7 "Klopfreglungseingriff." SWORD FORMULA_0111 0 0 -50.0000 60.0000 ECU_ADDRESS 0x3FBCB4 /end MEASUREMENT
/begin MEASUREMENT kr_dtz_zyl8 "Klopfreglungseingriff." SWORD FORMULA_0111 0 0 -50.0000 60.0000 ECU_ADDRESS 0x3FBCB6 /end MEASUREMENT
/begin MEASUREMENT kr_dtz_zyl9 "Klopfreglungseingriff." SWORD FORMULA_0111 0 0 -50.0000 60.0000 ECU_ADDRESS 0x3FBCB8 /end MEASUREMENT
/begin MEASUREMENT kr_dtz_zyl10 "Klopfreglungseingriff." SWORD FORMULA_0111 0 0 -50.0000 60.0000 ECU_ADDRESS 0x3FBCBA /end MEASUREMENT
/begin MEASUREMENT kr_fbs_zyl1 "Engeriespektrum der Klopffrequenz." SWORD FORMULA_0734 0 0 0.0 74.4334 ECU_ADDRESS 0x3FBCBC /end MEASUREMENT
/begin MEASUREMENT kr_fbs_zyl2 "Engeriespektrum der Klopffrequenz." SWORD FORMULA_0734 0 0 0.0 74.4334 ECU_ADDRESS 0x3FBCBE /end MEASUREMENT
/begin MEASUREMENT kr_fbs_zyl3 "Engeriespektrum der Klopffrequenz." SWORD FORMULA_0734 0 0 0.0 74.4334 ECU_ADDRESS 0x3FBCC0 /end MEASUREMENT
/begin MEASUREMENT kr_fbs_zyl4 "Engeriespektrum der Klopffrequenz." SWORD FORMULA_0734 0 0 0.0 74.4334 ECU_ADDRESS 0x3FBCC2 /end MEASUREMENT
/begin MEASUREMENT kr_fbs_zyl5 "Engeriespektrum der Klopffrequenz." SWORD FORMULA_0734 0 0 0.0 74.4334 ECU_ADDRESS 0x3FBCC4 /end MEASUREMENT
/begin MEASUREMENT kr_fbs_zyl6 "Engeriespektrum der Klopffrequenz." SWORD FORMULA_0734 0 0 0.0 74.4334 ECU_ADDRESS 0x3FBCC6 /end MEASUREMENT
/begin MEASUREMENT kr_fbs_zyl7 "Engeriespektrum der Klopffrequenz." SWORD FORMULA_0734 0 0 0.0 74.4334 ECU_ADDRESS 0x3FBCC8 /end MEASUREMENT
/begin MEASUREMENT kr_fbs_zyl8 "Engeriespektrum der Klopffrequenz." SWORD FORMULA_0734 0 0 0.0 74.4334 ECU_ADDRESS 0x3FBCCA /end MEASUREMENT
/begin MEASUREMENT kr_fbs_zyl9 "Engeriespektrum der Klopffrequenz." SWORD FORMULA_0734 0 0 0.0 74.4334 ECU_ADDRESS 0x3FBCCC /end MEASUREMENT
/begin MEASUREMENT kr_fbs_zyl10 "Engeriespektrum der Klopffrequenz." SWORD FORMULA_0734 0 0 0.0 74.4334 ECU_ADDRESS 0x3FBCCE /end MEASUREMENT
/begin MEASUREMENT kr_dtz_ab_zyl1 "Klopfregelungseingriff in Abregelphase." SWORD FORMULA_0111 0 0 -50.0000 60.0000 ECU_ADDRESS 0x3FBCD0 /end MEASUREMENT
/begin MEASUREMENT kr_dtz_ab_zyl2 "Klopfregelungseingriff in Abregelphase." SWORD FORMULA_0111 0 0 -50.0000 60.0000 ECU_ADDRESS 0x3FBCD2 /end MEASUREMENT
/begin MEASUREMENT kr_dtz_ab_zyl3 "Klopfregelungseingriff in Abregelphase." SWORD FORMULA_0111 0 0 -50.0000 60.0000 ECU_ADDRESS 0x3FBCD4 /end MEASUREMENT
/begin MEASUREMENT kr_dtz_ab_zyl4 "Klopfregelungseingriff in Abregelphase." SWORD FORMULA_0111 0 0 -50.0000 60.0000 ECU_ADDRESS 0x3FBCD6 /end MEASUREMENT
/begin MEASUREMENT kr_dtz_ab_zyl5 "Klopfregelungseingriff in Abregelphase." SWORD FORMULA_0111 0 0 -50.0000 60.0000 ECU_ADDRESS 0x3FBCD8 /end MEASUREMENT
/begin MEASUREMENT kr_dtz_ab_zyl6 "Klopfregelungseingriff in Abregelphase." SWORD FORMULA_0111 0 0 -50.0000 60.0000 ECU_ADDRESS 0x3FBCDA /end MEASUREMENT
/begin MEASUREMENT kr_dtz_ab_zyl7 "Klopfregelungseingriff in Abregelphase." SWORD FORMULA_0111 0 0 -50.0000 60.0000 ECU_ADDRESS 0x3FBCDC /end MEASUREMENT
/begin MEASUREMENT kr_dtz_ab_zyl8 "Klopfregelungseingriff in Abregelphase." SWORD FORMULA_0111 0 0 -50.0000 60.0000 ECU_ADDRESS 0x3FBCDE /end MEASUREMENT
/begin MEASUREMENT kr_dtz_ab_zyl9 "Klopfregelungseingriff in Abregelphase." SWORD FORMULA_0111 0 0 -50.0000 60.0000 ECU_ADDRESS 0x3FBCE0 /end MEASUREMENT
/begin MEASUREMENT kr_dtz_ab_zyl10 "Klopfregelungseingriff in Abregelphase." SWORD FORMULA_0111 0 0 -50.0000 60.0000 ECU_ADDRESS 0x3FBCE2 /end MEASUREMENT
/begin MEASUREMENT kr_dtz_sum_all "Klopfregelungseingriffsumme." SLONG FORMULA_0244 0 0 -100.0000 100.0000 ECU_ADDRESS 0x3FBCE4 /end MEASUREMENT
/begin MEASUREMENT kr_dtz_int_zyl1 "Klopfreglungseingriff (intern)." SLONG FORMULA_0243 0 0 -50.0000 60.0000 ECU_ADDRESS 0x3FBCE8 /end MEASUREMENT
/begin MEASUREMENT kr_dtz_int_zyl2 "Klopfreglungseingriff (intern)." SLONG FORMULA_0243 0 0 -50.0000 60.0000 ECU_ADDRESS 0x3FBCEC /end MEASUREMENT
/begin MEASUREMENT kr_dtz_int_zyl3 "Klopfreglungseingriff (intern)." SLONG FORMULA_0243 0 0 -50.0000 60.0000 ECU_ADDRESS 0x3FBCF0 /end MEASUREMENT
/begin MEASUREMENT kr_dtz_int_zyl4 "Klopfreglungseingriff (intern)." SLONG FORMULA_0243 0 0 -50.0000 60.0000 ECU_ADDRESS 0x3FBCF4 /end MEASUREMENT
/begin MEASUREMENT kr_dtz_int_zyl5 "Klopfreglungseingriff (intern)." SLONG FORMULA_0243 0 0 -50.0000 60.0000 ECU_ADDRESS 0x3FBCF8 /end MEASUREMENT
/begin MEASUREMENT kr_dtz_int_zyl6 "Klopfreglungseingriff (intern)." SLONG FORMULA_0243 0 0 -50.0000 60.0000 ECU_ADDRESS 0x3FBCFC /end MEASUREMENT
/begin MEASUREMENT kr_dtz_int_zyl7 "Klopfreglungseingriff (intern)." SLONG FORMULA_0243 0 0 -50.0000 60.0000 ECU_ADDRESS 0x3FBD00 /end MEASUREMENT
/begin MEASUREMENT kr_dtz_int_zyl8 "Klopfreglungseingriff (intern)." SLONG FORMULA_0243 0 0 -50.0000 60.0000 ECU_ADDRESS 0x3FBD04 /end MEASUREMENT
/begin MEASUREMENT kr_dtz_int_zyl9 "Klopfreglungseingriff (intern)." SLONG FORMULA_0243 0 0 -50.0000 60.0000 ECU_ADDRESS 0x3FBD08 /end MEASUREMENT
/begin MEASUREMENT kr_dtz_int_zyl10 "Klopfreglungseingriff (intern)." SLONG FORMULA_0243 0 0 -50.0000 60.0000 ECU_ADDRESS 0x3FBD0C /end MEASUREMENT
/begin MEASUREMENT kr_dtz_bez_zyl1 "Bezugszuendwinkel fuer Aufregelphase." SLONG FORMULA_0243 0 0 -50.0000 60.0000 ECU_ADDRESS 0x3FBD10 /end MEASUREMENT
/begin MEASUREMENT kr_dtz_bez_zyl2 "Bezugszuendwinkel fuer Aufregelphase." SLONG FORMULA_0243 0 0 -50.0000 60.0000 ECU_ADDRESS 0x3FBD14 /end MEASUREMENT
/begin MEASUREMENT kr_dtz_bez_zyl3 "Bezugszuendwinkel fuer Aufregelphase." SLONG FORMULA_0243 0 0 -50.0000 60.0000 ECU_ADDRESS 0x3FBD18 /end MEASUREMENT
/begin MEASUREMENT kr_dtz_bez_zyl4 "Bezugszuendwinkel fuer Aufregelphase." SLONG FORMULA_0243 0 0 -50.0000 60.0000 ECU_ADDRESS 0x3FBD1C /end MEASUREMENT
/begin MEASUREMENT kr_dtz_bez_zyl5 "Bezugszuendwinkel fuer Aufregelphase." SLONG FORMULA_0243 0 0 -50.0000 60.0000 ECU_ADDRESS 0x3FBD20 /end MEASUREMENT
/begin MEASUREMENT kr_dtz_bez_zyl6 "Bezugszuendwinkel fuer Aufregelphase." SLONG FORMULA_0243 0 0 -50.0000 60.0000 ECU_ADDRESS 0x3FBD24 /end MEASUREMENT
/begin MEASUREMENT kr_dtz_bez_zyl7 "Bezugszuendwinkel fuer Aufregelphase." SLONG FORMULA_0243 0 0 -50.0000 60.0000 ECU_ADDRESS 0x3FBD28 /end MEASUREMENT
/begin MEASUREMENT kr_dtz_bez_zyl8 "Bezugszuendwinkel fuer Aufregelphase." SLONG FORMULA_0243 0 0 -50.0000 60.0000 ECU_ADDRESS 0x3FBD2C /end MEASUREMENT
/begin MEASUREMENT kr_dtz_bez_zyl9 "Bezugszuendwinkel fuer Aufregelphase." SLONG FORMULA_0243 0 0 -50.0000 60.0000 ECU_ADDRESS 0x3FBD30 /end MEASUREMENT
/begin MEASUREMENT kr_dtz_bez_zyl10 "Bezugszuendwinkel fuer Aufregelphase." SLONG FORMULA_0243 0 0 -50.0000 60.0000 ECU_ADDRESS 0x3FBD34 /end MEASUREMENT
/begin MEASUREMENT kr_dtz_grad_zyl1 "Klopfregelungseingriffgradient." SLONG FORMULA_0243 0 0 -50.0000 60.0000 ECU_ADDRESS 0x3FBD38 /end MEASUREMENT
/begin MEASUREMENT kr_dtz_grad_zyl2 "Klopfregelungseingriffgradient." SLONG FORMULA_0243 0 0 -50.0000 60.0000 ECU_ADDRESS 0x3FBD3C /end MEASUREMENT
/begin MEASUREMENT kr_dtz_grad_zyl3 "Klopfregelungseingriffgradient." SLONG FORMULA_0243 0 0 -50.0000 60.0000 ECU_ADDRESS 0x3FBD40 /end MEASUREMENT
/begin MEASUREMENT kr_dtz_grad_zyl4 "Klopfregelungseingriffgradient." SLONG FORMULA_0243 0 0 -50.0000 60.0000 ECU_ADDRESS 0x3FBD44 /end MEASUREMENT
/begin MEASUREMENT kr_dtz_grad_zyl5 "Klopfregelungseingriffgradient." SLONG FORMULA_0243 0 0 -50.0000 60.0000 ECU_ADDRESS 0x3FBD48 /end MEASUREMENT
/begin MEASUREMENT kr_dtz_grad_zyl6 "Klopfregelungseingriffgradient." SLONG FORMULA_0243 0 0 -50.0000 60.0000 ECU_ADDRESS 0x3FBD4C /end MEASUREMENT
/begin MEASUREMENT kr_dtz_grad_zyl7 "Klopfregelungseingriffgradient." SLONG FORMULA_0243 0 0 -50.0000 60.0000 ECU_ADDRESS 0x3FBD50 /end MEASUREMENT
/begin MEASUREMENT kr_dtz_grad_zyl8 "Klopfregelungseingriffgradient." SLONG FORMULA_0243 0 0 -50.0000 60.0000 ECU_ADDRESS 0x3FBD54 /end MEASUREMENT
/begin MEASUREMENT kr_dtz_grad_zyl9 "Klopfregelungseingriffgradient." SLONG FORMULA_0243 0 0 -50.0000 60.0000 ECU_ADDRESS 0x3FBD58 /end MEASUREMENT
/begin MEASUREMENT kr_dtz_grad_zyl10 "Klopfregelungseingriffgradient." SLONG FORMULA_0243 0 0 -50.0000 60.0000 ECU_ADDRESS 0x3FBD5C /end MEASUREMENT
/begin MEASUREMENT kr_sst_fbs12_zyl1 "SST" ULONG FORMULA_0000 0 0 0.0 4294967295.0000 ECU_ADDRESS 0x3FBD60 /end MEASUREMENT
/begin MEASUREMENT kr_sst_fbs12_zyl2 "SST" ULONG FORMULA_0000 0 0 0.0 4294967295.0000 ECU_ADDRESS 0x3FBD64 /end MEASUREMENT
/begin MEASUREMENT kr_sst_fbs12_zyl3 "SST" ULONG FORMULA_0000 0 0 0.0 4294967295.0000 ECU_ADDRESS 0x3FBD68 /end MEASUREMENT
/begin MEASUREMENT kr_sst_fbs12_zyl4 "SST" ULONG FORMULA_0000 0 0 0.0 4294967295.0000 ECU_ADDRESS 0x3FBD6C /end MEASUREMENT
/begin MEASUREMENT kr_sst_fbs12_zyl5 "SST" ULONG FORMULA_0000 0 0 0.0 4294967295.0000 ECU_ADDRESS 0x3FBD70 /end MEASUREMENT
/begin MEASUREMENT kr_sst_fbs12_zyl6 "SST" ULONG FORMULA_0000 0 0 0.0 4294967295.0000 ECU_ADDRESS 0x3FBD74 /end MEASUREMENT
/begin MEASUREMENT kr_sst_fbs12_zyl7 "SST" ULONG FORMULA_0000 0 0 0.0 4294967295.0000 ECU_ADDRESS 0x3FBD78 /end MEASUREMENT
/begin MEASUREMENT kr_sst_fbs12_zyl8 "SST" ULONG FORMULA_0000 0 0 0.0 4294967295.0000 ECU_ADDRESS 0x3FBD7C /end MEASUREMENT
/begin MEASUREMENT kr_sst_fbs12_zyl9 "SST" ULONG FORMULA_0000 0 0 0.0 4294967295.0000 ECU_ADDRESS 0x3FBD80 /end MEASUREMENT
/begin MEASUREMENT kr_sst_fbs12_zyl10 "SST" ULONG FORMULA_0000 0 0 0.0 4294967295.0000 ECU_ADDRESS 0x3FBD84 /end MEASUREMENT
/begin AXIS_PTS GKL_KR_AXIS_FBS "Stuetzstellen ueber Frequenz-Band-Spektrum." 0x742BA fbs TAD_UB_VV_SW 74.4 FORMULA_0734 12 0.0 74.4334 FORMAT "%5.2" /end AXIS_PTS
/* ------------------ Abschnitt erzeugt aus kus.dat ------------------ */
/begin CHARACTERISTIC K_KUS_CFG "Schalter Konfiguration Kupplungsschlupfregelung | EN: Schalter Konfiguration Kupplungsschlupfregelung" VALUE 0x748FE TKW_VV_VV_UB 100.0 FORMULA_0737 0.0 255.0 /end CHARACTERISTIC
/begin CHARACTERISTIC K_KUS_STUFE "Eingriffsstufe Kupplungsschlupfregelung | EN: Eingriffsstufe Kupplungsschlupfregelung" VALUE 0x748FF TKW_VV_VV_UB 100.0 FORMULA_0003 0.0 255.0000 /end CHARACTERISTIC
/begin CHARACTERISTIC K_KUS_N_DELTA_EIN "Begrenzung Abregelrampe Motordrehzahl | EN: Begrenzung Abregelrampe Motordrehzahl" VALUE 0x74900 TKW_VV_VV_UW 100.0 FORMULA_0738 0.0 20000.0000 FORMAT "%5.2" /end CHARACTERISTIC
/begin CHARACTERISTIC K_KUS_N_DELTA_AUS "Begrenzung Abregelrampe Motordrehzahl | EN: Begrenzung Abregelrampe Motordrehzahl" VALUE 0x74902 TKW_VV_VV_UW 100.0 FORMULA_0738 0.0 20000.0000 FORMAT "%5.2" /end CHARACTERISTIC
/begin CHARACTERISTIC K_KUS_GANG_MAX "maximaler Gang, bei dem noch eine Freigabe erfolgt | EN: maximaler Gang, bei dem noch eine Freigabe erfolgt" VALUE 0x74904 TKW_VV_VV_SB 100.0 FORMULA_0318 -1.0000 10.0000 /end CHARACTERISTIC
/begin CHARACTERISTIC K_KUS_N_GETR_EIN_MIN "minimale Getriebeeingangsdrehzahl KUS Timer | EN: minimale Getriebeeingangsdrehzahl KUS Timer" VALUE 0x74906 TKW_VV_VV_SW 100.0 FORMULA_0006 0.0 10000.0000 /end CHARACTERISTIC
/begin CHARACTERISTIC K_KUS_N_GETR_EIN_HYS "Hysterese minimale Getriebeeingangsdrehzahl KUS Timer | EN: Hysterese minimale Getriebeeingangsdrehzahl KUS Timer" VALUE 0x74908 TKW_VV_VV_SW 100.0 FORMULA_0006 0.0 10000.0000 /end CHARACTERISTIC
/begin CHARACTERISTIC K_KUS_N_MIN "minimale Motordrehzahl KUS Timer | EN: minimale Motordrehzahl KUS Timer" VALUE 0x7490A TKW_VV_VV_SW 100.0 FORMULA_0006 0.0 10000.0000 /end CHARACTERISTIC
/begin CHARACTERISTIC K_KUS_N_HYS "Hysterese minimale Motordrehzahl KUS Timer | EN: Hysterese minimale Motordrehzahl KUS Timer" VALUE 0x7490C TKW_VV_VV_SW 100.0 FORMULA_0006 0.0 10000.0000 /end CHARACTERISTIC
/begin CHARACTERISTIC K_KUS_V_VORNE_MAX "maximale Geschwindigkeit, bei der noch Freigabe | EN: maximale Geschwindigkeit, bei der noch Freigabe" VALUE 0x7490E TKW_VV_VV_SW 100.0 FORMULA_0078 -80.0000 360.0000 FORMAT "%4.1" /end CHARACTERISTIC
/begin CHARACTERISTIC K_KUS_V_VORNE_HYS "Hysterese maximale Geschwindigkeit, bei der noch Freigabe | EN: Hysterese maximale Geschwindigkeit, bei der noch Freigabe" VALUE 0x74910 TKW_VV_VV_SW 100.0 FORMULA_0078 -80.0000 360.0000 FORMAT "%4.1" /end CHARACTERISTIC
/begin CHARACTERISTIC KL_KUS_SCHLUPF_MAX "zulaessiger Kupplungsschlupf | EN: Permitted clutch slip" CURVE 0x74912 TKL_UB_VV_SW 100.0 FORMULA_0006 0.0 10000.0000 /begin AXIS_DESCR STD_AXIS Kusstufe FORMULA_0003 6 0.0 255.0000 /end AXIS_DESCR /end CHARACTERISTIC
/begin CHARACTERISTIC KL_KUS_GANG_FAK "Ganganteil abh. vom Schlupf | EN: Gear share depending on slip" CURVE 0x74926 TKL_SW_VV_SW 100.0 FORMULA_0075 -1.0000 10.0000 /begin AXIS_DESCR STD_AXIS Schlupf FORMULA_0006 4 0.0 10000.0000 /end AXIS_DESCR FORMAT "%6.3" /end CHARACTERISTIC
/begin CHARACTERISTIC KL_KUS_N_MIN_AFZ "untere Motordrehzahl abh. von der Steigung | EN: Lower engine speed depending on gradient (incline)" CURVE 0x74938 TKL_SW_VV_SW 100.0 FORMULA_0006 0.0 10000.0000
 /begin AXIS_DESCR STD_AXIS Laengsbeschleunigung FORMULA_0132 4 -50.0000 50.0000 FORMAT "%5.2" /end AXIS_DESCR
/end CHARACTERISTIC
/begin CHARACTERISTIC KF_KUS_N_MIN "untere Begrenzung maximale Motordrehzahl | EN: Lower limit of maximum engine speed" MAP 0x7494A TKF_SW_SW_SW 100.0 FORMULA_0006 0.0 10000.0000 /begin AXIS_DESCR STD_AXIS Timer FORMULA_0117 4 0.0 160.0000 FORMAT "%5.2" /end AXIS_DESCR /begin AXIS_DESCR STD_AXIS n FORMULA_0006 4 -10000.0000 10000.0000 /end AXIS_DESCR /end CHARACTERISTIC
/begin MEASUREMENT kus_st "Status Kupplungsschlupf-Funktion" UBYTE FORMULA_0033 0 0 0.0 255.0000 ECU_ADDRESS 0x3FBD88 /end MEASUREMENT
/begin MEASUREMENT kus_st_enable "Status Kupplungsschlupf-Funktion Enable" UBYTE FORMULA_0736 0 0 0.0 255.0 ECU_ADDRESS 0x3FBD88 BIT_MASK 0x1 /end MEASUREMENT
/begin MEASUREMENT kus_timer "Timer Motor Teillast oder Volllast" UWORD FORMULA_0117 0 0 0.0 150.0000 ECU_ADDRESS 0x3FBD8A /end MEASUREMENT
/begin MEASUREMENT kus_n_max "maximale Motordrehzahl, Kupplungsschlupfregelung" SWORD FORMULA_0006 0 0 0.0 10000.0000 ECU_ADDRESS 0x3FBD8C /end MEASUREMENT
/begin MEASUREMENT kus_n_schlupf "Kupplungsschlupf" SWORD FORMULA_0006 0 0 -10000.0000 10000.0000 ECU_ADDRESS 0x3FBD8E /end MEASUREMENT
/begin MEASUREMENT kus_gang "Gang mit Zwischenstufen, Kupplungsschlupfregelung" SWORD FORMULA_0075 0 0 -1.0000 10.0000 ECU_ADDRESS 0x3FBD90 /end MEASUREMENT
/begin MEASUREMENT kus_n_getr_ein_alt "Getriebeeingangsdrehzahl" SWORD FORMULA_0006 0 0 0.0 12000.0000 ECU_ADDRESS 0x3FBD92 /end MEASUREMENT
/* ------------------ Abschnitt erzeugt aus md_kus.dat ------------------ */
/begin CHARACTERISTIC K_MD_KUS_PID_A1 "Koeffizient a1, PID-Regler | EN: Coefficient a1, PID controller" VALUE 0x778BA TKW_VV_VV_SW 100.0 FORMULA_0497 -10.0000 10.0000 FORMAT "%5.2" /end CHARACTERISTIC
/begin CHARACTERISTIC K_MD_KUS_BEGR_TAU1_EIN "Zeitkonstante weiches Aufsteuern ein | EN: Time constant soft ramp-up, on [s]" VALUE 0x778BC TKW_VV_VV_UB 100.0 FORMULA_0478 0.0051 1.2800 /end CHARACTERISTIC
/begin CHARACTERISTIC K_MD_KUS_BEGR_TAU1_AUS "Zeitkonstante weiches Aufsteuern ein | EN: Time constant soft ramp-up, off [s]" VALUE 0x778BD TKW_VV_VV_UB 100.0 FORMULA_0478 0.0051 1.2800 /end CHARACTERISTIC
/begin CHARACTERISTIC K_MD_KUS_BEGR_TAU_EIN "Zeitkonstante weiches Aufsteuern ein | EN: Time constant soft ramp-up, on [s]" VALUE 0x778BE TKW_VV_VV_UB 100.0 FORMULA_0478 0.0051 1.2800 /end CHARACTERISTIC
/begin CHARACTERISTIC K_MD_KUS_BEGR_TAU_AUS "Zeitkonstante weiches Aufsteuern ein | EN: Time constant soft ramp-up, off [s]" VALUE 0x778BF TKW_VV_VV_UB 100.0 FORMULA_0478 0.0051 1.2800 /end CHARACTERISTIC
/begin CHARACTERISTIC KL_MD_KUS_KR_FAK "Faktor auf KR | EN: Factor on KR (gain)" CURVE 0x778C0 TKL_SW_VV_UW 100.0 FORMULA_0075 0.0 10.0000
 /begin AXIS_DESCR STD_AXIS Regelabweichung FORMULA_0006 6 -10000.0000 10000.0000 /end AXIS_DESCR
 FORMAT "%6.3" /end CHARACTERISTIC
/begin CHARACTERISTIC KL_MD_KUS_KUPP_MIN "Minimalmoment fuer Regler | EN: Maximum IPM clutch torque" CURVE 0x778DA TKL_SW_VV_SW 100.0 FORMULA_0009 -100.0000 1000.0000
 /begin AXIS_DESCR STD_AXIS Kupplungsschlupf FORMULA_0006 4 -10000.0000 10000.0000 /end AXIS_DESCR
 FORMAT "%4.1" /end CHARACTERISTIC
/begin CHARACTERISTIC KL_MD_KUS_TN_FAK "Faktor auf TN | EN: Factor on TN (integral time)" CURVE 0x778EC TKL_SW_VV_UW 100.0 FORMULA_0075 0.0 10.0000
 /begin AXIS_DESCR STD_AXIS Regelabweichung FORMULA_0006 6 -10000.0000 10000.0000 /end AXIS_DESCR
 FORMAT "%6.3" /end CHARACTERISTIC
/begin CHARACTERISTIC KL_MD_KUS_TV_FAK "Faktor auf TV | EN: Factor on TV (derivative time)" CURVE 0x77906 TKL_SW_VV_UW 100.0 FORMULA_0075 0.0 10.0000
 /begin AXIS_DESCR STD_AXIS Regelabweichung FORMULA_0006 6 -10000.0000 10000.0000 /end AXIS_DESCR
 FORMAT "%6.3" /end CHARACTERISTIC
/begin CHARACTERISTIC KF_MD_KUS_KR "Regelparameter KR | EN: Control parameter KR (gain)" MAP 0x77920 TKF_SW_SW_SW 100.0 FORMULA_0816 0.0 2.0000 /begin AXIS_DESCR STD_AXIS Gang FORMULA_0075 7 -1.0000 10.0000 FORMAT "%6.3" /end AXIS_DESCR /begin AXIS_DESCR STD_AXIS n FORMULA_0006 6 0.0 10000.0000 /end AXIS_DESCR FORMAT "%5.2" /end CHARACTERISTIC
/begin CHARACTERISTIC KF_MD_KUS_TN "Regelparameter TN | EN: Control parameter TN (integral time)" MAP 0x77990 TKF_SW_SW_SW 100.0 FORMULA_0499 0.0030 30.0000 /begin AXIS_DESCR STD_AXIS Gang FORMULA_0075 7 -1.0000 10.0000 FORMAT "%6.3" /end AXIS_DESCR /begin AXIS_DESCR STD_AXIS n FORMULA_0006 6 0.0 10000.0000 /end AXIS_DESCR FORMAT "%6.3" /end CHARACTERISTIC
/begin CHARACTERISTIC KF_MD_KUS_TV "Regelparameter TV | EN: Control parameter TV (derivative time)" MAP 0x77A00 TKF_SW_SW_SW 100.0 FORMULA_0499 0.0 20.0000 /begin AXIS_DESCR STD_AXIS Gang FORMULA_0075 7 -1.0000 10.0000 FORMAT "%6.3" /end AXIS_DESCR /begin AXIS_DESCR STD_AXIS n FORMULA_0006 6 0.0 10000.0000 /end AXIS_DESCR FORMAT "%6.3" /end CHARACTERISTIC
/begin MEASUREMENT md_kus_n_dif "Regelabweichung, Kupplungsschlupf" SWORD FORMULA_0006 0 0 0.0 10000.0000 ECU_ADDRESS 0x3FC02C /end MEASUREMENT
/begin MEASUREMENT md_kus_n_dif_verz1 "Regelabweichung, 1 x verzoegert, Kupplungsschlupf" SWORD FORMULA_0006 0 0 0.0 10000.0000 ECU_ADDRESS 0x3FC02E /end MEASUREMENT
/begin MEASUREMENT md_kus_n_dif_verz2 "Regelabweichung, 2 x verzoegert, Kupplungsschlupf" SWORD FORMULA_0006 0 0 0.0 10000.0000 ECU_ADDRESS 0x3FC030 /end MEASUREMENT
/begin MEASUREMENT md_kus_pid_b0 "Koeffizient b0, PID-Regler" SLONG FORMULA_0815 0 0 -2147483.6480 2147483.6470 ECU_ADDRESS 0x3FC034 /end MEASUREMENT
/begin MEASUREMENT md_kus_pid_b1 "Koeffizient b1, PID-Regler" SLONG FORMULA_0815 0 0 -2147483.6480 2147483.6470 ECU_ADDRESS 0x3FC038 /end MEASUREMENT
/begin MEASUREMENT md_kus_pid_b2 "Koeffizient b2, PID-Regler" SLONG FORMULA_0815 0 0 -2147483.6480 2147483.6470 ECU_ADDRESS 0x3FC03C /end MEASUREMENT
/begin MEASUREMENT md_kus_pid "Motormomentenbegrenzung des PID-Reglers" SWORD FORMULA_0009 0 0 -100.0000 1000.0000 ECU_ADDRESS 0x3FC040 /end MEASUREMENT
/begin MEASUREMENT md_kus_begr1 "effektive Motormomentenbegrenzung, PT1" SWORD FORMULA_0009 0 0 -100.0000 1000.0000 ECU_ADDRESS 0x3FC042 /end MEASUREMENT
/begin MEASUREMENT md_kus_begr "effektive Motormomentenbegrenzung" SWORD FORMULA_0009 0 0 -100.0000 1000.0000 ECU_ADDRESS 0x3FC044 /end MEASUREMENT
/begin MEASUREMENT md_kus_st_freigabe_alt "Status Kupplungsschlupf-Funktion" UBYTE FORMULA_0033 0 0 0.0 255.0000 ECU_ADDRESS 0x3FC046 /end MEASUREMENT
/begin MEASUREMENT md_kus_st_freigabe_alt_enable "Status Kupplungsschlupf-Funktion Enable" UBYTE FORMULA_0736 0 0 0.0 255.0 ECU_ADDRESS 0x3FC046 BIT_MASK 0x1 /end MEASUREMENT
/* ------------------ Abschnitt erzeugt aus tka.dat ------------------ */
/begin CHARACTERISTIC K_TKA_DIAG_MIN "Unter Grenze Kuehlwasseraustrittstemperatur" VALUE 0x796F0 TKW_VV_VV_SW 100.0 FORMULA_0987 -50.0000 170.0000 FORMAT "%6.3" /end CHARACTERISTIC
/begin CHARACTERISTIC K_TKA_DIAG_MAX "Obere Grenze Kuehlwasseraustrittstemperatur" VALUE 0x796F2 TKW_VV_VV_SW 100.0 FORMULA_0987 -50.0000 170.0000 FORMAT "%6.3" /end CHARACTERISTIC
/begin CHARACTERISTIC K_TKA_TAU "Filterkonstante fuer die Kuehlwasseraustrittstemperatur" VALUE 0x796F4 TKW_VV_VV_UB 100.0 FORMULA_0679 0.1004 25.6000 /end CHARACTERISTIC
/begin CHARACTERISTIC K_TKA_OBD_DELTA_HIGH "Maximale Ueberhoehung von tka gegenueber tmot" VALUE 0x796F6 TKW_VV_VV_SW 100.0 FORMULA_0076 -1000.0000 1000.0000 FORMAT "%4.1" /end CHARACTERISTIC
/begin CHARACTERISTIC K_TKA_OBD_DELTA_NORM "Erwartete Temperaturerhoehung von tka" VALUE 0x796F8 TKW_VV_VV_SW 100.0 FORMULA_0076 -1000.0000 1000.0000 FORMAT "%4.1" /end CHARACTERISTIC
/begin CHARACTERISTIC K_TKA_OBD_TMOT_MIN "Temperaturschwelle fuer TKA-Diagnose" VALUE 0x796FA TKW_VV_VV_SW 100.0 FORMULA_0023 -50.0000 170.0000 FORMAT "%4.1" /end CHARACTERISTIC
/begin CHARACTERISTIC KL_TKA_NTC "Kennlinie Kuehleraustrittstemperatur" CURVE 0x796FC TKL_SW_VV_SW 100.0 FORMULA_0987 -50.0000 170.0000 /begin AXIS_DESCR STD_AXIS tka_ad FORMULA_0123 8 0.0 1023.0000 /end AXIS_DESCR FORMAT "%6.3" /end CHARACTERISTIC
/begin CHARACTERISTIC KL_TKA_OBD_TMOT_T "Kennlinie Diagnosezeit" CURVE 0x7971E TKL_SW_VV_UW 100.0 FORMULA_0073 0.0 6553.5000
 /begin AXIS_DESCR STD_AXIS tka FORMULA_0023 8 -50.0000 170.0000 FORMAT "%4.1" /end AXIS_DESCR
 FORMAT "%4.1" /end CHARACTERISTIC
/begin MEASUREMENT tka_ad "Eingelesener Spannungswert fuer Kuehlwasseraustrittstemperatur" SWORD FORMULA_0123 0 0 0.0 1023.0000 ECU_ADDRESS 0x3FC400 /end MEASUREMENT
/begin MEASUREMENT tka_roh "Ungefilterter Messwert der Kuehlwasseraustrittstemperatur" SWORD FORMULA_0987 0 0 -50.0000 170.0000 ECU_ADDRESS 0x3FC402 /end MEASUREMENT
/begin MEASUREMENT tka_filter "Gefilterter Messwert der Kuehlwasseraustrittstemperatur" SWORD FORMULA_0987 0 0 -50.0000 170.0000 ECU_ADDRESS 0x3FC404 /end MEASUREMENT
/begin MEASUREMENT tka_obd_tmot_t "" UWORD FORMULA_0073 0 0 0.0 6553.5000 ECU_ADDRESS 0x3FC406 /end MEASUREMENT
/begin MEASUREMENT tka_obd_st "" UWORD FORMULA_1003 0 0 0.0 65535.0 ECU_ADDRESS 0x3FC408 /end MEASUREMENT
/* ------------------ Abschnitt erzeugt aus vr.dat ------------------ */
/begin CHARACTERISTIC K_VR_REG_CFG "Schalter Freigabe Verstaerkungsregelung." VALUE 0x7A330 TKW_VV_VV_UB 100.0 FORMULA_0574 0.0 1.0 /end CHARACTERISTIC
/begin CHARACTERISTIC K_VR_ED_GAIN "Sollaussteuerung im Fehlerfall." VALUE 0x7A332 TKW_VV_VV_SW 100.0 FORMULA_0449 0.0 16.0000 FORMAT "%5.2" /end CHARACTERISTIC
/begin CHARACTERISTIC K_VR_SOLL "Sollaussteuerung. | EN: Target signal level" VALUE 0x7A334 TKW_VV_VV_SW 100.0 FORMULA_0578 -800.1953 800.1709 FORMAT "%5.2" /end CHARACTERISTIC
/begin CHARACTERISTIC K_VR_PROP_GAIN "Proportionalreglerverstaerkung." VALUE 0x7A336 TKW_VV_VV_SW 100.0 FORMULA_1057 0.0 4.0000 FORMAT "%7.4" /end CHARACTERISTIC
/begin CHARACTERISTIC K_VR_INT_GAIN "Integralreglerverstaerkung." VALUE 0x7A338 TKW_VV_VV_SW 100.0 FORMULA_1057 0.0 4.0000 FORMAT "%7.4" /end CHARACTERISTIC
/begin CHARACTERISTIC K_VR_INI "Initialwert aller Messverstaerkungen." VALUE 0x7A33A TKW_VV_VV_SW 100.0 FORMULA_0449 0.0 16.0000 FORMAT "%5.2" /end CHARACTERISTIC
/begin CHARACTERISTIC K_VR_VORST_MIN "Minimale Verstaerkung der Vorsteuerung. | EN: Minimum gain of the pre-control" VALUE 0x7A33C TKW_VV_VV_SW 100.0 FORMULA_0449 0.0 16.0000 FORMAT "%5.2" /end CHARACTERISTIC
/begin CHARACTERISTIC K_VR_VORST_MAX "Maximale Verstaerkung der Vorsteuerung. | EN: Maximum gain of the pre-control" VALUE 0x7A33E TKW_VV_VV_SW 100.0 FORMULA_0449 0.0 16.0000 FORMAT "%5.2" /end CHARACTERISTIC
/begin CHARACTERISTIC K_VR_REG_MIN_SAT "Minimale Verstaerkung des Reglers." VALUE 0x7A340 TKW_VV_VV_SW 100.0 FORMULA_0449 -16.0000 16.0000 FORMAT "%5.2" /end CHARACTERISTIC
/begin CHARACTERISTIC K_VR_REG_MAX_SAT "Maximale Verstaerkung des Reglers." VALUE 0x7A342 TKW_VV_VV_SW 100.0 FORMULA_0449 -16.0000 16.0000 FORMAT "%5.2" /end CHARACTERISTIC
/begin CHARACTERISTIC K_VR_REG_MIN_IC "Minimale Verstaerkung des Reglers." VALUE 0x7A344 TKW_VV_VV_SW 100.0 FORMULA_0449 -16.0000 16.0000 FORMAT "%5.2" /end CHARACTERISTIC
/begin CHARACTERISTIC K_VR_REG_MAX_IC "Maximale Verstaerkung des Reglers." VALUE 0x7A346 TKW_VV_VV_SW 100.0 FORMULA_0449 -16.0000 16.0000 FORMAT "%5.2" /end CHARACTERISTIC
/begin CHARACTERISTIC K_VR_MESS_MIN_SAT "Minimale Messverstaerkung." VALUE 0x7A348 TKW_VV_VV_SW 100.0 FORMULA_0449 0.0 16.0000 FORMAT "%5.2" /end CHARACTERISTIC
/begin CHARACTERISTIC K_VR_MESS_MAX_SAT "Maximale Messverstaerkung." VALUE 0x7A34A TKW_VV_VV_SW 100.0 FORMULA_0449 0.0 16.0000 FORMAT "%5.2" /end CHARACTERISTIC
/begin CHARACTERISTIC K_VR_MESS_MIN_IC "Minimale Messverstaerkung." VALUE 0x7A34C TKW_VV_VV_SW 100.0 FORMULA_0449 0.0 16.0000 FORMAT "%5.2" /end CHARACTERISTIC
/begin CHARACTERISTIC K_VR_MESS_MAX_IC "Maximale Messverstaerkung." VALUE 0x7A34E TKW_VV_VV_SW 100.0 FORMULA_0449 0.0 16.0000 FORMAT "%5.2" /end CHARACTERISTIC
/begin CHARACTERISTIC K_VR_SAT_0 "Verstaerkungsstufen Ionensatellit." VALUE 0x7A350 TKW_VV_VV_SW 100.0 FORMULA_0449 0.0 16.0000 FORMAT "%5.2" /end CHARACTERISTIC
/begin CHARACTERISTIC K_VR_SAT_1 "Verstaerkungsstufen Ionensatellit." VALUE 0x7A352 TKW_VV_VV_SW 100.0 FORMULA_0449 0.0 16.0000 FORMAT "%5.2" /end CHARACTERISTIC
/begin CHARACTERISTIC K_VR_SAT_2 "Verstaerkungsstufen Ionensatellit." VALUE 0x7A354 TKW_VV_VV_SW 100.0 FORMULA_0449 0.0 16.0000 FORMAT "%5.2" /end CHARACTERISTIC
/begin CHARACTERISTIC K_VR_SAT_3 "Verstaerkungsstufen Ionensatellit." VALUE 0x7A356 TKW_VV_VV_SW 100.0 FORMULA_0449 0.0 16.0000 FORMAT "%5.2" /end CHARACTERISTIC
/begin CHARACTERISTIC K_VR_IC_0 "Verstaerkungsstufen integrierte Spulen." VALUE 0x7A358 TKW_VV_VV_SW 100.0 FORMULA_0449 0.0 16.0000 FORMAT "%5.2" /end CHARACTERISTIC
/begin CHARACTERISTIC K_VR_IC_1 "Verstaerkungsstufen integrierte Spulen." VALUE 0x7A35A TKW_VV_VV_SW 100.0 FORMULA_0449 0.0 16.0000 FORMAT "%5.2" /end CHARACTERISTIC
/begin CHARACTERISTIC K_VR_IC_2 "Verstaerkungsstufen integrierte Spulen." VALUE 0x7A35C TKW_VV_VV_SW 100.0 FORMULA_0449 0.0 16.0000 FORMAT "%5.2" /end CHARACTERISTIC
/begin CHARACTERISTIC K_VR_IC_3 "Verstaerkungsstufen integrierte Spulen." VALUE 0x7A35E TKW_VV_VV_SW 100.0 FORMULA_0449 0.0 16.0000 FORMAT "%5.2" /end CHARACTERISTIC
/begin CHARACTERISTIC K_VR_IC_4 "Verstaerkungsstufen integrierte Spulen." VALUE 0x7A360 TKW_VV_VV_SW 100.0 FORMULA_0449 0.0 16.0000 FORMAT "%5.2" /end CHARACTERISTIC
/begin CHARACTERISTIC K_VR_IC_5 "Verstaerkungsstufen integrierte Spulen." VALUE 0x7A362 TKW_VV_VV_SW 100.0 FORMULA_0449 0.0 16.0000 FORMAT "%5.2" /end CHARACTERISTIC
/begin CHARACTERISTIC K_VR_IC_6 "Verstaerkungsstufen integrierte Spulen." VALUE 0x7A364 TKW_VV_VV_SW 100.0 FORMULA_0449 0.0 16.0000 FORMAT "%5.2" /end CHARACTERISTIC
/begin CHARACTERISTIC K_VR_IC_7 "Verstaerkungsstufen integrierte Spulen." VALUE 0x7A366 TKW_VV_VV_SW 100.0 FORMULA_0449 0.0 16.0000 FORMAT "%5.2" /end CHARACTERISTIC
/begin CHARACTERISTIC K_VR_IC_8 "Verstaerkungsstufen integrierte Spulen." VALUE 0x7A368 TKW_VV_VV_SW 100.0 FORMULA_0449 0.0 16.0000 FORMAT "%5.2" /end CHARACTERISTIC
/begin CHARACTERISTIC K_VR_LP_COEF_1of20_ "Tief-Pass Filter zur Maximalwertbestimmung." VALUE 0x7A36C TKW_VV_VV_SF 100.0 FORMULA_0579 -340282346638528860000000000000000000000.0000 340282346638528860000000000000000000000.0000 FORMAT "%7.4" /end CHARACTERISTIC
/begin CHARACTERISTIC K_VR_LP_COEF_2of20_ "Tief-Pass Filter zur Maximalwertbestimmung." VALUE 0x7A370 TKW_VV_VV_SF 100.0 FORMULA_0579 -340282346638528860000000000000000000000.0000 340282346638528860000000000000000000000.0000 FORMAT "%7.4" /end CHARACTERISTIC
/begin CHARACTERISTIC K_VR_LP_COEF_3of20_ "Tief-Pass Filter zur Maximalwertbestimmung." VALUE 0x7A374 TKW_VV_VV_SF 100.0 FORMULA_0579 -340282346638528860000000000000000000000.0000 340282346638528860000000000000000000000.0000 FORMAT "%7.4" /end CHARACTERISTIC
/begin CHARACTERISTIC K_VR_LP_COEF_4of20_ "Tief-Pass Filter zur Maximalwertbestimmung." VALUE 0x7A378 TKW_VV_VV_SF 100.0 FORMULA_0579 -340282346638528860000000000000000000000.0000 340282346638528860000000000000000000000.0000 FORMAT "%7.4" /end CHARACTERISTIC
/begin CHARACTERISTIC K_VR_LP_COEF_5of20_ "Tief-Pass Filter zur Maximalwertbestimmung." VALUE 0x7A37C TKW_VV_VV_SF 100.0 FORMULA_0579 -340282346638528860000000000000000000000.0000 340282346638528860000000000000000000000.0000 FORMAT "%7.4" /end CHARACTERISTIC
/begin CHARACTERISTIC K_VR_LP_COEF_6of20_ "Tief-Pass Filter zur Maximalwertbestimmung." VALUE 0x7A380 TKW_VV_VV_SF 100.0 FORMULA_0579 -340282346638528860000000000000000000000.0000 340282346638528860000000000000000000000.0000 FORMAT "%7.4" /end CHARACTERISTIC
/begin CHARACTERISTIC K_VR_LP_COEF_7of20_ "Tief-Pass Filter zur Maximalwertbestimmung." VALUE 0x7A384 TKW_VV_VV_SF 100.0 FORMULA_0579 -340282346638528860000000000000000000000.0000 340282346638528860000000000000000000000.0000 FORMAT "%7.4" /end CHARACTERISTIC
/begin CHARACTERISTIC K_VR_LP_COEF_8of20_ "Tief-Pass Filter zur Maximalwertbestimmung." VALUE 0x7A388 TKW_VV_VV_SF 100.0 FORMULA_0579 -340282346638528860000000000000000000000.0000 340282346638528860000000000000000000000.0000 FORMAT "%7.4" /end CHARACTERISTIC
/begin CHARACTERISTIC K_VR_LP_COEF_9of20_ "Tief-Pass Filter zur Maximalwertbestimmung." VALUE 0x7A38C TKW_VV_VV_SF 100.0 FORMULA_0579 -340282346638528860000000000000000000000.0000 340282346638528860000000000000000000000.0000 FORMAT "%7.4" /end CHARACTERISTIC
/begin CHARACTERISTIC K_VR_LP_COEF_10of20_ "Tief-Pass Filter zur Maximalwertbestimmung." VALUE 0x7A390 TKW_VV_VV_SF 100.0 FORMULA_0579 -340282346638528860000000000000000000000.0000 340282346638528860000000000000000000000.0000 FORMAT "%7.4" /end CHARACTERISTIC
/begin CHARACTERISTIC K_VR_LP_COEF_11of20_ "Tief-Pass Filter zur Maximalwertbestimmung." VALUE 0x7A394 TKW_VV_VV_SF 100.0 FORMULA_0579 -340282346638528860000000000000000000000.0000 340282346638528860000000000000000000000.0000 FORMAT "%7.4" /end CHARACTERISTIC
/begin CHARACTERISTIC K_VR_LP_COEF_12of20_ "Tief-Pass Filter zur Maximalwertbestimmung." VALUE 0x7A398 TKW_VV_VV_SF 100.0 FORMULA_0579 -340282346638528860000000000000000000000.0000 340282346638528860000000000000000000000.0000 FORMAT "%7.4" /end CHARACTERISTIC
/begin CHARACTERISTIC K_VR_LP_COEF_13of20_ "Tief-Pass Filter zur Maximalwertbestimmung." VALUE 0x7A39C TKW_VV_VV_SF 100.0 FORMULA_0579 -340282346638528860000000000000000000000.0000 340282346638528860000000000000000000000.0000 FORMAT "%7.4" /end CHARACTERISTIC
/begin CHARACTERISTIC K_VR_LP_COEF_14of20_ "Tief-Pass Filter zur Maximalwertbestimmung." VALUE 0x7A3A0 TKW_VV_VV_SF 100.0 FORMULA_0579 -340282346638528860000000000000000000000.0000 340282346638528860000000000000000000000.0000 FORMAT "%7.4" /end CHARACTERISTIC
/begin CHARACTERISTIC K_VR_LP_COEF_15of20_ "Tief-Pass Filter zur Maximalwertbestimmung." VALUE 0x7A3A4 TKW_VV_VV_SF 100.0 FORMULA_0579 -340282346638528860000000000000000000000.0000 340282346638528860000000000000000000000.0000 FORMAT "%7.4" /end CHARACTERISTIC
/begin CHARACTERISTIC K_VR_LP_COEF_16of20_ "Tief-Pass Filter zur Maximalwertbestimmung." VALUE 0x7A3A8 TKW_VV_VV_SF 100.0 FORMULA_0579 -340282346638528860000000000000000000000.0000 340282346638528860000000000000000000000.0000 FORMAT "%7.4" /end CHARACTERISTIC
/begin CHARACTERISTIC K_VR_LP_COEF_17of20_ "Tief-Pass Filter zur Maximalwertbestimmung." VALUE 0x7A3AC TKW_VV_VV_SF 100.0 FORMULA_0579 -340282346638528860000000000000000000000.0000 340282346638528860000000000000000000000.0000 FORMAT "%7.4" /end CHARACTERISTIC
/begin CHARACTERISTIC K_VR_LP_COEF_18of20_ "Tief-Pass Filter zur Maximalwertbestimmung." VALUE 0x7A3B0 TKW_VV_VV_SF 100.0 FORMULA_0579 -340282346638528860000000000000000000000.0000 340282346638528860000000000000000000000.0000 FORMAT "%7.4" /end CHARACTERISTIC
/begin CHARACTERISTIC K_VR_LP_COEF_19of20_ "Tief-Pass Filter zur Maximalwertbestimmung." VALUE 0x7A3B4 TKW_VV_VV_SF 100.0 FORMULA_0579 -340282346638528860000000000000000000000.0000 340282346638528860000000000000000000000.0000 FORMAT "%7.4" /end CHARACTERISTIC
/begin CHARACTERISTIC K_VR_LP_COEF_20of20_ "Tief-Pass Filter zur Maximalwertbestimmung." VALUE 0x7A3B8 TKW_VV_VV_SF 100.0 FORMULA_0579 -340282346638528860000000000000000000000.0000 340282346638528860000000000000000000000.0000 FORMAT "%7.4" /end CHARACTERISTIC
/begin CHARACTERISTIC K_VR_TEST_SEND_ENABLE "Sender-Freigabe | EN: Test function enable" VALUE 0x7A3BC TKW_VV_VV_UB 100.0 FORMULA_1058 0.0 255.0 /end CHARACTERISTIC
/begin CHARACTERISTIC K_VR_TEST_V_MESS "Verstaerkungsstufe Test. | EN: Test gain stage" VALUE 0x7A3BD TKW_VV_VV_UB 100.0 FORMULA_0003 0.0 7.0000 /end CHARACTERISTIC
/begin CHARACTERISTIC K_VR_TEST_U_MESS "Spannungs-Umschaltung Test. | EN: Test voltage selection" VALUE 0x7A3BE TKW_VV_VV_UB 100.0 FORMULA_1059 0.0 255.0 /end CHARACTERISTIC
/begin CHARACTERISTIC K_VR_TEST_I_SOFT_OFF "Stromschwelle SoftOff Test." VALUE 0x7A3BF TKW_VV_VV_UB 100.0 FORMULA_1060 0.0 255.0 /end CHARACTERISTIC
/begin CHARACTERISTIC KL_VR_VORST_DTZ "Korrekturfaktor ueber Rueckziehwinkel. | EN: Correction factor over retraction angle" CURVE 0x7A3C0 TKL_SW_VV_SW 100.0 FORMULA_0449 0.0 16.0000 /begin AXIS_DESCR STD_AXIS tz FORMULA_0111 8 -50.0000 60.0000 FORMAT "%4.1" /end AXIS_DESCR FORMAT "%5.2" /end CHARACTERISTIC
/begin CHARACTERISTIC GKF_VR_VORST_BAS "Basisvorsteuereung der Erfassungstufe. | EN: Base pre-control of the measuring stage (ion current)" MAP 0x7A3E2 TGF_VV_VV_SW 16.0 FORMULA_0449 0.0 16.0000 FORMAT "%5.2"
 /begin AXIS_DESCR COM_AXIS n FORMULA_0006 16 0.0 10000.0000 AXIS_PTS_REF AXIS_N16 /end AXIS_DESCR
 /begin AXIS_DESCR COM_AXIS rf_m FORMULA_0007 10 0.0 2.0000 AXIS_PTS_REF AXIS_RF10 /end AXIS_DESCR
/end CHARACTERISTIC
/begin MEASUREMENT vr_st "Zustandsvariable Verstaerkungsregeler." UWORD FORMULA_1046 0 0 0.0 1023.0 ECU_ADDRESS 0x3FC618 /end MEASUREMENT
/begin MEASUREMENT vr_st_zyl1 "Verstaerkungsregeler Zylinder 1." UWORD FORMULA_1047 0 0 0.0 1.0 ECU_ADDRESS 0x3FC618 BIT_MASK 0x1 /end MEASUREMENT
/begin MEASUREMENT vr_st_zyl2 "Verstaerkungsregeler Zylinder 2." UWORD FORMULA_1048 0 0 0.0 1.0 ECU_ADDRESS 0x3FC618 BIT_MASK 0x2 /end MEASUREMENT
/begin MEASUREMENT vr_st_zyl3 "Verstaerkungsregeler Zylinder 3." UWORD FORMULA_1049 0 0 0.0 1.0 ECU_ADDRESS 0x3FC618 BIT_MASK 0x4 /end MEASUREMENT
/begin MEASUREMENT vr_st_zyl4 "Verstaerkungsregeler Zylinder 4." UWORD FORMULA_1050 0 0 0.0 1.0 ECU_ADDRESS 0x3FC618 BIT_MASK 0x8 /end MEASUREMENT
/begin MEASUREMENT vr_st_zyl5 "Verstaerkungsregeler Zylinder 5." UWORD FORMULA_1051 0 0 0.0 1.0 ECU_ADDRESS 0x3FC618 BIT_MASK 0x10 /end MEASUREMENT
/begin MEASUREMENT vr_st_zyl6 "Verstaerkungsregeler Zylinder 6." UWORD FORMULA_1052 0 0 0.0 1.0 ECU_ADDRESS 0x3FC618 BIT_MASK 0x20 /end MEASUREMENT
/begin MEASUREMENT vr_st_zyl7 "Verstaerkungsregeler Zylinder 7." UWORD FORMULA_1053 0 0 0.0 1.0 ECU_ADDRESS 0x3FC618 BIT_MASK 0x40 /end MEASUREMENT
/begin MEASUREMENT vr_st_zyl8 "Verstaerkungsregeler Zylinder 8." UWORD FORMULA_1054 0 0 0.0 1.0 ECU_ADDRESS 0x3FC618 BIT_MASK 0x80 /end MEASUREMENT
/begin MEASUREMENT vr_st_zyl9 "Verstaerkungsregeler Zylinder 9." UWORD FORMULA_1055 0 0 0.0 1.0 ECU_ADDRESS 0x3FC618 BIT_MASK 0x100 /end MEASUREMENT
/begin MEASUREMENT vr_st_zyl10 "Verstaerkungsregeler Zylinder 10." UWORD FORMULA_1056 0 0 0.0 1.0 ECU_ADDRESS 0x3FC618 BIT_MASK 0x200 /end MEASUREMENT
/begin MEASUREMENT vr_vorst_bas_b1 "Basisvorsteuereung der Erfassungstufe." SWORD FORMULA_0449 0 0 0.0 16.0000 ECU_ADDRESS 0x3FC61A /end MEASUREMENT
/begin MEASUREMENT vr_vorst_bas_b2 "Basisvorsteuereung der Erfassungstufe." SWORD FORMULA_0449 0 0 0.0 16.0000 ECU_ADDRESS 0x3FC61C /end MEASUREMENT
/begin MEASUREMENT vr_vorst_offs_zyl1 "Offsetvorsteuerung der Erfassungstufe." SWORD FORMULA_0449 0 0 0.0 16.0000 ECU_ADDRESS 0x3FC61E /end MEASUREMENT
/begin MEASUREMENT vr_vorst_offs_zyl2 "Offsetvorsteuerung der Erfassungstufe." SWORD FORMULA_0449 0 0 0.0 16.0000 ECU_ADDRESS 0x3FC620 /end MEASUREMENT
/begin MEASUREMENT vr_vorst_offs_zyl3 "Offsetvorsteuerung der Erfassungstufe." SWORD FORMULA_0449 0 0 0.0 16.0000 ECU_ADDRESS 0x3FC622 /end MEASUREMENT
/begin MEASUREMENT vr_vorst_offs_zyl4 "Offsetvorsteuerung der Erfassungstufe." SWORD FORMULA_0449 0 0 0.0 16.0000 ECU_ADDRESS 0x3FC624 /end MEASUREMENT
/begin MEASUREMENT vr_vorst_offs_zyl5 "Offsetvorsteuerung der Erfassungstufe." SWORD FORMULA_0449 0 0 0.0 16.0000 ECU_ADDRESS 0x3FC626 /end MEASUREMENT
/begin MEASUREMENT vr_vorst_offs_zyl6 "Offsetvorsteuerung der Erfassungstufe." SWORD FORMULA_0449 0 0 0.0 16.0000 ECU_ADDRESS 0x3FC628 /end MEASUREMENT
/begin MEASUREMENT vr_vorst_offs_zyl7 "Offsetvorsteuerung der Erfassungstufe." SWORD FORMULA_0449 0 0 0.0 16.0000 ECU_ADDRESS 0x3FC62A /end MEASUREMENT
/begin MEASUREMENT vr_vorst_offs_zyl8 "Offsetvorsteuerung der Erfassungstufe." SWORD FORMULA_0449 0 0 0.0 16.0000 ECU_ADDRESS 0x3FC62C /end MEASUREMENT
/begin MEASUREMENT vr_vorst_offs_zyl9 "Offsetvorsteuerung der Erfassungstufe." SWORD FORMULA_0449 0 0 0.0 16.0000 ECU_ADDRESS 0x3FC62E /end MEASUREMENT
/begin MEASUREMENT vr_vorst_offs_zyl10 "Offsetvorsteuerung der Erfassungstufe." SWORD FORMULA_0449 0 0 0.0 16.0000 ECU_ADDRESS 0x3FC630 /end MEASUREMENT
/begin MEASUREMENT vr_vorst_zyl1 "Vorsteuerung der Erfassungstufe." SWORD FORMULA_0449 0 0 0.0 16.0000 ECU_ADDRESS 0x3FC632 /end MEASUREMENT
/begin MEASUREMENT vr_vorst_zyl2 "Vorsteuerung der Erfassungstufe." SWORD FORMULA_0449 0 0 0.0 16.0000 ECU_ADDRESS 0x3FC634 /end MEASUREMENT
/begin MEASUREMENT vr_vorst_zyl3 "Vorsteuerung der Erfassungstufe." SWORD FORMULA_0449 0 0 0.0 16.0000 ECU_ADDRESS 0x3FC636 /end MEASUREMENT
/begin MEASUREMENT vr_vorst_zyl4 "Vorsteuerung der Erfassungstufe." SWORD FORMULA_0449 0 0 0.0 16.0000 ECU_ADDRESS 0x3FC638 /end MEASUREMENT
/begin MEASUREMENT vr_vorst_zyl5 "Vorsteuerung der Erfassungstufe." SWORD FORMULA_0449 0 0 0.0 16.0000 ECU_ADDRESS 0x3FC63A /end MEASUREMENT
/begin MEASUREMENT vr_vorst_zyl6 "Vorsteuerung der Erfassungstufe." SWORD FORMULA_0449 0 0 0.0 16.0000 ECU_ADDRESS 0x3FC63C /end MEASUREMENT
/begin MEASUREMENT vr_vorst_zyl7 "Vorsteuerung der Erfassungstufe." SWORD FORMULA_0449 0 0 0.0 16.0000 ECU_ADDRESS 0x3FC63E /end MEASUREMENT
/begin MEASUREMENT vr_vorst_zyl8 "Vorsteuerung der Erfassungstufe." SWORD FORMULA_0449 0 0 0.0 16.0000 ECU_ADDRESS 0x3FC640 /end MEASUREMENT
/begin MEASUREMENT vr_vorst_zyl9 "Vorsteuerung der Erfassungstufe." SWORD FORMULA_0449 0 0 0.0 16.0000 ECU_ADDRESS 0x3FC642 /end MEASUREMENT
/begin MEASUREMENT vr_vorst_zyl10 "Vorsteuerung der Erfassungstufe." SWORD FORMULA_0449 0 0 0.0 16.0000 ECU_ADDRESS 0x3FC644 /end MEASUREMENT
/begin MEASUREMENT vr_soll_ist_zyl1 "Ist-Aussteuerung." SWORD FORMULA_0578 0 0 -800.1953 800.1709 ECU_ADDRESS 0x3FC646 /end MEASUREMENT
/begin MEASUREMENT vr_soll_ist_zyl2 "Ist-Aussteuerung." SWORD FORMULA_0578 0 0 -800.1953 800.1709 ECU_ADDRESS 0x3FC648 /end MEASUREMENT
/begin MEASUREMENT vr_soll_ist_zyl3 "Ist-Aussteuerung." SWORD FORMULA_0578 0 0 -800.1953 800.1709 ECU_ADDRESS 0x3FC64A /end MEASUREMENT
/begin MEASUREMENT vr_soll_ist_zyl4 "Ist-Aussteuerung." SWORD FORMULA_0578 0 0 -800.1953 800.1709 ECU_ADDRESS 0x3FC64C /end MEASUREMENT
/begin MEASUREMENT vr_soll_ist_zyl5 "Ist-Aussteuerung." SWORD FORMULA_0578 0 0 -800.1953 800.1709 ECU_ADDRESS 0x3FC64E /end MEASUREMENT
/begin MEASUREMENT vr_soll_ist_zyl6 "Ist-Aussteuerung." SWORD FORMULA_0578 0 0 -800.1953 800.1709 ECU_ADDRESS 0x3FC650 /end MEASUREMENT
/begin MEASUREMENT vr_soll_ist_zyl7 "Ist-Aussteuerung." SWORD FORMULA_0578 0 0 -800.1953 800.1709 ECU_ADDRESS 0x3FC652 /end MEASUREMENT
/begin MEASUREMENT vr_soll_ist_zyl8 "Ist-Aussteuerung." SWORD FORMULA_0578 0 0 -800.1953 800.1709 ECU_ADDRESS 0x3FC654 /end MEASUREMENT
/begin MEASUREMENT vr_soll_ist_zyl9 "Ist-Aussteuerung." SWORD FORMULA_0578 0 0 -800.1953 800.1709 ECU_ADDRESS 0x3FC656 /end MEASUREMENT
/begin MEASUREMENT vr_soll_ist_zyl10 "Ist-Aussteuerung." SWORD FORMULA_0578 0 0 -800.1953 800.1709 ECU_ADDRESS 0x3FC658 /end MEASUREMENT
/begin MEASUREMENT vr_reg_soll_zyl1 "Gewichteter Reglersolleingang." SWORD FORMULA_0449 0 0 0.0 16.0000 ECU_ADDRESS 0x3FC65A /end MEASUREMENT
/begin MEASUREMENT vr_reg_soll_zyl2 "Gewichteter Reglersolleingang." SWORD FORMULA_0449 0 0 0.0 16.0000 ECU_ADDRESS 0x3FC65C /end MEASUREMENT
/begin MEASUREMENT vr_reg_soll_zyl3 "Gewichteter Reglersolleingang." SWORD FORMULA_0449 0 0 0.0 16.0000 ECU_ADDRESS 0x3FC65E /end MEASUREMENT
/begin MEASUREMENT vr_reg_soll_zyl4 "Gewichteter Reglersolleingang." SWORD FORMULA_0449 0 0 0.0 16.0000 ECU_ADDRESS 0x3FC660 /end MEASUREMENT
/begin MEASUREMENT vr_reg_soll_zyl5 "Gewichteter Reglersolleingang." SWORD FORMULA_0449 0 0 0.0 16.0000 ECU_ADDRESS 0x3FC662 /end MEASUREMENT
/begin MEASUREMENT vr_reg_soll_zyl6 "Gewichteter Reglersolleingang." SWORD FORMULA_0449 0 0 0.0 16.0000 ECU_ADDRESS 0x3FC664 /end MEASUREMENT
/begin MEASUREMENT vr_reg_soll_zyl7 "Gewichteter Reglersolleingang." SWORD FORMULA_0449 0 0 0.0 16.0000 ECU_ADDRESS 0x3FC666 /end MEASUREMENT
/begin MEASUREMENT vr_reg_soll_zyl8 "Gewichteter Reglersolleingang." SWORD FORMULA_0449 0 0 0.0 16.0000 ECU_ADDRESS 0x3FC668 /end MEASUREMENT
/begin MEASUREMENT vr_reg_soll_zyl9 "Gewichteter Reglersolleingang." SWORD FORMULA_0449 0 0 0.0 16.0000 ECU_ADDRESS 0x3FC66A /end MEASUREMENT
/begin MEASUREMENT vr_reg_soll_zyl10 "Gewichteter Reglersolleingang." SWORD FORMULA_0449 0 0 0.0 16.0000 ECU_ADDRESS 0x3FC66C /end MEASUREMENT
/begin MEASUREMENT vr_reg_ist_zyl1 "Gewichteter Regleristeingang." SWORD FORMULA_0449 0 0 0.0 16.0000 ECU_ADDRESS 0x3FC66E /end MEASUREMENT
/begin MEASUREMENT vr_reg_ist_zyl2 "Gewichteter Regleristeingang." SWORD FORMULA_0449 0 0 0.0 16.0000 ECU_ADDRESS 0x3FC670 /end MEASUREMENT
/begin MEASUREMENT vr_reg_ist_zyl3 "Gewichteter Regleristeingang." SWORD FORMULA_0449 0 0 0.0 16.0000 ECU_ADDRESS 0x3FC672 /end MEASUREMENT
/begin MEASUREMENT vr_reg_ist_zyl4 "Gewichteter Regleristeingang." SWORD FORMULA_0449 0 0 0.0 16.0000 ECU_ADDRESS 0x3FC674 /end MEASUREMENT
/begin MEASUREMENT vr_reg_ist_zyl5 "Gewichteter Regleristeingang." SWORD FORMULA_0449 0 0 0.0 16.0000 ECU_ADDRESS 0x3FC676 /end MEASUREMENT
/begin MEASUREMENT vr_reg_ist_zyl6 "Gewichteter Regleristeingang." SWORD FORMULA_0449 0 0 0.0 16.0000 ECU_ADDRESS 0x3FC678 /end MEASUREMENT
/begin MEASUREMENT vr_reg_ist_zyl7 "Gewichteter Regleristeingang." SWORD FORMULA_0449 0 0 0.0 16.0000 ECU_ADDRESS 0x3FC67A /end MEASUREMENT
/begin MEASUREMENT vr_reg_ist_zyl8 "Gewichteter Regleristeingang." SWORD FORMULA_0449 0 0 0.0 16.0000 ECU_ADDRESS 0x3FC67C /end MEASUREMENT
/begin MEASUREMENT vr_reg_ist_zyl9 "Gewichteter Regleristeingang." SWORD FORMULA_0449 0 0 0.0 16.0000 ECU_ADDRESS 0x3FC67E /end MEASUREMENT
/begin MEASUREMENT vr_reg_ist_zyl10 "Gewichteter Regleristeingang." SWORD FORMULA_0449 0 0 0.0 16.0000 ECU_ADDRESS 0x3FC680 /end MEASUREMENT
/begin MEASUREMENT vr_reg_err_zyl1 "Regelfehler." SWORD FORMULA_0449 0 0 0.0 16.0000 ECU_ADDRESS 0x3FC682 /end MEASUREMENT
/begin MEASUREMENT vr_reg_err_zyl2 "Regelfehler." SWORD FORMULA_0449 0 0 0.0 16.0000 ECU_ADDRESS 0x3FC684 /end MEASUREMENT
/begin MEASUREMENT vr_reg_err_zyl3 "Regelfehler." SWORD FORMULA_0449 0 0 0.0 16.0000 ECU_ADDRESS 0x3FC686 /end MEASUREMENT
/begin MEASUREMENT vr_reg_err_zyl4 "Regelfehler." SWORD FORMULA_0449 0 0 0.0 16.0000 ECU_ADDRESS 0x3FC688 /end MEASUREMENT
/begin MEASUREMENT vr_reg_err_zyl5 "Regelfehler." SWORD FORMULA_0449 0 0 0.0 16.0000 ECU_ADDRESS 0x3FC68A /end MEASUREMENT
/begin MEASUREMENT vr_reg_err_zyl6 "Regelfehler." SWORD FORMULA_0449 0 0 0.0 16.0000 ECU_ADDRESS 0x3FC68C /end MEASUREMENT
/begin MEASUREMENT vr_reg_err_zyl7 "Regelfehler." SWORD FORMULA_0449 0 0 0.0 16.0000 ECU_ADDRESS 0x3FC68E /end MEASUREMENT
/begin MEASUREMENT vr_reg_err_zyl8 "Regelfehler." SWORD FORMULA_0449 0 0 0.0 16.0000 ECU_ADDRESS 0x3FC690 /end MEASUREMENT
/begin MEASUREMENT vr_reg_err_zyl9 "Regelfehler." SWORD FORMULA_0449 0 0 0.0 16.0000 ECU_ADDRESS 0x3FC692 /end MEASUREMENT
/begin MEASUREMENT vr_reg_err_zyl10 "Regelfehler." SWORD FORMULA_0449 0 0 0.0 16.0000 ECU_ADDRESS 0x3FC694 /end MEASUREMENT
/begin MEASUREMENT vr_reg_prop_zyl1 "Proportionaler Regleranteil." SWORD FORMULA_0449 0 0 0.0 16.0000 ECU_ADDRESS 0x3FC696 /end MEASUREMENT
/begin MEASUREMENT vr_reg_prop_zyl2 "Proportionaler Regleranteil." SWORD FORMULA_0449 0 0 0.0 16.0000 ECU_ADDRESS 0x3FC698 /end MEASUREMENT
/begin MEASUREMENT vr_reg_prop_zyl3 "Proportionaler Regleranteil." SWORD FORMULA_0449 0 0 0.0 16.0000 ECU_ADDRESS 0x3FC69A /end MEASUREMENT
/begin MEASUREMENT vr_reg_prop_zyl4 "Proportionaler Regleranteil." SWORD FORMULA_0449 0 0 0.0 16.0000 ECU_ADDRESS 0x3FC69C /end MEASUREMENT
/begin MEASUREMENT vr_reg_prop_zyl5 "Proportionaler Regleranteil." SWORD FORMULA_0449 0 0 0.0 16.0000 ECU_ADDRESS 0x3FC69E /end MEASUREMENT
/begin MEASUREMENT vr_reg_prop_zyl6 "Proportionaler Regleranteil." SWORD FORMULA_0449 0 0 0.0 16.0000 ECU_ADDRESS 0x3FC6A0 /end MEASUREMENT
/begin MEASUREMENT vr_reg_prop_zyl7 "Proportionaler Regleranteil." SWORD FORMULA_0449 0 0 0.0 16.0000 ECU_ADDRESS 0x3FC6A2 /end MEASUREMENT
/begin MEASUREMENT vr_reg_prop_zyl8 "Proportionaler Regleranteil." SWORD FORMULA_0449 0 0 0.0 16.0000 ECU_ADDRESS 0x3FC6A4 /end MEASUREMENT
/begin MEASUREMENT vr_reg_prop_zyl9 "Proportionaler Regleranteil." SWORD FORMULA_0449 0 0 0.0 16.0000 ECU_ADDRESS 0x3FC6A6 /end MEASUREMENT
/begin MEASUREMENT vr_reg_prop_zyl10 "Proportionaler Regleranteil." SWORD FORMULA_0449 0 0 0.0 16.0000 ECU_ADDRESS 0x3FC6A8 /end MEASUREMENT
/begin MEASUREMENT vr_reg_int_zyl1 "Integraler Regleranteil." SWORD FORMULA_0449 0 0 0.0 16.0000 ECU_ADDRESS 0x3FC6AA /end MEASUREMENT
/begin MEASUREMENT vr_reg_int_zyl2 "Integraler Regleranteil." SWORD FORMULA_0449 0 0 0.0 16.0000 ECU_ADDRESS 0x3FC6AC /end MEASUREMENT
/begin MEASUREMENT vr_reg_int_zyl3 "Integraler Regleranteil." SWORD FORMULA_0449 0 0 0.0 16.0000 ECU_ADDRESS 0x3FC6AE /end MEASUREMENT
/begin MEASUREMENT vr_reg_int_zyl4 "Integraler Regleranteil." SWORD FORMULA_0449 0 0 0.0 16.0000 ECU_ADDRESS 0x3FC6B0 /end MEASUREMENT
/begin MEASUREMENT vr_reg_int_zyl5 "Integraler Regleranteil." SWORD FORMULA_0449 0 0 0.0 16.0000 ECU_ADDRESS 0x3FC6B2 /end MEASUREMENT
/begin MEASUREMENT vr_reg_int_zyl6 "Integraler Regleranteil." SWORD FORMULA_0449 0 0 0.0 16.0000 ECU_ADDRESS 0x3FC6B4 /end MEASUREMENT
/begin MEASUREMENT vr_reg_int_zyl7 "Integraler Regleranteil." SWORD FORMULA_0449 0 0 0.0 16.0000 ECU_ADDRESS 0x3FC6B6 /end MEASUREMENT
/begin MEASUREMENT vr_reg_int_zyl8 "Integraler Regleranteil." SWORD FORMULA_0449 0 0 0.0 16.0000 ECU_ADDRESS 0x3FC6B8 /end MEASUREMENT
/begin MEASUREMENT vr_reg_int_zyl9 "Integraler Regleranteil." SWORD FORMULA_0449 0 0 0.0 16.0000 ECU_ADDRESS 0x3FC6BA /end MEASUREMENT
/begin MEASUREMENT vr_reg_int_zyl10 "Integraler Regleranteil." SWORD FORMULA_0449 0 0 0.0 16.0000 ECU_ADDRESS 0x3FC6BC /end MEASUREMENT
/begin MEASUREMENT vr_reg_zyl1 "Reglerausgang." SWORD FORMULA_0449 0 0 0.0 16.0000 ECU_ADDRESS 0x3FC6BE /end MEASUREMENT
/begin MEASUREMENT vr_reg_zyl2 "Reglerausgang." SWORD FORMULA_0449 0 0 0.0 16.0000 ECU_ADDRESS 0x3FC6C0 /end MEASUREMENT
/begin MEASUREMENT vr_reg_zyl3 "Reglerausgang." SWORD FORMULA_0449 0 0 0.0 16.0000 ECU_ADDRESS 0x3FC6C2 /end MEASUREMENT
/begin MEASUREMENT vr_reg_zyl4 "Reglerausgang." SWORD FORMULA_0449 0 0 0.0 16.0000 ECU_ADDRESS 0x3FC6C4 /end MEASUREMENT
/begin MEASUREMENT vr_reg_zyl5 "Reglerausgang." SWORD FORMULA_0449 0 0 0.0 16.0000 ECU_ADDRESS 0x3FC6C6 /end MEASUREMENT
/begin MEASUREMENT vr_reg_zyl6 "Reglerausgang." SWORD FORMULA_0449 0 0 0.0 16.0000 ECU_ADDRESS 0x3FC6C8 /end MEASUREMENT
/begin MEASUREMENT vr_reg_zyl7 "Reglerausgang." SWORD FORMULA_0449 0 0 0.0 16.0000 ECU_ADDRESS 0x3FC6CA /end MEASUREMENT
/begin MEASUREMENT vr_reg_zyl8 "Reglerausgang." SWORD FORMULA_0449 0 0 0.0 16.0000 ECU_ADDRESS 0x3FC6CC /end MEASUREMENT
/begin MEASUREMENT vr_reg_zyl9 "Reglerausgang." SWORD FORMULA_0449 0 0 0.0 16.0000 ECU_ADDRESS 0x3FC6CE /end MEASUREMENT
/begin MEASUREMENT vr_reg_zyl10 "Reglerausgang." SWORD FORMULA_0449 0 0 0.0 16.0000 ECU_ADDRESS 0x3FC6D0 /end MEASUREMENT
/begin MEASUREMENT vr_mess_soll_zyl1 "Sollverstaerkung." SWORD FORMULA_0449 0 0 0.0 16.0000 ECU_ADDRESS 0x3FC6D2 /end MEASUREMENT
/begin MEASUREMENT vr_mess_soll_zyl2 "Sollverstaerkung." SWORD FORMULA_0449 0 0 0.0 16.0000 ECU_ADDRESS 0x3FC6D4 /end MEASUREMENT
/begin MEASUREMENT vr_mess_soll_zyl3 "Sollverstaerkung." SWORD FORMULA_0449 0 0 0.0 16.0000 ECU_ADDRESS 0x3FC6D6 /end MEASUREMENT
/begin MEASUREMENT vr_mess_soll_zyl4 "Sollverstaerkung." SWORD FORMULA_0449 0 0 0.0 16.0000 ECU_ADDRESS 0x3FC6D8 /end MEASUREMENT
/begin MEASUREMENT vr_mess_soll_zyl5 "Sollverstaerkung." SWORD FORMULA_0449 0 0 0.0 16.0000 ECU_ADDRESS 0x3FC6DA /end MEASUREMENT
/begin MEASUREMENT vr_mess_soll_zyl6 "Sollverstaerkung." SWORD FORMULA_0449 0 0 0.0 16.0000 ECU_ADDRESS 0x3FC6DC /end MEASUREMENT
/begin MEASUREMENT vr_mess_soll_zyl7 "Sollverstaerkung." SWORD FORMULA_0449 0 0 0.0 16.0000 ECU_ADDRESS 0x3FC6DE /end MEASUREMENT
/begin MEASUREMENT vr_mess_soll_zyl8 "Sollverstaerkung." SWORD FORMULA_0449 0 0 0.0 16.0000 ECU_ADDRESS 0x3FC6E0 /end MEASUREMENT
/begin MEASUREMENT vr_mess_soll_zyl9 "Sollverstaerkung." SWORD FORMULA_0449 0 0 0.0 16.0000 ECU_ADDRESS 0x3FC6E2 /end MEASUREMENT
/begin MEASUREMENT vr_mess_soll_zyl10 "Sollverstaerkung." SWORD FORMULA_0449 0 0 0.0 16.0000 ECU_ADDRESS 0x3FC6E4 /end MEASUREMENT
/begin MEASUREMENT vr_mess_index_zyl1 "Index zur Verstaerkungsstufe." UBYTE FORMULA_0003 0 0 0.0 255.0000 ECU_ADDRESS 0x3FC6E6 /end MEASUREMENT
/begin MEASUREMENT vr_mess_index_zyl2 "Index zur Verstaerkungsstufe." UBYTE FORMULA_0003 0 0 0.0 255.0000 ECU_ADDRESS 0x3FC6E7 /end MEASUREMENT
/begin MEASUREMENT vr_mess_index_zyl3 "Index zur Verstaerkungsstufe." UBYTE FORMULA_0003 0 0 0.0 255.0000 ECU_ADDRESS 0x3FC6E8 /end MEASUREMENT
/begin MEASUREMENT vr_mess_index_zyl4 "Index zur Verstaerkungsstufe." UBYTE FORMULA_0003 0 0 0.0 255.0000 ECU_ADDRESS 0x3FC6E9 /end MEASUREMENT
/begin MEASUREMENT vr_mess_index_zyl5 "Index zur Verstaerkungsstufe." UBYTE FORMULA_0003 0 0 0.0 255.0000 ECU_ADDRESS 0x3FC6EA /end MEASUREMENT
/begin MEASUREMENT vr_mess_index_zyl6 "Index zur Verstaerkungsstufe." UBYTE FORMULA_0003 0 0 0.0 255.0000 ECU_ADDRESS 0x3FC6EB /end MEASUREMENT
/begin MEASUREMENT vr_mess_index_zyl7 "Index zur Verstaerkungsstufe." UBYTE FORMULA_0003 0 0 0.0 255.0000 ECU_ADDRESS 0x3FC6EC /end MEASUREMENT
/begin MEASUREMENT vr_mess_index_zyl8 "Index zur Verstaerkungsstufe." UBYTE FORMULA_0003 0 0 0.0 255.0000 ECU_ADDRESS 0x3FC6ED /end MEASUREMENT
/begin MEASUREMENT vr_mess_index_zyl9 "Index zur Verstaerkungsstufe." UBYTE FORMULA_0003 0 0 0.0 255.0000 ECU_ADDRESS 0x3FC6EE /end MEASUREMENT
/begin MEASUREMENT vr_mess_index_zyl10 "Index zur Verstaerkungsstufe." UBYTE FORMULA_0003 0 0 0.0 255.0000 ECU_ADDRESS 0x3FC6EF /end MEASUREMENT
/begin MEASUREMENT vr_mess_ist_zyl1 "Istverstaerkung." SWORD FORMULA_0449 0 0 0.0 16.0000 ECU_ADDRESS 0x3FC6F0 /end MEASUREMENT
/begin MEASUREMENT vr_mess_ist_zyl2 "Istverstaerkung." SWORD FORMULA_0449 0 0 0.0 16.0000 ECU_ADDRESS 0x3FC6F2 /end MEASUREMENT
/begin MEASUREMENT vr_mess_ist_zyl3 "Istverstaerkung." SWORD FORMULA_0449 0 0 0.0 16.0000 ECU_ADDRESS 0x3FC6F4 /end MEASUREMENT
/begin MEASUREMENT vr_mess_ist_zyl4 "Istverstaerkung." SWORD FORMULA_0449 0 0 0.0 16.0000 ECU_ADDRESS 0x3FC6F6 /end MEASUREMENT
/begin MEASUREMENT vr_mess_ist_zyl5 "Istverstaerkung." SWORD FORMULA_0449 0 0 0.0 16.0000 ECU_ADDRESS 0x3FC6F8 /end MEASUREMENT
/begin MEASUREMENT vr_mess_ist_zyl6 "Istverstaerkung." SWORD FORMULA_0449 0 0 0.0 16.0000 ECU_ADDRESS 0x3FC6FA /end MEASUREMENT
/begin MEASUREMENT vr_mess_ist_zyl7 "Istverstaerkung." SWORD FORMULA_0449 0 0 0.0 16.0000 ECU_ADDRESS 0x3FC6FC /end MEASUREMENT
/begin MEASUREMENT vr_mess_ist_zyl8 "Istverstaerkung." SWORD FORMULA_0449 0 0 0.0 16.0000 ECU_ADDRESS 0x3FC6FE /end MEASUREMENT
/begin MEASUREMENT vr_mess_ist_zyl9 "Istverstaerkung." SWORD FORMULA_0449 0 0 0.0 16.0000 ECU_ADDRESS 0x3FC700 /end MEASUREMENT
/begin MEASUREMENT vr_mess_ist_zyl10 "Istverstaerkung." SWORD FORMULA_0449 0 0 0.0 16.0000 ECU_ADDRESS 0x3FC702 /end MEASUREMENT
/begin MEASUREMENT vr_mess_set_zyl1 "Verstgseinstellung." UBYTE FORMULA_0003 0 0 0.0 255.0000 ECU_ADDRESS 0x3FC704 /end MEASUREMENT
/begin MEASUREMENT vr_mess_set_zyl2 "Verstgseinstellung." UBYTE FORMULA_0003 0 0 0.0 255.0000 ECU_ADDRESS 0x3FC705 /end MEASUREMENT
/begin MEASUREMENT vr_mess_set_zyl3 "Verstgseinstellung." UBYTE FORMULA_0003 0 0 0.0 255.0000 ECU_ADDRESS 0x3FC706 /end MEASUREMENT
/begin MEASUREMENT vr_mess_set_zyl4 "Verstgseinstellung." UBYTE FORMULA_0003 0 0 0.0 255.0000 ECU_ADDRESS 0x3FC707 /end MEASUREMENT
/begin MEASUREMENT vr_mess_set_zyl5 "Verstgseinstellung." UBYTE FORMULA_0003 0 0 0.0 255.0000 ECU_ADDRESS 0x3FC708 /end MEASUREMENT
/begin MEASUREMENT vr_mess_set_zyl6 "Verstgseinstellung." UBYTE FORMULA_0003 0 0 0.0 255.0000 ECU_ADDRESS 0x3FC709 /end MEASUREMENT
/begin MEASUREMENT vr_mess_set_zyl7 "Verstgseinstellung." UBYTE FORMULA_0003 0 0 0.0 255.0000 ECU_ADDRESS 0x3FC70A /end MEASUREMENT
/begin MEASUREMENT vr_mess_set_zyl8 "Verstgseinstellung." UBYTE FORMULA_0003 0 0 0.0 255.0000 ECU_ADDRESS 0x3FC70B /end MEASUREMENT
/begin MEASUREMENT vr_mess_set_zyl9 "Verstgseinstellung." UBYTE FORMULA_0003 0 0 0.0 255.0000 ECU_ADDRESS 0x3FC70C /end MEASUREMENT
/begin MEASUREMENT vr_mess_set_zyl10 "Verstgseinstellung." UBYTE FORMULA_0003 0 0 0.0 255.0000 ECU_ADDRESS 0x3FC70D /end MEASUREMENT
/begin MEASUREMENT vr_sci_err_cnt_zyl1 "TPU SCI-Nachricht konnte nicht gestartet werden." UBYTE FORMULA_0003 0 0 0.0 255.0000 ECU_ADDRESS 0x3FC70E /end MEASUREMENT
/begin MEASUREMENT vr_sci_err_cnt_zyl2 "TPU SCI-Nachricht konnte nicht gestartet werden." UBYTE FORMULA_0003 0 0 0.0 255.0000 ECU_ADDRESS 0x3FC70F /end MEASUREMENT
/begin MEASUREMENT vr_sci_err_cnt_zyl3 "TPU SCI-Nachricht konnte nicht gestartet werden." UBYTE FORMULA_0003 0 0 0.0 255.0000 ECU_ADDRESS 0x3FC710 /end MEASUREMENT
/begin MEASUREMENT vr_sci_err_cnt_zyl4 "TPU SCI-Nachricht konnte nicht gestartet werden." UBYTE FORMULA_0003 0 0 0.0 255.0000 ECU_ADDRESS 0x3FC711 /end MEASUREMENT
/begin MEASUREMENT vr_sci_err_cnt_zyl5 "TPU SCI-Nachricht konnte nicht gestartet werden." UBYTE FORMULA_0003 0 0 0.0 255.0000 ECU_ADDRESS 0x3FC712 /end MEASUREMENT
/begin MEASUREMENT vr_sci_err_cnt_zyl6 "TPU SCI-Nachricht konnte nicht gestartet werden." UBYTE FORMULA_0003 0 0 0.0 255.0000 ECU_ADDRESS 0x3FC713 /end MEASUREMENT
/begin MEASUREMENT vr_sci_err_cnt_zyl7 "TPU SCI-Nachricht konnte nicht gestartet werden." UBYTE FORMULA_0003 0 0 0.0 255.0000 ECU_ADDRESS 0x3FC714 /end MEASUREMENT
/begin MEASUREMENT vr_sci_err_cnt_zyl8 "TPU SCI-Nachricht konnte nicht gestartet werden." UBYTE FORMULA_0003 0 0 0.0 255.0000 ECU_ADDRESS 0x3FC715 /end MEASUREMENT
/begin MEASUREMENT vr_sci_err_cnt_zyl9 "TPU SCI-Nachricht konnte nicht gestartet werden." UBYTE FORMULA_0003 0 0 0.0 255.0000 ECU_ADDRESS 0x3FC716 /end MEASUREMENT
/begin MEASUREMENT vr_sci_err_cnt_zyl10 "TPU SCI-Nachricht konnte nicht gestartet werden." UBYTE FORMULA_0003 0 0 0.0 255.0000 ECU_ADDRESS 0x3FC717 /end MEASUREMENT
/begin MEASUREMENT vr_sci_msg_err "TPU SCI-Nachricht zu spaet ausgegeben." UWORD FORMULA_0010 0 0 0.0 65535.0000 ECU_ADDRESS 0x3FC718 /end MEASUREMENT
/begin FUNCTION Ionenstrom ""
 /begin DEF_CHARACTERISTIC GKF_VR_VORST_BAS KL_VR_VORST_DTZ K_ISS_ADC_MAX K_ISS_ADC_MIN K_ISS_KLIPPING_MAX K_ISS_MAX_DELTA K_ISS_TIME_MS_MIN K_VR_ED_GAIN K_VR_IC_0 K_VR_IC_1 K_VR_IC_2 K_VR_IC_3 K_VR_IC_4 K_VR_IC_5 K_VR_IC_6 K_VR_IC_7 K_VR_IC_8 K_VR_INI K_VR_INT_GAIN K_VR_LP_COEF_10of20_ K_VR_LP_COEF_11of20_ K_VR_LP_COEF_12of20_ K_VR_LP_COEF_13of20_ K_VR_LP_COEF_14of20_ K_VR_LP_COEF_15of20_ K_VR_LP_COEF_16of20_ K_VR_LP_COEF_17of20_ K_VR_LP_COEF_18of20_ K_VR_LP_COEF_19of20_ K_VR_LP_COEF_1of20_ K_VR_LP_COEF_20of20_ K_VR_LP_COEF_2of20_ K_VR_LP_COEF_3of20_ K_VR_LP_COEF_4of20_ K_VR_LP_COEF_5of20_ K_VR_LP_COEF_6of20_ K_VR_LP_COEF_7of20_ K_VR_LP_COEF_8of20_ K_VR_LP_COEF_9of20_ K_VR_MESS_MAX_IC K_VR_MESS_MAX_SAT K_VR_MESS_MIN_IC K_VR_MESS_MIN_SAT K_VR_PROP_GAIN K_VR_REG_CFG K_VR_REG_MAX_IC K_VR_REG_MAX_SAT K_VR_REG_MIN_IC K_VR_REG_MIN_SAT K_VR_SAT_0 K_VR_SAT_1 K_VR_SAT_2 K_VR_SAT_3 K_VR_SOLL K_VR_TEST_I_SOFT_OFF K_VR_TEST_SEND_ENABLE K_VR_TEST_U_MESS K_VR_TEST_V_MESS K_VR_VORST_MAX K_VR_VORST_MIN /end DEF_CHARACTERISTIC
 /begin REF_CHARACTERISTIC /end REF_CHARACTERISTIC
 /begin IN_MEASUREMENT /end IN_MEASUREMENT
 /begin OUT_MEASUREMENT iss_adc_b1 iss_adc_b2 iss_adc_max iss_adc_max_cnt_zyl1 iss_adc_max_cnt_zyl10 iss_adc_max_cnt_zyl2 iss_adc_max_cnt_zyl3 iss_adc_max_cnt_zyl4 iss_adc_max_cnt_zyl5 iss_adc_max_cnt_zyl6 iss_adc_max_cnt_zyl7 iss_adc_max_cnt_zyl8 iss_adc_max_cnt_zyl9 iss_adc_min iss_int_avg_zyl1 iss_int_avg_zyl10 iss_int_avg_zyl2 iss_int_avg_zyl3 iss_int_avg_zyl4 iss_int_avg_zyl5 iss_int_avg_zyl6 iss_int_avg_zyl7 iss_int_avg_zyl8 iss_int_avg_zyl9 iss_klipping_cnt_zyl1 iss_klipping_cnt_zyl10 iss_klipping_cnt_zyl2 iss_klipping_cnt_zyl3 iss_klipping_cnt_zyl4 iss_klipping_cnt_zyl5 iss_klipping_cnt_zyl6 iss_klipping_cnt_zyl7 iss_klipping_cnt_zyl8 iss_klipping_cnt_zyl9 vr_mess_index_zyl1 vr_mess_index_zyl10 vr_mess_index_zyl2 vr_mess_index_zyl3 vr_mess_index_zyl4 vr_mess_index_zyl5 vr_mess_index_zyl6 vr_mess_index_zyl7 vr_mess_index_zyl8 vr_mess_index_zyl9 vr_mess_ist_zyl1 vr_mess_ist_zyl10 vr_mess_ist_zyl2 vr_mess_ist_zyl3 vr_mess_ist_zyl4 vr_mess_ist_zyl5 vr_mess_ist_zyl6 vr_mess_ist_zyl7 vr_mess_ist_zyl8 vr_mess_ist_zyl9 vr_mess_set_zyl1 vr_mess_set_zyl10 vr_mess_set_zyl2 vr_mess_set_zyl3 vr_mess_set_zyl4 vr_mess_set_zyl5 vr_mess_set_zyl6 vr_mess_set_zyl7 vr_mess_set_zyl8 vr_mess_set_zyl9 vr_mess_soll_zyl1 vr_mess_soll_zyl10 vr_mess_soll_zyl2 vr_mess_soll_zyl3 vr_mess_soll_zyl4 vr_mess_soll_zyl5 vr_mess_soll_zyl6 vr_mess_soll_zyl7 vr_mess_soll_zyl8 vr_mess_soll_zyl9 vr_reg_err_zyl1 vr_reg_err_zyl10 vr_reg_err_zyl2 vr_reg_err_zyl3 vr_reg_err_zyl4 vr_reg_err_zyl5 vr_reg_err_zyl6 vr_reg_err_zyl7 vr_reg_err_zyl8 vr_reg_err_zyl9 vr_reg_int_zyl1 vr_reg_int_zyl10 vr_reg_int_zyl2 vr_reg_int_zyl3 vr_reg_int_zyl4 vr_reg_int_zyl5 vr_reg_int_zyl6 vr_reg_int_zyl7 vr_reg_int_zyl8 vr_reg_int_zyl9 vr_reg_ist_zyl1 vr_reg_ist_zyl10 vr_reg_ist_zyl2 vr_reg_ist_zyl3 vr_reg_ist_zyl4 vr_reg_ist_zyl5 vr_reg_ist_zyl6 vr_reg_ist_zyl7 vr_reg_ist_zyl8 vr_reg_ist_zyl9 vr_reg_prop_zyl1 vr_reg_prop_zyl10 vr_reg_prop_zyl2 vr_reg_prop_zyl3 vr_reg_prop_zyl4 vr_reg_prop_zyl5 vr_reg_prop_zyl6 vr_reg_prop_zyl7 vr_reg_prop_zyl8 vr_reg_prop_zyl9 vr_reg_soll_zyl1 vr_reg_soll_zyl10 vr_reg_soll_zyl2 vr_reg_soll_zyl3 vr_reg_soll_zyl4 vr_reg_soll_zyl5 vr_reg_soll_zyl6 vr_reg_soll_zyl7 vr_reg_soll_zyl8 vr_reg_soll_zyl9 vr_reg_zyl1 vr_reg_zyl10 vr_reg_zyl2 vr_reg_zyl3 vr_reg_zyl4 vr_reg_zyl5 vr_reg_zyl6 vr_reg_zyl7 vr_reg_zyl8 vr_reg_zyl9 vr_sci_err_cnt_zyl1 vr_sci_err_cnt_zyl10 vr_sci_err_cnt_zyl2 vr_sci_err_cnt_zyl3 vr_sci_err_cnt_zyl4 vr_sci_err_cnt_zyl5 vr_sci_err_cnt_zyl6 vr_sci_err_cnt_zyl7 vr_sci_err_cnt_zyl8 vr_sci_err_cnt_zyl9 vr_sci_msg_err vr_soll_ist_zyl1 vr_soll_ist_zyl10 vr_soll_ist_zyl2 vr_soll_ist_zyl3 vr_soll_ist_zyl4 vr_soll_ist_zyl5 vr_soll_ist_zyl6 vr_soll_ist_zyl7 vr_soll_ist_zyl8 vr_soll_ist_zyl9 vr_st vr_st_zyl1 vr_st_zyl10 vr_st_zyl2 vr_st_zyl3 vr_st_zyl4 vr_st_zyl5 vr_st_zyl6 vr_st_zyl7 vr_st_zyl8 vr_st_zyl9 vr_vorst_bas_b1 vr_vorst_bas_b2 vr_vorst_offs_zyl1 vr_vorst_offs_zyl10 vr_vorst_offs_zyl2 vr_vorst_offs_zyl3 vr_vorst_offs_zyl4 vr_vorst_offs_zyl5 vr_vorst_offs_zyl6 vr_vorst_offs_zyl7 vr_vorst_offs_zyl8 vr_vorst_offs_zyl9 vr_vorst_zyl1 vr_vorst_zyl10 vr_vorst_zyl2 vr_vorst_zyl3 vr_vorst_zyl4 vr_vorst_zyl5 vr_vorst_zyl6 vr_vorst_zyl7 vr_vorst_zyl8 vr_vorst_zyl9 /end OUT_MEASUREMENT
/end FUNCTION
/begin FUNCTION KFIPOL "" /begin DEF_CHARACTERISTIC /end DEF_CHARACTERISTIC /begin REF_CHARACTERISTIC /end REF_CHARACTERISTIC /begin IN_MEASUREMENT /end IN_MEASUREMENT /begin OUT_MEASUREMENT /end OUT_MEASUREMENT /end FUNCTION
/begin FUNCTION KIS-Schnittstelle ""
 /begin DEF_CHARACTERISTIC K_KIS_ACTIVE_PULSE K_KIS_CFG K_KIS_LEN K_KIS_PERIOD K_KIS_START K_KIS_TIME_OUT /end DEF_CHARACTERISTIC
 /begin REF_CHARACTERISTIC /end REF_CHARACTERISTIC
 /begin IN_MEASUREMENT /end IN_MEASUREMENT
 /begin OUT_MEASUREMENT /end OUT_MEASUREMENT
/end FUNCTION
/begin FUNCTION KWP-Jobs "" /begin DEF_CHARACTERISTIC /end DEF_CHARACTERISTIC /begin REF_CHARACTERISTIC /end REF_CHARACTERISTIC /begin IN_MEASUREMENT /end IN_MEASUREMENT /begin OUT_MEASUREMENT /end OUT_MEASUREMENT /end FUNCTION
/begin FUNCTION KWP-Programmierung "" /begin DEF_CHARACTERISTIC /end DEF_CHARACTERISTIC /begin REF_CHARACTERISTIC /end REF_CHARACTERISTIC /begin IN_MEASUREMENT /end IN_MEASUREMENT /begin OUT_MEASUREMENT /end OUT_MEASUREMENT /end FUNCTION
/begin FUNCTION Kh ""
 /begin DEF_CHARACTERISTIC KF_KH_RG_OPT KF_KH_TZ_ABS_TMOT_F KF_KH_TZ_ETA_AB KF_KH_TZ_ETA_AUF KF_KH_TZ_ETA_GRUND KF_KH_TZ_ETA_LL KF_KH_TZ_GRUND KF_KH_TZ_LL KF_KH_VAN_TMOT_F KL_KH_ALT_OFFSET KL_KH_TZ_ABS_AUF_TMOT KL_KH_TZ_ABS_INIT KL_KH_TZ_DELAY_TMOT KL_KH_TZ_PUMG_F KL_KH_T_MAX KL_KH_VAN_AUF_TMOT_A KL_KH_VAN_AUF_TMOT_E KL_KH_VAN_DELAY_TMOT KL_KH_VAN_RG_REG_I KL_KH_VAN_RG_REG_P K_KH_N_MAX K_KH_N_MAX_HYS K_KH_PKSR_PL_TMOT_MIN K_KH_RF_MAX K_KH_RF_MAX_HYS K_KH_SMG_TMOT_MAX K_KH_SMG_TMOT_MIN K_KH_TKAT_CFG K_KH_TKAT_ENDE K_KH_TKAT_HYST K_KH_TZ_AB K_KH_TZ_ABS_AB K_KH_TZ_AUF K_KH_TZ_CFG K_KH_VAN_AB_Auslass K_KH_VAN_AB_Einlass K_KH_VAN_CFG K_KH_VAN_TMOT_MAX K_KH_VAN_VO_FAKT K_KH_VAN_VO_I_MAX /end DEF_CHARACTERISTIC
 /begin REF_CHARACTERISTIC /end REF_CHARACTERISTIC
 /begin IN_MEASUREMENT /end IN_MEASUREMENT
 /begin OUT_MEASUREMENT kh_time_on kh_tkat kh_tkat_alt kh_tkat_alt_offset kh_tz_delta_roh kh_tz_eta kh_tz_eta_roh kh_tz_fak kh_tz_offs kh_tz_offs_roh kh_tz_roh kh_van_fakt_kf_mw kh_van_fakt_max kh_van_faktor_Auslass kh_van_faktor_Einlass kh_van_rg_delta_b1 kh_van_rg_delta_b2 kh_van_rg_opt_b1 kh_van_rg_opt_b2 kh_van_vo_b1 kh_van_vo_b2 kh_van_vo_i_b1 kh_van_vo_i_b2 kh_van_vo_p_b1 kh_van_vo_p_b2 /end OUT_MEASUREMENT
/end FUNCTION
/begin FUNCTION Klopfadaption ""
 /begin DEF_CHARACTERISTIC GKL_KA_ADAPT_MIN KF_KA_F KF_KA_F_K KF_KA_OFFS KF_KA_OFFS_VL KF_KA_T_KOMP KL_KA_F_VL KL_KA_PUMG_VL KL_KA_RF_MIN K_KA_ADAPT_MAX K_KA_AQ_GRAD_MAX K_KA_AQ_GRAD_SEGM_CNT K_KA_DIAG_T K_KA_DTZ_MAX K_KA_FILT_KK_KA K_KA_FILT_KK_KKA K_KA_FILT_LK K_KA_FILT_SK K_KA_KLIPPING_MAX K_KA_KS_CFG K_KA_RESET_CFG K_KA_TP_TAU K_KA_TREPP_F K_KA_TZ_KS K_KA_TZ_MIN_HYST /end DEF_CHARACTERISTIC
 /begin REF_CHARACTERISTIC /end REF_CHARACTERISTIC
 /begin IN_MEASUREMENT /end IN_MEASUREMENT
 /begin OUT_MEASUREMENT ka_adapt_min ka_adapt_tz_zyl_int ka_adapt_tz_zyl_int_max ka_adapt_tz_zyl_int_roh ka_aq_grad_segm_cnt_b1 ka_aq_grad_segm_cnt_b2 ka_dtz_diag_st ka_dtz_diag_t_b1 ka_dtz_diag_t_b2 ka_dtz_tp_zyl1 ka_dtz_tp_zyl10 ka_dtz_tp_zyl2 ka_dtz_tp_zyl3 ka_dtz_tp_zyl4 ka_dtz_tp_zyl5 ka_dtz_tp_zyl6 ka_dtz_tp_zyl7 ka_dtz_tp_zyl8 ka_dtz_tp_zyl9 ka_dtz_zyl1 ka_dtz_zyl10 ka_dtz_zyl2 ka_dtz_zyl3 ka_dtz_zyl4 ka_dtz_zyl5 ka_dtz_zyl6 ka_dtz_zyl7 ka_dtz_zyl8 ka_dtz_zyl9 ka_f ka_f_k_b1 ka_f_k_b2 ka_offs_zyl1 ka_offs_zyl10 ka_offs_zyl2 ka_offs_zyl3 ka_offs_zyl4 ka_offs_zyl5 ka_offs_zyl6 ka_offs_zyl7 ka_offs_zyl8 ka_offs_zyl9 ka_pumg ka_rf_min_b1 ka_rf_min_b2 ka_st_b1 ka_st_b2 ka_t_komp_b1 ka_t_komp_b2 ka_tz_diag_st ka_tz_diag_t_b1 ka_tz_diag_t_b2 ka_tz_min_st /end OUT_MEASUREMENT
/end FUNCTION
/begin FUNCTION Klopfregelung ""
 /begin DEF_CHARACTERISTIC GKF_KR_ANZ_ASP_AUF GKF_KR_ANZ_ASP_HOLD GKF_KR_DTZ_AB GKF_KR_FBS_AVG_OFF_MAX GKF_KR_KNOCK_LAENGE GKF_KR_KNOCK_TZ_OFFS GKL_KR_AXIS_FBS GKL_KR_DTZ_MAX GKL_KR_FBS_AVG_OFF_MAX GKL_KR_RF_MIN KL_KR_FBS_AVG_NO K_KR_APPL_CFG K_KR_APPL_DTZ_ZYL1 K_KR_APPL_DTZ_ZYL10 K_KR_APPL_DTZ_ZYL2 K_KR_APPL_DTZ_ZYL3 K_KR_APPL_DTZ_ZYL4 K_KR_APPL_DTZ_ZYL5 K_KR_APPL_DTZ_ZYL6 K_KR_APPL_DTZ_ZYL7 K_KR_APPL_DTZ_ZYL8 K_KR_APPL_DTZ_ZYL9 K_KR_APPL_NUM_ZYL1 K_KR_APPL_NUM_ZYL10 K_KR_APPL_NUM_ZYL2 K_KR_APPL_NUM_ZYL3 K_KR_APPL_NUM_ZYL4 K_KR_APPL_NUM_ZYL5 K_KR_APPL_NUM_ZYL6 K_KR_APPL_NUM_ZYL7 K_KR_APPL_NUM_ZYL8 K_KR_APPL_NUM_ZYL9 K_KR_APPL_PER K_KR_CFG K_KR_DIAG_T K_KR_FB_LEN K_KR_FB_START K_KR_KLIPPING_MAX K_KR_TMOT_MIN /end DEF_CHARACTERISTIC
 /begin REF_CHARACTERISTIC /end REF_CHARACTERISTIC
 /begin IN_MEASUREMENT /end IN_MEASUREMENT
 /begin OUT_MEASUREMENT kr_ab_st kr_ab_st_zyl1 kr_ab_st_zyl10 kr_ab_st_zyl2 kr_ab_st_zyl3 kr_ab_st_zyl4 kr_ab_st_zyl5 kr_ab_st_zyl6 kr_ab_st_zyl7 kr_ab_st_zyl8 kr_ab_st_zyl9 kr_akt_st kr_akt_st_zyl1 kr_akt_st_zyl10 kr_akt_st_zyl2 kr_akt_st_zyl3 kr_akt_st_zyl4 kr_akt_st_zyl5 kr_akt_st_zyl6 kr_akt_st_zyl7 kr_akt_st_zyl8 kr_akt_st_zyl9 kr_anz_asp_auf kr_anz_asp_auf_bez_zyl1 kr_anz_asp_auf_bez_zyl10 kr_anz_asp_auf_bez_zyl2 kr_anz_asp_auf_bez_zyl3 kr_anz_asp_auf_bez_zyl4 kr_anz_asp_auf_bez_zyl5 kr_anz_asp_auf_bez_zyl6 kr_anz_asp_auf_bez_zyl7 kr_anz_asp_auf_bez_zyl8 kr_anz_asp_auf_bez_zyl9 kr_anz_asp_hold kr_appl_cnt_zyl1 kr_appl_cnt_zyl10 kr_appl_cnt_zyl2 kr_appl_cnt_zyl3 kr_appl_cnt_zyl4 kr_appl_cnt_zyl5 kr_appl_cnt_zyl6 kr_appl_cnt_zyl7 kr_appl_cnt_zyl8 kr_appl_cnt_zyl9 kr_asp_cnt kr_diag_st kr_dtz_ab_zyl1 kr_dtz_ab_zyl10 kr_dtz_ab_zyl2 kr_dtz_ab_zyl3 kr_dtz_ab_zyl4 kr_dtz_ab_zyl5 kr_dtz_ab_zyl6 kr_dtz_ab_zyl7 kr_dtz_ab_zyl8 kr_dtz_ab_zyl9 kr_dtz_bez_zyl1 kr_dtz_bez_zyl10 kr_dtz_bez_zyl2 kr_dtz_bez_zyl3 kr_dtz_bez_zyl4 kr_dtz_bez_zyl5 kr_dtz_bez_zyl6 kr_dtz_bez_zyl7 kr_dtz_bez_zyl8 kr_dtz_bez_zyl9 kr_dtz_diag_t_b1 kr_dtz_diag_t_b2 kr_dtz_grad_zyl1 kr_dtz_grad_zyl10 kr_dtz_grad_zyl2 kr_dtz_grad_zyl3 kr_dtz_grad_zyl4 kr_dtz_grad_zyl5 kr_dtz_grad_zyl6 kr_dtz_grad_zyl7 kr_dtz_grad_zyl8 kr_dtz_grad_zyl9 kr_dtz_int_zyl1 kr_dtz_int_zyl10 kr_dtz_int_zyl2 kr_dtz_int_zyl3 kr_dtz_int_zyl4 kr_dtz_int_zyl5 kr_dtz_int_zyl6 kr_dtz_int_zyl7 kr_dtz_int_zyl8 kr_dtz_int_zyl9 kr_dtz_max kr_dtz_mw_b1 kr_dtz_mw_b2 kr_dtz_sum_all kr_dtz_zyl1 kr_dtz_zyl10 kr_dtz_zyl2 kr_dtz_zyl3 kr_dtz_zyl4 kr_dtz_zyl5 kr_dtz_zyl6 kr_dtz_zyl7 kr_dtz_zyl8 kr_dtz_zyl9 kr_fbs_avg_delta_zyl1 kr_fbs_avg_delta_zyl10 kr_fbs_avg_delta_zyl2 kr_fbs_avg_delta_zyl3 kr_fbs_avg_delta_zyl4 kr_fbs_avg_delta_zyl5 kr_fbs_avg_delta_zyl6 kr_fbs_avg_delta_zyl7 kr_fbs_avg_delta_zyl8 kr_fbs_avg_delta_zyl9 kr_fbs_avg_no_b1 kr_fbs_avg_no_b2 kr_fbs_avg_off_max_b1 kr_fbs_avg_off_max_b2 kr_fbs_avg_zyl1 kr_fbs_avg_zyl10 kr_fbs_avg_zyl2 kr_fbs_avg_zyl3 kr_fbs_avg_zyl4 kr_fbs_avg_zyl5 kr_fbs_avg_zyl6 kr_fbs_avg_zyl7 kr_fbs_avg_zyl8 kr_fbs_avg_zyl9 kr_fbs_zyl1 kr_fbs_zyl10 kr_fbs_zyl2 kr_fbs_zyl3 kr_fbs_zyl4 kr_fbs_zyl5 kr_fbs_zyl6 kr_fbs_zyl7 kr_fbs_zyl8 kr_fbs_zyl9 kr_hold_count_zyl1 kr_hold_count_zyl10 kr_hold_count_zyl2 kr_hold_count_zyl3 kr_hold_count_zyl4 kr_hold_count_zyl5 kr_hold_count_zyl6 kr_hold_count_zyl7 kr_hold_count_zyl8 kr_hold_count_zyl9 kr_int_avg_norm_zyl1 kr_int_avg_norm_zyl10 kr_int_avg_norm_zyl2 kr_int_avg_norm_zyl3 kr_int_avg_norm_zyl4 kr_int_avg_norm_zyl5 kr_int_avg_norm_zyl6 kr_int_avg_norm_zyl7 kr_int_avg_norm_zyl8 kr_int_avg_norm_zyl9 kr_int_avg_zyl1 kr_int_avg_zyl10 kr_int_avg_zyl2 kr_int_avg_zyl3 kr_int_avg_zyl4 kr_int_avg_zyl5 kr_int_avg_zyl6 kr_int_avg_zyl7 kr_int_avg_zyl8 kr_int_avg_zyl9 kr_klipping_cnt_zyl1 kr_klipping_cnt_zyl10 kr_klipping_cnt_zyl2 kr_klipping_cnt_zyl3 kr_klipping_cnt_zyl4 kr_klipping_cnt_zyl5 kr_klipping_cnt_zyl6 kr_klipping_cnt_zyl7 kr_klipping_cnt_zyl8 kr_klipping_cnt_zyl9 kr_knock_laenge_b1 kr_knock_laenge_b2 kr_knock_tz_offs_b1 kr_knock_tz_offs_b2 kr_rf_min_b1 kr_rf_min_b2 kr_sst_fbs12_zyl1 kr_sst_fbs12_zyl10 kr_sst_fbs12_zyl2 kr_sst_fbs12_zyl3 kr_sst_fbs12_zyl4 kr_sst_fbs12_zyl5 kr_sst_fbs12_zyl6 kr_sst_fbs12_zyl7 kr_sst_fbs12_zyl8 kr_sst_fbs12_zyl9 kr_st_b1 kr_st_b2 kr_st_erk kr_st_erk_zyl1 kr_st_erk_zyl10 kr_st_erk_zyl2 kr_st_erk_zyl3 kr_st_erk_zyl4 kr_st_erk_zyl5 kr_st_erk_zyl6 kr_st_erk_zyl7 kr_st_erk_zyl8 kr_st_erk_zyl9 /end OUT_MEASUREMENT
/end FUNCTION
/begin FUNCTION Kuehleraustrittstemperatur ""
 /begin DEF_CHARACTERISTIC KL_TKA_NTC KL_TKA_OBD_TMOT_T K_TKA_DIAG_MAX K_TKA_DIAG_MIN K_TKA_OBD_DELTA_HIGH K_TKA_OBD_DELTA_NORM K_TKA_OBD_TMOT_MIN K_TKA_TAU /end DEF_CHARACTERISTIC
 /begin REF_CHARACTERISTIC /end REF_CHARACTERISTIC
 /begin IN_MEASUREMENT /end IN_MEASUREMENT
 /begin OUT_MEASUREMENT tka_ad tka_filter tka_obd_st tka_obd_tmot_t tka_roh /end OUT_MEASUREMENT
/end FUNCTION
/begin FUNCTION Kupplungsschlupfregelung ""
 /begin DEF_CHARACTERISTIC KF_KUS_N_MIN KF_MD_KUS_KR KF_MD_KUS_TN KF_MD_KUS_TV KL_KUS_GANG_FAK KL_KUS_N_MIN_AFZ KL_KUS_SCHLUPF_MAX KL_MD_KUS_KR_FAK KL_MD_KUS_KUPP_MIN KL_MD_KUS_TN_FAK KL_MD_KUS_TV_FAK K_KUS_CFG K_KUS_GANG_MAX K_KUS_N_DELTA_AUS K_KUS_N_DELTA_EIN K_KUS_N_GETR_EIN_HYS K_KUS_N_GETR_EIN_MIN K_KUS_N_HYS K_KUS_N_MIN K_KUS_STUFE K_KUS_V_VORNE_HYS K_KUS_V_VORNE_MAX K_MD_KUS_BEGR_TAU1_AUS K_MD_KUS_BEGR_TAU1_EIN K_MD_KUS_BEGR_TAU_AUS K_MD_KUS_BEGR_TAU_EIN K_MD_KUS_PID_A1 /end DEF_CHARACTERISTIC
 /begin REF_CHARACTERISTIC /end REF_CHARACTERISTIC
 /begin IN_MEASUREMENT /end IN_MEASUREMENT
 /begin OUT_MEASUREMENT kus_gang kus_n_getr_ein_alt kus_n_max kus_n_schlupf kus_st kus_st_enable kus_timer md_kus_begr md_kus_begr1 md_kus_n_dif md_kus_n_dif_verz1 md_kus_n_dif_verz2 md_kus_pid md_kus_pid_b0 md_kus_pid_b1 md_kus_pid_b2 md_kus_st_freigabe_alt md_kus_st_freigabe_alt_enable /end OUT_MEASUREMENT
/end FUNCTION
/begin RECORD_LAYOUT TKW_VV_VV_UB FNC_VALUES 1 UBYTE COLUMN_DIR DIRECT /end RECORD_LAYOUT
/begin RECORD_LAYOUT TKW_VV_VV_SB FNC_VALUES 1 SBYTE COLUMN_DIR DIRECT /end RECORD_LAYOUT
/begin RECORD_LAYOUT TKW_VV_VV_UW FNC_VALUES 1 UWORD COLUMN_DIR DIRECT /end RECORD_LAYOUT
/begin RECORD_LAYOUT TKW_VV_VV_SW FNC_VALUES 1 SWORD COLUMN_DIR DIRECT /end RECORD_LAYOUT
/begin RECORD_LAYOUT TKW_VV_VV_UL FNC_VALUES 1 ULONG COLUMN_DIR DIRECT /end RECORD_LAYOUT
/begin RECORD_LAYOUT TKW_VV_VV_SF FNC_VALUES 1 FLOAT32_IEEE COLUMN_DIR DIRECT /end RECORD_LAYOUT
/begin RECORD_LAYOUT TKL_UB_VV_SW NO_AXIS_PTS_X 1 UBYTE RESERVED 2 BYTE AXIS_PTS_X 3 UBYTE INDEX_INCR DIRECT FNC_VALUES 4 SWORD COLUMN_DIR DIRECT /end RECORD_LAYOUT
/begin RECORD_LAYOUT TKL_UW_VV_SW NO_AXIS_PTS_X 1 UBYTE RESERVED 2 BYTE AXIS_PTS_X 3 UWORD INDEX_INCR DIRECT FNC_VALUES 4 SWORD COLUMN_DIR DIRECT /end RECORD_LAYOUT
/begin RECORD_LAYOUT TKL_SW_VV_UB NO_AXIS_PTS_X 1 UBYTE RESERVED 2 BYTE AXIS_PTS_X 3 SWORD INDEX_INCR DIRECT FNC_VALUES 4 UBYTE COLUMN_DIR DIRECT /end RECORD_LAYOUT
/begin RECORD_LAYOUT TKL_SW_VV_UW NO_AXIS_PTS_X 1 UBYTE RESERVED 2 BYTE AXIS_PTS_X 3 SWORD INDEX_INCR DIRECT FNC_VALUES 4 UWORD COLUMN_DIR DIRECT /end RECORD_LAYOUT
/begin RECORD_LAYOUT TKL_SW_VV_SW NO_AXIS_PTS_X 1 UBYTE RESERVED 2 BYTE AXIS_PTS_X 3 SWORD INDEX_INCR DIRECT FNC_VALUES 4 SWORD COLUMN_DIR DIRECT /end RECORD_LAYOUT
/begin RECORD_LAYOUT TKF_SW_SW_UW NO_AXIS_PTS_X 1 UBYTE NO_AXIS_PTS_Y 2 UBYTE AXIS_PTS_X 3 SWORD INDEX_INCR DIRECT AXIS_PTS_Y 4 SWORD INDEX_INCR DIRECT FNC_VALUES 5 UWORD COLUMN_DIR DIRECT /end RECORD_LAYOUT
/begin RECORD_LAYOUT TKF_SW_SW_SW NO_AXIS_PTS_X 1 UBYTE NO_AXIS_PTS_Y 2 UBYTE AXIS_PTS_X 3 SWORD INDEX_INCR DIRECT AXIS_PTS_Y 4 SWORD INDEX_INCR DIRECT FNC_VALUES 5 SWORD COLUMN_DIR DIRECT /end RECORD_LAYOUT
/begin RECORD_LAYOUT TGL_VV_VV_SW FNC_VALUES 1 SWORD COLUMN_DIR DIRECT /end RECORD_LAYOUT
/begin RECORD_LAYOUT TGF_VV_VV_UB FNC_VALUES 1 UBYTE COLUMN_DIR DIRECT /end RECORD_LAYOUT
/begin RECORD_LAYOUT TGF_VV_VV_SW FNC_VALUES 1 SWORD COLUMN_DIR DIRECT /end RECORD_LAYOUT
/begin RECORD_LAYOUT TAD_UB_VV_SW NO_AXIS_PTS_X 1 UBYTE RESERVED 2 BYTE AXIS_PTS_X 3 SWORD INDEX_INCR DIRECT /end RECORD_LAYOUT
/end MODULE
/end PROJECT
