/begin PROJECT MSS65-ign-V452 "MSS65 IGN - V452.01-B204.00, data set 0569Q60Z160E"
/begin HEADER "" VERSION "V452.01-B204.00" /end HEADER
/begin MODULE _MSS65-ign "MSS65 IGN - V452.01-B204.00, calibration xxxxxxxx"
/begin MOD_COMMON "" BYTE_ORDER MSB_FIRST /* Default byteorder (Motorola) */ /end MOD_COMMON
/begin COMPU_METHOD FORMULA_0003 "FORMULA_0003" RAT_FUNC "%3.0" "-" COEFFS 0 1 0 0 0 1 /end COMPU_METHOD
/begin COMPU_METHOD FORMULA_0010 "FORMULA_0010" RAT_FUNC "%5.0" "-" COEFFS 0 1 0 0 0 1 /end COMPU_METHOD
/begin COMPU_METHOD FORMULA_0024 "FORMULA_0024" RAT_FUNC "%9.4" "-" COEFFS 0 32768 0 0 0 1 /end COMPU_METHOD
/begin COMPU_METHOD FORMULA_0050 "FORMULA_0050" TAB_VERB "%5.0" "-" COMPU_TAB_REF FORMULA_0050_VTAB /end COMPU_METHOD
/begin COMPU_VTAB FORMULA_0050_VTAB "FORMULA_0050_VTAB" TAB_VERB 352 10000 "SK_INJ_TESTFEHLER" 10001 "PUMG_FEHLER" 10002 "HFM1_FEHLER" 10003 "HFM2_FEHLER" 10004 "PSAU1_FEHLER" 10005 "PSAU2_FEHLER" 10006 "VAN_HALL_E1_FEHLER" 10007 "VAN_HALL_A1_FEHLER" 10008 "VAN_HALL_E2_FEHLER" 10009 "VAN_HALL_A2_FEHLER" 10010 "VAN_REGL_E1_FEHLER" 10011 "VAN_REGL_A1_FEHLER" 10012 "VAN_REGL_E2_FEHLER" 10013 "VAN_REGL_A2_FEHLER" 10014 "NW1_SYNC_FEHLER" 10015 "NW2_SYNC_FEHLER" 10016 "PCTRL_IGN_FEHLER" 10017 "PT_TORQDKG_FEHLER" 10018 "PKS_FEHLER" 10019 "PT_STATUSR_FEHLER" 10020 "LAVK1_FEHLER" 10021 "LAVK2_FEHLER" 10022 "LAVK1_OBD_PLAU_FEHLER" 10023 "LAVK2_OBD_PLAU_FEHLER" 10024 "LAVK1_OBD_SA_FEHLER" 10025 "LAVK2_OBD_SA_FEHLER" 10026 "LANK1_FEHLER" 10027 "LANK2_FEHLER" 10028 "LSHNK1_FEHLER" 10029 "LSHNK2_FEHLER" 52615 "PT_BUSOFF" 52632 "PT_TORQDSC_FEHLER" 52645 "PT_STDSC_FEHLER" 52667 "PT_VRAD_FEHLER" 52636 "PT_VFZG_FEHLER" 52628 "PT_ATEMP_FEHLER" 52640 "PT_KLST_FEHLER" 52649 "PT_KKOS_FEHLER" 52641 "PT_LRW_FEHLER" 10039 "FPLAU1_FEHLER" 10040 "FPLAU2_FEHLER" 10041 "SL_ML_HFM_FEHLER" 10042 "LANK1_OBD_S_FEHLER" 10043 "LANK2_OBD_S_FEHLER" 10044 "LAVK1_OBD_TL_FEHLER" 10045 "LAVK2_OBD_TL_FEHLER" 10046 "LSHVK1_FEHLER" 10047 "LSHVK2_FEHLER" 10048 "LSRVK1_OBD_REG_FEHLER" 10049 "LSRVK2_OBD_REG_FEHLER" 10050 "LSHVK1_R_FEHLER" 10051 "LSHVK2_R_FEHLER" 10052 "LSRVK1_OBD_START_FEHLER" 10053 "LSRVK2_OBD_START_FEHLER" 10054 "LSRVK1_OBD_REF_FEHLER" 10055 "LSRVK2_OBD_REF_FEHLER" 10056 "LAVK1_DIAG_FEHLER" 10057 "LAVK2_DIAG_FEHLER" 10058 "LAVK1_IA_OPENLOAD_FEHLER" 10059 "LAVK2_IA_OPENLOAD_FEHLER" 10060 "PT_GRB_FEHLER" 10061 "PT_GRB2_FEHLER" 10062 "LAVK1_UN_OPENLOAD_FEHLER" 10063 "LAVK2_UN_OPENLOAD_FEHLER" 10064 "LAVK1_IP_OPENLOAD_FEHLER" 10065 "LAVK2_IP_OPENLOAD_FEHLER" 10066 "APPL_DATA_INJ" 10067 "TZ1_FEHLER" 10068 "TZ2_FEHLER" 10069 "TZ3_FEHLER" 10070 "TZ4_FEHLER" 10071 "TZ5_FEHLER" 10072 "TZ6_FEHLER" 10073 "TZ7_FEHLER" 10074 "TZ8_FEHLER" 10075 "TZ9_FEHLER" 10076 "TZ10_FEHLER" 10077 "LAM1_REG_FEHLER" 10078 "LAM2_REG_FEHLER" 10079 "VAN_ANSCHL_E1_FEHLER" 10080 "VAN_ANSCHL_A1_FEHLER" 10081 "VAN_ANSCHL_E2_FEHLER" 10082 "VAN_ANSCHL_A2_FEHLER" 10083 "VAN_VENT_E1_FEHLER" 10084 "VAN_VENT_A1_FEHLER" 10085 "VAN_VENT_E2_FEHLER" 10086 "VAN_VENT_A2_FEHLER" 10087 "EV1_FEHLER" 10088 "EV2_FEHLER" 10089 "EV3_FEHLER" 10090 "EV4_FEHLER" 10091 "EV5_FEHLER" 10092 "EV6_FEHLER" 10093 "EV7_FEHLER" 10094 "EV8_FEHLER" 10095 "EV9_FEHLER" 10096 "EV10_FEHLER" 10097 "LAVK1_OBD_DYN_FEHLER" 10098 "LAVK2_OBD_DYN_FEHLER" 52650 "PT_CRASH_FEHLER" 52635 "PT_VEHMOD_FEHLER" 52629 "PT_BEDFGR_FEHLER" 10102 "DMTL_P_FEHLER" 10103 "DMTL_V_FEHLER" 10104 "DMTL_H_FEHLER" 10105 "DMTL_GROBLECK_FEHLER" 10106 "DMTL_FEUCHT_FEHLER" 10107 "DMTL_DECKEL_MELDUNG" 10108 "LA1_TRIM_FEHLER" 10109 "LA2_TRIM_FEHLER" 10110 "RLU87_FEHLER" 10111 "EKP_PWM_FEHLER" 10112 "SSP_FEHLER" 10113 "TD_FEHLER" 10114 "RLSLP_FEHLER" 10115 "SLV_FEHLER" 52639 "PT_KMST_FEHLER" 52648 "PT_STATKOM_FEHLER" 10118 "PKS_LL_FEHLER" 10119 "PKS_TL_FEHLER" 10120 "PKS_Q_FEHLER" 10121 "KAT_OBD1_FEHLER" 10122 "KAT_OBD2_FEHLER" 10123 "VAN_DSV_FEHLER" 10124 "FI_GEN" 10125 "FI_BSD" 10126 "FI_QLT" 10127 "FI_IBS1" 10128 "FI_IBS2" 10129 "FI_IBS3" 10130 "FI_PMBN" 10131 "FI_PMBATT" 10132 "MVAC_DRUCKSENSOR" 52668 "PT_BEDAT_FEHLER" 10134 "SK_MANAGER_INJ" 10135 "SSP_DIAG_FEHLER" 10136 "EWS_SCI_FEHLER" 10137 "EWS_MAN_FEHLER" 10138 "FI_BSD_0" 10139 "FI_BSD_6" 10140 "FI_BSDGLOB" 10141 "FI_PMRUHVERL" 10142 "FI_TOENS" 10143 "EBOX_ELU_FEHLER" 10144 "SG_INJ_FEHLER" 10145 "EGAS_ENLTG1_DIAG" 10146 "EGAS_ENLTG2_DIAG" 10147 "S_POEL_FEHLER" 10148 "TEV1_OBD_FEHLER" 10149 "TEV2_OBD_FEHLER" 10150 "TEV1_FEHLER" 10151 "TEV2_FEHLER" 10152 "EBENE2_INJ_FEHLER" 10153 "KW_FEHLER" 10154 "LA1_ADAPT_FEHLER" 10155 "LA2_ADAPT_FEHLER" 10156 "KGE1_FEHLER" 10157 "KGE2_FEHLER" 10158 "FST_FEHLER" 10159 "SLP_FEHLER" 10160 "SL_DURCHS_B1" 10161 "SL_DURCHS_B2" 10162 "SL_DURCHS_HSTRANG" 10163 "FETRAWE_FEHLER" 10164 "S_GETR_HS_FEHLER" 10165 "S_KUPP_HS_FEHLER" 10166 "VAN_DRUCK_FEHLER" 10167 "ELUP_FEHLER" 10168 "ELU_FEHLER" 52655 "PT_STATANH_FEHLER" 10170 "KSD1_FEHLER" 10171 "KSD2_FEHLER" 10172 "KATS1_FEHLER" 10173 "KATS2_FEHLER" 10174 "PT_STATGRB_FEHLER" 10175 "PT_ANFRADMOM_FEHLER" 10176 "FST_GEBER_FEHLER" 10177 "TANK_LEER_INFO" 10178 "PT_TOMA_FEHLER" 10179 "DMTL_FEINLECK_FEHLER" 10180 "PUMG_OBD_FEHLER" 10181 "SL_ML_HFM_OBD_FEHLER" 10182 "LA1_TRIM_AD_FEHLER" 10183 "LA2_TRIM_AD_FEHLER" 10184 "LANK1_OPENLOAD_FEHLER" 10185 "LANK2_OPENLOAD_FEHLER" 10186 "LANK1_OBD_WE_FEHLER" 10187 "LANK2_OBD_WE_FEHLER" 10188 "LSHNK1_R_FEHLER" 10189 "LSHNK2_R_FEHLER" 10190 "PKS_MODELL_FEHLER" 10191 "PKS_PAUFBAU_FEHLER" 10192 "PKSR_ADAPT_ANSCHL_FEHLER" 10193 "TGETR_FEHLER" 10194 "LAVK_ATIC42_FEHLER" 10195 "PT_ALAENGS_FEHLER" 10196 "PT_OBD_ED_FEHLER" 10197 "FST_GEBER_LI_FEHLER" 10198 "FST_GEBER_RE_FEHLER" 10199 "LANK1_OBD_SLOPE_FEHLER" 10200 "LANK2_OBD_SLOPE_FEHLER" 10201 "MVAC_OBD_FEHLER" 10202 "ELUP_OBD_FEHLER" 10203 "LAVK2_ATIC42_FEHLER" 10204 "INDEX_204_INJ" 10205 "INDEX_205_INJ" 10206 "INDEX_206_INJ" 10207 "INDEX_207_INJ" 10208 "INDEX_208_INJ" 10209 "INDEX_209_INJ" 10210 "INDEX_210_INJ" 10211 "INDEX_211_INJ" 10212 "INDEX_212_INJ" 10213 "INDEX_213_INJ" 10214 "INDEX_214_INJ" 10215 "INDEX_215_INJ" 10216 "INDEX_216_INJ" 10217 "INDEX_217_INJ" 10218 "INDEX_218_INJ" 10219 "INDEX_219_INJ" 10220 "INDEX_220_INJ" 10221 "INDEX_221_INJ" 10222 "INDEX_222_INJ" 10223 "INDEX_223_INJ" 11000 "SK_IGN_TESTFEHLER" 11001 "TMOT_FEHLER" 11002 "TMOT_OBD_FEHLER" 11003 "TAN1_FEHLER" 11004 "TAN2_FEHLER" 11005 "TIME_REL_OBD_FEHLER" 11006 "UB_FEHLER" 11007 "TKA_FEHLER" 11008 "TDME_FEHLER" 11009 "UEXT_111_219_514_FEHLER" 11010 "UEXT_124_512_FEHLER" 11011 "APPL_DATA_IGN" 11012 "TKA_OBD_FEHLER" 11013 "PWG1_FEHLER" 11014 "PWG2_FEHLER" 11015 "PWG_VGL_FEHLER" 11016 "PCTRL_INJ_FEHLER" 52669 "EC_LLS1_FEHLER" 52670 "EC_LLS2_FEHLER" 52671 "EC_DK1_FEHLER" 52672 "EC_DK2_FEHLER" 11021 "LLS1_SK_FEHLER" 11022 "LLS2_SK_FEHLER" 11023 "SMG_SCHALTABLAUF" 11024 "SMG_SK_FEHLER" 11025 "SMG_SK_N_UEBERWACHUNG" 11026 "TUMG_OBD_FEHLER" 11027 "V_FEHLER" 11028 "DK_INIT_FEHLER" 11029 "DK1_REG_FEHLER" 11030 "DK2_REG_FEHLER" 11031 "DK1_ADAPT_FEHLER" 11032 "DK2_ADAPT_FEHLER" 11033 "IONVERST_B1" 11034 "IONSPG_B1" 11035 "IONVERST_B2" 11036 "IONSPG_B2" 11037 "TABG1_FEHLER" 11038 "TABG2_FEHLER" 11039 "DK1_WDK_FEHLER" 11040 "DK2_WDK_FEHLER" 11041 "DK1_PDR_FEHLER" 11042 "DK2_PDR_FEHLER" 11043 "LLS1_REG_FEHLER" 11044 "LLS2_REG_FEHLER" 11045 "DK1_SK_FEHLER" 11046 "DK2_SK_FEHLER" 11047 "DK1_FT_FEHLER" 11048 "DK2_FT_FEHLER" 11049 "MD_SK_ERR" 11050 "LLS_INIT_FEHLER" 11051 "DSC_EINGR_FEHLER" 11052 "DK1_CMD_FEHLER" 11053 "DK2_CMD_FEHLER" 11054 "LLS1_CMD_FEHLER" 11055 "LLS2_CMD_FEHLER" 52673 "SC_SMG1_FEHLER" 52674 "SC_SMG2_FEHLER" 52675 "SC_SMG3_FEHLER" 52619 "SC_BUSOFF_FEHLER" 52627 "EC_BUSOFF_FEHLER" 11061 "AUSS_KAT_Z1_FEHLER" 11062 "AUSS_KAT_Z2_FEHLER" 11063 "AUSS_KAT_Z3_FEHLER" 11064 "AUSS_KAT_Z4_FEHLER" 11065 "AUSS_KAT_Z5_FEHLER" 11066 "AUSS_KAT_Z6_FEHLER" 11067 "AUSS_KAT_Z7_FEHLER" 11068 "AUSS_KAT_Z8_FEHLER" 11069 "AUSS_KAT_Z9_FEHLER" 11070 "AUSS_KAT_Z10_FEHLER" 11071 "ION_SIG_BANK_1" 11072 "ION_SIG_BANK_2" 11073 "AUSS_KAT_MULT_FEHLER" 11074 "AUSS_ABG_Z1_FEHLER" 11075 "AUSS_ABG_Z2_FEHLER" 11076 "AUSS_ABG_Z3_FEHLER" 11077 "AUSS_ABG_Z4_FEHLER" 11078 "AUSS_ABG_Z5_FEHLER" 11079 "AUSS_ABG_Z6_FEHLER" 11080 "AUSS_ABG_Z7_FEHLER" 11081 "AUSS_ABG_Z8_FEHLER" 11082 "AUSS_ABG_Z9_FEHLER" 11083 "AUSS_ABG_Z10_FEHLER" 11084 "ION_SAT_BANK_1" 11085 "ION_SAT_BANK_2" 11086 "AUSS_ABG_MULT_FEHLER" 11087 "TAN_OBD_B1_FEHLER" 11088 "DKG_EINGR_FEHLER" 11089 "SC_PKS_FEHLER" 11090 "ZOELP1_FEHLER" 11091 "ZOELP2_FEHLER" 11092 "SG_IGN_FEHLER" 11093 "EBENE2_IGN_FEHLER" 11094 "BLS_PLAU_FEHLER" 11095 "SK_MANAGER_IGN" 11096 "LLR_DIAGNOSE" 11097 "THERMOSTAT_FEHLER" 11098 "TAN_OBD_B2_FEHLER" 11099 "DK1_ZUSTAND" 11100 "DK2_ZUSTAND" 11101 "FGR_ABWURF" 11102 "PWG_BLS_FEHLER" 11103 "START_RL_FEHLER" 11104 "AFZ_FEHLER" 11105 "N_GETR_EIN_HS_FEHLER" 11106 "TUMG_FEHLER" 11107 "LLR_DIAGNOSE_CSS" 11108 "TMOT_HIGH_FEHLER" 11109 "AFZ_NA_FEHLER" 11110 "INDEX_110_IGN" 11111 "INDEX_111_IGN" 11112 "INDEX_112_IGN" 11113 "INDEX_113_IGN" 11114 "INDEX_114_IGN" 11115 "INDEX_115_IGN" 11116 "INDEX_116_IGN" 11117 "INDEX_117_IGN" 11118 "INDEX_118_IGN" 11119 "INDEX_119_IGN" 11120 "INDEX_120_IGN" 11121 "INDEX_121_IGN" 11122 "INDEX_122_IGN" 11123 "INDEX_123_IGN" 11124 "INDEX_124_IGN" 11125 "INDEX_125_IGN" 11126 "INDEX_126_IGN" 11127 "INDEX_127_IGN" /end COMPU_VTAB
/begin COMPU_METHOD FORMULA_0051 "FORMULA_0051" RAT_FUNC "%5.0" "km" COEFFS 0 1 0 0 0 8 /end COMPU_METHOD
/begin COMPU_METHOD FORMULA_0052 "FORMULA_0052" RAT_FUNC "%5.0" "-" COEFFS 0 4 0 0 0 1 /end COMPU_METHOD
/begin COMPU_METHOD FORMULA_0053 "FORMULA_0053" RAT_FUNC "%7.2" "g/s" COEFFS 0 100 0 0 0 1 /end COMPU_METHOD
/begin COMPU_METHOD FORMULA_0054 "FORMULA_0054" TAB_VERB "%3.0" "-" COMPU_TAB_REF FORMULA_0054_VTAB /end COMPU_METHOD
/begin COMPU_VTAB FORMULA_0054_VTAB "FORMULA_0054_VTAB" TAB_VERB 4 1 "Regler noch aus" 2 "Regler aktiv" 4 "Schubabschalten" 8 "Sonde defekt" /end COMPU_VTAB
/begin COMPU_METHOD FORMULA_0055 "FORMULA_0055" RAT_FUNC "%7.4" "-" COEFFS 0 128 0 0 0 1 /end COMPU_METHOD
/begin COMPU_METHOD FORMULA_0056 "FORMULA_0056" RAT_FUNC "%7.4" "%" COEFFS 0 255 0 0 0 100 /end COMPU_METHOD
/begin COMPU_METHOD FORMULA_0057 "FORMULA_0057" RAT_FUNC "%3.0" "�C" COEFFS 0 1 40 0 0 1 /end COMPU_METHOD
/begin COMPU_METHOD FORMULA_0058 "FORMULA_0058" RAT_FUNC "%3.0" "kPa" COEFFS 0 1 0 0 0 3 /end COMPU_METHOD
/begin COMPU_METHOD FORMULA_0059 "FORMULA_0059" RAT_FUNC "%3.0" "km/h" COEFFS 0 1 0 0 0 1 /end COMPU_METHOD
/begin COMPU_METHOD FORMULA_0060 "FORMULA_0060" RAT_FUNC "%4.1" "�KW" COEFFS 0 2 128 0 0 1 /end COMPU_METHOD
/begin COMPU_METHOD FORMULA_0061 "FORMULA_0061" TAB_VERB "%3.0" "-" COMPU_TAB_REF FORMULA_0061_VTAB /end COMPU_METHOD
/begin COMPU_VTAB FORMULA_0061_VTAB "FORMULA_0061_VTAB" TAB_VERB 2 1 "Einblasung" 4 "Keine Einblasung" /end COMPU_VTAB
/begin COMPU_METHOD FORMULA_0062 "FORMULA_0062" RAT_FUNC "%5.0" "s" COEFFS 0 1 0 0 0 1 /end COMPU_METHOD
/begin COMPU_METHOD FORMULA_0063 "FORMULA_0063" RAT_FUNC "%8.3" "V" COEFFS 0 1000 0 0 0 1 /end COMPU_METHOD
/begin COMPU_METHOD FORMULA_0064 "FORMULA_0064" RAT_FUNC "%9.4" "%" COEFFS 0 255 0 0 0 1 /end COMPU_METHOD
/begin COMPU_METHOD FORMULA_0065 "FORMULA_0065" RAT_FUNC "%5.2" "%" COEFFS 0 255 0 0 0 100 /end COMPU_METHOD
/begin COMPU_METHOD FORMULA_0066 "FORMULA_0066" RAT_FUNC "%3.0" "kPa" COEFFS 0 1 0 0 0 1 /end COMPU_METHOD
/begin MEASUREMENT ed_fsp_1of20_.fehlercode_nv "Externer Fehlerort" UWORD FORMULA_0050 0 0 0.0 65535.0 ECU_ADDRESS 0x3F9778 /end MEASUREMENT
/begin MEASUREMENT ed_fsp_2of20_.fehlercode_nv "Externer Fehlerort" UWORD FORMULA_0050 0 0 0.0 65535.0 ECU_ADDRESS 0x3F97CA /end MEASUREMENT
/begin MEASUREMENT ed_fsp_3of20_.fehlercode_nv "Externer Fehlerort" UWORD FORMULA_0050 0 0 0.0 65535.0 ECU_ADDRESS 0x3F981C /end MEASUREMENT
/begin MEASUREMENT ed_fsp_4of20_.fehlercode_nv "Externer Fehlerort" UWORD FORMULA_0050 0 0 0.0 65535.0 ECU_ADDRESS 0x3F986E /end MEASUREMENT
/begin MEASUREMENT ed_fsp_5of20_.fehlercode_nv "Externer Fehlerort" UWORD FORMULA_0050 0 0 0.0 65535.0 ECU_ADDRESS 0x3F98C0 /end MEASUREMENT
/begin MEASUREMENT ed_fsp_6of20_.fehlercode_nv "Externer Fehlerort" UWORD FORMULA_0050 0 0 0.0 65535.0 ECU_ADDRESS 0x3F9912 /end MEASUREMENT
/begin MEASUREMENT ed_fsp_7of20_.fehlercode_nv "Externer Fehlerort" UWORD FORMULA_0050 0 0 0.0 65535.0 ECU_ADDRESS 0x3F9964 /end MEASUREMENT
/begin MEASUREMENT ed_fsp_8of20_.fehlercode_nv "Externer Fehlerort" UWORD FORMULA_0050 0 0 0.0 65535.0 ECU_ADDRESS 0x3F99B6 /end MEASUREMENT
/begin MEASUREMENT ed_fsp_9of20_.fehlercode_nv "Externer Fehlerort" UWORD FORMULA_0050 0 0 0.0 65535.0 ECU_ADDRESS 0x3F9A08 /end MEASUREMENT
/begin MEASUREMENT ed_fsp_15of20_.fehlercode_nv "Externer Fehlerort" UWORD FORMULA_0050 0 0 0.0 65535.0 ECU_ADDRESS 0x3F9BF4 /end MEASUREMENT
/begin MEASUREMENT ed_fsp_16of20_.fehlercode_nv "Externer Fehlerort" UWORD FORMULA_0050 0 0 0.0 65535.0 ECU_ADDRESS 0x3F9C46 /end MEASUREMENT
/begin MEASUREMENT ed_fsp_17of20_.fehlercode_nv "Externer Fehlerort" UWORD FORMULA_0050 0 0 0.0 65535.0 ECU_ADDRESS 0x3F9C98 /end MEASUREMENT
/begin MEASUREMENT ed_fsp_18of20_.fehlercode_nv "Externer Fehlerort" UWORD FORMULA_0050 0 0 0.0 65535.0 ECU_ADDRESS 0x3F9CEA /end MEASUREMENT
/begin MEASUREMENT ed_fsp_19of20_.fehlercode_nv "Externer Fehlerort" UWORD FORMULA_0050 0 0 0.0 65535.0 ECU_ADDRESS 0x3F9D3C /end MEASUREMENT
/begin MEASUREMENT ed_fsp_20of20_.fehlercode_nv "Externer Fehlerort" UWORD FORMULA_0050 0 0 0.0 65535.0 ECU_ADDRESS 0x3F9D8E /end MEASUREMENT
/begin MEASUREMENT ed_fsp_1of20_.fehlerart_nv "Fehlerart und Statusbits" UWORD FORMULA_0010 0 0 0.0 65535.0000 ECU_ADDRESS 0x3F977A /end MEASUREMENT
/begin MEASUREMENT ed_fsp_2of20_.fehlerart_nv "Fehlerart und Statusbits" UWORD FORMULA_0010 0 0 0.0 65535.0000 ECU_ADDRESS 0x3F97CC /end MEASUREMENT
/begin MEASUREMENT ed_fsp_3of20_.fehlerart_nv "Fehlerart und Statusbits" UWORD FORMULA_0010 0 0 0.0 65535.0000 ECU_ADDRESS 0x3F981E /end MEASUREMENT
/begin MEASUREMENT ed_fsp_4of20_.fehlerart_nv "Fehlerart und Statusbits" UWORD FORMULA_0010 0 0 0.0 65535.0000 ECU_ADDRESS 0x3F9870 /end MEASUREMENT
/begin MEASUREMENT ed_fsp_5of20_.fehlerart_nv "Fehlerart und Statusbits" UWORD FORMULA_0010 0 0 0.0 65535.0000 ECU_ADDRESS 0x3F98C2 /end MEASUREMENT
/begin MEASUREMENT ed_fsp_6of20_.fehlerart_nv "Fehlerart und Statusbits" UWORD FORMULA_0010 0 0 0.0 65535.0000 ECU_ADDRESS 0x3F9914 /end MEASUREMENT
/begin MEASUREMENT ed_fsp_7of20_.fehlerart_nv "Fehlerart und Statusbits" UWORD FORMULA_0010 0 0 0.0 65535.0000 ECU_ADDRESS 0x3F9966 /end MEASUREMENT
/begin MEASUREMENT ed_fsp_8of20_.fehlerart_nv "Fehlerart und Statusbits" UWORD FORMULA_0010 0 0 0.0 65535.0000 ECU_ADDRESS 0x3F99B8 /end MEASUREMENT
/begin MEASUREMENT ed_fsp_9of20_.fehlerart_nv "Fehlerart und Statusbits" UWORD FORMULA_0010 0 0 0.0 65535.0000 ECU_ADDRESS 0x3F9A0A /end MEASUREMENT
/begin MEASUREMENT ed_fsp_15of20_.fehlerart_nv "Fehlerart und Statusbits" UWORD FORMULA_0010 0 0 0.0 65535.0000 ECU_ADDRESS 0x3F9BF6 /end MEASUREMENT
/begin MEASUREMENT ed_fsp_16of20_.fehlerart_nv "Fehlerart und Statusbits" UWORD FORMULA_0010 0 0 0.0 65535.0000 ECU_ADDRESS 0x3F9C48 /end MEASUREMENT
/begin MEASUREMENT ed_fsp_17of20_.fehlerart_nv "Fehlerart und Statusbits" UWORD FORMULA_0010 0 0 0.0 65535.0000 ECU_ADDRESS 0x3F9C9A /end MEASUREMENT
/begin MEASUREMENT ed_fsp_18of20_.fehlerart_nv "Fehlerart und Statusbits" UWORD FORMULA_0010 0 0 0.0 65535.0000 ECU_ADDRESS 0x3F9CEC /end MEASUREMENT
/begin MEASUREMENT ed_fsp_19of20_.fehlerart_nv "Fehlerart und Statusbits" UWORD FORMULA_0010 0 0 0.0 65535.0000 ECU_ADDRESS 0x3F9D3E /end MEASUREMENT
/begin MEASUREMENT ed_fsp_20of20_.fehlerart_nv "Fehlerart und Statusbits" UWORD FORMULA_0010 0 0 0.0 65535.0000 ECU_ADDRESS 0x3F9D90 /end MEASUREMENT
/begin MEASUREMENT ed_fsp_1of20_.haeufigkeitszaehler_nv "Uebergangszaehler von i.O. -> n.i.O" UBYTE FORMULA_0003 0 0 0.0 255.0000 ECU_ADDRESS 0x3F977C /end MEASUREMENT
/begin MEASUREMENT ed_fsp_2of20_.haeufigkeitszaehler_nv "Uebergangszaehler von i.O. -> n.i.O" UBYTE FORMULA_0003 0 0 0.0 255.0000 ECU_ADDRESS 0x3F97CE /end MEASUREMENT
/begin MEASUREMENT ed_fsp_3of20_.haeufigkeitszaehler_nv "Uebergangszaehler von i.O. -> n.i.O" UBYTE FORMULA_0003 0 0 0.0 255.0000 ECU_ADDRESS 0x3F9820 /end MEASUREMENT
/begin MEASUREMENT ed_fsp_4of20_.haeufigkeitszaehler_nv "Uebergangszaehler von i.O. -> n.i.O" UBYTE FORMULA_0003 0 0 0.0 255.0000 ECU_ADDRESS 0x3F9872 /end MEASUREMENT
/begin MEASUREMENT ed_fsp_5of20_.haeufigkeitszaehler_nv "Uebergangszaehler von i.O. -> n.i.O" UBYTE FORMULA_0003 0 0 0.0 255.0000 ECU_ADDRESS 0x3F98C4 /end MEASUREMENT
/begin MEASUREMENT ed_fsp_6of20_.haeufigkeitszaehler_nv "Uebergangszaehler von i.O. -> n.i.O" UBYTE FORMULA_0003 0 0 0.0 255.0000 ECU_ADDRESS 0x3F9916 /end MEASUREMENT
/begin MEASUREMENT ed_fsp_7of20_.haeufigkeitszaehler_nv "Uebergangszaehler von i.O. -> n.i.O" UBYTE FORMULA_0003 0 0 0.0 255.0000 ECU_ADDRESS 0x3F9968 /end MEASUREMENT
/begin MEASUREMENT ed_fsp_8of20_.haeufigkeitszaehler_nv "Uebergangszaehler von i.O. -> n.i.O" UBYTE FORMULA_0003 0 0 0.0 255.0000 ECU_ADDRESS 0x3F99BA /end MEASUREMENT
/begin MEASUREMENT ed_fsp_9of20_.haeufigkeitszaehler_nv "Uebergangszaehler von i.O. -> n.i.O" UBYTE FORMULA_0003 0 0 0.0 255.0000 ECU_ADDRESS 0x3F9A0C /end MEASUREMENT
/begin MEASUREMENT ed_fsp_14of20_.haeufigkeitszaehler_nv "Uebergangszaehler von i.O. -> n.i.O" UBYTE FORMULA_0003 0 0 0.0 255.0000 ECU_ADDRESS 0x3F9BA6 /end MEASUREMENT
/begin MEASUREMENT ed_fsp_15of20_.haeufigkeitszaehler_nv "Uebergangszaehler von i.O. -> n.i.O" UBYTE FORMULA_0003 0 0 0.0 255.0000 ECU_ADDRESS 0x3F9BF8 /end MEASUREMENT
/begin MEASUREMENT ed_fsp_16of20_.haeufigkeitszaehler_nv "Uebergangszaehler von i.O. -> n.i.O" UBYTE FORMULA_0003 0 0 0.0 255.0000 ECU_ADDRESS 0x3F9C4A /end MEASUREMENT
/begin MEASUREMENT ed_fsp_17of20_.haeufigkeitszaehler_nv "Uebergangszaehler von i.O. -> n.i.O" UBYTE FORMULA_0003 0 0 0.0 255.0000 ECU_ADDRESS 0x3F9C9C /end MEASUREMENT
/begin MEASUREMENT ed_fsp_18of20_.haeufigkeitszaehler_nv "Uebergangszaehler von i.O. -> n.i.O" UBYTE FORMULA_0003 0 0 0.0 255.0000 ECU_ADDRESS 0x3F9CEE /end MEASUREMENT
/begin MEASUREMENT ed_fsp_19of20_.haeufigkeitszaehler_nv "Uebergangszaehler von i.O. -> n.i.O" UBYTE FORMULA_0003 0 0 0.0 255.0000 ECU_ADDRESS 0x3F9D40 /end MEASUREMENT
/begin MEASUREMENT ed_fsp_20of20_.haeufigkeitszaehler_nv "Uebergangszaehler von i.O. -> n.i.O" UBYTE FORMULA_0003 0 0 0.0 255.0000 ECU_ADDRESS 0x3F9D92 /end MEASUREMENT
/begin MEASUREMENT ed_fsp_1of20_.logistikzaehler_nv "Warm-Up-Cycling-Zaehler" UBYTE FORMULA_0003 0 0 0.0 255.0000 ECU_ADDRESS 0x3F977D /end MEASUREMENT
/begin MEASUREMENT ed_fsp_2of20_.logistikzaehler_nv "Warm-Up-Cycling-Zaehler" UBYTE FORMULA_0003 0 0 0.0 255.0000 ECU_ADDRESS 0x3F97CF /end MEASUREMENT
/begin MEASUREMENT ed_fsp_3of20_.logistikzaehler_nv "Warm-Up-Cycling-Zaehler" UBYTE FORMULA_0003 0 0 0.0 255.0000 ECU_ADDRESS 0x3F9821 /end MEASUREMENT
/begin MEASUREMENT ed_fsp_4of20_.logistikzaehler_nv "Warm-Up-Cycling-Zaehler" UBYTE FORMULA_0003 0 0 0.0 255.0000 ECU_ADDRESS 0x3F9873 /end MEASUREMENT
/begin MEASUREMENT ed_fsp_5of20_.logistikzaehler_nv "Warm-Up-Cycling-Zaehler" UBYTE FORMULA_0003 0 0 0.0 255.0000 ECU_ADDRESS 0x3F98C5 /end MEASUREMENT
/begin MEASUREMENT ed_fsp_6of20_.logistikzaehler_nv "Warm-Up-Cycling-Zaehler" UBYTE FORMULA_0003 0 0 0.0 255.0000 ECU_ADDRESS 0x3F9917 /end MEASUREMENT
/begin MEASUREMENT ed_fsp_7of20_.logistikzaehler_nv "Warm-Up-Cycling-Zaehler" UBYTE FORMULA_0003 0 0 0.0 255.0000 ECU_ADDRESS 0x3F9969 /end MEASUREMENT
/begin MEASUREMENT ed_fsp_8of20_.logistikzaehler_nv "Warm-Up-Cycling-Zaehler" UBYTE FORMULA_0003 0 0 0.0 255.0000 ECU_ADDRESS 0x3F99BB /end MEASUREMENT
/begin MEASUREMENT ed_fsp_9of20_.logistikzaehler_nv "Warm-Up-Cycling-Zaehler" UBYTE FORMULA_0003 0 0 0.0 255.0000 ECU_ADDRESS 0x3F9A0D /end MEASUREMENT
/begin MEASUREMENT ed_fsp_14of20_.logistikzaehler_nv "Warm-Up-Cycling-Zaehler" UBYTE FORMULA_0003 0 0 0.0 255.0000 ECU_ADDRESS 0x3F9BA7 /end MEASUREMENT
/begin MEASUREMENT ed_fsp_15of20_.logistikzaehler_nv "Warm-Up-Cycling-Zaehler" UBYTE FORMULA_0003 0 0 0.0 255.0000 ECU_ADDRESS 0x3F9BF9 /end MEASUREMENT
/begin MEASUREMENT ed_fsp_16of20_.logistikzaehler_nv "Warm-Up-Cycling-Zaehler" UBYTE FORMULA_0003 0 0 0.0 255.0000 ECU_ADDRESS 0x3F9C4B /end MEASUREMENT
/begin MEASUREMENT ed_fsp_17of20_.logistikzaehler_nv "Warm-Up-Cycling-Zaehler" UBYTE FORMULA_0003 0 0 0.0 255.0000 ECU_ADDRESS 0x3F9C9D /end MEASUREMENT
/begin MEASUREMENT ed_fsp_18of20_.logistikzaehler_nv "Warm-Up-Cycling-Zaehler" UBYTE FORMULA_0003 0 0 0.0 255.0000 ECU_ADDRESS 0x3F9CEF /end MEASUREMENT
/begin MEASUREMENT ed_fsp_19of20_.logistikzaehler_nv "Warm-Up-Cycling-Zaehler" UBYTE FORMULA_0003 0 0 0.0 255.0000 ECU_ADDRESS 0x3F9D41 /end MEASUREMENT
/begin MEASUREMENT ed_fsp_20of20_.logistikzaehler_nv "Warm-Up-Cycling-Zaehler" UBYTE FORMULA_0003 0 0 0.0 255.0000 ECU_ADDRESS 0x3F9D93 /end MEASUREMENT
/begin MEASUREMENT ed_fsp_1of20_.uw_satz_1of3_.uw_km_stand_nv "Kilometerstand beim Fehlereintrag" UWORD FORMULA_0051 0 0 0.0 524280.0000 ECU_ADDRESS 0x3F977E /end MEASUREMENT
/begin MEASUREMENT ed_fsp_1of20_.uw_satz_2of3_.uw_km_stand_nv "Kilometerstand beim Fehlereintrag" UWORD FORMULA_0051 0 0 0.0 524280.0000 ECU_ADDRESS 0x3F9788 /end MEASUREMENT
/begin MEASUREMENT ed_fsp_1of20_.uw_satz_3of3_.uw_km_stand_nv "Kilometerstand beim Fehlereintrag" UWORD FORMULA_0051 0 0 0.0 524280.0000 ECU_ADDRESS 0x3F9792 /end MEASUREMENT
/begin MEASUREMENT ed_fsp_2of20_.uw_satz_1of3_.uw_km_stand_nv "Kilometerstand beim Fehlereintrag" UWORD FORMULA_0051 0 0 0.0 524280.0000 ECU_ADDRESS 0x3F97D0 /end MEASUREMENT
/begin MEASUREMENT ed_fsp_2of20_.uw_satz_2of3_.uw_km_stand_nv "Kilometerstand beim Fehlereintrag" UWORD FORMULA_0051 0 0 0.0 524280.0000 ECU_ADDRESS 0x3F97DA /end MEASUREMENT
/begin MEASUREMENT ed_fsp_2of20_.uw_satz_3of3_.uw_km_stand_nv "Kilometerstand beim Fehlereintrag" UWORD FORMULA_0051 0 0 0.0 524280.0000 ECU_ADDRESS 0x3F97E4 /end MEASUREMENT
/begin MEASUREMENT ed_fsp_3of20_.uw_satz_1of3_.uw_km_stand_nv "Kilometerstand beim Fehlereintrag" UWORD FORMULA_0051 0 0 0.0 524280.0000 ECU_ADDRESS 0x3F9822 /end MEASUREMENT
/begin MEASUREMENT ed_fsp_3of20_.uw_satz_2of3_.uw_km_stand_nv "Kilometerstand beim Fehlereintrag" UWORD FORMULA_0051 0 0 0.0 524280.0000 ECU_ADDRESS 0x3F982C /end MEASUREMENT
/begin MEASUREMENT ed_fsp_3of20_.uw_satz_3of3_.uw_km_stand_nv "Kilometerstand beim Fehlereintrag" UWORD FORMULA_0051 0 0 0.0 524280.0000 ECU_ADDRESS 0x3F9836 /end MEASUREMENT
/begin MEASUREMENT ed_fsp_4of20_.uw_satz_1of3_.uw_km_stand_nv "Kilometerstand beim Fehlereintrag" UWORD FORMULA_0051 0 0 0.0 524280.0000 ECU_ADDRESS 0x3F9874 /end MEASUREMENT
/begin MEASUREMENT ed_fsp_4of20_.uw_satz_2of3_.uw_km_stand_nv "Kilometerstand beim Fehlereintrag" UWORD FORMULA_0051 0 0 0.0 524280.0000 ECU_ADDRESS 0x3F987E /end MEASUREMENT
/begin MEASUREMENT ed_fsp_4of20_.uw_satz_3of3_.uw_km_stand_nv "Kilometerstand beim Fehlereintrag" UWORD FORMULA_0051 0 0 0.0 524280.0000 ECU_ADDRESS 0x3F9888 /end MEASUREMENT
/begin MEASUREMENT ed_fsp_5of20_.uw_satz_1of3_.uw_km_stand_nv "Kilometerstand beim Fehlereintrag" UWORD FORMULA_0051 0 0 0.0 524280.0000 ECU_ADDRESS 0x3F98C6 /end MEASUREMENT
/begin MEASUREMENT ed_fsp_5of20_.uw_satz_2of3_.uw_km_stand_nv "Kilometerstand beim Fehlereintrag" UWORD FORMULA_0051 0 0 0.0 524280.0000 ECU_ADDRESS 0x3F98D0 /end MEASUREMENT
/begin MEASUREMENT ed_fsp_5of20_.uw_satz_3of3_.uw_km_stand_nv "Kilometerstand beim Fehlereintrag" UWORD FORMULA_0051 0 0 0.0 524280.0000 ECU_ADDRESS 0x3F98DA /end MEASUREMENT
/begin MEASUREMENT ed_fsp_6of20_.uw_satz_1of3_.uw_km_stand_nv "Kilometerstand beim Fehlereintrag" UWORD FORMULA_0051 0 0 0.0 524280.0000 ECU_ADDRESS 0x3F9918 /end MEASUREMENT
/begin MEASUREMENT ed_fsp_6of20_.uw_satz_2of3_.uw_km_stand_nv "Kilometerstand beim Fehlereintrag" UWORD FORMULA_0051 0 0 0.0 524280.0000 ECU_ADDRESS 0x3F9922 /end MEASUREMENT
/begin MEASUREMENT ed_fsp_6of20_.uw_satz_3of3_.uw_km_stand_nv "Kilometerstand beim Fehlereintrag" UWORD FORMULA_0051 0 0 0.0 524280.0000 ECU_ADDRESS 0x3F992C /end MEASUREMENT
/begin MEASUREMENT ed_fsp_7of20_.uw_satz_1of3_.uw_km_stand_nv "Kilometerstand beim Fehlereintrag" UWORD FORMULA_0051 0 0 0.0 524280.0000 ECU_ADDRESS 0x3F996A /end MEASUREMENT
/begin MEASUREMENT ed_fsp_7of20_.uw_satz_2of3_.uw_km_stand_nv "Kilometerstand beim Fehlereintrag" UWORD FORMULA_0051 0 0 0.0 524280.0000 ECU_ADDRESS 0x3F9974 /end MEASUREMENT
/begin MEASUREMENT ed_fsp_7of20_.uw_satz_3of3_.uw_km_stand_nv "Kilometerstand beim Fehlereintrag" UWORD FORMULA_0051 0 0 0.0 524280.0000 ECU_ADDRESS 0x3F997E /end MEASUREMENT
/begin MEASUREMENT ed_fsp_8of20_.uw_satz_1of3_.uw_km_stand_nv "Kilometerstand beim Fehlereintrag" UWORD FORMULA_0051 0 0 0.0 524280.0000 ECU_ADDRESS 0x3F99BC /end MEASUREMENT
/begin MEASUREMENT ed_fsp_8of20_.uw_satz_2of3_.uw_km_stand_nv "Kilometerstand beim Fehlereintrag" UWORD FORMULA_0051 0 0 0.0 524280.0000 ECU_ADDRESS 0x3F99C6 /end MEASUREMENT
/begin MEASUREMENT ed_fsp_8of20_.uw_satz_3of3_.uw_km_stand_nv "Kilometerstand beim Fehlereintrag" UWORD FORMULA_0051 0 0 0.0 524280.0000 ECU_ADDRESS 0x3F99D0 /end MEASUREMENT
/begin MEASUREMENT ed_fsp_9of20_.uw_satz_1of3_.uw_km_stand_nv "Kilometerstand beim Fehlereintrag" UWORD FORMULA_0051 0 0 0.0 524280.0000 ECU_ADDRESS 0x3F9A0E /end MEASUREMENT
/begin MEASUREMENT ed_fsp_9of20_.uw_satz_2of3_.uw_km_stand_nv "Kilometerstand beim Fehlereintrag" UWORD FORMULA_0051 0 0 0.0 524280.0000 ECU_ADDRESS 0x3F9A18 /end MEASUREMENT
/begin MEASUREMENT ed_fsp_14of20_.uw_satz_1of3_.uw_km_stand_nv "Kilometerstand beim Fehlereintrag" UWORD FORMULA_0051 0 0 0.0 524280.0000 ECU_ADDRESS 0x3F9BA8 /end MEASUREMENT
/begin MEASUREMENT ed_fsp_14of20_.uw_satz_2of3_.uw_km_stand_nv "Kilometerstand beim Fehlereintrag" UWORD FORMULA_0051 0 0 0.0 524280.0000 ECU_ADDRESS 0x3F9BB2 /end MEASUREMENT
/begin MEASUREMENT ed_fsp_14of20_.uw_satz_3of3_.uw_km_stand_nv "Kilometerstand beim Fehlereintrag" UWORD FORMULA_0051 0 0 0.0 524280.0000 ECU_ADDRESS 0x3F9BBC /end MEASUREMENT
/begin MEASUREMENT ed_fsp_15of20_.uw_satz_1of3_.uw_km_stand_nv "Kilometerstand beim Fehlereintrag" UWORD FORMULA_0051 0 0 0.0 524280.0000 ECU_ADDRESS 0x3F9BFA /end MEASUREMENT
/begin MEASUREMENT ed_fsp_15of20_.uw_satz_2of3_.uw_km_stand_nv "Kilometerstand beim Fehlereintrag" UWORD FORMULA_0051 0 0 0.0 524280.0000 ECU_ADDRESS 0x3F9C04 /end MEASUREMENT
/begin MEASUREMENT ed_fsp_15of20_.uw_satz_3of3_.uw_km_stand_nv "Kilometerstand beim Fehlereintrag" UWORD FORMULA_0051 0 0 0.0 524280.0000 ECU_ADDRESS 0x3F9C0E /end MEASUREMENT
/begin MEASUREMENT ed_fsp_16of20_.uw_satz_1of3_.uw_km_stand_nv "Kilometerstand beim Fehlereintrag" UWORD FORMULA_0051 0 0 0.0 524280.0000 ECU_ADDRESS 0x3F9C4C /end MEASUREMENT
/begin MEASUREMENT ed_fsp_16of20_.uw_satz_2of3_.uw_km_stand_nv "Kilometerstand beim Fehlereintrag" UWORD FORMULA_0051 0 0 0.0 524280.0000 ECU_ADDRESS 0x3F9C56 /end MEASUREMENT
/begin MEASUREMENT ed_fsp_16of20_.uw_satz_3of3_.uw_km_stand_nv "Kilometerstand beim Fehlereintrag" UWORD FORMULA_0051 0 0 0.0 524280.0000 ECU_ADDRESS 0x3F9C60 /end MEASUREMENT
/begin MEASUREMENT ed_fsp_17of20_.uw_satz_1of3_.uw_km_stand_nv "Kilometerstand beim Fehlereintrag" UWORD FORMULA_0051 0 0 0.0 524280.0000 ECU_ADDRESS 0x3F9C9E /end MEASUREMENT
/begin MEASUREMENT ed_fsp_17of20_.uw_satz_2of3_.uw_km_stand_nv "Kilometerstand beim Fehlereintrag" UWORD FORMULA_0051 0 0 0.0 524280.0000 ECU_ADDRESS 0x3F9CA8 /end MEASUREMENT
/begin MEASUREMENT ed_fsp_17of20_.uw_satz_3of3_.uw_km_stand_nv "Kilometerstand beim Fehlereintrag" UWORD FORMULA_0051 0 0 0.0 524280.0000 ECU_ADDRESS 0x3F9CB2 /end MEASUREMENT
/begin MEASUREMENT ed_fsp_18of20_.uw_satz_1of3_.uw_km_stand_nv "Kilometerstand beim Fehlereintrag" UWORD FORMULA_0051 0 0 0.0 524280.0000 ECU_ADDRESS 0x3F9CF0 /end MEASUREMENT
/begin MEASUREMENT ed_fsp_18of20_.uw_satz_2of3_.uw_km_stand_nv "Kilometerstand beim Fehlereintrag" UWORD FORMULA_0051 0 0 0.0 524280.0000 ECU_ADDRESS 0x3F9CFA /end MEASUREMENT
/begin MEASUREMENT ed_fsp_18of20_.uw_satz_3of3_.uw_km_stand_nv "Kilometerstand beim Fehlereintrag" UWORD FORMULA_0051 0 0 0.0 524280.0000 ECU_ADDRESS 0x3F9D04 /end MEASUREMENT
/begin MEASUREMENT ed_fsp_19of20_.uw_satz_1of3_.uw_km_stand_nv "Kilometerstand beim Fehlereintrag" UWORD FORMULA_0051 0 0 0.0 524280.0000 ECU_ADDRESS 0x3F9D42 /end MEASUREMENT
/begin MEASUREMENT ed_fsp_19of20_.uw_satz_2of3_.uw_km_stand_nv "Kilometerstand beim Fehlereintrag" UWORD FORMULA_0051 0 0 0.0 524280.0000 ECU_ADDRESS 0x3F9D4C /end MEASUREMENT
/begin MEASUREMENT ed_fsp_19of20_.uw_satz_3of3_.uw_km_stand_nv "Kilometerstand beim Fehlereintrag" UWORD FORMULA_0051 0 0 0.0 524280.0000 ECU_ADDRESS 0x3F9D56 /end MEASUREMENT
/begin MEASUREMENT ed_fsp_20of20_.uw_satz_1of3_.uw_km_stand_nv "Kilometerstand beim Fehlereintrag" UWORD FORMULA_0051 0 0 0.0 524280.0000 ECU_ADDRESS 0x3F9D94 /end MEASUREMENT
/begin MEASUREMENT ed_fsp_20of20_.uw_satz_2of3_.uw_km_stand_nv "Kilometerstand beim Fehlereintrag" UWORD FORMULA_0051 0 0 0.0 524280.0000 ECU_ADDRESS 0x3F9D9E /end MEASUREMENT
/begin MEASUREMENT ed_fsp_20of20_.uw_satz_3of3_.uw_km_stand_nv "Kilometerstand beim Fehlereintrag" UWORD FORMULA_0051 0 0 0.0 524280.0000 ECU_ADDRESS 0x3F9DA8 /end MEASUREMENT
/begin MEASUREMENT ed_fsp_1of20_.uw_satz_1of3_.uw_wert_nv_1of4_ "Umweltbedingung beim Fehlereintrag" UWORD FORMULA_0010 0 0 0.0 65535.0000 ECU_ADDRESS 0x3F9780 /end MEASUREMENT
/begin MEASUREMENT ed_fsp_1of20_.uw_satz_1of3_.uw_wert_nv_2of4_ "Umweltbedingung beim Fehlereintrag" UWORD FORMULA_0010 0 0 0.0 65535.0000 ECU_ADDRESS 0x3F9782 /end MEASUREMENT
/begin MEASUREMENT ed_fsp_1of20_.uw_satz_1of3_.uw_wert_nv_3of4_ "Umweltbedingung beim Fehlereintrag" UWORD FORMULA_0010 0 0 0.0 65535.0000 ECU_ADDRESS 0x3F9784 /end MEASUREMENT
/begin MEASUREMENT ed_fsp_1of20_.uw_satz_1of3_.uw_wert_nv_4of4_ "Umweltbedingung beim Fehlereintrag" UWORD FORMULA_0010 0 0 0.0 65535.0000 ECU_ADDRESS 0x3F9786 /end MEASUREMENT
/begin MEASUREMENT ed_fsp_1of20_.uw_satz_2of3_.uw_wert_nv_1of4_ "Umweltbedingung beim Fehlereintrag" UWORD FORMULA_0010 0 0 0.0 65535.0000 ECU_ADDRESS 0x3F978A /end MEASUREMENT
/begin MEASUREMENT ed_fsp_1of20_.uw_satz_2of3_.uw_wert_nv_2of4_ "Umweltbedingung beim Fehlereintrag" UWORD FORMULA_0010 0 0 0.0 65535.0000 ECU_ADDRESS 0x3F978C /end MEASUREMENT
/begin MEASUREMENT ed_fsp_1of20_.uw_satz_2of3_.uw_wert_nv_3of4_ "Umweltbedingung beim Fehlereintrag" UWORD FORMULA_0010 0 0 0.0 65535.0000 ECU_ADDRESS 0x3F978E /end MEASUREMENT
/begin MEASUREMENT ed_fsp_1of20_.uw_satz_2of3_.uw_wert_nv_4of4_ "Umweltbedingung beim Fehlereintrag" UWORD FORMULA_0010 0 0 0.0 65535.0000 ECU_ADDRESS 0x3F9790 /end MEASUREMENT
/begin MEASUREMENT ed_fsp_1of20_.uw_satz_3of3_.uw_wert_nv_1of4_ "Umweltbedingung beim Fehlereintrag" UWORD FORMULA_0010 0 0 0.0 65535.0000 ECU_ADDRESS 0x3F9794 /end MEASUREMENT
/begin MEASUREMENT ed_fsp_1of20_.uw_satz_3of3_.uw_wert_nv_2of4_ "Umweltbedingung beim Fehlereintrag" UWORD FORMULA_0010 0 0 0.0 65535.0000 ECU_ADDRESS 0x3F9796 /end MEASUREMENT
/begin MEASUREMENT ed_fsp_1of20_.uw_satz_3of3_.uw_wert_nv_3of4_ "Umweltbedingung beim Fehlereintrag" UWORD FORMULA_0010 0 0 0.0 65535.0000 ECU_ADDRESS 0x3F9798 /end MEASUREMENT
/begin MEASUREMENT ed_fsp_1of20_.uw_satz_3of3_.uw_wert_nv_4of4_ "Umweltbedingung beim Fehlereintrag" UWORD FORMULA_0010 0 0 0.0 65535.0000 ECU_ADDRESS 0x3F979A /end MEASUREMENT
/begin MEASUREMENT ed_fsp_2of20_.uw_satz_1of3_.uw_wert_nv_1of4_ "Umweltbedingung beim Fehlereintrag" UWORD FORMULA_0010 0 0 0.0 65535.0000 ECU_ADDRESS 0x3F97D2 /end MEASUREMENT
/begin MEASUREMENT ed_fsp_2of20_.uw_satz_1of3_.uw_wert_nv_2of4_ "Umweltbedingung beim Fehlereintrag" UWORD FORMULA_0010 0 0 0.0 65535.0000 ECU_ADDRESS 0x3F97D4 /end MEASUREMENT
/begin MEASUREMENT ed_fsp_2of20_.uw_satz_1of3_.uw_wert_nv_3of4_ "Umweltbedingung beim Fehlereintrag" UWORD FORMULA_0010 0 0 0.0 65535.0000 ECU_ADDRESS 0x3F97D6 /end MEASUREMENT
/begin MEASUREMENT ed_fsp_2of20_.uw_satz_1of3_.uw_wert_nv_4of4_ "Umweltbedingung beim Fehlereintrag" UWORD FORMULA_0010 0 0 0.0 65535.0000 ECU_ADDRESS 0x3F97D8 /end MEASUREMENT
/begin MEASUREMENT ed_fsp_2of20_.uw_satz_2of3_.uw_wert_nv_1of4_ "Umweltbedingung beim Fehlereintrag" UWORD FORMULA_0010 0 0 0.0 65535.0000 ECU_ADDRESS 0x3F97DC /end MEASUREMENT
/begin MEASUREMENT ed_fsp_2of20_.uw_satz_2of3_.uw_wert_nv_2of4_ "Umweltbedingung beim Fehlereintrag" UWORD FORMULA_0010 0 0 0.0 65535.0000 ECU_ADDRESS 0x3F97DE /end MEASUREMENT
/begin MEASUREMENT ed_fsp_2of20_.uw_satz_2of3_.uw_wert_nv_3of4_ "Umweltbedingung beim Fehlereintrag" UWORD FORMULA_0010 0 0 0.0 65535.0000 ECU_ADDRESS 0x3F97E0 /end MEASUREMENT
/begin MEASUREMENT ed_fsp_2of20_.uw_satz_2of3_.uw_wert_nv_4of4_ "Umweltbedingung beim Fehlereintrag" UWORD FORMULA_0010 0 0 0.0 65535.0000 ECU_ADDRESS 0x3F97E2 /end MEASUREMENT
/begin MEASUREMENT ed_fsp_2of20_.uw_satz_3of3_.uw_wert_nv_1of4_ "Umweltbedingung beim Fehlereintrag" UWORD FORMULA_0010 0 0 0.0 65535.0000 ECU_ADDRESS 0x3F97E6 /end MEASUREMENT
/begin MEASUREMENT ed_fsp_2of20_.uw_satz_3of3_.uw_wert_nv_2of4_ "Umweltbedingung beim Fehlereintrag" UWORD FORMULA_0010 0 0 0.0 65535.0000 ECU_ADDRESS 0x3F97E8 /end MEASUREMENT
/begin MEASUREMENT ed_fsp_2of20_.uw_satz_3of3_.uw_wert_nv_3of4_ "Umweltbedingung beim Fehlereintrag" UWORD FORMULA_0010 0 0 0.0 65535.0000 ECU_ADDRESS 0x3F97EA /end MEASUREMENT
/begin MEASUREMENT ed_fsp_2of20_.uw_satz_3of3_.uw_wert_nv_4of4_ "Umweltbedingung beim Fehlereintrag" UWORD FORMULA_0010 0 0 0.0 65535.0000 ECU_ADDRESS 0x3F97EC /end MEASUREMENT
/begin MEASUREMENT ed_fsp_3of20_.uw_satz_1of3_.uw_wert_nv_1of4_ "Umweltbedingung beim Fehlereintrag" UWORD FORMULA_0010 0 0 0.0 65535.0000 ECU_ADDRESS 0x3F9824 /end MEASUREMENT
/begin MEASUREMENT ed_fsp_3of20_.uw_satz_1of3_.uw_wert_nv_2of4_ "Umweltbedingung beim Fehlereintrag" UWORD FORMULA_0010 0 0 0.0 65535.0000 ECU_ADDRESS 0x3F9826 /end MEASUREMENT
/begin MEASUREMENT ed_fsp_3of20_.uw_satz_1of3_.uw_wert_nv_3of4_ "Umweltbedingung beim Fehlereintrag" UWORD FORMULA_0010 0 0 0.0 65535.0000 ECU_ADDRESS 0x3F9828 /end MEASUREMENT
/begin MEASUREMENT ed_fsp_3of20_.uw_satz_1of3_.uw_wert_nv_4of4_ "Umweltbedingung beim Fehlereintrag" UWORD FORMULA_0010 0 0 0.0 65535.0000 ECU_ADDRESS 0x3F982A /end MEASUREMENT
/begin MEASUREMENT ed_fsp_3of20_.uw_satz_2of3_.uw_wert_nv_1of4_ "Umweltbedingung beim Fehlereintrag" UWORD FORMULA_0010 0 0 0.0 65535.0000 ECU_ADDRESS 0x3F982E /end MEASUREMENT
/begin MEASUREMENT ed_fsp_3of20_.uw_satz_2of3_.uw_wert_nv_2of4_ "Umweltbedingung beim Fehlereintrag" UWORD FORMULA_0010 0 0 0.0 65535.0000 ECU_ADDRESS 0x3F9830 /end MEASUREMENT
/begin MEASUREMENT ed_fsp_3of20_.uw_satz_2of3_.uw_wert_nv_3of4_ "Umweltbedingung beim Fehlereintrag" UWORD FORMULA_0010 0 0 0.0 65535.0000 ECU_ADDRESS 0x3F9832 /end MEASUREMENT
/begin MEASUREMENT ed_fsp_3of20_.uw_satz_2of3_.uw_wert_nv_4of4_ "Umweltbedingung beim Fehlereintrag" UWORD FORMULA_0010 0 0 0.0 65535.0000 ECU_ADDRESS 0x3F9834 /end MEASUREMENT
/begin MEASUREMENT ed_fsp_3of20_.uw_satz_3of3_.uw_wert_nv_1of4_ "Umweltbedingung beim Fehlereintrag" UWORD FORMULA_0010 0 0 0.0 65535.0000 ECU_ADDRESS 0x3F9838 /end MEASUREMENT
/begin MEASUREMENT ed_fsp_3of20_.uw_satz_3of3_.uw_wert_nv_2of4_ "Umweltbedingung beim Fehlereintrag" UWORD FORMULA_0010 0 0 0.0 65535.0000 ECU_ADDRESS 0x3F983A /end MEASUREMENT
/begin MEASUREMENT ed_fsp_3of20_.uw_satz_3of3_.uw_wert_nv_3of4_ "Umweltbedingung beim Fehlereintrag" UWORD FORMULA_0010 0 0 0.0 65535.0000 ECU_ADDRESS 0x3F983C /end MEASUREMENT
/begin MEASUREMENT ed_fsp_3of20_.uw_satz_3of3_.uw_wert_nv_4of4_ "Umweltbedingung beim Fehlereintrag" UWORD FORMULA_0010 0 0 0.0 65535.0000 ECU_ADDRESS 0x3F983E /end MEASUREMENT
/begin MEASUREMENT ed_fsp_4of20_.uw_satz_1of3_.uw_wert_nv_1of4_ "Umweltbedingung beim Fehlereintrag" UWORD FORMULA_0010 0 0 0.0 65535.0000 ECU_ADDRESS 0x3F9876 /end MEASUREMENT
/begin MEASUREMENT ed_fsp_4of20_.uw_satz_1of3_.uw_wert_nv_2of4_ "Umweltbedingung beim Fehlereintrag" UWORD FORMULA_0010 0 0 0.0 65535.0000 ECU_ADDRESS 0x3F9878 /end MEASUREMENT
/begin MEASUREMENT ed_fsp_4of20_.uw_satz_1of3_.uw_wert_nv_3of4_ "Umweltbedingung beim Fehlereintrag" UWORD FORMULA_0010 0 0 0.0 65535.0000 ECU_ADDRESS 0x3F987A /end MEASUREMENT
/begin MEASUREMENT ed_fsp_4of20_.uw_satz_1of3_.uw_wert_nv_4of4_ "Umweltbedingung beim Fehlereintrag" UWORD FORMULA_0010 0 0 0.0 65535.0000 ECU_ADDRESS 0x3F987C /end MEASUREMENT
/begin MEASUREMENT ed_fsp_4of20_.uw_satz_2of3_.uw_wert_nv_1of4_ "Umweltbedingung beim Fehlereintrag" UWORD FORMULA_0010 0 0 0.0 65535.0000 ECU_ADDRESS 0x3F9880 /end MEASUREMENT
/begin MEASUREMENT ed_fsp_4of20_.uw_satz_2of3_.uw_wert_nv_2of4_ "Umweltbedingung beim Fehlereintrag" UWORD FORMULA_0010 0 0 0.0 65535.0000 ECU_ADDRESS 0x3F9882 /end MEASUREMENT
/begin MEASUREMENT ed_fsp_4of20_.uw_satz_2of3_.uw_wert_nv_3of4_ "Umweltbedingung beim Fehlereintrag" UWORD FORMULA_0010 0 0 0.0 65535.0000 ECU_ADDRESS 0x3F9884 /end MEASUREMENT
/begin MEASUREMENT ed_fsp_4of20_.uw_satz_2of3_.uw_wert_nv_4of4_ "Umweltbedingung beim Fehlereintrag" UWORD FORMULA_0010 0 0 0.0 65535.0000 ECU_ADDRESS 0x3F9886 /end MEASUREMENT
/begin MEASUREMENT ed_fsp_4of20_.uw_satz_3of3_.uw_wert_nv_1of4_ "Umweltbedingung beim Fehlereintrag" UWORD FORMULA_0010 0 0 0.0 65535.0000 ECU_ADDRESS 0x3F988A /end MEASUREMENT
/begin MEASUREMENT ed_fsp_4of20_.uw_satz_3of3_.uw_wert_nv_2of4_ "Umweltbedingung beim Fehlereintrag" UWORD FORMULA_0010 0 0 0.0 65535.0000 ECU_ADDRESS 0x3F988C /end MEASUREMENT
/begin MEASUREMENT ed_fsp_4of20_.uw_satz_3of3_.uw_wert_nv_3of4_ "Umweltbedingung beim Fehlereintrag" UWORD FORMULA_0010 0 0 0.0 65535.0000 ECU_ADDRESS 0x3F988E /end MEASUREMENT
/begin MEASUREMENT ed_fsp_4of20_.uw_satz_3of3_.uw_wert_nv_4of4_ "Umweltbedingung beim Fehlereintrag" UWORD FORMULA_0010 0 0 0.0 65535.0000 ECU_ADDRESS 0x3F9890 /end MEASUREMENT
/begin MEASUREMENT ed_fsp_5of20_.uw_satz_1of3_.uw_wert_nv_1of4_ "Umweltbedingung beim Fehlereintrag" UWORD FORMULA_0010 0 0 0.0 65535.0000 ECU_ADDRESS 0x3F98C8 /end MEASUREMENT
/begin MEASUREMENT ed_fsp_5of20_.uw_satz_1of3_.uw_wert_nv_2of4_ "Umweltbedingung beim Fehlereintrag" UWORD FORMULA_0010 0 0 0.0 65535.0000 ECU_ADDRESS 0x3F98CA /end MEASUREMENT
/begin MEASUREMENT ed_fsp_5of20_.uw_satz_1of3_.uw_wert_nv_3of4_ "Umweltbedingung beim Fehlereintrag" UWORD FORMULA_0010 0 0 0.0 65535.0000 ECU_ADDRESS 0x3F98CC /end MEASUREMENT
/begin MEASUREMENT ed_fsp_5of20_.uw_satz_1of3_.uw_wert_nv_4of4_ "Umweltbedingung beim Fehlereintrag" UWORD FORMULA_0010 0 0 0.0 65535.0000 ECU_ADDRESS 0x3F98CE /end MEASUREMENT
/begin MEASUREMENT ed_fsp_5of20_.uw_satz_2of3_.uw_wert_nv_1of4_ "Umweltbedingung beim Fehlereintrag" UWORD FORMULA_0010 0 0 0.0 65535.0000 ECU_ADDRESS 0x3F98D2 /end MEASUREMENT
/begin MEASUREMENT ed_fsp_5of20_.uw_satz_2of3_.uw_wert_nv_2of4_ "Umweltbedingung beim Fehlereintrag" UWORD FORMULA_0010 0 0 0.0 65535.0000 ECU_ADDRESS 0x3F98D4 /end MEASUREMENT
/begin MEASUREMENT ed_fsp_5of20_.uw_satz_2of3_.uw_wert_nv_3of4_ "Umweltbedingung beim Fehlereintrag" UWORD FORMULA_0010 0 0 0.0 65535.0000 ECU_ADDRESS 0x3F98D6 /end MEASUREMENT
/begin MEASUREMENT ed_fsp_5of20_.uw_satz_2of3_.uw_wert_nv_4of4_ "Umweltbedingung beim Fehlereintrag" UWORD FORMULA_0010 0 0 0.0 65535.0000 ECU_ADDRESS 0x3F98D8 /end MEASUREMENT
/begin MEASUREMENT ed_fsp_5of20_.uw_satz_3of3_.uw_wert_nv_1of4_ "Umweltbedingung beim Fehlereintrag" UWORD FORMULA_0010 0 0 0.0 65535.0000 ECU_ADDRESS 0x3F98DC /end MEASUREMENT
/begin MEASUREMENT ed_fsp_5of20_.uw_satz_3of3_.uw_wert_nv_2of4_ "Umweltbedingung beim Fehlereintrag" UWORD FORMULA_0010 0 0 0.0 65535.0000 ECU_ADDRESS 0x3F98DE /end MEASUREMENT
/begin MEASUREMENT ed_fsp_5of20_.uw_satz_3of3_.uw_wert_nv_3of4_ "Umweltbedingung beim Fehlereintrag" UWORD FORMULA_0010 0 0 0.0 65535.0000 ECU_ADDRESS 0x3F98E0 /end MEASUREMENT
/begin MEASUREMENT ed_fsp_5of20_.uw_satz_3of3_.uw_wert_nv_4of4_ "Umweltbedingung beim Fehlereintrag" UWORD FORMULA_0010 0 0 0.0 65535.0000 ECU_ADDRESS 0x3F98E2 /end MEASUREMENT
/begin MEASUREMENT ed_fsp_6of20_.uw_satz_1of3_.uw_wert_nv_1of4_ "Umweltbedingung beim Fehlereintrag" UWORD FORMULA_0010 0 0 0.0 65535.0000 ECU_ADDRESS 0x3F991A /end MEASUREMENT
/begin MEASUREMENT ed_fsp_6of20_.uw_satz_1of3_.uw_wert_nv_2of4_ "Umweltbedingung beim Fehlereintrag" UWORD FORMULA_0010 0 0 0.0 65535.0000 ECU_ADDRESS 0x3F991C /end MEASUREMENT
/begin MEASUREMENT ed_fsp_6of20_.uw_satz_1of3_.uw_wert_nv_3of4_ "Umweltbedingung beim Fehlereintrag" UWORD FORMULA_0010 0 0 0.0 65535.0000 ECU_ADDRESS 0x3F991E /end MEASUREMENT
/begin MEASUREMENT ed_fsp_6of20_.uw_satz_1of3_.uw_wert_nv_4of4_ "Umweltbedingung beim Fehlereintrag" UWORD FORMULA_0010 0 0 0.0 65535.0000 ECU_ADDRESS 0x3F9920 /end MEASUREMENT
/begin MEASUREMENT ed_fsp_6of20_.uw_satz_2of3_.uw_wert_nv_1of4_ "Umweltbedingung beim Fehlereintrag" UWORD FORMULA_0010 0 0 0.0 65535.0000 ECU_ADDRESS 0x3F9924 /end MEASUREMENT
/begin MEASUREMENT ed_fsp_6of20_.uw_satz_2of3_.uw_wert_nv_2of4_ "Umweltbedingung beim Fehlereintrag" UWORD FORMULA_0010 0 0 0.0 65535.0000 ECU_ADDRESS 0x3F9926 /end MEASUREMENT
/begin MEASUREMENT ed_fsp_6of20_.uw_satz_2of3_.uw_wert_nv_3of4_ "Umweltbedingung beim Fehlereintrag" UWORD FORMULA_0010 0 0 0.0 65535.0000 ECU_ADDRESS 0x3F9928 /end MEASUREMENT
/begin MEASUREMENT ed_fsp_6of20_.uw_satz_2of3_.uw_wert_nv_4of4_ "Umweltbedingung beim Fehlereintrag" UWORD FORMULA_0010 0 0 0.0 65535.0000 ECU_ADDRESS 0x3F992A /end MEASUREMENT
/begin MEASUREMENT ed_fsp_6of20_.uw_satz_3of3_.uw_wert_nv_1of4_ "Umweltbedingung beim Fehlereintrag" UWORD FORMULA_0010 0 0 0.0 65535.0000 ECU_ADDRESS 0x3F992E /end MEASUREMENT
/begin MEASUREMENT ed_fsp_6of20_.uw_satz_3of3_.uw_wert_nv_2of4_ "Umweltbedingung beim Fehlereintrag" UWORD FORMULA_0010 0 0 0.0 65535.0000 ECU_ADDRESS 0x3F9930 /end MEASUREMENT
/begin MEASUREMENT ed_fsp_6of20_.uw_satz_3of3_.uw_wert_nv_3of4_ "Umweltbedingung beim Fehlereintrag" UWORD FORMULA_0010 0 0 0.0 65535.0000 ECU_ADDRESS 0x3F9932 /end MEASUREMENT
/begin MEASUREMENT ed_fsp_6of20_.uw_satz_3of3_.uw_wert_nv_4of4_ "Umweltbedingung beim Fehlereintrag" UWORD FORMULA_0010 0 0 0.0 65535.0000 ECU_ADDRESS 0x3F9934 /end MEASUREMENT
/begin MEASUREMENT ed_fsp_7of20_.uw_satz_1of3_.uw_wert_nv_1of4_ "Umweltbedingung beim Fehlereintrag" UWORD FORMULA_0010 0 0 0.0 65535.0000 ECU_ADDRESS 0x3F996C /end MEASUREMENT
/begin MEASUREMENT ed_fsp_7of20_.uw_satz_1of3_.uw_wert_nv_2of4_ "Umweltbedingung beim Fehlereintrag" UWORD FORMULA_0010 0 0 0.0 65535.0000 ECU_ADDRESS 0x3F996E /end MEASUREMENT
/begin MEASUREMENT ed_fsp_7of20_.uw_satz_1of3_.uw_wert_nv_3of4_ "Umweltbedingung beim Fehlereintrag" UWORD FORMULA_0010 0 0 0.0 65535.0000 ECU_ADDRESS 0x3F9970 /end MEASUREMENT
/begin MEASUREMENT ed_fsp_7of20_.uw_satz_1of3_.uw_wert_nv_4of4_ "Umweltbedingung beim Fehlereintrag" UWORD FORMULA_0010 0 0 0.0 65535.0000 ECU_ADDRESS 0x3F9972 /end MEASUREMENT
/begin MEASUREMENT ed_fsp_7of20_.uw_satz_2of3_.uw_wert_nv_1of4_ "Umweltbedingung beim Fehlereintrag" UWORD FORMULA_0010 0 0 0.0 65535.0000 ECU_ADDRESS 0x3F9976 /end MEASUREMENT
/begin MEASUREMENT ed_fsp_7of20_.uw_satz_2of3_.uw_wert_nv_2of4_ "Umweltbedingung beim Fehlereintrag" UWORD FORMULA_0010 0 0 0.0 65535.0000 ECU_ADDRESS 0x3F9978 /end MEASUREMENT
/begin MEASUREMENT ed_fsp_7of20_.uw_satz_2of3_.uw_wert_nv_3of4_ "Umweltbedingung beim Fehlereintrag" UWORD FORMULA_0010 0 0 0.0 65535.0000 ECU_ADDRESS 0x3F997A /end MEASUREMENT
/begin MEASUREMENT ed_fsp_7of20_.uw_satz_2of3_.uw_wert_nv_4of4_ "Umweltbedingung beim Fehlereintrag" UWORD FORMULA_0010 0 0 0.0 65535.0000 ECU_ADDRESS 0x3F997C /end MEASUREMENT
/begin MEASUREMENT ed_fsp_7of20_.uw_satz_3of3_.uw_wert_nv_1of4_ "Umweltbedingung beim Fehlereintrag" UWORD FORMULA_0010 0 0 0.0 65535.0000 ECU_ADDRESS 0x3F9980 /end MEASUREMENT
/begin MEASUREMENT ed_fsp_7of20_.uw_satz_3of3_.uw_wert_nv_2of4_ "Umweltbedingung beim Fehlereintrag" UWORD FORMULA_0010 0 0 0.0 65535.0000 ECU_ADDRESS 0x3F9982 /end MEASUREMENT
/begin MEASUREMENT ed_fsp_7of20_.uw_satz_3of3_.uw_wert_nv_3of4_ "Umweltbedingung beim Fehlereintrag" UWORD FORMULA_0010 0 0 0.0 65535.0000 ECU_ADDRESS 0x3F9984 /end MEASUREMENT
/begin MEASUREMENT ed_fsp_7of20_.uw_satz_3of3_.uw_wert_nv_4of4_ "Umweltbedingung beim Fehlereintrag" UWORD FORMULA_0010 0 0 0.0 65535.0000 ECU_ADDRESS 0x3F9986 /end MEASUREMENT
/begin MEASUREMENT ed_fsp_8of20_.uw_satz_1of3_.uw_wert_nv_1of4_ "Umweltbedingung beim Fehlereintrag" UWORD FORMULA_0010 0 0 0.0 65535.0000 ECU_ADDRESS 0x3F99BE /end MEASUREMENT
/begin MEASUREMENT ed_fsp_8of20_.uw_satz_1of3_.uw_wert_nv_2of4_ "Umweltbedingung beim Fehlereintrag" UWORD FORMULA_0010 0 0 0.0 65535.0000 ECU_ADDRESS 0x3F99C0 /end MEASUREMENT
/begin MEASUREMENT ed_fsp_8of20_.uw_satz_1of3_.uw_wert_nv_3of4_ "Umweltbedingung beim Fehlereintrag" UWORD FORMULA_0010 0 0 0.0 65535.0000 ECU_ADDRESS 0x3F99C2 /end MEASUREMENT
/begin MEASUREMENT ed_fsp_8of20_.uw_satz_1of3_.uw_wert_nv_4of4_ "Umweltbedingung beim Fehlereintrag" UWORD FORMULA_0010 0 0 0.0 65535.0000 ECU_ADDRESS 0x3F99C4 /end MEASUREMENT
/begin MEASUREMENT ed_fsp_8of20_.uw_satz_2of3_.uw_wert_nv_1of4_ "Umweltbedingung beim Fehlereintrag" UWORD FORMULA_0010 0 0 0.0 65535.0000 ECU_ADDRESS 0x3F99C8 /end MEASUREMENT
/begin MEASUREMENT ed_fsp_8of20_.uw_satz_2of3_.uw_wert_nv_2of4_ "Umweltbedingung beim Fehlereintrag" UWORD FORMULA_0010 0 0 0.0 65535.0000 ECU_ADDRESS 0x3F99CA /end MEASUREMENT
/begin MEASUREMENT ed_fsp_8of20_.uw_satz_2of3_.uw_wert_nv_3of4_ "Umweltbedingung beim Fehlereintrag" UWORD FORMULA_0010 0 0 0.0 65535.0000 ECU_ADDRESS 0x3F99CC /end MEASUREMENT
/begin MEASUREMENT ed_fsp_8of20_.uw_satz_2of3_.uw_wert_nv_4of4_ "Umweltbedingung beim Fehlereintrag" UWORD FORMULA_0010 0 0 0.0 65535.0000 ECU_ADDRESS 0x3F99CE /end MEASUREMENT
/begin MEASUREMENT ed_fsp_8of20_.uw_satz_3of3_.uw_wert_nv_1of4_ "Umweltbedingung beim Fehlereintrag" UWORD FORMULA_0010 0 0 0.0 65535.0000 ECU_ADDRESS 0x3F99D2 /end MEASUREMENT
/begin MEASUREMENT ed_fsp_8of20_.uw_satz_3of3_.uw_wert_nv_2of4_ "Umweltbedingung beim Fehlereintrag" UWORD FORMULA_0010 0 0 0.0 65535.0000 ECU_ADDRESS 0x3F99D4 /end MEASUREMENT
/begin MEASUREMENT ed_fsp_8of20_.uw_satz_3of3_.uw_wert_nv_3of4_ "Umweltbedingung beim Fehlereintrag" UWORD FORMULA_0010 0 0 0.0 65535.0000 ECU_ADDRESS 0x3F99D6 /end MEASUREMENT
/begin MEASUREMENT ed_fsp_8of20_.uw_satz_3of3_.uw_wert_nv_4of4_ "Umweltbedingung beim Fehlereintrag" UWORD FORMULA_0010 0 0 0.0 65535.0000 ECU_ADDRESS 0x3F99D8 /end MEASUREMENT
/begin MEASUREMENT ed_fsp_9of20_.uw_satz_1of3_.uw_wert_nv_1of4_ "Umweltbedingung beim Fehlereintrag" UWORD FORMULA_0010 0 0 0.0 65535.0000 ECU_ADDRESS 0x3F9A10 /end MEASUREMENT
/begin MEASUREMENT ed_fsp_9of20_.uw_satz_1of3_.uw_wert_nv_2of4_ "Umweltbedingung beim Fehlereintrag" UWORD FORMULA_0010 0 0 0.0 65535.0000 ECU_ADDRESS 0x3F9A12 /end MEASUREMENT
/begin MEASUREMENT ed_fsp_9of20_.uw_satz_1of3_.uw_wert_nv_3of4_ "Umweltbedingung beim Fehlereintrag" UWORD FORMULA_0010 0 0 0.0 65535.0000 ECU_ADDRESS 0x3F9A14 /end MEASUREMENT
/begin MEASUREMENT ed_fsp_9of20_.uw_satz_1of3_.uw_wert_nv_4of4_ "Umweltbedingung beim Fehlereintrag" UWORD FORMULA_0010 0 0 0.0 65535.0000 ECU_ADDRESS 0x3F9A16 /end MEASUREMENT
/begin MEASUREMENT ed_fsp_14of20_.uw_satz_1of3_.uw_wert_nv_1of4_ "Umweltbedingung beim Fehlereintrag" UWORD FORMULA_0010 0 0 0.0 65535.0000 ECU_ADDRESS 0x3F9BAA /end MEASUREMENT
/begin MEASUREMENT ed_fsp_14of20_.uw_satz_1of3_.uw_wert_nv_2of4_ "Umweltbedingung beim Fehlereintrag" UWORD FORMULA_0010 0 0 0.0 65535.0000 ECU_ADDRESS 0x3F9BAC /end MEASUREMENT
/begin MEASUREMENT ed_fsp_14of20_.uw_satz_1of3_.uw_wert_nv_3of4_ "Umweltbedingung beim Fehlereintrag" UWORD FORMULA_0010 0 0 0.0 65535.0000 ECU_ADDRESS 0x3F9BAE /end MEASUREMENT
/begin MEASUREMENT ed_fsp_14of20_.uw_satz_1of3_.uw_wert_nv_4of4_ "Umweltbedingung beim Fehlereintrag" UWORD FORMULA_0010 0 0 0.0 65535.0000 ECU_ADDRESS 0x3F9BB0 /end MEASUREMENT
/begin MEASUREMENT ed_fsp_14of20_.uw_satz_2of3_.uw_wert_nv_1of4_ "Umweltbedingung beim Fehlereintrag" UWORD FORMULA_0010 0 0 0.0 65535.0000 ECU_ADDRESS 0x3F9BB4 /end MEASUREMENT
/begin MEASUREMENT ed_fsp_14of20_.uw_satz_2of3_.uw_wert_nv_2of4_ "Umweltbedingung beim Fehlereintrag" UWORD FORMULA_0010 0 0 0.0 65535.0000 ECU_ADDRESS 0x3F9BB6 /end MEASUREMENT
/begin MEASUREMENT ed_fsp_14of20_.uw_satz_2of3_.uw_wert_nv_3of4_ "Umweltbedingung beim Fehlereintrag" UWORD FORMULA_0010 0 0 0.0 65535.0000 ECU_ADDRESS 0x3F9BB8 /end MEASUREMENT
/begin MEASUREMENT ed_fsp_14of20_.uw_satz_2of3_.uw_wert_nv_4of4_ "Umweltbedingung beim Fehlereintrag" UWORD FORMULA_0010 0 0 0.0 65535.0000 ECU_ADDRESS 0x3F9BBA /end MEASUREMENT
/begin MEASUREMENT ed_fsp_14of20_.uw_satz_3of3_.uw_wert_nv_1of4_ "Umweltbedingung beim Fehlereintrag" UWORD FORMULA_0010 0 0 0.0 65535.0000 ECU_ADDRESS 0x3F9BBE /end MEASUREMENT
/begin MEASUREMENT ed_fsp_14of20_.uw_satz_3of3_.uw_wert_nv_2of4_ "Umweltbedingung beim Fehlereintrag" UWORD FORMULA_0010 0 0 0.0 65535.0000 ECU_ADDRESS 0x3F9BC0 /end MEASUREMENT
/begin MEASUREMENT ed_fsp_14of20_.uw_satz_3of3_.uw_wert_nv_3of4_ "Umweltbedingung beim Fehlereintrag" UWORD FORMULA_0010 0 0 0.0 65535.0000 ECU_ADDRESS 0x3F9BC2 /end MEASUREMENT
/begin MEASUREMENT ed_fsp_14of20_.uw_satz_3of3_.uw_wert_nv_4of4_ "Umweltbedingung beim Fehlereintrag" UWORD FORMULA_0010 0 0 0.0 65535.0000 ECU_ADDRESS 0x3F9BC4 /end MEASUREMENT
/begin MEASUREMENT ed_fsp_15of20_.uw_satz_1of3_.uw_wert_nv_1of4_ "Umweltbedingung beim Fehlereintrag" UWORD FORMULA_0010 0 0 0.0 65535.0000 ECU_ADDRESS 0x3F9BFC /end MEASUREMENT
/begin MEASUREMENT ed_fsp_15of20_.uw_satz_1of3_.uw_wert_nv_2of4_ "Umweltbedingung beim Fehlereintrag" UWORD FORMULA_0010 0 0 0.0 65535.0000 ECU_ADDRESS 0x3F9BFE /end MEASUREMENT
/begin MEASUREMENT ed_fsp_15of20_.uw_satz_1of3_.uw_wert_nv_3of4_ "Umweltbedingung beim Fehlereintrag" UWORD FORMULA_0010 0 0 0.0 65535.0000 ECU_ADDRESS 0x3F9C00 /end MEASUREMENT
/begin MEASUREMENT ed_fsp_15of20_.uw_satz_1of3_.uw_wert_nv_4of4_ "Umweltbedingung beim Fehlereintrag" UWORD FORMULA_0010 0 0 0.0 65535.0000 ECU_ADDRESS 0x3F9C02 /end MEASUREMENT
/begin MEASUREMENT ed_fsp_15of20_.uw_satz_2of3_.uw_wert_nv_1of4_ "Umweltbedingung beim Fehlereintrag" UWORD FORMULA_0010 0 0 0.0 65535.0000 ECU_ADDRESS 0x3F9C06 /end MEASUREMENT
/begin MEASUREMENT ed_fsp_15of20_.uw_satz_2of3_.uw_wert_nv_2of4_ "Umweltbedingung beim Fehlereintrag" UWORD FORMULA_0010 0 0 0.0 65535.0000 ECU_ADDRESS 0x3F9C08 /end MEASUREMENT
/begin MEASUREMENT ed_fsp_15of20_.uw_satz_2of3_.uw_wert_nv_3of4_ "Umweltbedingung beim Fehlereintrag" UWORD FORMULA_0010 0 0 0.0 65535.0000 ECU_ADDRESS 0x3F9C0A /end MEASUREMENT
/begin MEASUREMENT ed_fsp_15of20_.uw_satz_2of3_.uw_wert_nv_4of4_ "Umweltbedingung beim Fehlereintrag" UWORD FORMULA_0010 0 0 0.0 65535.0000 ECU_ADDRESS 0x3F9C0C /end MEASUREMENT
/begin MEASUREMENT ed_fsp_15of20_.uw_satz_3of3_.uw_wert_nv_1of4_ "Umweltbedingung beim Fehlereintrag" UWORD FORMULA_0010 0 0 0.0 65535.0000 ECU_ADDRESS 0x3F9C10 /end MEASUREMENT
/begin MEASUREMENT ed_fsp_15of20_.uw_satz_3of3_.uw_wert_nv_2of4_ "Umweltbedingung beim Fehlereintrag" UWORD FORMULA_0010 0 0 0.0 65535.0000 ECU_ADDRESS 0x3F9C12 /end MEASUREMENT
/begin MEASUREMENT ed_fsp_15of20_.uw_satz_3of3_.uw_wert_nv_3of4_ "Umweltbedingung beim Fehlereintrag" UWORD FORMULA_0010 0 0 0.0 65535.0000 ECU_ADDRESS 0x3F9C14 /end MEASUREMENT
/begin MEASUREMENT ed_fsp_15of20_.uw_satz_3of3_.uw_wert_nv_4of4_ "Umweltbedingung beim Fehlereintrag" UWORD FORMULA_0010 0 0 0.0 65535.0000 ECU_ADDRESS 0x3F9C16 /end MEASUREMENT
/begin MEASUREMENT ed_fsp_16of20_.uw_satz_1of3_.uw_wert_nv_1of4_ "Umweltbedingung beim Fehlereintrag" UWORD FORMULA_0010 0 0 0.0 65535.0000 ECU_ADDRESS 0x3F9C4E /end MEASUREMENT
/begin MEASUREMENT ed_fsp_16of20_.uw_satz_1of3_.uw_wert_nv_2of4_ "Umweltbedingung beim Fehlereintrag" UWORD FORMULA_0010 0 0 0.0 65535.0000 ECU_ADDRESS 0x3F9C50 /end MEASUREMENT
/begin MEASUREMENT ed_fsp_16of20_.uw_satz_1of3_.uw_wert_nv_3of4_ "Umweltbedingung beim Fehlereintrag" UWORD FORMULA_0010 0 0 0.0 65535.0000 ECU_ADDRESS 0x3F9C52 /end MEASUREMENT
/begin MEASUREMENT ed_fsp_16of20_.uw_satz_1of3_.uw_wert_nv_4of4_ "Umweltbedingung beim Fehlereintrag" UWORD FORMULA_0010 0 0 0.0 65535.0000 ECU_ADDRESS 0x3F9C54 /end MEASUREMENT
/begin MEASUREMENT ed_fsp_16of20_.uw_satz_2of3_.uw_wert_nv_1of4_ "Umweltbedingung beim Fehlereintrag" UWORD FORMULA_0010 0 0 0.0 65535.0000 ECU_ADDRESS 0x3F9C58 /end MEASUREMENT
/begin MEASUREMENT ed_fsp_16of20_.uw_satz_2of3_.uw_wert_nv_2of4_ "Umweltbedingung beim Fehlereintrag" UWORD FORMULA_0010 0 0 0.0 65535.0000 ECU_ADDRESS 0x3F9C5A /end MEASUREMENT
/begin MEASUREMENT ed_fsp_16of20_.uw_satz_2of3_.uw_wert_nv_3of4_ "Umweltbedingung beim Fehlereintrag" UWORD FORMULA_0010 0 0 0.0 65535.0000 ECU_ADDRESS 0x3F9C5C /end MEASUREMENT
/begin MEASUREMENT ed_fsp_16of20_.uw_satz_2of3_.uw_wert_nv_4of4_ "Umweltbedingung beim Fehlereintrag" UWORD FORMULA_0010 0 0 0.0 65535.0000 ECU_ADDRESS 0x3F9C5E /end MEASUREMENT
/begin MEASUREMENT ed_fsp_16of20_.uw_satz_3of3_.uw_wert_nv_1of4_ "Umweltbedingung beim Fehlereintrag" UWORD FORMULA_0010 0 0 0.0 65535.0000 ECU_ADDRESS 0x3F9C62 /end MEASUREMENT
/begin MEASUREMENT ed_fsp_16of20_.uw_satz_3of3_.uw_wert_nv_2of4_ "Umweltbedingung beim Fehlereintrag" UWORD FORMULA_0010 0 0 0.0 65535.0000 ECU_ADDRESS 0x3F9C64 /end MEASUREMENT
/begin MEASUREMENT ed_fsp_16of20_.uw_satz_3of3_.uw_wert_nv_3of4_ "Umweltbedingung beim Fehlereintrag" UWORD FORMULA_0010 0 0 0.0 65535.0000 ECU_ADDRESS 0x3F9C66 /end MEASUREMENT
/begin MEASUREMENT ed_fsp_16of20_.uw_satz_3of3_.uw_wert_nv_4of4_ "Umweltbedingung beim Fehlereintrag" UWORD FORMULA_0010 0 0 0.0 65535.0000 ECU_ADDRESS 0x3F9C68 /end MEASUREMENT
/begin MEASUREMENT ed_fsp_17of20_.uw_satz_1of3_.uw_wert_nv_1of4_ "Umweltbedingung beim Fehlereintrag" UWORD FORMULA_0010 0 0 0.0 65535.0000 ECU_ADDRESS 0x3F9CA0 /end MEASUREMENT
/begin MEASUREMENT ed_fsp_17of20_.uw_satz_1of3_.uw_wert_nv_2of4_ "Umweltbedingung beim Fehlereintrag" UWORD FORMULA_0010 0 0 0.0 65535.0000 ECU_ADDRESS 0x3F9CA2 /end MEASUREMENT
/begin MEASUREMENT ed_fsp_17of20_.uw_satz_1of3_.uw_wert_nv_3of4_ "Umweltbedingung beim Fehlereintrag" UWORD FORMULA_0010 0 0 0.0 65535.0000 ECU_ADDRESS 0x3F9CA4 /end MEASUREMENT
/begin MEASUREMENT ed_fsp_17of20_.uw_satz_1of3_.uw_wert_nv_4of4_ "Umweltbedingung beim Fehlereintrag" UWORD FORMULA_0010 0 0 0.0 65535.0000 ECU_ADDRESS 0x3F9CA6 /end MEASUREMENT
/begin MEASUREMENT ed_fsp_17of20_.uw_satz_2of3_.uw_wert_nv_1of4_ "Umweltbedingung beim Fehlereintrag" UWORD FORMULA_0010 0 0 0.0 65535.0000 ECU_ADDRESS 0x3F9CAA /end MEASUREMENT
/begin MEASUREMENT ed_fsp_17of20_.uw_satz_2of3_.uw_wert_nv_2of4_ "Umweltbedingung beim Fehlereintrag" UWORD FORMULA_0010 0 0 0.0 65535.0000 ECU_ADDRESS 0x3F9CAC /end MEASUREMENT
/begin MEASUREMENT ed_fsp_17of20_.uw_satz_2of3_.uw_wert_nv_3of4_ "Umweltbedingung beim Fehlereintrag" UWORD FORMULA_0010 0 0 0.0 65535.0000 ECU_ADDRESS 0x3F9CAE /end MEASUREMENT
/begin MEASUREMENT ed_fsp_17of20_.uw_satz_2of3_.uw_wert_nv_4of4_ "Umweltbedingung beim Fehlereintrag" UWORD FORMULA_0010 0 0 0.0 65535.0000 ECU_ADDRESS 0x3F9CB0 /end MEASUREMENT
/begin MEASUREMENT ed_fsp_17of20_.uw_satz_3of3_.uw_wert_nv_1of4_ "Umweltbedingung beim Fehlereintrag" UWORD FORMULA_0010 0 0 0.0 65535.0000 ECU_ADDRESS 0x3F9CB4 /end MEASUREMENT
/begin MEASUREMENT ed_fsp_17of20_.uw_satz_3of3_.uw_wert_nv_2of4_ "Umweltbedingung beim Fehlereintrag" UWORD FORMULA_0010 0 0 0.0 65535.0000 ECU_ADDRESS 0x3F9CB6 /end MEASUREMENT
/begin MEASUREMENT ed_fsp_17of20_.uw_satz_3of3_.uw_wert_nv_3of4_ "Umweltbedingung beim Fehlereintrag" UWORD FORMULA_0010 0 0 0.0 65535.0000 ECU_ADDRESS 0x3F9CB8 /end MEASUREMENT
/begin MEASUREMENT ed_fsp_17of20_.uw_satz_3of3_.uw_wert_nv_4of4_ "Umweltbedingung beim Fehlereintrag" UWORD FORMULA_0010 0 0 0.0 65535.0000 ECU_ADDRESS 0x3F9CBA /end MEASUREMENT
/begin MEASUREMENT ed_fsp_18of20_.uw_satz_1of3_.uw_wert_nv_1of4_ "Umweltbedingung beim Fehlereintrag" UWORD FORMULA_0010 0 0 0.0 65535.0000 ECU_ADDRESS 0x3F9CF2 /end MEASUREMENT
/begin MEASUREMENT ed_fsp_18of20_.uw_satz_1of3_.uw_wert_nv_2of4_ "Umweltbedingung beim Fehlereintrag" UWORD FORMULA_0010 0 0 0.0 65535.0000 ECU_ADDRESS 0x3F9CF4 /end MEASUREMENT
/begin MEASUREMENT ed_fsp_18of20_.uw_satz_1of3_.uw_wert_nv_3of4_ "Umweltbedingung beim Fehlereintrag" UWORD FORMULA_0010 0 0 0.0 65535.0000 ECU_ADDRESS 0x3F9CF6 /end MEASUREMENT
/begin MEASUREMENT ed_fsp_18of20_.uw_satz_1of3_.uw_wert_nv_4of4_ "Umweltbedingung beim Fehlereintrag" UWORD FORMULA_0010 0 0 0.0 65535.0000 ECU_ADDRESS 0x3F9CF8 /end MEASUREMENT
/begin MEASUREMENT ed_fsp_18of20_.uw_satz_2of3_.uw_wert_nv_1of4_ "Umweltbedingung beim Fehlereintrag" UWORD FORMULA_0010 0 0 0.0 65535.0000 ECU_ADDRESS 0x3F9CFC /end MEASUREMENT
/begin MEASUREMENT ed_fsp_18of20_.uw_satz_2of3_.uw_wert_nv_2of4_ "Umweltbedingung beim Fehlereintrag" UWORD FORMULA_0010 0 0 0.0 65535.0000 ECU_ADDRESS 0x3F9CFE /end MEASUREMENT
/begin MEASUREMENT ed_fsp_18of20_.uw_satz_2of3_.uw_wert_nv_3of4_ "Umweltbedingung beim Fehlereintrag" UWORD FORMULA_0010 0 0 0.0 65535.0000 ECU_ADDRESS 0x3F9D00 /end MEASUREMENT
/begin MEASUREMENT ed_fsp_18of20_.uw_satz_2of3_.uw_wert_nv_4of4_ "Umweltbedingung beim Fehlereintrag" UWORD FORMULA_0010 0 0 0.0 65535.0000 ECU_ADDRESS 0x3F9D02 /end MEASUREMENT
/begin MEASUREMENT ed_fsp_18of20_.uw_satz_3of3_.uw_wert_nv_1of4_ "Umweltbedingung beim Fehlereintrag" UWORD FORMULA_0010 0 0 0.0 65535.0000 ECU_ADDRESS 0x3F9D06 /end MEASUREMENT
/begin MEASUREMENT ed_fsp_18of20_.uw_satz_3of3_.uw_wert_nv_2of4_ "Umweltbedingung beim Fehlereintrag" UWORD FORMULA_0010 0 0 0.0 65535.0000 ECU_ADDRESS 0x3F9D08 /end MEASUREMENT
/begin MEASUREMENT ed_fsp_18of20_.uw_satz_3of3_.uw_wert_nv_3of4_ "Umweltbedingung beim Fehlereintrag" UWORD FORMULA_0010 0 0 0.0 65535.0000 ECU_ADDRESS 0x3F9D0A /end MEASUREMENT
/begin MEASUREMENT ed_fsp_18of20_.uw_satz_3of3_.uw_wert_nv_4of4_ "Umweltbedingung beim Fehlereintrag" UWORD FORMULA_0010 0 0 0.0 65535.0000 ECU_ADDRESS 0x3F9D0C /end MEASUREMENT
/begin MEASUREMENT ed_fsp_19of20_.uw_satz_1of3_.uw_wert_nv_1of4_ "Umweltbedingung beim Fehlereintrag" UWORD FORMULA_0010 0 0 0.0 65535.0000 ECU_ADDRESS 0x3F9D44 /end MEASUREMENT
/begin MEASUREMENT ed_fsp_19of20_.uw_satz_1of3_.uw_wert_nv_2of4_ "Umweltbedingung beim Fehlereintrag" UWORD FORMULA_0010 0 0 0.0 65535.0000 ECU_ADDRESS 0x3F9D46 /end MEASUREMENT
/begin MEASUREMENT ed_fsp_19of20_.uw_satz_1of3_.uw_wert_nv_3of4_ "Umweltbedingung beim Fehlereintrag" UWORD FORMULA_0010 0 0 0.0 65535.0000 ECU_ADDRESS 0x3F9D48 /end MEASUREMENT
/begin MEASUREMENT ed_fsp_19of20_.uw_satz_1of3_.uw_wert_nv_4of4_ "Umweltbedingung beim Fehlereintrag" UWORD FORMULA_0010 0 0 0.0 65535.0000 ECU_ADDRESS 0x3F9D4A /end MEASUREMENT
/begin MEASUREMENT ed_fsp_19of20_.uw_satz_2of3_.uw_wert_nv_1of4_ "Umweltbedingung beim Fehlereintrag" UWORD FORMULA_0010 0 0 0.0 65535.0000 ECU_ADDRESS 0x3F9D4E /end MEASUREMENT
/begin MEASUREMENT ed_fsp_19of20_.uw_satz_2of3_.uw_wert_nv_2of4_ "Umweltbedingung beim Fehlereintrag" UWORD FORMULA_0010 0 0 0.0 65535.0000 ECU_ADDRESS 0x3F9D50 /end MEASUREMENT
/begin MEASUREMENT ed_fsp_19of20_.uw_satz_2of3_.uw_wert_nv_3of4_ "Umweltbedingung beim Fehlereintrag" UWORD FORMULA_0010 0 0 0.0 65535.0000 ECU_ADDRESS 0x3F9D52 /end MEASUREMENT
/begin MEASUREMENT ed_fsp_19of20_.uw_satz_2of3_.uw_wert_nv_4of4_ "Umweltbedingung beim Fehlereintrag" UWORD FORMULA_0010 0 0 0.0 65535.0000 ECU_ADDRESS 0x3F9D54 /end MEASUREMENT
/begin MEASUREMENT ed_fsp_19of20_.uw_satz_3of3_.uw_wert_nv_1of4_ "Umweltbedingung beim Fehlereintrag" UWORD FORMULA_0010 0 0 0.0 65535.0000 ECU_ADDRESS 0x3F9D58 /end MEASUREMENT
/begin MEASUREMENT ed_fsp_19of20_.uw_satz_3of3_.uw_wert_nv_2of4_ "Umweltbedingung beim Fehlereintrag" UWORD FORMULA_0010 0 0 0.0 65535.0000 ECU_ADDRESS 0x3F9D5A /end MEASUREMENT
/begin MEASUREMENT ed_fsp_19of20_.uw_satz_3of3_.uw_wert_nv_3of4_ "Umweltbedingung beim Fehlereintrag" UWORD FORMULA_0010 0 0 0.0 65535.0000 ECU_ADDRESS 0x3F9D5C /end MEASUREMENT
/begin MEASUREMENT ed_fsp_19of20_.uw_satz_3of3_.uw_wert_nv_4of4_ "Umweltbedingung beim Fehlereintrag" UWORD FORMULA_0010 0 0 0.0 65535.0000 ECU_ADDRESS 0x3F9D5E /end MEASUREMENT
/begin MEASUREMENT ed_fsp_20of20_.uw_satz_1of3_.uw_wert_nv_1of4_ "Umweltbedingung beim Fehlereintrag" UWORD FORMULA_0010 0 0 0.0 65535.0000 ECU_ADDRESS 0x3F9D96 /end MEASUREMENT
/begin MEASUREMENT ed_fsp_20of20_.uw_satz_1of3_.uw_wert_nv_2of4_ "Umweltbedingung beim Fehlereintrag" UWORD FORMULA_0010 0 0 0.0 65535.0000 ECU_ADDRESS 0x3F9D98 /end MEASUREMENT
/begin MEASUREMENT ed_fsp_20of20_.uw_satz_1of3_.uw_wert_nv_3of4_ "Umweltbedingung beim Fehlereintrag" UWORD FORMULA_0010 0 0 0.0 65535.0000 ECU_ADDRESS 0x3F9D9A /end MEASUREMENT
/begin MEASUREMENT ed_fsp_20of20_.uw_satz_1of3_.uw_wert_nv_4of4_ "Umweltbedingung beim Fehlereintrag" UWORD FORMULA_0010 0 0 0.0 65535.0000 ECU_ADDRESS 0x3F9D9C /end MEASUREMENT
/begin MEASUREMENT ed_fsp_20of20_.uw_satz_2of3_.uw_wert_nv_1of4_ "Umweltbedingung beim Fehlereintrag" UWORD FORMULA_0010 0 0 0.0 65535.0000 ECU_ADDRESS 0x3F9DA0 /end MEASUREMENT
/begin MEASUREMENT ed_fsp_20of20_.uw_satz_2of3_.uw_wert_nv_2of4_ "Umweltbedingung beim Fehlereintrag" UWORD FORMULA_0010 0 0 0.0 65535.0000 ECU_ADDRESS 0x3F9DA2 /end MEASUREMENT
/begin MEASUREMENT ed_fsp_20of20_.uw_satz_2of3_.uw_wert_nv_3of4_ "Umweltbedingung beim Fehlereintrag" UWORD FORMULA_0010 0 0 0.0 65535.0000 ECU_ADDRESS 0x3F9DA4 /end MEASUREMENT
/begin MEASUREMENT ed_fsp_20of20_.uw_satz_2of3_.uw_wert_nv_4of4_ "Umweltbedingung beim Fehlereintrag" UWORD FORMULA_0010 0 0 0.0 65535.0000 ECU_ADDRESS 0x3F9DA6 /end MEASUREMENT
/begin MEASUREMENT ed_fsp_20of20_.uw_satz_3of3_.uw_wert_nv_1of4_ "Umweltbedingung beim Fehlereintrag" UWORD FORMULA_0010 0 0 0.0 65535.0000 ECU_ADDRESS 0x3F9DAA /end MEASUREMENT
/begin MEASUREMENT ed_fsp_20of20_.uw_satz_3of3_.uw_wert_nv_2of4_ "Umweltbedingung beim Fehlereintrag" UWORD FORMULA_0010 0 0 0.0 65535.0000 ECU_ADDRESS 0x3F9DAC /end MEASUREMENT
/begin MEASUREMENT ed_fsp_20of20_.uw_satz_3of3_.uw_wert_nv_3of4_ "Umweltbedingung beim Fehlereintrag" UWORD FORMULA_0010 0 0 0.0 65535.0000 ECU_ADDRESS 0x3F9DAE /end MEASUREMENT
/begin MEASUREMENT ed_fsp_20of20_.uw_satz_3of3_.uw_wert_nv_4of4_ "Umweltbedingung beim Fehlereintrag" UWORD FORMULA_0010 0 0 0.0 65535.0000 ECU_ADDRESS 0x3F9DB0 /end MEASUREMENT
/begin MEASUREMENT ed_fsp_1of20_.inj_fehlerzaehler_nv "INJ-Fehlerzaehler" UWORD FORMULA_0010 0 0 0.0 65535.0000 ECU_ADDRESS 0x3F979C /end MEASUREMENT
/begin MEASUREMENT ed_fsp_2of20_.inj_fehlerzaehler_nv "INJ-Fehlerzaehler" UWORD FORMULA_0010 0 0 0.0 65535.0000 ECU_ADDRESS 0x3F97EE /end MEASUREMENT
/begin MEASUREMENT ed_fsp_3of20_.inj_fehlerzaehler_nv "INJ-Fehlerzaehler" UWORD FORMULA_0010 0 0 0.0 65535.0000 ECU_ADDRESS 0x3F9840 /end MEASUREMENT
/begin MEASUREMENT ed_fsp_4of20_.inj_fehlerzaehler_nv "INJ-Fehlerzaehler" UWORD FORMULA_0010 0 0 0.0 65535.0000 ECU_ADDRESS 0x3F9892 /end MEASUREMENT
/begin MEASUREMENT ed_fsp_5of20_.inj_fehlerzaehler_nv "INJ-Fehlerzaehler" UWORD FORMULA_0010 0 0 0.0 65535.0000 ECU_ADDRESS 0x3F98E4 /end MEASUREMENT
/begin MEASUREMENT ed_fsp_6of20_.inj_fehlerzaehler_nv "INJ-Fehlerzaehler" UWORD FORMULA_0010 0 0 0.0 65535.0000 ECU_ADDRESS 0x3F9936 /end MEASUREMENT
/begin MEASUREMENT ed_fsp_7of20_.inj_fehlerzaehler_nv "INJ-Fehlerzaehler" UWORD FORMULA_0010 0 0 0.0 65535.0000 ECU_ADDRESS 0x3F9988 /end MEASUREMENT
/begin MEASUREMENT ed_fsp_8of20_.inj_fehlerzaehler_nv "INJ-Fehlerzaehler" UWORD FORMULA_0010 0 0 0.0 65535.0000 ECU_ADDRESS 0x3F99DA /end MEASUREMENT
/begin MEASUREMENT ed_fsp_9of20_.inj_fehlerzaehler_nv "INJ-Fehlerzaehler" UWORD FORMULA_0010 0 0 0.0 65535.0000 ECU_ADDRESS 0x3F9A2C /end MEASUREMENT
/begin MEASUREMENT ed_fsp_14of20_.inj_fehlerzaehler_nv "INJ-Fehlerzaehler" UWORD FORMULA_0010 0 0 0.0 65535.0000 ECU_ADDRESS 0x3F9BC6 /end MEASUREMENT
/begin MEASUREMENT ed_fsp_15of20_.inj_fehlerzaehler_nv "INJ-Fehlerzaehler" UWORD FORMULA_0010 0 0 0.0 65535.0000 ECU_ADDRESS 0x3F9C18 /end MEASUREMENT
/begin MEASUREMENT ed_fsp_16of20_.inj_fehlerzaehler_nv "INJ-Fehlerzaehler" UWORD FORMULA_0010 0 0 0.0 65535.0000 ECU_ADDRESS 0x3F9C6A /end MEASUREMENT
/begin MEASUREMENT ed_fsp_17of20_.inj_fehlerzaehler_nv "INJ-Fehlerzaehler" UWORD FORMULA_0010 0 0 0.0 65535.0000 ECU_ADDRESS 0x3F9CBC /end MEASUREMENT
/begin MEASUREMENT ed_fsp_18of20_.inj_fehlerzaehler_nv "INJ-Fehlerzaehler" UWORD FORMULA_0010 0 0 0.0 65535.0000 ECU_ADDRESS 0x3F9D0E /end MEASUREMENT
/begin MEASUREMENT ed_fsp_19of20_.inj_fehlerzaehler_nv "INJ-Fehlerzaehler" UWORD FORMULA_0010 0 0 0.0 65535.0000 ECU_ADDRESS 0x3F9D60 /end MEASUREMENT
/begin MEASUREMENT ed_fsp_20of20_.inj_fehlerzaehler_nv "INJ-Fehlerzaehler" UWORD FORMULA_0010 0 0 0.0 65535.0000 ECU_ADDRESS 0x3F9DB2 /end MEASUREMENT
/begin MEASUREMENT ed_fsp_1of20_.ed_fil_index_nv "Verweis auf Fehlerfilter" UWORD FORMULA_0010 0 0 0.0 65535.0000 ECU_ADDRESS 0x3F979E /end MEASUREMENT
/begin MEASUREMENT ed_fsp_2of20_.ed_fil_index_nv "Verweis auf Fehlerfilter" UWORD FORMULA_0010 0 0 0.0 65535.0000 ECU_ADDRESS 0x3F97F0 /end MEASUREMENT
/begin MEASUREMENT ed_fsp_3of20_.ed_fil_index_nv "Verweis auf Fehlerfilter" UWORD FORMULA_0010 0 0 0.0 65535.0000 ECU_ADDRESS 0x3F9842 /end MEASUREMENT
/begin MEASUREMENT ed_fsp_4of20_.ed_fil_index_nv "Verweis auf Fehlerfilter" UWORD FORMULA_0010 0 0 0.0 65535.0000 ECU_ADDRESS 0x3F9894 /end MEASUREMENT
/begin MEASUREMENT ed_fsp_5of20_.ed_fil_index_nv "Verweis auf Fehlerfilter" UWORD FORMULA_0010 0 0 0.0 65535.0000 ECU_ADDRESS 0x3F98E6 /end MEASUREMENT
/begin MEASUREMENT ed_fsp_6of20_.ed_fil_index_nv "Verweis auf Fehlerfilter" UWORD FORMULA_0010 0 0 0.0 65535.0000 ECU_ADDRESS 0x3F9938 /end MEASUREMENT
/begin MEASUREMENT ed_fsp_7of20_.ed_fil_index_nv "Verweis auf Fehlerfilter" UWORD FORMULA_0010 0 0 0.0 65535.0000 ECU_ADDRESS 0x3F998A /end MEASUREMENT
/begin MEASUREMENT ed_fsp_8of20_.ed_fil_index_nv "Verweis auf Fehlerfilter" UWORD FORMULA_0010 0 0 0.0 65535.0000 ECU_ADDRESS 0x3F99DC /end MEASUREMENT
/begin MEASUREMENT ed_fsp_9of20_.ed_fil_index_nv "Verweis auf Fehlerfilter" UWORD FORMULA_0010 0 0 0.0 65535.0000 ECU_ADDRESS 0x3F9A2E /end MEASUREMENT
/begin MEASUREMENT ed_fsp_15of20_.ed_fil_index_nv "Verweis auf Fehlerfilter" UWORD FORMULA_0010 0 0 0.0 65535.0000 ECU_ADDRESS 0x3F9C1A /end MEASUREMENT
/begin MEASUREMENT ed_fsp_16of20_.ed_fil_index_nv "Verweis auf Fehlerfilter" UWORD FORMULA_0010 0 0 0.0 65535.0000 ECU_ADDRESS 0x3F9C6C /end MEASUREMENT
/begin MEASUREMENT ed_fsp_17of20_.ed_fil_index_nv "Verweis auf Fehlerfilter" UWORD FORMULA_0010 0 0 0.0 65535.0000 ECU_ADDRESS 0x3F9CBE /end MEASUREMENT
/begin MEASUREMENT ed_fsp_18of20_.ed_fil_index_nv "Verweis auf Fehlerfilter" UWORD FORMULA_0010 0 0 0.0 65535.0000 ECU_ADDRESS 0x3F9D10 /end MEASUREMENT
/begin MEASUREMENT ed_fsp_19of20_.ed_fil_index_nv "Verweis auf Fehlerfilter" UWORD FORMULA_0010 0 0 0.0 65535.0000 ECU_ADDRESS 0x3F9D62 /end MEASUREMENT
/begin MEASUREMENT ed_fsp_20of20_.ed_fil_index_nv "Verweis auf Fehlerfilter" UWORD FORMULA_0010 0 0 0.0 65535.0000 ECU_ADDRESS 0x3F9DB4 /end MEASUREMENT
/begin MEASUREMENT ed_fsp_1of20_.mil_filter_nv "Filterwert der Milansteuerung" SBYTE FORMULA_0003 0 0 -128.0000 127.0000 ECU_ADDRESS 0x3F97A0 /end MEASUREMENT
/begin MEASUREMENT ed_fsp_2of20_.mil_filter_nv "Filterwert der Milansteuerung" SBYTE FORMULA_0003 0 0 -128.0000 127.0000 ECU_ADDRESS 0x3F97F2 /end MEASUREMENT
/begin MEASUREMENT ed_fsp_3of20_.mil_filter_nv "Filterwert der Milansteuerung" SBYTE FORMULA_0003 0 0 -128.0000 127.0000 ECU_ADDRESS 0x3F9844 /end MEASUREMENT
/begin MEASUREMENT ed_fsp_4of20_.mil_filter_nv "Filterwert der Milansteuerung" SBYTE FORMULA_0003 0 0 -128.0000 127.0000 ECU_ADDRESS 0x3F9896 /end MEASUREMENT
/begin MEASUREMENT ed_fsp_5of20_.mil_filter_nv "Filterwert der Milansteuerung" SBYTE FORMULA_0003 0 0 -128.0000 127.0000 ECU_ADDRESS 0x3F98E8 /end MEASUREMENT
/begin MEASUREMENT ed_fsp_6of20_.mil_filter_nv "Filterwert der Milansteuerung" SBYTE FORMULA_0003 0 0 -128.0000 127.0000 ECU_ADDRESS 0x3F993A /end MEASUREMENT
/begin MEASUREMENT ed_fsp_7of20_.mil_filter_nv "Filterwert der Milansteuerung" SBYTE FORMULA_0003 0 0 -128.0000 127.0000 ECU_ADDRESS 0x3F998C /end MEASUREMENT
/begin MEASUREMENT ed_fsp_8of20_.mil_filter_nv "Filterwert der Milansteuerung" SBYTE FORMULA_0003 0 0 -128.0000 127.0000 ECU_ADDRESS 0x3F99DE /end MEASUREMENT
/begin MEASUREMENT ed_fsp_9of20_.mil_filter_nv "Filterwert der Milansteuerung" SBYTE FORMULA_0003 0 0 -128.0000 127.0000 ECU_ADDRESS 0x3F9A30 /end MEASUREMENT
/begin MEASUREMENT ed_fsp_14of20_.mil_filter_nv "Filterwert der Milansteuerung" SBYTE FORMULA_0003 0 0 -128.0000 127.0000 ECU_ADDRESS 0x3F9BCA /end MEASUREMENT
/begin MEASUREMENT ed_fsp_15of20_.mil_filter_nv "Filterwert der Milansteuerung" SBYTE FORMULA_0003 0 0 -128.0000 127.0000 ECU_ADDRESS 0x3F9C1C /end MEASUREMENT
/begin MEASUREMENT ed_fsp_16of20_.mil_filter_nv "Filterwert der Milansteuerung" SBYTE FORMULA_0003 0 0 -128.0000 127.0000 ECU_ADDRESS 0x3F9C6E /end MEASUREMENT
/begin MEASUREMENT ed_fsp_17of20_.mil_filter_nv "Filterwert der Milansteuerung" SBYTE FORMULA_0003 0 0 -128.0000 127.0000 ECU_ADDRESS 0x3F9CC0 /end MEASUREMENT
/begin MEASUREMENT ed_fsp_18of20_.mil_filter_nv "Filterwert der Milansteuerung" SBYTE FORMULA_0003 0 0 -128.0000 127.0000 ECU_ADDRESS 0x3F9D12 /end MEASUREMENT
/begin MEASUREMENT ed_fsp_19of20_.mil_filter_nv "Filterwert der Milansteuerung" SBYTE FORMULA_0003 0 0 -128.0000 127.0000 ECU_ADDRESS 0x3F9D64 /end MEASUREMENT
/begin MEASUREMENT ed_fsp_20of20_.mil_filter_nv "Filterwert der Milansteuerung" SBYTE FORMULA_0003 0 0 -128.0000 127.0000 ECU_ADDRESS 0x3F9DB6 /end MEASUREMENT
/begin MEASUREMENT ed_fsp_1of20_.mil_filter_scdn_nv "Similar Conditions Eintragsfilterwert der Milansteuerung" UBYTE FORMULA_0003 0 0 0.0 255.0000 ECU_ADDRESS 0x3F97A1 /end MEASUREMENT
/begin MEASUREMENT ed_fsp_2of20_.mil_filter_scdn_nv "Similar Conditions Eintragsfilterwert der Milansteuerung" UBYTE FORMULA_0003 0 0 0.0 255.0000 ECU_ADDRESS 0x3F97F3 /end MEASUREMENT
/begin MEASUREMENT ed_fsp_3of20_.mil_filter_scdn_nv "Similar Conditions Eintragsfilterwert der Milansteuerung" UBYTE FORMULA_0003 0 0 0.0 255.0000 ECU_ADDRESS 0x3F9845 /end MEASUREMENT
/begin MEASUREMENT ed_fsp_4of20_.mil_filter_scdn_nv "Similar Conditions Eintragsfilterwert der Milansteuerung" UBYTE FORMULA_0003 0 0 0.0 255.0000 ECU_ADDRESS 0x3F9897 /end MEASUREMENT
/begin MEASUREMENT ed_fsp_5of20_.mil_filter_scdn_nv "Similar Conditions Eintragsfilterwert der Milansteuerung" UBYTE FORMULA_0003 0 0 0.0 255.0000 ECU_ADDRESS 0x3F98E9 /end MEASUREMENT
/begin MEASUREMENT ed_fsp_6of20_.mil_filter_scdn_nv "Similar Conditions Eintragsfilterwert der Milansteuerung" UBYTE FORMULA_0003 0 0 0.0 255.0000 ECU_ADDRESS 0x3F993B /end MEASUREMENT
/begin MEASUREMENT ed_fsp_7of20_.mil_filter_scdn_nv "Similar Conditions Eintragsfilterwert der Milansteuerung" UBYTE FORMULA_0003 0 0 0.0 255.0000 ECU_ADDRESS 0x3F998D /end MEASUREMENT
/begin MEASUREMENT ed_fsp_8of20_.mil_filter_scdn_nv "Similar Conditions Eintragsfilterwert der Milansteuerung" UBYTE FORMULA_0003 0 0 0.0 255.0000 ECU_ADDRESS 0x3F99DF /end MEASUREMENT
/begin MEASUREMENT ed_fsp_9of20_.mil_filter_scdn_nv "Similar Conditions Eintragsfilterwert der Milansteuerung" UBYTE FORMULA_0003 0 0 0.0 255.0000 ECU_ADDRESS 0x3F9A31 /end MEASUREMENT
/begin MEASUREMENT ed_fsp_14of20_.mil_filter_scdn_nv "Similar Conditions Eintragsfilterwert der Milansteuerung" UBYTE FORMULA_0003 0 0 0.0 255.0000 ECU_ADDRESS 0x3F9BCB /end MEASUREMENT
/begin MEASUREMENT ed_fsp_15of20_.mil_filter_scdn_nv "Similar Conditions Eintragsfilterwert der Milansteuerung" UBYTE FORMULA_0003 0 0 0.0 255.0000 ECU_ADDRESS 0x3F9C1D /end MEASUREMENT
/begin MEASUREMENT ed_fsp_16of20_.mil_filter_scdn_nv "Similar Conditions Eintragsfilterwert der Milansteuerung" UBYTE FORMULA_0003 0 0 0.0 255.0000 ECU_ADDRESS 0x3F9C6F /end MEASUREMENT
/begin MEASUREMENT ed_fsp_17of20_.mil_filter_scdn_nv "Similar Conditions Eintragsfilterwert der Milansteuerung" UBYTE FORMULA_0003 0 0 0.0 255.0000 ECU_ADDRESS 0x3F9CC1 /end MEASUREMENT
/begin MEASUREMENT ed_fsp_18of20_.mil_filter_scdn_nv "Similar Conditions Eintragsfilterwert der Milansteuerung" UBYTE FORMULA_0003 0 0 0.0 255.0000 ECU_ADDRESS 0x3F9D13 /end MEASUREMENT
/begin MEASUREMENT ed_fsp_19of20_.mil_filter_scdn_nv "Similar Conditions Eintragsfilterwert der Milansteuerung" UBYTE FORMULA_0003 0 0 0.0 255.0000 ECU_ADDRESS 0x3F9D65 /end MEASUREMENT
/begin MEASUREMENT ed_fsp_20of20_.mil_filter_scdn_nv "Similar Conditions Eintragsfilterwert der Milansteuerung" UBYTE FORMULA_0003 0 0 0.0 255.0000 ECU_ADDRESS 0x3F9DB7 /end MEASUREMENT
/begin MEASUREMENT ed_fsp_1of20_.scdn_zaehler_nv "Im similar Fenster" UWORD FORMULA_0010 0 0 0.0 65535.0000 ECU_ADDRESS 0x3F97A2 /end MEASUREMENT
/begin MEASUREMENT ed_fsp_2of20_.scdn_zaehler_nv "Im similar Fenster" UWORD FORMULA_0010 0 0 0.0 65535.0000 ECU_ADDRESS 0x3F97F4 /end MEASUREMENT
/begin MEASUREMENT ed_fsp_3of20_.scdn_zaehler_nv "Im similar Fenster" UWORD FORMULA_0010 0 0 0.0 65535.0000 ECU_ADDRESS 0x3F9846 /end MEASUREMENT
/begin MEASUREMENT ed_fsp_4of20_.scdn_zaehler_nv "Im similar Fenster" UWORD FORMULA_0010 0 0 0.0 65535.0000 ECU_ADDRESS 0x3F9898 /end MEASUREMENT
/begin MEASUREMENT ed_fsp_5of20_.scdn_zaehler_nv "Im similar Fenster" UWORD FORMULA_0010 0 0 0.0 65535.0000 ECU_ADDRESS 0x3F98EA /end MEASUREMENT
/begin MEASUREMENT ed_fsp_6of20_.scdn_zaehler_nv "Im similar Fenster" UWORD FORMULA_0010 0 0 0.0 65535.0000 ECU_ADDRESS 0x3F993C /end MEASUREMENT
/begin MEASUREMENT ed_fsp_7of20_.scdn_zaehler_nv "Im similar Fenster" UWORD FORMULA_0010 0 0 0.0 65535.0000 ECU_ADDRESS 0x3F998E /end MEASUREMENT
/begin MEASUREMENT ed_fsp_8of20_.scdn_zaehler_nv "Im similar Fenster" UWORD FORMULA_0010 0 0 0.0 65535.0000 ECU_ADDRESS 0x3F99E0 /end MEASUREMENT
/begin MEASUREMENT ed_fsp_9of20_.scdn_zaehler_nv "Im similar Fenster" UWORD FORMULA_0010 0 0 0.0 65535.0000 ECU_ADDRESS 0x3F9A32 /end MEASUREMENT
/begin MEASUREMENT ed_fsp_14of20_.scdn_zaehler_nv "Im similar Fenster" UWORD FORMULA_0010 0 0 0.0 65535.0000 ECU_ADDRESS 0x3F9BCC /end MEASUREMENT
/begin MEASUREMENT ed_fsp_15of20_.scdn_zaehler_nv "Im similar Fenster" UWORD FORMULA_0010 0 0 0.0 65535.0000 ECU_ADDRESS 0x3F9C1E /end MEASUREMENT
/begin MEASUREMENT ed_fsp_16of20_.scdn_zaehler_nv "Im similar Fenster" UWORD FORMULA_0010 0 0 0.0 65535.0000 ECU_ADDRESS 0x3F9C70 /end MEASUREMENT
/begin MEASUREMENT ed_fsp_17of20_.scdn_zaehler_nv "Im similar Fenster" UWORD FORMULA_0010 0 0 0.0 65535.0000 ECU_ADDRESS 0x3F9CC2 /end MEASUREMENT
/begin MEASUREMENT ed_fsp_18of20_.scdn_zaehler_nv "Im similar Fenster" UWORD FORMULA_0010 0 0 0.0 65535.0000 ECU_ADDRESS 0x3F9D14 /end MEASUREMENT
/begin MEASUREMENT ed_fsp_19of20_.scdn_zaehler_nv "Im similar Fenster" UWORD FORMULA_0010 0 0 0.0 65535.0000 ECU_ADDRESS 0x3F9D66 /end MEASUREMENT
/begin MEASUREMENT ed_fsp_20of20_.scdn_zaehler_nv "Im similar Fenster" UWORD FORMULA_0010 0 0 0.0 65535.0000 ECU_ADDRESS 0x3F9DB8 /end MEASUREMENT
/begin MEASUREMENT ed_fsp_1of20_.scdn_nenner_nv "Gesamte Anzahl" UWORD FORMULA_0010 0 0 0.0 65535.0000 ECU_ADDRESS 0x3F97A4 /end MEASUREMENT
/begin MEASUREMENT ed_fsp_2of20_.scdn_nenner_nv "Gesamte Anzahl" UWORD FORMULA_0010 0 0 0.0 65535.0000 ECU_ADDRESS 0x3F97F6 /end MEASUREMENT
/begin MEASUREMENT ed_fsp_3of20_.scdn_nenner_nv "Gesamte Anzahl" UWORD FORMULA_0010 0 0 0.0 65535.0000 ECU_ADDRESS 0x3F9848 /end MEASUREMENT
/begin MEASUREMENT ed_fsp_4of20_.scdn_nenner_nv "Gesamte Anzahl" UWORD FORMULA_0010 0 0 0.0 65535.0000 ECU_ADDRESS 0x3F989A /end MEASUREMENT
/begin MEASUREMENT ed_fsp_5of20_.scdn_nenner_nv "Gesamte Anzahl" UWORD FORMULA_0010 0 0 0.0 65535.0000 ECU_ADDRESS 0x3F98EC /end MEASUREMENT
/begin MEASUREMENT ed_fsp_6of20_.scdn_nenner_nv "Gesamte Anzahl" UWORD FORMULA_0010 0 0 0.0 65535.0000 ECU_ADDRESS 0x3F993E /end MEASUREMENT
/begin MEASUREMENT ed_fsp_7of20_.scdn_nenner_nv "Gesamte Anzahl" UWORD FORMULA_0010 0 0 0.0 65535.0000 ECU_ADDRESS 0x3F9990 /end MEASUREMENT
/begin MEASUREMENT ed_fsp_8of20_.scdn_nenner_nv "Gesamte Anzahl" UWORD FORMULA_0010 0 0 0.0 65535.0000 ECU_ADDRESS 0x3F99E2 /end MEASUREMENT
/begin MEASUREMENT ed_fsp_9of20_.scdn_nenner_nv "Gesamte Anzahl" UWORD FORMULA_0010 0 0 0.0 65535.0000 ECU_ADDRESS 0x3F9A34 /end MEASUREMENT
/begin MEASUREMENT ed_fsp_14of20_.scdn_nenner_nv "Gesamte Anzahl" UWORD FORMULA_0010 0 0 0.0 65535.0000 ECU_ADDRESS 0x3F9BCE /end MEASUREMENT
/begin MEASUREMENT ed_fsp_15of20_.scdn_nenner_nv "Gesamte Anzahl" UWORD FORMULA_0010 0 0 0.0 65535.0000 ECU_ADDRESS 0x3F9C20 /end MEASUREMENT
/begin MEASUREMENT ed_fsp_16of20_.scdn_nenner_nv "Gesamte Anzahl" UWORD FORMULA_0010 0 0 0.0 65535.0000 ECU_ADDRESS 0x3F9C72 /end MEASUREMENT
/begin MEASUREMENT ed_fsp_17of20_.scdn_nenner_nv "Gesamte Anzahl" UWORD FORMULA_0010 0 0 0.0 65535.0000 ECU_ADDRESS 0x3F9CC4 /end MEASUREMENT
/begin MEASUREMENT ed_fsp_18of20_.scdn_nenner_nv "Gesamte Anzahl" UWORD FORMULA_0010 0 0 0.0 65535.0000 ECU_ADDRESS 0x3F9D16 /end MEASUREMENT
/begin MEASUREMENT ed_fsp_19of20_.scdn_nenner_nv "Gesamte Anzahl" UWORD FORMULA_0010 0 0 0.0 65535.0000 ECU_ADDRESS 0x3F9D68 /end MEASUREMENT
/begin MEASUREMENT ed_fsp_20of20_.scdn_nenner_nv "Gesamte Anzahl" UWORD FORMULA_0010 0 0 0.0 65535.0000 ECU_ADDRESS 0x3F9DBA /end MEASUREMENT
/begin MEASUREMENT ed_fsp_1of20_.ff_p_code_nv "P-Code des Freeze Frame" UWORD FORMULA_0010 0 0 0.0 65535.0000 ECU_ADDRESS 0x3F97A6 /end MEASUREMENT
/begin MEASUREMENT ed_fsp_2of20_.ff_p_code_nv "P-Code des Freeze Frame" UWORD FORMULA_0010 0 0 0.0 65535.0000 ECU_ADDRESS 0x3F97F8 /end MEASUREMENT
/begin MEASUREMENT ed_fsp_3of20_.ff_p_code_nv "P-Code des Freeze Frame" UWORD FORMULA_0010 0 0 0.0 65535.0000 ECU_ADDRESS 0x3F984A /end MEASUREMENT
/begin MEASUREMENT ed_fsp_4of20_.ff_p_code_nv "P-Code des Freeze Frame" UWORD FORMULA_0010 0 0 0.0 65535.0000 ECU_ADDRESS 0x3F989C /end MEASUREMENT
/begin MEASUREMENT ed_fsp_5of20_.ff_p_code_nv "P-Code des Freeze Frame" UWORD FORMULA_0010 0 0 0.0 65535.0000 ECU_ADDRESS 0x3F98EE /end MEASUREMENT
/begin MEASUREMENT ed_fsp_6of20_.ff_p_code_nv "P-Code des Freeze Frame" UWORD FORMULA_0010 0 0 0.0 65535.0000 ECU_ADDRESS 0x3F9940 /end MEASUREMENT
/begin MEASUREMENT ed_fsp_7of20_.ff_p_code_nv "P-Code des Freeze Frame" UWORD FORMULA_0010 0 0 0.0 65535.0000 ECU_ADDRESS 0x3F9992 /end MEASUREMENT
/begin MEASUREMENT ed_fsp_8of20_.ff_p_code_nv "P-Code des Freeze Frame" UWORD FORMULA_0010 0 0 0.0 65535.0000 ECU_ADDRESS 0x3F99E4 /end MEASUREMENT
/begin MEASUREMENT ed_fsp_9of20_.ff_p_code_nv "P-Code des Freeze Frame" UWORD FORMULA_0010 0 0 0.0 65535.0000 ECU_ADDRESS 0x3F9A36 /end MEASUREMENT
/begin MEASUREMENT ed_fsp_14of20_.ff_p_code_nv "P-Code des Freeze Frame" UWORD FORMULA_0010 0 0 0.0 65535.0000 ECU_ADDRESS 0x3F9BD0 /end MEASUREMENT
/begin MEASUREMENT ed_fsp_15of20_.ff_p_code_nv "P-Code des Freeze Frame" UWORD FORMULA_0010 0 0 0.0 65535.0000 ECU_ADDRESS 0x3F9C22 /end MEASUREMENT
/begin MEASUREMENT ed_fsp_16of20_.ff_p_code_nv "P-Code des Freeze Frame" UWORD FORMULA_0010 0 0 0.0 65535.0000 ECU_ADDRESS 0x3F9C74 /end MEASUREMENT
/begin MEASUREMENT ed_fsp_17of20_.ff_p_code_nv "P-Code des Freeze Frame" UWORD FORMULA_0010 0 0 0.0 65535.0000 ECU_ADDRESS 0x3F9CC6 /end MEASUREMENT
/begin MEASUREMENT ed_fsp_18of20_.ff_p_code_nv "P-Code des Freeze Frame" UWORD FORMULA_0010 0 0 0.0 65535.0000 ECU_ADDRESS 0x3F9D18 /end MEASUREMENT
/begin MEASUREMENT ed_fsp_19of20_.ff_p_code_nv "P-Code des Freeze Frame" UWORD FORMULA_0010 0 0 0.0 65535.0000 ECU_ADDRESS 0x3F9D6A /end MEASUREMENT
/begin MEASUREMENT ed_fsp_20of20_.ff_p_code_nv "P-Code des Freeze Frame" UWORD FORMULA_0010 0 0 0.0 65535.0000 ECU_ADDRESS 0x3F9DBC /end MEASUREMENT
/begin MEASUREMENT ed_fsp_1of20_.ff_n_nv "Drehzahl des Freeze Frame" UWORD FORMULA_0052 0 0 0.0 16383.7500 ECU_ADDRESS 0x3F97A8 /end MEASUREMENT
/begin MEASUREMENT ed_fsp_2of20_.ff_n_nv "Drehzahl des Freeze Frame" UWORD FORMULA_0052 0 0 0.0 16383.7500 ECU_ADDRESS 0x3F97FA /end MEASUREMENT
/begin MEASUREMENT ed_fsp_3of20_.ff_n_nv "Drehzahl des Freeze Frame" UWORD FORMULA_0052 0 0 0.0 16383.7500 ECU_ADDRESS 0x3F984C /end MEASUREMENT
/begin MEASUREMENT ed_fsp_4of20_.ff_n_nv "Drehzahl des Freeze Frame" UWORD FORMULA_0052 0 0 0.0 16383.7500 ECU_ADDRESS 0x3F989E /end MEASUREMENT
/begin MEASUREMENT ed_fsp_5of20_.ff_n_nv "Drehzahl des Freeze Frame" UWORD FORMULA_0052 0 0 0.0 16383.7500 ECU_ADDRESS 0x3F98F0 /end MEASUREMENT
/begin MEASUREMENT ed_fsp_6of20_.ff_n_nv "Drehzahl des Freeze Frame" UWORD FORMULA_0052 0 0 0.0 16383.7500 ECU_ADDRESS 0x3F9942 /end MEASUREMENT
/begin MEASUREMENT ed_fsp_7of20_.ff_n_nv "Drehzahl des Freeze Frame" UWORD FORMULA_0052 0 0 0.0 16383.7500 ECU_ADDRESS 0x3F9994 /end MEASUREMENT
/begin MEASUREMENT ed_fsp_8of20_.ff_n_nv "Drehzahl des Freeze Frame" UWORD FORMULA_0052 0 0 0.0 16383.7500 ECU_ADDRESS 0x3F99E6 /end MEASUREMENT
/begin MEASUREMENT ed_fsp_9of20_.ff_n_nv "Drehzahl des Freeze Frame" UWORD FORMULA_0052 0 0 0.0 16383.7500 ECU_ADDRESS 0x3F9A38 /end MEASUREMENT
/begin MEASUREMENT ed_fsp_14of20_.ff_n_nv "Drehzahl des Freeze Frame" UWORD FORMULA_0052 0 0 0.0 16383.7500 ECU_ADDRESS 0x3F9BD2 /end MEASUREMENT
/begin MEASUREMENT ed_fsp_15of20_.ff_n_nv "Drehzahl des Freeze Frame" UWORD FORMULA_0052 0 0 0.0 16383.7500 ECU_ADDRESS 0x3F9C24 /end MEASUREMENT
/begin MEASUREMENT ed_fsp_16of20_.ff_n_nv "Drehzahl des Freeze Frame" UWORD FORMULA_0052 0 0 0.0 16383.7500 ECU_ADDRESS 0x3F9C76 /end MEASUREMENT
/begin MEASUREMENT ed_fsp_17of20_.ff_n_nv "Drehzahl des Freeze Frame" UWORD FORMULA_0052 0 0 0.0 16383.7500 ECU_ADDRESS 0x3F9CC8 /end MEASUREMENT
/begin MEASUREMENT ed_fsp_18of20_.ff_n_nv "Drehzahl des Freeze Frame" UWORD FORMULA_0052 0 0 0.0 16383.7500 ECU_ADDRESS 0x3F9D1A /end MEASUREMENT
/begin MEASUREMENT ed_fsp_19of20_.ff_n_nv "Drehzahl des Freeze Frame" UWORD FORMULA_0052 0 0 0.0 16383.7500 ECU_ADDRESS 0x3F9D6C /end MEASUREMENT
/begin MEASUREMENT ed_fsp_20of20_.ff_n_nv "Drehzahl des Freeze Frame" UWORD FORMULA_0052 0 0 0.0 16383.7500 ECU_ADDRESS 0x3F9DBE /end MEASUREMENT
/begin MEASUREMENT ed_fsp_1of20_.ff_ml_b1_nv "Luftmasse des Freeze Frame" UWORD FORMULA_0053 0 0 0.0 655.3500 ECU_ADDRESS 0x3F97AA /end MEASUREMENT
/begin MEASUREMENT ed_fsp_2of20_.ff_ml_b1_nv "Luftmasse des Freeze Frame" UWORD FORMULA_0053 0 0 0.0 655.3500 ECU_ADDRESS 0x3F97FC /end MEASUREMENT
/begin MEASUREMENT ed_fsp_3of20_.ff_ml_b1_nv "Luftmasse des Freeze Frame" UWORD FORMULA_0053 0 0 0.0 655.3500 ECU_ADDRESS 0x3F984E /end MEASUREMENT
/begin MEASUREMENT ed_fsp_4of20_.ff_ml_b1_nv "Luftmasse des Freeze Frame" UWORD FORMULA_0053 0 0 0.0 655.3500 ECU_ADDRESS 0x3F98A0 /end MEASUREMENT
/begin MEASUREMENT ed_fsp_5of20_.ff_ml_b1_nv "Luftmasse des Freeze Frame" UWORD FORMULA_0053 0 0 0.0 655.3500 ECU_ADDRESS 0x3F98F2 /end MEASUREMENT
/begin MEASUREMENT ed_fsp_6of20_.ff_ml_b1_nv "Luftmasse des Freeze Frame" UWORD FORMULA_0053 0 0 0.0 655.3500 ECU_ADDRESS 0x3F9944 /end MEASUREMENT
/begin MEASUREMENT ed_fsp_7of20_.ff_ml_b1_nv "Luftmasse des Freeze Frame" UWORD FORMULA_0053 0 0 0.0 655.3500 ECU_ADDRESS 0x3F9996 /end MEASUREMENT
/begin MEASUREMENT ed_fsp_8of20_.ff_ml_b1_nv "Luftmasse des Freeze Frame" UWORD FORMULA_0053 0 0 0.0 655.3500 ECU_ADDRESS 0x3F99E8 /end MEASUREMENT
/begin MEASUREMENT ed_fsp_9of20_.ff_ml_b1_nv "Luftmasse des Freeze Frame" UWORD FORMULA_0053 0 0 0.0 655.3500 ECU_ADDRESS 0x3F9A3A /end MEASUREMENT
/begin MEASUREMENT ed_fsp_14of20_.ff_ml_b1_nv "Luftmasse des Freeze Frame" UWORD FORMULA_0053 0 0 0.0 655.3500 ECU_ADDRESS 0x3F9BD4 /end MEASUREMENT
/begin MEASUREMENT ed_fsp_15of20_.ff_ml_b1_nv "Luftmasse des Freeze Frame" UWORD FORMULA_0053 0 0 0.0 655.3500 ECU_ADDRESS 0x3F9C26 /end MEASUREMENT
/begin MEASUREMENT ed_fsp_16of20_.ff_ml_b1_nv "Luftmasse des Freeze Frame" UWORD FORMULA_0053 0 0 0.0 655.3500 ECU_ADDRESS 0x3F9C78 /end MEASUREMENT
/begin MEASUREMENT ed_fsp_17of20_.ff_ml_b1_nv "Luftmasse des Freeze Frame" UWORD FORMULA_0053 0 0 0.0 655.3500 ECU_ADDRESS 0x3F9CCA /end MEASUREMENT
/begin MEASUREMENT ed_fsp_18of20_.ff_ml_b1_nv "Luftmasse des Freeze Frame" UWORD FORMULA_0053 0 0 0.0 655.3500 ECU_ADDRESS 0x3F9D1C /end MEASUREMENT
/begin MEASUREMENT ed_fsp_19of20_.ff_ml_b1_nv "Luftmasse des Freeze Frame" UWORD FORMULA_0053 0 0 0.0 655.3500 ECU_ADDRESS 0x3F9D6E /end MEASUREMENT
/begin MEASUREMENT ed_fsp_20of20_.ff_ml_b1_nv "Luftmasse des Freeze Frame" UWORD FORMULA_0053 0 0 0.0 655.3500 ECU_ADDRESS 0x3F9DC0 /end MEASUREMENT
/begin MEASUREMENT ed_fsp_1of20_.ff_lam_reg_b1_nv "Einspritzsystem des Freeze Frame" UBYTE FORMULA_0054 0 0 0.0 255.0 ECU_ADDRESS 0x3F97AC /end MEASUREMENT
/begin MEASUREMENT ed_fsp_2of20_.ff_lam_reg_b1_nv "Einspritzsystem des Freeze Frame" UBYTE FORMULA_0054 0 0 0.0 255.0 ECU_ADDRESS 0x3F97FE /end MEASUREMENT
/begin MEASUREMENT ed_fsp_3of20_.ff_lam_reg_b1_nv "Einspritzsystem des Freeze Frame" UBYTE FORMULA_0054 0 0 0.0 255.0 ECU_ADDRESS 0x3F9850 /end MEASUREMENT
/begin MEASUREMENT ed_fsp_4of20_.ff_lam_reg_b1_nv "Einspritzsystem des Freeze Frame" UBYTE FORMULA_0054 0 0 0.0 255.0 ECU_ADDRESS 0x3F98A2 /end MEASUREMENT
/begin MEASUREMENT ed_fsp_5of20_.ff_lam_reg_b1_nv "Einspritzsystem des Freeze Frame" UBYTE FORMULA_0054 0 0 0.0 255.0 ECU_ADDRESS 0x3F98F4 /end MEASUREMENT
/begin MEASUREMENT ed_fsp_6of20_.ff_lam_reg_b1_nv "Einspritzsystem des Freeze Frame" UBYTE FORMULA_0054 0 0 0.0 255.0 ECU_ADDRESS 0x3F9946 /end MEASUREMENT
/begin MEASUREMENT ed_fsp_7of20_.ff_lam_reg_b1_nv "Einspritzsystem des Freeze Frame" UBYTE FORMULA_0054 0 0 0.0 255.0 ECU_ADDRESS 0x3F9998 /end MEASUREMENT
/begin MEASUREMENT ed_fsp_8of20_.ff_lam_reg_b1_nv "Einspritzsystem des Freeze Frame" UBYTE FORMULA_0054 0 0 0.0 255.0 ECU_ADDRESS 0x3F99EA /end MEASUREMENT
/begin MEASUREMENT ed_fsp_9of20_.ff_lam_reg_b1_nv "Einspritzsystem des Freeze Frame" UBYTE FORMULA_0054 0 0 0.0 255.0 ECU_ADDRESS 0x3F9A3C /end MEASUREMENT
/begin MEASUREMENT ed_fsp_14of20_.ff_lam_reg_b1_nv "Einspritzsystem des Freeze Frame" UBYTE FORMULA_0054 0 0 0.0 255.0 ECU_ADDRESS 0x3F9BD6 /end MEASUREMENT
/begin MEASUREMENT ed_fsp_15of20_.ff_lam_reg_b1_nv "Einspritzsystem des Freeze Frame" UBYTE FORMULA_0054 0 0 0.0 255.0 ECU_ADDRESS 0x3F9C28 /end MEASUREMENT
/begin MEASUREMENT ed_fsp_16of20_.ff_lam_reg_b1_nv "Einspritzsystem des Freeze Frame" UBYTE FORMULA_0054 0 0 0.0 255.0 ECU_ADDRESS 0x3F9C7A /end MEASUREMENT
/begin MEASUREMENT ed_fsp_17of20_.ff_lam_reg_b1_nv "Einspritzsystem des Freeze Frame" UBYTE FORMULA_0054 0 0 0.0 255.0 ECU_ADDRESS 0x3F9CCC /end MEASUREMENT
/begin MEASUREMENT ed_fsp_18of20_.ff_lam_reg_b1_nv "Einspritzsystem des Freeze Frame" UBYTE FORMULA_0054 0 0 0.0 255.0 ECU_ADDRESS 0x3F9D1E /end MEASUREMENT
/begin MEASUREMENT ed_fsp_19of20_.ff_lam_reg_b1_nv "Einspritzsystem des Freeze Frame" UBYTE FORMULA_0054 0 0 0.0 255.0 ECU_ADDRESS 0x3F9D70 /end MEASUREMENT
/begin MEASUREMENT ed_fsp_20of20_.ff_lam_reg_b1_nv "Einspritzsystem des Freeze Frame" UBYTE FORMULA_0054 0 0 0.0 255.0 ECU_ADDRESS 0x3F9DC2 /end MEASUREMENT
/begin MEASUREMENT ed_fsp_1of20_.ff_lam_reg_b2_nv "Einspritzsystem des Freeze Frame" UBYTE FORMULA_0054 0 0 0.0 255.0 ECU_ADDRESS 0x3F97AD /end MEASUREMENT
/begin MEASUREMENT ed_fsp_2of20_.ff_lam_reg_b2_nv "Einspritzsystem des Freeze Frame" UBYTE FORMULA_0054 0 0 0.0 255.0 ECU_ADDRESS 0x3F97FF /end MEASUREMENT
/begin MEASUREMENT ed_fsp_3of20_.ff_lam_reg_b2_nv "Einspritzsystem des Freeze Frame" UBYTE FORMULA_0054 0 0 0.0 255.0 ECU_ADDRESS 0x3F9851 /end MEASUREMENT
/begin MEASUREMENT ed_fsp_4of20_.ff_lam_reg_b2_nv "Einspritzsystem des Freeze Frame" UBYTE FORMULA_0054 0 0 0.0 255.0 ECU_ADDRESS 0x3F98A3 /end MEASUREMENT
/begin MEASUREMENT ed_fsp_5of20_.ff_lam_reg_b2_nv "Einspritzsystem des Freeze Frame" UBYTE FORMULA_0054 0 0 0.0 255.0 ECU_ADDRESS 0x3F98F5 /end MEASUREMENT
/begin MEASUREMENT ed_fsp_6of20_.ff_lam_reg_b2_nv "Einspritzsystem des Freeze Frame" UBYTE FORMULA_0054 0 0 0.0 255.0 ECU_ADDRESS 0x3F9947 /end MEASUREMENT
/begin MEASUREMENT ed_fsp_7of20_.ff_lam_reg_b2_nv "Einspritzsystem des Freeze Frame" UBYTE FORMULA_0054 0 0 0.0 255.0 ECU_ADDRESS 0x3F9999 /end MEASUREMENT
/begin MEASUREMENT ed_fsp_8of20_.ff_lam_reg_b2_nv "Einspritzsystem des Freeze Frame" UBYTE FORMULA_0054 0 0 0.0 255.0 ECU_ADDRESS 0x3F99EB /end MEASUREMENT
/begin MEASUREMENT ed_fsp_9of20_.ff_lam_reg_b2_nv "Einspritzsystem des Freeze Frame" UBYTE FORMULA_0054 0 0 0.0 255.0 ECU_ADDRESS 0x3F9A3D /end MEASUREMENT
/begin MEASUREMENT ed_fsp_14of20_.ff_lam_reg_b2_nv "Einspritzsystem des Freeze Frame" UBYTE FORMULA_0054 0 0 0.0 255.0 ECU_ADDRESS 0x3F9BD7 /end MEASUREMENT
/begin MEASUREMENT ed_fsp_15of20_.ff_lam_reg_b2_nv "Einspritzsystem des Freeze Frame" UBYTE FORMULA_0054 0 0 0.0 255.0 ECU_ADDRESS 0x3F9C29 /end MEASUREMENT
/begin MEASUREMENT ed_fsp_16of20_.ff_lam_reg_b2_nv "Einspritzsystem des Freeze Frame" UBYTE FORMULA_0054 0 0 0.0 255.0 ECU_ADDRESS 0x3F9C7B /end MEASUREMENT
/begin MEASUREMENT ed_fsp_17of20_.ff_lam_reg_b2_nv "Einspritzsystem des Freeze Frame" UBYTE FORMULA_0054 0 0 0.0 255.0 ECU_ADDRESS 0x3F9CCD /end MEASUREMENT
/begin MEASUREMENT ed_fsp_18of20_.ff_lam_reg_b2_nv "Einspritzsystem des Freeze Frame" UBYTE FORMULA_0054 0 0 0.0 255.0 ECU_ADDRESS 0x3F9D1F /end MEASUREMENT
/begin MEASUREMENT ed_fsp_19of20_.ff_lam_reg_b2_nv "Einspritzsystem des Freeze Frame" UBYTE FORMULA_0054 0 0 0.0 255.0 ECU_ADDRESS 0x3F9D71 /end MEASUREMENT
/begin MEASUREMENT ed_fsp_20of20_.ff_lam_reg_b2_nv "Einspritzsystem des Freeze Frame" UBYTE FORMULA_0054 0 0 0.0 255.0 ECU_ADDRESS 0x3F9DC3 /end MEASUREMENT
/begin MEASUREMENT ed_fsp_1of20_.ff_lam_reg_f_b1_nv "Lambdaregelfaktor des Freeze Frame" UBYTE FORMULA_0055 0 0 0.0 1.9921 ECU_ADDRESS 0x3F97AE /end MEASUREMENT
/begin MEASUREMENT ed_fsp_2of20_.ff_lam_reg_f_b1_nv "Lambdaregelfaktor des Freeze Frame" UBYTE FORMULA_0055 0 0 0.0 1.9921 ECU_ADDRESS 0x3F9800 /end MEASUREMENT
/begin MEASUREMENT ed_fsp_3of20_.ff_lam_reg_f_b1_nv "Lambdaregelfaktor des Freeze Frame" UBYTE FORMULA_0055 0 0 0.0 1.9921 ECU_ADDRESS 0x3F9852 /end MEASUREMENT
/begin MEASUREMENT ed_fsp_4of20_.ff_lam_reg_f_b1_nv "Lambdaregelfaktor des Freeze Frame" UBYTE FORMULA_0055 0 0 0.0 1.9921 ECU_ADDRESS 0x3F98A4 /end MEASUREMENT
/begin MEASUREMENT ed_fsp_5of20_.ff_lam_reg_f_b1_nv "Lambdaregelfaktor des Freeze Frame" UBYTE FORMULA_0055 0 0 0.0 1.9921 ECU_ADDRESS 0x3F98F6 /end MEASUREMENT
/begin MEASUREMENT ed_fsp_6of20_.ff_lam_reg_f_b1_nv "Lambdaregelfaktor des Freeze Frame" UBYTE FORMULA_0055 0 0 0.0 1.9921 ECU_ADDRESS 0x3F9948 /end MEASUREMENT
/begin MEASUREMENT ed_fsp_7of20_.ff_lam_reg_f_b1_nv "Lambdaregelfaktor des Freeze Frame" UBYTE FORMULA_0055 0 0 0.0 1.9921 ECU_ADDRESS 0x3F999A /end MEASUREMENT
/begin MEASUREMENT ed_fsp_8of20_.ff_lam_reg_f_b1_nv "Lambdaregelfaktor des Freeze Frame" UBYTE FORMULA_0055 0 0 0.0 1.9921 ECU_ADDRESS 0x3F99EC /end MEASUREMENT
/begin MEASUREMENT ed_fsp_9of20_.ff_lam_reg_f_b1_nv "Lambdaregelfaktor des Freeze Frame" UBYTE FORMULA_0055 0 0 0.0 1.9921 ECU_ADDRESS 0x3F9A3E /end MEASUREMENT
/begin MEASUREMENT ed_fsp_14of20_.ff_lam_reg_f_b1_nv "Lambdaregelfaktor des Freeze Frame" UBYTE FORMULA_0055 0 0 0.0 1.9921 ECU_ADDRESS 0x3F9BD8 /end MEASUREMENT
/begin MEASUREMENT ed_fsp_15of20_.ff_lam_reg_f_b1_nv "Lambdaregelfaktor des Freeze Frame" UBYTE FORMULA_0055 0 0 0.0 1.9921 ECU_ADDRESS 0x3F9C2A /end MEASUREMENT
/begin MEASUREMENT ed_fsp_16of20_.ff_lam_reg_f_b1_nv "Lambdaregelfaktor des Freeze Frame" UBYTE FORMULA_0055 0 0 0.0 1.9921 ECU_ADDRESS 0x3F9C7C /end MEASUREMENT
/begin MEASUREMENT ed_fsp_17of20_.ff_lam_reg_f_b1_nv "Lambdaregelfaktor des Freeze Frame" UBYTE FORMULA_0055 0 0 0.0 1.9921 ECU_ADDRESS 0x3F9CCE /end MEASUREMENT
/begin MEASUREMENT ed_fsp_18of20_.ff_lam_reg_f_b1_nv "Lambdaregelfaktor des Freeze Frame" UBYTE FORMULA_0055 0 0 0.0 1.9921 ECU_ADDRESS 0x3F9D20 /end MEASUREMENT
/begin MEASUREMENT ed_fsp_19of20_.ff_lam_reg_f_b1_nv "Lambdaregelfaktor des Freeze Frame" UBYTE FORMULA_0055 0 0 0.0 1.9921 ECU_ADDRESS 0x3F9D72 /end MEASUREMENT
/begin MEASUREMENT ed_fsp_20of20_.ff_lam_reg_f_b1_nv "Lambdaregelfaktor des Freeze Frame" UBYTE FORMULA_0055 0 0 0.0 1.9921 ECU_ADDRESS 0x3F9DC4 /end MEASUREMENT
/begin MEASUREMENT ed_fsp_1of20_.ff_lam_reg_f_b2_nv "Lambdaregelfaktor des Freeze Frame" UBYTE FORMULA_0055 0 0 0.0 1.9921 ECU_ADDRESS 0x3F97AF /end MEASUREMENT
/begin MEASUREMENT ed_fsp_2of20_.ff_lam_reg_f_b2_nv "Lambdaregelfaktor des Freeze Frame" UBYTE FORMULA_0055 0 0 0.0 1.9921 ECU_ADDRESS 0x3F9801 /end MEASUREMENT
/begin MEASUREMENT ed_fsp_3of20_.ff_lam_reg_f_b2_nv "Lambdaregelfaktor des Freeze Frame" UBYTE FORMULA_0055 0 0 0.0 1.9921 ECU_ADDRESS 0x3F9853 /end MEASUREMENT
/begin MEASUREMENT ed_fsp_4of20_.ff_lam_reg_f_b2_nv "Lambdaregelfaktor des Freeze Frame" UBYTE FORMULA_0055 0 0 0.0 1.9921 ECU_ADDRESS 0x3F98A5 /end MEASUREMENT
/begin MEASUREMENT ed_fsp_5of20_.ff_lam_reg_f_b2_nv "Lambdaregelfaktor des Freeze Frame" UBYTE FORMULA_0055 0 0 0.0 1.9921 ECU_ADDRESS 0x3F98F7 /end MEASUREMENT
/begin MEASUREMENT ed_fsp_6of20_.ff_lam_reg_f_b2_nv "Lambdaregelfaktor des Freeze Frame" UBYTE FORMULA_0055 0 0 0.0 1.9921 ECU_ADDRESS 0x3F9949 /end MEASUREMENT
/begin MEASUREMENT ed_fsp_7of20_.ff_lam_reg_f_b2_nv "Lambdaregelfaktor des Freeze Frame" UBYTE FORMULA_0055 0 0 0.0 1.9921 ECU_ADDRESS 0x3F999B /end MEASUREMENT
/begin MEASUREMENT ed_fsp_8of20_.ff_lam_reg_f_b2_nv "Lambdaregelfaktor des Freeze Frame" UBYTE FORMULA_0055 0 0 0.0 1.9921 ECU_ADDRESS 0x3F99ED /end MEASUREMENT
/begin MEASUREMENT ed_fsp_9of20_.ff_lam_reg_f_b2_nv "Lambdaregelfaktor des Freeze Frame" UBYTE FORMULA_0055 0 0 0.0 1.9921 ECU_ADDRESS 0x3F9A3F /end MEASUREMENT
/begin MEASUREMENT ed_fsp_14of20_.ff_lam_reg_f_b2_nv "Lambdaregelfaktor des Freeze Frame" UBYTE FORMULA_0055 0 0 0.0 1.9921 ECU_ADDRESS 0x3F9BD9 /end MEASUREMENT
/begin MEASUREMENT ed_fsp_15of20_.ff_lam_reg_f_b2_nv "Lambdaregelfaktor des Freeze Frame" UBYTE FORMULA_0055 0 0 0.0 1.9921 ECU_ADDRESS 0x3F9C2B /end MEASUREMENT
/begin MEASUREMENT ed_fsp_16of20_.ff_lam_reg_f_b2_nv "Lambdaregelfaktor des Freeze Frame" UBYTE FORMULA_0055 0 0 0.0 1.9921 ECU_ADDRESS 0x3F9C7D /end MEASUREMENT
/begin MEASUREMENT ed_fsp_17of20_.ff_lam_reg_f_b2_nv "Lambdaregelfaktor des Freeze Frame" UBYTE FORMULA_0055 0 0 0.0 1.9921 ECU_ADDRESS 0x3F9CCF /end MEASUREMENT
/begin MEASUREMENT ed_fsp_18of20_.ff_lam_reg_f_b2_nv "Lambdaregelfaktor des Freeze Frame" UBYTE FORMULA_0055 0 0 0.0 1.9921 ECU_ADDRESS 0x3F9D21 /end MEASUREMENT
/begin MEASUREMENT ed_fsp_19of20_.ff_lam_reg_f_b2_nv "Lambdaregelfaktor des Freeze Frame" UBYTE FORMULA_0055 0 0 0.0 1.9921 ECU_ADDRESS 0x3F9D73 /end MEASUREMENT
/begin MEASUREMENT ed_fsp_20of20_.ff_lam_reg_f_b2_nv "Lambdaregelfaktor des Freeze Frame" UBYTE FORMULA_0055 0 0 0.0 1.9921 ECU_ADDRESS 0x3F9DC5 /end MEASUREMENT
/begin MEASUREMENT ed_fsp_1of20_.ff_laa_f_ber_b1_nv "Lambdaadaptionsfaktor ohne TE des Freeze Frame" UBYTE FORMULA_0055 0 0 0.0 1.9921 ECU_ADDRESS 0x3F97B0 /end MEASUREMENT
/begin MEASUREMENT ed_fsp_2of20_.ff_laa_f_ber_b1_nv "Lambdaadaptionsfaktor ohne TE des Freeze Frame" UBYTE FORMULA_0055 0 0 0.0 1.9921 ECU_ADDRESS 0x3F9802 /end MEASUREMENT
/begin MEASUREMENT ed_fsp_3of20_.ff_laa_f_ber_b1_nv "Lambdaadaptionsfaktor ohne TE des Freeze Frame" UBYTE FORMULA_0055 0 0 0.0 1.9921 ECU_ADDRESS 0x3F9854 /end MEASUREMENT
/begin MEASUREMENT ed_fsp_4of20_.ff_laa_f_ber_b1_nv "Lambdaadaptionsfaktor ohne TE des Freeze Frame" UBYTE FORMULA_0055 0 0 0.0 1.9921 ECU_ADDRESS 0x3F98A6 /end MEASUREMENT
/begin MEASUREMENT ed_fsp_5of20_.ff_laa_f_ber_b1_nv "Lambdaadaptionsfaktor ohne TE des Freeze Frame" UBYTE FORMULA_0055 0 0 0.0 1.9921 ECU_ADDRESS 0x3F98F8 /end MEASUREMENT
/begin MEASUREMENT ed_fsp_6of20_.ff_laa_f_ber_b1_nv "Lambdaadaptionsfaktor ohne TE des Freeze Frame" UBYTE FORMULA_0055 0 0 0.0 1.9921 ECU_ADDRESS 0x3F994A /end MEASUREMENT
/begin MEASUREMENT ed_fsp_7of20_.ff_laa_f_ber_b1_nv "Lambdaadaptionsfaktor ohne TE des Freeze Frame" UBYTE FORMULA_0055 0 0 0.0 1.9921 ECU_ADDRESS 0x3F999C /end MEASUREMENT
/begin MEASUREMENT ed_fsp_8of20_.ff_laa_f_ber_b1_nv "Lambdaadaptionsfaktor ohne TE des Freeze Frame" UBYTE FORMULA_0055 0 0 0.0 1.9921 ECU_ADDRESS 0x3F99EE /end MEASUREMENT
/begin MEASUREMENT ed_fsp_9of20_.ff_laa_f_ber_b1_nv "Lambdaadaptionsfaktor ohne TE des Freeze Frame" UBYTE FORMULA_0055 0 0 0.0 1.9921 ECU_ADDRESS 0x3F9A40 /end MEASUREMENT
/begin MEASUREMENT ed_fsp_14of20_.ff_laa_f_ber_b1_nv "Lambdaadaptionsfaktor ohne TE des Freeze Frame" UBYTE FORMULA_0055 0 0 0.0 1.9921 ECU_ADDRESS 0x3F9BDA /end MEASUREMENT
/begin MEASUREMENT ed_fsp_15of20_.ff_laa_f_ber_b1_nv "Lambdaadaptionsfaktor ohne TE des Freeze Frame" UBYTE FORMULA_0055 0 0 0.0 1.9921 ECU_ADDRESS 0x3F9C2C /end MEASUREMENT
/begin MEASUREMENT ed_fsp_16of20_.ff_laa_f_ber_b1_nv "Lambdaadaptionsfaktor ohne TE des Freeze Frame" UBYTE FORMULA_0055 0 0 0.0 1.9921 ECU_ADDRESS 0x3F9C7E /end MEASUREMENT
/begin MEASUREMENT ed_fsp_17of20_.ff_laa_f_ber_b1_nv "Lambdaadaptionsfaktor ohne TE des Freeze Frame" UBYTE FORMULA_0055 0 0 0.0 1.9921 ECU_ADDRESS 0x3F9CD0 /end MEASUREMENT
/begin MEASUREMENT ed_fsp_18of20_.ff_laa_f_ber_b1_nv "Lambdaadaptionsfaktor ohne TE des Freeze Frame" UBYTE FORMULA_0055 0 0 0.0 1.9921 ECU_ADDRESS 0x3F9D22 /end MEASUREMENT
/begin MEASUREMENT ed_fsp_19of20_.ff_laa_f_ber_b1_nv "Lambdaadaptionsfaktor ohne TE des Freeze Frame" UBYTE FORMULA_0055 0 0 0.0 1.9921 ECU_ADDRESS 0x3F9D74 /end MEASUREMENT
/begin MEASUREMENT ed_fsp_20of20_.ff_laa_f_ber_b1_nv "Lambdaadaptionsfaktor ohne TE des Freeze Frame" UBYTE FORMULA_0055 0 0 0.0 1.9921 ECU_ADDRESS 0x3F9DC6 /end MEASUREMENT
/begin MEASUREMENT ed_fsp_1of20_.ff_laa_f_ber_b2_nv "Lambdaadaptionsfaktor ohne TE des Freeze Frame" UBYTE FORMULA_0055 0 0 0.0 1.9921 ECU_ADDRESS 0x3F97B1 /end MEASUREMENT
/begin MEASUREMENT ed_fsp_2of20_.ff_laa_f_ber_b2_nv "Lambdaadaptionsfaktor ohne TE des Freeze Frame" UBYTE FORMULA_0055 0 0 0.0 1.9921 ECU_ADDRESS 0x3F9803 /end MEASUREMENT
/begin MEASUREMENT ed_fsp_3of20_.ff_laa_f_ber_b2_nv "Lambdaadaptionsfaktor ohne TE des Freeze Frame" UBYTE FORMULA_0055 0 0 0.0 1.9921 ECU_ADDRESS 0x3F9855 /end MEASUREMENT
/begin MEASUREMENT ed_fsp_4of20_.ff_laa_f_ber_b2_nv "Lambdaadaptionsfaktor ohne TE des Freeze Frame" UBYTE FORMULA_0055 0 0 0.0 1.9921 ECU_ADDRESS 0x3F98A7 /end MEASUREMENT
/begin MEASUREMENT ed_fsp_5of20_.ff_laa_f_ber_b2_nv "Lambdaadaptionsfaktor ohne TE des Freeze Frame" UBYTE FORMULA_0055 0 0 0.0 1.9921 ECU_ADDRESS 0x3F98F9 /end MEASUREMENT
/begin MEASUREMENT ed_fsp_6of20_.ff_laa_f_ber_b2_nv "Lambdaadaptionsfaktor ohne TE des Freeze Frame" UBYTE FORMULA_0055 0 0 0.0 1.9921 ECU_ADDRESS 0x3F994B /end MEASUREMENT
/begin MEASUREMENT ed_fsp_7of20_.ff_laa_f_ber_b2_nv "Lambdaadaptionsfaktor ohne TE des Freeze Frame" UBYTE FORMULA_0055 0 0 0.0 1.9921 ECU_ADDRESS 0x3F999D /end MEASUREMENT
/begin MEASUREMENT ed_fsp_8of20_.ff_laa_f_ber_b2_nv "Lambdaadaptionsfaktor ohne TE des Freeze Frame" UBYTE FORMULA_0055 0 0 0.0 1.9921 ECU_ADDRESS 0x3F99EF /end MEASUREMENT
/begin MEASUREMENT ed_fsp_9of20_.ff_laa_f_ber_b2_nv "Lambdaadaptionsfaktor ohne TE des Freeze Frame" UBYTE FORMULA_0055 0 0 0.0 1.9921 ECU_ADDRESS 0x3F9A41 /end MEASUREMENT
/begin MEASUREMENT ed_fsp_14of20_.ff_laa_f_ber_b2_nv "Lambdaadaptionsfaktor ohne TE des Freeze Frame" UBYTE FORMULA_0055 0 0 0.0 1.9921 ECU_ADDRESS 0x3F9BDB /end MEASUREMENT
/begin MEASUREMENT ed_fsp_15of20_.ff_laa_f_ber_b2_nv "Lambdaadaptionsfaktor ohne TE des Freeze Frame" UBYTE FORMULA_0055 0 0 0.0 1.9921 ECU_ADDRESS 0x3F9C2D /end MEASUREMENT
/begin MEASUREMENT ed_fsp_16of20_.ff_laa_f_ber_b2_nv "Lambdaadaptionsfaktor ohne TE des Freeze Frame" UBYTE FORMULA_0055 0 0 0.0 1.9921 ECU_ADDRESS 0x3F9C7F /end MEASUREMENT
/begin MEASUREMENT ed_fsp_17of20_.ff_laa_f_ber_b2_nv "Lambdaadaptionsfaktor ohne TE des Freeze Frame" UBYTE FORMULA_0055 0 0 0.0 1.9921 ECU_ADDRESS 0x3F9CD1 /end MEASUREMENT
/begin MEASUREMENT ed_fsp_18of20_.ff_laa_f_ber_b2_nv "Lambdaadaptionsfaktor ohne TE des Freeze Frame" UBYTE FORMULA_0055 0 0 0.0 1.9921 ECU_ADDRESS 0x3F9D23 /end MEASUREMENT
/begin MEASUREMENT ed_fsp_19of20_.ff_laa_f_ber_b2_nv "Lambdaadaptionsfaktor ohne TE des Freeze Frame" UBYTE FORMULA_0055 0 0 0.0 1.9921 ECU_ADDRESS 0x3F9D75 /end MEASUREMENT
/begin MEASUREMENT ed_fsp_20of20_.ff_laa_f_ber_b2_nv "Lambdaadaptionsfaktor ohne TE des Freeze Frame" UBYTE FORMULA_0055 0 0 0.0 1.9921 ECU_ADDRESS 0x3F9DC7 /end MEASUREMENT
/begin MEASUREMENT ed_fsp_1of20_.ff_rf_b1_berech_nv "Berechnete_Last des Freeze Frame" UBYTE FORMULA_0056 0 0 0.0 100.0000 ECU_ADDRESS 0x3F97B2 /end MEASUREMENT
/begin MEASUREMENT ed_fsp_2of20_.ff_rf_b1_berech_nv "Berechnete_Last des Freeze Frame" UBYTE FORMULA_0056 0 0 0.0 100.0000 ECU_ADDRESS 0x3F9804 /end MEASUREMENT
/begin MEASUREMENT ed_fsp_3of20_.ff_rf_b1_berech_nv "Berechnete_Last des Freeze Frame" UBYTE FORMULA_0056 0 0 0.0 100.0000 ECU_ADDRESS 0x3F9856 /end MEASUREMENT
/begin MEASUREMENT ed_fsp_4of20_.ff_rf_b1_berech_nv "Berechnete_Last des Freeze Frame" UBYTE FORMULA_0056 0 0 0.0 100.0000 ECU_ADDRESS 0x3F98A8 /end MEASUREMENT
/begin MEASUREMENT ed_fsp_5of20_.ff_rf_b1_berech_nv "Berechnete_Last des Freeze Frame" UBYTE FORMULA_0056 0 0 0.0 100.0000 ECU_ADDRESS 0x3F98FA /end MEASUREMENT
/begin MEASUREMENT ed_fsp_6of20_.ff_rf_b1_berech_nv "Berechnete_Last des Freeze Frame" UBYTE FORMULA_0056 0 0 0.0 100.0000 ECU_ADDRESS 0x3F994C /end MEASUREMENT
/begin MEASUREMENT ed_fsp_7of20_.ff_rf_b1_berech_nv "Berechnete_Last des Freeze Frame" UBYTE FORMULA_0056 0 0 0.0 100.0000 ECU_ADDRESS 0x3F999E /end MEASUREMENT
/begin MEASUREMENT ed_fsp_8of20_.ff_rf_b1_berech_nv "Berechnete_Last des Freeze Frame" UBYTE FORMULA_0056 0 0 0.0 100.0000 ECU_ADDRESS 0x3F99F0 /end MEASUREMENT
/begin MEASUREMENT ed_fsp_9of20_.ff_rf_b1_berech_nv "Berechnete_Last des Freeze Frame" UBYTE FORMULA_0056 0 0 0.0 100.0000 ECU_ADDRESS 0x3F9A42 /end MEASUREMENT
/begin MEASUREMENT ed_fsp_14of20_.ff_rf_b1_berech_nv "Berechnete_Last des Freeze Frame" UBYTE FORMULA_0056 0 0 0.0 100.0000 ECU_ADDRESS 0x3F9BDC /end MEASUREMENT
/begin MEASUREMENT ed_fsp_15of20_.ff_rf_b1_berech_nv "Berechnete_Last des Freeze Frame" UBYTE FORMULA_0056 0 0 0.0 100.0000 ECU_ADDRESS 0x3F9C2E /end MEASUREMENT
/begin MEASUREMENT ed_fsp_16of20_.ff_rf_b1_berech_nv "Berechnete_Last des Freeze Frame" UBYTE FORMULA_0056 0 0 0.0 100.0000 ECU_ADDRESS 0x3F9C80 /end MEASUREMENT
/begin MEASUREMENT ed_fsp_17of20_.ff_rf_b1_berech_nv "Berechnete_Last des Freeze Frame" UBYTE FORMULA_0056 0 0 0.0 100.0000 ECU_ADDRESS 0x3F9CD2 /end MEASUREMENT
/begin MEASUREMENT ed_fsp_18of20_.ff_rf_b1_berech_nv "Berechnete_Last des Freeze Frame" UBYTE FORMULA_0056 0 0 0.0 100.0000 ECU_ADDRESS 0x3F9D24 /end MEASUREMENT
/begin MEASUREMENT ed_fsp_19of20_.ff_rf_b1_berech_nv "Berechnete_Last des Freeze Frame" UBYTE FORMULA_0056 0 0 0.0 100.0000 ECU_ADDRESS 0x3F9D76 /end MEASUREMENT
/begin MEASUREMENT ed_fsp_20of20_.ff_rf_b1_berech_nv "Berechnete_Last des Freeze Frame" UBYTE FORMULA_0056 0 0 0.0 100.0000 ECU_ADDRESS 0x3F9DC8 /end MEASUREMENT
/begin MEASUREMENT ed_fsp_1of20_.ff_tmot_nv "Kuehlwassertemperatur des Freeze Frame" UBYTE FORMULA_0057 0 0 -40.0000 215.0000 ECU_ADDRESS 0x3F97B3 /end MEASUREMENT
/begin MEASUREMENT ed_fsp_2of20_.ff_tmot_nv "Kuehlwassertemperatur des Freeze Frame" UBYTE FORMULA_0057 0 0 -40.0000 215.0000 ECU_ADDRESS 0x3F9805 /end MEASUREMENT
/begin MEASUREMENT ed_fsp_3of20_.ff_tmot_nv "Kuehlwassertemperatur des Freeze Frame" UBYTE FORMULA_0057 0 0 -40.0000 215.0000 ECU_ADDRESS 0x3F9857 /end MEASUREMENT
/begin MEASUREMENT ed_fsp_4of20_.ff_tmot_nv "Kuehlwassertemperatur des Freeze Frame" UBYTE FORMULA_0057 0 0 -40.0000 215.0000 ECU_ADDRESS 0x3F98A9 /end MEASUREMENT
/begin MEASUREMENT ed_fsp_5of20_.ff_tmot_nv "Kuehlwassertemperatur des Freeze Frame" UBYTE FORMULA_0057 0 0 -40.0000 215.0000 ECU_ADDRESS 0x3F98FB /end MEASUREMENT
/begin MEASUREMENT ed_fsp_6of20_.ff_tmot_nv "Kuehlwassertemperatur des Freeze Frame" UBYTE FORMULA_0057 0 0 -40.0000 215.0000 ECU_ADDRESS 0x3F994D /end MEASUREMENT
/begin MEASUREMENT ed_fsp_7of20_.ff_tmot_nv "Kuehlwassertemperatur des Freeze Frame" UBYTE FORMULA_0057 0 0 -40.0000 215.0000 ECU_ADDRESS 0x3F999F /end MEASUREMENT
/begin MEASUREMENT ed_fsp_8of20_.ff_tmot_nv "Kuehlwassertemperatur des Freeze Frame" UBYTE FORMULA_0057 0 0 -40.0000 215.0000 ECU_ADDRESS 0x3F99F1 /end MEASUREMENT
/begin MEASUREMENT ed_fsp_9of20_.ff_tmot_nv "Kuehlwassertemperatur des Freeze Frame" UBYTE FORMULA_0057 0 0 -40.0000 215.0000 ECU_ADDRESS 0x3F9A43 /end MEASUREMENT
/begin MEASUREMENT ed_fsp_14of20_.ff_tmot_nv "Kuehlwassertemperatur des Freeze Frame" UBYTE FORMULA_0057 0 0 -40.0000 215.0000 ECU_ADDRESS 0x3F9BDD /end MEASUREMENT
/begin MEASUREMENT ed_fsp_15of20_.ff_tmot_nv "Kuehlwassertemperatur des Freeze Frame" UBYTE FORMULA_0057 0 0 -40.0000 215.0000 ECU_ADDRESS 0x3F9C2F /end MEASUREMENT
/begin MEASUREMENT ed_fsp_16of20_.ff_tmot_nv "Kuehlwassertemperatur des Freeze Frame" UBYTE FORMULA_0057 0 0 -40.0000 215.0000 ECU_ADDRESS 0x3F9C81 /end MEASUREMENT
/begin MEASUREMENT ed_fsp_17of20_.ff_tmot_nv "Kuehlwassertemperatur des Freeze Frame" UBYTE FORMULA_0057 0 0 -40.0000 215.0000 ECU_ADDRESS 0x3F9CD3 /end MEASUREMENT
/begin MEASUREMENT ed_fsp_18of20_.ff_tmot_nv "Kuehlwassertemperatur des Freeze Frame" UBYTE FORMULA_0057 0 0 -40.0000 215.0000 ECU_ADDRESS 0x3F9D25 /end MEASUREMENT
/begin MEASUREMENT ed_fsp_19of20_.ff_tmot_nv "Kuehlwassertemperatur des Freeze Frame" UBYTE FORMULA_0057 0 0 -40.0000 215.0000 ECU_ADDRESS 0x3F9D77 /end MEASUREMENT
/begin MEASUREMENT ed_fsp_20of20_.ff_tmot_nv "Kuehlwassertemperatur des Freeze Frame" UBYTE FORMULA_0057 0 0 -40.0000 215.0000 ECU_ADDRESS 0x3F9DC9 /end MEASUREMENT
/begin MEASUREMENT ed_fsp_1of20_.ff_pks_ist_nv "Kraftstoffdruck des Freeze Frame" UBYTE FORMULA_0058 0 0 0.0 765.0000 ECU_ADDRESS 0x3F97B4 /end MEASUREMENT
/begin MEASUREMENT ed_fsp_2of20_.ff_pks_ist_nv "Kraftstoffdruck des Freeze Frame" UBYTE FORMULA_0058 0 0 0.0 765.0000 ECU_ADDRESS 0x3F9806 /end MEASUREMENT
/begin MEASUREMENT ed_fsp_3of20_.ff_pks_ist_nv "Kraftstoffdruck des Freeze Frame" UBYTE FORMULA_0058 0 0 0.0 765.0000 ECU_ADDRESS 0x3F9858 /end MEASUREMENT
/begin MEASUREMENT ed_fsp_4of20_.ff_pks_ist_nv "Kraftstoffdruck des Freeze Frame" UBYTE FORMULA_0058 0 0 0.0 765.0000 ECU_ADDRESS 0x3F98AA /end MEASUREMENT
/begin MEASUREMENT ed_fsp_5of20_.ff_pks_ist_nv "Kraftstoffdruck des Freeze Frame" UBYTE FORMULA_0058 0 0 0.0 765.0000 ECU_ADDRESS 0x3F98FC /end MEASUREMENT
/begin MEASUREMENT ed_fsp_6of20_.ff_pks_ist_nv "Kraftstoffdruck des Freeze Frame" UBYTE FORMULA_0058 0 0 0.0 765.0000 ECU_ADDRESS 0x3F994E /end MEASUREMENT
/begin MEASUREMENT ed_fsp_7of20_.ff_pks_ist_nv "Kraftstoffdruck des Freeze Frame" UBYTE FORMULA_0058 0 0 0.0 765.0000 ECU_ADDRESS 0x3F99A0 /end MEASUREMENT
/begin MEASUREMENT ed_fsp_8of20_.ff_pks_ist_nv "Kraftstoffdruck des Freeze Frame" UBYTE FORMULA_0058 0 0 0.0 765.0000 ECU_ADDRESS 0x3F99F2 /end MEASUREMENT
/begin MEASUREMENT ed_fsp_9of20_.ff_pks_ist_nv "Kraftstoffdruck des Freeze Frame" UBYTE FORMULA_0058 0 0 0.0 765.0000 ECU_ADDRESS 0x3F9A44 /end MEASUREMENT
/begin MEASUREMENT ed_fsp_14of20_.ff_pks_ist_nv "Kraftstoffdruck des Freeze Frame" UBYTE FORMULA_0058 0 0 0.0 765.0000 ECU_ADDRESS 0x3F9BDE /end MEASUREMENT
/begin MEASUREMENT ed_fsp_15of20_.ff_pks_ist_nv "Kraftstoffdruck des Freeze Frame" UBYTE FORMULA_0058 0 0 0.0 765.0000 ECU_ADDRESS 0x3F9C30 /end MEASUREMENT
/begin MEASUREMENT ed_fsp_16of20_.ff_pks_ist_nv "Kraftstoffdruck des Freeze Frame" UBYTE FORMULA_0058 0 0 0.0 765.0000 ECU_ADDRESS 0x3F9C82 /end MEASUREMENT
/begin MEASUREMENT ed_fsp_17of20_.ff_pks_ist_nv "Kraftstoffdruck des Freeze Frame" UBYTE FORMULA_0058 0 0 0.0 765.0000 ECU_ADDRESS 0x3F9CD4 /end MEASUREMENT
/begin MEASUREMENT ed_fsp_18of20_.ff_pks_ist_nv "Kraftstoffdruck des Freeze Frame" UBYTE FORMULA_0058 0 0 0.0 765.0000 ECU_ADDRESS 0x3F9D26 /end MEASUREMENT
/begin MEASUREMENT ed_fsp_19of20_.ff_pks_ist_nv "Kraftstoffdruck des Freeze Frame" UBYTE FORMULA_0058 0 0 0.0 765.0000 ECU_ADDRESS 0x3F9D78 /end MEASUREMENT
/begin MEASUREMENT ed_fsp_20of20_.ff_pks_ist_nv "Kraftstoffdruck des Freeze Frame" UBYTE FORMULA_0058 0 0 0.0 765.0000 ECU_ADDRESS 0x3F9DCA /end MEASUREMENT
/begin MEASUREMENT ed_fsp_1of20_.ff_v_vorne_nv "Geschwindigkeit des Freeze Frame" UBYTE FORMULA_0059 0 0 0.0 255.0000 ECU_ADDRESS 0x3F97B5 /end MEASUREMENT
/begin MEASUREMENT ed_fsp_2of20_.ff_v_vorne_nv "Geschwindigkeit des Freeze Frame" UBYTE FORMULA_0059 0 0 0.0 255.0000 ECU_ADDRESS 0x3F9807 /end MEASUREMENT
/begin MEASUREMENT ed_fsp_3of20_.ff_v_vorne_nv "Geschwindigkeit des Freeze Frame" UBYTE FORMULA_0059 0 0 0.0 255.0000 ECU_ADDRESS 0x3F9859 /end MEASUREMENT
/begin MEASUREMENT ed_fsp_4of20_.ff_v_vorne_nv "Geschwindigkeit des Freeze Frame" UBYTE FORMULA_0059 0 0 0.0 255.0000 ECU_ADDRESS 0x3F98AB /end MEASUREMENT
/begin MEASUREMENT ed_fsp_5of20_.ff_v_vorne_nv "Geschwindigkeit des Freeze Frame" UBYTE FORMULA_0059 0 0 0.0 255.0000 ECU_ADDRESS 0x3F98FD /end MEASUREMENT
/begin MEASUREMENT ed_fsp_6of20_.ff_v_vorne_nv "Geschwindigkeit des Freeze Frame" UBYTE FORMULA_0059 0 0 0.0 255.0000 ECU_ADDRESS 0x3F994F /end MEASUREMENT
/begin MEASUREMENT ed_fsp_7of20_.ff_v_vorne_nv "Geschwindigkeit des Freeze Frame" UBYTE FORMULA_0059 0 0 0.0 255.0000 ECU_ADDRESS 0x3F99A1 /end MEASUREMENT
/begin MEASUREMENT ed_fsp_8of20_.ff_v_vorne_nv "Geschwindigkeit des Freeze Frame" UBYTE FORMULA_0059 0 0 0.0 255.0000 ECU_ADDRESS 0x3F99F3 /end MEASUREMENT
/begin MEASUREMENT ed_fsp_9of20_.ff_v_vorne_nv "Geschwindigkeit des Freeze Frame" UBYTE FORMULA_0059 0 0 0.0 255.0000 ECU_ADDRESS 0x3F9A45 /end MEASUREMENT
/begin MEASUREMENT ed_fsp_14of20_.ff_v_vorne_nv "Geschwindigkeit des Freeze Frame" UBYTE FORMULA_0059 0 0 0.0 255.0000 ECU_ADDRESS 0x3F9BDF /end MEASUREMENT
/begin MEASUREMENT ed_fsp_15of20_.ff_v_vorne_nv "Geschwindigkeit des Freeze Frame" UBYTE FORMULA_0059 0 0 0.0 255.0000 ECU_ADDRESS 0x3F9C31 /end MEASUREMENT
/begin MEASUREMENT ed_fsp_16of20_.ff_v_vorne_nv "Geschwindigkeit des Freeze Frame" UBYTE FORMULA_0059 0 0 0.0 255.0000 ECU_ADDRESS 0x3F9C83 /end MEASUREMENT
/begin MEASUREMENT ed_fsp_17of20_.ff_v_vorne_nv "Geschwindigkeit des Freeze Frame" UBYTE FORMULA_0059 0 0 0.0 255.0000 ECU_ADDRESS 0x3F9CD5 /end MEASUREMENT
/begin MEASUREMENT ed_fsp_18of20_.ff_v_vorne_nv "Geschwindigkeit des Freeze Frame" UBYTE FORMULA_0059 0 0 0.0 255.0000 ECU_ADDRESS 0x3F9D27 /end MEASUREMENT
/begin MEASUREMENT ed_fsp_19of20_.ff_v_vorne_nv "Geschwindigkeit des Freeze Frame" UBYTE FORMULA_0059 0 0 0.0 255.0000 ECU_ADDRESS 0x3F9D79 /end MEASUREMENT
/begin MEASUREMENT ed_fsp_20of20_.ff_v_vorne_nv "Geschwindigkeit des Freeze Frame" UBYTE FORMULA_0059 0 0 0.0 255.0000 ECU_ADDRESS 0x3F9DCB /end MEASUREMENT
/begin MEASUREMENT ed_fsp_1of20_.ff_tz1_nv "Zuendwinkel 1 des Freeze Frame" UBYTE FORMULA_0060 0 0 -64.0000 63.5000 ECU_ADDRESS 0x3F97B6 /end MEASUREMENT
/begin MEASUREMENT ed_fsp_2of20_.ff_tz1_nv "Zuendwinkel 1 des Freeze Frame" UBYTE FORMULA_0060 0 0 -64.0000 63.5000 ECU_ADDRESS 0x3F9808 /end MEASUREMENT
/begin MEASUREMENT ed_fsp_3of20_.ff_tz1_nv "Zuendwinkel 1 des Freeze Frame" UBYTE FORMULA_0060 0 0 -64.0000 63.5000 ECU_ADDRESS 0x3F985A /end MEASUREMENT
/begin MEASUREMENT ed_fsp_4of20_.ff_tz1_nv "Zuendwinkel 1 des Freeze Frame" UBYTE FORMULA_0060 0 0 -64.0000 63.5000 ECU_ADDRESS 0x3F98AC /end MEASUREMENT
/begin MEASUREMENT ed_fsp_5of20_.ff_tz1_nv "Zuendwinkel 1 des Freeze Frame" UBYTE FORMULA_0060 0 0 -64.0000 63.5000 ECU_ADDRESS 0x3F98FE /end MEASUREMENT
/begin MEASUREMENT ed_fsp_6of20_.ff_tz1_nv "Zuendwinkel 1 des Freeze Frame" UBYTE FORMULA_0060 0 0 -64.0000 63.5000 ECU_ADDRESS 0x3F9950 /end MEASUREMENT
/begin MEASUREMENT ed_fsp_7of20_.ff_tz1_nv "Zuendwinkel 1 des Freeze Frame" UBYTE FORMULA_0060 0 0 -64.0000 63.5000 ECU_ADDRESS 0x3F99A2 /end MEASUREMENT
/begin MEASUREMENT ed_fsp_8of20_.ff_tz1_nv "Zuendwinkel 1 des Freeze Frame" UBYTE FORMULA_0060 0 0 -64.0000 63.5000 ECU_ADDRESS 0x3F99F4 /end MEASUREMENT
/begin MEASUREMENT ed_fsp_9of20_.ff_tz1_nv "Zuendwinkel 1 des Freeze Frame" UBYTE FORMULA_0060 0 0 -64.0000 63.5000 ECU_ADDRESS 0x3F9A46 /end MEASUREMENT
/begin MEASUREMENT ed_fsp_14of20_.ff_tz1_nv "Zuendwinkel 1 des Freeze Frame" UBYTE FORMULA_0060 0 0 -64.0000 63.5000 ECU_ADDRESS 0x3F9BE0 /end MEASUREMENT
/begin MEASUREMENT ed_fsp_15of20_.ff_tz1_nv "Zuendwinkel 1 des Freeze Frame" UBYTE FORMULA_0060 0 0 -64.0000 63.5000 ECU_ADDRESS 0x3F9C32 /end MEASUREMENT
/begin MEASUREMENT ed_fsp_16of20_.ff_tz1_nv "Zuendwinkel 1 des Freeze Frame" UBYTE FORMULA_0060 0 0 -64.0000 63.5000 ECU_ADDRESS 0x3F9C84 /end MEASUREMENT
/begin MEASUREMENT ed_fsp_17of20_.ff_tz1_nv "Zuendwinkel 1 des Freeze Frame" UBYTE FORMULA_0060 0 0 -64.0000 63.5000 ECU_ADDRESS 0x3F9CD6 /end MEASUREMENT
/begin MEASUREMENT ed_fsp_18of20_.ff_tz1_nv "Zuendwinkel 1 des Freeze Frame" UBYTE FORMULA_0060 0 0 -64.0000 63.5000 ECU_ADDRESS 0x3F9D28 /end MEASUREMENT
/begin MEASUREMENT ed_fsp_19of20_.ff_tz1_nv "Zuendwinkel 1 des Freeze Frame" UBYTE FORMULA_0060 0 0 -64.0000 63.5000 ECU_ADDRESS 0x3F9D7A /end MEASUREMENT
/begin MEASUREMENT ed_fsp_20of20_.ff_tz1_nv "Zuendwinkel 1 des Freeze Frame" UBYTE FORMULA_0060 0 0 -64.0000 63.5000 ECU_ADDRESS 0x3F9DCC /end MEASUREMENT
/begin MEASUREMENT ed_fsp_1of20_.ff_tan_b1_nv "Ansauglufttemperatur des Freeze Frame" UBYTE FORMULA_0057 0 0 -40.0000 215.0000 ECU_ADDRESS 0x3F97B7 /end MEASUREMENT
/begin MEASUREMENT ed_fsp_2of20_.ff_tan_b1_nv "Ansauglufttemperatur des Freeze Frame" UBYTE FORMULA_0057 0 0 -40.0000 215.0000 ECU_ADDRESS 0x3F9809 /end MEASUREMENT
/begin MEASUREMENT ed_fsp_3of20_.ff_tan_b1_nv "Ansauglufttemperatur des Freeze Frame" UBYTE FORMULA_0057 0 0 -40.0000 215.0000 ECU_ADDRESS 0x3F985B /end MEASUREMENT
/begin MEASUREMENT ed_fsp_4of20_.ff_tan_b1_nv "Ansauglufttemperatur des Freeze Frame" UBYTE FORMULA_0057 0 0 -40.0000 215.0000 ECU_ADDRESS 0x3F98AD /end MEASUREMENT
/begin MEASUREMENT ed_fsp_5of20_.ff_tan_b1_nv "Ansauglufttemperatur des Freeze Frame" UBYTE FORMULA_0057 0 0 -40.0000 215.0000 ECU_ADDRESS 0x3F98FF /end MEASUREMENT
/begin MEASUREMENT ed_fsp_6of20_.ff_tan_b1_nv "Ansauglufttemperatur des Freeze Frame" UBYTE FORMULA_0057 0 0 -40.0000 215.0000 ECU_ADDRESS 0x3F9951 /end MEASUREMENT
/begin MEASUREMENT ed_fsp_7of20_.ff_tan_b1_nv "Ansauglufttemperatur des Freeze Frame" UBYTE FORMULA_0057 0 0 -40.0000 215.0000 ECU_ADDRESS 0x3F99A3 /end MEASUREMENT
/begin MEASUREMENT ed_fsp_8of20_.ff_tan_b1_nv "Ansauglufttemperatur des Freeze Frame" UBYTE FORMULA_0057 0 0 -40.0000 215.0000 ECU_ADDRESS 0x3F99F5 /end MEASUREMENT
/begin MEASUREMENT ed_fsp_9of20_.ff_tan_b1_nv "Ansauglufttemperatur des Freeze Frame" UBYTE FORMULA_0057 0 0 -40.0000 215.0000 ECU_ADDRESS 0x3F9A47 /end MEASUREMENT
/begin MEASUREMENT ed_fsp_14of20_.ff_tan_b1_nv "Ansauglufttemperatur des Freeze Frame" UBYTE FORMULA_0057 0 0 -40.0000 215.0000 ECU_ADDRESS 0x3F9BE1 /end MEASUREMENT
/begin MEASUREMENT ed_fsp_15of20_.ff_tan_b1_nv "Ansauglufttemperatur des Freeze Frame" UBYTE FORMULA_0057 0 0 -40.0000 215.0000 ECU_ADDRESS 0x3F9C33 /end MEASUREMENT
/begin MEASUREMENT ed_fsp_16of20_.ff_tan_b1_nv "Ansauglufttemperatur des Freeze Frame" UBYTE FORMULA_0057 0 0 -40.0000 215.0000 ECU_ADDRESS 0x3F9C85 /end MEASUREMENT
/begin MEASUREMENT ed_fsp_17of20_.ff_tan_b1_nv "Ansauglufttemperatur des Freeze Frame" UBYTE FORMULA_0057 0 0 -40.0000 215.0000 ECU_ADDRESS 0x3F9CD7 /end MEASUREMENT
/begin MEASUREMENT ed_fsp_18of20_.ff_tan_b1_nv "Ansauglufttemperatur des Freeze Frame" UBYTE FORMULA_0057 0 0 -40.0000 215.0000 ECU_ADDRESS 0x3F9D29 /end MEASUREMENT
/begin MEASUREMENT ed_fsp_19of20_.ff_tan_b1_nv "Ansauglufttemperatur des Freeze Frame" UBYTE FORMULA_0057 0 0 -40.0000 215.0000 ECU_ADDRESS 0x3F9D7B /end MEASUREMENT
/begin MEASUREMENT ed_fsp_20of20_.ff_tan_b1_nv "Ansauglufttemperatur des Freeze Frame" UBYTE FORMULA_0057 0 0 -40.0000 215.0000 ECU_ADDRESS 0x3F9DCD /end MEASUREMENT
/begin MEASUREMENT ed_fsp_1of20_.ff_egas_abs_dk_b1_nv "Absolute Drosselklappenposition des Freeze Frame" UBYTE FORMULA_0056 0 0 0.0 100.0000 ECU_ADDRESS 0x3F97B8 /end MEASUREMENT
/begin MEASUREMENT ed_fsp_2of20_.ff_egas_abs_dk_b1_nv "Absolute Drosselklappenposition des Freeze Frame" UBYTE FORMULA_0056 0 0 0.0 100.0000 ECU_ADDRESS 0x3F980A /end MEASUREMENT
/begin MEASUREMENT ed_fsp_3of20_.ff_egas_abs_dk_b1_nv "Absolute Drosselklappenposition des Freeze Frame" UBYTE FORMULA_0056 0 0 0.0 100.0000 ECU_ADDRESS 0x3F985C /end MEASUREMENT
/begin MEASUREMENT ed_fsp_4of20_.ff_egas_abs_dk_b1_nv "Absolute Drosselklappenposition des Freeze Frame" UBYTE FORMULA_0056 0 0 0.0 100.0000 ECU_ADDRESS 0x3F98AE /end MEASUREMENT
/begin MEASUREMENT ed_fsp_5of20_.ff_egas_abs_dk_b1_nv "Absolute Drosselklappenposition des Freeze Frame" UBYTE FORMULA_0056 0 0 0.0 100.0000 ECU_ADDRESS 0x3F9900 /end MEASUREMENT
/begin MEASUREMENT ed_fsp_6of20_.ff_egas_abs_dk_b1_nv "Absolute Drosselklappenposition des Freeze Frame" UBYTE FORMULA_0056 0 0 0.0 100.0000 ECU_ADDRESS 0x3F9952 /end MEASUREMENT
/begin MEASUREMENT ed_fsp_7of20_.ff_egas_abs_dk_b1_nv "Absolute Drosselklappenposition des Freeze Frame" UBYTE FORMULA_0056 0 0 0.0 100.0000 ECU_ADDRESS 0x3F99A4 /end MEASUREMENT
/begin MEASUREMENT ed_fsp_8of20_.ff_egas_abs_dk_b1_nv "Absolute Drosselklappenposition des Freeze Frame" UBYTE FORMULA_0056 0 0 0.0 100.0000 ECU_ADDRESS 0x3F99F6 /end MEASUREMENT
/begin MEASUREMENT ed_fsp_9of20_.ff_egas_abs_dk_b1_nv "Absolute Drosselklappenposition des Freeze Frame" UBYTE FORMULA_0056 0 0 0.0 100.0000 ECU_ADDRESS 0x3F9A48 /end MEASUREMENT
/begin MEASUREMENT ed_fsp_14of20_.ff_egas_abs_dk_b1_nv "Absolute Drosselklappenposition des Freeze Frame" UBYTE FORMULA_0056 0 0 0.0 100.0000 ECU_ADDRESS 0x3F9BE2 /end MEASUREMENT
/begin MEASUREMENT ed_fsp_15of20_.ff_egas_abs_dk_b1_nv "Absolute Drosselklappenposition des Freeze Frame" UBYTE FORMULA_0056 0 0 0.0 100.0000 ECU_ADDRESS 0x3F9C34 /end MEASUREMENT
/begin MEASUREMENT ed_fsp_16of20_.ff_egas_abs_dk_b1_nv "Absolute Drosselklappenposition des Freeze Frame" UBYTE FORMULA_0056 0 0 0.0 100.0000 ECU_ADDRESS 0x3F9C86 /end MEASUREMENT
/begin MEASUREMENT ed_fsp_17of20_.ff_egas_abs_dk_b1_nv "Absolute Drosselklappenposition des Freeze Frame" UBYTE FORMULA_0056 0 0 0.0 100.0000 ECU_ADDRESS 0x3F9CD8 /end MEASUREMENT
/begin MEASUREMENT ed_fsp_18of20_.ff_egas_abs_dk_b1_nv "Absolute Drosselklappenposition des Freeze Frame" UBYTE FORMULA_0056 0 0 0.0 100.0000 ECU_ADDRESS 0x3F9D2A /end MEASUREMENT
/begin MEASUREMENT ed_fsp_19of20_.ff_egas_abs_dk_b1_nv "Absolute Drosselklappenposition des Freeze Frame" UBYTE FORMULA_0056 0 0 0.0 100.0000 ECU_ADDRESS 0x3F9D7C /end MEASUREMENT
/begin MEASUREMENT ed_fsp_20of20_.ff_egas_abs_dk_b1_nv "Absolute Drosselklappenposition des Freeze Frame" UBYTE FORMULA_0056 0 0 0.0 100.0000 ECU_ADDRESS 0x3F9DCE /end MEASUREMENT
/begin MEASUREMENT ed_fsp_1of20_.ff_sl_st_nv "Sekundaerluftstatus des Freeze Frame" UBYTE FORMULA_0061 0 0 0.0 255.0 ECU_ADDRESS 0x3F97B9 /end MEASUREMENT
/begin MEASUREMENT ed_fsp_2of20_.ff_sl_st_nv "Sekundaerluftstatus des Freeze Frame" UBYTE FORMULA_0061 0 0 0.0 255.0 ECU_ADDRESS 0x3F980B /end MEASUREMENT
/begin MEASUREMENT ed_fsp_3of20_.ff_sl_st_nv "Sekundaerluftstatus des Freeze Frame" UBYTE FORMULA_0061 0 0 0.0 255.0 ECU_ADDRESS 0x3F985D /end MEASUREMENT
/begin MEASUREMENT ed_fsp_4of20_.ff_sl_st_nv "Sekundaerluftstatus des Freeze Frame" UBYTE FORMULA_0061 0 0 0.0 255.0 ECU_ADDRESS 0x3F98AF /end MEASUREMENT
/begin MEASUREMENT ed_fsp_5of20_.ff_sl_st_nv "Sekundaerluftstatus des Freeze Frame" UBYTE FORMULA_0061 0 0 0.0 255.0 ECU_ADDRESS 0x3F9901 /end MEASUREMENT
/begin MEASUREMENT ed_fsp_6of20_.ff_sl_st_nv "Sekundaerluftstatus des Freeze Frame" UBYTE FORMULA_0061 0 0 0.0 255.0 ECU_ADDRESS 0x3F9953 /end MEASUREMENT
/begin MEASUREMENT ed_fsp_7of20_.ff_sl_st_nv "Sekundaerluftstatus des Freeze Frame" UBYTE FORMULA_0061 0 0 0.0 255.0 ECU_ADDRESS 0x3F99A5 /end MEASUREMENT
/begin MEASUREMENT ed_fsp_8of20_.ff_sl_st_nv "Sekundaerluftstatus des Freeze Frame" UBYTE FORMULA_0061 0 0 0.0 255.0 ECU_ADDRESS 0x3F99F7 /end MEASUREMENT
/begin MEASUREMENT ed_fsp_9of20_.ff_sl_st_nv "Sekundaerluftstatus des Freeze Frame" UBYTE FORMULA_0061 0 0 0.0 255.0 ECU_ADDRESS 0x3F9A49 /end MEASUREMENT
/begin MEASUREMENT ed_fsp_14of20_.ff_sl_st_nv "Sekundaerluftstatus des Freeze Frame" UBYTE FORMULA_0061 0 0 0.0 255.0 ECU_ADDRESS 0x3F9BE3 /end MEASUREMENT
/begin MEASUREMENT ed_fsp_15of20_.ff_sl_st_nv "Sekundaerluftstatus des Freeze Frame" UBYTE FORMULA_0061 0 0 0.0 255.0 ECU_ADDRESS 0x3F9C35 /end MEASUREMENT
/begin MEASUREMENT ed_fsp_16of20_.ff_sl_st_nv "Sekundaerluftstatus des Freeze Frame" UBYTE FORMULA_0061 0 0 0.0 255.0 ECU_ADDRESS 0x3F9C87 /end MEASUREMENT
/begin MEASUREMENT ed_fsp_17of20_.ff_sl_st_nv "Sekundaerluftstatus des Freeze Frame" UBYTE FORMULA_0061 0 0 0.0 255.0 ECU_ADDRESS 0x3F9CD9 /end MEASUREMENT
/begin MEASUREMENT ed_fsp_18of20_.ff_sl_st_nv "Sekundaerluftstatus des Freeze Frame" UBYTE FORMULA_0061 0 0 0.0 255.0 ECU_ADDRESS 0x3F9D2B /end MEASUREMENT
/begin MEASUREMENT ed_fsp_19of20_.ff_sl_st_nv "Sekundaerluftstatus des Freeze Frame" UBYTE FORMULA_0061 0 0 0.0 255.0 ECU_ADDRESS 0x3F9D7D /end MEASUREMENT
/begin MEASUREMENT ed_fsp_20of20_.ff_sl_st_nv "Sekundaerluftstatus des Freeze Frame" UBYTE FORMULA_0061 0 0 0.0 255.0 ECU_ADDRESS 0x3F9DCF /end MEASUREMENT
/begin MEASUREMENT ed_fsp_1of20_.ff_time_ml_nv "Zeit seit Motorstart des Freeze Frame" UWORD FORMULA_0062 0 0 0.0 65535.0000 ECU_ADDRESS 0x3F97BA /end MEASUREMENT
/begin MEASUREMENT ed_fsp_2of20_.ff_time_ml_nv "Zeit seit Motorstart des Freeze Frame" UWORD FORMULA_0062 0 0 0.0 65535.0000 ECU_ADDRESS 0x3F980C /end MEASUREMENT
/begin MEASUREMENT ed_fsp_3of20_.ff_time_ml_nv "Zeit seit Motorstart des Freeze Frame" UWORD FORMULA_0062 0 0 0.0 65535.0000 ECU_ADDRESS 0x3F985E /end MEASUREMENT
/begin MEASUREMENT ed_fsp_4of20_.ff_time_ml_nv "Zeit seit Motorstart des Freeze Frame" UWORD FORMULA_0062 0 0 0.0 65535.0000 ECU_ADDRESS 0x3F98B0 /end MEASUREMENT
/begin MEASUREMENT ed_fsp_5of20_.ff_time_ml_nv "Zeit seit Motorstart des Freeze Frame" UWORD FORMULA_0062 0 0 0.0 65535.0000 ECU_ADDRESS 0x3F9902 /end MEASUREMENT
/begin MEASUREMENT ed_fsp_6of20_.ff_time_ml_nv "Zeit seit Motorstart des Freeze Frame" UWORD FORMULA_0062 0 0 0.0 65535.0000 ECU_ADDRESS 0x3F9954 /end MEASUREMENT
/begin MEASUREMENT ed_fsp_7of20_.ff_time_ml_nv "Zeit seit Motorstart des Freeze Frame" UWORD FORMULA_0062 0 0 0.0 65535.0000 ECU_ADDRESS 0x3F99A6 /end MEASUREMENT
/begin MEASUREMENT ed_fsp_8of20_.ff_time_ml_nv "Zeit seit Motorstart des Freeze Frame" UWORD FORMULA_0062 0 0 0.0 65535.0000 ECU_ADDRESS 0x3F99F8 /end MEASUREMENT
/begin MEASUREMENT ed_fsp_9of20_.ff_time_ml_nv "Zeit seit Motorstart des Freeze Frame" UWORD FORMULA_0062 0 0 0.0 65535.0000 ECU_ADDRESS 0x3F9A4A /end MEASUREMENT
/begin MEASUREMENT ed_fsp_14of20_.ff_time_ml_nv "Zeit seit Motorstart des Freeze Frame" UWORD FORMULA_0062 0 0 0.0 65535.0000 ECU_ADDRESS 0x3F9BE4 /end MEASUREMENT
/begin MEASUREMENT ed_fsp_15of20_.ff_time_ml_nv "Zeit seit Motorstart des Freeze Frame" UWORD FORMULA_0062 0 0 0.0 65535.0000 ECU_ADDRESS 0x3F9C36 /end MEASUREMENT
/begin MEASUREMENT ed_fsp_16of20_.ff_time_ml_nv "Zeit seit Motorstart des Freeze Frame" UWORD FORMULA_0062 0 0 0.0 65535.0000 ECU_ADDRESS 0x3F9C88 /end MEASUREMENT
/begin MEASUREMENT ed_fsp_17of20_.ff_time_ml_nv "Zeit seit Motorstart des Freeze Frame" UWORD FORMULA_0062 0 0 0.0 65535.0000 ECU_ADDRESS 0x3F9CDA /end MEASUREMENT
/begin MEASUREMENT ed_fsp_18of20_.ff_time_ml_nv "Zeit seit Motorstart des Freeze Frame" UWORD FORMULA_0062 0 0 0.0 65535.0000 ECU_ADDRESS 0x3F9D2C /end MEASUREMENT
/begin MEASUREMENT ed_fsp_19of20_.ff_time_ml_nv "Zeit seit Motorstart des Freeze Frame" UWORD FORMULA_0062 0 0 0.0 65535.0000 ECU_ADDRESS 0x3F9D7E /end MEASUREMENT
/begin MEASUREMENT ed_fsp_20of20_.ff_time_ml_nv "Zeit seit Motorstart des Freeze Frame" UWORD FORMULA_0062 0 0 0.0 65535.0000 ECU_ADDRESS 0x3F9DD0 /end MEASUREMENT
/begin MEASUREMENT ed_fsp_1of20_.ff_ub_nv "Systemspannung fuer Steuergeraet des Freeze Frame" UWORD FORMULA_0063 0 0 0.0 65.5350 ECU_ADDRESS 0x3F97BC /end MEASUREMENT
/begin MEASUREMENT ed_fsp_2of20_.ff_ub_nv "Systemspannung fuer Steuergeraet des Freeze Frame" UWORD FORMULA_0063 0 0 0.0 65.5350 ECU_ADDRESS 0x3F980E /end MEASUREMENT
/begin MEASUREMENT ed_fsp_3of20_.ff_ub_nv "Systemspannung fuer Steuergeraet des Freeze Frame" UWORD FORMULA_0063 0 0 0.0 65.5350 ECU_ADDRESS 0x3F9860 /end MEASUREMENT
/begin MEASUREMENT ed_fsp_4of20_.ff_ub_nv "Systemspannung fuer Steuergeraet des Freeze Frame" UWORD FORMULA_0063 0 0 0.0 65.5350 ECU_ADDRESS 0x3F98B2 /end MEASUREMENT
/begin MEASUREMENT ed_fsp_5of20_.ff_ub_nv "Systemspannung fuer Steuergeraet des Freeze Frame" UWORD FORMULA_0063 0 0 0.0 65.5350 ECU_ADDRESS 0x3F9904 /end MEASUREMENT
/begin MEASUREMENT ed_fsp_6of20_.ff_ub_nv "Systemspannung fuer Steuergeraet des Freeze Frame" UWORD FORMULA_0063 0 0 0.0 65.5350 ECU_ADDRESS 0x3F9956 /end MEASUREMENT
/begin MEASUREMENT ed_fsp_7of20_.ff_ub_nv "Systemspannung fuer Steuergeraet des Freeze Frame" UWORD FORMULA_0063 0 0 0.0 65.5350 ECU_ADDRESS 0x3F99A8 /end MEASUREMENT
/begin MEASUREMENT ed_fsp_8of20_.ff_ub_nv "Systemspannung fuer Steuergeraet des Freeze Frame" UWORD FORMULA_0063 0 0 0.0 65.5350 ECU_ADDRESS 0x3F99FA /end MEASUREMENT
/begin MEASUREMENT ed_fsp_9of20_.ff_ub_nv "Systemspannung fuer Steuergeraet des Freeze Frame" UWORD FORMULA_0063 0 0 0.0 65.5350 ECU_ADDRESS 0x3F9A4C /end MEASUREMENT
/begin MEASUREMENT ed_fsp_14of20_.ff_ub_nv "Systemspannung fuer Steuergeraet des Freeze Frame" UWORD FORMULA_0063 0 0 0.0 65.5350 ECU_ADDRESS 0x3F9BE6 /end MEASUREMENT
/begin MEASUREMENT ed_fsp_15of20_.ff_ub_nv "Systemspannung fuer Steuergeraet des Freeze Frame" UWORD FORMULA_0063 0 0 0.0 65.5350 ECU_ADDRESS 0x3F9C38 /end MEASUREMENT
/begin MEASUREMENT ed_fsp_16of20_.ff_ub_nv "Systemspannung fuer Steuergeraet des Freeze Frame" UWORD FORMULA_0063 0 0 0.0 65.5350 ECU_ADDRESS 0x3F9C8A /end MEASUREMENT
/begin MEASUREMENT ed_fsp_17of20_.ff_ub_nv "Systemspannung fuer Steuergeraet des Freeze Frame" UWORD FORMULA_0063 0 0 0.0 65.5350 ECU_ADDRESS 0x3F9CDC /end MEASUREMENT
/begin MEASUREMENT ed_fsp_18of20_.ff_ub_nv "Systemspannung fuer Steuergeraet des Freeze Frame" UWORD FORMULA_0063 0 0 0.0 65.5350 ECU_ADDRESS 0x3F9D2E /end MEASUREMENT
/begin MEASUREMENT ed_fsp_19of20_.ff_ub_nv "Systemspannung fuer Steuergeraet des Freeze Frame" UWORD FORMULA_0063 0 0 0.0 65.5350 ECU_ADDRESS 0x3F9D80 /end MEASUREMENT
/begin MEASUREMENT ed_fsp_20of20_.ff_ub_nv "Systemspannung fuer Steuergeraet des Freeze Frame" UWORD FORMULA_0063 0 0 0.0 65.5350 ECU_ADDRESS 0x3F9DD2 /end MEASUREMENT
/begin MEASUREMENT ed_fsp_1of20_.ff_rf_b1_nv "Absolute Lastwert des Freeze Frame" UWORD FORMULA_0064 0 0 0.0 257.0000 ECU_ADDRESS 0x3F97BE /end MEASUREMENT
/begin MEASUREMENT ed_fsp_2of20_.ff_rf_b1_nv "Absolute Lastwert des Freeze Frame" UWORD FORMULA_0064 0 0 0.0 257.0000 ECU_ADDRESS 0x3F9810 /end MEASUREMENT
/begin MEASUREMENT ed_fsp_3of20_.ff_rf_b1_nv "Absolute Lastwert des Freeze Frame" UWORD FORMULA_0064 0 0 0.0 257.0000 ECU_ADDRESS 0x3F9862 /end MEASUREMENT
/begin MEASUREMENT ed_fsp_4of20_.ff_rf_b1_nv "Absolute Lastwert des Freeze Frame" UWORD FORMULA_0064 0 0 0.0 257.0000 ECU_ADDRESS 0x3F98B4 /end MEASUREMENT
/begin MEASUREMENT ed_fsp_5of20_.ff_rf_b1_nv "Absolute Lastwert des Freeze Frame" UWORD FORMULA_0064 0 0 0.0 257.0000 ECU_ADDRESS 0x3F9906 /end MEASUREMENT
/begin MEASUREMENT ed_fsp_6of20_.ff_rf_b1_nv "Absolute Lastwert des Freeze Frame" UWORD FORMULA_0064 0 0 0.0 257.0000 ECU_ADDRESS 0x3F9958 /end MEASUREMENT
/begin MEASUREMENT ed_fsp_7of20_.ff_rf_b1_nv "Absolute Lastwert des Freeze Frame" UWORD FORMULA_0064 0 0 0.0 257.0000 ECU_ADDRESS 0x3F99AA /end MEASUREMENT
/begin MEASUREMENT ed_fsp_8of20_.ff_rf_b1_nv "Absolute Lastwert des Freeze Frame" UWORD FORMULA_0064 0 0 0.0 257.0000 ECU_ADDRESS 0x3F99FC /end MEASUREMENT
/begin MEASUREMENT ed_fsp_9of20_.ff_rf_b1_nv "Absolute Lastwert des Freeze Frame" UWORD FORMULA_0064 0 0 0.0 257.0000 ECU_ADDRESS 0x3F9A4E /end MEASUREMENT
/begin MEASUREMENT ed_fsp_14of20_.ff_rf_b1_nv "Absolute Lastwert des Freeze Frame" UWORD FORMULA_0064 0 0 0.0 257.0000 ECU_ADDRESS 0x3F9BE8 /end MEASUREMENT
/begin MEASUREMENT ed_fsp_15of20_.ff_rf_b1_nv "Absolute Lastwert des Freeze Frame" UWORD FORMULA_0064 0 0 0.0 257.0000 ECU_ADDRESS 0x3F9C3A /end MEASUREMENT
/begin MEASUREMENT ed_fsp_16of20_.ff_rf_b1_nv "Absolute Lastwert des Freeze Frame" UWORD FORMULA_0064 0 0 0.0 257.0000 ECU_ADDRESS 0x3F9C8C /end MEASUREMENT
/begin MEASUREMENT ed_fsp_17of20_.ff_rf_b1_nv "Absolute Lastwert des Freeze Frame" UWORD FORMULA_0064 0 0 0.0 257.0000 ECU_ADDRESS 0x3F9CDE /end MEASUREMENT
/begin MEASUREMENT ed_fsp_18of20_.ff_rf_b1_nv "Absolute Lastwert des Freeze Frame" UWORD FORMULA_0064 0 0 0.0 257.0000 ECU_ADDRESS 0x3F9D30 /end MEASUREMENT
/begin MEASUREMENT ed_fsp_19of20_.ff_rf_b1_nv "Absolute Lastwert des Freeze Frame" UWORD FORMULA_0064 0 0 0.0 257.0000 ECU_ADDRESS 0x3F9D82 /end MEASUREMENT
/begin MEASUREMENT ed_fsp_20of20_.ff_rf_b1_nv "Absolute Lastwert des Freeze Frame" UWORD FORMULA_0064 0 0 0.0 257.0000 ECU_ADDRESS 0x3F9DD4 /end MEASUREMENT
/begin MEASUREMENT ed_fsp_1of20_.ff_lam_soll_b1_nv "Lambdaregelfaktor des Freeze Frame" UWORD FORMULA_0024 0 0 0.0 1.9999 ECU_ADDRESS 0x3F97C0 /end MEASUREMENT
/begin MEASUREMENT ed_fsp_2of20_.ff_lam_soll_b1_nv "Lambdaregelfaktor des Freeze Frame" UWORD FORMULA_0024 0 0 0.0 1.9999 ECU_ADDRESS 0x3F9812 /end MEASUREMENT
/begin MEASUREMENT ed_fsp_3of20_.ff_lam_soll_b1_nv "Lambdaregelfaktor des Freeze Frame" UWORD FORMULA_0024 0 0 0.0 1.9999 ECU_ADDRESS 0x3F9864 /end MEASUREMENT
/begin MEASUREMENT ed_fsp_4of20_.ff_lam_soll_b1_nv "Lambdaregelfaktor des Freeze Frame" UWORD FORMULA_0024 0 0 0.0 1.9999 ECU_ADDRESS 0x3F98B6 /end MEASUREMENT
/begin MEASUREMENT ed_fsp_5of20_.ff_lam_soll_b1_nv "Lambdaregelfaktor des Freeze Frame" UWORD FORMULA_0024 0 0 0.0 1.9999 ECU_ADDRESS 0x3F9908 /end MEASUREMENT
/begin MEASUREMENT ed_fsp_6of20_.ff_lam_soll_b1_nv "Lambdaregelfaktor des Freeze Frame" UWORD FORMULA_0024 0 0 0.0 1.9999 ECU_ADDRESS 0x3F995A /end MEASUREMENT
/begin MEASUREMENT ed_fsp_7of20_.ff_lam_soll_b1_nv "Lambdaregelfaktor des Freeze Frame" UWORD FORMULA_0024 0 0 0.0 1.9999 ECU_ADDRESS 0x3F99AC /end MEASUREMENT
/begin MEASUREMENT ed_fsp_8of20_.ff_lam_soll_b1_nv "Lambdaregelfaktor des Freeze Frame" UWORD FORMULA_0024 0 0 0.0 1.9999 ECU_ADDRESS 0x3F99FE /end MEASUREMENT
/begin MEASUREMENT ed_fsp_9of20_.ff_lam_soll_b1_nv "Lambdaregelfaktor des Freeze Frame" UWORD FORMULA_0024 0 0 0.0 1.9999 ECU_ADDRESS 0x3F9A50 /end MEASUREMENT
/begin MEASUREMENT ed_fsp_14of20_.ff_lam_soll_b1_nv "Lambdaregelfaktor des Freeze Frame" UWORD FORMULA_0024 0 0 0.0 1.9999 ECU_ADDRESS 0x3F9BEA /end MEASUREMENT
/begin MEASUREMENT ed_fsp_15of20_.ff_lam_soll_b1_nv "Lambdaregelfaktor des Freeze Frame" UWORD FORMULA_0024 0 0 0.0 1.9999 ECU_ADDRESS 0x3F9C3C /end MEASUREMENT
/begin MEASUREMENT ed_fsp_16of20_.ff_lam_soll_b1_nv "Lambdaregelfaktor des Freeze Frame" UWORD FORMULA_0024 0 0 0.0 1.9999 ECU_ADDRESS 0x3F9C8E /end MEASUREMENT
/begin MEASUREMENT ed_fsp_17of20_.ff_lam_soll_b1_nv "Lambdaregelfaktor des Freeze Frame" UWORD FORMULA_0024 0 0 0.0 1.9999 ECU_ADDRESS 0x3F9CE0 /end MEASUREMENT
/begin MEASUREMENT ed_fsp_18of20_.ff_lam_soll_b1_nv "Lambdaregelfaktor des Freeze Frame" UWORD FORMULA_0024 0 0 0.0 1.9999 ECU_ADDRESS 0x3F9D32 /end MEASUREMENT
/begin MEASUREMENT ed_fsp_19of20_.ff_lam_soll_b1_nv "Lambdaregelfaktor des Freeze Frame" UWORD FORMULA_0024 0 0 0.0 1.9999 ECU_ADDRESS 0x3F9D84 /end MEASUREMENT
/begin MEASUREMENT ed_fsp_20of20_.ff_lam_soll_b1_nv "Lambdaregelfaktor des Freeze Frame" UWORD FORMULA_0024 0 0 0.0 1.9999 ECU_ADDRESS 0x3F9DD6 /end MEASUREMENT
/begin MEASUREMENT ed_fsp_1of20_.ff_tev_b1_nv "Tankentlueftungsventil des Freeze Frame" UBYTE FORMULA_0065 0 0 0.0 100.0000 ECU_ADDRESS 0x3F97C2 /end MEASUREMENT
/begin MEASUREMENT ed_fsp_2of20_.ff_tev_b1_nv "Tankentlueftungsventil des Freeze Frame" UBYTE FORMULA_0065 0 0 0.0 100.0000 ECU_ADDRESS 0x3F9814 /end MEASUREMENT
/begin MEASUREMENT ed_fsp_3of20_.ff_tev_b1_nv "Tankentlueftungsventil des Freeze Frame" UBYTE FORMULA_0065 0 0 0.0 100.0000 ECU_ADDRESS 0x3F9866 /end MEASUREMENT
/begin MEASUREMENT ed_fsp_4of20_.ff_tev_b1_nv "Tankentlueftungsventil des Freeze Frame" UBYTE FORMULA_0065 0 0 0.0 100.0000 ECU_ADDRESS 0x3F98B8 /end MEASUREMENT
/begin MEASUREMENT ed_fsp_5of20_.ff_tev_b1_nv "Tankentlueftungsventil des Freeze Frame" UBYTE FORMULA_0065 0 0 0.0 100.0000 ECU_ADDRESS 0x3F990A /end MEASUREMENT
/begin MEASUREMENT ed_fsp_6of20_.ff_tev_b1_nv "Tankentlueftungsventil des Freeze Frame" UBYTE FORMULA_0065 0 0 0.0 100.0000 ECU_ADDRESS 0x3F995C /end MEASUREMENT
/begin MEASUREMENT ed_fsp_7of20_.ff_tev_b1_nv "Tankentlueftungsventil des Freeze Frame" UBYTE FORMULA_0065 0 0 0.0 100.0000 ECU_ADDRESS 0x3F99AE /end MEASUREMENT
/begin MEASUREMENT ed_fsp_8of20_.ff_tev_b1_nv "Tankentlueftungsventil des Freeze Frame" UBYTE FORMULA_0065 0 0 0.0 100.0000 ECU_ADDRESS 0x3F9A00 /end MEASUREMENT
/begin MEASUREMENT ed_fsp_9of20_.ff_tev_b1_nv "Tankentlueftungsventil des Freeze Frame" UBYTE FORMULA_0065 0 0 0.0 100.0000 ECU_ADDRESS 0x3F9A52 /end MEASUREMENT
/begin MEASUREMENT ed_fsp_14of20_.ff_tev_b1_nv "Tankentlueftungsventil des Freeze Frame" UBYTE FORMULA_0065 0 0 0.0 100.0000 ECU_ADDRESS 0x3F9BEC /end MEASUREMENT
/begin MEASUREMENT ed_fsp_15of20_.ff_tev_b1_nv "Tankentlueftungsventil des Freeze Frame" UBYTE FORMULA_0065 0 0 0.0 100.0000 ECU_ADDRESS 0x3F9C3E /end MEASUREMENT
/begin MEASUREMENT ed_fsp_16of20_.ff_tev_b1_nv "Tankentlueftungsventil des Freeze Frame" UBYTE FORMULA_0065 0 0 0.0 100.0000 ECU_ADDRESS 0x3F9C90 /end MEASUREMENT
/begin MEASUREMENT ed_fsp_17of20_.ff_tev_b1_nv "Tankentlueftungsventil des Freeze Frame" UBYTE FORMULA_0065 0 0 0.0 100.0000 ECU_ADDRESS 0x3F9CE2 /end MEASUREMENT
/begin MEASUREMENT ed_fsp_18of20_.ff_tev_b1_nv "Tankentlueftungsventil des Freeze Frame" UBYTE FORMULA_0065 0 0 0.0 100.0000 ECU_ADDRESS 0x3F9D34 /end MEASUREMENT
/begin MEASUREMENT ed_fsp_19of20_.ff_tev_b1_nv "Tankentlueftungsventil des Freeze Frame" UBYTE FORMULA_0065 0 0 0.0 100.0000 ECU_ADDRESS 0x3F9D86 /end MEASUREMENT
/begin MEASUREMENT ed_fsp_20of20_.ff_tev_b1_nv "Tankentlueftungsventil des Freeze Frame" UBYTE FORMULA_0065 0 0 0.0 100.0000 ECU_ADDRESS 0x3F9DD8 /end MEASUREMENT
/begin MEASUREMENT ed_fsp_1of20_.ff_fst_nv "Tankfuellstand des Freeze Frame" UBYTE FORMULA_0065 0 0 0.0 100.0000 ECU_ADDRESS 0x3F97C3 /end MEASUREMENT
/begin MEASUREMENT ed_fsp_2of20_.ff_fst_nv "Tankfuellstand des Freeze Frame" UBYTE FORMULA_0065 0 0 0.0 100.0000 ECU_ADDRESS 0x3F9815 /end MEASUREMENT
/begin MEASUREMENT ed_fsp_3of20_.ff_fst_nv "Tankfuellstand des Freeze Frame" UBYTE FORMULA_0065 0 0 0.0 100.0000 ECU_ADDRESS 0x3F9867 /end MEASUREMENT
/begin MEASUREMENT ed_fsp_4of20_.ff_fst_nv "Tankfuellstand des Freeze Frame" UBYTE FORMULA_0065 0 0 0.0 100.0000 ECU_ADDRESS 0x3F98B9 /end MEASUREMENT
/begin MEASUREMENT ed_fsp_5of20_.ff_fst_nv "Tankfuellstand des Freeze Frame" UBYTE FORMULA_0065 0 0 0.0 100.0000 ECU_ADDRESS 0x3F990B /end MEASUREMENT
/begin MEASUREMENT ed_fsp_6of20_.ff_fst_nv "Tankfuellstand des Freeze Frame" UBYTE FORMULA_0065 0 0 0.0 100.0000 ECU_ADDRESS 0x3F995D /end MEASUREMENT
/begin MEASUREMENT ed_fsp_7of20_.ff_fst_nv "Tankfuellstand des Freeze Frame" UBYTE FORMULA_0065 0 0 0.0 100.0000 ECU_ADDRESS 0x3F99AF /end MEASUREMENT
/begin MEASUREMENT ed_fsp_8of20_.ff_fst_nv "Tankfuellstand des Freeze Frame" UBYTE FORMULA_0065 0 0 0.0 100.0000 ECU_ADDRESS 0x3F9A01 /end MEASUREMENT
/begin MEASUREMENT ed_fsp_9of20_.ff_fst_nv "Tankfuellstand des Freeze Frame" UBYTE FORMULA_0065 0 0 0.0 100.0000 ECU_ADDRESS 0x3F9A53 /end MEASUREMENT
/begin MEASUREMENT ed_fsp_14of20_.ff_fst_nv "Tankfuellstand des Freeze Frame" UBYTE FORMULA_0065 0 0 0.0 100.0000 ECU_ADDRESS 0x3F9BED /end MEASUREMENT
/begin MEASUREMENT ed_fsp_15of20_.ff_fst_nv "Tankfuellstand des Freeze Frame" UBYTE FORMULA_0065 0 0 0.0 100.0000 ECU_ADDRESS 0x3F9C3F /end MEASUREMENT
/begin MEASUREMENT ed_fsp_16of20_.ff_fst_nv "Tankfuellstand des Freeze Frame" UBYTE FORMULA_0065 0 0 0.0 100.0000 ECU_ADDRESS 0x3F9C91 /end MEASUREMENT
/begin MEASUREMENT ed_fsp_17of20_.ff_fst_nv "Tankfuellstand des Freeze Frame" UBYTE FORMULA_0065 0 0 0.0 100.0000 ECU_ADDRESS 0x3F9CE3 /end MEASUREMENT
/begin MEASUREMENT ed_fsp_18of20_.ff_fst_nv "Tankfuellstand des Freeze Frame" UBYTE FORMULA_0065 0 0 0.0 100.0000 ECU_ADDRESS 0x3F9D35 /end MEASUREMENT
/begin MEASUREMENT ed_fsp_19of20_.ff_fst_nv "Tankfuellstand des Freeze Frame" UBYTE FORMULA_0065 0 0 0.0 100.0000 ECU_ADDRESS 0x3F9D87 /end MEASUREMENT
/begin MEASUREMENT ed_fsp_20of20_.ff_fst_nv "Tankfuellstand des Freeze Frame" UBYTE FORMULA_0065 0 0 0.0 100.0000 ECU_ADDRESS 0x3F9DD9 /end MEASUREMENT
/begin MEASUREMENT ed_fsp_1of20_.ff_pumg_nv "Barometrischer Druck des Freeze Frame" UBYTE FORMULA_0066 0 0 0.0 255.0000 ECU_ADDRESS 0x3F97C4 /end MEASUREMENT
/begin MEASUREMENT ed_fsp_2of20_.ff_pumg_nv "Barometrischer Druck des Freeze Frame" UBYTE FORMULA_0066 0 0 0.0 255.0000 ECU_ADDRESS 0x3F9816 /end MEASUREMENT
/begin MEASUREMENT ed_fsp_3of20_.ff_pumg_nv "Barometrischer Druck des Freeze Frame" UBYTE FORMULA_0066 0 0 0.0 255.0000 ECU_ADDRESS 0x3F9868 /end MEASUREMENT
/begin MEASUREMENT ed_fsp_4of20_.ff_pumg_nv "Barometrischer Druck des Freeze Frame" UBYTE FORMULA_0066 0 0 0.0 255.0000 ECU_ADDRESS 0x3F98BA /end MEASUREMENT
/begin MEASUREMENT ed_fsp_5of20_.ff_pumg_nv "Barometrischer Druck des Freeze Frame" UBYTE FORMULA_0066 0 0 0.0 255.0000 ECU_ADDRESS 0x3F990C /end MEASUREMENT
/begin MEASUREMENT ed_fsp_6of20_.ff_pumg_nv "Barometrischer Druck des Freeze Frame" UBYTE FORMULA_0066 0 0 0.0 255.0000 ECU_ADDRESS 0x3F995E /end MEASUREMENT
/begin MEASUREMENT ed_fsp_7of20_.ff_pumg_nv "Barometrischer Druck des Freeze Frame" UBYTE FORMULA_0066 0 0 0.0 255.0000 ECU_ADDRESS 0x3F99B0 /end MEASUREMENT
/begin MEASUREMENT ed_fsp_8of20_.ff_pumg_nv "Barometrischer Druck des Freeze Frame" UBYTE FORMULA_0066 0 0 0.0 255.0000 ECU_ADDRESS 0x3F9A02 /end MEASUREMENT
/begin MEASUREMENT ed_fsp_9of20_.ff_pumg_nv "Barometrischer Druck des Freeze Frame" UBYTE FORMULA_0066 0 0 0.0 255.0000 ECU_ADDRESS 0x3F9A54 /end MEASUREMENT
/begin MEASUREMENT ed_fsp_14of20_.ff_pumg_nv "Barometrischer Druck des Freeze Frame" UBYTE FORMULA_0066 0 0 0.0 255.0000 ECU_ADDRESS 0x3F9BEE /end MEASUREMENT
/begin MEASUREMENT ed_fsp_15of20_.ff_pumg_nv "Barometrischer Druck des Freeze Frame" UBYTE FORMULA_0066 0 0 0.0 255.0000 ECU_ADDRESS 0x3F9C40 /end MEASUREMENT
/begin MEASUREMENT ed_fsp_16of20_.ff_pumg_nv "Barometrischer Druck des Freeze Frame" UBYTE FORMULA_0066 0 0 0.0 255.0000 ECU_ADDRESS 0x3F9C92 /end MEASUREMENT
/begin MEASUREMENT ed_fsp_17of20_.ff_pumg_nv "Barometrischer Druck des Freeze Frame" UBYTE FORMULA_0066 0 0 0.0 255.0000 ECU_ADDRESS 0x3F9CE4 /end MEASUREMENT
/begin MEASUREMENT ed_fsp_18of20_.ff_pumg_nv "Barometrischer Druck des Freeze Frame" UBYTE FORMULA_0066 0 0 0.0 255.0000 ECU_ADDRESS 0x3F9D36 /end MEASUREMENT
/begin MEASUREMENT ed_fsp_19of20_.ff_pumg_nv "Barometrischer Druck des Freeze Frame" UBYTE FORMULA_0066 0 0 0.0 255.0000 ECU_ADDRESS 0x3F9D88 /end MEASUREMENT
/begin MEASUREMENT ed_fsp_20of20_.ff_pumg_nv "Barometrischer Druck des Freeze Frame" UBYTE FORMULA_0066 0 0 0.0 255.0000 ECU_ADDRESS 0x3F9DDA /end MEASUREMENT
/begin MEASUREMENT ed_fsp_1of20_.ff_egas_ist_dk_b1_nv "Relative Drosselklappen des Freeze Frame" UBYTE FORMULA_0065 0 0 0.0 100.0000 ECU_ADDRESS 0x3F97C5 /end MEASUREMENT
/begin MEASUREMENT ed_fsp_2of20_.ff_egas_ist_dk_b1_nv "Relative Drosselklappen des Freeze Frame" UBYTE FORMULA_0065 0 0 0.0 100.0000 ECU_ADDRESS 0x3F9817 /end MEASUREMENT
/begin MEASUREMENT ed_fsp_3of20_.ff_egas_ist_dk_b1_nv "Relative Drosselklappen des Freeze Frame" UBYTE FORMULA_0065 0 0 0.0 100.0000 ECU_ADDRESS 0x3F9869 /end MEASUREMENT
/begin MEASUREMENT ed_fsp_4of20_.ff_egas_ist_dk_b1_nv "Relative Drosselklappen des Freeze Frame" UBYTE FORMULA_0065 0 0 0.0 100.0000 ECU_ADDRESS 0x3F98BB /end MEASUREMENT
/begin MEASUREMENT ed_fsp_5of20_.ff_egas_ist_dk_b1_nv "Relative Drosselklappen des Freeze Frame" UBYTE FORMULA_0065 0 0 0.0 100.0000 ECU_ADDRESS 0x3F990D /end MEASUREMENT
/begin MEASUREMENT ed_fsp_6of20_.ff_egas_ist_dk_b1_nv "Relative Drosselklappen des Freeze Frame" UBYTE FORMULA_0065 0 0 0.0 100.0000 ECU_ADDRESS 0x3F995F /end MEASUREMENT
/begin MEASUREMENT ed_fsp_7of20_.ff_egas_ist_dk_b1_nv "Relative Drosselklappen des Freeze Frame" UBYTE FORMULA_0065 0 0 0.0 100.0000 ECU_ADDRESS 0x3F99B1 /end MEASUREMENT
/begin MEASUREMENT ed_fsp_8of20_.ff_egas_ist_dk_b1_nv "Relative Drosselklappen des Freeze Frame" UBYTE FORMULA_0065 0 0 0.0 100.0000 ECU_ADDRESS 0x3F9A03 /end MEASUREMENT
/begin MEASUREMENT ed_fsp_9of20_.ff_egas_ist_dk_b1_nv "Relative Drosselklappen des Freeze Frame" UBYTE FORMULA_0065 0 0 0.0 100.0000 ECU_ADDRESS 0x3F9A55 /end MEASUREMENT
/begin MEASUREMENT ed_fsp_14of20_.ff_egas_ist_dk_b1_nv "Relative Drosselklappen des Freeze Frame" UBYTE FORMULA_0065 0 0 0.0 100.0000 ECU_ADDRESS 0x3F9BEF /end MEASUREMENT
/begin MEASUREMENT ed_fsp_15of20_.ff_egas_ist_dk_b1_nv "Relative Drosselklappen des Freeze Frame" UBYTE FORMULA_0065 0 0 0.0 100.0000 ECU_ADDRESS 0x3F9C41 /end MEASUREMENT
/begin MEASUREMENT ed_fsp_16of20_.ff_egas_ist_dk_b1_nv "Relative Drosselklappen des Freeze Frame" UBYTE FORMULA_0065 0 0 0.0 100.0000 ECU_ADDRESS 0x3F9C93 /end MEASUREMENT
/begin MEASUREMENT ed_fsp_17of20_.ff_egas_ist_dk_b1_nv "Relative Drosselklappen des Freeze Frame" UBYTE FORMULA_0065 0 0 0.0 100.0000 ECU_ADDRESS 0x3F9CE5 /end MEASUREMENT
/begin MEASUREMENT ed_fsp_18of20_.ff_egas_ist_dk_b1_nv "Relative Drosselklappen des Freeze Frame" UBYTE FORMULA_0065 0 0 0.0 100.0000 ECU_ADDRESS 0x3F9D37 /end MEASUREMENT
/begin MEASUREMENT ed_fsp_19of20_.ff_egas_ist_dk_b1_nv "Relative Drosselklappen des Freeze Frame" UBYTE FORMULA_0065 0 0 0.0 100.0000 ECU_ADDRESS 0x3F9D89 /end MEASUREMENT
/begin MEASUREMENT ed_fsp_20of20_.ff_egas_ist_dk_b1_nv "Relative Drosselklappen des Freeze Frame" UBYTE FORMULA_0065 0 0 0.0 100.0000 ECU_ADDRESS 0x3F9DDB /end MEASUREMENT
/begin MEASUREMENT ed_fsp_1of20_.ff_tumg_nv "Umgebungslufttemperatur des Freeze Frame" UBYTE FORMULA_0057 0 0 -40.0000 215.0000 ECU_ADDRESS 0x3F97C6 /end MEASUREMENT
/begin MEASUREMENT ed_fsp_2of20_.ff_tumg_nv "Umgebungslufttemperatur des Freeze Frame" UBYTE FORMULA_0057 0 0 -40.0000 215.0000 ECU_ADDRESS 0x3F9818 /end MEASUREMENT
/begin MEASUREMENT ed_fsp_3of20_.ff_tumg_nv "Umgebungslufttemperatur des Freeze Frame" UBYTE FORMULA_0057 0 0 -40.0000 215.0000 ECU_ADDRESS 0x3F986A /end MEASUREMENT
/begin MEASUREMENT ed_fsp_4of20_.ff_tumg_nv "Umgebungslufttemperatur des Freeze Frame" UBYTE FORMULA_0057 0 0 -40.0000 215.0000 ECU_ADDRESS 0x3F98BC /end MEASUREMENT
/begin MEASUREMENT ed_fsp_5of20_.ff_tumg_nv "Umgebungslufttemperatur des Freeze Frame" UBYTE FORMULA_0057 0 0 -40.0000 215.0000 ECU_ADDRESS 0x3F990E /end MEASUREMENT
/begin MEASUREMENT ed_fsp_6of20_.ff_tumg_nv "Umgebungslufttemperatur des Freeze Frame" UBYTE FORMULA_0057 0 0 -40.0000 215.0000 ECU_ADDRESS 0x3F9960 /end MEASUREMENT
/begin MEASUREMENT ed_fsp_7of20_.ff_tumg_nv "Umgebungslufttemperatur des Freeze Frame" UBYTE FORMULA_0057 0 0 -40.0000 215.0000 ECU_ADDRESS 0x3F99B2 /end MEASUREMENT
/begin MEASUREMENT ed_fsp_8of20_.ff_tumg_nv "Umgebungslufttemperatur des Freeze Frame" UBYTE FORMULA_0057 0 0 -40.0000 215.0000 ECU_ADDRESS 0x3F9A04 /end MEASUREMENT
/begin MEASUREMENT ed_fsp_9of20_.ff_tumg_nv "Umgebungslufttemperatur des Freeze Frame" UBYTE FORMULA_0057 0 0 -40.0000 215.0000 ECU_ADDRESS 0x3F9A56 /end MEASUREMENT
/begin MEASUREMENT ed_fsp_14of20_.ff_tumg_nv "Umgebungslufttemperatur des Freeze Frame" UBYTE FORMULA_0057 0 0 -40.0000 215.0000 ECU_ADDRESS 0x3F9BF0 /end MEASUREMENT
/begin MEASUREMENT ed_fsp_15of20_.ff_tumg_nv "Umgebungslufttemperatur des Freeze Frame" UBYTE FORMULA_0057 0 0 -40.0000 215.0000 ECU_ADDRESS 0x3F9C42 /end MEASUREMENT
/begin MEASUREMENT ed_fsp_16of20_.ff_tumg_nv "Umgebungslufttemperatur des Freeze Frame" UBYTE FORMULA_0057 0 0 -40.0000 215.0000 ECU_ADDRESS 0x3F9C94 /end MEASUREMENT
/begin MEASUREMENT ed_fsp_17of20_.ff_tumg_nv "Umgebungslufttemperatur des Freeze Frame" UBYTE FORMULA_0057 0 0 -40.0000 215.0000 ECU_ADDRESS 0x3F9CE6 /end MEASUREMENT
/begin MEASUREMENT ed_fsp_18of20_.ff_tumg_nv "Umgebungslufttemperatur des Freeze Frame" UBYTE FORMULA_0057 0 0 -40.0000 215.0000 ECU_ADDRESS 0x3F9D38 /end MEASUREMENT
/begin MEASUREMENT ed_fsp_19of20_.ff_tumg_nv "Umgebungslufttemperatur des Freeze Frame" UBYTE FORMULA_0057 0 0 -40.0000 215.0000 ECU_ADDRESS 0x3F9D8A /end MEASUREMENT
/begin MEASUREMENT ed_fsp_20of20_.ff_tumg_nv "Umgebungslufttemperatur des Freeze Frame" UBYTE FORMULA_0057 0 0 -40.0000 215.0000 ECU_ADDRESS 0x3F9DDC /end MEASUREMENT
/begin MEASUREMENT ed_fsp_1of20_.ff_pwg1_abs_roh_nv "Gaspedalposition D des Freeze Frame" UBYTE FORMULA_0065 0 0 0.0 100.0000 ECU_ADDRESS 0x3F97C7 /end MEASUREMENT
/begin MEASUREMENT ed_fsp_2of20_.ff_pwg1_abs_roh_nv "Gaspedalposition D des Freeze Frame" UBYTE FORMULA_0065 0 0 0.0 100.0000 ECU_ADDRESS 0x3F9819 /end MEASUREMENT
/begin MEASUREMENT ed_fsp_3of20_.ff_pwg1_abs_roh_nv "Gaspedalposition D des Freeze Frame" UBYTE FORMULA_0065 0 0 0.0 100.0000 ECU_ADDRESS 0x3F986B /end MEASUREMENT
/begin MEASUREMENT ed_fsp_4of20_.ff_pwg1_abs_roh_nv "Gaspedalposition D des Freeze Frame" UBYTE FORMULA_0065 0 0 0.0 100.0000 ECU_ADDRESS 0x3F98BD /end MEASUREMENT
/begin MEASUREMENT ed_fsp_5of20_.ff_pwg1_abs_roh_nv "Gaspedalposition D des Freeze Frame" UBYTE FORMULA_0065 0 0 0.0 100.0000 ECU_ADDRESS 0x3F990F /end MEASUREMENT
/begin MEASUREMENT ed_fsp_6of20_.ff_pwg1_abs_roh_nv "Gaspedalposition D des Freeze Frame" UBYTE FORMULA_0065 0 0 0.0 100.0000 ECU_ADDRESS 0x3F9961 /end MEASUREMENT
/begin MEASUREMENT ed_fsp_7of20_.ff_pwg1_abs_roh_nv "Gaspedalposition D des Freeze Frame" UBYTE FORMULA_0065 0 0 0.0 100.0000 ECU_ADDRESS 0x3F99B3 /end MEASUREMENT
/begin MEASUREMENT ed_fsp_8of20_.ff_pwg1_abs_roh_nv "Gaspedalposition D des Freeze Frame" UBYTE FORMULA_0065 0 0 0.0 100.0000 ECU_ADDRESS 0x3F9A05 /end MEASUREMENT
/begin MEASUREMENT ed_fsp_9of20_.ff_pwg1_abs_roh_nv "Gaspedalposition D des Freeze Frame" UBYTE FORMULA_0065 0 0 0.0 100.0000 ECU_ADDRESS 0x3F9A57 /end MEASUREMENT
/begin MEASUREMENT ed_fsp_14of20_.ff_pwg1_abs_roh_nv "Gaspedalposition D des Freeze Frame" UBYTE FORMULA_0065 0 0 0.0 100.0000 ECU_ADDRESS 0x3F9BF1 /end MEASUREMENT
/begin MEASUREMENT ed_fsp_15of20_.ff_pwg1_abs_roh_nv "Gaspedalposition D des Freeze Frame" UBYTE FORMULA_0065 0 0 0.0 100.0000 ECU_ADDRESS 0x3F9C43 /end MEASUREMENT
/begin MEASUREMENT ed_fsp_16of20_.ff_pwg1_abs_roh_nv "Gaspedalposition D des Freeze Frame" UBYTE FORMULA_0065 0 0 0.0 100.0000 ECU_ADDRESS 0x3F9C95 /end MEASUREMENT
/begin MEASUREMENT ed_fsp_17of20_.ff_pwg1_abs_roh_nv "Gaspedalposition D des Freeze Frame" UBYTE FORMULA_0065 0 0 0.0 100.0000 ECU_ADDRESS 0x3F9CE7 /end MEASUREMENT
/begin MEASUREMENT ed_fsp_18of20_.ff_pwg1_abs_roh_nv "Gaspedalposition D des Freeze Frame" UBYTE FORMULA_0065 0 0 0.0 100.0000 ECU_ADDRESS 0x3F9D39 /end MEASUREMENT
/begin MEASUREMENT ed_fsp_19of20_.ff_pwg1_abs_roh_nv "Gaspedalposition D des Freeze Frame" UBYTE FORMULA_0065 0 0 0.0 100.0000 ECU_ADDRESS 0x3F9D8B /end MEASUREMENT
/begin MEASUREMENT ed_fsp_20of20_.ff_pwg1_abs_roh_nv "Gaspedalposition D des Freeze Frame" UBYTE FORMULA_0065 0 0 0.0 100.0000 ECU_ADDRESS 0x3F9DDD /end MEASUREMENT
/begin MEASUREMENT ed_fsp_1of20_.ff_pwg2_abs_roh_nv "Gaspedalposition E des Freeze Frame" UBYTE FORMULA_0065 0 0 0.0 100.0000 ECU_ADDRESS 0x3F97C8 /end MEASUREMENT
/begin MEASUREMENT ed_fsp_2of20_.ff_pwg2_abs_roh_nv "Gaspedalposition E des Freeze Frame" UBYTE FORMULA_0065 0 0 0.0 100.0000 ECU_ADDRESS 0x3F981A /end MEASUREMENT
/begin MEASUREMENT ed_fsp_3of20_.ff_pwg2_abs_roh_nv "Gaspedalposition E des Freeze Frame" UBYTE FORMULA_0065 0 0 0.0 100.0000 ECU_ADDRESS 0x3F986C /end MEASUREMENT
/begin MEASUREMENT ed_fsp_4of20_.ff_pwg2_abs_roh_nv "Gaspedalposition E des Freeze Frame" UBYTE FORMULA_0065 0 0 0.0 100.0000 ECU_ADDRESS 0x3F98BE /end MEASUREMENT
/begin MEASUREMENT ed_fsp_5of20_.ff_pwg2_abs_roh_nv "Gaspedalposition E des Freeze Frame" UBYTE FORMULA_0065 0 0 0.0 100.0000 ECU_ADDRESS 0x3F9910 /end MEASUREMENT
/begin MEASUREMENT ed_fsp_6of20_.ff_pwg2_abs_roh_nv "Gaspedalposition E des Freeze Frame" UBYTE FORMULA_0065 0 0 0.0 100.0000 ECU_ADDRESS 0x3F9962 /end MEASUREMENT
/begin MEASUREMENT ed_fsp_7of20_.ff_pwg2_abs_roh_nv "Gaspedalposition E des Freeze Frame" UBYTE FORMULA_0065 0 0 0.0 100.0000 ECU_ADDRESS 0x3F99B4 /end MEASUREMENT
/begin MEASUREMENT ed_fsp_8of20_.ff_pwg2_abs_roh_nv "Gaspedalposition E des Freeze Frame" UBYTE FORMULA_0065 0 0 0.0 100.0000 ECU_ADDRESS 0x3F9A06 /end MEASUREMENT
/begin MEASUREMENT ed_fsp_9of20_.ff_pwg2_abs_roh_nv "Gaspedalposition E des Freeze Frame" UBYTE FORMULA_0065 0 0 0.0 100.0000 ECU_ADDRESS 0x3F9A58 /end MEASUREMENT
/begin MEASUREMENT ed_fsp_14of20_.ff_pwg2_abs_roh_nv "Gaspedalposition E des Freeze Frame" UBYTE FORMULA_0065 0 0 0.0 100.0000 ECU_ADDRESS 0x3F9BF2 /end MEASUREMENT
/begin MEASUREMENT ed_fsp_15of20_.ff_pwg2_abs_roh_nv "Gaspedalposition E des Freeze Frame" UBYTE FORMULA_0065 0 0 0.0 100.0000 ECU_ADDRESS 0x3F9C44 /end MEASUREMENT
/begin MEASUREMENT ed_fsp_16of20_.ff_pwg2_abs_roh_nv "Gaspedalposition E des Freeze Frame" UBYTE FORMULA_0065 0 0 0.0 100.0000 ECU_ADDRESS 0x3F9C96 /end MEASUREMENT
/begin MEASUREMENT ed_fsp_17of20_.ff_pwg2_abs_roh_nv "Gaspedalposition E des Freeze Frame" UBYTE FORMULA_0065 0 0 0.0 100.0000 ECU_ADDRESS 0x3F9CE8 /end MEASUREMENT
/begin MEASUREMENT ed_fsp_18of20_.ff_pwg2_abs_roh_nv "Gaspedalposition E des Freeze Frame" UBYTE FORMULA_0065 0 0 0.0 100.0000 ECU_ADDRESS 0x3F9D3A /end MEASUREMENT
/begin MEASUREMENT ed_fsp_19of20_.ff_pwg2_abs_roh_nv "Gaspedalposition E des Freeze Frame" UBYTE FORMULA_0065 0 0 0.0 100.0000 ECU_ADDRESS 0x3F9D8C /end MEASUREMENT
/begin MEASUREMENT ed_fsp_20of20_.ff_pwg2_abs_roh_nv "Gaspedalposition E des Freeze Frame" UBYTE FORMULA_0065 0 0 0.0 100.0000 ECU_ADDRESS 0x3F9DDE /end MEASUREMENT
/begin MEASUREMENT ed_fsp_1of20_.ff_egas_soll_dk_b1_nv "Sollwert relative Drosselklappenposition des Freeze Frame" UBYTE FORMULA_0065 0 0 0.0 100.0000 ECU_ADDRESS 0x3F97C9 /end MEASUREMENT
/begin MEASUREMENT ed_fsp_2of20_.ff_egas_soll_dk_b1_nv "Sollwert relative Drosselklappenposition des Freeze Frame" UBYTE FORMULA_0065 0 0 0.0 100.0000 ECU_ADDRESS 0x3F981B /end MEASUREMENT
/begin MEASUREMENT ed_fsp_3of20_.ff_egas_soll_dk_b1_nv "Sollwert relative Drosselklappenposition des Freeze Frame" UBYTE FORMULA_0065 0 0 0.0 100.0000 ECU_ADDRESS 0x3F986D /end MEASUREMENT
/begin MEASUREMENT ed_fsp_4of20_.ff_egas_soll_dk_b1_nv "Sollwert relative Drosselklappenposition des Freeze Frame" UBYTE FORMULA_0065 0 0 0.0 100.0000 ECU_ADDRESS 0x3F98BF /end MEASUREMENT
/begin MEASUREMENT ed_fsp_5of20_.ff_egas_soll_dk_b1_nv "Sollwert relative Drosselklappenposition des Freeze Frame" UBYTE FORMULA_0065 0 0 0.0 100.0000 ECU_ADDRESS 0x3F9911 /end MEASUREMENT
/begin MEASUREMENT ed_fsp_6of20_.ff_egas_soll_dk_b1_nv "Sollwert relative Drosselklappenposition des Freeze Frame" UBYTE FORMULA_0065 0 0 0.0 100.0000 ECU_ADDRESS 0x3F9963 /end MEASUREMENT
/begin MEASUREMENT ed_fsp_7of20_.ff_egas_soll_dk_b1_nv "Sollwert relative Drosselklappenposition des Freeze Frame" UBYTE FORMULA_0065 0 0 0.0 100.0000 ECU_ADDRESS 0x3F99B5 /end MEASUREMENT
/begin MEASUREMENT ed_fsp_8of20_.ff_egas_soll_dk_b1_nv "Sollwert relative Drosselklappenposition des Freeze Frame" UBYTE FORMULA_0065 0 0 0.0 100.0000 ECU_ADDRESS 0x3F9A07 /end MEASUREMENT
/begin MEASUREMENT ed_fsp_9of20_.ff_egas_soll_dk_b1_nv "Sollwert relative Drosselklappenposition des Freeze Frame" UBYTE FORMULA_0065 0 0 0.0 100.0000 ECU_ADDRESS 0x3F9A59 /end MEASUREMENT
/begin MEASUREMENT ed_fsp_14of20_.ff_egas_soll_dk_b1_nv "Sollwert relative Drosselklappenposition des Freeze Frame" UBYTE FORMULA_0065 0 0 0.0 100.0000 ECU_ADDRESS 0x3F9BF3 /end MEASUREMENT
/begin MEASUREMENT ed_fsp_15of20_.ff_egas_soll_dk_b1_nv "Sollwert relative Drosselklappenposition des Freeze Frame" UBYTE FORMULA_0065 0 0 0.0 100.0000 ECU_ADDRESS 0x3F9C45 /end MEASUREMENT
/begin MEASUREMENT ed_fsp_16of20_.ff_egas_soll_dk_b1_nv "Sollwert relative Drosselklappenposition des Freeze Frame" UBYTE FORMULA_0065 0 0 0.0 100.0000 ECU_ADDRESS 0x3F9C97 /end MEASUREMENT
/begin MEASUREMENT ed_fsp_17of20_.ff_egas_soll_dk_b1_nv "Sollwert relative Drosselklappenposition des Freeze Frame" UBYTE FORMULA_0065 0 0 0.0 100.0000 ECU_ADDRESS 0x3F9CE9 /end MEASUREMENT
/begin MEASUREMENT ed_fsp_18of20_.ff_egas_soll_dk_b1_nv "Sollwert relative Drosselklappenposition des Freeze Frame" UBYTE FORMULA_0065 0 0 0.0 100.0000 ECU_ADDRESS 0x3F9D3B /end MEASUREMENT
/begin MEASUREMENT ed_fsp_19of20_.ff_egas_soll_dk_b1_nv "Sollwert relative Drosselklappenposition des Freeze Frame" UBYTE FORMULA_0065 0 0 0.0 100.0000 ECU_ADDRESS 0x3F9D8D /end MEASUREMENT
/begin MEASUREMENT ed_fsp_20of20_.ff_egas_soll_dk_b1_nv "Sollwert relative Drosselklappenposition des Freeze Frame" UBYTE FORMULA_0065 0 0 0.0 100.0000 ECU_ADDRESS 0x3F9DDF /end MEASUREMENT
/begin FUNCTION Eigendiagnose ""
 /begin OUT_MEASUREMENT ed_fsp_14of20_.ff_egas_abs_dk_b1_nv ed_fsp_14of20_.ff_egas_ist_dk_b1_nv ed_fsp_14of20_.ff_egas_soll_dk_b1_nv ed_fsp_14of20_.ff_fst_nv ed_fsp_14of20_.ff_laa_f_ber_b1_nv ed_fsp_14of20_.ff_laa_f_ber_b2_nv ed_fsp_14of20_.ff_lam_reg_b1_nv ed_fsp_14of20_.ff_lam_reg_b2_nv ed_fsp_14of20_.ff_lam_reg_f_b1_nv ed_fsp_14of20_.ff_lam_reg_f_b2_nv ed_fsp_14of20_.ff_lam_soll_b1_nv ed_fsp_14of20_.ff_ml_b1_nv ed_fsp_14of20_.ff_n_nv ed_fsp_14of20_.ff_p_code_nv ed_fsp_14of20_.ff_pks_ist_nv ed_fsp_14of20_.ff_pumg_nv ed_fsp_14of20_.ff_pwg1_abs_roh_nv ed_fsp_14of20_.ff_pwg2_abs_roh_nv ed_fsp_14of20_.ff_rf_b1_berech_nv ed_fsp_14of20_.ff_rf_b1_nv ed_fsp_14of20_.ff_sl_st_nv ed_fsp_14of20_.ff_tan_b1_nv ed_fsp_14of20_.ff_tev_b1_nv ed_fsp_14of20_.ff_time_ml_nv ed_fsp_14of20_.ff_tmot_nv ed_fsp_14of20_.ff_tumg_nv ed_fsp_14of20_.ff_tz1_nv ed_fsp_14of20_.ff_ub_nv ed_fsp_14of20_.ff_v_vorne_nv ed_fsp_14of20_.haeufigkeitszaehler_nv ed_fsp_14of20_.inj_fehlerzaehler_nv ed_fsp_14of20_.logistikzaehler_nv ed_fsp_14of20_.mil_filter_nv ed_fsp_14of20_.mil_filter_scdn_nv ed_fsp_14of20_.scdn_nenner_nv ed_fsp_14of20_.scdn_zaehler_nv ed_fsp_14of20_.uw_satz_1of3_.uw_km_stand_nv ed_fsp_14of20_.uw_satz_1of3_.uw_wert_nv_1of4_ ed_fsp_14of20_.uw_satz_1of3_.uw_wert_nv_2of4_ ed_fsp_14of20_.uw_satz_1of3_.uw_wert_nv_3of4_ ed_fsp_14of20_.uw_satz_1of3_.uw_wert_nv_4of4_ ed_fsp_14of20_.uw_satz_2of3_.uw_km_stand_nv ed_fsp_14of20_.uw_satz_2of3_.uw_wert_nv_1of4_ ed_fsp_14of20_.uw_satz_2of3_.uw_wert_nv_2of4_ ed_fsp_14of20_.uw_satz_2of3_.uw_wert_nv_3of4_ ed_fsp_14of20_.uw_satz_2of3_.uw_wert_nv_4of4_ ed_fsp_14of20_.uw_satz_3of3_.uw_km_stand_nv ed_fsp_14of20_.uw_satz_3of3_.uw_wert_nv_1of4_ ed_fsp_14of20_.uw_satz_3of3_.uw_wert_nv_2of4_ ed_fsp_14of20_.uw_satz_3of3_.uw_wert_nv_3of4_ ed_fsp_14of20_.uw_satz_3of3_.uw_wert_nv_4of4_ ed_fsp_15of20_.ed_fil_index_nv ed_fsp_15of20_.fehlerart_nv ed_fsp_15of20_.fehlercode_nv ed_fsp_15of20_.ff_egas_abs_dk_b1_nv ed_fsp_15of20_.ff_egas_ist_dk_b1_nv ed_fsp_15of20_.ff_egas_soll_dk_b1_nv ed_fsp_15of20_.ff_fst_nv ed_fsp_15of20_.ff_laa_f_ber_b1_nv ed_fsp_15of20_.ff_laa_f_ber_b2_nv ed_fsp_15of20_.ff_lam_reg_b1_nv ed_fsp_15of20_.ff_lam_reg_b2_nv ed_fsp_15of20_.ff_lam_reg_f_b1_nv ed_fsp_15of20_.ff_lam_reg_f_b2_nv ed_fsp_15of20_.ff_lam_soll_b1_nv ed_fsp_15of20_.ff_ml_b1_nv ed_fsp_15of20_.ff_n_nv ed_fsp_15of20_.ff_p_code_nv ed_fsp_15of20_.ff_pks_ist_nv ed_fsp_15of20_.ff_pumg_nv ed_fsp_15of20_.ff_pwg1_abs_roh_nv ed_fsp_15of20_.ff_pwg2_abs_roh_nv ed_fsp_15of20_.ff_rf_b1_berech_nv ed_fsp_15of20_.ff_rf_b1_nv ed_fsp_15of20_.ff_sl_st_nv ed_fsp_15of20_.ff_tan_b1_nv ed_fsp_15of20_.ff_tev_b1_nv ed_fsp_15of20_.ff_time_ml_nv ed_fsp_15of20_.ff_tmot_nv ed_fsp_15of20_.ff_tumg_nv ed_fsp_15of20_.ff_tz1_nv ed_fsp_15of20_.ff_ub_nv ed_fsp_15of20_.ff_v_vorne_nv ed_fsp_15of20_.haeufigkeitszaehler_nv ed_fsp_15of20_.inj_fehlerzaehler_nv ed_fsp_15of20_.logistikzaehler_nv ed_fsp_15of20_.mil_filter_nv ed_fsp_15of20_.mil_filter_scdn_nv ed_fsp_15of20_.scdn_nenner_nv ed_fsp_15of20_.scdn_zaehler_nv ed_fsp_15of20_.uw_satz_1of3_.uw_km_stand_nv ed_fsp_15of20_.uw_satz_1of3_.uw_wert_nv_1of4_ ed_fsp_15of20_.uw_satz_1of3_.uw_wert_nv_2of4_ ed_fsp_15of20_.uw_satz_1of3_.uw_wert_nv_3of4_ ed_fsp_15of20_.uw_satz_1of3_.uw_wert_nv_4of4_ ed_fsp_15of20_.uw_satz_2of3_.uw_km_stand_nv ed_fsp_15of20_.uw_satz_2of3_.uw_wert_nv_1of4_ ed_fsp_15of20_.uw_satz_2of3_.uw_wert_nv_2of4_ ed_fsp_15of20_.uw_satz_2of3_.uw_wert_nv_3of4_ ed_fsp_15of20_.uw_satz_2of3_.uw_wert_nv_4of4_ ed_fsp_15of20_.uw_satz_3of3_.uw_km_stand_nv ed_fsp_15of20_.uw_satz_3of3_.uw_wert_nv_1of4_ ed_fsp_15of20_.uw_satz_3of3_.uw_wert_nv_2of4_ ed_fsp_15of20_.uw_satz_3of3_.uw_wert_nv_3of4_ ed_fsp_15of20_.uw_satz_3of3_.uw_wert_nv_4of4_ ed_fsp_16of20_.ed_fil_index_nv ed_fsp_16of20_.fehlerart_nv ed_fsp_16of20_.fehlercode_nv ed_fsp_16of20_.ff_egas_abs_dk_b1_nv ed_fsp_16of20_.ff_egas_ist_dk_b1_nv ed_fsp_16of20_.ff_egas_soll_dk_b1_nv ed_fsp_16of20_.ff_fst_nv ed_fsp_16of20_.ff_laa_f_ber_b1_nv ed_fsp_16of20_.ff_laa_f_ber_b2_nv ed_fsp_16of20_.ff_lam_reg_b1_nv ed_fsp_16of20_.ff_lam_reg_b2_nv ed_fsp_16of20_.ff_lam_reg_f_b1_nv ed_fsp_16of20_.ff_lam_reg_f_b2_nv ed_fsp_16of20_.ff_lam_soll_b1_nv ed_fsp_16of20_.ff_ml_b1_nv ed_fsp_16of20_.ff_n_nv ed_fsp_16of20_.ff_p_code_nv ed_fsp_16of20_.ff_pks_ist_nv ed_fsp_16of20_.ff_pumg_nv ed_fsp_16of20_.ff_pwg1_abs_roh_nv ed_fsp_16of20_.ff_pwg2_abs_roh_nv ed_fsp_16of20_.ff_rf_b1_berech_nv ed_fsp_16of20_.ff_rf_b1_nv ed_fsp_16of20_.ff_sl_st_nv ed_fsp_16of20_.ff_tan_b1_nv ed_fsp_16of20_.ff_tev_b1_nv ed_fsp_16of20_.ff_time_ml_nv ed_fsp_16of20_.ff_tmot_nv ed_fsp_16of20_.ff_tumg_nv ed_fsp_16of20_.ff_tz1_nv ed_fsp_16of20_.ff_ub_nv ed_fsp_16of20_.ff_v_vorne_nv ed_fsp_16of20_.haeufigkeitszaehler_nv ed_fsp_16of20_.inj_fehlerzaehler_nv ed_fsp_16of20_.logistikzaehler_nv ed_fsp_16of20_.mil_filter_nv ed_fsp_16of20_.mil_filter_scdn_nv ed_fsp_16of20_.scdn_nenner_nv ed_fsp_16of20_.scdn_zaehler_nv ed_fsp_16of20_.uw_satz_1of3_.uw_km_stand_nv ed_fsp_16of20_.uw_satz_1of3_.uw_wert_nv_1of4_ ed_fsp_16of20_.uw_satz_1of3_.uw_wert_nv_2of4_ ed_fsp_16of20_.uw_satz_1of3_.uw_wert_nv_3of4_ ed_fsp_16of20_.uw_satz_1of3_.uw_wert_nv_4of4_ ed_fsp_16of20_.uw_satz_2of3_.uw_km_stand_nv ed_fsp_16of20_.uw_satz_2of3_.uw_wert_nv_1of4_ ed_fsp_16of20_.uw_satz_2of3_.uw_wert_nv_2of4_ ed_fsp_16of20_.uw_satz_2of3_.uw_wert_nv_3of4_ ed_fsp_16of20_.uw_satz_2of3_.uw_wert_nv_4of4_ ed_fsp_16of20_.uw_satz_3of3_.uw_km_stand_nv ed_fsp_16of20_.uw_satz_3of3_.uw_wert_nv_1of4_ ed_fsp_16of20_.uw_satz_3of3_.uw_wert_nv_2of4_ ed_fsp_16of20_.uw_satz_3of3_.uw_wert_nv_3of4_ ed_fsp_16of20_.uw_satz_3of3_.uw_wert_nv_4of4_ ed_fsp_17of20_.ed_fil_index_nv ed_fsp_17of20_.fehlerart_nv ed_fsp_17of20_.fehlercode_nv ed_fsp_17of20_.ff_egas_abs_dk_b1_nv ed_fsp_17of20_.ff_egas_ist_dk_b1_nv ed_fsp_17of20_.ff_egas_soll_dk_b1_nv ed_fsp_17of20_.ff_fst_nv ed_fsp_17of20_.ff_laa_f_ber_b1_nv ed_fsp_17of20_.ff_laa_f_ber_b2_nv ed_fsp_17of20_.ff_lam_reg_b1_nv ed_fsp_17of20_.ff_lam_reg_b2_nv ed_fsp_17of20_.ff_lam_reg_f_b1_nv ed_fsp_17of20_.ff_lam_reg_f_b2_nv ed_fsp_17of20_.ff_lam_soll_b1_nv ed_fsp_17of20_.ff_ml_b1_nv ed_fsp_17of20_.ff_n_nv ed_fsp_17of20_.ff_p_code_nv ed_fsp_17of20_.ff_pks_ist_nv ed_fsp_17of20_.ff_pumg_nv ed_fsp_17of20_.ff_pwg1_abs_roh_nv ed_fsp_17of20_.ff_pwg2_abs_roh_nv ed_fsp_17of20_.ff_rf_b1_berech_nv ed_fsp_17of20_.ff_rf_b1_nv ed_fsp_17of20_.ff_sl_st_nv ed_fsp_17of20_.ff_tan_b1_nv ed_fsp_17of20_.ff_tev_b1_nv ed_fsp_17of20_.ff_time_ml_nv ed_fsp_17of20_.ff_tmot_nv ed_fsp_17of20_.ff_tumg_nv ed_fsp_17of20_.ff_tz1_nv ed_fsp_17of20_.ff_ub_nv ed_fsp_17of20_.ff_v_vorne_nv ed_fsp_17of20_.haeufigkeitszaehler_nv ed_fsp_17of20_.inj_fehlerzaehler_nv ed_fsp_17of20_.logistikzaehler_nv ed_fsp_17of20_.mil_filter_nv ed_fsp_17of20_.mil_filter_scdn_nv ed_fsp_17of20_.scdn_nenner_nv ed_fsp_17of20_.scdn_zaehler_nv ed_fsp_17of20_.uw_satz_1of3_.uw_km_stand_nv ed_fsp_17of20_.uw_satz_1of3_.uw_wert_nv_1of4_ ed_fsp_17of20_.uw_satz_1of3_.uw_wert_nv_2of4_ ed_fsp_17of20_.uw_satz_1of3_.uw_wert_nv_3of4_ ed_fsp_17of20_.uw_satz_1of3_.uw_wert_nv_4of4_ ed_fsp_17of20_.uw_satz_2of3_.uw_km_stand_nv ed_fsp_17of20_.uw_satz_2of3_.uw_wert_nv_1of4_ ed_fsp_17of20_.uw_satz_2of3_.uw_wert_nv_2of4_ ed_fsp_17of20_.uw_satz_2of3_.uw_wert_nv_3of4_ ed_fsp_17of20_.uw_satz_2of3_.uw_wert_nv_4of4_ ed_fsp_17of20_.uw_satz_3of3_.uw_km_stand_nv ed_fsp_17of20_.uw_satz_3of3_.uw_wert_nv_1of4_ ed_fsp_17of20_.uw_satz_3of3_.uw_wert_nv_2of4_ ed_fsp_17of20_.uw_satz_3of3_.uw_wert_nv_3of4_ ed_fsp_17of20_.uw_satz_3of3_.uw_wert_nv_4of4_ ed_fsp_18of20_.ed_fil_index_nv ed_fsp_18of20_.fehlerart_nv ed_fsp_18of20_.fehlercode_nv ed_fsp_18of20_.ff_egas_abs_dk_b1_nv ed_fsp_18of20_.ff_egas_ist_dk_b1_nv ed_fsp_18of20_.ff_egas_soll_dk_b1_nv ed_fsp_18of20_.ff_fst_nv ed_fsp_18of20_.ff_laa_f_ber_b1_nv ed_fsp_18of20_.ff_laa_f_ber_b2_nv ed_fsp_18of20_.ff_lam_reg_b1_nv ed_fsp_18of20_.ff_lam_reg_b2_nv ed_fsp_18of20_.ff_lam_reg_f_b1_nv ed_fsp_18of20_.ff_lam_reg_f_b2_nv ed_fsp_18of20_.ff_lam_soll_b1_nv ed_fsp_18of20_.ff_ml_b1_nv ed_fsp_18of20_.ff_n_nv ed_fsp_18of20_.ff_p_code_nv ed_fsp_18of20_.ff_pks_ist_nv ed_fsp_18of20_.ff_pumg_nv ed_fsp_18of20_.ff_pwg1_abs_roh_nv ed_fsp_18of20_.ff_pwg2_abs_roh_nv ed_fsp_18of20_.ff_rf_b1_berech_nv ed_fsp_18of20_.ff_rf_b1_nv ed_fsp_18of20_.ff_sl_st_nv ed_fsp_18of20_.ff_tan_b1_nv ed_fsp_18of20_.ff_tev_b1_nv ed_fsp_18of20_.ff_time_ml_nv ed_fsp_18of20_.ff_tmot_nv ed_fsp_18of20_.ff_tumg_nv ed_fsp_18of20_.ff_tz1_nv ed_fsp_18of20_.ff_ub_nv ed_fsp_18of20_.ff_v_vorne_nv ed_fsp_18of20_.haeufigkeitszaehler_nv ed_fsp_18of20_.inj_fehlerzaehler_nv ed_fsp_18of20_.logistikzaehler_nv ed_fsp_18of20_.mil_filter_nv ed_fsp_18of20_.mil_filter_scdn_nv ed_fsp_18of20_.scdn_nenner_nv ed_fsp_18of20_.scdn_zaehler_nv ed_fsp_18of20_.uw_satz_1of3_.uw_km_stand_nv ed_fsp_18of20_.uw_satz_1of3_.uw_wert_nv_1of4_ ed_fsp_18of20_.uw_satz_1of3_.uw_wert_nv_2of4_ ed_fsp_18of20_.uw_satz_1of3_.uw_wert_nv_3of4_ ed_fsp_18of20_.uw_satz_1of3_.uw_wert_nv_4of4_ ed_fsp_18of20_.uw_satz_2of3_.uw_km_stand_nv ed_fsp_18of20_.uw_satz_2of3_.uw_wert_nv_1of4_ ed_fsp_18of20_.uw_satz_2of3_.uw_wert_nv_2of4_ ed_fsp_18of20_.uw_satz_2of3_.uw_wert_nv_3of4_ ed_fsp_18of20_.uw_satz_2of3_.uw_wert_nv_4of4_ ed_fsp_18of20_.uw_satz_3of3_.uw_km_stand_nv ed_fsp_18of20_.uw_satz_3of3_.uw_wert_nv_1of4_ ed_fsp_18of20_.uw_satz_3of3_.uw_wert_nv_2of4_ ed_fsp_18of20_.uw_satz_3of3_.uw_wert_nv_3of4_ ed_fsp_18of20_.uw_satz_3of3_.uw_wert_nv_4of4_ ed_fsp_19of20_.ed_fil_index_nv ed_fsp_19of20_.fehlerart_nv ed_fsp_19of20_.fehlercode_nv ed_fsp_19of20_.ff_egas_abs_dk_b1_nv ed_fsp_19of20_.ff_egas_ist_dk_b1_nv ed_fsp_19of20_.ff_egas_soll_dk_b1_nv ed_fsp_19of20_.ff_fst_nv ed_fsp_19of20_.ff_laa_f_ber_b1_nv ed_fsp_19of20_.ff_laa_f_ber_b2_nv ed_fsp_19of20_.ff_lam_reg_b1_nv ed_fsp_19of20_.ff_lam_reg_b2_nv ed_fsp_19of20_.ff_lam_reg_f_b1_nv ed_fsp_19of20_.ff_lam_reg_f_b2_nv ed_fsp_19of20_.ff_lam_soll_b1_nv ed_fsp_19of20_.ff_ml_b1_nv ed_fsp_19of20_.ff_n_nv ed_fsp_19of20_.ff_p_code_nv ed_fsp_19of20_.ff_pks_ist_nv ed_fsp_19of20_.ff_pumg_nv ed_fsp_19of20_.ff_pwg1_abs_roh_nv ed_fsp_19of20_.ff_pwg2_abs_roh_nv ed_fsp_19of20_.ff_rf_b1_berech_nv ed_fsp_19of20_.ff_rf_b1_nv ed_fsp_19of20_.ff_sl_st_nv ed_fsp_19of20_.ff_tan_b1_nv ed_fsp_19of20_.ff_tev_b1_nv ed_fsp_19of20_.ff_time_ml_nv ed_fsp_19of20_.ff_tmot_nv ed_fsp_19of20_.ff_tumg_nv ed_fsp_19of20_.ff_tz1_nv ed_fsp_19of20_.ff_ub_nv ed_fsp_19of20_.ff_v_vorne_nv ed_fsp_19of20_.haeufigkeitszaehler_nv ed_fsp_19of20_.inj_fehlerzaehler_nv ed_fsp_19of20_.logistikzaehler_nv ed_fsp_19of20_.mil_filter_nv ed_fsp_19of20_.mil_filter_scdn_nv ed_fsp_19of20_.scdn_nenner_nv ed_fsp_19of20_.scdn_zaehler_nv ed_fsp_19of20_.uw_satz_1of3_.uw_km_stand_nv ed_fsp_19of20_.uw_satz_1of3_.uw_wert_nv_1of4_ ed_fsp_19of20_.uw_satz_1of3_.uw_wert_nv_2of4_ ed_fsp_19of20_.uw_satz_1of3_.uw_wert_nv_3of4_ ed_fsp_19of20_.uw_satz_1of3_.uw_wert_nv_4of4_ ed_fsp_19of20_.uw_satz_2of3_.uw_km_stand_nv ed_fsp_19of20_.uw_satz_2of3_.uw_wert_nv_1of4_ ed_fsp_19of20_.uw_satz_2of3_.uw_wert_nv_2of4_ ed_fsp_19of20_.uw_satz_2of3_.uw_wert_nv_3of4_ ed_fsp_19of20_.uw_satz_2of3_.uw_wert_nv_4of4_ ed_fsp_19of20_.uw_satz_3of3_.uw_km_stand_nv ed_fsp_19of20_.uw_satz_3of3_.uw_wert_nv_1of4_ ed_fsp_19of20_.uw_satz_3of3_.uw_wert_nv_2of4_ ed_fsp_19of20_.uw_satz_3of3_.uw_wert_nv_3of4_ ed_fsp_19of20_.uw_satz_3of3_.uw_wert_nv_4of4_ ed_fsp_1of20_.ed_fil_index_nv ed_fsp_1of20_.fehlerart_nv ed_fsp_1of20_.fehlercode_nv ed_fsp_1of20_.ff_egas_abs_dk_b1_nv ed_fsp_1of20_.ff_egas_ist_dk_b1_nv ed_fsp_1of20_.ff_egas_soll_dk_b1_nv ed_fsp_1of20_.ff_fst_nv ed_fsp_1of20_.ff_laa_f_ber_b1_nv ed_fsp_1of20_.ff_laa_f_ber_b2_nv ed_fsp_1of20_.ff_lam_reg_b1_nv ed_fsp_1of20_.ff_lam_reg_b2_nv ed_fsp_1of20_.ff_lam_reg_f_b1_nv ed_fsp_1of20_.ff_lam_reg_f_b2_nv ed_fsp_1of20_.ff_lam_soll_b1_nv ed_fsp_1of20_.ff_ml_b1_nv ed_fsp_1of20_.ff_n_nv ed_fsp_1of20_.ff_p_code_nv ed_fsp_1of20_.ff_pks_ist_nv ed_fsp_1of20_.ff_pumg_nv ed_fsp_1of20_.ff_pwg1_abs_roh_nv ed_fsp_1of20_.ff_pwg2_abs_roh_nv ed_fsp_1of20_.ff_rf_b1_berech_nv ed_fsp_1of20_.ff_rf_b1_nv ed_fsp_1of20_.ff_sl_st_nv ed_fsp_1of20_.ff_tan_b1_nv ed_fsp_1of20_.ff_tev_b1_nv ed_fsp_1of20_.ff_time_ml_nv ed_fsp_1of20_.ff_tmot_nv ed_fsp_1of20_.ff_tumg_nv ed_fsp_1of20_.ff_tz1_nv ed_fsp_1of20_.ff_ub_nv ed_fsp_1of20_.ff_v_vorne_nv ed_fsp_1of20_.haeufigkeitszaehler_nv ed_fsp_1of20_.inj_fehlerzaehler_nv ed_fsp_1of20_.logistikzaehler_nv ed_fsp_1of20_.mil_filter_nv ed_fsp_1of20_.mil_filter_scdn_nv ed_fsp_1of20_.scdn_nenner_nv ed_fsp_1of20_.scdn_zaehler_nv ed_fsp_1of20_.uw_satz_1of3_.uw_km_stand_nv ed_fsp_1of20_.uw_satz_1of3_.uw_wert_nv_1of4_ ed_fsp_1of20_.uw_satz_1of3_.uw_wert_nv_2of4_ ed_fsp_1of20_.uw_satz_1of3_.uw_wert_nv_3of4_ ed_fsp_1of20_.uw_satz_1of3_.uw_wert_nv_4of4_ ed_fsp_1of20_.uw_satz_2of3_.uw_km_stand_nv ed_fsp_1of20_.uw_satz_2of3_.uw_wert_nv_1of4_ ed_fsp_1of20_.uw_satz_2of3_.uw_wert_nv_2of4_ ed_fsp_1of20_.uw_satz_2of3_.uw_wert_nv_3of4_ ed_fsp_1of20_.uw_satz_2of3_.uw_wert_nv_4of4_ ed_fsp_1of20_.uw_satz_3of3_.uw_km_stand_nv ed_fsp_1of20_.uw_satz_3of3_.uw_wert_nv_1of4_ ed_fsp_1of20_.uw_satz_3of3_.uw_wert_nv_2of4_ ed_fsp_1of20_.uw_satz_3of3_.uw_wert_nv_3of4_ ed_fsp_1of20_.uw_satz_3of3_.uw_wert_nv_4of4_ ed_fsp_20of20_.ed_fil_index_nv ed_fsp_20of20_.fehlerart_nv ed_fsp_20of20_.fehlercode_nv ed_fsp_20of20_.ff_egas_abs_dk_b1_nv ed_fsp_20of20_.ff_egas_ist_dk_b1_nv ed_fsp_20of20_.ff_egas_soll_dk_b1_nv ed_fsp_20of20_.ff_fst_nv ed_fsp_20of20_.ff_laa_f_ber_b1_nv ed_fsp_20of20_.ff_laa_f_ber_b2_nv ed_fsp_20of20_.ff_lam_reg_b1_nv ed_fsp_20of20_.ff_lam_reg_b2_nv ed_fsp_20of20_.ff_lam_reg_f_b1_nv ed_fsp_20of20_.ff_lam_reg_f_b2_nv ed_fsp_20of20_.ff_lam_soll_b1_nv ed_fsp_20of20_.ff_ml_b1_nv ed_fsp_20of20_.ff_n_nv ed_fsp_20of20_.ff_p_code_nv ed_fsp_20of20_.ff_pks_ist_nv ed_fsp_20of20_.ff_pumg_nv ed_fsp_20of20_.ff_pwg1_abs_roh_nv ed_fsp_20of20_.ff_pwg2_abs_roh_nv ed_fsp_20of20_.ff_rf_b1_berech_nv ed_fsp_20of20_.ff_rf_b1_nv ed_fsp_20of20_.ff_sl_st_nv ed_fsp_20of20_.ff_tan_b1_nv ed_fsp_20of20_.ff_tev_b1_nv ed_fsp_20of20_.ff_time_ml_nv ed_fsp_20of20_.ff_tmot_nv ed_fsp_20of20_.ff_tumg_nv ed_fsp_20of20_.ff_tz1_nv ed_fsp_20of20_.ff_ub_nv ed_fsp_20of20_.ff_v_vorne_nv ed_fsp_20of20_.haeufigkeitszaehler_nv ed_fsp_20of20_.inj_fehlerzaehler_nv ed_fsp_20of20_.logistikzaehler_nv ed_fsp_20of20_.mil_filter_nv ed_fsp_20of20_.mil_filter_scdn_nv ed_fsp_20of20_.scdn_nenner_nv ed_fsp_20of20_.scdn_zaehler_nv ed_fsp_20of20_.uw_satz_1of3_.uw_km_stand_nv ed_fsp_20of20_.uw_satz_1of3_.uw_wert_nv_1of4_ ed_fsp_20of20_.uw_satz_1of3_.uw_wert_nv_2of4_ ed_fsp_20of20_.uw_satz_1of3_.uw_wert_nv_3of4_ ed_fsp_20of20_.uw_satz_1of3_.uw_wert_nv_4of4_ ed_fsp_20of20_.uw_satz_2of3_.uw_km_stand_nv ed_fsp_20of20_.uw_satz_2of3_.uw_wert_nv_1of4_ ed_fsp_20of20_.uw_satz_2of3_.uw_wert_nv_2of4_ ed_fsp_20of20_.uw_satz_2of3_.uw_wert_nv_3of4_ ed_fsp_20of20_.uw_satz_2of3_.uw_wert_nv_4of4_ ed_fsp_20of20_.uw_satz_3of3_.uw_km_stand_nv ed_fsp_20of20_.uw_satz_3of3_.uw_wert_nv_1of4_ ed_fsp_20of20_.uw_satz_3of3_.uw_wert_nv_2of4_ ed_fsp_20of20_.uw_satz_3of3_.uw_wert_nv_3of4_ ed_fsp_20of20_.uw_satz_3of3_.uw_wert_nv_4of4_ ed_fsp_2of20_.ed_fil_index_nv ed_fsp_2of20_.fehlerart_nv ed_fsp_2of20_.fehlercode_nv ed_fsp_2of20_.ff_egas_abs_dk_b1_nv ed_fsp_2of20_.ff_egas_ist_dk_b1_nv ed_fsp_2of20_.ff_egas_soll_dk_b1_nv ed_fsp_2of20_.ff_fst_nv ed_fsp_2of20_.ff_laa_f_ber_b1_nv ed_fsp_2of20_.ff_laa_f_ber_b2_nv ed_fsp_2of20_.ff_lam_reg_b1_nv ed_fsp_2of20_.ff_lam_reg_b2_nv ed_fsp_2of20_.ff_lam_reg_f_b1_nv ed_fsp_2of20_.ff_lam_reg_f_b2_nv ed_fsp_2of20_.ff_lam_soll_b1_nv ed_fsp_2of20_.ff_ml_b1_nv ed_fsp_2of20_.ff_n_nv ed_fsp_2of20_.ff_p_code_nv ed_fsp_2of20_.ff_pks_ist_nv ed_fsp_2of20_.ff_pumg_nv ed_fsp_2of20_.ff_pwg1_abs_roh_nv ed_fsp_2of20_.ff_pwg2_abs_roh_nv ed_fsp_2of20_.ff_rf_b1_berech_nv ed_fsp_2of20_.ff_rf_b1_nv ed_fsp_2of20_.ff_sl_st_nv ed_fsp_2of20_.ff_tan_b1_nv ed_fsp_2of20_.ff_tev_b1_nv ed_fsp_2of20_.ff_time_ml_nv ed_fsp_2of20_.ff_tmot_nv ed_fsp_2of20_.ff_tumg_nv ed_fsp_2of20_.ff_tz1_nv ed_fsp_2of20_.ff_ub_nv ed_fsp_2of20_.ff_v_vorne_nv ed_fsp_2of20_.haeufigkeitszaehler_nv ed_fsp_2of20_.inj_fehlerzaehler_nv ed_fsp_2of20_.logistikzaehler_nv ed_fsp_2of20_.mil_filter_nv ed_fsp_2of20_.mil_filter_scdn_nv ed_fsp_2of20_.scdn_nenner_nv ed_fsp_2of20_.scdn_zaehler_nv ed_fsp_2of20_.uw_satz_1of3_.uw_km_stand_nv ed_fsp_2of20_.uw_satz_1of3_.uw_wert_nv_1of4_ ed_fsp_2of20_.uw_satz_1of3_.uw_wert_nv_2of4_ ed_fsp_2of20_.uw_satz_1of3_.uw_wert_nv_3of4_ ed_fsp_2of20_.uw_satz_1of3_.uw_wert_nv_4of4_ ed_fsp_2of20_.uw_satz_2of3_.uw_km_stand_nv ed_fsp_2of20_.uw_satz_2of3_.uw_wert_nv_1of4_ ed_fsp_2of20_.uw_satz_2of3_.uw_wert_nv_2of4_ ed_fsp_2of20_.uw_satz_2of3_.uw_wert_nv_3of4_ ed_fsp_2of20_.uw_satz_2of3_.uw_wert_nv_4of4_ ed_fsp_2of20_.uw_satz_3of3_.uw_km_stand_nv ed_fsp_2of20_.uw_satz_3of3_.uw_wert_nv_1of4_ ed_fsp_2of20_.uw_satz_3of3_.uw_wert_nv_2of4_ ed_fsp_2of20_.uw_satz_3of3_.uw_wert_nv_3of4_ ed_fsp_2of20_.uw_satz_3of3_.uw_wert_nv_4of4_ ed_fsp_3of20_.ed_fil_index_nv ed_fsp_3of20_.fehlerart_nv ed_fsp_3of20_.fehlercode_nv ed_fsp_3of20_.ff_egas_abs_dk_b1_nv ed_fsp_3of20_.ff_egas_ist_dk_b1_nv ed_fsp_3of20_.ff_egas_soll_dk_b1_nv ed_fsp_3of20_.ff_fst_nv ed_fsp_3of20_.ff_laa_f_ber_b1_nv ed_fsp_3of20_.ff_laa_f_ber_b2_nv ed_fsp_3of20_.ff_lam_reg_b1_nv ed_fsp_3of20_.ff_lam_reg_b2_nv ed_fsp_3of20_.ff_lam_reg_f_b1_nv ed_fsp_3of20_.ff_lam_reg_f_b2_nv ed_fsp_3of20_.ff_lam_soll_b1_nv ed_fsp_3of20_.ff_ml_b1_nv ed_fsp_3of20_.ff_n_nv ed_fsp_3of20_.ff_p_code_nv ed_fsp_3of20_.ff_pks_ist_nv ed_fsp_3of20_.ff_pumg_nv ed_fsp_3of20_.ff_pwg1_abs_roh_nv ed_fsp_3of20_.ff_pwg2_abs_roh_nv ed_fsp_3of20_.ff_rf_b1_berech_nv ed_fsp_3of20_.ff_rf_b1_nv ed_fsp_3of20_.ff_sl_st_nv ed_fsp_3of20_.ff_tan_b1_nv ed_fsp_3of20_.ff_tev_b1_nv ed_fsp_3of20_.ff_time_ml_nv ed_fsp_3of20_.ff_tmot_nv ed_fsp_3of20_.ff_tumg_nv ed_fsp_3of20_.ff_tz1_nv ed_fsp_3of20_.ff_ub_nv ed_fsp_3of20_.ff_v_vorne_nv ed_fsp_3of20_.haeufigkeitszaehler_nv ed_fsp_3of20_.inj_fehlerzaehler_nv ed_fsp_3of20_.logistikzaehler_nv ed_fsp_3of20_.mil_filter_nv ed_fsp_3of20_.mil_filter_scdn_nv ed_fsp_3of20_.scdn_nenner_nv ed_fsp_3of20_.scdn_zaehler_nv ed_fsp_3of20_.uw_satz_1of3_.uw_km_stand_nv ed_fsp_3of20_.uw_satz_1of3_.uw_wert_nv_1of4_ ed_fsp_3of20_.uw_satz_1of3_.uw_wert_nv_2of4_ ed_fsp_3of20_.uw_satz_1of3_.uw_wert_nv_3of4_ ed_fsp_3of20_.uw_satz_1of3_.uw_wert_nv_4of4_ ed_fsp_3of20_.uw_satz_2of3_.uw_km_stand_nv ed_fsp_3of20_.uw_satz_2of3_.uw_wert_nv_1of4_ ed_fsp_3of20_.uw_satz_2of3_.uw_wert_nv_2of4_ ed_fsp_3of20_.uw_satz_2of3_.uw_wert_nv_3of4_ ed_fsp_3of20_.uw_satz_2of3_.uw_wert_nv_4of4_ ed_fsp_3of20_.uw_satz_3of3_.uw_km_stand_nv ed_fsp_3of20_.uw_satz_3of3_.uw_wert_nv_1of4_ ed_fsp_3of20_.uw_satz_3of3_.uw_wert_nv_2of4_ ed_fsp_3of20_.uw_satz_3of3_.uw_wert_nv_3of4_ ed_fsp_3of20_.uw_satz_3of3_.uw_wert_nv_4of4_ ed_fsp_4of20_.ed_fil_index_nv ed_fsp_4of20_.fehlerart_nv ed_fsp_4of20_.fehlercode_nv ed_fsp_4of20_.ff_egas_abs_dk_b1_nv ed_fsp_4of20_.ff_egas_ist_dk_b1_nv ed_fsp_4of20_.ff_egas_soll_dk_b1_nv ed_fsp_4of20_.ff_fst_nv ed_fsp_4of20_.ff_laa_f_ber_b1_nv ed_fsp_4of20_.ff_laa_f_ber_b2_nv ed_fsp_4of20_.ff_lam_reg_b1_nv ed_fsp_4of20_.ff_lam_reg_b2_nv ed_fsp_4of20_.ff_lam_reg_f_b1_nv ed_fsp_4of20_.ff_lam_reg_f_b2_nv ed_fsp_4of20_.ff_lam_soll_b1_nv ed_fsp_4of20_.ff_ml_b1_nv ed_fsp_4of20_.ff_n_nv ed_fsp_4of20_.ff_p_code_nv ed_fsp_4of20_.ff_pks_ist_nv ed_fsp_4of20_.ff_pumg_nv ed_fsp_4of20_.ff_pwg1_abs_roh_nv ed_fsp_4of20_.ff_pwg2_abs_roh_nv ed_fsp_4of20_.ff_rf_b1_berech_nv ed_fsp_4of20_.ff_rf_b1_nv ed_fsp_4of20_.ff_sl_st_nv ed_fsp_4of20_.ff_tan_b1_nv ed_fsp_4of20_.ff_tev_b1_nv ed_fsp_4of20_.ff_time_ml_nv ed_fsp_4of20_.ff_tmot_nv ed_fsp_4of20_.ff_tumg_nv ed_fsp_4of20_.ff_tz1_nv ed_fsp_4of20_.ff_ub_nv ed_fsp_4of20_.ff_v_vorne_nv ed_fsp_4of20_.haeufigkeitszaehler_nv ed_fsp_4of20_.inj_fehlerzaehler_nv ed_fsp_4of20_.logistikzaehler_nv ed_fsp_4of20_.mil_filter_nv ed_fsp_4of20_.mil_filter_scdn_nv ed_fsp_4of20_.scdn_nenner_nv ed_fsp_4of20_.scdn_zaehler_nv ed_fsp_4of20_.uw_satz_1of3_.uw_km_stand_nv ed_fsp_4of20_.uw_satz_1of3_.uw_wert_nv_1of4_ ed_fsp_4of20_.uw_satz_1of3_.uw_wert_nv_2of4_ ed_fsp_4of20_.uw_satz_1of3_.uw_wert_nv_3of4_ ed_fsp_4of20_.uw_satz_1of3_.uw_wert_nv_4of4_ ed_fsp_4of20_.uw_satz_2of3_.uw_km_stand_nv ed_fsp_4of20_.uw_satz_2of3_.uw_wert_nv_1of4_ ed_fsp_4of20_.uw_satz_2of3_.uw_wert_nv_2of4_ ed_fsp_4of20_.uw_satz_2of3_.uw_wert_nv_3of4_ ed_fsp_4of20_.uw_satz_2of3_.uw_wert_nv_4of4_ ed_fsp_4of20_.uw_satz_3of3_.uw_km_stand_nv ed_fsp_4of20_.uw_satz_3of3_.uw_wert_nv_1of4_ ed_fsp_4of20_.uw_satz_3of3_.uw_wert_nv_2of4_ ed_fsp_4of20_.uw_satz_3of3_.uw_wert_nv_3of4_ ed_fsp_4of20_.uw_satz_3of3_.uw_wert_nv_4of4_ ed_fsp_5of20_.ed_fil_index_nv ed_fsp_5of20_.fehlerart_nv ed_fsp_5of20_.fehlercode_nv ed_fsp_5of20_.ff_egas_abs_dk_b1_nv ed_fsp_5of20_.ff_egas_ist_dk_b1_nv ed_fsp_5of20_.ff_egas_soll_dk_b1_nv ed_fsp_5of20_.ff_fst_nv ed_fsp_5of20_.ff_laa_f_ber_b1_nv ed_fsp_5of20_.ff_laa_f_ber_b2_nv ed_fsp_5of20_.ff_lam_reg_b1_nv ed_fsp_5of20_.ff_lam_reg_b2_nv ed_fsp_5of20_.ff_lam_reg_f_b1_nv ed_fsp_5of20_.ff_lam_reg_f_b2_nv ed_fsp_5of20_.ff_lam_soll_b1_nv ed_fsp_5of20_.ff_ml_b1_nv ed_fsp_5of20_.ff_n_nv ed_fsp_5of20_.ff_p_code_nv ed_fsp_5of20_.ff_pks_ist_nv ed_fsp_5of20_.ff_pumg_nv ed_fsp_5of20_.ff_pwg1_abs_roh_nv ed_fsp_5of20_.ff_pwg2_abs_roh_nv ed_fsp_5of20_.ff_rf_b1_berech_nv ed_fsp_5of20_.ff_rf_b1_nv ed_fsp_5of20_.ff_sl_st_nv ed_fsp_5of20_.ff_tan_b1_nv ed_fsp_5of20_.ff_tev_b1_nv ed_fsp_5of20_.ff_time_ml_nv ed_fsp_5of20_.ff_tmot_nv ed_fsp_5of20_.ff_tumg_nv ed_fsp_5of20_.ff_tz1_nv ed_fsp_5of20_.ff_ub_nv ed_fsp_5of20_.ff_v_vorne_nv ed_fsp_5of20_.haeufigkeitszaehler_nv ed_fsp_5of20_.inj_fehlerzaehler_nv ed_fsp_5of20_.logistikzaehler_nv ed_fsp_5of20_.mil_filter_nv ed_fsp_5of20_.mil_filter_scdn_nv ed_fsp_5of20_.scdn_nenner_nv ed_fsp_5of20_.scdn_zaehler_nv ed_fsp_5of20_.uw_satz_1of3_.uw_km_stand_nv ed_fsp_5of20_.uw_satz_1of3_.uw_wert_nv_1of4_ ed_fsp_5of20_.uw_satz_1of3_.uw_wert_nv_2of4_ ed_fsp_5of20_.uw_satz_1of3_.uw_wert_nv_3of4_ ed_fsp_5of20_.uw_satz_1of3_.uw_wert_nv_4of4_ ed_fsp_5of20_.uw_satz_2of3_.uw_km_stand_nv ed_fsp_5of20_.uw_satz_2of3_.uw_wert_nv_1of4_ ed_fsp_5of20_.uw_satz_2of3_.uw_wert_nv_2of4_ ed_fsp_5of20_.uw_satz_2of3_.uw_wert_nv_3of4_ ed_fsp_5of20_.uw_satz_2of3_.uw_wert_nv_4of4_ ed_fsp_5of20_.uw_satz_3of3_.uw_km_stand_nv ed_fsp_5of20_.uw_satz_3of3_.uw_wert_nv_1of4_ ed_fsp_5of20_.uw_satz_3of3_.uw_wert_nv_2of4_ ed_fsp_5of20_.uw_satz_3of3_.uw_wert_nv_3of4_ ed_fsp_5of20_.uw_satz_3of3_.uw_wert_nv_4of4_ ed_fsp_6of20_.ed_fil_index_nv ed_fsp_6of20_.fehlerart_nv ed_fsp_6of20_.fehlercode_nv ed_fsp_6of20_.ff_egas_abs_dk_b1_nv ed_fsp_6of20_.ff_egas_ist_dk_b1_nv ed_fsp_6of20_.ff_egas_soll_dk_b1_nv ed_fsp_6of20_.ff_fst_nv ed_fsp_6of20_.ff_laa_f_ber_b1_nv ed_fsp_6of20_.ff_laa_f_ber_b2_nv ed_fsp_6of20_.ff_lam_reg_b1_nv ed_fsp_6of20_.ff_lam_reg_b2_nv ed_fsp_6of20_.ff_lam_reg_f_b1_nv ed_fsp_6of20_.ff_lam_reg_f_b2_nv ed_fsp_6of20_.ff_lam_soll_b1_nv ed_fsp_6of20_.ff_ml_b1_nv ed_fsp_6of20_.ff_n_nv ed_fsp_6of20_.ff_p_code_nv ed_fsp_6of20_.ff_pks_ist_nv ed_fsp_6of20_.ff_pumg_nv ed_fsp_6of20_.ff_pwg1_abs_roh_nv ed_fsp_6of20_.ff_pwg2_abs_roh_nv ed_fsp_6of20_.ff_rf_b1_berech_nv ed_fsp_6of20_.ff_rf_b1_nv ed_fsp_6of20_.ff_sl_st_nv ed_fsp_6of20_.ff_tan_b1_nv ed_fsp_6of20_.ff_tev_b1_nv ed_fsp_6of20_.ff_time_ml_nv ed_fsp_6of20_.ff_tmot_nv ed_fsp_6of20_.ff_tumg_nv ed_fsp_6of20_.ff_tz1_nv ed_fsp_6of20_.ff_ub_nv ed_fsp_6of20_.ff_v_vorne_nv ed_fsp_6of20_.haeufigkeitszaehler_nv ed_fsp_6of20_.inj_fehlerzaehler_nv ed_fsp_6of20_.logistikzaehler_nv ed_fsp_6of20_.mil_filter_nv ed_fsp_6of20_.mil_filter_scdn_nv ed_fsp_6of20_.scdn_nenner_nv ed_fsp_6of20_.scdn_zaehler_nv ed_fsp_6of20_.uw_satz_1of3_.uw_km_stand_nv ed_fsp_6of20_.uw_satz_1of3_.uw_wert_nv_1of4_ ed_fsp_6of20_.uw_satz_1of3_.uw_wert_nv_2of4_ ed_fsp_6of20_.uw_satz_1of3_.uw_wert_nv_3of4_ ed_fsp_6of20_.uw_satz_1of3_.uw_wert_nv_4of4_ ed_fsp_6of20_.uw_satz_2of3_.uw_km_stand_nv ed_fsp_6of20_.uw_satz_2of3_.uw_wert_nv_1of4_ ed_fsp_6of20_.uw_satz_2of3_.uw_wert_nv_2of4_ ed_fsp_6of20_.uw_satz_2of3_.uw_wert_nv_3of4_ ed_fsp_6of20_.uw_satz_2of3_.uw_wert_nv_4of4_ ed_fsp_6of20_.uw_satz_3of3_.uw_km_stand_nv ed_fsp_6of20_.uw_satz_3of3_.uw_wert_nv_1of4_ ed_fsp_6of20_.uw_satz_3of3_.uw_wert_nv_2of4_ ed_fsp_6of20_.uw_satz_3of3_.uw_wert_nv_3of4_ ed_fsp_6of20_.uw_satz_3of3_.uw_wert_nv_4of4_ ed_fsp_7of20_.ed_fil_index_nv ed_fsp_7of20_.fehlerart_nv ed_fsp_7of20_.fehlercode_nv ed_fsp_7of20_.ff_egas_abs_dk_b1_nv ed_fsp_7of20_.ff_egas_ist_dk_b1_nv ed_fsp_7of20_.ff_egas_soll_dk_b1_nv ed_fsp_7of20_.ff_fst_nv ed_fsp_7of20_.ff_laa_f_ber_b1_nv ed_fsp_7of20_.ff_laa_f_ber_b2_nv ed_fsp_7of20_.ff_lam_reg_b1_nv ed_fsp_7of20_.ff_lam_reg_b2_nv ed_fsp_7of20_.ff_lam_reg_f_b1_nv ed_fsp_7of20_.ff_lam_reg_f_b2_nv ed_fsp_7of20_.ff_lam_soll_b1_nv ed_fsp_7of20_.ff_ml_b1_nv ed_fsp_7of20_.ff_n_nv ed_fsp_7of20_.ff_p_code_nv ed_fsp_7of20_.ff_pks_ist_nv ed_fsp_7of20_.ff_pumg_nv ed_fsp_7of20_.ff_pwg1_abs_roh_nv ed_fsp_7of20_.ff_pwg2_abs_roh_nv ed_fsp_7of20_.ff_rf_b1_berech_nv ed_fsp_7of20_.ff_rf_b1_nv ed_fsp_7of20_.ff_sl_st_nv ed_fsp_7of20_.ff_tan_b1_nv ed_fsp_7of20_.ff_tev_b1_nv ed_fsp_7of20_.ff_time_ml_nv ed_fsp_7of20_.ff_tmot_nv ed_fsp_7of20_.ff_tumg_nv ed_fsp_7of20_.ff_tz1_nv ed_fsp_7of20_.ff_ub_nv ed_fsp_7of20_.ff_v_vorne_nv ed_fsp_7of20_.haeufigkeitszaehler_nv ed_fsp_7of20_.inj_fehlerzaehler_nv ed_fsp_7of20_.logistikzaehler_nv ed_fsp_7of20_.mil_filter_nv ed_fsp_7of20_.mil_filter_scdn_nv ed_fsp_7of20_.scdn_nenner_nv ed_fsp_7of20_.scdn_zaehler_nv ed_fsp_7of20_.uw_satz_1of3_.uw_km_stand_nv ed_fsp_7of20_.uw_satz_1of3_.uw_wert_nv_1of4_ ed_fsp_7of20_.uw_satz_1of3_.uw_wert_nv_2of4_ ed_fsp_7of20_.uw_satz_1of3_.uw_wert_nv_3of4_ ed_fsp_7of20_.uw_satz_1of3_.uw_wert_nv_4of4_ ed_fsp_7of20_.uw_satz_2of3_.uw_km_stand_nv ed_fsp_7of20_.uw_satz_2of3_.uw_wert_nv_1of4_ ed_fsp_7of20_.uw_satz_2of3_.uw_wert_nv_2of4_ ed_fsp_7of20_.uw_satz_2of3_.uw_wert_nv_3of4_ ed_fsp_7of20_.uw_satz_2of3_.uw_wert_nv_4of4_ ed_fsp_7of20_.uw_satz_3of3_.uw_km_stand_nv ed_fsp_7of20_.uw_satz_3of3_.uw_wert_nv_1of4_ ed_fsp_7of20_.uw_satz_3of3_.uw_wert_nv_2of4_ ed_fsp_7of20_.uw_satz_3of3_.uw_wert_nv_3of4_ ed_fsp_7of20_.uw_satz_3of3_.uw_wert_nv_4of4_ ed_fsp_8of20_.ed_fil_index_nv ed_fsp_8of20_.fehlerart_nv ed_fsp_8of20_.fehlercode_nv ed_fsp_8of20_.ff_egas_abs_dk_b1_nv ed_fsp_8of20_.ff_egas_ist_dk_b1_nv ed_fsp_8of20_.ff_egas_soll_dk_b1_nv ed_fsp_8of20_.ff_fst_nv ed_fsp_8of20_.ff_laa_f_ber_b1_nv ed_fsp_8of20_.ff_laa_f_ber_b2_nv ed_fsp_8of20_.ff_lam_reg_b1_nv ed_fsp_8of20_.ff_lam_reg_b2_nv ed_fsp_8of20_.ff_lam_reg_f_b1_nv ed_fsp_8of20_.ff_lam_reg_f_b2_nv ed_fsp_8of20_.ff_lam_soll_b1_nv ed_fsp_8of20_.ff_ml_b1_nv ed_fsp_8of20_.ff_n_nv ed_fsp_8of20_.ff_p_code_nv ed_fsp_8of20_.ff_pks_ist_nv ed_fsp_8of20_.ff_pumg_nv ed_fsp_8of20_.ff_pwg1_abs_roh_nv ed_fsp_8of20_.ff_pwg2_abs_roh_nv ed_fsp_8of20_.ff_rf_b1_berech_nv ed_fsp_8of20_.ff_rf_b1_nv ed_fsp_8of20_.ff_sl_st_nv ed_fsp_8of20_.ff_tan_b1_nv ed_fsp_8of20_.ff_tev_b1_nv ed_fsp_8of20_.ff_time_ml_nv ed_fsp_8of20_.ff_tmot_nv ed_fsp_8of20_.ff_tumg_nv ed_fsp_8of20_.ff_tz1_nv ed_fsp_8of20_.ff_ub_nv ed_fsp_8of20_.ff_v_vorne_nv ed_fsp_8of20_.haeufigkeitszaehler_nv ed_fsp_8of20_.inj_fehlerzaehler_nv ed_fsp_8of20_.logistikzaehler_nv ed_fsp_8of20_.mil_filter_nv ed_fsp_8of20_.mil_filter_scdn_nv ed_fsp_8of20_.scdn_nenner_nv ed_fsp_8of20_.scdn_zaehler_nv ed_fsp_8of20_.uw_satz_1of3_.uw_km_stand_nv ed_fsp_8of20_.uw_satz_1of3_.uw_wert_nv_1of4_ ed_fsp_8of20_.uw_satz_1of3_.uw_wert_nv_2of4_ ed_fsp_8of20_.uw_satz_1of3_.uw_wert_nv_3of4_ ed_fsp_8of20_.uw_satz_1of3_.uw_wert_nv_4of4_ ed_fsp_8of20_.uw_satz_2of3_.uw_km_stand_nv ed_fsp_8of20_.uw_satz_2of3_.uw_wert_nv_1of4_ ed_fsp_8of20_.uw_satz_2of3_.uw_wert_nv_2of4_ ed_fsp_8of20_.uw_satz_2of3_.uw_wert_nv_3of4_ ed_fsp_8of20_.uw_satz_2of3_.uw_wert_nv_4of4_ ed_fsp_8of20_.uw_satz_3of3_.uw_km_stand_nv ed_fsp_8of20_.uw_satz_3of3_.uw_wert_nv_1of4_ ed_fsp_8of20_.uw_satz_3of3_.uw_wert_nv_2of4_ ed_fsp_8of20_.uw_satz_3of3_.uw_wert_nv_3of4_ ed_fsp_8of20_.uw_satz_3of3_.uw_wert_nv_4of4_ ed_fsp_9of20_.ed_fil_index_nv ed_fsp_9of20_.fehlerart_nv ed_fsp_9of20_.fehlercode_nv ed_fsp_9of20_.ff_egas_abs_dk_b1_nv ed_fsp_9of20_.ff_egas_ist_dk_b1_nv ed_fsp_9of20_.ff_egas_soll_dk_b1_nv ed_fsp_9of20_.ff_fst_nv ed_fsp_9of20_.ff_laa_f_ber_b1_nv ed_fsp_9of20_.ff_laa_f_ber_b2_nv ed_fsp_9of20_.ff_lam_reg_b1_nv ed_fsp_9of20_.ff_lam_reg_b2_nv ed_fsp_9of20_.ff_lam_reg_f_b1_nv ed_fsp_9of20_.ff_lam_reg_f_b2_nv ed_fsp_9of20_.ff_lam_soll_b1_nv ed_fsp_9of20_.ff_ml_b1_nv ed_fsp_9of20_.ff_n_nv ed_fsp_9of20_.ff_p_code_nv ed_fsp_9of20_.ff_pks_ist_nv ed_fsp_9of20_.ff_pumg_nv ed_fsp_9of20_.ff_pwg1_abs_roh_nv ed_fsp_9of20_.ff_pwg2_abs_roh_nv ed_fsp_9of20_.ff_rf_b1_berech_nv ed_fsp_9of20_.ff_rf_b1_nv ed_fsp_9of20_.ff_sl_st_nv ed_fsp_9of20_.ff_tan_b1_nv ed_fsp_9of20_.ff_tev_b1_nv ed_fsp_9of20_.ff_time_ml_nv ed_fsp_9of20_.ff_tmot_nv ed_fsp_9of20_.ff_tumg_nv ed_fsp_9of20_.ff_tz1_nv ed_fsp_9of20_.ff_ub_nv ed_fsp_9of20_.ff_v_vorne_nv ed_fsp_9of20_.haeufigkeitszaehler_nv ed_fsp_9of20_.inj_fehlerzaehler_nv ed_fsp_9of20_.logistikzaehler_nv ed_fsp_9of20_.mil_filter_nv ed_fsp_9of20_.mil_filter_scdn_nv ed_fsp_9of20_.scdn_nenner_nv ed_fsp_9of20_.scdn_zaehler_nv ed_fsp_9of20_.uw_satz_1of3_.uw_km_stand_nv ed_fsp_9of20_.uw_satz_1of3_.uw_wert_nv_1of4_ ed_fsp_9of20_.uw_satz_1of3_.uw_wert_nv_2of4_ ed_fsp_9of20_.uw_satz_1of3_.uw_wert_nv_3of4_ ed_fsp_9of20_.uw_satz_1of3_.uw_wert_nv_4of4_ ed_fsp_9of20_.uw_satz_2of3_.uw_km_stand_nv /end OUT_MEASUREMENT
/end FUNCTION
/end MODULE
/end PROJECT
