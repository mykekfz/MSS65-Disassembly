/begin PROJECT MSS65-ign-V452 "MSS65 IGN - V452.01-B204.00, data set 0569Q60Z160E"
/begin HEADER "" VERSION "V452.01-B204.00" /end HEADER
/begin MODULE _MSS65-ign "MSS65 IGN - V452.01-B204.00, calibration xxxxxxxx"
/begin MOD_COMMON "" BYTE_ORDER MSB_FIRST /* Default byteorder (Motorola) */ /end MOD_COMMON
/* Formel fuer 1:1-Wiedergabe ohne Einheit */
/begin COMPU_METHOD FORMULA_USER1 "FORMULA_USER1" RAT_FUNC "%7.0" "-" COEFFS 0 1 0 0 0 1 /end COMPU_METHOD
/begin COMPU_METHOD DEFAULT_FORMULA "DEFAULT_FORMULA" RAT_FUNC "%7.0" "" COEFFS 0 1 0 0 0 1 /end COMPU_METHOD
/begin COMPU_METHOD FORMULA_0002 "FORMULA_0002" TAB_VERB "%3.0" "-" COMPU_TAB_REF FORMULA_0002_VTAB /end COMPU_METHOD
/begin COMPU_VTAB FORMULA_0002_VTAB "FORMULA_0002_VTAB" TAB_VERB 4 0 "in Ordnung" 128 "queue full" 64 "queue fehler" 32 "IRQ illegal" DEFAULT_VALUE "undefiniert" /end COMPU_VTAB
/begin COMPU_METHOD FORMULA_0003 "FORMULA_0003" RAT_FUNC "%3.0" "-" COEFFS 0 1 0 0 0 1 /end COMPU_METHOD
/begin COMPU_METHOD FORMULA_0006 "FORMULA_0006" RAT_FUNC "%5.0" "Upm" COEFFS 0 1 0 0 0 1 /end COMPU_METHOD
/begin COMPU_METHOD FORMULA_0021 "FORMULA_0021" RAT_FUNC "%7.2" "s" COEFFS 0 100 0 0 0 1 /end COMPU_METHOD
/* ------------------ Abschnitt erzeugt aus adapt_glob.dat ------------------ */
/begin COMPU_METHOD FORMULA_0023 "FORMULA_0023" RAT_FUNC "%6.1" "�C" COEFFS 0 10 2732 0 0 1 /end COMPU_METHOD
/begin COMPU_METHOD FORMULA_0033 "FORMULA_0033" RAT_FUNC "%5.2" "-" COEFFS 0 1 0 0 0 1 /end COMPU_METHOD
/begin COMPU_METHOD FORMULA_0062 "FORMULA_0062" RAT_FUNC "%5.0" "s" COEFFS 0 1 0 0 0 1 /end COMPU_METHOD
/begin COMPU_METHOD FORMULA_0073 "FORMULA_0073" RAT_FUNC "%6.1" "s" COEFFS 0 10 0 0 0 1 /end COMPU_METHOD
/begin COMPU_METHOD FORMULA_0075 "FORMULA_0075" RAT_FUNC "%8.3" "-" COEFFS 0 1024 0 0 0 1 /end COMPU_METHOD
/begin COMPU_METHOD FORMULA_0076 "FORMULA_0076" RAT_FUNC "%6.1" "Kelvin" COEFFS 0 10 0 0 0 1 /end COMPU_METHOD
/begin COMPU_METHOD FORMULA_0077 "FORMULA_0077" RAT_FUNC "%6.1" "mbar" COEFFS 0 16 0 0 0 1 /end COMPU_METHOD
/begin COMPU_METHOD FORMULA_0078 "FORMULA_0078" RAT_FUNC "%6.1" "km/h" COEFFS 0 16 0 0 0 1 /end COMPU_METHOD
/begin COMPU_METHOD FORMULA_0112 "FORMULA_0112" RAT_FUNC "%6.1" "kg/h" COEFFS 0 10 0 0 0 1 /end COMPU_METHOD
/begin COMPU_METHOD FORMULA_0123 "FORMULA_0123" RAT_FUNC "%5.0" "digit" COEFFS 0 1 0 0 0 1 /end COMPU_METHOD
/begin COMPU_METHOD FORMULA_0132 "FORMULA_0132" RAT_FUNC "%7.2" "m/(s*s)" COEFFS 0 40 0 0 0 1 /end COMPU_METHOD
/begin COMPU_METHOD FORMULA_0140 "FORMULA_0140" RAT_FUNC "%5.0" "bar/s" COEFFS 0 1 0 0 0 50 /end COMPU_METHOD
/begin COMPU_METHOD FORMULA_0146 "FORMULA_0146" RAT_FUNC "%6.1" "%" COEFFS 0 1667 0 0 0 100 /end COMPU_METHOD
/begin COMPU_METHOD FORMULA_0147 "FORMULA_0147" RAT_FUNC "%6.1" "qmm" COEFFS 0 10 0 0 0 1 /end COMPU_METHOD
/begin COMPU_METHOD FORMULA_0152 "FORMULA_0152" RAT_FUNC "%9.2" "s" COEFFS 0 100 0 0 0 1 /end COMPU_METHOD
/* ------------------ Abschnitt erzeugt aus qadc.dat ------------------ */
/begin COMPU_METHOD FORMULA_0354 "FORMULA_0354" TAB_VERB "%5.2" "-" COMPU_TAB_REF FORMULA_0354_VTAB /end COMPU_METHOD
/begin COMPU_VTAB FORMULA_0354_VTAB "FORMULA_0354_VTAB" TAB_VERB 3 0 "OK" 1 "QADCA NIO" 2 "QADCB NIO" DEFAULT_VALUE "undef" /end COMPU_VTAB
/* ------------------ Abschnitt erzeugt aus spi.dat ------------------ */
/begin COMPU_METHOD FORMULA_0370 "FORMULA_0370" TAB_VERB "%3.0" "-" COMPU_TAB_REF FORMULA_0370_VTAB /end COMPU_METHOD
/begin COMPU_VTAB FORMULA_0370_VTAB "FORMULA_0370_VTAB" TAB_VERB 2 0 "frei" 128 "Belegt" DEFAULT_VALUE "undefiniert" /end COMPU_VTAB
/begin COMPU_METHOD FORMULA_0497 "FORMULA_0497" RAT_FUNC "%7.2" "-" COEFFS 0 100 0 0 0 1 /end COMPU_METHOD
/begin COMPU_METHOD FORMULA_0501 "FORMULA_0501" RAT_FUNC "%4.1" "s" COEFFS 0 10 0 0 0 1 /end COMPU_METHOD
/begin COMPU_METHOD FORMULA_0627 "FORMULA_0627" RAT_FUNC "%5.0" "min" COEFFS 0 60 0 0 0 1 /end COMPU_METHOD
/begin COMPU_METHOD FORMULA_0679 "FORMULA_0679" RAT_FUNC "%5.2" "s" COEFFS 0 0 25.6 0 1 0 /end COMPU_METHOD
/* ------------------ Abschnitt erzeugt aus mzyl_sek.dat ------------------ */
/begin COMPU_METHOD FORMULA_0835 "FORMULA_0835" RAT_FUNC "%7.2" "qmm" COEFFS 0 1000 0 0 0 1 /end COMPU_METHOD
/begin COMPU_METHOD FORMULA_0836 "FORMULA_0836" TAB_VERB "%5.2" "-" COMPU_TAB_REF FORMULA_0836_VTAB /end COMPU_METHOD
/begin COMPU_VTAB FORMULA_0836_VTAB "FORMULA_0836_VTAB" TAB_VERB 2 0 "immer" 1 "keine bei SSP-DIAG" DEFAULT_VALUE "undefiniert" /end COMPU_VTAB
/begin COMPU_METHOD FORMULA_0837 "FORMULA_0837" RAT_FUNC "%8.3" "-/5ms" COEFFS 0 1024 0 0 0 1 /end COMPU_METHOD
/* ------------------ Abschnitt erzeugt aus sl_zwd.dat ------------------ */
/begin COMPU_METHOD FORMULA_0908 "FORMULA_0908" TAB_VERB "%3.0" "-" COMPU_TAB_REF FORMULA_0908_VTAB /end COMPU_METHOD
/begin COMPU_VTAB FORMULA_0908_VTAB "FORMULA_0908_VTAB" TAB_VERB 5 0 "ZWD aus" 1 "ZWD ein" 2 "OBD anst." 4 "Test mode" 8 "EXD-Tester" DEFAULT_VALUE "ungueltig" /end COMPU_VTAB
/begin COMPU_METHOD FORMULA_0986 "FORMULA_0986" RAT_FUNC "%7.2" "min" COEFFS 0 60 0 0 0 1 /end COMPU_METHOD
/begin COMPU_METHOD FORMULA_0988 "FORMULA_0988" RAT_FUNC "%7.2" "s" COEFFS 0 0 6553.5 0 1 0 /end COMPU_METHOD
/* ------------------ Abschnitt erzeugt aus toel.dat ------------------ */
/begin COMPU_METHOD FORMULA_1022 "FORMULA_1022" RAT_FUNC "%11.4" "�C" COEFFS 0 10000 2732000 0 0 1 /end COMPU_METHOD
/begin COMPU_METHOD FORMULA_1023 "FORMULA_1023" RAT_FUNC "%9.4" "Kelvin" COEFFS 0 10000 0 0 0 1 /end COMPU_METHOD
/begin COMPU_METHOD FORMULA_1025 "FORMULA_1025" RAT_FUNC "%7.2" "Anteil [0..1]" COEFFS 0 100 0 0 0 1 /end COMPU_METHOD
/* ------------------ Abschnitt erzeugt aus toel_modell.dat ------------------ */
/begin COMPU_METHOD FORMULA_1026 "FORMULA_1026" RAT_FUNC "%8.3" "kg" COEFFS 0 512 0 0 0 1 /end COMPU_METHOD
/* ------------------ Abschnitt erzeugt aus tumg.dat ------------------ */
/begin COMPU_METHOD FORMULA_1031 "FORMULA_1031" TAB_VERB "%5.2" "-" COMPU_TAB_REF FORMULA_1031_VTAB /end COMPU_METHOD
/begin COMPU_VTAB FORMULA_1031_VTAB "FORMULA_1031_VTAB" TAB_VERB 8 0 "Warte auf Diag.-Bed./CAN" 1 "Diagnose Kaltstart" 2 "Diagnose Modell" 4 "Warte auf Bed. FS-Eintrag" 8 "Diagnosebedingung n.i.O." 16 "Diagnose i. O." 32 "Diagnose n.i.O." 128 "Diagnose gesperrt" DEFAULT_VALUE "undef" /end COMPU_VTAB
/begin COMPU_METHOD FORMULA_1032 "FORMULA_1032" TAB_VERB "%5.2" "-" COMPU_TAB_REF FORMULA_1032_VTAB /end COMPU_METHOD
/begin COMPU_VTAB FORMULA_1032_VTAB "FORMULA_1032_VTAB" TAB_VERB 8 0 "Initialisierung" 1 "Fahrt" 2 "Aufheizen" 3 "Fahrt Aufheizen" 4 "Dynamik" 5 "Fahrt Dynamik" 6 "Aufheizen Dynamik" 7 "Fahrt Aufheizen Dynamik" DEFAULT_VALUE "undef." /end COMPU_VTAB
/begin COMPU_METHOD FORMULA_1033 "FORMULA_1033" TAB_VERB "%5.2" "-" COMPU_TAB_REF FORMULA_1033_VTAB /end COMPU_METHOD
/begin COMPU_VTAB FORMULA_1033_VTAB "FORMULA_1033_VTAB" TAB_VERB 3 0 "kein Vergleichswert" 1 "TUMG_OBD_KALTSTART" 2 "TUMG_OBD_MODELL" DEFAULT_VALUE "undef" /end COMPU_VTAB
/begin COMPU_METHOD FORMULA_1034 "FORMULA_1034" TAB_VERB "%3.0" "-" COMPU_TAB_REF FORMULA_1034_VTAB /end COMPU_METHOD
/begin COMPU_VTAB FORMULA_1034_VTAB "FORMULA_1034_VTAB" TAB_VERB 3 0 "OBD aus" 1 "OBD kontinuierlich" 2 "OBD einmalig" /end COMPU_VTAB
/* ------------------ Abschnitt erzeugt aus zoelp.dat ------------------ */
/begin COMPU_METHOD FORMULA_1062 "FORMULA_1062" TAB_VERB "%5.2" "-" COMPU_TAB_REF FORMULA_1062_VTAB /end COMPU_METHOD
/begin COMPU_VTAB FORMULA_1062_VTAB "FORMULA_1062_VTAB" TAB_VERB 5 0 "aus" 1 "an" 2 "an manuel" 4 "an FG" 8 "an EXD" DEFAULT_VALUE "ungueltig" /end COMPU_VTAB
/begin COMPU_METHOD FORMULA_1063 "FORMULA_1063" RAT_FUNC "%4.1" "A" COEFFS 0 10 0 0 0 1 /end COMPU_METHOD
/begin COMPU_METHOD FORMULA_1064 "FORMULA_1064" TAB_VERB "%5.2" "-" COMPU_TAB_REF FORMULA_1064_VTAB /end COMPU_METHOD
/begin COMPU_VTAB FORMULA_1064_VTAB "FORMULA_1064_VTAB" TAB_VERB 4 0 "inaktiv" 1 "aktiv" 5 "B1 aktiv man" 17 "B2 aktiv man" DEFAULT_VALUE "ungueltig" /end COMPU_VTAB
/begin COMPU_METHOD FORMULA_1065 "FORMULA_1065" TAB_VERB "%5.2" "-" COMPU_TAB_REF FORMULA_1065_VTAB /end COMPU_METHOD
/begin COMPU_VTAB FORMULA_1065_VTAB "FORMULA_1065_VTAB" TAB_VERB 2 1 "normal" -1 "um" DEFAULT_VALUE "ungueltig" /end COMPU_VTAB
/* ------------------ Abschnitt erzeugt aus qadc.dat ------------------ */
/begin MEASUREMENT qadc_check_ccw_st "CCW Check Status" UBYTE FORMULA_0354 0 0 0.0 255.0 ECU_ADDRESS 0x3FC1AE /end MEASUREMENT
/begin MEASUREMENT qadc_err_cnt "CCW Check Fehlerzaehler" UBYTE FORMULA_0033 0 0 0.0 255.0000 ECU_ADDRESS 0x3FC1AF /end MEASUREMENT
/begin MEASUREMENT qadc_check_ccw_adr "CCW Check Adresse des Fehlers" UBYTE FORMULA_0033 0 0 0.0 255.0000 ECU_ADDRESS 0x3FC1B0 /end MEASUREMENT
/* ------------------ Abschnitt erzeugt aus spi.dat ------------------ */
/begin MEASUREMENT spim_errorcounter "Fehlerzaehler der Spi" UBYTE FORMULA_0003 0 0 0.0 255.0000 ECU_ADDRESS 0x3FC32C /end MEASUREMENT
/begin MEASUREMENT spim_reqcounter "Anzahl der Auftraege in der Queue" UBYTE FORMULA_0003 0 0 0.0 255.0000 ECU_ADDRESS 0x3FC32D /end MEASUREMENT
/begin MEASUREMENT spim_status "Statusvariable der SPI" UBYTE FORMULA_0370 0 0 0.0 255.0 ECU_ADDRESS 0x3FC32E /end MEASUREMENT
/begin MEASUREMENT spim_errorcode "Statusvariable der SPI" UBYTE FORMULA_0002 0 0 0.0 255.0 ECU_ADDRESS 0x3FC32F /end MEASUREMENT
/* ------------------ Abschnitt erzeugt aus mzyl_sek.dat ------------------ */
/begin CHARACTERISTIC K_MZYL_SEK_AQ_ABS_SSP "Oeffnungquersch. bei SSP ein" VALUE 0x78616 TKW_VV_VV_UW 100.0 FORMULA_0147 0.0 50.0000 FORMAT "%4.1" /end CHARACTERISTIC
/begin CHARACTERISTIC K_MZYL_SEK_SSP_DIAG_CFG "Einfluss SSP Diagnose" VALUE 0x78618 TKW_VV_VV_UB 100.0 FORMULA_0836 0.0 255.0 /end CHARACTERISTIC
/begin CHARACTERISTIC K_MZYL_SEK_MVAC_ABREG "Faktor fuer Abregelung" VALUE 0x7861A TKW_VV_VV_UW 100.0 FORMULA_0837 0.0 1.0000 FORMAT "%6.3" /end CHARACTERISTIC
/begin CHARACTERISTIC K_MZYL_SEK_MVAC_BANK_FAK_1of2_ "Bankspezifische Gewichtung" VALUE 0x7861C TKW_VV_VV_UW 100.0 FORMULA_0075 0.0 4.0000 FORMAT "%6.3" /end CHARACTERISTIC
/begin CHARACTERISTIC K_MZYL_SEK_MVAC_BANK_FAK_2of2_ "Bankspezifische Gewichtung" VALUE 0x7861E TKW_VV_VV_UW 100.0 FORMULA_0075 0.0 4.0000 FORMAT "%6.3" /end CHARACTERISTIC
/begin CHARACTERISTIC K_MZYL_SEK_SSP_BANK_FAK_1of2_ "Bankspezifische Gewichtung" VALUE 0x78620 TKW_VV_VV_UW 100.0 FORMULA_0075 0.0 4.0000 FORMAT "%6.3" /end CHARACTERISTIC
/begin CHARACTERISTIC K_MZYL_SEK_SSP_BANK_FAK_2of2_ "Bankspezifische Gewichtung" VALUE 0x78622 TKW_VV_VV_UW 100.0 FORMULA_0075 0.0 4.0000 FORMAT "%6.3" /end CHARACTERISTIC
/begin CHARACTERISTIC KL_MZYL_SEK_MVAC_N_FAK "Faktor ueber Drehzahl" CURVE 0x78624 TKL_SW_VV_UW 100.0 FORMULA_0075 0.0 4.0000 /begin AXIS_DESCR STD_AXIS n FORMULA_0006 8 0.0 10000.0000 /end AXIS_DESCR FORMAT "%6.3" /end CHARACTERISTIC
/begin CHARACTERISTIC KF_MZYL_SEK_MVAC_AQ_ABS "Querschnitt Mastervak" MAP 0x78646 TKF_SW_SW_UW 100.0 FORMULA_0835 0.0 65.0000
 /begin AXIS_DESCR STD_AXIS pdif FORMULA_0077 4 -2000.0000 2000.0000 FORMAT "%4.1" /end AXIS_DESCR
 /begin AXIS_DESCR STD_AXIS can_brp_grad FORMULA_0140 6 -5000.0000 5000.0000 /end AXIS_DESCR
 FORMAT "%5.2" /end CHARACTERISTIC
/begin MEASUREMENT mzyl_sek_aq_mvac_1of2_ "aq aus Mastervac" UWORD FORMULA_0835 0 0 0.0 65.0000 ECU_ADDRESS 0x3FC10E /end MEASUREMENT
/begin MEASUREMENT mzyl_sek_aq_mvac_2of2_ "aq aus Mastervac" UWORD FORMULA_0835 0 0 0.0 65.0000 ECU_ADDRESS 0x3FC110 /end MEASUREMENT
/begin MEASUREMENT mzyl_sek_aq_mvac_roh "aq aus Mastervac ohne Abregelung" UWORD FORMULA_0835 0 0 0.0 65.0000 ECU_ADDRESS 0x3FC112 /end MEASUREMENT
/begin MEASUREMENT mzyl_sek_mvac_fak "Abregelungsfaktor" UWORD FORMULA_0075 0 0 0.0 4.0000 ECU_ADDRESS 0x3FC114 /end MEASUREMENT
/begin MEASUREMENT mzyl_sek_aq_ssp_roh "Saugstrahlpumpenquerschnitt" UWORD FORMULA_0147 0 0 0.0 6500.0000 ECU_ADDRESS 0x3FC116 /end MEASUREMENT
/begin MEASUREMENT mzyl_sek_aq_ssp_1of2_ "Wirksamer Querschnitt Saugstrahlpumpe" UWORD FORMULA_0147 0 0 0.0 6500.0000 ECU_ADDRESS 0x3FC118 /end MEASUREMENT
/begin MEASUREMENT mzyl_sek_aq_ssp_2of2_ "Wirksamer Querschnitt Saugstrahlpumpe" UWORD FORMULA_0147 0 0 0.0 6500.0000 ECU_ADDRESS 0x3FC11A /end MEASUREMENT
/* ------------------ Abschnitt erzeugt aus sl_zwd.dat ------------------ */
/begin CHARACTERISTIC K_SL_ZWD_TV_MIN "Minimal ausgegebenes Tv" VALUE 0x78922 TKW_VV_VV_SW 100.0 FORMULA_0146 0.0 100.0000 FORMAT "%4.1" /end CHARACTERISTIC
/begin CHARACTERISTIC K_SL_ZWD_TV_MAX "Maximal ausgegebenes Tv" VALUE 0x78924 TKW_VV_VV_SW 100.0 FORMULA_0146 0.0 100.0000 FORMAT "%4.1" /end CHARACTERISTIC
/begin CHARACTERISTIC K_SL_ZWD_TV_SLP_TEST "Testtastverhaeltniss wenn SLP" VALUE 0x78926 TKW_VV_VV_SW 100.0 FORMULA_0146 0.0 100.0000 FORMAT "%4.1" /end CHARACTERISTIC
/begin MEASUREMENT sl_zwd_st "Status SL-ZWD " UBYTE FORMULA_0908 0 0 0.0 255.0 ECU_ADDRESS 0x3FC20C /end MEASUREMENT
/begin MEASUREMENT sl_zwd_tv_tpu "TPU Tastverh. ZWD fuer SL" SWORD FORMULA_0146 0 0 0.0 100.0000 ECU_ADDRESS 0x3FC20E /end MEASUREMENT
/* ------------------ Abschnitt erzeugt aus toel_modell.dat ------------------ */
/begin CHARACTERISTIC K_TOEL_MODELL_LM_INTEGRATOR_DT "Tau fuer toel_modell_lm-Integrator | EN: Tau fuer toel_modell_lm-Integrator" VALUE 0x79A1A TKW_VV_VV_UW 100.0 FORMULA_0988 0.1000 6553.5000 FORMAT "%5.2" /end CHARACTERISTIC
/begin CHARACTERISTIC K_TOEL_MODELL_N_T1 "PT1-Filterzeitkonstante fuer toel_modell_n_filt" VALUE 0x79A1C TKW_VV_VV_UB 100.0 FORMULA_0679 0.1004 25.6000 /end CHARACTERISTIC
/begin CHARACTERISTIC K_TOEL_MODELL_AEBEGR "Aenderungsbegrenzung fuer toel_modell | EN: Aenderungsbegrenzung toel_modell" VALUE 0x79A1E TKW_VV_VV_UW 100.0 FORMULA_0076 0.0 1000.0000 FORMAT "%4.1" /end CHARACTERISTIC
/begin CHARACTERISTIC K_TOEL_MODELL_BEGR_OFFS "Temperaturfenster Begrenzung | EN: Grenzwertueberwachung toel_modell_aufheiz" VALUE 0x79A20 TKW_VV_VV_SW 100.0 FORMULA_0076 -1000.0000 1000.0000 FORMAT "%4.1" /end CHARACTERISTIC
/begin CHARACTERISTIC K_TOEL_MODELL_T_MS "Schwelle Motor steht" VALUE 0x79A22 TKW_VV_VV_UW 100.0 FORMULA_0986 0.0167 1092.2500 FORMAT "%5.2" /end CHARACTERISTIC
/begin CHARACTERISTIC K_TOEL_MODELL_TMOT_GRD_F "toel_modell-Gradient f(Kuehlwassertemp.)" VALUE 0x79A24 TKW_VV_VV_SW 100.0 FORMULA_0497 0.0 1.0000 FORMAT "%5.2" /end CHARACTERISTIC
/begin CHARACTERISTIC KL_TOEL_MODELL_N "n-Einfluss Motorreibung" CURVE 0x79A26 TKL_SW_VV_SW 100.0 FORMULA_1023 0.0 0.0600 /begin AXIS_DESCR STD_AXIS Motordrehzahl FORMULA_0006 6 0.0 10000.0000 /end AXIS_DESCR FORMAT "%7.4" /end CHARACTERISTIC
/begin CHARACTERISTIC KL_TOEL_MODELL_DN "gefilterter n-Einfluss Motorreibung" CURVE 0x79A40 TKL_SW_VV_SW 100.0 FORMULA_1023 -0.0400 0.0400 /begin AXIS_DESCR STD_AXIS n FORMULA_0006 6 -10000.0000 10000.0000 /end AXIS_DESCR FORMAT "%7.4" /end CHARACTERISTIC
/begin CHARACTERISTIC KF_TOEL_MODELL_V_TAN_MW "Oelkuehlungsoffset" MAP 0x79A5A TKF_SW_SW_SW 100.0 FORMULA_0076 -50.0000 50.0000
 /begin AXIS_DESCR STD_AXIS v_hinten FORMULA_0078 7 -80.0000 360.0000 FORMAT "%4.1" /end AXIS_DESCR
 /begin AXIS_DESCR STD_AXIS tan_mw FORMULA_0023 7 -50.0000 170.0000 FORMAT "%4.1" /end AXIS_DESCR
 FORMAT "%4.1" /end CHARACTERISTIC
/begin CHARACTERISTIC KF_TOEL_MODELL_WICHT "Wichtungsfaktor toel_modell_kalt" MAP 0x79ADA TKF_SW_SW_UW 100.0 FORMULA_1025 0.0 100.0000
 /begin AXIS_DESCR STD_AXIS toel_modell_lm FORMULA_1026 6 0.0 63.9980 FORMAT "%6.3" /end AXIS_DESCR
 /begin AXIS_DESCR STD_AXIS zust_tmot_start FORMULA_0023 6 -50.0000 170.0000 FORMAT "%4.1" /end AXIS_DESCR
 FORMAT "%5.2" /end CHARACTERISTIC
/begin MEASUREMENT toel_modell_lm "verbrauchte Luftmasse im DCY bis Rechenanschlag" SWORD FORMULA_1026 0 0 0.0 63.9980 ECU_ADDRESS 0x3FC488 /end MEASUREMENT
/begin MEASUREMENT toel_modell_dt "Summe Toel-Gradient" SWORD FORMULA_1023 0 0 -3.0000 3.0000 ECU_ADDRESS 0x3FC48A /end MEASUREMENT
/begin MEASUREMENT toel_modell_dt_dn "Toel-Gradient aus dn" SWORD FORMULA_1023 0 0 -3.0000 3.0000 ECU_ADDRESS 0x3FC48C /end MEASUREMENT
/begin MEASUREMENT toel_modell_dt_n "Toel-Gradient aus n" SWORD FORMULA_1023 0 0 -3.0000 3.0000 ECU_ADDRESS 0x3FC48E /end MEASUREMENT
/begin MEASUREMENT toel_modell_dt_tmot "Toel-Gradient aus tmot" SWORD FORMULA_1023 0 0 -3.0000 3.0000 ECU_ADDRESS 0x3FC490 /end MEASUREMENT
/begin MEASUREMENT toel_modell_n_filt "PT1-gefilterte Motordrehzahl" SWORD FORMULA_0006 0 0 0.0 10000.0000 ECU_ADDRESS 0x3FC492 /end MEASUREMENT
/begin MEASUREMENT toel_modell_kalt "begrenzte Oeltemperatur aus Aufheizmodell" SLONG FORMULA_1022 0 0 -50.0000 150.0000 ECU_ADDRESS 0x3FC494 /end MEASUREMENT
/begin MEASUREMENT toel_modell_wr_abst "Oeltemperatur im Abstellen speichern" UBYTE FORMULA_0003 0 0 0.0 255.0000 ECU_ADDRESS 0x3FC498 /end MEASUREMENT
/begin MEASUREMENT toel_modell_start "Oeltemperaturmodell im Start" SWORD FORMULA_0023 0 0 -50.0000 170.0000 ECU_ADDRESS 0x3FC49A /end MEASUREMENT
/begin MEASUREMENT toel_modell_warm "Oeltemperatur aus Heiszmodell" SWORD FORMULA_0023 0 0 -50.0000 170.0000 ECU_ADDRESS 0x3FC49C /end MEASUREMENT
/begin MEASUREMENT toel_modell_aufwaerm "Neue Soll-Oeltemperatur (vor Begrenzung)" SWORD FORMULA_0023 0 0 -50.0000 170.0000 ECU_ADDRESS 0x3FC49E /end MEASUREMENT
/* ------------------ Abschnitt erzeugt aus tumg.dat ------------------ */
/begin CHARACTERISTIC K_TUMG_OBD_CFG "Schalter Diagnose-Art | EN: 0x00 OBD aus 0x01 OBD kont i- nuierlich 0x02 OBD ei n- malig Schalter Diagnose-Art" VALUE 0x79B74 TKW_VV_VV_UB 100.0 FORMULA_1034 0.0 255.0 /end CHARACTERISTIC
/begin CHARACTERISTIC K_TUMG_OBD_T_POWER_ON "Wartezeit nach Power On | EN: Wartezeit nach Power On" VALUE 0x79B76 TKW_VV_VV_UW 100.0 FORMULA_0021 0.0 655.0000 FORMAT "%5.2" /end CHARACTERISTIC
/begin CHARACTERISTIC K_TUMG_OBD_ML_SUM_MIN "min. Integral-ML-Strom seit Start Modellberechung" VALUE 0x79B78 TKW_VV_VV_SW 100.0 FORMULA_0112 -100.0000 1400.0000 FORMAT "%4.1" /end CHARACTERISTIC
/begin CHARACTERISTIC K_TUMG_OBD_N_MIN "min. Motordrehzahl fuer Modellberechnung" VALUE 0x79B7A TKW_VV_VV_SW 100.0 FORMULA_0006 0.0 10000.0000 /end CHARACTERISTIC
/begin CHARACTERISTIC K_TUMG_OBD_TMOT_MIN "Mindest-Motortemperatur fuer Diagnose" VALUE 0x79B7C TKW_VV_VV_SW 100.0 FORMULA_0023 -50.0000 170.0000 FORMAT "%4.1" /end CHARACTERISTIC
/begin CHARACTERISTIC K_TUMG_OBD_V_MIN "min. Fahrzeuggeschwindigkeit fuer Modellberechnung" VALUE 0x79B7E TKW_VV_VV_SW 100.0 FORMULA_0078 -80.0000 360.0000 FORMAT "%4.1" /end CHARACTERISTIC
/begin CHARACTERISTIC K_TUMG_OBD_V_MAX "max. Fahrzeuggeschwindigkeit fuer Modellberechnung" VALUE 0x79B80 TKW_VV_VV_SW 100.0 FORMULA_0078 -80.0000 360.0000 FORMAT "%4.1" /end CHARACTERISTIC
/begin CHARACTERISTIC K_TUMG_OBD_ML_MIN "min. Luftmassenstrom fuer Modellberechnung" VALUE 0x79B82 TKW_VV_VV_SW 100.0 FORMULA_0112 -100.0000 1400.0000 FORMAT "%4.1" /end CHARACTERISTIC
/begin CHARACTERISTIC K_TUMG_OBD_ML_MAX "max. Luftmassenstrom fuer Modellberechnung" VALUE 0x79B84 TKW_VV_VV_SW 100.0 FORMULA_0112 -100.0000 1400.0000 FORMAT "%4.1" /end CHARACTERISTIC
/begin CHARACTERISTIC K_TUMG_OBD_TAN_MAX "max. zulaessige Ansaugtemperatur fuer Modellfreigabe" VALUE 0x79B86 TKW_VV_VV_SW 100.0 FORMULA_0023 -50.0000 170.0000 FORMAT "%4.1" /end CHARACTERISTIC
/begin CHARACTERISTIC K_TUMG_OBD_TKA_MIN "min. Kuehleraustrittstemperatur fuer Modellfreigabe" VALUE 0x79B88 TKW_VV_VV_SW 100.0 FORMULA_0023 -50.0000 170.0000 FORMAT "%4.1" /end CHARACTERISTIC
/begin CHARACTERISTIC K_TUMG_OBD_TIME_ML_MIN "min. Motorlaufzeit fuer stabile Bedingungen | EN: min. Motorlaufzeit fuer stabile B e-dingungen" VALUE 0x79B8A TKW_VV_VV_UW 100.0 FORMULA_0062 0.0 65535.0000 /end CHARACTERISTIC
/begin CHARACTERISTIC K_TUMG_OBD_TIME_MS_MIN "min. Motorstandzeit fuer Kaltstarterkennung | EN: min. Motorstandzeit fuer Kaltstarte r-kennung" VALUE 0x79B8C TKW_VV_VV_UW 100.0 FORMULA_0627 0.0 1092.2500 /end CHARACTERISTIC
/begin CHARACTERISTIC K_TUMG_OBD_TMOT_START_MAX "max. Motortemperatur bei Start der Kaltstarterkennung | EN: max. Motortemperatur bei Start der Kaltstarterkennung" VALUE 0x79B8E TKW_VV_VV_SW 100.0 FORMULA_0023 -50.0000 170.0000 FORMAT "%4.1" /end CHARACTERISTIC
/begin CHARACTERISTIC K_TUMG_OBD_TMOT_TAN_DELTA_MAX "max. Differenz zwischen tmot und tan fuer Kaltstart | EN: max. Differenz zwischen tmot und tan fuer Kaltstart" VALUE 0x79B90 TKW_VV_VV_SW 100.0 FORMULA_0076 -1000.0000 1000.0000 FORMAT "%4.1" /end CHARACTERISTIC
/begin CHARACTERISTIC K_TUMG_OBD_TAN_MIN "min. tan fuer Kaltstarterkennung" VALUE 0x79B92 TKW_VV_VV_SW 100.0 FORMULA_0023 -50.0000 170.0000 FORMAT "%4.1" /end CHARACTERISTIC
/begin CHARACTERISTIC K_TUMG_OBD_TMOT_KALT_MAX "max. Motortemperatur fuer Kaltstarterkennung | EN: max. Motortemperatur fuer Kaltsta r-terkennung" VALUE 0x79B94 TKW_VV_VV_SW 100.0 FORMULA_0023 -50.0000 170.0000 FORMAT "%4.1" /end CHARACTERISTIC
/begin CHARACTERISTIC K_TUMG_OBD_ML_TMOT_ZK "Tau fuer tumg_obd_model_offset1" VALUE 0x79B96 TKW_VV_VV_UW 100.0 FORMULA_0988 0.1000 6553.5000 FORMAT "%5.2" /end CHARACTERISTIC
/begin CHARACTERISTIC K_TUMG_OBD_MODEL_DELTA_MIN "min. Toleranz zwischen tumg und Modelltemperatur | EN: min. Toleranz zwischen tumg und Modelltemperatur" VALUE 0x79B98 TKW_VV_VV_SW 100.0 FORMULA_0076 -1000.0000 1000.0000 FORMAT "%4.1" /end CHARACTERISTIC
/begin CHARACTERISTIC K_TUMG_OBD_MODEL_DELTA_MAX "max. Toleranz zwischen tumg und Modelltemperatur | EN: max. Toleranz zwischen tumg und Modelltemperatur" VALUE 0x79B9A TKW_VV_VV_SW 100.0 FORMULA_0076 -1000.0000 1000.0000 FORMAT "%4.1" /end CHARACTERISTIC
/begin CHARACTERISTIC K_TUMG_OBD_TIME_SA_MAX "Zeit seit SA" VALUE 0x79B9C TKW_VV_VV_UL 100.0 FORMULA_0152 0.0 655.0000 FORMAT "%5.2" /end CHARACTERISTIC
/begin CHARACTERISTIC K_TUMG_OBD_MODEL_TAU "Tau fuer tumg_obd_model pt1-Filterung" VALUE 0x79BA0 TKW_VV_VV_UW 100.0 FORMULA_0988 0.1000 6553.5000 FORMAT "%5.2" /end CHARACTERISTIC
/begin CHARACTERISTIC K_TUMG_OBD_TAN_SLOW_TAU "Tau fuer pt1-Filterung von tan" VALUE 0x79BA2 TKW_VV_VV_UW 100.0 FORMULA_0988 0.1000 6553.5000 FORMAT "%5.2" /end CHARACTERISTIC
/begin CHARACTERISTIC K_TUMG_OBD_TAN_FAST_TAU "Tau fuer pt1-Filterung von tan" VALUE 0x79BA4 TKW_VV_VV_UW 100.0 FORMULA_0988 0.1000 6553.5000 FORMAT "%5.2" /end CHARACTERISTIC
/begin CHARACTERISTIC K_TUMG_OBD_TAN_FIL_DELTA_MAX "max. Delta zwischen tan-Filterwerten" VALUE 0x79BA6 TKW_VV_VV_SW 100.0 FORMULA_0076 -1000.0000 1000.0000 FORMAT "%4.1" /end CHARACTERISTIC
/begin CHARACTERISTIC KL_TUMG_OBD_V "Tau fuer tumg_obd_model_offset2 | EN: Time constant for tumg_obd_model_offset2" CURVE 0x79BA8 TKL_SW_VV_UW 100.0 FORMULA_0988 0.1000 6553.5000
 /begin AXIS_DESCR STD_AXIS v_vorne FORMULA_0078 8 -80.0000 360.0000 FORMAT "%4.1" /end AXIS_DESCR
 FORMAT "%5.2" /end CHARACTERISTIC
/begin CHARACTERISTIC KL_TUMG_OBD_MOD_TIME_ML_MIN "min. Motorlaufzeit fuer stabile Bedingungen" CURVE 0x79BCA TKL_SW_VV_UW 100.0 FORMULA_0062 0.0 65535.0000
 /begin AXIS_DESCR STD_AXIS zust_tmot_start FORMULA_0023 4 -50.0000 170.0000 FORMAT "%4.1" /end AXIS_DESCR
/end CHARACTERISTIC
/begin CHARACTERISTIC KL_TUMG_OBD_MAX_ERROR "Zaehler fuer Fehlerentprellung" CURVE 0x79BDC TKL_SW_VV_UB 100.0 FORMULA_0003 0.0 255.0000
 /begin AXIS_DESCR STD_AXIS tumg_obd_tan_filter_delta FORMULA_0076 2 -1000.0000 1000.0000 FORMAT "%4.1" /end AXIS_DESCR
/end CHARACTERISTIC
/begin CHARACTERISTIC KF_TUMG_OBD_MODEL_UPDATE_T_MIN "zeitliche Entprellung fuer Modellberechnung" MAP 0x79BE4 TKF_SW_SW_UW 100.0 FORMULA_0073 0.0 6553.5000
 /begin AXIS_DESCR STD_AXIS tumg_obd_abs_diff FORMULA_0076 6 -1000.0000 1000.0000 FORMAT "%4.1" /end AXIS_DESCR
 /begin AXIS_DESCR STD_AXIS tumg_obd_ml_mw FORMULA_0112 3 -100.0000 1400.0000 FORMAT "%4.1" /end AXIS_DESCR
 FORMAT "%4.1" /end CHARACTERISTIC
/begin CHARACTERISTIC KF_TUMG_OBD_TMOT_ML "tumg_obd-Kennfeld tmot-ml-Offset" MAP 0x79C1C TKF_SW_SW_SW 100.0 FORMULA_0076 -1000.0000 1000.0000
 /begin AXIS_DESCR STD_AXIS ml_b2 FORMULA_0112 7 -100.0000 1400.0000 FORMAT "%4.1" /end AXIS_DESCR
 /begin AXIS_DESCR STD_AXIS tmot FORMULA_0023 8 -50.0000 170.0000 FORMAT "%4.1" /end AXIS_DESCR
 FORMAT "%4.1" /end CHARACTERISTIC
/begin CHARACTERISTIC KF_TUMG_OBD_TKA_V "tumg_obd-Kennfeld tka-v-Offset" MAP 0x79CAC TKF_SW_SW_SW 100.0 FORMULA_0076 -1000.0000 1000.0000
 /begin AXIS_DESCR STD_AXIS v_vorne FORMULA_0078 8 -80.0000 360.0000 FORMAT "%4.1" /end AXIS_DESCR
 /begin AXIS_DESCR STD_AXIS tka FORMULA_0023 9 -50.0000 170.0000 FORMAT "%4.1" /end AXIS_DESCR
 FORMAT "%4.1" /end CHARACTERISTIC
/begin MEASUREMENT tumg_obd_st "Steuervariable fuer Diagnose" UBYTE FORMULA_1031 0 0 0.0 255.0 ECU_ADDRESS 0x3FC4C4 /end MEASUREMENT
/begin MEASUREMENT tumg_obd_freigabe_st "Freigabestatus fuer Modell" UBYTE FORMULA_1032 0 0 0.0 255.0 ECU_ADDRESS 0x3FC4C5 /end MEASUREMENT
/begin MEASUREMENT tumg_obd_timer "Filterzeit Modellfreigabe" UWORD FORMULA_0073 0 0 0.0 6553.5000 ECU_ADDRESS 0x3FC4C6 /end MEASUREMENT
/begin MEASUREMENT tumg_obd_ml_mw "Luftmasse Mittelwert" SWORD FORMULA_0112 0 0 -100.0000 1400.0000 ECU_ADDRESS 0x3FC4C8 /end MEASUREMENT
/begin MEASUREMENT tumg_obd_diag_st "Diagnoseart Modell oder Kaltstart" UBYTE FORMULA_1033 0 0 0.0 255.0 ECU_ADDRESS 0x3FC4CA /end MEASUREMENT
/begin MEASUREMENT tumg_obd_model_offset1 "Offset 1 aus KF_TUMG_OBD_TMOT_ML fuer tumg_obd_model" SWORD FORMULA_0076 0 0 -1000.0000 1000.0000 ECU_ADDRESS 0x3FC4CC /end MEASUREMENT
/begin MEASUREMENT tumg_obd_model_offset2 "Offset 2 aus KF_TUMG_OBD_TKA_V fuer tumg_obd_model" SWORD FORMULA_0076 0 0 -1000.0000 1000.0000 ECU_ADDRESS 0x3FC4D4 /end MEASUREMENT
/begin MEASUREMENT tumg_obd_model "tumg Modellwert" SWORD FORMULA_0023 0 0 -50.0000 170.0000 ECU_ADDRESS 0x3FC4DC /end MEASUREMENT
/begin MEASUREMENT tumg_obd_model_delta "Abweichung absolut tumg zu tumg_diag_model" SWORD FORMULA_0076 0 0 -1000.0000 1000.0000 ECU_ADDRESS 0x3FC4E4 /end MEASUREMENT
/begin MEASUREMENT tumg_obd_output "tumg nach Diagnose" SWORD FORMULA_0023 0 0 -50.0000 170.0000 ECU_ADDRESS 0x3FC4E6 /end MEASUREMENT
/begin MEASUREMENT tumg_obd_error_counter "Zaehler fuer Fehlerentprellung" UBYTE FORMULA_0003 0 0 0.0 255.0000 ECU_ADDRESS 0x3FC4E8 /end MEASUREMENT
/begin MEASUREMENT tumg_obd_ok_counter "Zaehler fuer ok-Entprellung" UBYTE FORMULA_0003 0 0 0.0 255.0000 ECU_ADDRESS 0x3FC4E9 /end MEASUREMENT
/begin MEASUREMENT tumg_obd_tan_abstell "tan bei Start bzw. letzter gueltiger Freigabe" SWORD FORMULA_0023 0 0 -50.0000 170.0000 ECU_ADDRESS 0x3FC4EA /end MEASUREMENT
/begin MEASUREMENT tumg_obd_tan_slow "tan-Filterwert fuer Delta zu tumg_obd_tan_abstell" SWORD FORMULA_0023 0 0 -50.0000 170.0000 ECU_ADDRESS 0x3FC4EC /end MEASUREMENT
/begin MEASUREMENT tumg_obd_tan_fast "tan-Filterwert fuer tumg-Modellfreigabe" SWORD FORMULA_0023 0 0 -50.0000 170.0000 ECU_ADDRESS 0x3FC4F4 /end MEASUREMENT
/* ------------------ Abschnitt erzeugt aus zoelp.dat ------------------ */
/begin CHARACTERISTIC K_ZOELP_CFG "Konfig ZOELP | EN: Konfig ZOELP" VALUE 0x7A522 TKW_VV_VV_UB 100.0 FORMULA_1064 0.0 255.0 /end CHARACTERISTIC
/begin CHARACTERISTIC K_ZOELP_AN "Querbeschleunigungsschwelle fuer OELP an | EN: Querbeschleunigungsschwelle fuer OELP an" VALUE 0x7A524 TKW_VV_VV_SW 100.0 FORMULA_0132 -20.0000 20.0000 FORMAT "%5.2" /end CHARACTERISTIC
/begin CHARACTERISTIC K_ZOELP_HYS "Querbeschleunigungshysterese fuer OELP an | EN: Querbeschleunigungshysterese fuer OELP an" VALUE 0x7A526 TKW_VV_VV_SW 100.0 FORMULA_0132 -20.0000 20.0000 FORMAT "%5.2" /end CHARACTERISTIC
/begin CHARACTERISTIC K_ZOELP_UM "Vorzeichenumkehr fuer can_ay | EN: Vorzeichenumkehr fuer can_ay" VALUE 0x7A528 TKW_VV_VV_SB 100.0 FORMULA_1065 -128.0 127.0 /end CHARACTERISTIC
/begin CHARACTERISTIC K_ZOELP_MAN_T_AN "ZOELP an Zeit im manuellem Betrieb | EN: ZOELP an Zeit im manuellem Betrieb" VALUE 0x7A529 TKW_VV_VV_UB 100.0 FORMULA_0501 0.0 25.5000 /end CHARACTERISTIC
/begin CHARACTERISTIC K_ZOELP_MAN_T_AUS "ZOELP aus Zeit im manuellem Betrieb | EN: ZOELP aus Zeit im manuellem Betrieb" VALUE 0x7A52A TKW_VV_VV_UB 100.0 FORMULA_0501 0.0 25.5000 /end CHARACTERISTIC
/begin CHARACTERISTIC K_ZOELP_FG_T_AN "Freigaengigkeits Anzeit | EN: Freigaengigkeits Anzeit" VALUE 0x7A52B TKW_VV_VV_UB 100.0 FORMULA_0501 0.0 25.5000 /end CHARACTERISTIC
/begin CHARACTERISTIC K_ZOELP_FG_T_AUS "Freigaengigkeits Auszeit | EN: Freigaengigkeits Auszeit" VALUE 0x7A52C TKW_VV_VV_UW 100.0 FORMULA_0073 0.0 6553.5000 FORMAT "%4.1" /end CHARACTERISTIC
/begin CHARACTERISTIC K_ZOELP_DIAG_TIME_WAIT "Wartezeit der Diagnose nach Pumpe an | EN: Wartezeit der Diagnose nach Pumpe an" VALUE 0x7A52E TKW_VV_VV_UB 100.0 FORMULA_0501 0.0 25.5000 /end CHARACTERISTIC
/begin CHARACTERISTIC K_ZOELP_TOEL "Freigaengigkeits und Diagnose-Schwelle abh. von toel | EN: Freigaengigkeits und Diagnose-Schwelle abh. von toel" VALUE 0x7A530 TKW_VV_VV_SW 100.0 FORMULA_0023 -50.0000 170.0000 FORMAT "%4.1" /end CHARACTERISTIC
/begin CHARACTERISTIC K_ZOELP_FG_N "Freigaengigkeits Schwelle abh. von n | EN: Freigaengigkeits Schwelle abh. von n" VALUE 0x7A532 TKW_VV_VV_SW 100.0 FORMULA_0006 0.0 10000.0000 /end CHARACTERISTIC
/begin CHARACTERISTIC K_ZOELP_DIAG_KURZSCHLUSS "Pumpenstromschwelle fuer Kurzschluss | EN: Pumpenstromschwelle fuer Kurzschluss" VALUE 0x7A534 TKW_VV_VV_UB 100.0 FORMULA_1063 0.0 25.0000 /end CHARACTERISTIC
/begin CHARACTERISTIC K_ZOELP_DIAG_KLEMMEN "Pumpenstromschwelle fuer Klemmen | EN: Pumpenstromschwelle fuer Klemmen" VALUE 0x7A535 TKW_VV_VV_UB 100.0 FORMULA_1063 0.0 25.0000 /end CHARACTERISTIC
/begin CHARACTERISTIC K_ZOELP_DIAG_KABELBRUCH "Pumpenstromschwelle fuer Kabelbruch (Openload) | EN: Pumpenstromschwelle fuer Kabelbruch (Openload)" VALUE 0x7A536 TKW_VV_VV_UB 100.0 FORMULA_1063 0.0 25.0000 /end CHARACTERISTIC
/begin MEASUREMENT zoelp_st_b1 "Zusatzoelpumpenstatus" UBYTE FORMULA_1062 0 0 0.0 255.0 ECU_ADDRESS 0x3FC71C /end MEASUREMENT
/begin MEASUREMENT zoelp_st_b2 "Zusatzoelpumpenstatus" UBYTE FORMULA_1062 0 0 0.0 255.0 ECU_ADDRESS 0x3FC71D /end MEASUREMENT
/begin MEASUREMENT zoelp_fg_timer "Timer fuer den Freigraengigkeitsschutz" UWORD FORMULA_0073 0 0 0.0 6553.5000 ECU_ADDRESS 0x3FC71E /end MEASUREMENT
/begin MEASUREMENT zoelp_time_on_1of2_ "Zeit fuer Pumpe an" UWORD FORMULA_0073 0 0 0.0 6553.5000 ECU_ADDRESS 0x3FC720 /end MEASUREMENT
/begin MEASUREMENT zoelp_time_on_2of2_ "Zeit fuer Pumpe an" UWORD FORMULA_0073 0 0 0.0 6553.5000 ECU_ADDRESS 0x3FC722 /end MEASUREMENT
/begin MEASUREMENT zoelp_exd_timeout "Timer fuer die Tester Ansteuerung" UBYTE FORMULA_0501 0 0 0.0 25.5000 ECU_ADDRESS 0x3FC724 /end MEASUREMENT
/begin MEASUREMENT zoelp_i_ad_b1 "AD-Wert der Strommessung" SWORD FORMULA_0123 0 0 0.0 1023.0000 ECU_ADDRESS 0x3FC726 /end MEASUREMENT
/begin MEASUREMENT zoelp_i_ad_b2 "AD-Wert der Strommessung" SWORD FORMULA_0123 0 0 0.0 1023.0000 ECU_ADDRESS 0x3FC728 /end MEASUREMENT
/begin MEASUREMENT zoelp_i_roh_b1 "Pumpenstrom" UBYTE FORMULA_1063 0 0 0.0 25.0000 ECU_ADDRESS 0x3FC72A /end MEASUREMENT
/begin MEASUREMENT zoelp_i_roh_b2 "Pumpenstrom" UBYTE FORMULA_1063 0 0 0.0 25.0000 ECU_ADDRESS 0x3FC72B /end MEASUREMENT
/begin FUNCTION mzyl_sek ""
 /begin DEF_CHARACTERISTIC KF_MZYL_SEK_MVAC_AQ_ABS KL_MZYL_SEK_MVAC_N_FAK K_MZYL_SEK_AQ_ABS_SSP K_MZYL_SEK_MVAC_ABREG K_MZYL_SEK_MVAC_BANK_FAK_1of2_ K_MZYL_SEK_MVAC_BANK_FAK_2of2_ K_MZYL_SEK_SSP_BANK_FAK_1of2_ K_MZYL_SEK_SSP_BANK_FAK_2of2_ K_MZYL_SEK_SSP_DIAG_CFG /end DEF_CHARACTERISTIC
 /begin REF_CHARACTERISTIC /end REF_CHARACTERISTIC
 /begin IN_MEASUREMENT /end IN_MEASUREMENT
 /begin OUT_MEASUREMENT mzyl_sek_aq_mvac_1of2_ mzyl_sek_aq_mvac_2of2_ mzyl_sek_aq_mvac_roh mzyl_sek_aq_ssp_1of2_ mzyl_sek_aq_ssp_2of2_ mzyl_sek_aq_ssp_roh mzyl_sek_mvac_fak /end OUT_MEASUREMENT
/end FUNCTION
/begin FUNCTION qadc_conf "" /begin DEF_CHARACTERISTIC /end DEF_CHARACTERISTIC /begin REF_CHARACTERISTIC /end REF_CHARACTERISTIC /begin IN_MEASUREMENT /end IN_MEASUREMENT /begin OUT_MEASUREMENT qadc_check_ccw_adr qadc_check_ccw_st qadc_err_cnt /end OUT_MEASUREMENT /end FUNCTION
/begin FUNCTION sl_zwd "" /begin DEF_CHARACTERISTIC K_SL_ZWD_TV_MAX K_SL_ZWD_TV_MIN K_SL_ZWD_TV_SLP_TEST /end DEF_CHARACTERISTIC /begin REF_CHARACTERISTIC /end REF_CHARACTERISTIC /begin IN_MEASUREMENT /end IN_MEASUREMENT /begin OUT_MEASUREMENT sl_zwd_st sl_zwd_tv_tpu /end OUT_MEASUREMENT /end FUNCTION
/begin FUNCTION spi "" /begin DEF_CHARACTERISTIC /end DEF_CHARACTERISTIC /begin REF_CHARACTERISTIC /end REF_CHARACTERISTIC /begin IN_MEASUREMENT /end IN_MEASUREMENT
 /begin OUT_MEASUREMENT spim_errorcode spim_errorcounter spim_reqcounter spim_status /end OUT_MEASUREMENT
/end FUNCTION
/begin FUNCTION toel_modell ""
 /begin DEF_CHARACTERISTIC KF_TOEL_MODELL_V_TAN_MW KF_TOEL_MODELL_WICHT KL_TOEL_MODELL_DN KL_TOEL_MODELL_N K_TOEL_MODELL_AEBEGR K_TOEL_MODELL_BEGR_OFFS K_TOEL_MODELL_LM_INTEGRATOR_DT K_TOEL_MODELL_N_T1 K_TOEL_MODELL_TMOT_GRD_F K_TOEL_MODELL_T_MS /end DEF_CHARACTERISTIC
 /begin REF_CHARACTERISTIC /end REF_CHARACTERISTIC
 /begin IN_MEASUREMENT /end IN_MEASUREMENT
 /begin OUT_MEASUREMENT toel_modell_aufwaerm toel_modell_dt toel_modell_dt_dn toel_modell_dt_n toel_modell_dt_tmot toel_modell_kalt toel_modell_lm toel_modell_n_filt toel_modell_start toel_modell_warm toel_modell_wr_abst /end OUT_MEASUREMENT
/end FUNCTION
/begin FUNCTION tumg-Diagnose ""
 /begin DEF_CHARACTERISTIC KF_TUMG_OBD_MODEL_UPDATE_T_MIN KF_TUMG_OBD_TKA_V KF_TUMG_OBD_TMOT_ML KL_TUMG_OBD_MAX_ERROR KL_TUMG_OBD_MOD_TIME_ML_MIN KL_TUMG_OBD_V K_TUMG_OBD_CFG K_TUMG_OBD_ML_MAX K_TUMG_OBD_ML_MIN K_TUMG_OBD_ML_SUM_MIN K_TUMG_OBD_ML_TMOT_ZK K_TUMG_OBD_MODEL_DELTA_MAX K_TUMG_OBD_MODEL_DELTA_MIN K_TUMG_OBD_MODEL_TAU K_TUMG_OBD_N_MIN K_TUMG_OBD_TAN_FAST_TAU K_TUMG_OBD_TAN_FIL_DELTA_MAX K_TUMG_OBD_TAN_MAX K_TUMG_OBD_TAN_MIN K_TUMG_OBD_TAN_SLOW_TAU K_TUMG_OBD_TIME_ML_MIN K_TUMG_OBD_TIME_MS_MIN K_TUMG_OBD_TIME_SA_MAX K_TUMG_OBD_TKA_MIN K_TUMG_OBD_TMOT_KALT_MAX K_TUMG_OBD_TMOT_MIN K_TUMG_OBD_TMOT_START_MAX K_TUMG_OBD_TMOT_TAN_DELTA_MAX K_TUMG_OBD_T_POWER_ON K_TUMG_OBD_V_MAX K_TUMG_OBD_V_MIN /end DEF_CHARACTERISTIC
 /begin REF_CHARACTERISTIC /end REF_CHARACTERISTIC
 /begin IN_MEASUREMENT /end IN_MEASUREMENT
 /begin OUT_MEASUREMENT tumg_obd_diag_st tumg_obd_error_counter tumg_obd_freigabe_st tumg_obd_ml_mw tumg_obd_model tumg_obd_model_delta tumg_obd_model_offset1 tumg_obd_model_offset2 tumg_obd_ok_counter tumg_obd_output tumg_obd_st tumg_obd_tan_abstell tumg_obd_tan_fast tumg_obd_tan_slow tumg_obd_timer /end OUT_MEASUREMENT
/end FUNCTION
/begin FUNCTION zoelp ""
 /begin DEF_CHARACTERISTIC K_ZOELP_AN K_ZOELP_CFG K_ZOELP_DIAG_KABELBRUCH K_ZOELP_DIAG_KLEMMEN K_ZOELP_DIAG_KURZSCHLUSS K_ZOELP_DIAG_TIME_WAIT K_ZOELP_FG_N K_ZOELP_FG_T_AN K_ZOELP_FG_T_AUS K_ZOELP_HYS K_ZOELP_MAN_T_AN K_ZOELP_MAN_T_AUS K_ZOELP_TOEL K_ZOELP_UM /end DEF_CHARACTERISTIC
 /begin REF_CHARACTERISTIC /end REF_CHARACTERISTIC
 /begin IN_MEASUREMENT /end IN_MEASUREMENT
 /begin OUT_MEASUREMENT zoelp_exd_timeout zoelp_fg_timer zoelp_i_ad_b1 zoelp_i_ad_b2 zoelp_i_roh_b1 zoelp_i_roh_b2 zoelp_st_b1 zoelp_st_b2 zoelp_time_on_1of2_ zoelp_time_on_2of2_ /end OUT_MEASUREMENT
/end FUNCTION
/begin RECORD_LAYOUT TKW_VV_VV_UB FNC_VALUES 1 UBYTE COLUMN_DIR DIRECT /end RECORD_LAYOUT
/begin RECORD_LAYOUT TKW_VV_VV_SB FNC_VALUES 1 SBYTE COLUMN_DIR DIRECT /end RECORD_LAYOUT
/begin RECORD_LAYOUT TKW_VV_VV_UW FNC_VALUES 1 UWORD COLUMN_DIR DIRECT /end RECORD_LAYOUT
/begin RECORD_LAYOUT TKW_VV_VV_SW FNC_VALUES 1 SWORD COLUMN_DIR DIRECT /end RECORD_LAYOUT
/begin RECORD_LAYOUT TKW_VV_VV_UL FNC_VALUES 1 ULONG COLUMN_DIR DIRECT /end RECORD_LAYOUT
/begin RECORD_LAYOUT TKL_SW_VV_UB NO_AXIS_PTS_X 1 UBYTE RESERVED 2 BYTE AXIS_PTS_X 3 SWORD INDEX_INCR DIRECT FNC_VALUES 4 UBYTE COLUMN_DIR DIRECT /end RECORD_LAYOUT
/begin RECORD_LAYOUT TKL_SW_VV_UW NO_AXIS_PTS_X 1 UBYTE RESERVED 2 BYTE AXIS_PTS_X 3 SWORD INDEX_INCR DIRECT FNC_VALUES 4 UWORD COLUMN_DIR DIRECT /end RECORD_LAYOUT
/begin RECORD_LAYOUT TKL_SW_VV_SW NO_AXIS_PTS_X 1 UBYTE RESERVED 2 BYTE AXIS_PTS_X 3 SWORD INDEX_INCR DIRECT FNC_VALUES 4 SWORD COLUMN_DIR DIRECT /end RECORD_LAYOUT
/begin RECORD_LAYOUT TKF_SW_SW_UW NO_AXIS_PTS_X 1 UBYTE NO_AXIS_PTS_Y 2 UBYTE AXIS_PTS_X 3 SWORD INDEX_INCR DIRECT AXIS_PTS_Y 4 SWORD INDEX_INCR DIRECT FNC_VALUES 5 UWORD COLUMN_DIR DIRECT /end RECORD_LAYOUT
/begin RECORD_LAYOUT TKF_SW_SW_SW NO_AXIS_PTS_X 1 UBYTE NO_AXIS_PTS_Y 2 UBYTE AXIS_PTS_X 3 SWORD INDEX_INCR DIRECT AXIS_PTS_Y 4 SWORD INDEX_INCR DIRECT FNC_VALUES 5 SWORD COLUMN_DIR DIRECT /end RECORD_LAYOUT
/* ---- V452-specific parameters (names assigned during V452 reverse engineering) ---- */
/begin CHARACTERISTIC K_N_GETR_HS_DIAG_ABTR_MIN "[V452-new, name assigned] Gearbox input speed diagnosis (fn 0x556D4): release only if n_getr_abtrieb >= this value" VALUE 0x786A8 TKW_VV_VV_SW 12000.0 FORMULA_0006 -12000.0000 12000.0000 /end CHARACTERISTIC
/begin CHARACTERISTIC K_N_GETR_HS_DIAG_N_MAX "[V452-new, name assigned] Gearbox input speed diagnosis (fn 0x556D4): release only if engine speed n <= this value" VALUE 0x786AA TKW_VV_VV_SW 12000.0 FORMULA_0006 -12000.0000 12000.0000 /end CHARACTERISTIC
/* ---- added 04.11.2026: further code-read calibration ---- */
/begin CHARACTERISTIC UNK_SK_SELFTEST_KL_08894 "Safety-concept lookup self-test reference table (fixed test vectors from ROM). Not tuning data - DO NOT MODIFY. [Added V452 04.11.2026]" CURVE 0x78894 TKL_SW_VV_SW 32767.0 FORMULA_USER1 -32768.0 32767.0
 /begin AXIS_DESCR STD_AXIS NO_INPUT_QUANTITY FORMULA_USER1 5 -32768.0 32767.0 /end AXIS_DESCR
/end CHARACTERISTIC
/begin CHARACTERISTIC UNK_SK_SELFTEST_KF_088AA "Safety-concept lookup self-test reference table (fixed test vectors from ROM). Not tuning data - DO NOT MODIFY. [Added V452 04.11.2026]" MAP 0x788AA TKF_SW_SW_SW 32767.0 FORMULA_USER1 -32768.0 32767.0
 /begin AXIS_DESCR STD_AXIS NO_INPUT_QUANTITY FORMULA_USER1 4 -32768.0 32767.0 /end AXIS_DESCR
 /begin AXIS_DESCR STD_AXIS NO_INPUT_QUANTITY FORMULA_USER1 4 -32768.0 32767.0 /end AXIS_DESCR
/end CHARACTERISTIC
/begin CHARACTERISTIC UNK_SK_SELFTEST_KF_088DC "Safety-concept lookup self-test reference table (fixed test vectors from ROM). Not tuning data - DO NOT MODIFY. [Added V452 04.11.2026]" MAP 0x788DC TKF_SW_SW_SW 32767.0 FORMULA_USER1 -32768.0 32767.0
 /begin AXIS_DESCR STD_AXIS NO_INPUT_QUANTITY FORMULA_USER1 4 -32768.0 32767.0 /end AXIS_DESCR
 /begin AXIS_DESCR STD_AXIS NO_INPUT_QUANTITY FORMULA_USER1 4 -32768.0 32767.0 /end AXIS_DESCR
/end CHARACTERISTIC
/end MODULE
/end PROJECT
