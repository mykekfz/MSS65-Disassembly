/begin PROJECT MSS65-ign-V452 "MSS65 IGN - V452.01-B204.00, data set 0569Q60Z160E"
/begin HEADER "" VERSION "V452.01-B204.00" /end HEADER
/begin MODULE _MSS65-ign "MSS65 IGN - V452.01-B204.00, calibration xxxxxxxx"
/begin MOD_COMMON "" BYTE_ORDER MSB_FIRST /* Default byteorder (Motorola) */ /end MOD_COMMON
/* Formel fuer 1:1-Wiedergabe ohne Einheit */
/begin COMPU_METHOD FORMULA_USER1 "FORMULA_USER1" RAT_FUNC "%7.0" "-" COEFFS 0 1 0 0 0 1 /end COMPU_METHOD
/*--------------------------- QADC A + B ------------------------------------------------*/
/begin MEASUREMENT qadca_qasr0 "qadca_qasr0, Statusregister0" UWORD FORMULA_USER1 0 0 0.0000 65535.0000 ECU_ADDRESS 0x304810 /begin FUNCTION_LIST Debugging /end FUNCTION_LIST /end MEASUREMENT
/begin MEASUREMENT qadca_qasr1 "qadca_qasr1, Statusregister1" UWORD FORMULA_USER1 0 0 0.0000 65535.0000 ECU_ADDRESS 0x304812 /begin FUNCTION_LIST Debugging /end FUNCTION_LIST /end MEASUREMENT
/begin MEASUREMENT qadcb_qasr0 "qadcb_qasr0, Statusregister0" UWORD FORMULA_USER1 0 0 0.0000 65535.0000 ECU_ADDRESS 0x304C10 /begin FUNCTION_LIST Debugging /end FUNCTION_LIST /end MEASUREMENT
/begin MEASUREMENT qadcb_qasr1 "qadcb_qasr1, Statusregister1" UWORD FORMULA_USER1 0 0 0.0000 65535.0000 ECU_ADDRESS 0x304C12 /begin FUNCTION_LIST Debugging /end FUNCTION_LIST /end MEASUREMENT
/*--------------------------- CAN A + B ------------------------------------------------*/
/begin MEASUREMENT cana_estat "Error-Status-Register" UWORD FORMULA_USER1 0 0 0.0000 65535.0000 ECU_ADDRESS 0x3070A0 /begin FUNCTION_LIST Debugging /end FUNCTION_LIST /end MEASUREMENT
/begin MEASUREMENT canb_estat "Error-Status-Register" UWORD FORMULA_USER1 0 0 0.0000 65535.0000 ECU_ADDRESS 0x3074A0 /begin FUNCTION_LIST Debugging /end FUNCTION_LIST /end MEASUREMENT
/* ------------------ Abschnitt erzeugt aus adapt_common.dat ------------------ */
/begin COMPU_METHOD FORMULA_0000 "FORMULA_0000" RAT_FUNC "%7.0" "-" COEFFS 0 1 0 0 0 1 /end COMPU_METHOD
/begin COMPU_METHOD FORMULA_0001 "FORMULA_0001" RAT_FUNC "%6.1" "%" COEFFS 0 10 0 0 0 1 /end COMPU_METHOD
/begin COMPU_METHOD FORMULA_0003 "FORMULA_0003" RAT_FUNC "%3.0" "-" COEFFS 0 1 0 0 0 1 /end COMPU_METHOD
/begin COMPU_METHOD FORMULA_0006 "FORMULA_0006" RAT_FUNC "%5.0" "Upm" COEFFS 0 1 0 0 0 1 /end COMPU_METHOD
/begin COMPU_METHOD FORMULA_0007 "FORMULA_0007" RAT_FUNC "%8.3" "-" COEFFS 0 10000 0 0 0 1 /end COMPU_METHOD
/begin COMPU_METHOD FORMULA_0008 "FORMULA_0008" RAT_FUNC "%6.1" "V" COEFFS 0 10 0 0 0 1 /end COMPU_METHOD
/begin COMPU_METHOD FORMULA_0010 "FORMULA_0010" RAT_FUNC "%5.0" "-" COEFFS 0 1 0 0 0 1 /end COMPU_METHOD
/begin COMPU_METHOD FORMULA_0017 "FORMULA_0017" RAT_FUNC "%9.2" "ms" COEFFS 0 7000 0 0 0 1 /end COMPU_METHOD
/begin COMPU_METHOD FORMULA_0021 "FORMULA_0021" RAT_FUNC "%7.2" "s" COEFFS 0 100 0 0 0 1 /end COMPU_METHOD
/* ------------------ Abschnitt erzeugt aus adapt_glob.dat ------------------ */
/begin COMPU_METHOD FORMULA_0023 "FORMULA_0023" RAT_FUNC "%6.1" "�C" COEFFS 0 10 2732 0 0 1 /end COMPU_METHOD
/begin COMPU_METHOD FORMULA_0033 "FORMULA_0033" RAT_FUNC "%5.2" "-" COEFFS 0 1 0 0 0 1 /end COMPU_METHOD
/* ------------------ Abschnitt erzeugt aus debug.dat ------------------ */
/begin COMPU_METHOD FORMULA_0041 "FORMULA_0041" RAT_FUNC "%9.2" "-" COEFFS 0 1 0 0 0 1 /end COMPU_METHOD
/begin COMPU_METHOD FORMULA_0062 "FORMULA_0062" RAT_FUNC "%5.0" "s" COEFFS 0 1 0 0 0 1 /end COMPU_METHOD
/begin COMPU_METHOD FORMULA_0074 "FORMULA_0074" RAT_FUNC "%7.0" "us" COEFFS 0 1 0 0 0 1 /end COMPU_METHOD
/begin COMPU_METHOD FORMULA_0075 "FORMULA_0075" RAT_FUNC "%8.3" "-" COEFFS 0 1024 0 0 0 1 /end COMPU_METHOD
/begin COMPU_METHOD FORMULA_0076 "FORMULA_0076" RAT_FUNC "%6.1" "Kelvin" COEFFS 0 10 0 0 0 1 /end COMPU_METHOD
/* ------------------ Abschnitt erzeugt aus eeprom.dat ------------------ */
/begin COMPU_METHOD FORMULA_0080 "FORMULA_0080" TAB_VERB "%3.0" "Seite" COMPU_TAB_REF FORMULA_0080_VTAB /end COMPU_METHOD
/begin COMPU_VTAB FORMULA_0080_VTAB "FORMULA_0080_VTAB" TAB_VERB 1 128 "Keine Daten)" /end COMPU_VTAB
/begin COMPU_METHOD FORMULA_0081 "FORMULA_0081" TAB_VERB "%3.0" "Seite" COMPU_TAB_REF FORMULA_0081_VTAB /end COMPU_METHOD
/begin COMPU_VTAB FORMULA_0081_VTAB "FORMULA_0081_VTAB" TAB_VERB 2 64 "Sektoren voll->A" 72 "Sektoren voll->B" /end COMPU_VTAB
/begin COMPU_METHOD FORMULA_0082 "FORMULA_0082" TAB_VERB "%3.0" "-" COMPU_TAB_REF FORMULA_0082_VTAB /end COMPU_METHOD
/begin COMPU_VTAB FORMULA_0082_VTAB "FORMULA_0082_VTAB" TAB_VERB 9 0 "Daten o.k." 1 "CRC Stand falsch" 2 "Andere Erstellung" 4 "Andere Version" 8 "Wichtig groesser" 16 "Wichtig kleiner" 32 "Wichtig CRC falsch" 64 "Wichtig Laenge nio" 128 "keine Daten" /end COMPU_VTAB
/* ------------------ Abschnitt erzeugt aus glob.dat ------------------ */
/begin COMPU_METHOD FORMULA_0083 "FORMULA_0083" RAT_FUNC "%7.2" "-" COEFFS 0 1 0 0 0 1 /end COMPU_METHOD
/begin COMPU_METHOD FORMULA_0115 "FORMULA_0115" RAT_FUNC "%7.2" "%" COEFFS 0 16384 0 0 0 100 /end COMPU_METHOD
/begin COMPU_METHOD FORMULA_0117 "FORMULA_0117" RAT_FUNC "%7.2" "s" COEFFS 0 200 0 0 0 1 /end COMPU_METHOD
/begin COMPU_METHOD FORMULA_0126 "FORMULA_0126" TAB_VERB "%3.0" "-" COMPU_TAB_REF FORMULA_0126_VTAB /end COMPU_METHOD
/begin COMPU_VTAB FORMULA_0126_VTAB "FORMULA_0126_VTAB" TAB_VERB 8 0 "O.K." 1 "BusOff" 2 "DPR" 4 "Timeout" 5 "BusOff+Timeout" 8 "Overflow" 16 "Chksum" 32 "Alive" DEFAULT_VALUE "Mehrfachfehler" /end COMPU_VTAB
/begin COMPU_METHOD FORMULA_0147 "FORMULA_0147" RAT_FUNC "%6.1" "qmm" COEFFS 0 10 0 0 0 1 /end COMPU_METHOD
/begin COMPU_METHOD FORMULA_0244 "FORMULA_0244" RAT_FUNC "%8.1" "�KW" COEFFS 0 10 0 0 0 1 /end COMPU_METHOD
/begin COMPU_METHOD FORMULA_0317 "FORMULA_0317" RAT_FUNC "%5.2" "s" COEFFS 0 100 0 0 0 1 /end COMPU_METHOD
/* ------------------ Abschnitt erzeugt aus n.dat ------------------ */
/begin COMPU_METHOD FORMULA_0348 "FORMULA_0348" TAB_VERB "%3.0" "-" COMPU_TAB_REF FORMULA_0348_VTAB /end COMPU_METHOD
/begin COMPU_VTAB FORMULA_0348_VTAB "FORMULA_0348_VTAB" TAB_VERB 6 0 "Initialisierung" 1 "Zahndrehzahl" 3 "noch Zahndrehzahl" 7 "Segmentdrehzahl" 16 "Stoerung" 17 "Stoerung" DEFAULT_VALUE "Eingefroren" /end COMPU_VTAB
/begin COMPU_METHOD FORMULA_0349 "FORMULA_0349" RAT_FUNC "%7.2" "ms" COEFFS 0 625 0 0 0 1 /end COMPU_METHOD
/* ------------------ Abschnitt erzeugt aus pctrl.dat ------------------ */
/begin COMPU_METHOD FORMULA_0352 "FORMULA_0352" RAT_FUNC "%5.2" "s" COEFFS 0 200 0 0 0 1 /end COMPU_METHOD
/* ------------------ Abschnitt erzeugt aus adapt.dat ------------------ */
/begin COMPU_METHOD FORMULA_0418 "FORMULA_0418" RAT_FUNC "%8.3" "V" COEFFS 0 1024 0 0 0 5 /end COMPU_METHOD
/begin COMPU_METHOD FORMULA_0420 "FORMULA_0420" RAT_FUNC "%3.0" "mal" COEFFS 0 1 0 0 0 1 /end COMPU_METHOD
/begin COMPU_METHOD FORMULA_0431 "FORMULA_0431" TAB_VERB "%5.0" "-" COMPU_TAB_REF FORMULA_0431_VTAB /end COMPU_METHOD
/begin COMPU_VTAB FORMULA_0431_VTAB "FORMULA_0431_VTAB" TAB_VERB 17 0 "kein Fehler" 1 "RAM-Fehler" 2 "ROM-Fehler" 4 "A/D Wandler-Fehler" 8 "Software Reset" 16 "CAN-Bus Fehler" 32 "CAN-Timeout" 64 "CAN-Fehler Chksum" 128 "CAN-Fehler Alive" 256 "Zylinderbankzuordnung" 512 "Bereichsueberwachung" 1024 "Gradientenueberwachung" 2048 "Lagereglerueberwachung" 4096 "therm. Ueberlast" 8192 "Motorschutz" 16384 "NP-Fehler" 32768 "NP-Abbruch" DEFAULT_VALUE "Mehrfachfehler" /end COMPU_VTAB
/begin COMPU_METHOD FORMULA_0432 "FORMULA_0432" TAB_VERB "%3.0" "-" COMPU_TAB_REF FORMULA_0432_VTAB /end COMPU_METHOD
/begin COMPU_VTAB FORMULA_0432_VTAB "FORMULA_0432_VTAB" TAB_VERB 6 1 "oA aus" 2 "oA aktiv" 4 "oA erfolgreich" 9 "oA abgelehnt" 10 "oA abgebrochen" 12 "oA fehlerhaft" DEFAULT_VALUE "undef" /end COMPU_VTAB
/begin COMPU_METHOD FORMULA_0433 "FORMULA_0433" TAB_VERB "%3.0" "-" COMPU_TAB_REF FORMULA_0433_VTAB /end COMPU_METHOD
/begin COMPU_VTAB FORMULA_0433_VTAB "FORMULA_0433_VTAB" TAB_VERB 7 0 "Init" 1 "Inaktiv" 2 "NP-Adapt" 4 "Aktiv" 8 "Zust bb" 10 "Federtest" 15 "Failsafe" /end COMPU_VTAB
/begin COMPU_METHOD FORMULA_0434 "FORMULA_0434" TAB_VERB "%5.2" "-" COMPU_TAB_REF FORMULA_0434_VTAB /end COMPU_METHOD
/begin COMPU_VTAB FORMULA_0434_VTAB "FORMULA_0434_VTAB" TAB_VERB 5 0 "Wait" 1 "Inaktiv" 2 "Aktiv" 3 "Aktiv/Adapt" 255 "Failsafe" /end COMPU_VTAB
/begin COMPU_METHOD FORMULA_0462 "FORMULA_0462" RAT_FUNC "%5.2" "s" COEFFS 0 0 2.56 0 1 0 /end COMPU_METHOD
/begin COMPU_METHOD FORMULA_0478 "FORMULA_0478" RAT_FUNC "%6.3" "s" COEFFS 0 0 1.28 0 1 0 /end COMPU_METHOD
/begin COMPU_METHOD FORMULA_0479 "FORMULA_0479" RAT_FUNC "%4.1" "%" COEFFS 0 10 0 0 0 1 /end COMPU_METHOD
/* ------------------ Abschnitt erzeugt aus dsp.dat ------------------ */
/begin COMPU_METHOD FORMULA_0581 "FORMULA_0581" TAB_VERB "%3.0" "-" COMPU_TAB_REF FORMULA_0581_VTAB /end COMPU_METHOD
/begin COMPU_VTAB FORMULA_0581_VTAB "FORMULA_0581_VTAB" TAB_VERB 4 0 "DMA Ok" 1 "Write Error" 2 "Read Error" 3 "Read+Write Error" DEFAULT_VALUE "Unknown Status" /end COMPU_VTAB
/begin COMPU_METHOD FORMULA_0582 "FORMULA_0582" TAB_VERB "%5.0" "-" COMPU_TAB_REF FORMULA_0582_VTAB /end COMPU_METHOD
/begin COMPU_VTAB FORMULA_0582_VTAB "FORMULA_0582_VTAB" TAB_VERB 32 0 "Bus Ok" 2 "Loaded" 6 "Booted" 14 "Run" 1 "Bus Error" 3 "Bus Error" 7 "Bus Error" 15 "Bus Error" 16 "Stack Error" 18 "Stack Error" 22 "Stack Error" 30 "Stack Error" 32 "Watchdog" 34 "Watchdog" 38 "Watchdog" 46 "Watchdog" 64 "Run Error" 66 "Run Error" 70 "Run Error" 78 "Run Error" 128 "MISC Error" 130 "MISC Error" 134 "MISC Error" 142 "MISC Error" 256 "PM Error" 258 "PM Error" 262 "PM Error" 270 "PM Error" 512 "DM Error" 514 "DM Error" 518 "DM Error" 526 "DM Error" DEFAULT_VALUE "Access denied" /end COMPU_VTAB
/begin COMPU_METHOD FORMULA_0583 "FORMULA_0583" RAT_FUNC "%6.1" "%" COEFFS 0 120 0 0 0 1 /end COMPU_METHOD
/begin COMPU_METHOD FORMULA_0584 "FORMULA_0584" RAT_FUNC "%9.2" "ms" COEFFS 0 250 0 0 0 1 /end COMPU_METHOD
/begin COMPU_METHOD FORMULA_0585 "FORMULA_0585" RAT_FUNC "%9.2" "mVs" COEFFS 0 1 0 0 0 3.22265625 /end COMPU_METHOD
/begin COMPU_METHOD FORMULA_0586 "FORMULA_0586" RAT_FUNC "%9.2" "V" COEFFS 0 1 0 0 0 0.00080566 /end COMPU_METHOD
/* ------------------ Abschnitt erzeugt aus egas.dat ------------------ */
/begin COMPU_METHOD FORMULA_0587 "FORMULA_0587" RAT_FUNC "%5.2" "sec" COEFFS 0 200 0 0 0 1 /end COMPU_METHOD
/begin COMPU_METHOD FORMULA_0588 "FORMULA_0588" TAB_VERB "%3.0" "-" COMPU_TAB_REF FORMULA_0588_VTAB /end COMPU_METHOD
/begin COMPU_VTAB FORMULA_0588_VTAB "FORMULA_0588_VTAB" TAB_VERB 8 0 "Keine" 1 "LLS1" 2 "LLS2" 3 "LLS1+2" 4 "DK1" 8 "DK2" 12 "DK1+2" 15 "Alle" /end COMPU_VTAB
/begin COMPU_METHOD FORMULA_0589 "FORMULA_0589" RAT_FUNC "%10.3" "V" COEFFS 0 1024 0 0 0 5 /end COMPU_METHOD
/begin COMPU_METHOD FORMULA_0590 "FORMULA_0590" RAT_FUNC "%3.0" "ms" COEFFS 0 1 0 0 0 5 /end COMPU_METHOD
/begin COMPU_METHOD FORMULA_0591 "FORMULA_0591" RAT_FUNC "%4.1" "%" COEFFS 0 1.28 128 0 0 1 /end COMPU_METHOD
/begin COMPU_METHOD FORMULA_0592 "FORMULA_0592" TAB_VERB "%5.2" "-" COMPU_TAB_REF FORMULA_0592_VTAB /end COMPU_METHOD
/begin COMPU_VTAB FORMULA_0592_VTAB "FORMULA_0592_VTAB" TAB_VERB 2 0 "disable" 1 "enable" /end COMPU_VTAB
/begin COMPU_METHOD FORMULA_0593 "FORMULA_0593" TAB_VERB "%5.2" "-" COMPU_TAB_REF FORMULA_0593_VTAB /end COMPU_METHOD
/begin COMPU_VTAB FORMULA_0593_VTAB "FORMULA_0593_VTAB" TAB_VERB 7 0 "Init" 1 "Inaktiv" 2 "NP-Adapt" 4 "Aktiv" 8 "Zust bb" 10 "Federtest" 15 "Failsafe" /end COMPU_VTAB
/begin COMPU_METHOD FORMULA_0594 "FORMULA_0594" TAB_VERB "%3.0" "-" COMPU_TAB_REF FORMULA_0594_VTAB /end COMPU_METHOD
/begin COMPU_VTAB FORMULA_0594_VTAB "FORMULA_0594_VTAB" TAB_VERB 13 0 "NP aus" 1 "NP default" 2 "NP aktiv" 3 "NP erfolgreich" 4 "NP abgelehnt" 5 "NP abgebrochen" 6 "NP fehlerhaft" 8 "FT aus" 10 "FT aktiv" 11 "FT erfolgreich" 12 "FT abgelehnt" 13 "FT abgebrochen" 14 "FT fehlerhaft" DEFAULT_VALUE "undef" /end COMPU_VTAB
/begin COMPU_METHOD FORMULA_0595 "FORMULA_0595" TAB_VERB "%5.2" "-" COMPU_TAB_REF FORMULA_0595_VTAB /end COMPU_METHOD
/begin COMPU_VTAB FORMULA_0595_VTAB "FORMULA_0595_VTAB" TAB_VERB 9 0 "Wait" 1 "Inaktiv" 2 "Gestaengetest" 3 "Adaption" 4 "EnableLtg-S" 5 "EnableLtg" 6 "Aktiv" 7 "Federtest" 255 "Failsafe" /end COMPU_VTAB
/begin COMPU_METHOD FORMULA_0596 "FORMULA_0596" RAT_FUNC "%7.2" "sec" COEFFS 0 200 0 0 0 1 /end COMPU_METHOD
/begin COMPU_METHOD FORMULA_0597 "FORMULA_0597" TAB_VERB "%3.0" "-" COMPU_TAB_REF FORMULA_0597_VTAB /end COMPU_METHOD
/begin COMPU_VTAB FORMULA_0597_VTAB "FORMULA_0597_VTAB" TAB_VERB 1 0 "Disable" DEFAULT_VALUE "Enable" /end COMPU_VTAB
/begin COMPU_METHOD FORMULA_0598 "FORMULA_0598" TAB_VERB "%3.0" "-" COMPU_TAB_REF FORMULA_0598_VTAB /end COMPU_METHOD
/begin COMPU_VTAB FORMULA_0598_VTAB "FORMULA_0598_VTAB" TAB_VERB 15 0 "No" 1 "NP" 2 "EN" 3 "NP+EN" 4 "FT" 5 "NP+FT" 6 "EN+FT" 7 "NP+En+FT" 8 "GT" 9 "GT+NP" 10 "GT+EN" 11 "GT+NP+EN" 12 "GT+FT" 14 "GT+FT+EN" 15 "GT+NP+EN+FT" /end COMPU_VTAB
/begin COMPU_METHOD FORMULA_0599 "FORMULA_0599" TAB_VERB "%3.0" "-" COMPU_TAB_REF FORMULA_0599_VTAB /end COMPU_METHOD
/begin COMPU_VTAB FORMULA_0599_VTAB "FORMULA_0599_VTAB" TAB_VERB 1 0 "Nein" DEFAULT_VALUE "Ja" /end COMPU_VTAB
/begin COMPU_METHOD FORMULA_0600 "FORMULA_0600" TAB_VERB "%3.0" "-" COMPU_TAB_REF FORMULA_0600_VTAB /end COMPU_METHOD
/begin COMPU_VTAB FORMULA_0600_VTAB "FORMULA_0600_VTAB" TAB_VERB 1 0 "Nein" DEFAULT_VALUE "Frei" /end COMPU_VTAB
/begin COMPU_METHOD FORMULA_0601 "FORMULA_0601" TAB_VERB "%3.0" "-" COMPU_TAB_REF FORMULA_0601_VTAB /end COMPU_METHOD
/begin COMPU_VTAB FORMULA_0601_VTAB "FORMULA_0601_VTAB" TAB_VERB 1 0 "Inaktiv" DEFAULT_VALUE "Aktiv" /end COMPU_VTAB
/begin COMPU_METHOD FORMULA_0602 "FORMULA_0602" TAB_VERB "%5.0" "-" COMPU_TAB_REF FORMULA_0602_VTAB /end COMPU_METHOD
/begin COMPU_VTAB FORMULA_0602_VTAB "FORMULA_0602_VTAB" TAB_VERB 12 0 "kein Fehler" 1 "R-Mode" 2 "Diagnose" 4 "undef" 8 "CAN-Fehler" 16 "EnLtg-Err" 32 "EnLtg-Diag" 64 "Startup" 128 "EnLtg-En" 256 "Gestaenge" 512 "EnLtg-Dis" 1024 "Federntest" DEFAULT_VALUE "Mehrfachfehler" /end COMPU_VTAB
/begin COMPU_METHOD FORMULA_0603 "FORMULA_0603" TAB_VERB "%5.2" "-" COMPU_TAB_REF FORMULA_0603_VTAB /end COMPU_METHOD
/begin COMPU_VTAB FORMULA_0603_VTAB "FORMULA_0603_VTAB" TAB_VERB 6 0 "Init" 1 "Inaktiv" 4 "Aktiv" 6 "Aktiv/Adapt" 8 "Zust bb" 15 "Failsafe" /end COMPU_VTAB
/begin COMPU_METHOD FORMULA_0604 "FORMULA_0604" TAB_VERB "%5.2" "-" COMPU_TAB_REF FORMULA_0604_VTAB /end COMPU_METHOD
/begin COMPU_VTAB FORMULA_0604_VTAB "FORMULA_0604_VTAB" TAB_VERB 5 0 "Init" 1 "Inaktiv" 4 "Aktiv" 6 "Aktiv/Adapt" 15 "Failsafe" /end COMPU_VTAB
/begin COMPU_METHOD FORMULA_0605 "FORMULA_0605" TAB_VERB "%5.2" "-" COMPU_TAB_REF FORMULA_0605_VTAB /end COMPU_METHOD
/begin COMPU_VTAB FORMULA_0605_VTAB "FORMULA_0605_VTAB" TAB_VERB 6 0 "Init" 1 "Inaktiv" 4 "Aktiv" 6 "Aktiv/Adapt" 8 "Zust bb" 15 "Failsafe" /end COMPU_VTAB
/begin COMPU_METHOD FORMULA_0606 "FORMULA_0606" TAB_VERB "%5.2" "-" COMPU_TAB_REF FORMULA_0606_VTAB /end COMPU_METHOD
/begin COMPU_VTAB FORMULA_0606_VTAB "FORMULA_0606_VTAB" TAB_VERB 1 0 "aus" DEFAULT_VALUE "Adaption" /end COMPU_VTAB
/begin COMPU_METHOD FORMULA_0607 "FORMULA_0607" TAB_VERB "%5.2" "-" COMPU_TAB_REF FORMULA_0607_VTAB /end COMPU_METHOD
/begin COMPU_VTAB FORMULA_0607_VTAB "FORMULA_0607_VTAB" TAB_VERB 3 0 "no Testmode" 1 "noKL50" 2 "Testmode" DEFAULT_VALUE "undef" /end COMPU_VTAB
/begin COMPU_METHOD FORMULA_0608 "FORMULA_0608" TAB_VERB "%5.2" "-" COMPU_TAB_REF FORMULA_0608_VTAB /end COMPU_METHOD
/begin COMPU_VTAB FORMULA_0608_VTAB "FORMULA_0608_VTAB" TAB_VERB 2 0 "no Testmode" 1 "Testmode" DEFAULT_VALUE "undef" /end COMPU_VTAB
/begin COMPU_METHOD FORMULA_0609 "FORMULA_0609" TAB_VERB "%5.2" "-" COMPU_TAB_REF FORMULA_0609_VTAB /end COMPU_METHOD
/begin COMPU_VTAB FORMULA_0609_VTAB "FORMULA_0609_VTAB" TAB_VERB 2 0 "Poti normal" 1 "Poti invers" /end COMPU_VTAB
/begin COMPU_METHOD FORMULA_0610 "FORMULA_0610" TAB_VERB "%5.2" "-" COMPU_TAB_REF FORMULA_0610_VTAB /end COMPU_METHOD
/begin COMPU_VTAB FORMULA_0610_VTAB "FORMULA_0610_VTAB" TAB_VERB 4 0 "aus" 1 "KH" 2 "ML" 3 "KH+ML" /end COMPU_VTAB
/begin COMPU_METHOD FORMULA_0611 "FORMULA_0611" TAB_VERB "%3.0" "-" COMPU_TAB_REF FORMULA_0611_VTAB /end COMPU_METHOD
/begin COMPU_VTAB FORMULA_0611_VTAB "FORMULA_0611_VTAB" TAB_VERB 11 0 "Inaktiv" 1 "LLS1" 2 "LLS2" 3 "LLS1+2" 4 "DK1" 5 "LLS1+DK1" 8 "DK2" 10 "LLS2+DK2" 12 "DK1+2" 15 "Alle" 16 "Bowdenzug" /end COMPU_VTAB
/begin COMPU_METHOD FORMULA_0612 "FORMULA_0612" RAT_FUNC "%7.2" "-" COEFFS 0 -1024 1024 0 0 -1 /end COMPU_METHOD
/begin COMPU_METHOD FORMULA_0613 "FORMULA_0613" RAT_FUNC "%4.1" "%/s" COEFFS 0 10 0 0 0 1 /end COMPU_METHOD
/begin COMPU_METHOD FORMULA_0614 "FORMULA_0614" RAT_FUNC "%8.3" "%/V" COEFFS 0 102400 0 0 0 1023 /end COMPU_METHOD
/* ------------------ Abschnitt erzeugt aus egas_cmd.dat ------------------ */
/begin COMPU_METHOD FORMULA_0615 "FORMULA_0615" TAB_VERB "%5.2" "-" COMPU_TAB_REF FORMULA_0615_VTAB /end COMPU_METHOD
/begin COMPU_VTAB FORMULA_0615_VTAB "FORMULA_0615_VTAB" TAB_VERB 9 0 "INAKTIV" 3 "NEUINIT" 5 "GET_VERS" 6 "SET_VERS" 9 "CLR_DIAGST" 10 "SET_ZYLBANK" 12 "CLR_EEPROM" 14 "CS_ERROR" 15 "UNKNOWN" /end COMPU_VTAB
/begin COMPU_METHOD FORMULA_0616 "FORMULA_0616" TAB_VERB "%3.0" "-" COMPU_TAB_REF FORMULA_0616_VTAB /end COMPU_METHOD
/begin COMPU_VTAB FORMULA_0616_VTAB "FORMULA_0616_VTAB" TAB_VERB 9 0 "INAKTIV" 3 "NEUINIT" 5 "GET_VERS" 6 "SET_VERS" 9 "CLR_DIAGST" 10 "SET_ZYLBANK" 12 "CLR_EEPROM" 14 "CS_ERROR" 15 "UNKNOWN" /end COMPU_VTAB
/begin COMPU_METHOD FORMULA_0617 "FORMULA_0617" RAT_FUNC "%6.1" "s" COEFFS 0 200 0 0 0 1 /end COMPU_METHOD
/begin COMPU_METHOD FORMULA_0618 "FORMULA_0618" TAB_VERB "%5.2" "-" COMPU_TAB_REF FORMULA_0618_VTAB /end COMPU_METHOD
/begin COMPU_VTAB FORMULA_0618_VTAB "FORMULA_0618_VTAB" TAB_VERB 3 0 "nothing" 1 "ackn" 15 "timeout" /end COMPU_VTAB
/begin COMPU_METHOD FORMULA_0619 "FORMULA_0619" TAB_VERB "%7.2" "-" COMPU_TAB_REF FORMULA_0619_VTAB /end COMPU_METHOD
/begin COMPU_VTAB FORMULA_0619_VTAB "FORMULA_0619_VTAB" TAB_VERB 44 0 "O.K." 1 "SH_TO_UB" 2 "SH_TO_GND" 4 "OPENLOAD" 8 "UNPLAUSI" 256 "O.K./ZYKLUS" 512 "FILTER" 513 "FIL/SH_TO_UB" 514 "FIL/SH_TO_GND" 516 "FIL/OPENLOAD" 520 "FIL/UNPLAUSI" 576 "VORHANDEN" 577 "VORH/SH_TO_UB" 578 "VORH/SH_TO_GND" 580 "VORH/OPENLOAD" 584 "VORH/UNPLAUSI" 768 "FILTER/ZYKLUS" 769 "FIL/ZYK/SH_TO_UB" 770 "FIL/ZYK/SH_TO_GND" 772 "FIL/ZYK/OPENLOAD" 776 "FIL/ZYK/UNPLAUSI" 832 "VORHANDEN/ZYKLUS" 833 "VORH/ZYK/SH_TO_UB" 834 "VORH/ZYK/SH_TO_GND" 836 "VORH/ZYK/OPENLOAD" 840 "VORH/ZYK/UNPLAUSI" 2048 "O.K./SCDN" 2304 "O.K./S/ZYKLUS" 2561 "FIL/S/SH_TO_UB" 2562 "FIL/S/SH_TO_GND" 2564 "FIL/S/OPENLOAD" 2568 "FIL/S/UNPLAUSI" 2625 "VORH/S/SH_TO_UB" 2626 "VORH/S/SH_TO_GND" 2628 "VORH/S/OPENLOAD" 2632 "VORH/S/UNPLAUSI" 2817 "FIL/ZYK/S/SH_TO_UB" 2818 "FIL/ZYK/S/SH_TO_GND" 2820 "FIL/ZYK/S/OPENLOAD" 2824 "FIL/ZYK/S/UNPLAUSI" 2881 "VORH/ZYK/S/SH_TO_UB" 2882 "VORH/ZYK/S/SH_TO_GND" 2884 "VORH/ZYK/S/OPENLOAD" 2888 "VORH/ZYK/S/UNPLAUSI" /end COMPU_VTAB
/begin COMPU_METHOD FORMULA_0620 "FORMULA_0620" TAB_VERB "%5.0" "-" COMPU_TAB_REF FORMULA_0620_VTAB /end COMPU_METHOD
/begin COMPU_VTAB FORMULA_0620_VTAB "FORMULA_0620_VTAB" TAB_VERB 3 0 "nothing" 1 "ackn" 15 "timeout" /end COMPU_VTAB
/* ------------------ Abschnitt erzeugt aus egas_sk.dat ------------------ */
/begin COMPU_METHOD FORMULA_0621 "FORMULA_0621" TAB_VERB "%5.2" "-" COMPU_TAB_REF FORMULA_0621_VTAB /end COMPU_METHOD
/begin COMPU_VTAB FORMULA_0621_VTAB "FORMULA_0621_VTAB" TAB_VERB 5 0 "kein Fehler" 1 "Soll-Vgl" 2 "Soll-Ist-Vgl" 4 "Mode-Vgl" 8 "CAN-Istwert" DEFAULT_VALUE "Mehrfachfehler" /end COMPU_VTAB
/begin COMPU_METHOD FORMULA_0622 "FORMULA_0622" TAB_VERB "%5.2" "-" COMPU_TAB_REF FORMULA_0622_VTAB /end COMPU_METHOD
/begin COMPU_VTAB FORMULA_0622_VTAB "FORMULA_0622_VTAB" TAB_VERB 6 0 "kein Fehler" 1 "Spalt offen" 2 "Klemmen offen" 4 "WDK-Istwert" 8 "WDK-CAN-Vgl" 12 "WDK-Istwert" DEFAULT_VALUE "Mehrfachfehler" /end COMPU_VTAB
/begin COMPU_METHOD FORMULA_0623 "FORMULA_0623" TAB_VERB "%5.2" "-" COMPU_TAB_REF FORMULA_0623_VTAB /end COMPU_METHOD
/begin COMPU_VTAB FORMULA_0623_VTAB "FORMULA_0623_VTAB" TAB_VERB 4 0 "kein Fehler" 1 "Soll-Vgl" 2 "Soll-Ist-Vgl" 4 "Mode-Vgl" DEFAULT_VALUE "Mehrfachfehler" /end COMPU_VTAB
/begin COMPU_METHOD FORMULA_0624 "FORMULA_0624" RAT_FUNC "%7.2" "%/sec" COEFFS 0 1 0 0 0 20 /end COMPU_METHOD
/begin COMPU_METHOD FORMULA_0625 "FORMULA_0625" TAB_VERB "%5.2" "-" COMPU_TAB_REF FORMULA_0625_VTAB /end COMPU_METHOD
/begin COMPU_VTAB FORMULA_0625_VTAB "FORMULA_0625_VTAB" TAB_VERB 2 0 "SK aus" 1 "SK aktiv" /end COMPU_VTAB
/* ------------------ Abschnitt erzeugt aus egas_stm.dat ------------------ */
/begin COMPU_METHOD FORMULA_0626 "FORMULA_0626" TAB_VERB "%5.2" "-" COMPU_TAB_REF FORMULA_0626_VTAB /end COMPU_METHOD
/begin COMPU_VTAB FORMULA_0626_VTAB "FORMULA_0626_VTAB" TAB_VERB 6 0 "Init" 1 "Versionsabfrage" 2 "Versionsvorgabe" 3 "Bankzuordnung" 4 "Statusabfrage" 5 "Kl15 aus" /end COMPU_VTAB
/begin COMPU_METHOD FORMULA_0627 "FORMULA_0627" RAT_FUNC "%5.0" "min" COEFFS 0 60 0 0 0 1 /end COMPU_METHOD
/begin COMPU_METHOD FORMULA_0628 "FORMULA_0628" TAB_VERB "%5.2" "-" COMPU_TAB_REF FORMULA_0628_VTAB /end COMPU_METHOD
/begin COMPU_VTAB FORMULA_0628_VTAB "FORMULA_0628_VTAB" TAB_VERB 1 0 "kein Fehler" DEFAULT_VALUE "mind. 1 Fehler" /end COMPU_VTAB
/begin COMPU_METHOD FORMULA_0629 "FORMULA_0629" TAB_VERB "%3.0" "-" COMPU_TAB_REF FORMULA_0629_VTAB /end COMPU_METHOD
/begin COMPU_VTAB FORMULA_0629_VTAB "FORMULA_0629_VTAB" TAB_VERB 11 0 "Aus" 1 "Start" 2 "Predrive" 3 "Start KlSpr" 4 "Kl.Sprung" 5 "Gr. Sprung" 6 "Start Rampe" 7 "Oeffnen 1" 8 "Oeffnen 2" 9 "Schliessen" 15 "Abbruch" DEFAULT_VALUE "undef" /end COMPU_VTAB
/begin COMPU_METHOD FORMULA_0630 "FORMULA_0630" RAT_FUNC "%8.3" "s" COEFFS 0 200 0 0 0 1 /end COMPU_METHOD
/begin COMPU_METHOD FORMULA_0631 "FORMULA_0631" RAT_FUNC "%8.1" "%" COEFFS 0 1.28 0 0 0 1 /end COMPU_METHOD
/begin COMPU_METHOD FORMULA_0632 "FORMULA_0632" RAT_FUNC "%8.1" "%" COEFFS 0 10 0 0 0 1 /end COMPU_METHOD
/begin COMPU_METHOD FORMULA_0633 "FORMULA_0633" RAT_FUNC "%7.2" "sec" COEFFS 0 1000 0 0 0 5 /end COMPU_METHOD
/begin COMPU_METHOD FORMULA_0634 "FORMULA_0634" RAT_FUNC "%4.1" "%" COEFFS 0 1.28 0 0 0 1 /end COMPU_METHOD
/* ------------------ Abschnitt erzeugt aus fgr.dat ------------------ */
/begin COMPU_METHOD FORMULA_0635 "FORMULA_0635" TAB_VERB "%4.1" "-" COMPU_TAB_REF FORMULA_0635_VTAB /end COMPU_METHOD
/begin COMPU_VTAB FORMULA_0635_VTAB "FORMULA_0635_VTAB" TAB_VERB 2 0 "nein" 1 "ja" /end COMPU_VTAB
/* ------------------ Abschnitt erzeugt aus n_e2.dat ------------------ */
/begin COMPU_METHOD FORMULA_0838 "FORMULA_0838" TAB_VERB "%5.2" "-" COMPU_TAB_REF FORMULA_0838_VTAB /end COMPU_METHOD
/begin COMPU_VTAB FORMULA_0838_VTAB "FORMULA_0838_VTAB" TAB_VERB 2 0 "Ok" 1 "Fehler" DEFAULT_VALUE "undefined" /end COMPU_VTAB
/* ------------------ Abschnitt erzeugt aus ppcm.dat ------------------ */
/begin COMPU_METHOD FORMULA_0841 "FORMULA_0841" RAT_FUNC "%7.0" "U/min" COEFFS 0 1 0 0 0 1 /end COMPU_METHOD
/begin COMPU_METHOD FORMULA_0842 "FORMULA_0842" TAB_VERB "%9.2" "-" COMPU_TAB_REF FORMULA_0842_VTAB /end COMPU_METHOD
/begin COMPU_VTAB FORMULA_0842_VTAB "FORMULA_0842_VTAB" TAB_VERB 13 1 "Motor steht" 2 "Motor presync" 4 "Start" 8 "LLOKS" 16 "LLMKS" 32 "TL" 64 "VL" 128 "SA" 256 "NL" 512 "Abgew." 1024 "Kl15 aus" 2048 "Wakeup" 4096 "Schub" DEFAULT_VALUE "undefiniert" /end COMPU_VTAB
/begin COMPU_METHOD FORMULA_0843 "FORMULA_0843" RAT_FUNC "%10.3" "-" COEFFS 0 10000 0 0 0 1 /end COMPU_METHOD
/begin COMPU_METHOD FORMULA_0844 "FORMULA_0844" RAT_FUNC "%10.3" "-" COEFFS 0 16384 0 0 0 1 /end COMPU_METHOD
/begin COMPU_METHOD FORMULA_0845 "FORMULA_0845" RAT_FUNC "%9.2" "%" COEFFS 0 16384 0 0 0 100 /end COMPU_METHOD
/begin COMPU_METHOD FORMULA_0846 "FORMULA_0846" TAB_VERB "%7.0" "-" COMPU_TAB_REF FORMULA_0846_VTAB /end COMPU_METHOD
/begin COMPU_VTAB FORMULA_0846_VTAB "FORMULA_0846_VTAB" TAB_VERB 5 0 "Aus" 7 "Aktiv" 1 "Einspr. aus" 5 "Einspr. aus" 3 "Zuendung aus" DEFAULT_VALUE "Idle" /end COMPU_VTAB
/begin COMPU_METHOD FORMULA_0847 "FORMULA_0847" TAB_VERB "%7.0" "-" COMPU_TAB_REF FORMULA_0847_VTAB /end COMPU_METHOD
/begin COMPU_VTAB FORMULA_0847_VTAB "FORMULA_0847_VTAB" TAB_VERB 1 0 "Aus" DEFAULT_VALUE "Aktiv" /end COMPU_VTAB
/begin COMPU_METHOD FORMULA_0848 "FORMULA_0848" TAB_VERB "%7.0" "-" COMPU_TAB_REF FORMULA_0848_VTAB /end COMPU_METHOD
/begin COMPU_VTAB FORMULA_0848_VTAB "FORMULA_0848_VTAB" TAB_VERB 1 0 "Ausschwingen ok." DEFAULT_VALUE "Fehler Ausschwingen." /end COMPU_VTAB
/begin COMPU_METHOD FORMULA_0849 "FORMULA_0849" TAB_VERB "%7.0" "-" COMPU_TAB_REF FORMULA_0849_VTAB /end COMPU_METHOD
/begin COMPU_VTAB FORMULA_0849_VTAB "FORMULA_0849_VTAB" TAB_VERB 1 0 "Zyl. 1 ok." DEFAULT_VALUE "Fehler Ausschw. Zyl. 1." /end COMPU_VTAB
/begin COMPU_METHOD FORMULA_0850 "FORMULA_0850" TAB_VERB "%7.0" "-" COMPU_TAB_REF FORMULA_0850_VTAB /end COMPU_METHOD
/begin COMPU_VTAB FORMULA_0850_VTAB "FORMULA_0850_VTAB" TAB_VERB 1 0 "Zyl. 2 ok." DEFAULT_VALUE "Fehler Ausschw. Zyl. 2." /end COMPU_VTAB
/begin COMPU_METHOD FORMULA_0851 "FORMULA_0851" TAB_VERB "%7.0" "-" COMPU_TAB_REF FORMULA_0851_VTAB /end COMPU_METHOD
/begin COMPU_VTAB FORMULA_0851_VTAB "FORMULA_0851_VTAB" TAB_VERB 1 0 "Zyl. 3 ok." DEFAULT_VALUE "Fehler Ausschw. Zyl. 3." /end COMPU_VTAB
/begin COMPU_METHOD FORMULA_0852 "FORMULA_0852" TAB_VERB "%7.0" "-" COMPU_TAB_REF FORMULA_0852_VTAB /end COMPU_METHOD
/begin COMPU_VTAB FORMULA_0852_VTAB "FORMULA_0852_VTAB" TAB_VERB 1 0 "Zyl. 4 ok." DEFAULT_VALUE "Fehler Ausschw. Zyl. 4." /end COMPU_VTAB
/begin COMPU_METHOD FORMULA_0853 "FORMULA_0853" TAB_VERB "%7.0" "-" COMPU_TAB_REF FORMULA_0853_VTAB /end COMPU_METHOD
/begin COMPU_VTAB FORMULA_0853_VTAB "FORMULA_0853_VTAB" TAB_VERB 1 0 "Zyl. 5 ok." DEFAULT_VALUE "Fehler Ausschw. Zyl. 5." /end COMPU_VTAB
/begin COMPU_METHOD FORMULA_0854 "FORMULA_0854" TAB_VERB "%7.0" "-" COMPU_TAB_REF FORMULA_0854_VTAB /end COMPU_METHOD
/begin COMPU_VTAB FORMULA_0854_VTAB "FORMULA_0854_VTAB" TAB_VERB 1 0 "Zyl. 6 ok." DEFAULT_VALUE "Fehler Ausschw. Zyl. 6." /end COMPU_VTAB
/begin COMPU_METHOD FORMULA_0855 "FORMULA_0855" TAB_VERB "%7.0" "-" COMPU_TAB_REF FORMULA_0855_VTAB /end COMPU_METHOD
/begin COMPU_VTAB FORMULA_0855_VTAB "FORMULA_0855_VTAB" TAB_VERB 1 0 "Zyl. 7 ok." DEFAULT_VALUE "Fehler Ausschw. Zyl. 7." /end COMPU_VTAB
/begin COMPU_METHOD FORMULA_0856 "FORMULA_0856" TAB_VERB "%7.0" "-" COMPU_TAB_REF FORMULA_0856_VTAB /end COMPU_METHOD
/begin COMPU_VTAB FORMULA_0856_VTAB "FORMULA_0856_VTAB" TAB_VERB 1 0 "Zyl. 8 ok." DEFAULT_VALUE "Fehler Ausschw. Zyl. 8." /end COMPU_VTAB
/begin COMPU_METHOD FORMULA_0857 "FORMULA_0857" TAB_VERB "%7.0" "-" COMPU_TAB_REF FORMULA_0857_VTAB /end COMPU_METHOD
/begin COMPU_VTAB FORMULA_0857_VTAB "FORMULA_0857_VTAB" TAB_VERB 1 0 "Zyl. 9 ok." DEFAULT_VALUE "Fehler Ausschw. Zyl. 9." /end COMPU_VTAB
/begin COMPU_METHOD FORMULA_0858 "FORMULA_0858" TAB_VERB "%7.0" "-" COMPU_TAB_REF FORMULA_0858_VTAB /end COMPU_METHOD
/begin COMPU_VTAB FORMULA_0858_VTAB "FORMULA_0858_VTAB" TAB_VERB 1 0 "Zyl. 10 ok." DEFAULT_VALUE "Fehler Ausschw. Zyl. 10." /end COMPU_VTAB
/begin COMPU_METHOD FORMULA_0859 "FORMULA_0859" TAB_VERB "%7.0" "-" COMPU_TAB_REF FORMULA_0859_VTAB /end COMPU_METHOD
/begin COMPU_VTAB FORMULA_0859_VTAB "FORMULA_0859_VTAB" TAB_VERB 1 0 "Verbrennung ok." DEFAULT_VALUE "Fehler Verbrennung." /end COMPU_VTAB
/begin COMPU_METHOD FORMULA_0860 "FORMULA_0860" TAB_VERB "%7.0" "-" COMPU_TAB_REF FORMULA_0860_VTAB /end COMPU_METHOD
/begin COMPU_VTAB FORMULA_0860_VTAB "FORMULA_0860_VTAB" TAB_VERB 1 0 "Zyl. 1 ok." DEFAULT_VALUE "Fehler Verbr. Zyl. 1." /end COMPU_VTAB
/begin COMPU_METHOD FORMULA_0861 "FORMULA_0861" TAB_VERB "%7.0" "-" COMPU_TAB_REF FORMULA_0861_VTAB /end COMPU_METHOD
/begin COMPU_VTAB FORMULA_0861_VTAB "FORMULA_0861_VTAB" TAB_VERB 1 0 "Zyl. 2 ok." DEFAULT_VALUE "Fehler Verbr. Zyl. 2." /end COMPU_VTAB
/begin COMPU_METHOD FORMULA_0862 "FORMULA_0862" TAB_VERB "%7.0" "-" COMPU_TAB_REF FORMULA_0862_VTAB /end COMPU_METHOD
/begin COMPU_VTAB FORMULA_0862_VTAB "FORMULA_0862_VTAB" TAB_VERB 1 0 "Zyl. 3 ok." DEFAULT_VALUE "Fehler Verbr. Zyl. 3." /end COMPU_VTAB
/begin COMPU_METHOD FORMULA_0863 "FORMULA_0863" TAB_VERB "%7.0" "-" COMPU_TAB_REF FORMULA_0863_VTAB /end COMPU_METHOD
/begin COMPU_VTAB FORMULA_0863_VTAB "FORMULA_0863_VTAB" TAB_VERB 1 0 "Zyl. 4 ok." DEFAULT_VALUE "Fehler Verbr. Zyl. 4." /end COMPU_VTAB
/begin COMPU_METHOD FORMULA_0864 "FORMULA_0864" TAB_VERB "%7.0" "-" COMPU_TAB_REF FORMULA_0864_VTAB /end COMPU_METHOD
/begin COMPU_VTAB FORMULA_0864_VTAB "FORMULA_0864_VTAB" TAB_VERB 1 0 "Zyl. 5 ok." DEFAULT_VALUE "Fehler Verbr. Zyl. 5." /end COMPU_VTAB
/begin COMPU_METHOD FORMULA_0865 "FORMULA_0865" TAB_VERB "%7.0" "-" COMPU_TAB_REF FORMULA_0865_VTAB /end COMPU_METHOD
/begin COMPU_VTAB FORMULA_0865_VTAB "FORMULA_0865_VTAB" TAB_VERB 1 0 "Zyl. 6 ok." DEFAULT_VALUE "Fehler Verbr. Zyl. 6." /end COMPU_VTAB
/begin COMPU_METHOD FORMULA_0866 "FORMULA_0866" TAB_VERB "%7.0" "-" COMPU_TAB_REF FORMULA_0866_VTAB /end COMPU_METHOD
/begin COMPU_VTAB FORMULA_0866_VTAB "FORMULA_0866_VTAB" TAB_VERB 1 0 "Zyl. 7 ok." DEFAULT_VALUE "Fehler Verbr. Zyl. 7." /end COMPU_VTAB
/begin COMPU_METHOD FORMULA_0867 "FORMULA_0867" TAB_VERB "%7.0" "-" COMPU_TAB_REF FORMULA_0867_VTAB /end COMPU_METHOD
/begin COMPU_VTAB FORMULA_0867_VTAB "FORMULA_0867_VTAB" TAB_VERB 1 0 "Zyl. 8 ok." DEFAULT_VALUE "Fehler Verbr. Zyl. 8." /end COMPU_VTAB
/begin COMPU_METHOD FORMULA_0868 "FORMULA_0868" TAB_VERB "%7.0" "-" COMPU_TAB_REF FORMULA_0868_VTAB /end COMPU_METHOD
/begin COMPU_VTAB FORMULA_0868_VTAB "FORMULA_0868_VTAB" TAB_VERB 1 0 "Zyl. 9 ok." DEFAULT_VALUE "Fehler Verbr. Zyl. 9." /end COMPU_VTAB
/begin COMPU_METHOD FORMULA_0869 "FORMULA_0869" TAB_VERB "%7.0" "-" COMPU_TAB_REF FORMULA_0869_VTAB /end COMPU_METHOD
/begin COMPU_VTAB FORMULA_0869_VTAB "FORMULA_0869_VTAB" TAB_VERB 1 0 "Zyl. 10 ok." DEFAULT_VALUE "Fehler Verbr. Zyl. 10." /end COMPU_VTAB
/begin COMPU_METHOD FORMULA_0870 "FORMULA_0870" TAB_VERB "%7.0" "-" COMPU_TAB_REF FORMULA_0870_VTAB /end COMPU_METHOD
/begin COMPU_VTAB FORMULA_0870_VTAB "FORMULA_0870_VTAB" TAB_VERB 1 0 "Kein Nebenschluss." DEFAULT_VALUE "Fehler Nebenschluss." /end COMPU_VTAB
/begin COMPU_METHOD FORMULA_0871 "FORMULA_0871" TAB_VERB "%7.0" "-" COMPU_TAB_REF FORMULA_0871_VTAB /end COMPU_METHOD
/begin COMPU_VTAB FORMULA_0871_VTAB "FORMULA_0871_VTAB" TAB_VERB 1 0 "Zyl. 1 ok." DEFAULT_VALUE "Fehler Nebenschluss. Zyl. 1." /end COMPU_VTAB
/begin COMPU_METHOD FORMULA_0872 "FORMULA_0872" TAB_VERB "%7.0" "-" COMPU_TAB_REF FORMULA_0872_VTAB /end COMPU_METHOD
/begin COMPU_VTAB FORMULA_0872_VTAB "FORMULA_0872_VTAB" TAB_VERB 1 0 "Zyl. 2 ok." DEFAULT_VALUE "Fehler Nebenschluss. Zyl. 2." /end COMPU_VTAB
/begin COMPU_METHOD FORMULA_0873 "FORMULA_0873" TAB_VERB "%7.0" "-" COMPU_TAB_REF FORMULA_0873_VTAB /end COMPU_METHOD
/begin COMPU_VTAB FORMULA_0873_VTAB "FORMULA_0873_VTAB" TAB_VERB 1 0 "Zyl. 3 ok." DEFAULT_VALUE "Fehler Nebenschluss. Zyl. 3." /end COMPU_VTAB
/begin COMPU_METHOD FORMULA_0874 "FORMULA_0874" TAB_VERB "%7.0" "-" COMPU_TAB_REF FORMULA_0874_VTAB /end COMPU_METHOD
/begin COMPU_VTAB FORMULA_0874_VTAB "FORMULA_0874_VTAB" TAB_VERB 1 0 "Zyl. 4 ok." DEFAULT_VALUE "Fehler Nebenschluss. Zyl. 4." /end COMPU_VTAB
/begin COMPU_METHOD FORMULA_0875 "FORMULA_0875" TAB_VERB "%7.0" "-" COMPU_TAB_REF FORMULA_0875_VTAB /end COMPU_METHOD
/begin COMPU_VTAB FORMULA_0875_VTAB "FORMULA_0875_VTAB" TAB_VERB 1 0 "Zyl. 5 ok." DEFAULT_VALUE "Fehler Nebenschluss. Zyl. 5." /end COMPU_VTAB
/begin COMPU_METHOD FORMULA_0876 "FORMULA_0876" TAB_VERB "%7.0" "-" COMPU_TAB_REF FORMULA_0876_VTAB /end COMPU_METHOD
/begin COMPU_VTAB FORMULA_0876_VTAB "FORMULA_0876_VTAB" TAB_VERB 1 0 "Zyl. 6 ok." DEFAULT_VALUE "Fehler Nebenschluss. Zyl. 6." /end COMPU_VTAB
/begin COMPU_METHOD FORMULA_0877 "FORMULA_0877" TAB_VERB "%7.0" "-" COMPU_TAB_REF FORMULA_0877_VTAB /end COMPU_METHOD
/begin COMPU_VTAB FORMULA_0877_VTAB "FORMULA_0877_VTAB" TAB_VERB 1 0 "Zyl. 7 ok." DEFAULT_VALUE "Fehler Nebenschluss. Zyl. 7." /end COMPU_VTAB
/begin COMPU_METHOD FORMULA_0878 "FORMULA_0878" TAB_VERB "%7.0" "-" COMPU_TAB_REF FORMULA_0878_VTAB /end COMPU_METHOD
/begin COMPU_VTAB FORMULA_0878_VTAB "FORMULA_0878_VTAB" TAB_VERB 1 0 "Zyl. 8 ok." DEFAULT_VALUE "Fehler Nebenschluss. Zyl. 8." /end COMPU_VTAB
/begin COMPU_METHOD FORMULA_0879 "FORMULA_0879" TAB_VERB "%7.0" "-" COMPU_TAB_REF FORMULA_0879_VTAB /end COMPU_METHOD
/begin COMPU_VTAB FORMULA_0879_VTAB "FORMULA_0879_VTAB" TAB_VERB 1 0 "Zyl. 9 ok." DEFAULT_VALUE "Fehler Nebenschluss. Zyl. 9." /end COMPU_VTAB
/begin COMPU_METHOD FORMULA_0880 "FORMULA_0880" TAB_VERB "%7.0" "-" COMPU_TAB_REF FORMULA_0880_VTAB /end COMPU_METHOD
/begin COMPU_VTAB FORMULA_0880_VTAB "FORMULA_0880_VTAB" TAB_VERB 1 0 "Zyl. 10 ok." DEFAULT_VALUE "Fehler Nebenschluss. Zyl. 10." /end COMPU_VTAB
/begin COMPU_METHOD FORMULA_0881 "FORMULA_0881" TAB_VERB "%7.0" "-" COMPU_TAB_REF FORMULA_0881_VTAB /end COMPU_METHOD
/begin COMPU_VTAB FORMULA_0881_VTAB "FORMULA_0881_VTAB" TAB_VERB 11 0 "Aus" 511 "Aktiv" 505 "Einspr. aus" 509 "Einspr. aus" 507 "Zuendung aus" 503 "Rueckziehwinkel" 495 "N Schwelle" 479 "RF Schwelle" 447 "Diag. Fehler" 383 "Pos. Dynamik" 255 "Neg. Dynamik" DEFAULT_VALUE "Idle" /end COMPU_VTAB
/begin COMPU_METHOD FORMULA_0882 "FORMULA_0882" RAT_FUNC "%8.1" "Grad" COEFFS 0 10 0 0 0 1 /end COMPU_METHOD
/begin COMPU_METHOD FORMULA_0883 "FORMULA_0883" TAB_VERB "%7.0" "-" COMPU_TAB_REF FORMULA_0883_VTAB /end COMPU_METHOD
/begin COMPU_VTAB FORMULA_0883_VTAB "FORMULA_0883_VTAB" TAB_VERB 1 0 "Kein Klopfen." DEFAULT_VALUE "Klopfen Erkannt." /end COMPU_VTAB
/begin COMPU_METHOD FORMULA_0884 "FORMULA_0884" RAT_FUNC "%9.2" "*" COEFFS 0 1024 0 0 0 1 /end COMPU_METHOD
/begin COMPU_METHOD FORMULA_0885 "FORMULA_0885" RAT_FUNC "%5.0" "Volt" COEFFS 0 1 0 0 0 0.00080566 /end COMPU_METHOD
/begin COMPU_METHOD FORMULA_0886 "FORMULA_0886" RAT_FUNC "%5.0" "Bar" COEFFS 0 1 0 0 0 0.03223 /end COMPU_METHOD
/begin COMPU_METHOD FORMULA_0887 "FORMULA_0887" RAT_FUNC "%6.1" "Grad" COEFFS 0 100 0 0 0 1 /end COMPU_METHOD
/* ------------------ Abschnitt erzeugt aus debug.dat ------------------ */
/begin CHARACTERISTIC K_DEBUG_READ_ADR "Read Address | EN: Debug read address" VALUE 0x70C4C TKW_VV_VV_UL 100.0 FORMULA_0041 0.0 4294967295.0000 FORMAT "%5.2" /end CHARACTERISTIC
/begin CHARACTERISTIC K_DEBUG_WRITE_ADR "Write Address | EN: Debug write address" VALUE 0x70C50 TKW_VV_VV_UL 100.0 FORMULA_0041 0.0 4294967295.0000 FORMAT "%5.2" /end CHARACTERISTIC
/begin CHARACTERISTIC K_DEBUG_WRITE_VALUE "Write VALUE | EN: Debug write value" VALUE 0x70C54 TKW_VV_VV_UL 100.0 FORMULA_0041 0.0 4294967295.0000 FORMAT "%5.2" /end CHARACTERISTIC
/begin CHARACTERISTIC K_DEBUG_RW_LENGTH "Read/-Write Length | EN: Debug read/write length" VALUE 0x70C58 TKW_VV_VV_UB 100.0 FORMULA_0033 0.0 255.0000 /end CHARACTERISTIC
/begin MEASUREMENT hwTaskCtr "Counter" UWORD FORMULA_0010 0 0 0.0 65535.0000 ECU_ADDRESS 0x3FB53C /end MEASUREMENT
/begin MEASUREMENT syncTaskCtr "Counter" UWORD FORMULA_0010 0 0 0.0 65535.0000 ECU_ADDRESS 0x3FB53E /end MEASUREMENT
/begin MEASUREMENT r1msTaskCtr "Counter" UWORD FORMULA_0010 0 0 0.0 65535.0000 ECU_ADDRESS 0x3FB540 /end MEASUREMENT
/begin MEASUREMENT r5msTaskCtr "Counter" UWORD FORMULA_0010 0 0 0.0 65535.0000 ECU_ADDRESS 0x3FB542 /end MEASUREMENT
/begin MEASUREMENT r10msTaskCtr "Counter" ULONG FORMULA_0000 0 0 0.0 4294967295.0000 ECU_ADDRESS 0x3FB544 /end MEASUREMENT
/begin MEASUREMENT r100msTaskCtr "Counter" UWORD FORMULA_0010 0 0 0.0 65535.0000 ECU_ADDRESS 0x3FB548 /end MEASUREMENT
/begin MEASUREMENT r1sTaskCtr "Counter" UWORD FORMULA_0010 0 0 0.0 65535.0000 ECU_ADDRESS 0x3FB54A /end MEASUREMENT
/begin MEASUREMENT bgTaskCtr "Counter" UWORD FORMULA_0010 0 0 0.0 65535.0000 ECU_ADDRESS 0x3FB54C /end MEASUREMENT
/begin MEASUREMENT cana_ctBoffDbounce "BusOff-Counter" UBYTE FORMULA_0003 0 0 0.0 255.0000 ECU_ADDRESS 0x3FB54E /end MEASUREMENT
/begin MEASUREMENT canb_ctBoffDbounce "BusOff-Counter" UBYTE FORMULA_0003 0 0 0.0 255.0000 ECU_ADDRESS 0x3FB54F /end MEASUREMENT
/begin MEASUREMENT debug_rw_result "Result Read/-Write Operation" ULONG FORMULA_0000 0 0 0.0 4294967295.0000 ECU_ADDRESS 0x3FB550 /end MEASUREMENT
/* ------------------ Abschnitt erzeugt aus diag_tr_ed.dat ------------------ */
/begin CHARACTERISTIC K_DIAG_TR_UB_MIN "UB-Schwelle ab der die Treiberdiagnose beginnen | EN: Battery-voltage threshold above which driver diagnosis starts" VALUE 0x70C5A TKW_VV_VV_SW 100.0 FORMULA_0008 0.0 28.0000 FORMAT "%4.1" /end CHARACTERISTIC
/begin MEASUREMENT ed_debug_laufzeit "Laufzeitmessung" ULONG FORMULA_0074 0 0 0.0 4294967295.0000 ECU_ADDRESS 0x3FB61C /end MEASUREMENT
/* ------------------ Abschnitt erzeugt aus eeprom.dat ------------------ */
/begin MEASUREMENT eeprom_seite_lesen "Wo wurde der letzte Datensatz gefunden" UBYTE FORMULA_0080 0 0 0.0 255.0 ECU_ADDRESS 0x3FB620 /end MEASUREMENT
/begin MEASUREMENT eeprom_seite_lesen_hdw "Wo wurde der letzte HDW-Datensatz gefunden" UBYTE FORMULA_0080 0 0 0.0 255.0 ECU_ADDRESS 0x3FB621 /end MEASUREMENT
/begin MEASUREMENT eeprom_seite_schreiben "Wo hin soll der naechste Datensatz geschrieben werden" UBYTE FORMULA_0081 0 0 0.0 255.0 ECU_ADDRESS 0x3FB622 /end MEASUREMENT
/begin MEASUREMENT eeprom_st "Status der EEPROM-Emulation" UBYTE FORMULA_0082 0 0 0.0 255.0 ECU_ADDRESS 0x3FB623 /end MEASUREMENT
/* ------------------ Abschnitt erzeugt aus n.dat ------------------ */
/begin CHARACTERISTIC K_N_ZEIT_STOERUNG "Einfrierzeit Drehzahlerfassung nach TPU Stoerung | EN: Freeze time of speed sensing after TPU fault [s]" VALUE 0x7868C TKW_VV_VV_SB 100.0 FORMULA_0317 0.0 1.2700 /end CHARACTERISTIC
/begin CHARACTERISTIC K_N_OBERGRENZE "Plausibilitaetsgrenze fuer die n-Erfassung | EN: Plausibility limit for engine-speed sensing [Upm]" VALUE 0x7868E TKW_VV_VV_SW 100.0 FORMULA_0006 0.0 20000.0000 /end CHARACTERISTIC
/begin CHARACTERISTIC K_N_MIN_FREEZE "Minimale Eintrittsdrehzahl fuer Drehzahl-Freeze | EN: Minimum entry speed for engine-speed freeze [Upm]" VALUE 0x78690 TKW_VV_VV_SW 100.0 FORMULA_0006 0.0 10000.0000 /end CHARACTERISTIC
/begin MEASUREMENT n_st_a "Status Drehzahlerfassung" UBYTE FORMULA_0348 0 0 0.0 255.0 ECU_ADDRESS 0x3FC11C /end MEASUREMENT
/begin MEASUREMENT n_st_b "Status Drehzahlerfassung" UBYTE FORMULA_0348 0 0 0.0 255.0 ECU_ADDRESS 0x3FC11D /end MEASUREMENT
/begin MEASUREMENT n_timer_stoerung_a "Zeitzaehler fuer Freeze Drehzahlerfassung" SBYTE FORMULA_0317 0 0 -1.2800 1.2700 ECU_ADDRESS 0x3FC11E /end MEASUREMENT
/begin MEASUREMENT n_timer_stoerung_b "Zeitzaehler fuer Freeze Drehzahlerfassung" SBYTE FORMULA_0317 0 0 -1.2800 1.2700 ECU_ADDRESS 0x3FC11F /end MEASUREMENT
/begin MEASUREMENT n_proz "Ersatzdrehzahl des jeweiligen Prozessors." SWORD FORMULA_0006 0 0 0.0 10000.0000 ECU_ADDRESS 0x3FC120 /end MEASUREMENT
/begin MEASUREMENT n_zahn_a "Drehzahl aus Zahnabstand" SWORD FORMULA_0006 0 0 0.0 10000.0000 ECU_ADDRESS 0x3FC122 /end MEASUREMENT
/begin MEASUREMENT n_zahn_b "Drehzahl aus Zahnabstand" SWORD FORMULA_0006 0 0 0.0 10000.0000 ECU_ADDRESS 0x3FC124 /end MEASUREMENT
/begin MEASUREMENT n_segm_a "Drehzahl aus Segmentabstand." SWORD FORMULA_0006 0 0 0.0 10000.0000 ECU_ADDRESS 0x3FC126 /end MEASUREMENT
/begin MEASUREMENT n_segm_b "Drehzahl aus Segmentabstand." SWORD FORMULA_0006 0 0 0.0 10000.0000 ECU_ADDRESS 0x3FC128 /end MEASUREMENT
/begin MEASUREMENT n_t_segm_a "Segmentzeit." UWORD FORMULA_0349 0 0 0.0 104.8560 ECU_ADDRESS 0x3FC12A /end MEASUREMENT
/begin MEASUREMENT n_t_segm_b "Segmentzeit." UWORD FORMULA_0349 0 0 0.0 104.8560 ECU_ADDRESS 0x3FC12C /end MEASUREMENT
/begin MEASUREMENT n_t_segm_start_a "Segmentstartzeit." ULONG FORMULA_0017 0 0 0.0 2396.7450 ECU_ADDRESS 0x3FC130 /end MEASUREMENT
/begin MEASUREMENT n_t_segm_start_b "Segmentstartzeit." ULONG FORMULA_0017 0 0 0.0 2396.7450 ECU_ADDRESS 0x3FC134 /end MEASUREMENT
/* ------------------ Abschnitt erzeugt aus dsp.dat ------------------ */
/begin MEASUREMENT dsp_bus_cnt "DSP bus error counter." UBYTE FORMULA_0003 0 0 0.0 255.0000 ECU_ADDRESS 0x3FE75C /end MEASUREMENT
/begin MEASUREMENT dsp_alive_cnt "DSP Alive Counter." UBYTE FORMULA_0003 0 0 0.0 255.0000 ECU_ADDRESS 0x3FB560 /end MEASUREMENT
/begin MEASUREMENT dsp_alive_cnt_old "Letzten DSP Alive Counter." UBYTE FORMULA_0003 0 0 0.0 255.0000 ECU_ADDRESS 0x3FB561 /end MEASUREMENT
/begin MEASUREMENT dsp_alive_cnt_err "Fehlerzaehler DSP Alive Fehlerzaehler." UBYTE FORMULA_0003 0 0 0.0 255.0000 ECU_ADDRESS 0x3FB562 /end MEASUREMENT
/begin MEASUREMENT dsp_stack_cnt_err "Fehlerzaehler Stack Fehlerzaehler." UBYTE FORMULA_0003 0 0 0.0 255.0000 ECU_ADDRESS 0x3FB563 /end MEASUREMENT
/begin MEASUREMENT dsp_zyl_err "Fehlerzaehler DSP Zylinderueberwachung." UBYTE FORMULA_0003 0 0 0.0 255.0000 ECU_ADDRESS 0x3FB564 /end MEASUREMENT
/begin MEASUREMENT dsp_dma_st "DSP DMA status." UBYTE FORMULA_0581 0 0 0.0 255.0 ECU_ADDRESS 0x3FB565 /end MEASUREMENT
/begin MEASUREMENT dsp_status "DSP status." UWORD FORMULA_0582 0 0 0.0 65535.0 ECU_ADDRESS 0x3FB566 /end MEASUREMENT
/begin MEASUREMENT dsp_stack_unused "DSP unused stack space counter." UWORD FORMULA_0010 0 0 0.0 65535.0000 ECU_ADDRESS 0x3FB568 /end MEASUREMENT
/begin MEASUREMENT dsp_load "DSP Lastanzeige." UWORD FORMULA_0583 0 0 0.0 100.0000 ECU_ADDRESS 0x3FB56A /end MEASUREMENT
/begin MEASUREMENT dsp_irq_cnt "DSP interrupt counter." UWORD FORMULA_0010 0 0 0.0 65535.0000 ECU_ADDRESS 0x3FB56C /end MEASUREMENT
/begin MEASUREMENT dsp_zyl_st "Quitierung DSP Zylinderueberwachung." UWORD FORMULA_0010 0 0 0.0 65535.0000 ECU_ADDRESS 0x3FB56E /end MEASUREMENT
/begin MEASUREMENT dsp_cnt_b1 "DSP counter." UWORD FORMULA_0010 0 0 0.0 65535.0000 ECU_ADDRESS 0x3FB570 /end MEASUREMENT
/begin MEASUREMENT dsp_cnt_b2 "DSP counter." UWORD FORMULA_0010 0 0 0.0 65535.0000 ECU_ADDRESS 0x3FB572 /end MEASUREMENT
/begin MEASUREMENT dsp_bank_cnt_b1 "DSP bank counter." UWORD FORMULA_0010 0 0 0.0 65535.0000 ECU_ADDRESS 0x3FB574 /end MEASUREMENT
/begin MEASUREMENT dsp_bank_cnt_b2 "DSP bank counter." UWORD FORMULA_0010 0 0 0.0 65535.0000 ECU_ADDRESS 0x3FB576 /end MEASUREMENT
/begin MEASUREMENT dsp_zyl1 "DSP cylinder counter." UWORD FORMULA_0010 0 0 0.0 65535.0000 ECU_ADDRESS 0x3FB578 /end MEASUREMENT
/begin MEASUREMENT dsp_zyl2 "DSP cylinder counter." UWORD FORMULA_0010 0 0 0.0 65535.0000 ECU_ADDRESS 0x3FB57A /end MEASUREMENT
/begin MEASUREMENT dsp_zyl3 "DSP cylinder counter." UWORD FORMULA_0010 0 0 0.0 65535.0000 ECU_ADDRESS 0x3FB57C /end MEASUREMENT
/begin MEASUREMENT dsp_zyl4 "DSP cylinder counter." UWORD FORMULA_0010 0 0 0.0 65535.0000 ECU_ADDRESS 0x3FB57E /end MEASUREMENT
/begin MEASUREMENT dsp_zyl5 "DSP cylinder counter." UWORD FORMULA_0010 0 0 0.0 65535.0000 ECU_ADDRESS 0x3FB580 /end MEASUREMENT
/begin MEASUREMENT dsp_zyl6 "DSP cylinder counter." UWORD FORMULA_0010 0 0 0.0 65535.0000 ECU_ADDRESS 0x3FB582 /end MEASUREMENT
/begin MEASUREMENT dsp_zyl7 "DSP cylinder counter." UWORD FORMULA_0010 0 0 0.0 65535.0000 ECU_ADDRESS 0x3FB584 /end MEASUREMENT
/begin MEASUREMENT dsp_zyl8 "DSP cylinder counter." UWORD FORMULA_0010 0 0 0.0 65535.0000 ECU_ADDRESS 0x3FB586 /end MEASUREMENT
/begin MEASUREMENT dsp_zyl9 "DSP cylinder counter." UWORD FORMULA_0010 0 0 0.0 65535.0000 ECU_ADDRESS 0x3FB588 /end MEASUREMENT
/begin MEASUREMENT dsp_zyl10 "DSP cylinder counter." UWORD FORMULA_0010 0 0 0.0 65535.0000 ECU_ADDRESS 0x3FB58A /end MEASUREMENT
/begin MEASUREMENT dsp_msgr_0 "DSP Message Register." ULONG FORMULA_0000 0 0 0.0 4294967295.0000 ECU_ADDRESS 0x3FB58C /end MEASUREMENT
/begin MEASUREMENT dsp_msgr_1 "DSP Message Register." ULONG FORMULA_0000 0 0 0.0 4294967295.0000 ECU_ADDRESS 0x3FB590 /end MEASUREMENT
/begin MEASUREMENT dsp_msgr_2 "DSP Message Register." ULONG FORMULA_0000 0 0 0.0 4294967295.0000 ECU_ADDRESS 0x3FB594 /end MEASUREMENT
/begin MEASUREMENT dsp_msgr_3 "DSP Message Register." ULONG FORMULA_0000 0 0 0.0 4294967295.0000 ECU_ADDRESS 0x3FB598 /end MEASUREMENT
/begin MEASUREMENT dsp_msgr_4 "DSP Message Register." ULONG FORMULA_0000 0 0 0.0 4294967295.0000 ECU_ADDRESS 0x3FB59C /end MEASUREMENT
/begin MEASUREMENT dsp_msgr_5 "DSP Message Register." ULONG FORMULA_0000 0 0 0.0 4294967295.0000 ECU_ADDRESS 0x3FB5A0 /end MEASUREMENT
/begin MEASUREMENT dsp_msgr_6 "DSP Message Register." ULONG FORMULA_0000 0 0 0.0 4294967295.0000 ECU_ADDRESS 0x3FB5A4 /end MEASUREMENT
/begin MEASUREMENT dsp_msgr_7 "DSP Message Register." ULONG FORMULA_0000 0 0 0.0 4294967295.0000 ECU_ADDRESS 0x3FB5A8 /end MEASUREMENT
/begin MEASUREMENT dsp_d2p_b1.spark_time "Funkenbrenndauer." ULONG FORMULA_0584 0 0 0.0 24.5760 ECU_ADDRESS 0x3FB5AC /end MEASUREMENT
/begin MEASUREMENT dsp_d2p_b2.spark_time "Funkenbrenndauer." ULONG FORMULA_0584 0 0 0.0 24.5760 ECU_ADDRESS 0x3FB5E0 /end MEASUREMENT
/begin MEASUREMENT dsp_d2p_b1.ns_samples "Laenge Nebenschluss." ULONG FORMULA_0584 0 0 0.0 24.5760 ECU_ADDRESS 0x3FB5B0 /end MEASUREMENT
/begin MEASUREMENT dsp_d2p_b2.ns_samples "Laenge Nebenschluss." ULONG FORMULA_0584 0 0 0.0 24.5760 ECU_ADDRESS 0x3FB5E4 /end MEASUREMENT
/begin MEASUREMENT dsp_d2p_b1.lp_samples "Laenge Aussetzerfenster." ULONG FORMULA_0584 0 0 0.0 24.5760 ECU_ADDRESS 0x3FB5B4 /end MEASUREMENT
/begin MEASUREMENT dsp_d2p_b2.lp_samples "Laenge Aussetzerfenster." ULONG FORMULA_0584 0 0 0.0 24.5760 ECU_ADDRESS 0x3FB5E8 /end MEASUREMENT
/begin MEASUREMENT dsp_d2p_b1.lp_int_value "TP-Integral im Aussetzerfenster." SLONG FORMULA_0585 0 0 0.0 50.0000 ECU_ADDRESS 0x3FB5B8 /end MEASUREMENT
/begin MEASUREMENT dsp_d2p_b2.lp_int_value "TP-Integral im Aussetzerfenster." SLONG FORMULA_0585 0 0 0.0 50.0000 ECU_ADDRESS 0x3FB5EC /end MEASUREMENT
/begin MEASUREMENT dsp_d2p_b1.min_avg_int "Minimalintegral im Aussetzerfenster." SLONG FORMULA_0585 0 0 0.0 50.0000 ECU_ADDRESS 0x3FB5BC /end MEASUREMENT
/begin MEASUREMENT dsp_d2p_b2.min_avg_int "Minimalintegral im Aussetzerfenster." SLONG FORMULA_0585 0 0 0.0 50.0000 ECU_ADDRESS 0x3FB5F0 /end MEASUREMENT
/begin MEASUREMENT dsp_d2p_b1.min_avg_samples "Anzahl Messpunkte Minimalintegral." ULONG FORMULA_0584 0 0 0.0 24.5760 ECU_ADDRESS 0x3FB5C0 /end MEASUREMENT
/begin MEASUREMENT dsp_d2p_b2.min_avg_samples "Anzahl Messpunkte Minimalintegral." ULONG FORMULA_0584 0 0 0.0 24.5760 ECU_ADDRESS 0x3FB5F4 /end MEASUREMENT
/begin MEASUREMENT dsp_d2p_b1.vr_samples "Laenge Klopffenster." ULONG FORMULA_0584 0 0 0.0 24.5760 ECU_ADDRESS 0x3FB5C4 /end MEASUREMENT
/begin MEASUREMENT dsp_d2p_b2.vr_samples "Laenge Klopffenster." ULONG FORMULA_0584 0 0 0.0 24.5760 ECU_ADDRESS 0x3FB5F8 /end MEASUREMENT
/begin MEASUREMENT dsp_d2p_b1.vr_max_value "Maximalwert im Klopffenster." SLONG FORMULA_0586 0 0 0.0 3.3000 ECU_ADDRESS 0x3FB5C8 /end MEASUREMENT
/begin MEASUREMENT dsp_d2p_b2.vr_max_value "Maximalwert im Klopffenster." SLONG FORMULA_0586 0 0 0.0 3.3000 ECU_ADDRESS 0x3FB5FC /end MEASUREMENT
/begin MEASUREMENT dsp_d2p_b1.vr_int_value "TP-Integral im Klopffenster." SLONG FORMULA_0585 0 0 0.0 50.0000 ECU_ADDRESS 0x3FB5CC /end MEASUREMENT
/begin MEASUREMENT dsp_d2p_b2.vr_int_value "TP-Integral im Klopffenster." SLONG FORMULA_0585 0 0 0.0 50.0000 ECU_ADDRESS 0x3FB600 /end MEASUREMENT
/begin MEASUREMENT dsp_d2p_b1.cam_cycle_cnt "Arbeitsspielzaehler." ULONG FORMULA_0000 0 0 0.0 4294967295.0000 ECU_ADDRESS 0x3FB5D0 /end MEASUREMENT
/begin MEASUREMENT dsp_d2p_b2.cam_cycle_cnt "Arbeitsspielzaehler." ULONG FORMULA_0000 0 0 0.0 4294967295.0000 ECU_ADDRESS 0x3FB604 /end MEASUREMENT
/begin MEASUREMENT dsp_d2p_b1.fbs "Energiespektrum." FLOAT32_IEEE FORMULA_0041 0 0 -340282346638528860000000000000000000000.0000 340282346638528860000000000000000000000.0000 ECU_ADDRESS 0x3FB5D4 /end MEASUREMENT
/begin MEASUREMENT dsp_d2p_b2.fbs "Energiespektrum." FLOAT32_IEEE FORMULA_0041 0 0 -340282346638528860000000000000000000000.0000 340282346638528860000000000000000000000.0000 ECU_ADDRESS 0x3FB608 /end MEASUREMENT
/begin MEASUREMENT dsp_d2p_b1.diag_adc_max "Max Rohionensignal im Messfenster." ULONG FORMULA_0586 0 0 0.0 3.3000 ECU_ADDRESS 0x3FB5D8 /end MEASUREMENT
/begin MEASUREMENT dsp_d2p_b2.diag_adc_max "Max Rohionensignal im Messfenster." ULONG FORMULA_0586 0 0 0.0 3.3000 ECU_ADDRESS 0x3FB60C /end MEASUREMENT
/begin MEASUREMENT dsp_d2p_b1.diag_adc_min "Min Rohionensignal im Messfenster." ULONG FORMULA_0586 0 0 0.0 3.3000 ECU_ADDRESS 0x3FB5DC /end MEASUREMENT
/begin MEASUREMENT dsp_d2p_b2.diag_adc_min "Min Rohionensignal im Messfenster." ULONG FORMULA_0586 0 0 0.0 3.3000 ECU_ADDRESS 0x3FB610 /end MEASUREMENT
/* ------------------ Abschnitt erzeugt aus egas.dat ------------------ */
/begin CHARACTERISTIC K_EGAS_CFG_DK "DK-Konfiguration" VALUE 0x719B2 TKW_VV_VV_UB 100.0 FORMULA_0607 0.0 255.0 /end CHARACTERISTIC
/begin CHARACTERISTIC K_EGAS_CFG_LLS "LLS-Konfiguration | EN: 0 no Testmode 1 Testmode ELSE undef LLS-Konfiguration" VALUE 0x719B3 TKW_VV_VV_UB 100.0 FORMULA_0608 0.0 255.0 /end CHARACTERISTIC
/begin CHARACTERISTIC K_EGAS_CFG_WDK "WDK-Konfiguration | EN: 0 Poti normal 1 Poti invers WDK-Konfiguration" VALUE 0x719B4 TKW_VV_VV_UB 100.0 FORMULA_0609 0.0 255.0 /end CHARACTERISTIC
/begin CHARACTERISTIC K_EGAS_CFG_AQ_SOLL "Filter-Konfiguration | EN: 0 aus 1 KH 2 ML 3 KH+ML Filter-Konfiguration" VALUE 0x719B5 TKW_VV_VV_UB 100.0 FORMULA_0610 0.0 255.0 /end CHARACTERISTIC
/begin CHARACTERISTIC K_EGAS_CFG_MCS_SOLL "Konfiguration MCS-Vorgabe | EN: 0 Inaktiv 1 LLS1 2 LLS2 3 LLS1+2 4 DK1 5 LLS1+DK1 8 DK2 10 LLS2+DK2 12 DK1+2 15 Alle 16 Bowdenzug Ko" VALUE 0x719B6 TKW_VV_VV_UB 100.0 FORMULA_0611 0.0 255.0 /end CHARACTERISTIC
/begin CHARACTERISTIC K_EGAS_AQ_SOLL_GRAD_TAU "Tau fuer AQ-Soll | EN: Tau fuer AQ-Soll" VALUE 0x719B7 TKW_VV_VV_UB 100.0 FORMULA_0478 0.0051 1.2800 /end CHARACTERISTIC
/begin CHARACTERISTIC K_EGAS_FT_ERR_SCHW "min. Schwelle fuer FT-Fehler | EN: min. Schwelle fuer FT-Fehler" VALUE 0x719B8 TKW_VV_VV_UB 100.0 FORMULA_0479 0.0 10.0000 /end CHARACTERISTIC
/begin CHARACTERISTIC K_EGAS_SOLL_AQ_TI_OFF "Notlaufquerschnitt bei Bankabschaltung | EN: Notlaufquerschnitt bei Bankabschaltung" VALUE 0x719BA TKW_VV_VV_UW 100.0 FORMULA_0147 0.0 6500.0000 FORMAT "%4.1" /end CHARACTERISTIC
/begin CHARACTERISTIC K_EGAS_SOLL_AQ_KH_N_MAX "Drehzahlschwelle fuer KH-Querschnitt | EN: Drehzahlschwelle fuer KH-Querschnitt" VALUE 0x719BC TKW_VV_VV_SW 100.0 FORMULA_0006 0.0 10000.0000 /end CHARACTERISTIC
/begin CHARACTERISTIC K_EGAS_SOLL_VL_FAK "Anhebung bei Vollast" VALUE 0x719BE TKW_VV_VV_UW 100.0 FORMULA_0612 1.0000 64.9990 FORMAT "%5.2" /end CHARACTERISTIC
/begin CHARACTERISTIC K_EGAS_SOLL_ENTDR_SCHW "dr_rel-Schwelle fuer entdr. Betrieb" VALUE 0x719C0 TKW_VV_VV_SW 100.0 FORMULA_0115 0.0 199.9938 FORMAT "%5.2" /end CHARACTERISTIC
/begin CHARACTERISTIC K_EGAS_SOLL_GT_OFF "Offsetsprung beim Gestaengetest | EN: Offsetsprung beim Gestaengetest" VALUE 0x719C2 TKW_VV_VV_SW 100.0 FORMULA_0001 -10.0000 120.0000 FORMAT "%4.1" /end CHARACTERISTIC
/begin CHARACTERISTIC K_EGAS_SOLL_MCS_LLS "DK-Sollwert | EN: DK-Sollwert" VALUE 0x719C4 TKW_VV_VV_SW 100.0 FORMULA_0001 -10.0000 120.0000 FORMAT "%4.1" /end CHARACTERISTIC
/begin CHARACTERISTIC K_EGAS_SOLL_MCS_DK "DK-Sollwert | EN: DK-Sollwert" VALUE 0x719C6 TKW_VV_VV_SW 100.0 FORMULA_0001 -10.0000 120.0000 FORMAT "%4.1" /end CHARACTERISTIC
/begin CHARACTERISTIC K_EGAS_SOLL_LLS_DK_SCHW "DK-Schwelle fuer LLS-Schwebung | EN: DK-Schwelle fuer LLS - Schwebung" VALUE 0x719C8 TKW_VV_VV_UB 100.0 FORMULA_0479 0.0 25.0000 /end CHARACTERISTIC
/begin CHARACTERISTIC K_EGAS_SOLL_LLS_OFF "Offset fuer LLS-Schwebung | EN: Offset fuer LLS-Schwebung" VALUE 0x719C9 TKW_VV_VV_UB 100.0 FORMULA_0479 0.0 25.0000 /end CHARACTERISTIC
/begin CHARACTERISTIC K_EGAS_SOLL_LLS_DELTA "Rampe fuer LLS-Schwebung | EN: Rampe fuer LLS-Schwebung" VALUE 0x719CA TKW_VV_VV_UB 100.0 FORMULA_0613 0.0 25.0000 /end CHARACTERISTIC
/begin CHARACTERISTIC K_EGAS_WDK_MIN "min. WDK | EN: Minimum throttle angle [V]" VALUE 0x719CC TKW_VV_VV_SW 100.0 FORMULA_0418 0.0 5.0000 FORMAT "%6.3" /end CHARACTERISTIC
/begin CHARACTERISTIC K_EGAS_WDK_MAX "max. WDK | EN: Maximum throttle angle [V]" VALUE 0x719CE TKW_VV_VV_SW 100.0 FORMULA_0418 0.0 5.0000 FORMAT "%6.3" /end CHARACTERISTIC
/begin CHARACTERISTIC K_EGAS_WDK_NORM "Umrechnung V in % | EN: Conversion V to % [%/V]" VALUE 0x719D0 TKW_VV_VV_SW 100.0 FORMULA_0614 0.0 100.0000 FORMAT "%6.3" /end CHARACTERISTIC
/begin CHARACTERISTIC K_EGAS_WDK_A0_TIME "Zeit fuer Konstantwert | EN: Time for constant value [ms]" VALUE 0x719D2 TKW_VV_VV_UB 100.0 FORMULA_0590 0.0 1000.0000 /end CHARACTERISTIC
/begin CHARACTERISTIC K_EGAS_WDK_A0_KONST "A0 konstant | EN: A0 constant [V]" VALUE 0x719D4 TKW_VV_VV_SW 100.0 FORMULA_0418 0.0 0.5000 FORMAT "%6.3" /end CHARACTERISTIC
/begin CHARACTERISTIC K_EGAS_WDK_A0_OFF_B1 "min. A0-Wert | EN: Minimum A0 value" VALUE 0x719D6 TKW_VV_VV_SW 100.0 FORMULA_0418 -2.0000 2.0000 FORMAT "%6.3" /end CHARACTERISTIC
/begin CHARACTERISTIC K_EGAS_WDK_A0_OFF_B2 "min. A0-Wert | EN: Minimum A0 value" VALUE 0x719D8 TKW_VV_VV_SW 100.0 FORMULA_0418 -2.0000 2.0000 FORMAT "%6.3" /end CHARACTERISTIC
/begin CHARACTERISTIC K_EGAS_WDK_A0_MIN "min. A0-Wert | EN: Minimum A0 value [V]" VALUE 0x719DA TKW_VV_VV_SW 100.0 FORMULA_0418 0.0 5.0000 FORMAT "%6.3" /end CHARACTERISTIC
/begin CHARACTERISTIC K_EGAS_WDK_A0_MAX "max. A0-Wert | EN: Maximum A0 value [V]" VALUE 0x719DC TKW_VV_VV_SW 100.0 FORMULA_0418 0.0 5.0000 FORMAT "%6.3" /end CHARACTERISTIC
/begin CHARACTERISTIC K_EGAS_WDK_A0_DFT "Default A0-Wert | EN: Default A0 value [V]" VALUE 0x719DE TKW_VV_VV_SW 100.0 FORMULA_0418 0.0 5.0000 FORMAT "%6.3" /end CHARACTERISTIC
/begin CHARACTERISTIC K_EGAS_WDK_A0_DELTA_MAX "max. A0-Delta | EN: Maximum A0 delta [V]" VALUE 0x719E0 TKW_VV_VV_SW 100.0 FORMULA_0418 0.0 5.0000 FORMAT "%6.3" /end CHARACTERISTIC
/begin CHARACTERISTIC K_EGAS_WDK_A0_ANZAHL "Anzahl der A0-Mittelwerte | EN: Number of A0 averages [mal]" VALUE 0x719E2 TKW_VV_VV_UB 100.0 FORMULA_0420 0.0 250.0000 /end CHARACTERISTIC
/begin CHARACTERISTIC K_EGAS_CAN_ALIVE_ERR_MAX "max. Zeit f�r CAN-Alive | EN: Maximum time for CAN alive signal" VALUE 0x719E3 TKW_VV_VV_UB 100.0 FORMULA_0003 0.0 255.0000 /end CHARACTERISTIC
/begin CHARACTERISTIC K_EGAS_CAN_ED_TSPERR "Wartezeit fuer CAN-Diagnose | EN: Wait time for CAN diagnosis [sec]" VALUE 0x719E4 TKW_VV_VV_UB 100.0 FORMULA_0587 0.0 1.2750 /end CHARACTERISTIC
/begin CHARACTERISTIC K_EGAS_CAN_ED_UB_MIN "min. Ub fuer CAN-Diagnose | EN: Minimum battery voltage for CAN diagnosis [V]" VALUE 0x719E6 TKW_VV_VV_SW 100.0 FORMULA_0008 0.0 28.0000 FORMAT "%4.1" /end CHARACTERISTIC
/begin CHARACTERISTIC K_EGAS_LLS_R_DIAG_CLR "Fehlermaske fuer ClrDiag | EN: Fault mask for ClrDiag" VALUE 0x719E8 TKW_VV_VV_UW 100.0 FORMULA_0010 0.0 65535.0000 /end CHARACTERISTIC
/begin CHARACTERISTIC K_EGAS_LLS_R_DIAG_FAIL "Fehlermaske fuer Failsafe | EN: Fault mask for failsafe" VALUE 0x719EA TKW_VV_VV_UW 100.0 FORMULA_0010 0.0 65535.0000 /end CHARACTERISTIC
/begin CHARACTERISTIC K_EGAS_DK_R_DIAG_CLR "Fehlermaske fuer ClrDiag | EN: Fault mask for ClrDiag" VALUE 0x719EC TKW_VV_VV_UW 100.0 FORMULA_0010 0.0 65535.0000 /end CHARACTERISTIC
/begin CHARACTERISTIC K_EGAS_DK_R_DIAG_FAIL "Fehlermaske fuer Failsafe | EN: Fault mask for failsafe" VALUE 0x719EE TKW_VV_VV_UW 100.0 FORMULA_0010 0.0 65535.0000 /end CHARACTERISTIC
/begin CHARACTERISTIC K_EGAS_LLS_R_DIAG_CLR_MAX "max. Anzahl fuer ClrDiag LLS | EN: Maximum count for ClrDiag, idle air valve" VALUE 0x719F0 TKW_VV_VV_UB 100.0 FORMULA_0003 0.0 255.0000 /end CHARACTERISTIC
/begin CHARACTERISTIC K_EGAS_DK_R_DIAG_CLR_MAX "max. Anzahl fuer ClrDiag DK | EN: Maximum count for ClrDiag, throttle" VALUE 0x719F1 TKW_VV_VV_UB 100.0 FORMULA_0003 0.0 255.0000 /end CHARACTERISTIC
/begin CHARACTERISTIC K_EGAS_T_KL50 "Wartezeit bei KL50 | EN: Wait time at terminal 50 (cranking) [s]" VALUE 0x719F2 TKW_VV_VV_UB 100.0 FORMULA_0352 0.0 1.2750 /end CHARACTERISTIC
/begin CHARACTERISTIC K_EGAS_SOLL_BOWDEN_LLS_F "Fehlermaske fuer Failsafe | EN: Weighting factor" VALUE 0x719F4 TKW_VV_VV_UW 100.0 FORMULA_0075 0.0 4.0000 FORMAT "%6.3" /end CHARACTERISTIC
/begin CHARACTERISTIC KL_EGAS_N_AQ_START_POS "pos. Drehzahlfilter im Start | EN: Positive engine-speed filter during start" CURVE 0x719F6 TKL_SW_VV_UB 100.0 FORMULA_0478 0.0051 1.2800 /begin AXIS_DESCR STD_AXIS n FORMULA_0006 6 0.0 10000.0000 /end AXIS_DESCR /end CHARACTERISTIC
/begin CHARACTERISTIC KL_EGAS_N_AQ_START_NEG "neg. Drehzahlfilter im Start | EN: Negative engine-speed filter during start" CURVE 0x71A0A TKL_SW_VV_UB 100.0 FORMULA_0478 0.0051 1.2800 /begin AXIS_DESCR STD_AXIS n FORMULA_0006 6 0.0 10000.0000 /end AXIS_DESCR /end CHARACTERISTIC
/begin CHARACTERISTIC KF_EGAS_SOLL_AQ "AQ-Sollwert pro Bank | EN: Target charge (rf) from throttle opening area, per bank - core airflow/load model (normal operation)" MAP 0x71A1E TKF_SW_SW_UW 100.0 FORMULA_0147 0.0 6500.0000 /begin AXIS_DESCR STD_AXIS n FORMULA_0006 22 0.0 10000.0000 /end AXIS_DESCR /begin AXIS_DESCR STD_AXIS rf_soll FORMULA_0007 22 0.0 2.0000 FORMAT "%6.3" /end AXIS_DESCR FORMAT "%4.1" /end CHARACTERISTIC
/begin CHARACTERISTIC KF_EGAS_SOLL_AQ_NOTL "AQ-Sollwert Notlauf pro Bank | EN: Target charge (rf) from throttle opening area, per bank - LIMP-HOME (Notlauf) map" MAP 0x71E40 TKF_SW_SW_UW 100.0 FORMULA_0147 0.0 6500.0000 /begin AXIS_DESCR STD_AXIS n FORMULA_0006 22 0.0 10000.0000 /end AXIS_DESCR /begin AXIS_DESCR STD_AXIS rf_soll FORMULA_0007 22 0.0 2.0000 FORMAT "%6.3" /end AXIS_DESCR FORMAT "%4.1" /end CHARACTERISTIC
/begin CHARACTERISTIC KF_EGAS_SOLL_AQ_KH "AQ-Sollwert KH pro Bank" MAP 0x72262 TKF_SW_SW_UW 100.0 FORMULA_0147 0.0 6500.0000 /begin AXIS_DESCR STD_AXIS n FORMULA_0006 18 0.0 10000.0000 /end AXIS_DESCR /begin AXIS_DESCR STD_AXIS rf_soll FORMULA_0007 22 0.0 2.0000 FORMAT "%6.3" /end AXIS_DESCR FORMAT "%4.1" /end CHARACTERISTIC
/begin CHARACTERISTIC KF_EGAS_SOLL_WL_OFFS "Warmlaufkorrektur, Faktor um 0 | EN: Warm-up correction factor" MAP 0x725CC TKF_SW_SW_SW 100.0 FORMULA_0075 -4.0000 4.0000 /begin AXIS_DESCR STD_AXIS n FORMULA_0006 8 0.0 10000.0000 /end AXIS_DESCR /begin AXIS_DESCR STD_AXIS rf FORMULA_0007 8 0.0 2.0000 FORMAT "%6.3" /end AXIS_DESCR FORMAT "%6.3" /end CHARACTERISTIC
/begin CHARACTERISTIC KF_EGAS_SOLL_WL_GEW_F "Warmlaufegwichtungsfaktor, Faktor um 0 | EN: Warm-up weighting factor (factor around 0)" MAP 0x7266E TKF_SW_SW_SW 100.0 FORMULA_0075 -4.0000 4.0000 /begin AXIS_DESCR STD_AXIS time_ml FORMULA_0021 8 0.0 320.0000 FORMAT "%5.2" /end AXIS_DESCR
 /begin AXIS_DESCR STD_AXIS zust_tmot_start FORMULA_0023 8 -50.0000 170.0000 FORMAT "%4.1" /end AXIS_DESCR
 FORMAT "%6.3" /end CHARACTERISTIC
/begin CHARACTERISTIC KF_EGAS_N_AQ_KH_NEG "neg. Drehzahlfilter bei KH" MAP 0x72710 TKF_SW_SW_UB 100.0 FORMULA_0478 0.0051 1.2800 /begin AXIS_DESCR STD_AXIS n FORMULA_0006 8 0.0 10000.0000 /end AXIS_DESCR
 /begin AXIS_DESCR STD_AXIS egas_aq_soll FORMULA_0147 8 0.0 3200.0000 FORMAT "%4.1" /end AXIS_DESCR
/end CHARACTERISTIC
/begin CHARACTERISTIC KF_EGAS_N_AQ_KH_POS "pos. Drehzahlfilter bei KH" MAP 0x72772 TKF_SW_SW_UB 100.0 FORMULA_0478 0.0051 1.2800 /begin AXIS_DESCR STD_AXIS n FORMULA_0006 8 0.0 10000.0000 /end AXIS_DESCR
 /begin AXIS_DESCR STD_AXIS egas_aq_soll FORMULA_0147 8 0.0 3200.0000 FORMAT "%4.1" /end AXIS_DESCR
/end CHARACTERISTIC
/begin CHARACTERISTIC KF_EGAS_N_AQ_ML_NEG "neg. Drehzahlfilter bei ML | EN: Negative speed filter (tau) vs n and target area, engine running" MAP 0x727D4 TKF_SW_SW_UB 100.0 FORMULA_0478 0.0051 1.2800 /begin AXIS_DESCR STD_AXIS n FORMULA_0006 8 0.0 10000.0000 /end AXIS_DESCR
 /begin AXIS_DESCR STD_AXIS egas_aq_soll FORMULA_0147 8 0.0 3200.0000 FORMAT "%4.1" /end AXIS_DESCR
/end CHARACTERISTIC
/begin CHARACTERISTIC KF_EGAS_N_AQ_ML_POS "pos. Drehzahlfilter bei ML" MAP 0x72836 TKF_SW_SW_UB 100.0 FORMULA_0478 0.0051 1.2800 /begin AXIS_DESCR STD_AXIS n FORMULA_0006 8 0.0 10000.0000 /end AXIS_DESCR
 /begin AXIS_DESCR STD_AXIS egas_aq_soll FORMULA_0147 8 0.0 3200.0000 FORMAT "%4.1" /end AXIS_DESCR
/end CHARACTERISTIC
/begin CHARACTERISTIC K_EGAS_SOLL_BOWDEN_MIN "min. LLS-Schwelle | EN: Minimum idle air valve threshold [%]" VALUE 0x7A9DC TKW_VV_VV_SW 100.0 FORMULA_0001 -10.0000 120.0000 FORMAT "%4.1" /end CHARACTERISTIC
/begin MEASUREMENT egas_n_aq "gefilterte Drehzahl" SWORD FORMULA_0006 0 0 0.0 10000.0000 ECU_ADDRESS 0x3FB62C /end MEASUREMENT
/begin MEASUREMENT egas_can_ed_tsperr_lls "Wartezeit CAN-LLS" UBYTE FORMULA_0587 0 0 0.0 1.2750 ECU_ADDRESS 0x3FB62E /end MEASUREMENT
/begin MEASUREMENT egas_can_ed_tsperr_dk "Wartezeit CAN-DK" UBYTE FORMULA_0587 0 0 0.0 1.2750 ECU_ADDRESS 0x3FB62F /end MEASUREMENT
/begin MEASUREMENT egas_st_empf "Egas-Empfangsstaus" UBYTE FORMULA_0588 0 0 0.0 255.0 ECU_ADDRESS 0x3FB630 /end MEASUREMENT
/begin MEASUREMENT egas_st_empf_hys "Egas-Empfangsstaus pro SG-Lauf" UBYTE FORMULA_0588 0 0 0.0 255.0 ECU_ADDRESS 0x3FB631 /end MEASUREMENT
/begin MEASUREMENT egas_aq_soll_fil_b1 "AQ-Soll gefilteret" UWORD FORMULA_0147 0 0 0.0 6500.0000 ECU_ADDRESS 0x3FB632 /end MEASUREMENT
/begin MEASUREMENT egas_aq_soll_fil_b2 "AQ-Soll gefilteret" UWORD FORMULA_0147 0 0 0.0 6500.0000 ECU_ADDRESS 0x3FB634 /end MEASUREMENT
/begin MEASUREMENT egas_aq_soll_lls_b1 "AQ-Soll fuer LLS" UWORD FORMULA_0147 0 0 0.0 6500.0000 ECU_ADDRESS 0x3FB636 /end MEASUREMENT
/begin MEASUREMENT egas_aq_soll_lls_b2 "AQ-Soll fuer LLS" UWORD FORMULA_0147 0 0 0.0 6500.0000 ECU_ADDRESS 0x3FB638 /end MEASUREMENT
/begin MEASUREMENT egas_aq_soll_dk_b1 "AQ-Soll fuer DK" UWORD FORMULA_0147 0 0 0.0 6500.0000 ECU_ADDRESS 0x3FB63A /end MEASUREMENT
/begin MEASUREMENT egas_aq_soll_dk_b2 "AQ-Soll fuer DK" UWORD FORMULA_0147 0 0 0.0 6500.0000 ECU_ADDRESS 0x3FB63C /end MEASUREMENT
/begin MEASUREMENT egas_wdk_b1.abs_roh "nicht korr. U_WDK" SWORD FORMULA_0418 0 0 0.0 5.0000 ECU_ADDRESS 0x3FB640 /end MEASUREMENT
/begin MEASUREMENT egas_wdk_b2.abs_roh "nicht korr. U_WDK" SWORD FORMULA_0418 0 0 0.0 5.0000 ECU_ADDRESS 0x3FB654 /end MEASUREMENT
/begin MEASUREMENT egas_wdk_b1.abs "korr. U_WDK" SWORD FORMULA_0418 0 0 0.0 5.0000 ECU_ADDRESS 0x3FB642 /end MEASUREMENT
/begin MEASUREMENT egas_wdk_b2.abs "korr. U_WDK" SWORD FORMULA_0418 0 0 0.0 5.0000 ECU_ADDRESS 0x3FB656 /end MEASUREMENT
/begin MEASUREMENT egas_wdk_b1.a0_min "min. Wert der Adaption" SWORD FORMULA_0418 0 0 0.0 5.0000 ECU_ADDRESS 0x3FB644 /end MEASUREMENT
/begin MEASUREMENT egas_wdk_b2.a0_min "min. Wert der Adaption" SWORD FORMULA_0418 0 0 0.0 5.0000 ECU_ADDRESS 0x3FB658 /end MEASUREMENT
/begin MEASUREMENT egas_wdk_b1.a0_max "max. Wert der Adaption" SWORD FORMULA_0418 0 0 0.0 5.0000 ECU_ADDRESS 0x3FB646 /end MEASUREMENT
/begin MEASUREMENT egas_wdk_b2.a0_max "max. Wert der Adaption" SWORD FORMULA_0418 0 0 0.0 5.0000 ECU_ADDRESS 0x3FB65A /end MEASUREMENT
/begin MEASUREMENT egas_wdk_b1.a0_vgl "Vergleichswert der Adaption" SWORD FORMULA_0418 0 0 0.0 5.0000 ECU_ADDRESS 0x3FB648 /end MEASUREMENT
/begin MEASUREMENT egas_wdk_b2.a0_vgl "Vergleichswert der Adaption" SWORD FORMULA_0418 0 0 0.0 5.0000 ECU_ADDRESS 0x3FB65C /end MEASUREMENT
/begin MEASUREMENT egas_wdk_b1.a0_sum "Adaptionssumme" SLONG FORMULA_0589 0 0 0.0 5.0000 ECU_ADDRESS 0x3FB64C /end MEASUREMENT
/begin MEASUREMENT egas_wdk_b2.a0_sum "Adaptionssumme" SLONG FORMULA_0589 0 0 0.0 5.0000 ECU_ADDRESS 0x3FB660 /end MEASUREMENT
/begin MEASUREMENT egas_wdk_b1.a0_cnt "Adaptionszaehler" UBYTE FORMULA_0003 0 0 0.0 255.0000 ECU_ADDRESS 0x3FB650 /end MEASUREMENT
/begin MEASUREMENT egas_wdk_b2.a0_cnt "Adaptionszaehler" UBYTE FORMULA_0003 0 0 0.0 255.0000 ECU_ADDRESS 0x3FB664 /end MEASUREMENT
/begin MEASUREMENT egas_wdk_b1.a0_time "Timer fuer Vgl-Wert" UBYTE FORMULA_0590 0 0 0.0 1275.0000 ECU_ADDRESS 0x3FB651 /end MEASUREMENT
/begin MEASUREMENT egas_wdk_b2.a0_time "Timer fuer Vgl-Wert" UBYTE FORMULA_0590 0 0 0.0 1275.0000 ECU_ADDRESS 0x3FB665 /end MEASUREMENT
/begin MEASUREMENT egas_dk_b1.r_sollw "R-Sollwert" SWORD FORMULA_0001 0 0 -10.0000 120.0000 ECU_ADDRESS 0x3FB66C /end MEASUREMENT
/begin MEASUREMENT egas_dk_b2.r_sollw "R-Sollwert" SWORD FORMULA_0001 0 0 -10.0000 120.0000 ECU_ADDRESS 0x3FB688 /end MEASUREMENT
/begin MEASUREMENT egas_dk_b1.r_diag_st "Diagnosestatus" UWORD FORMULA_0431 0 0 0.0 65535.0 ECU_ADDRESS 0x3FB66A /end MEASUREMENT
/begin MEASUREMENT egas_dk_b2.r_diag_st "Diagnosestatus" UWORD FORMULA_0431 0 0 0.0 65535.0 ECU_ADDRESS 0x3FB686 /end MEASUREMENT
/begin MEASUREMENT egas_dk_b1.r_gpos "Istwert (roh)" SWORD FORMULA_0001 0 0 -10.0000 120.0000 ECU_ADDRESS 0x3FB66E /end MEASUREMENT
/begin MEASUREMENT egas_dk_b2.r_gpos "Istwert (roh)" SWORD FORMULA_0001 0 0 -10.0000 120.0000 ECU_ADDRESS 0x3FB68A /end MEASUREMENT
/begin MEASUREMENT egas_dk_b1.r_tv "Tastverhaeltnis" UBYTE FORMULA_0591 0 0 -100.0000 99.2187 ECU_ADDRESS 0x3FB672 /end MEASUREMENT
/begin MEASUREMENT egas_dk_b2.r_tv "Tastverhaeltnis" UBYTE FORMULA_0591 0 0 -100.0000 99.2187 ECU_ADDRESS 0x3FB68E /end MEASUREMENT
/begin MEASUREMENT egas_dk_b1.r_alive "R-Alive" UBYTE FORMULA_0003 0 0 0.0 255.0000 ECU_ADDRESS 0x3FB671 /end MEASUREMENT
/begin MEASUREMENT egas_dk_b2.r_alive "R-Alive" UBYTE FORMULA_0003 0 0 0.0 255.0000 ECU_ADDRESS 0x3FB68D /end MEASUREMENT
/begin MEASUREMENT egas_dk_b1.r_enable "R-Enable" UBYTE FORMULA_0592 0 0 0.0 255.0 ECU_ADDRESS 0x3FB670 /end MEASUREMENT
/begin MEASUREMENT egas_dk_b2.r_enable "R-Enable" UBYTE FORMULA_0592 0 0 0.0 255.0 ECU_ADDRESS 0x3FB68C /end MEASUREMENT
/begin MEASUREMENT egas_dk_b1.r_mode "R-Mode" UBYTE FORMULA_0593 0 0 0.0 255.0 ECU_ADDRESS 0x3FB668 /end MEASUREMENT
/begin MEASUREMENT egas_dk_b2.r_mode "R-Mode" UBYTE FORMULA_0593 0 0 0.0 255.0 ECU_ADDRESS 0x3FB684 /end MEASUREMENT
/begin MEASUREMENT egas_dk_b1.r_adapt_st "R-Adaption" UBYTE FORMULA_0594 0 0 0.0 255.0 ECU_ADDRESS 0x3FB669 /end MEASUREMENT
/begin MEASUREMENT egas_dk_b2.r_adapt_st "R-Adaption" UBYTE FORMULA_0594 0 0 0.0 255.0 ECU_ADDRESS 0x3FB685 /end MEASUREMENT
/begin MEASUREMENT egas_dk_b1.can_st "CAN-Status" UBYTE FORMULA_0126 0 0 0.0 255.0 ECU_ADDRESS 0x3FB673 /end MEASUREMENT
/begin MEASUREMENT egas_dk_b2.can_st "CAN-Status" UBYTE FORMULA_0126 0 0 0.0 255.0 ECU_ADDRESS 0x3FB68F /end MEASUREMENT
/begin MEASUREMENT egas_dk_b1.mode "Mode" UBYTE FORMULA_0433 0 0 0.0 255.0 ECU_ADDRESS 0x3FB674 /end MEASUREMENT
/begin MEASUREMENT egas_dk_b2.mode "Mode" UBYTE FORMULA_0433 0 0 0.0 255.0 ECU_ADDRESS 0x3FB690 /end MEASUREMENT
/begin MEASUREMENT egas_dk_b1.mode_can "DK-Mode CAN" UBYTE FORMULA_0593 0 0 0.0 255.0 ECU_ADDRESS 0x3FB675 /end MEASUREMENT
/begin MEASUREMENT egas_dk_b2.mode_can "DK-Mode CAN" UBYTE FORMULA_0593 0 0 0.0 255.0 ECU_ADDRESS 0x3FB691 /end MEASUREMENT
/begin MEASUREMENT egas_dk_b1.state "State" UBYTE FORMULA_0595 0 0 0.0 255.0 ECU_ADDRESS 0x3FB676 /end MEASUREMENT
/begin MEASUREMENT egas_dk_b2.state "State" UBYTE FORMULA_0595 0 0 0.0 255.0 ECU_ADDRESS 0x3FB692 /end MEASUREMENT
/begin MEASUREMENT egas_dk_b1.state_time "Zeit im akt. State" UWORD FORMULA_0596 0 0 0.0 327.6750 ECU_ADDRESS 0x3FB678 /end MEASUREMENT
/begin MEASUREMENT egas_dk_b2.state_time "Zeit im akt. State" UWORD FORMULA_0596 0 0 0.0 327.6750 ECU_ADDRESS 0x3FB694 /end MEASUREMENT
/begin MEASUREMENT egas_dk_b1.flags "Flags" UBYTE FORMULA_0003 0 0 0.0 255.0000 ECU_ADDRESS 0x3FB67A /end MEASUREMENT
/begin MEASUREMENT egas_dk_b2.flags "Flags" UBYTE FORMULA_0003 0 0 0.0 255.0000 ECU_ADDRESS 0x3FB696 /end MEASUREMENT
/begin MEASUREMENT egas_dk.flags_en_b1 "Enable-Flag" UBYTE FORMULA_0597 0 0 0.0 255.0 ECU_ADDRESS 0x3FB67A BIT_MASK 0x1 /end MEASUREMENT
/begin MEASUREMENT egas_dk.flags_en_b2 "Enable-Flag" UBYTE FORMULA_0597 0 0 0.0 255.0 ECU_ADDRESS 0x3FB696 BIT_MASK 0x1 /end MEASUREMENT
/begin MEASUREMENT egas_dk.flags_tst_b1 "durchgef�hrte Tests" UBYTE FORMULA_0598 0 0 0.0 255.0 ECU_ADDRESS 0x3FB67A BIT_MASK 0x1E /end MEASUREMENT
/begin MEASUREMENT egas_dk.flags_tst_b2 "durchgef�hrte Tests" UBYTE FORMULA_0598 0 0 0.0 255.0 ECU_ADDRESS 0x3FB696 BIT_MASK 0x1E /end MEASUREMENT
/begin MEASUREMENT egas_dk.flags_ftime_b1 "Failtimer abgelaufen" UBYTE FORMULA_0599 0 0 0.0 255.0 ECU_ADDRESS 0x3FB67A BIT_MASK 0x20 /end MEASUREMENT
/begin MEASUREMENT egas_dk.flags_ftime_b2 "Failtimer abgelaufen" UBYTE FORMULA_0599 0 0 0.0 255.0 ECU_ADDRESS 0x3FB696 BIT_MASK 0x20 /end MEASUREMENT
/begin MEASUREMENT egas_dk.flags_nachadapt_b1 "Nachadaption" UBYTE FORMULA_0600 0 0 0.0 255.0 ECU_ADDRESS 0x3FB67A BIT_MASK 0x40 /end MEASUREMENT
/begin MEASUREMENT egas_dk.flags_nachadapt_b2 "Nachadaption" UBYTE FORMULA_0600 0 0 0.0 255.0 ECU_ADDRESS 0x3FB696 BIT_MASK 0x40 /end MEASUREMENT
/begin MEASUREMENT egas_dk.flags_kh_b1 "KH-Querschnitt" UBYTE FORMULA_0601 0 0 0.0 255.0 ECU_ADDRESS 0x3FB67A BIT_MASK 0x80 /end MEASUREMENT
/begin MEASUREMENT egas_dk.flags_kh_b2 "KH-Querschnitt" UBYTE FORMULA_0601 0 0 0.0 255.0 ECU_ADDRESS 0x3FB696 BIT_MASK 0x80 /end MEASUREMENT
/begin MEASUREMENT egas_dk_b1.fail_st "Failsafe-Status" UWORD FORMULA_0602 0 0 0.0 65535.0 ECU_ADDRESS 0x3FB67C /end MEASUREMENT
/begin MEASUREMENT egas_dk_b2.fail_st "Failsafe-Status" UWORD FORMULA_0602 0 0 0.0 65535.0 ECU_ADDRESS 0x3FB698 /end MEASUREMENT
/begin MEASUREMENT egas_dk_b1.alive_err "Zaehler Aliveerror" UBYTE FORMULA_0003 0 0 0.0 255.0000 ECU_ADDRESS 0x3FB67B /end MEASUREMENT
/begin MEASUREMENT egas_dk_b2.alive_err "Zaehler Aliveerror" UBYTE FORMULA_0003 0 0 0.0 255.0000 ECU_ADDRESS 0x3FB697 /end MEASUREMENT
/begin MEASUREMENT egas_dk_b1.fail_cnt "Zaehler Fail-Status" UBYTE FORMULA_0003 0 0 0.0 255.0000 ECU_ADDRESS 0x3FB680 /end MEASUREMENT
/begin MEASUREMENT egas_dk_b2.fail_cnt "Zaehler Fail-Status" UBYTE FORMULA_0003 0 0 0.0 255.0000 ECU_ADDRESS 0x3FB69C /end MEASUREMENT
/begin MEASUREMENT egas_dk_b1.r_diag_clr "Zaehler DiagClr" UBYTE FORMULA_0003 0 0 0.0 255.0000 ECU_ADDRESS 0x3FB681 /end MEASUREMENT
/begin MEASUREMENT egas_dk_b2.r_diag_clr "Zaehler DiagClr" UBYTE FORMULA_0003 0 0 0.0 255.0000 ECU_ADDRESS 0x3FB69D /end MEASUREMENT
/begin MEASUREMENT egas_lls_b1.r_sollw "R-Sollwert" SWORD FORMULA_0001 0 0 -10.0000 120.0000 ECU_ADDRESS 0x3FB6A4 /end MEASUREMENT
/begin MEASUREMENT egas_lls_b2.r_sollw "R-Sollwert" SWORD FORMULA_0001 0 0 -10.0000 120.0000 ECU_ADDRESS 0x3FB6C0 /end MEASUREMENT
/begin MEASUREMENT egas_lls_b1.r_diag_st "Diagnosestatus" UWORD FORMULA_0431 0 0 0.0 65535.0 ECU_ADDRESS 0x3FB6A2 /end MEASUREMENT
/begin MEASUREMENT egas_lls_b2.r_diag_st "Diagnosestatus" UWORD FORMULA_0431 0 0 0.0 65535.0 ECU_ADDRESS 0x3FB6BE /end MEASUREMENT
/begin MEASUREMENT egas_lls_b1.r_gpos "Istwert (roh)" SWORD FORMULA_0001 0 0 -10.0000 120.0000 ECU_ADDRESS 0x3FB6A6 /end MEASUREMENT
/begin MEASUREMENT egas_lls_b2.r_gpos "Istwert (roh)" SWORD FORMULA_0001 0 0 -10.0000 120.0000 ECU_ADDRESS 0x3FB6C2 /end MEASUREMENT
/begin MEASUREMENT egas_lls_b1.r_tv "Tastverhaeltnis" UBYTE FORMULA_0591 0 0 -100.0000 99.2187 ECU_ADDRESS 0x3FB6AA /end MEASUREMENT
/begin MEASUREMENT egas_lls_b2.r_tv "Tastverhaeltnis" UBYTE FORMULA_0591 0 0 -100.0000 99.2187 ECU_ADDRESS 0x3FB6C6 /end MEASUREMENT
/begin MEASUREMENT egas_lls_b1.r_alive "R-Alive" UBYTE FORMULA_0003 0 0 0.0 255.0000 ECU_ADDRESS 0x3FB6A9 /end MEASUREMENT
/begin MEASUREMENT egas_lls_b2.r_alive "R-Alive" UBYTE FORMULA_0003 0 0 0.0 255.0000 ECU_ADDRESS 0x3FB6C5 /end MEASUREMENT
/begin MEASUREMENT egas_lls_b1.r_mode "R-Mode" UBYTE FORMULA_0603 0 0 0.0 255.0 ECU_ADDRESS 0x3FB6A0 /end MEASUREMENT
/begin MEASUREMENT egas_lls_b2.r_mode "R-Mode" UBYTE FORMULA_0603 0 0 0.0 255.0 ECU_ADDRESS 0x3FB6BC /end MEASUREMENT
/begin MEASUREMENT egas_lls_b1.r_adapt_st "Adaptionsstatus" UBYTE FORMULA_0432 0 0 0.0 255.0 ECU_ADDRESS 0x3FB6A1 /end MEASUREMENT
/begin MEASUREMENT egas_lls_b2.r_adapt_st "Adaptionsstatus" UBYTE FORMULA_0432 0 0 0.0 255.0 ECU_ADDRESS 0x3FB6BD /end MEASUREMENT
/begin MEASUREMENT egas_lls_b1.state "State" UBYTE FORMULA_0434 0 0 0.0 255.0 ECU_ADDRESS 0x3FB6AE /end MEASUREMENT
/begin MEASUREMENT egas_lls_b2.state "State" UBYTE FORMULA_0434 0 0 0.0 255.0 ECU_ADDRESS 0x3FB6CA /end MEASUREMENT
/begin MEASUREMENT egas_lls_b1.state_time "Zeit im akt. State" UWORD FORMULA_0596 0 0 0.0 327.6750 ECU_ADDRESS 0x3FB6B0 /end MEASUREMENT
/begin MEASUREMENT egas_lls_b2.state_time "Zeit im akt. State" UWORD FORMULA_0596 0 0 0.0 327.6750 ECU_ADDRESS 0x3FB6CC /end MEASUREMENT
/begin MEASUREMENT egas_lls_b1.mode "LLS-Mode" UBYTE FORMULA_0604 0 0 0.0 255.0 ECU_ADDRESS 0x3FB6AC /end MEASUREMENT
/begin MEASUREMENT egas_lls_b2.mode "LLS-Mode" UBYTE FORMULA_0604 0 0 0.0 255.0 ECU_ADDRESS 0x3FB6C8 /end MEASUREMENT
/begin MEASUREMENT egas_lls_b1.mode_can "LLS-Mode CAN" UBYTE FORMULA_0605 0 0 0.0 255.0 ECU_ADDRESS 0x3FB6AD /end MEASUREMENT
/begin MEASUREMENT egas_lls_b2.mode_can "LLS-Mode CAN" UBYTE FORMULA_0605 0 0 0.0 255.0 ECU_ADDRESS 0x3FB6C9 /end MEASUREMENT
/begin MEASUREMENT egas_lls_b1.can_st "CAN-Status" UBYTE FORMULA_0126 0 0 0.0 255.0 ECU_ADDRESS 0x3FB6AB /end MEASUREMENT
/begin MEASUREMENT egas_lls_b2.can_st "CAN-Status" UBYTE FORMULA_0126 0 0 0.0 255.0 ECU_ADDRESS 0x3FB6C7 /end MEASUREMENT
/begin MEASUREMENT egas_lls_b1.flags "LLS-Flags" UBYTE FORMULA_0003 0 0 0.0 255.0000 ECU_ADDRESS 0x3FB6B2 /end MEASUREMENT
/begin MEASUREMENT egas_lls_b2.flags "LLS-Flags" UBYTE FORMULA_0003 0 0 0.0 255.0000 ECU_ADDRESS 0x3FB6CE /end MEASUREMENT
/begin MEASUREMENT egas_lls.flags_adpt_b1 "Adaptionsflag" UBYTE FORMULA_0606 0 0 0.0 255.0 ECU_ADDRESS 0x3FB6B2 BIT_MASK 0x3 /end MEASUREMENT
/begin MEASUREMENT egas_lls.flags_adpt_b2 "Adaptionsflag" UBYTE FORMULA_0606 0 0 0.0 255.0 ECU_ADDRESS 0x3FB6CE BIT_MASK 0x3 /end MEASUREMENT
/begin MEASUREMENT egas_lls_b1.alive_err "Zaehler Aliveerror" UBYTE FORMULA_0003 0 0 0.0 255.0000 ECU_ADDRESS 0x3FB6B3 /end MEASUREMENT
/begin MEASUREMENT egas_lls_b2.alive_err "Zaehler Aliveerror" UBYTE FORMULA_0003 0 0 0.0 255.0000 ECU_ADDRESS 0x3FB6CF /end MEASUREMENT
/begin MEASUREMENT egas_lls_b1.fail_st "Failsafe-Status" UWORD FORMULA_0602 0 0 0.0 65535.0 ECU_ADDRESS 0x3FB6B4 /end MEASUREMENT
/begin MEASUREMENT egas_lls_b2.fail_st "Failsafe-Status" UWORD FORMULA_0602 0 0 0.0 65535.0 ECU_ADDRESS 0x3FB6D0 /end MEASUREMENT
/begin MEASUREMENT egas_lls_b1.fail_cnt "Zaehler Fail-Status" UBYTE FORMULA_0003 0 0 0.0 255.0000 ECU_ADDRESS 0x3FB6B8 /end MEASUREMENT
/begin MEASUREMENT egas_lls_b2.fail_cnt "Zaehler Fail-Status" UBYTE FORMULA_0003 0 0 0.0 255.0000 ECU_ADDRESS 0x3FB6D4 /end MEASUREMENT
/begin MEASUREMENT egas_lls_b1.r_diag_clr "Zaehler DiagClr" UBYTE FORMULA_0003 0 0 0.0 255.0000 ECU_ADDRESS 0x3FB6B9 /end MEASUREMENT
/begin MEASUREMENT egas_lls_b2.r_diag_clr "Zaehler DiagClr" UBYTE FORMULA_0003 0 0 0.0 255.0000 ECU_ADDRESS 0x3FB6D5 /end MEASUREMENT
/begin MEASUREMENT egas_aq_rf_wl_f "Warmlauffaktor" UWORD FORMULA_0075 0 0 0.0 4.0000 ECU_ADDRESS 0x3FB6D8 /end MEASUREMENT
/begin MEASUREMENT egas_t_kl50 "KL50-Einfluss auf Istposition" UBYTE FORMULA_0352 0 0 0.0 1.2750 ECU_ADDRESS 0x3FB6DA /end MEASUREMENT
/* ------------------ Abschnitt erzeugt aus egas_cmd.dat ------------------ */
/begin MEASUREMENT egas_snd_lls.cmd_b1 "CMD-B1" UBYTE FORMULA_0615 0 0 0.0 255.0 ECU_ADDRESS 0x3FB6DC /end MEASUREMENT
/begin MEASUREMENT egas_snd_lls.cmd_b2 "CMD-B2" UBYTE FORMULA_0616 0 0 0.0 255.0 ECU_ADDRESS 0x3FB6DD /end MEASUREMENT
/begin MEASUREMENT egas_snd_lls.cmd_b1_fifo_1of5_ "CMD-B2" UBYTE FORMULA_0616 0 0 0.0 255.0 ECU_ADDRESS 0x3FB6DE /end MEASUREMENT
/begin MEASUREMENT egas_snd_lls.cmd_b1_fifo_2of5_ "CMD-B2" UBYTE FORMULA_0616 0 0 0.0 255.0 ECU_ADDRESS 0x3FB6DF /end MEASUREMENT
/begin MEASUREMENT egas_snd_lls.cmd_b1_fifo_3of5_ "CMD-B2" UBYTE FORMULA_0616 0 0 0.0 255.0 ECU_ADDRESS 0x3FB6E0 /end MEASUREMENT
/begin MEASUREMENT egas_snd_lls.cmd_b1_fifo_4of5_ "CMD-B2" UBYTE FORMULA_0616 0 0 0.0 255.0 ECU_ADDRESS 0x3FB6E1 /end MEASUREMENT
/begin MEASUREMENT egas_snd_lls.cmd_b1_fifo_5of5_ "CMD-B2" UBYTE FORMULA_0616 0 0 0.0 255.0 ECU_ADDRESS 0x3FB6E2 /end MEASUREMENT
/begin MEASUREMENT egas_snd_lls.cmd_b2_fifo_1of5_ "CMD-B2" UBYTE FORMULA_0616 0 0 0.0 255.0 ECU_ADDRESS 0x3FB6E3 /end MEASUREMENT
/begin MEASUREMENT egas_snd_lls.cmd_b2_fifo_2of5_ "CMD-B2" UBYTE FORMULA_0616 0 0 0.0 255.0 ECU_ADDRESS 0x3FB6E4 /end MEASUREMENT
/begin MEASUREMENT egas_snd_lls.cmd_b2_fifo_3of5_ "CMD-B2" UBYTE FORMULA_0616 0 0 0.0 255.0 ECU_ADDRESS 0x3FB6E5 /end MEASUREMENT
/begin MEASUREMENT egas_snd_lls.cmd_b2_fifo_4of5_ "CMD-B2" UBYTE FORMULA_0616 0 0 0.0 255.0 ECU_ADDRESS 0x3FB6E6 /end MEASUREMENT
/begin MEASUREMENT egas_snd_lls.cmd_b2_fifo_5of5_ "CMD-B2" UBYTE FORMULA_0616 0 0 0.0 255.0 ECU_ADDRESS 0x3FB6E7 /end MEASUREMENT
/begin MEASUREMENT egas_snd_lls.v_ko_vers "Vorgabe KOMM" UBYTE FORMULA_0003 0 0 0.0 255.0000 ECU_ADDRESS 0x3FB6EA /end MEASUREMENT
/begin MEASUREMENT egas_snd_lls.v_bank "Vorgabe BANK" UBYTE FORMULA_0003 0 0 0.0 255.0000 ECU_ADDRESS 0x3FB6EB /end MEASUREMENT
/begin MEASUREMENT egas_snd_lls.v_clr_diag_b1 "Diag Bank1" UWORD FORMULA_0010 0 0 0.0 65535.0000 ECU_ADDRESS 0x3FB6EC /end MEASUREMENT
/begin MEASUREMENT egas_snd_lls.v_clr_diag_b2 "Diag Bank1" UWORD FORMULA_0010 0 0 0.0 65535.0000 ECU_ADDRESS 0x3FB6EE /end MEASUREMENT
/begin MEASUREMENT egas_snd_lls.time "Timeout" UWORD FORMULA_0617 0 0 0.0 327.6750 ECU_ADDRESS 0x3FB6E8 /end MEASUREMENT
/begin MEASUREMENT egas_rec_lls_b1.r_cmd "R-CMD-B1" UBYTE FORMULA_0616 0 0 0.0 255.0 ECU_ADDRESS 0x3FB6F3 /end MEASUREMENT
/begin MEASUREMENT egas_rec_lls_b2.r_cmd "R-CMD-B1" UBYTE FORMULA_0616 0 0 0.0 255.0 ECU_ADDRESS 0x3FB707 /end MEASUREMENT
/begin MEASUREMENT egas_rec_lls_bX.r_cmd "R-CMD-B1" UBYTE FORMULA_0616 0 0 0.0 255.0 ECU_ADDRESS 0x3FB71B /end MEASUREMENT
/begin MEASUREMENT egas_rec_lls_b1.r_bank "Zylinder" UBYTE FORMULA_0003 0 0 0.0 255.0000 ECU_ADDRESS 0x3FB6F4 /end MEASUREMENT
/begin MEASUREMENT egas_rec_lls_b2.r_bank "Zylinder" UBYTE FORMULA_0003 0 0 0.0 255.0000 ECU_ADDRESS 0x3FB708 /end MEASUREMENT
/begin MEASUREMENT egas_rec_lls_bX.r_bank "Zylinder" UBYTE FORMULA_0003 0 0 0.0 255.0000 ECU_ADDRESS 0x3FB71C /end MEASUREMENT
/begin MEASUREMENT egas_rec_lls_b1.r_ko_vers "Kommunikationsversion" UBYTE FORMULA_0003 0 0 0.0 255.0000 ECU_ADDRESS 0x3FB6F5 /end MEASUREMENT
/begin MEASUREMENT egas_rec_lls_b2.r_ko_vers "Kommunikationsversion" UBYTE FORMULA_0003 0 0 0.0 255.0000 ECU_ADDRESS 0x3FB709 /end MEASUREMENT
/begin MEASUREMENT egas_rec_lls_bX.r_ko_vers "Kommunikationsversion" UBYTE FORMULA_0003 0 0 0.0 255.0000 ECU_ADDRESS 0x3FB71D /end MEASUREMENT
/begin MEASUREMENT egas_rec_lls_b1.r_hw_vers "HW-Version" UWORD FORMULA_0010 0 0 0.0 65535.0000 ECU_ADDRESS 0x3FB6F6 /end MEASUREMENT
/begin MEASUREMENT egas_rec_lls_b2.r_hw_vers "HW-Version" UWORD FORMULA_0010 0 0 0.0 65535.0000 ECU_ADDRESS 0x3FB70A /end MEASUREMENT
/begin MEASUREMENT egas_rec_lls_bX.r_hw_vers "HW-Version" UWORD FORMULA_0010 0 0 0.0 65535.0000 ECU_ADDRESS 0x3FB71E /end MEASUREMENT
/begin MEASUREMENT egas_rec_lls_b1.r_sw_vers "SW-Version" UWORD FORMULA_0010 0 0 0.0 65535.0000 ECU_ADDRESS 0x3FB6F8 /end MEASUREMENT
/begin MEASUREMENT egas_rec_lls_b2.r_sw_vers "SW-Version" UWORD FORMULA_0010 0 0 0.0 65535.0000 ECU_ADDRESS 0x3FB70C /end MEASUREMENT
/begin MEASUREMENT egas_rec_lls_bX.r_sw_vers "SW-Version" UWORD FORMULA_0010 0 0 0.0 65535.0000 ECU_ADDRESS 0x3FB720 /end MEASUREMENT
/begin MEASUREMENT egas_rec_lls_b1.r_diag_st "Diagnosestatus" UWORD FORMULA_0010 0 0 0.0 65535.0000 ECU_ADDRESS 0x3FB6FA /end MEASUREMENT
/begin MEASUREMENT egas_rec_lls_b2.r_diag_st "Diagnosestatus" UWORD FORMULA_0010 0 0 0.0 65535.0000 ECU_ADDRESS 0x3FB70E /end MEASUREMENT
/begin MEASUREMENT egas_rec_lls_bX.r_diag_st "Diagnosestatus" UWORD FORMULA_0010 0 0 0.0 65535.0000 ECU_ADDRESS 0x3FB722 /end MEASUREMENT
/begin MEASUREMENT egas_rec_lls_b1.r_set_vers "Kommunikationsversion" UBYTE FORMULA_0003 0 0 0.0 255.0000 ECU_ADDRESS 0x3FB6FC /end MEASUREMENT
/begin MEASUREMENT egas_rec_lls_b2.r_set_vers "Kommunikationsversion" UBYTE FORMULA_0003 0 0 0.0 255.0000 ECU_ADDRESS 0x3FB710 /end MEASUREMENT
/begin MEASUREMENT egas_rec_lls_bX.r_set_vers "Kommunikationsversion" UBYTE FORMULA_0003 0 0 0.0 255.0000 ECU_ADDRESS 0x3FB724 /end MEASUREMENT
/begin MEASUREMENT egas_rec_lls_b1.status "Empfangsstatus" UBYTE FORMULA_0618 0 0 0.0 255.0 ECU_ADDRESS 0x3FB6FE /end MEASUREMENT
/begin MEASUREMENT egas_rec_lls_b2.status "Empfangsstatus" UBYTE FORMULA_0618 0 0 0.0 255.0 ECU_ADDRESS 0x3FB712 /end MEASUREMENT
/begin MEASUREMENT egas_rec_lls_bX.status "Empfangsstatus" UBYTE FORMULA_0618 0 0 0.0 255.0 ECU_ADDRESS 0x3FB726 /end MEASUREMENT
/begin MEASUREMENT egas_rec_lls_b1.cs_err "CS-Error" UBYTE FORMULA_0003 0 0 0.0 255.0000 ECU_ADDRESS 0x3FB6FD /end MEASUREMENT
/begin MEASUREMENT egas_rec_lls_b2.cs_err "CS-Error" UBYTE FORMULA_0003 0 0 0.0 255.0000 ECU_ADDRESS 0x3FB711 /end MEASUREMENT
/begin MEASUREMENT egas_rec_lls_bX.cs_err "CS-Error" UBYTE FORMULA_0003 0 0 0.0 255.0000 ECU_ADDRESS 0x3FB725 /end MEASUREMENT
/begin MEASUREMENT egas_rec_lls_b1.rec_ack "Receive-Ack" UWORD FORMULA_0083 0 0 0.0 65535.0000 ECU_ADDRESS 0x3FB700 /end MEASUREMENT
/begin MEASUREMENT egas_rec_lls_b2.rec_ack "Receive-Ack" UWORD FORMULA_0083 0 0 0.0 65535.0000 ECU_ADDRESS 0x3FB714 /end MEASUREMENT
/begin MEASUREMENT egas_rec_lls_bX.rec_ack "Receive-Ack" UWORD FORMULA_0083 0 0 0.0 65535.0000 ECU_ADDRESS 0x3FB728 /end MEASUREMENT
/begin MEASUREMENT egas_rec_lls_b1.rec_err "Receive-Error" UWORD FORMULA_0083 0 0 0.0 65535.0000 ECU_ADDRESS 0x3FB702 /end MEASUREMENT
/begin MEASUREMENT egas_rec_lls_b2.rec_err "Receive-Error" UWORD FORMULA_0083 0 0 0.0 65535.0000 ECU_ADDRESS 0x3FB716 /end MEASUREMENT
/begin MEASUREMENT egas_rec_lls_bX.rec_err "Receive-Error" UWORD FORMULA_0083 0 0 0.0 65535.0000 ECU_ADDRESS 0x3FB72A /end MEASUREMENT
/begin MEASUREMENT egas_rec_lls_b1.ed "ED-Status" UWORD FORMULA_0619 0 0 0.0 65535.0 ECU_ADDRESS 0x3FB704 /end MEASUREMENT
/begin MEASUREMENT egas_rec_lls_b2.ed "ED-Status" UWORD FORMULA_0619 0 0 0.0 65535.0 ECU_ADDRESS 0x3FB718 /end MEASUREMENT
/begin MEASUREMENT egas_rec_lls_bX.ed "ED-Status" UWORD FORMULA_0619 0 0 0.0 65535.0 ECU_ADDRESS 0x3FB72C /end MEASUREMENT
/begin MEASUREMENT egas_snd_dk.cmd_b1 "CMD-B1" UBYTE FORMULA_0615 0 0 0.0 255.0 ECU_ADDRESS 0x3FB72E /end MEASUREMENT
/begin MEASUREMENT egas_snd_dk.cmd_b2 "CMD-B2" UBYTE FORMULA_0616 0 0 0.0 255.0 ECU_ADDRESS 0x3FB72F /end MEASUREMENT
/begin MEASUREMENT egas_snd_dk.cmd_b1_fifo_1of5_ "CMD-B2" UBYTE FORMULA_0616 0 0 0.0 255.0 ECU_ADDRESS 0x3FB730 /end MEASUREMENT
/begin MEASUREMENT egas_snd_dk.cmd_b1_fifo_2of5_ "CMD-B2" UBYTE FORMULA_0616 0 0 0.0 255.0 ECU_ADDRESS 0x3FB731 /end MEASUREMENT
/begin MEASUREMENT egas_snd_dk.cmd_b1_fifo_3of5_ "CMD-B2" UBYTE FORMULA_0616 0 0 0.0 255.0 ECU_ADDRESS 0x3FB732 /end MEASUREMENT
/begin MEASUREMENT egas_snd_dk.cmd_b1_fifo_4of5_ "CMD-B2" UBYTE FORMULA_0616 0 0 0.0 255.0 ECU_ADDRESS 0x3FB733 /end MEASUREMENT
/begin MEASUREMENT egas_snd_dk.cmd_b1_fifo_5of5_ "CMD-B2" UBYTE FORMULA_0616 0 0 0.0 255.0 ECU_ADDRESS 0x3FB734 /end MEASUREMENT
/begin MEASUREMENT egas_snd_dk.cmd_b2_fifo_1of5_ "CMD-B2" UBYTE FORMULA_0616 0 0 0.0 255.0 ECU_ADDRESS 0x3FB735 /end MEASUREMENT
/begin MEASUREMENT egas_snd_dk.cmd_b2_fifo_2of5_ "CMD-B2" UBYTE FORMULA_0616 0 0 0.0 255.0 ECU_ADDRESS 0x3FB736 /end MEASUREMENT
/begin MEASUREMENT egas_snd_dk.cmd_b2_fifo_3of5_ "CMD-B2" UBYTE FORMULA_0616 0 0 0.0 255.0 ECU_ADDRESS 0x3FB737 /end MEASUREMENT
/begin MEASUREMENT egas_snd_dk.cmd_b2_fifo_4of5_ "CMD-B2" UBYTE FORMULA_0616 0 0 0.0 255.0 ECU_ADDRESS 0x3FB738 /end MEASUREMENT
/begin MEASUREMENT egas_snd_dk.cmd_b2_fifo_5of5_ "CMD-B2" UBYTE FORMULA_0616 0 0 0.0 255.0 ECU_ADDRESS 0x3FB739 /end MEASUREMENT
/begin MEASUREMENT egas_snd_dk.v_ko_vers "Vorgabe KOMM" UBYTE FORMULA_0003 0 0 0.0 255.0000 ECU_ADDRESS 0x3FB73C /end MEASUREMENT
/begin MEASUREMENT egas_snd_dk.v_bank "Vorgabe BANK" UBYTE FORMULA_0003 0 0 0.0 255.0000 ECU_ADDRESS 0x3FB73D /end MEASUREMENT
/begin MEASUREMENT egas_snd_dk.v_clr_diag_b1 "Diag Bank1" UWORD FORMULA_0010 0 0 0.0 65535.0000 ECU_ADDRESS 0x3FB73E /end MEASUREMENT
/begin MEASUREMENT egas_snd_dk.v_clr_diag_b2 "Diag Bank1" UWORD FORMULA_0010 0 0 0.0 65535.0000 ECU_ADDRESS 0x3FB740 /end MEASUREMENT
/begin MEASUREMENT egas_snd_dk.time "Timeout" UWORD FORMULA_0617 0 0 0.0 327.6750 ECU_ADDRESS 0x3FB73A /end MEASUREMENT
/begin MEASUREMENT egas_rec_dk_b1.r_cmd "R-CMD-B1" UBYTE FORMULA_0616 0 0 0.0 255.0 ECU_ADDRESS 0x3FB745 /end MEASUREMENT
/begin MEASUREMENT egas_rec_dk_b2.r_cmd "R-CMD-B1" UBYTE FORMULA_0616 0 0 0.0 255.0 ECU_ADDRESS 0x3FB759 /end MEASUREMENT
/begin MEASUREMENT egas_rec_dk_bX.r_cmd "R-CMD-B1" UBYTE FORMULA_0616 0 0 0.0 255.0 ECU_ADDRESS 0x3FB76D /end MEASUREMENT
/begin MEASUREMENT egas_rec_dk_b1.r_bank "Zylinder" UBYTE FORMULA_0003 0 0 0.0 255.0000 ECU_ADDRESS 0x3FB746 /end MEASUREMENT
/begin MEASUREMENT egas_rec_dk_b2.r_bank "Zylinder" UBYTE FORMULA_0003 0 0 0.0 255.0000 ECU_ADDRESS 0x3FB75A /end MEASUREMENT
/begin MEASUREMENT egas_rec_dk_bX.r_bank "Zylinder" UBYTE FORMULA_0003 0 0 0.0 255.0000 ECU_ADDRESS 0x3FB76E /end MEASUREMENT
/begin MEASUREMENT egas_rec_dk_b1.r_ko_vers "Kommunikationsversion" UBYTE FORMULA_0003 0 0 0.0 255.0000 ECU_ADDRESS 0x3FB747 /end MEASUREMENT
/begin MEASUREMENT egas_rec_dk_b2.r_ko_vers "Kommunikationsversion" UBYTE FORMULA_0003 0 0 0.0 255.0000 ECU_ADDRESS 0x3FB75B /end MEASUREMENT
/begin MEASUREMENT egas_rec_dk_bX.r_ko_vers "Kommunikationsversion" UBYTE FORMULA_0003 0 0 0.0 255.0000 ECU_ADDRESS 0x3FB76F /end MEASUREMENT
/begin MEASUREMENT egas_rec_dk_b1.r_hw_vers "HW-Version" UWORD FORMULA_0010 0 0 0.0 65535.0000 ECU_ADDRESS 0x3FB748 /end MEASUREMENT
/begin MEASUREMENT egas_rec_dk_b2.r_hw_vers "HW-Version" UWORD FORMULA_0010 0 0 0.0 65535.0000 ECU_ADDRESS 0x3FB75C /end MEASUREMENT
/begin MEASUREMENT egas_rec_dk_bX.r_hw_vers "HW-Version" UWORD FORMULA_0010 0 0 0.0 65535.0000 ECU_ADDRESS 0x3FB770 /end MEASUREMENT
/begin MEASUREMENT egas_rec_dk_b1.r_sw_vers "SW-Version" UWORD FORMULA_0010 0 0 0.0 65535.0000 ECU_ADDRESS 0x3FB74A /end MEASUREMENT
/begin MEASUREMENT egas_rec_dk_b2.r_sw_vers "SW-Version" UWORD FORMULA_0010 0 0 0.0 65535.0000 ECU_ADDRESS 0x3FB75E /end MEASUREMENT
/begin MEASUREMENT egas_rec_dk_bX.r_sw_vers "SW-Version" UWORD FORMULA_0010 0 0 0.0 65535.0000 ECU_ADDRESS 0x3FB772 /end MEASUREMENT
/begin MEASUREMENT egas_rec_dk_b1.r_diag_st "Diagnosestatus" UWORD FORMULA_0620 0 0 0.0 65535.0 ECU_ADDRESS 0x3FB74C /end MEASUREMENT
/begin MEASUREMENT egas_rec_dk_b2.r_diag_st "Diagnosestatus" UWORD FORMULA_0620 0 0 0.0 65535.0 ECU_ADDRESS 0x3FB760 /end MEASUREMENT
/begin MEASUREMENT egas_rec_dk_bX.r_diag_st "Diagnosestatus" UWORD FORMULA_0620 0 0 0.0 65535.0 ECU_ADDRESS 0x3FB774 /end MEASUREMENT
/begin MEASUREMENT egas_rec_dk_b1.r_set_vers "Kommunikationsversion" UBYTE FORMULA_0003 0 0 0.0 255.0000 ECU_ADDRESS 0x3FB74E /end MEASUREMENT
/begin MEASUREMENT egas_rec_dk_b2.r_set_vers "Kommunikationsversion" UBYTE FORMULA_0003 0 0 0.0 255.0000 ECU_ADDRESS 0x3FB762 /end MEASUREMENT
/begin MEASUREMENT egas_rec_dk_bX.r_set_vers "Kommunikationsversion" UBYTE FORMULA_0003 0 0 0.0 255.0000 ECU_ADDRESS 0x3FB776 /end MEASUREMENT
/begin MEASUREMENT egas_rec_dk_b1.status "Empfangsstatus" UBYTE FORMULA_0618 0 0 0.0 255.0 ECU_ADDRESS 0x3FB750 /end MEASUREMENT
/begin MEASUREMENT egas_rec_dk_b2.status "Empfangsstatus" UBYTE FORMULA_0618 0 0 0.0 255.0 ECU_ADDRESS 0x3FB764 /end MEASUREMENT
/begin MEASUREMENT egas_rec_dk_bX.status "Empfangsstatus" UBYTE FORMULA_0618 0 0 0.0 255.0 ECU_ADDRESS 0x3FB778 /end MEASUREMENT
/begin MEASUREMENT egas_rec_dk_b1.cs_err "CS-Error" UBYTE FORMULA_0003 0 0 0.0 255.0000 ECU_ADDRESS 0x3FB74F /end MEASUREMENT
/begin MEASUREMENT egas_rec_dk_b2.cs_err "CS-Error" UBYTE FORMULA_0003 0 0 0.0 255.0000 ECU_ADDRESS 0x3FB763 /end MEASUREMENT
/begin MEASUREMENT egas_rec_dk_bX.cs_err "CS-Error" UBYTE FORMULA_0003 0 0 0.0 255.0000 ECU_ADDRESS 0x3FB777 /end MEASUREMENT
/begin MEASUREMENT egas_rec_dk_b1.rec_ack "Receive-Ack" UWORD FORMULA_0083 0 0 0.0 65535.0000 ECU_ADDRESS 0x3FB752 /end MEASUREMENT
/begin MEASUREMENT egas_rec_dk_b2.rec_ack "Receive-Ack" UWORD FORMULA_0083 0 0 0.0 65535.0000 ECU_ADDRESS 0x3FB766 /end MEASUREMENT
/begin MEASUREMENT egas_rec_dk_bX.rec_ack "Receive-Ack" UWORD FORMULA_0083 0 0 0.0 65535.0000 ECU_ADDRESS 0x3FB77A /end MEASUREMENT
/begin MEASUREMENT egas_rec_dk_b1.rec_err "Receive-Error" UWORD FORMULA_0083 0 0 0.0 65535.0000 ECU_ADDRESS 0x3FB754 /end MEASUREMENT
/begin MEASUREMENT egas_rec_dk_b2.rec_err "Receive-Error" UWORD FORMULA_0083 0 0 0.0 65535.0000 ECU_ADDRESS 0x3FB768 /end MEASUREMENT
/begin MEASUREMENT egas_rec_dk_bX.rec_err "Receive-Error" UWORD FORMULA_0083 0 0 0.0 65535.0000 ECU_ADDRESS 0x3FB77C /end MEASUREMENT
/begin MEASUREMENT egas_rec_dk_b1.ed "ED-Status" UWORD FORMULA_0619 0 0 0.0 65535.0 ECU_ADDRESS 0x3FB756 /end MEASUREMENT
/begin MEASUREMENT egas_rec_dk_b2.ed "ED-Status" UWORD FORMULA_0619 0 0 0.0 65535.0 ECU_ADDRESS 0x3FB76A /end MEASUREMENT
/begin MEASUREMENT egas_rec_dk_bX.ed "ED-Status" UWORD FORMULA_0619 0 0 0.0 65535.0 ECU_ADDRESS 0x3FB77E /end MEASUREMENT
/* ------------------ Abschnitt erzeugt aus egas_sk.dat ------------------ */
/begin CHARACTERISTIC K_EGAS_SK_CONTROL "SK-Schalter | EN: Safety-concept switch" VALUE 0x72898 TKW_VV_VV_UB 100.0 FORMULA_0625 0.0 255.0 /end CHARACTERISTIC
/begin CHARACTERISTIC K_EGAS_SK_T_OFFEN "max. Zeit Istwertabweichung | EN: Maximum time for actual-value deviation [s]" VALUE 0x72899 TKW_VV_VV_UB 100.0 FORMULA_0317 0.0 2.5500 /end CHARACTERISTIC
/begin CHARACTERISTIC K_EGAS_SK_TAU_LLS "Filter LLS-Ueberwachung | EN: Filter, idle air valve monitoring [s]" VALUE 0x7289A TKW_VV_VV_UB 100.0 FORMULA_0462 0.0101 2.5600 /end CHARACTERISTIC
/begin CHARACTERISTIC K_EGAS_SK_TAU_DK "Filter DK-Ueberwachung | EN: Filter, throttle monitoring [s]" VALUE 0x7289B TKW_VV_VV_UB 100.0 FORMULA_0462 0.0101 2.5600 /end CHARACTERISTIC
/begin CHARACTERISTIC K_EGAS_SK_SOLL_DIFF "max. Differenz Sollwertabweichung | EN: Maximum difference, setpoint deviation [%]" VALUE 0x7289C TKW_VV_VV_SW 100.0 FORMULA_0001 -10.0000 120.0000 FORMAT "%4.1" /end CHARACTERISTIC
/begin CHARACTERISTIC K_EGAS_SK_SOLL_DIFF_LLS "max. Differenz Sollwertabweichung | EN: Maximum difference, setpoint deviation [%]" VALUE 0x7289E TKW_VV_VV_SW 100.0 FORMULA_0001 -10.0000 120.0000 FORMAT "%4.1" /end CHARACTERISTIC
/begin CHARACTERISTIC K_EGAS_SK_IST_DIFF_LLS "max. Differenz Istwertabweichung | EN: Maximum difference, actual-value deviation [%]" VALUE 0x728A0 TKW_VV_VV_SW 100.0 FORMULA_0001 -10.0000 120.0000 FORMAT "%4.1" /end CHARACTERISTIC
/begin CHARACTERISTIC K_EGAS_SK_T_SOLL "max. Zeit Sollwertabweichung | EN: Maximum time for setpoint deviation [s]" VALUE 0x728A2 TKW_VV_VV_UW 100.0 FORMULA_0021 0.0 10.0000 FORMAT "%5.2" /end CHARACTERISTIC
/begin CHARACTERISTIC K_EGAS_SK_T_WDK "max. Zeit Analog-/CAN-Abweichung | EN: Maximum time for analogue vs CAN deviation [s]" VALUE 0x728A4 TKW_VV_VV_UW 100.0 FORMULA_0021 0.0 10.0000 FORMAT "%5.2" /end CHARACTERISTIC
/begin CHARACTERISTIC K_EGAS_SK_T_IST "max. Zeit Soll-/Istabweichung | EN: Maximum time for setpoint/actual deviation [s]" VALUE 0x728A6 TKW_VV_VV_UW 100.0 FORMULA_0021 0.0 10.0000 FORMAT "%5.2" /end CHARACTERISTIC
/begin CHARACTERISTIC K_EGAS_SK_T_SOLL_LLS "max. Zeit Sollwertabweichung | EN: Maximum time for setpoint deviation [s]" VALUE 0x728A8 TKW_VV_VV_UW 100.0 FORMULA_0021 0.0 10.0000 FORMAT "%5.2" /end CHARACTERISTIC
/begin CHARACTERISTIC K_EGAS_SK_T_IST_LLS "max. Zeit Istwertabweichung | EN: Maximum time for actual-value deviation [s]" VALUE 0x728AA TKW_VV_VV_UW 100.0 FORMULA_0021 0.0 10.0000 FORMAT "%5.2" /end CHARACTERISTIC
/begin CHARACTERISTIC K_EGAS_SK_T_MODE "max. Zeit Modeabweichung | EN: Maximum time for mode deviation [s]" VALUE 0x728AC TKW_VV_VV_UW 100.0 FORMULA_0021 0.0 10.0000 FORMAT "%5.2" /end CHARACTERISTIC
/begin CHARACTERISTIC K_EGAS_SK_T_MODE_INIT "max. Zeit Modeabweichung LLS-Init | EN: Maximum time for mode deviation during idle-valve init [s]" VALUE 0x728AE TKW_VV_VV_UW 100.0 FORMULA_0021 0.0 10.0000 FORMAT "%5.2" /end CHARACTERISTIC
/begin CHARACTERISTIC K_EGAS_SK_T_NP_MAX "max. Dauer fuer NP-Adaption | EN: Maximum duration for zero-point adaptation [sec]" VALUE 0x728B0 TKW_VV_VV_UW 100.0 FORMULA_0596 0.0 327.6750 FORMAT "%5.2" /end CHARACTERISTIC
/begin CHARACTERISTIC K_EGAS_SK_DK_OFFEN_1 "Schwelle fuer Spalt offen | EN: Threshold for gap open [%]" VALUE 0x728B2 TKW_VV_VV_SW 100.0 FORMULA_0001 -10.0000 120.0000 FORMAT "%4.1" /end CHARACTERISTIC
/begin CHARACTERISTIC K_EGAS_SK_DK_OFFEN_2 "Schwelle fuer Klemmen offen | EN: Threshold for clamping open [%]" VALUE 0x728B4 TKW_VV_VV_SW 100.0 FORMULA_0001 -10.0000 120.0000 FORMAT "%4.1" /end CHARACTERISTIC
/begin CHARACTERISTIC K_EGAS_SK_NEUINIT_MAX "max. Anzahl fuer Neuinits | EN: Maximum number of re-initialisations" VALUE 0x728B6 TKW_VV_VV_UB 100.0 FORMULA_0003 0.0 255.0000 /end CHARACTERISTIC
/begin CHARACTERISTIC K_EGAS_SK_FAIL_MAX "max. Anzahl fuer Fail-Status | EN: max. Anzahl fuer Fail-Status" VALUE 0x728B7 TKW_VV_VV_UB 100.0 FORMULA_0003 0.0 255.0000 /end CHARACTERISTIC
/begin CHARACTERISTIC K_EGAS_SK_RF_TSTART "Wartezeit nach Start" VALUE 0x728B8 TKW_VV_VV_UW 100.0 FORMULA_0021 0.0 10.0000 FORMAT "%5.2" /end CHARACTERISTIC
/begin CHARACTERISTIC K_EGAS_SK_RF_IO_OFF "Offset der zulaessigen Differenz wdk-rf" VALUE 0x728BA TKW_VV_VV_SW 100.0 FORMULA_0007 0.0 2.0000 FORMAT "%6.3" /end CHARACTERISTIC
/begin CHARACTERISTIC K_EGAS_SK_RF_IO_FAK "Faktor der zulaessigen Differenz wdk-rf" VALUE 0x728BC TKW_VV_VV_UW 100.0 FORMULA_0075 0.0 4.0000 FORMAT "%6.3" /end CHARACTERISTIC
/begin CHARACTERISTIC K_EGAS_SK_RF_IO_DK "Fehlerschwelle fuer DK iO" VALUE 0x728BE TKW_VV_VV_UB 100.0 FORMULA_0003 0.0 16.0000 /end CHARACTERISTIC
/begin CHARACTERISTIC K_EGAS_SK_RF_IO_WDK "Fehlerschwelle fuer WDK iO" VALUE 0x728BF TKW_VV_VV_UB 100.0 FORMULA_0003 0.0 16.0000 /end CHARACTERISTIC
/begin CHARACTERISTIC K_EGAS_SK_T_RGPOS "max. Zeit CAN-Fehlerkennung | EN: max. Zeit CAN-Fehlerkennung" VALUE 0x728C0 TKW_VV_VV_UB 100.0 FORMULA_0317 0.0 2.0000 /end CHARACTERISTIC
/begin CHARACTERISTIC KL_EGAS_SK_DK_DIFF_MAX "max. Differenz Soll/Ist | EN: Maximum setpoint/actual difference" CURVE 0x728C2 TKL_SW_VV_SW 100.0 FORMULA_0001 -10.0000 120.0000
 /begin AXIS_DESCR STD_AXIS dk_soll FORMULA_0001 4 -10.0000 120.0000 FORMAT "%4.1" /end AXIS_DESCR
 FORMAT "%4.1" /end CHARACTERISTIC
/begin CHARACTERISTIC KL_EGAS_SK_WDK_DIFF "max. Differenz Analog-/CAN-Abweichung | EN: Maximum analogue vs CAN deviation" CURVE 0x728D4 TKL_SW_VV_SW 100.0 FORMULA_0001 -10.0000 120.0000
 /begin AXIS_DESCR STD_AXIS dk_ist FORMULA_0001 4 -10.0000 120.0000 FORMAT "%4.1" /end AXIS_DESCR
 FORMAT "%4.1" /end CHARACTERISTIC
/begin MEASUREMENT egas_sk_b1.zust_dk "SK-Zustand der DK" UBYTE FORMULA_0621 0 0 0.0 255.0 ECU_ADDRESS 0x3FB781 BIT_MASK 0xF /end MEASUREMENT
/begin MEASUREMENT egas_sk_b2.zust_dk "SK-Zustand der DK" UBYTE FORMULA_0621 0 0 0.0 255.0 ECU_ADDRESS 0x3FB7A9 BIT_MASK 0xF /end MEASUREMENT
/begin MEASUREMENT egas_sk.fzust_dk_b1 "SK-Zustand der DK" UBYTE FORMULA_0622 0 0 0.0 255.0 ECU_ADDRESS 0x3FB781 BIT_MASK 0xF0 /end MEASUREMENT
/begin MEASUREMENT egas_sk.fzust_dk_b2 "SK-Zustand der DK" UBYTE FORMULA_0622 0 0 0.0 255.0 ECU_ADDRESS 0x3FB7A9 BIT_MASK 0xF0 /end MEASUREMENT
/begin MEASUREMENT egas_sk_b1.zust_lls "SK-Zustand der LLS" UBYTE FORMULA_0623 0 0 0.0 255.0 ECU_ADDRESS 0x3FB780 /end MEASUREMENT
/begin MEASUREMENT egas_sk_b2.zust_lls "SK-Zustand der LLS" UBYTE FORMULA_0623 0 0 0.0 255.0 ECU_ADDRESS 0x3FB7A8 /end MEASUREMENT
/begin MEASUREMENT egas_sk_b1.dk_diff_max "max. Differenz Soll/Ist" SWORD FORMULA_0001 0 0 -10.0000 120.0000 ECU_ADDRESS 0x3FB782 /end MEASUREMENT
/begin MEASUREMENT egas_sk_b2.dk_diff_max "max. Differenz Soll/Ist" SWORD FORMULA_0001 0 0 -10.0000 120.0000 ECU_ADDRESS 0x3FB7AA /end MEASUREMENT
/begin MEASUREMENT egas_sk_b1.wdk_diff_max "max. Differenz CAN/WDK" SWORD FORMULA_0001 0 0 -10.0000 120.0000 ECU_ADDRESS 0x3FB784 /end MEASUREMENT
/begin MEASUREMENT egas_sk_b2.wdk_diff_max "max. Differenz CAN/WDK" SWORD FORMULA_0001 0 0 -10.0000 120.0000 ECU_ADDRESS 0x3FB7AC /end MEASUREMENT
/begin MEASUREMENT egas_sk_b1.soll_lls "LLS-Sollwert gefiltert" SWORD FORMULA_0001 0 0 -10.0000 120.0000 ECU_ADDRESS 0x3FB79C /end MEASUREMENT
/begin MEASUREMENT egas_sk_b2.soll_lls "LLS-Sollwert gefiltert" SWORD FORMULA_0001 0 0 -10.0000 120.0000 ECU_ADDRESS 0x3FB7C4 /end MEASUREMENT
/begin MEASUREMENT egas_sk_b1.soll_dk "DK-Sollwert gefiltert" SWORD FORMULA_0001 0 0 -10.0000 120.0000 ECU_ADDRESS 0x3FB79A /end MEASUREMENT
/begin MEASUREMENT egas_sk_b2.soll_dk "DK-Sollwert gefiltert" SWORD FORMULA_0001 0 0 -10.0000 120.0000 ECU_ADDRESS 0x3FB7C2 /end MEASUREMENT
/begin MEASUREMENT egas_sk_b1.t_soll_dk "Zeit Sollwertabweichung" UWORD FORMULA_0021 0 0 0.0 10.0000 ECU_ADDRESS 0x3FB786 /end MEASUREMENT
/begin MEASUREMENT egas_sk_b2.t_soll_dk "Zeit Sollwertabweichung" UWORD FORMULA_0021 0 0 0.0 10.0000 ECU_ADDRESS 0x3FB7AE /end MEASUREMENT
/begin MEASUREMENT egas_sk_b1.t_soll_lls "Zeit Sollwertabweichung" UWORD FORMULA_0021 0 0 0.0 10.0000 ECU_ADDRESS 0x3FB788 /end MEASUREMENT
/begin MEASUREMENT egas_sk_b2.t_soll_lls "Zeit Sollwertabweichung" UWORD FORMULA_0021 0 0 0.0 10.0000 ECU_ADDRESS 0x3FB7B0 /end MEASUREMENT
/begin MEASUREMENT egas_sk_b1.t_ist_dk "Zeit Soll-/Istabweichung" UWORD FORMULA_0021 0 0 0.0 10.0000 ECU_ADDRESS 0x3FB78A /end MEASUREMENT
/begin MEASUREMENT egas_sk_b2.t_ist_dk "Zeit Soll-/Istabweichung" UWORD FORMULA_0021 0 0 0.0 10.0000 ECU_ADDRESS 0x3FB7B2 /end MEASUREMENT
/begin MEASUREMENT egas_sk_b1.t_ist_lls "Zeit Soll-/Istabweichung" UWORD FORMULA_0021 0 0 0.0 10.0000 ECU_ADDRESS 0x3FB78C /end MEASUREMENT
/begin MEASUREMENT egas_sk_b2.t_ist_lls "Zeit Soll-/Istabweichung" UWORD FORMULA_0021 0 0 0.0 10.0000 ECU_ADDRESS 0x3FB7B4 /end MEASUREMENT
/begin MEASUREMENT egas_sk_b1.t_wdk "Zeit Analog-/CAN-Abweichung" UWORD FORMULA_0021 0 0 0.0 10.0000 ECU_ADDRESS 0x3FB78E /end MEASUREMENT
/begin MEASUREMENT egas_sk_b2.t_wdk "Zeit Analog-/CAN-Abweichung" UWORD FORMULA_0021 0 0 0.0 10.0000 ECU_ADDRESS 0x3FB7B6 /end MEASUREMENT
/begin MEASUREMENT egas_sk_b1.t_mode_dk "Zeit DK-Modeabweichung" UWORD FORMULA_0021 0 0 0.0 10.0000 ECU_ADDRESS 0x3FB792 /end MEASUREMENT
/begin MEASUREMENT egas_sk_b2.t_mode_dk "Zeit DK-Modeabweichung" UWORD FORMULA_0021 0 0 0.0 10.0000 ECU_ADDRESS 0x3FB7BA /end MEASUREMENT
/begin MEASUREMENT egas_sk_b1.t_mode_lls "Zeit LLS-Modeabweichung" UWORD FORMULA_0021 0 0 0.0 10.0000 ECU_ADDRESS 0x3FB790 /end MEASUREMENT
/begin MEASUREMENT egas_sk_b2.t_mode_lls "Zeit LLS-Modeabweichung" UWORD FORMULA_0021 0 0 0.0 10.0000 ECU_ADDRESS 0x3FB7B8 /end MEASUREMENT
/begin MEASUREMENT egas_sk_b1.dk_off_rampe "DK-Abschaltungrampe" SWORD FORMULA_0624 0 0 -655360.0000 655340.0000 ECU_ADDRESS 0x3FB798 /end MEASUREMENT
/begin MEASUREMENT egas_sk_b2.dk_off_rampe "DK-Abschaltungrampe" SWORD FORMULA_0624 0 0 -655360.0000 655340.0000 ECU_ADDRESS 0x3FB7C0 /end MEASUREMENT
/begin MEASUREMENT egas_sk_b1.t_dk_offen_1 "Zeit fuer Spalt offen" UWORD FORMULA_0021 0 0 0.0 10.0000 ECU_ADDRESS 0x3FB794 /end MEASUREMENT
/begin MEASUREMENT egas_sk_b2.t_dk_offen_1 "Zeit fuer Spalt offen" UWORD FORMULA_0021 0 0 0.0 10.0000 ECU_ADDRESS 0x3FB7BC /end MEASUREMENT
/begin MEASUREMENT egas_sk_b1.t_dk_offen_2 "Zeit fuer Klemmen offen" UWORD FORMULA_0021 0 0 0.0 10.0000 ECU_ADDRESS 0x3FB796 /end MEASUREMENT
/begin MEASUREMENT egas_sk_b2.t_dk_offen_2 "Zeit fuer Klemmen offen" UWORD FORMULA_0021 0 0 0.0 10.0000 ECU_ADDRESS 0x3FB7BE /end MEASUREMENT
/begin MEASUREMENT egas_sk_b1.rf_io_ring "Ringpuffer" UWORD FORMULA_0010 0 0 0.0 65535.0000 ECU_ADDRESS 0x3FB7A0 /end MEASUREMENT
/begin MEASUREMENT egas_sk_b2.rf_io_ring "Ringpuffer" UWORD FORMULA_0010 0 0 0.0 65535.0000 ECU_ADDRESS 0x3FB7C8 /end MEASUREMENT
/begin MEASUREMENT egas_sk_b1.rf_io_delta "Zulaessige Rf-Abweichung" SWORD FORMULA_0007 0 0 0.0 2.0000 ECU_ADDRESS 0x3FB7A2 /end MEASUREMENT
/begin MEASUREMENT egas_sk_b2.rf_io_delta "Zulaessige Rf-Abweichung" SWORD FORMULA_0007 0 0 0.0 2.0000 ECU_ADDRESS 0x3FB7CA /end MEASUREMENT
/begin MEASUREMENT egas_sk_b1.rf_io "iO-Counter" UBYTE FORMULA_0003 0 0 0.0 16.0000 ECU_ADDRESS 0x3FB7A4 /end MEASUREMENT
/begin MEASUREMENT egas_sk_b2.rf_io "iO-Counter" UBYTE FORMULA_0003 0 0 0.0 16.0000 ECU_ADDRESS 0x3FB7CC /end MEASUREMENT
/begin MEASUREMENT egas_sk_b1.t_rgpos_lls "Zeit RGPOS-Fehler" UBYTE FORMULA_0317 0 0 0.0 2.0000 ECU_ADDRESS 0x3FB7A5 /end MEASUREMENT
/begin MEASUREMENT egas_sk_b2.t_rgpos_lls "Zeit RGPOS-Fehler" UBYTE FORMULA_0317 0 0 0.0 2.0000 ECU_ADDRESS 0x3FB7CD /end MEASUREMENT
/begin MEASUREMENT egas_sk_b1.t_rgpos_dk "Zeit RGPOS-Fehler" UBYTE FORMULA_0317 0 0 0.0 2.0000 ECU_ADDRESS 0x3FB7A6 /end MEASUREMENT
/begin MEASUREMENT egas_sk_b2.t_rgpos_dk "Zeit RGPOS-Fehler" UBYTE FORMULA_0317 0 0 0.0 2.0000 ECU_ADDRESS 0x3FB7CE /end MEASUREMENT
/* ------------------ Abschnitt erzeugt aus egas_stm.dat ------------------ */
/begin CHARACTERISTIC K_EGAS_STM_NOINIT_SK "SK-Fehler ohne Neuinit | EN: SK-Fehler ohne Neuinit" VALUE 0x728E6 TKW_VV_VV_UW 100.0 FORMULA_0010 0.0 65535.0000 /end CHARACTERISTIC
/begin CHARACTERISTIC K_EGAS_STM_NOINIT_FAIL "Fail-Fehler ohne Neuinit | EN: Fail-Fehler ohne Neuinit" VALUE 0x728E8 TKW_VV_VV_UW 100.0 FORMULA_0010 0.0 65535.0000 /end CHARACTERISTIC
/begin CHARACTERISTIC K_EGAS_STM_LLS_DK_SCHW "DK-Schwelle fuer LLS-Adaption | EN: DK-Schwelle fuer LLS - Adaption" VALUE 0x728EA TKW_VV_VV_SW 100.0 FORMULA_0001 -10.0000 120.0000 FORMAT "%4.1" /end CHARACTERISTIC
/begin CHARACTERISTIC K_EGAS_STM_LLS_T_ADAPT "max. Zeit fuer LLS-Adaption | EN: max. Zeit fuer LLS-Adaption" VALUE 0x728EC TKW_VV_VV_UW 100.0 FORMULA_0633 0.0 327.6750 FORMAT "%5.2" /end CHARACTERISTIC
/begin CHARACTERISTIC K_EGAS_STM_T_ADAPT "Adaptionszyklus fuer LLS und DK | EN: Adaptionszyklus fuer LLS und DK" VALUE 0x728EE TKW_VV_VV_UW 100.0 FORMULA_0627 0.0 1092.2500 /end CHARACTERISTIC
/begin CHARACTERISTIC K_EGAS_STM_DK_WAIT_DIS "Warten auf Disable | EN: Wait for disable [sec]" VALUE 0x728F0 TKW_VV_VV_UW 100.0 FORMULA_0633 0.0 327.6750 FORMAT "%5.2" /end CHARACTERISTIC
/begin CHARACTERISTIC K_EGAS_STM_DK_SK_ZU "Schwelle fuer SK-/GT-Test | EN: Threshold for safety-concept / linkage test [%]" VALUE 0x728F2 TKW_VV_VV_SW 100.0 FORMULA_0001 -10.0000 120.0000 FORMAT "%4.1" /end CHARACTERISTIC
/begin CHARACTERISTIC K_EGAS_STM_DK_SK_TST "SK-Testzeit | EN: Safety-concept test time [sec]" VALUE 0x728F4 TKW_VV_VV_UW 100.0 FORMULA_0633 0.0 327.6750 FORMAT "%5.2" /end CHARACTERISTIC
/begin CHARACTERISTIC K_EGAS_STM_DK_GT_TIME "max. Zeit fuer Gestaengetest | EN: Maximum time for linkage test [sec]" VALUE 0x728F6 TKW_VV_VV_UW 100.0 FORMULA_0633 0.0 327.6750 FORMAT "%5.2" /end CHARACTERISTIC
/begin CHARACTERISTIC K_EGAS_STM_DK_GT_TMOT "min. Temp fuer Gestaengetest | EN: Minimum temperature for linkage test [°C]" VALUE 0x728F8 TKW_VV_VV_SW 100.0 FORMULA_0023 -50.0000 170.0000 FORMAT "%4.1" /end CHARACTERISTIC
/begin CHARACTERISTIC K_EGAS_STM_DK_GT_UB "min. Ub fuer Gestaengetest | EN: Minimum battery voltage for linkage test [V]" VALUE 0x728FA TKW_VV_VV_SW 100.0 FORMULA_0008 0.0 28.0000 FORMAT "%4.1" /end CHARACTERISTIC
/begin CHARACTERISTIC K_EGAS_STM_DK_GT_MIN "min. Delta fuer Gestaengetest | EN: Minimum delta for linkage test [%]" VALUE 0x728FC TKW_VV_VV_SW 100.0 FORMULA_0001 -10.0000 120.0000 FORMAT "%4.1" /end CHARACTERISTIC
/begin CHARACTERISTIC K_EGAS_STM_DK_GT_MAX "max. Position fuer Abbruch Gestaengetest | EN: Maximum position for aborting linkage test [%]" VALUE 0x728FE TKW_VV_VV_SW 100.0 FORMULA_0001 -10.0000 120.0000 FORMAT "%4.1" /end CHARACTERISTIC
/begin CHARACTERISTIC K_EGAS_STM_DK_N_FAST "schneller DK-Hochlauf beim Reset | EN: Fast throttle run-up on reset [Upm]" VALUE 0x72900 TKW_VV_VV_SW 100.0 FORMULA_0006 0.0 10000.0000 /end CHARACTERISTIC
/begin CHARACTERISTIC K_EGAS_STM_DK_N_KL50 "schneller DK-Hochlauf bei Kl50 | EN: Fast throttle run-up at terminal 50 (cranking) [Upm]" VALUE 0x72902 TKW_VV_VV_SW 100.0 FORMULA_0006 0.0 10000.0000 /end CHARACTERISTIC
/begin CHARACTERISTIC K_EGAS_STM_DK_FT_TMOT "min. Temp fuer Federntest | EN: Minimum temperature for spring test [°C]" VALUE 0x72904 TKW_VV_VV_SW 100.0 FORMULA_0023 -50.0000 170.0000 FORMAT "%4.1" /end CHARACTERISTIC
/begin CHARACTERISTIC K_EGAS_STM_DK_NP_UB "min. Ub fuer Nullpunktsadaption | EN: Minimum battery voltage for zero-point adaptation [V]" VALUE 0x72906 TKW_VV_VV_SW 100.0 FORMULA_0008 0.0 28.0000 FORMAT "%4.1" /end CHARACTERISTIC
/begin CHARACTERISTIC K_EGAS_STM_DK_NP_NMAX "max. Drehzahl fuer Nachadaption | EN: Maximum engine speed for post-adaptation [Upm]" VALUE 0x72908 TKW_VV_VV_SW 100.0 FORMULA_0006 0.0 10000.0000 /end CHARACTERISTIC
/begin CHARACTERISTIC K_EGAS_STM_DK_NP_TMOT "Differenz fuer Nachadaption" VALUE 0x7290A TKW_VV_VV_SW 100.0 FORMULA_0076 -1000.0000 1000.0000 FORMAT "%4.1" /end CHARACTERISTIC
/begin CHARACTERISTIC K_EGAS_STM_DK_NP_TMOT_MIN "min. Temp fuer Nullpunktadaption | EN: min. Temp fuer Nullpunktadaption" VALUE 0x7290C TKW_VV_VV_SW 100.0 FORMULA_0023 -50.0000 170.0000 FORMAT "%4.1" /end CHARACTERISTIC
/begin CHARACTERISTIC K_EGAS_STM_DK_NP_PMIN "min. Psau fuer Nachadaption | EN: Minimum intake manifold pressure for post-adaptation [%]" VALUE 0x7290E TKW_VV_VV_SW 100.0 FORMULA_0115 0.0 120.0000 FORMAT "%5.2" /end CHARACTERISTIC
/begin CHARACTERISTIC K_EGAS_STM_DK_NP_PMAX "max. Psau fuer Nachadaption | EN: Maximum intake manifold pressure for post-adaptation [%]" VALUE 0x72910 TKW_VV_VV_SW 100.0 FORMULA_0115 0.0 120.0000 FORMAT "%5.2" /end CHARACTERISTIC
/begin CHARACTERISTIC K_EGAS_STM_DK_MODE_HW "HW-Nr fuer ModeVgl-Hosentraeger | EN: Hardware number for mode comparison (redundancy check)" VALUE 0x72912 TKW_VV_VV_UW 100.0 FORMULA_0010 0.0 65535.0000 /end CHARACTERISTIC
/begin CHARACTERISTIC K_EGAS_EXD_UB_MIN "min. Ub fuer DK-Diagnose | EN: Minimum battery voltage for throttle diagnosis [V]" VALUE 0x72914 TKW_VV_VV_SW 100.0 FORMULA_0008 0.0 28.0000 FORMAT "%4.1" /end CHARACTERISTIC
/begin CHARACTERISTIC K_EGAS_EXD_UB_MAX "max. Ub fuer DK-Diagnose | EN: Maximum battery voltage for throttle diagnosis [V]" VALUE 0x72916 TKW_VV_VV_SW 100.0 FORMULA_0008 0.0 28.0000 FORMAT "%4.1" /end CHARACTERISTIC
/begin CHARACTERISTIC K_EGAS_EXD_KS_T_MAX "max. Zeit Kleinsprung | EN: Maximum time for small step [s]" VALUE 0x72918 TKW_VV_VV_UB 100.0 FORMULA_0352 0.0 1.2750 /end CHARACTERISTIC
/begin CHARACTERISTIC K_EGAS_EXD_GS_T_MAX "max. Zeit Grosssprung | EN: Maximum time for large step [s]" VALUE 0x72919 TKW_VV_VV_UB 100.0 FORMULA_0352 0.0 1.2750 /end CHARACTERISTIC
/begin CHARACTERISTIC K_EGAS_EXD_SW_SOLL "Startwert Sprunge | EN: Start value for steps [%]" VALUE 0x7291A TKW_VV_VV_SW 100.0 FORMULA_0001 -10.0000 120.0000 FORMAT "%4.1" /end CHARACTERISTIC
/begin CHARACTERISTIC K_EGAS_EXD_KS_SOLL "Sollwert Kleinsprung | EN: Setpoint for small step (throttle test) [%]" VALUE 0x7291C TKW_VV_VV_SW 100.0 FORMULA_0001 -10.0000 120.0000 FORMAT "%4.1" /end CHARACTERISTIC
/begin CHARACTERISTIC K_EGAS_EXD_GS_SOLL "Sollwert Grosssprung | EN: Setpoint for large step (throttle test) [%]" VALUE 0x7291E TKW_VV_VV_SW 100.0 FORMULA_0001 -10.0000 120.0000 FORMAT "%4.1" /end CHARACTERISTIC
/begin CHARACTERISTIC K_EGAS_EXD_R1_SOLL_TV "min. Sollwert fuer TV - Oeffnen 1 | EN: Minimum setpoint for duty cycle - opening 1 [%]" VALUE 0x72920 TKW_VV_VV_SW 100.0 FORMULA_0001 -10.0000 120.0000 FORMAT "%4.1" /end CHARACTERISTIC
/begin CHARACTERISTIC K_EGAS_EXD_R1_SOLL "Endwert Rampe 1 - Oeffnen 1 | EN: End value ramp 1 - opening 1 [%]" VALUE 0x72922 TKW_VV_VV_SW 100.0 FORMULA_0001 -10.0000 120.0000 FORMAT "%4.1" /end CHARACTERISTIC
/begin CHARACTERISTIC K_EGAS_EXD_R2_SOLL "Endwert Rampe 2 - Oeffnen 2 | EN: End value ramp 2 - opening 2 [%]" VALUE 0x72924 TKW_VV_VV_SW 100.0 FORMULA_0001 -10.0000 120.0000 FORMAT "%4.1" /end CHARACTERISTIC
/begin CHARACTERISTIC K_EGAS_EXD_R1_TIME "Zeit Rampe 1 - Oeffnen 1 | EN: Time ramp 1 - opening 1 [s]" VALUE 0x72926 TKW_VV_VV_UW 100.0 FORMULA_0117 0.0 325.0000 FORMAT "%5.2" /end CHARACTERISTIC
/begin CHARACTERISTIC K_EGAS_EXD_R2_TIME "Zeit Rampe 2 - Oeffnen 2 | EN: Time ramp 2 - opening 2 [s]" VALUE 0x72928 TKW_VV_VV_UW 100.0 FORMULA_0117 0.0 325.0000 FORMAT "%5.2" /end CHARACTERISTIC
/begin CHARACTERISTIC K_EGAS_EXD_R3_TIME "Zeit Rampe 3 - Schliessen | EN: Time ramp 3 - closing [s]" VALUE 0x7292A TKW_VV_VV_UW 100.0 FORMULA_0117 0.0 325.0000 FORMAT "%5.2" /end CHARACTERISTIC
/begin CHARACTERISTIC KL_EGAS_EXD_VORST_LLS_AUF "Vorsteuerwert LLS-Auf | EN: Idle-air actuator feed-forward duty, opening" CURVE 0x7292C TKL_SW_VV_UB 100.0 FORMULA_0634 0.0 199.2187
 /begin AXIS_DESCR STD_AXIS r_sollw FORMULA_0001 4 -10.0000 120.0000 FORMAT "%4.1" /end AXIS_DESCR
/end CHARACTERISTIC
/begin CHARACTERISTIC KL_EGAS_EXD_VORST_LLS_ZU "Vorsteuerwert LLS-Zu | EN: Idle-air actuator feed-forward duty, closing" CURVE 0x7293A TKL_SW_VV_UB 100.0 FORMULA_0634 0.0 199.2187
 /begin AXIS_DESCR STD_AXIS r_sollw FORMULA_0001 4 -10.0000 120.0000 FORMAT "%4.1" /end AXIS_DESCR
/end CHARACTERISTIC
/begin CHARACTERISTIC KL_EGAS_EXD_VORST_DK_AUF "Vorsteuerwert DK-Auf | EN: Throttle pre-control value, opening" CURVE 0x72948 TKL_SW_VV_UB 100.0 FORMULA_0634 0.0 199.2187
 /begin AXIS_DESCR STD_AXIS r_sollw FORMULA_0001 4 -10.0000 120.0000 FORMAT "%4.1" /end AXIS_DESCR
/end CHARACTERISTIC
/begin CHARACTERISTIC KL_EGAS_EXD_VORST_DK_ZU "Vorsteuerwert DK-Zu | EN: Throttle pre-control value, closing" CURVE 0x72956 TKL_SW_VV_UB 100.0 FORMULA_0634 0.0 199.2187
 /begin AXIS_DESCR STD_AXIS r_sollw FORMULA_0001 4 -10.0000 120.0000 FORMAT "%4.1" /end AXIS_DESCR
/end CHARACTERISTIC
/begin MEASUREMENT egas_lls_startup "LLS-Startstate" UBYTE FORMULA_0626 0 0 0.0 255.0 ECU_ADDRESS 0x3FB7D0 /end MEASUREMENT
/begin MEASUREMENT egas_dk_startup "DK-Startstate" UBYTE FORMULA_0626 0 0 0.0 255.0 ECU_ADDRESS 0x3FB7D2 /end MEASUREMENT
/begin MEASUREMENT egas_lls_neuinit_cnt "Anzahl LLS-Neuinits" UBYTE FORMULA_0003 0 0 0.0 255.0000 ECU_ADDRESS 0x3FB7D4 /end MEASUREMENT
/begin MEASUREMENT egas_dk_neuinit_cnt "Anzahl DK-Neuinits" UBYTE FORMULA_0003 0 0 0.0 255.0000 ECU_ADDRESS 0x3FB7D5 /end MEASUREMENT
/begin MEASUREMENT egas_stm_lls_time_oa "letzte Adaptionszeit" UWORD FORMULA_0627 0 0 0.0 1092.2500 ECU_ADDRESS 0x3FB7D6 /end MEASUREMENT
/begin MEASUREMENT egas_dk_fil_fail "DK-Fehlerfilter" UBYTE FORMULA_0628 0 0 0.0 255.0 ECU_ADDRESS 0x3FB7D8 /end MEASUREMENT
/begin MEASUREMENT egas_exd_dk_state "Status ext. DK-Diagnose" UBYTE FORMULA_0629 0 0 0.0 255.0 ECU_ADDRESS 0x3FB7D9 /end MEASUREMENT
/begin MEASUREMENT egas_exd_lls_state "Status ext. LLS-Diagnose" UBYTE FORMULA_0629 0 0 0.0 255.0 ECU_ADDRESS 0x3FB7DA /end MEASUREMENT
/begin MEASUREMENT egas_exd_timer "Timer ext. Diagnose" UWORD FORMULA_0596 0 0 0.0 327.6750 ECU_ADDRESS 0x3FB7DC /end MEASUREMENT
/begin MEASUREMENT egas_exd_dk_soll "Sollwert ext. DK-Diagnose" SWORD FORMULA_0001 0 0 -10.0000 120.0000 ECU_ADDRESS 0x3FB7DE /end MEASUREMENT
/begin MEASUREMENT egas_exd_lls_soll "Sollwert ext. LLS-Diagnose" SWORD FORMULA_0001 0 0 -10.0000 120.0000 ECU_ADDRESS 0x3FB7E0 /end MEASUREMENT
/begin MEASUREMENT egas_exd_ks_time_up_b1 "Zeit Kleinsprung Up" UWORD FORMULA_0630 0 0 0.0 325.0000 ECU_ADDRESS 0x3FB7E2 /end MEASUREMENT
/begin MEASUREMENT egas_exd_ks_time_up_b2 "Zeit Kleinsprung Up" UWORD FORMULA_0630 0 0 0.0 325.0000 ECU_ADDRESS 0x3FB7E4 /end MEASUREMENT
/begin MEASUREMENT egas_exd_ks_time_dn_b1 "Zeit Kleinsprung Down" UWORD FORMULA_0630 0 0 0.0 325.0000 ECU_ADDRESS 0x3FB7E6 /end MEASUREMENT
/begin MEASUREMENT egas_exd_ks_time_dn_b2 "Zeit Kleinsprung Down" UWORD FORMULA_0630 0 0 0.0 325.0000 ECU_ADDRESS 0x3FB7E8 /end MEASUREMENT
/begin MEASUREMENT egas_exd_gs_time_up_b1 "Zeit Grosssprung Up" UWORD FORMULA_0630 0 0 0.0 325.0000 ECU_ADDRESS 0x3FB7EA /end MEASUREMENT
/begin MEASUREMENT egas_exd_gs_time_up_b2 "Zeit Grosssprung Up" UWORD FORMULA_0630 0 0 0.0 325.0000 ECU_ADDRESS 0x3FB7EC /end MEASUREMENT
/begin MEASUREMENT egas_exd_gs_time_dn_b1 "Zeit Grosssprung Down" UWORD FORMULA_0630 0 0 0.0 325.0000 ECU_ADDRESS 0x3FB7EE /end MEASUREMENT
/begin MEASUREMENT egas_exd_gs_time_dn_b2 "Zeit Grosssprung Down" UWORD FORMULA_0630 0 0 0.0 325.0000 ECU_ADDRESS 0x3FB7F0 /end MEASUREMENT
/begin MEASUREMENT egas_exd_r1_ra_max_b1 "max. Regeldifferenz Oeffnen 1" SWORD FORMULA_0001 0 0 -10.0000 120.0000 ECU_ADDRESS 0x3FB7F2 /end MEASUREMENT
/begin MEASUREMENT egas_exd_r1_ra_max_b2 "max. Regeldifferenz Oeffnen 1" SWORD FORMULA_0001 0 0 -10.0000 120.0000 ECU_ADDRESS 0x3FB7F4 /end MEASUREMENT
/begin MEASUREMENT egas_exd_r2_ra_max_b1 "max. Regeldifferenz Oeffnen 2" SWORD FORMULA_0001 0 0 -10.0000 120.0000 ECU_ADDRESS 0x3FB7F6 /end MEASUREMENT
/begin MEASUREMENT egas_exd_r2_ra_max_b2 "max. Regeldifferenz Oeffnen 2" SWORD FORMULA_0001 0 0 -10.0000 120.0000 ECU_ADDRESS 0x3FB7F8 /end MEASUREMENT
/begin MEASUREMENT egas_exd_r3_ra_max_b1 "max. Regeldifferenz Schliessen" SWORD FORMULA_0001 0 0 -10.0000 120.0000 ECU_ADDRESS 0x3FB7FA /end MEASUREMENT
/begin MEASUREMENT egas_exd_r3_ra_max_b2 "max. Regeldifferenz Schliessen" SWORD FORMULA_0001 0 0 -10.0000 120.0000 ECU_ADDRESS 0x3FB7FC /end MEASUREMENT
/begin MEASUREMENT egas_exd_r1_tv_sum_b1 "Integral Tastverhaeltnis Oeffnen 1" ULONG FORMULA_0631 0 0 0.0 3355443199.2187 ECU_ADDRESS 0x3FB800 /end MEASUREMENT
/begin MEASUREMENT egas_exd_r1_tv_sum_b2 "Integral Tastverhaeltnis Oeffnen 1" ULONG FORMULA_0631 0 0 0.0 3355443199.2187 ECU_ADDRESS 0x3FB804 /end MEASUREMENT
/begin MEASUREMENT egas_exd_r2_tv_sum_b1 "Integral Tastverhaeltnis Oeffnen 2" ULONG FORMULA_0631 0 0 0.0 3355443199.2187 ECU_ADDRESS 0x3FB808 /end MEASUREMENT
/begin MEASUREMENT egas_exd_r2_tv_sum_b2 "Integral Tastverhaeltnis Oeffnen 2" ULONG FORMULA_0631 0 0 0.0 3355443199.2187 ECU_ADDRESS 0x3FB80C /end MEASUREMENT
/begin MEASUREMENT egas_exd_r3_tv_sum_b1 "Integral Tastverhaeltnis Schliessen" ULONG FORMULA_0631 0 0 0.0 3355443199.2187 ECU_ADDRESS 0x3FB810 /end MEASUREMENT
/begin MEASUREMENT egas_exd_r3_tv_sum_b2 "Integral Tastverhaeltnis Schliessen" ULONG FORMULA_0631 0 0 0.0 3355443199.2187 ECU_ADDRESS 0x3FB814 /end MEASUREMENT
/begin MEASUREMENT egas_exd_r1_tv_mw_b1 "Mittelwert Tastverhaeltnis Oeffnen 1" SLONG FORMULA_0631 0 0 -1677721600.0000 1677721599.2187 ECU_ADDRESS 0x3FB818 /end MEASUREMENT
/begin MEASUREMENT egas_exd_r1_tv_mw_b2 "Mittelwert Tastverhaeltnis Oeffnen 1" SLONG FORMULA_0631 0 0 -1677721600.0000 1677721599.2187 ECU_ADDRESS 0x3FB81C /end MEASUREMENT
/begin MEASUREMENT egas_exd_r2_tv_mw_b1 "Mittelwert Tastverhaeltnis Oeffnen 2" SLONG FORMULA_0631 0 0 -1677721600.0000 1677721599.2187 ECU_ADDRESS 0x3FB820 /end MEASUREMENT
/begin MEASUREMENT egas_exd_r2_tv_mw_b2 "Mittelwert Tastverhaeltnis Oeffnen 2" SLONG FORMULA_0631 0 0 -1677721600.0000 1677721599.2187 ECU_ADDRESS 0x3FB824 /end MEASUREMENT
/begin MEASUREMENT egas_exd_r3_tv_mw_b1 "Mittelwert Tastverhaeltnis Schliessen" SLONG FORMULA_0631 0 0 -1677721600.0000 1677721599.2187 ECU_ADDRESS 0x3FB828 /end MEASUREMENT
/begin MEASUREMENT egas_exd_r3_tv_mw_b2 "Mittelwert Tastverhaeltnis Schliessen" SLONG FORMULA_0631 0 0 -1677721600.0000 1677721599.2187 ECU_ADDRESS 0x3FB82C /end MEASUREMENT
/begin MEASUREMENT egas_exd_r1_ra_sum_b1 "Integral Regelabweichung Oeffnen 1" ULONG FORMULA_0632 0 0 0.0 429496729.5000 ECU_ADDRESS 0x3FB830 /end MEASUREMENT
/begin MEASUREMENT egas_exd_r1_ra_sum_b2 "Integral Regelabweichung Oeffnen 1" ULONG FORMULA_0632 0 0 0.0 429496729.5000 ECU_ADDRESS 0x3FB834 /end MEASUREMENT
/begin MEASUREMENT egas_exd_r2_ra_sum_b1 "Integral Regelabweichung Oeffnen 1" ULONG FORMULA_0632 0 0 0.0 429496729.5000 ECU_ADDRESS 0x3FB838 /end MEASUREMENT
/begin MEASUREMENT egas_exd_r2_ra_sum_b2 "Integral Regelabweichung Oeffnen 1" ULONG FORMULA_0632 0 0 0.0 429496729.5000 ECU_ADDRESS 0x3FB83C /end MEASUREMENT
/begin MEASUREMENT egas_exd_r3_ra_sum_b1 "Integral Regelabweichung Oeffnen 1" ULONG FORMULA_0632 0 0 0.0 429496729.5000 ECU_ADDRESS 0x3FB840 /end MEASUREMENT
/begin MEASUREMENT egas_exd_r3_ra_sum_b2 "Integral Regelabweichung Oeffnen 1" ULONG FORMULA_0632 0 0 0.0 429496729.5000 ECU_ADDRESS 0x3FB844 /end MEASUREMENT
/begin MEASUREMENT egas_exd_soll_1of4_ "Sollwert ext. Diagnose" SWORD FORMULA_0001 0 0 -10.0000 120.0000 ECU_ADDRESS 0x3FB848 /end MEASUREMENT
/begin MEASUREMENT egas_exd_soll_2of4_ "Sollwert ext. Diagnose" SWORD FORMULA_0001 0 0 -10.0000 120.0000 ECU_ADDRESS 0x3FB84A /end MEASUREMENT
/begin MEASUREMENT egas_exd_soll_3of4_ "Sollwert ext. Diagnose" SWORD FORMULA_0001 0 0 -10.0000 120.0000 ECU_ADDRESS 0x3FB84C /end MEASUREMENT
/begin MEASUREMENT egas_exd_soll_4of4_ "Sollwert ext. Diagnose" SWORD FORMULA_0001 0 0 -10.0000 120.0000 ECU_ADDRESS 0x3FB84E /end MEASUREMENT
/begin MEASUREMENT egas_exd_timeout_1of4_ "Sollwert Timeout" UWORD FORMULA_0062 0 0 0.0 65535.0000 ECU_ADDRESS 0x3FB850 /end MEASUREMENT
/begin MEASUREMENT egas_exd_timeout_2of4_ "Sollwert Timeout" UWORD FORMULA_0062 0 0 0.0 65535.0000 ECU_ADDRESS 0x3FB852 /end MEASUREMENT
/begin MEASUREMENT egas_exd_timeout_3of4_ "Sollwert Timeout" UWORD FORMULA_0062 0 0 0.0 65535.0000 ECU_ADDRESS 0x3FB854 /end MEASUREMENT
/begin MEASUREMENT egas_exd_timeout_4of4_ "Sollwert Timeout" UWORD FORMULA_0062 0 0 0.0 65535.0000 ECU_ADDRESS 0x3FB856 /end MEASUREMENT
/begin MEASUREMENT egas_exd_timeout_en "EnLtg Timeout" UWORD FORMULA_0062 0 0 0.0 65535.0000 ECU_ADDRESS 0x3FB858 /end MEASUREMENT
/* ------------------ Abschnitt erzeugt aus n_e2.dat ------------------ */
/begin CHARACTERISTIC K_N_E2_DELTA "Max zulaessige Drehzahl fuer Ebene 2 | EN: Max zulaessige Drehzahl fuer Ebene 2" VALUE 0x7A996 TKW_VV_VV_SW 100.0 FORMULA_0006 0.0 10000.0000 /end CHARACTERISTIC
/begin CHARACTERISTIC K_N_E2_T_MAX "Maximale Fehlerzeit der Drehzahl fuer Ebene 2 | EN: Maximale Fehlerzeit der Drehzahl fuer Ebene 2" VALUE 0x7A998 TKW_VV_VV_UW 100.0 FORMULA_0021 0.0 655.0000 FORMAT "%5.2" /end CHARACTERISTIC
/begin MEASUREMENT n_e2_st "Status Drehzahl fuer Ebene 2" UBYTE FORMULA_0838 0 0 0.0 255.0 ECU_ADDRESS 0x3FC7EE /end MEASUREMENT
/begin MEASUREMENT n_e2_t "Fehlerzeit der Drehzahl fuer Ebene 2" UWORD FORMULA_0021 0 0 0.0 655.0000 ECU_ADDRESS 0x3FC7F0 /end MEASUREMENT
/* ------------------ Abschnitt erzeugt aus ppcm.dat ------------------ */
/begin CHARACTERISTIC K_DSP_MESSEN "Schalter Freigabe DSP MESS: 0 = Aus; 1 = Aktiv | EN: Switch enabling DSP measurement: 0 = off, 1 = active" VALUE 0x7A9D6 TKW_VV_VV_UB 100.0 FORMULA_0003 0.0 1.0000 /end CHARACTERISTIC
/begin MEASUREMENT dsp_MotDat.n "n,0,Y, !!! Dummy not for Gredi !!!" SLONG FORMULA_0841 0 0 0.0 10000.0000 ECU_ADDRESS 0xC60A1C /end MEASUREMENT
/begin MEASUREMENT dsp_MotDat.zustand_motor "Zustand Motor,1,Y, !!! Dummy not for Gredi !!!" ULONG FORMULA_0842 0 0 0.0 4294967295.0 ECU_ADDRESS 0xC60A20 /end MEASUREMENT
/begin MEASUREMENT dsp_MotDat.rf_b1 "rf_b1,2,Y, !!! Dummy not for Gredi !!!" SLONG FORMULA_0843 0 0 0.0 2.0000 ECU_ADDRESS 0xC60A24 /end MEASUREMENT
/begin MEASUREMENT dsp_MotDat.rf_b2 "rf_b2,3,Y, !!! Dummy not for Gredi !!!" SLONG FORMULA_0843 0 0 0.0 2.0000 ECU_ADDRESS 0xC60A28 /end MEASUREMENT
/begin MEASUREMENT dsp_MotDat.lam_ist_mw_b1 "Mittelwert IST-Lambda B1,4,Y, !!! Dummy not for Gredi !!!" SLONG FORMULA_0844 0 0 0.0 3.9990 ECU_ADDRESS 0xC60A2C /end MEASUREMENT
/begin MEASUREMENT dsp_MotDat.lam_ist_mw_b2 "Mittelwert IST-Lambda B2,5,Y, !!! Dummy not for Gredi !!!" SLONG FORMULA_0844 0 0 0.0 3.9990 ECU_ADDRESS 0xC60A30 /end MEASUREMENT
/begin MEASUREMENT dsp_MotDat.dr_rel_b1 "rel. Drosselung B1,6,Y, !!! Dummy not for Gredi !!!" SLONG FORMULA_0845 0 0 0.0 199.9938 ECU_ADDRESS 0xC60A34 /end MEASUREMENT
/begin MEASUREMENT dsp_MotDat.dr_rel_b2 "rel. Drosselung B2,7,Y, !!! Dummy not for Gredi !!!" SLONG FORMULA_0845 0 0 0.0 199.9938 ECU_ADDRESS 0xC60A38 /end MEASUREMENT
/begin MEASUREMENT dsp_MotDat.van_ist_E1 "Vanos Ist E1,8,Y, !!! Dummy not for Gredi !!!" SLONG FORMULA_0244 0 0 50.0000 160.0000 ECU_ADDRESS 0xC60A3C /end MEASUREMENT
/begin MEASUREMENT dsp_MotDat.van_ist_A1 "Vanos Ist A1,9,Y, !!! Dummy not for Gredi !!!" SLONG FORMULA_0244 0 0 50.0000 160.0000 ECU_ADDRESS 0xC60A40 /end MEASUREMENT
/begin MEASUREMENT dsp_MotDat.van_ist_E2 "Vanos Ist E2,10,Y, !!! Dummy not for Gredi !!!" SLONG FORMULA_0244 0 0 50.0000 160.0000 ECU_ADDRESS 0xC60A44 /end MEASUREMENT
/begin MEASUREMENT dsp_MotDat.van_ist_A2 "Vanos Ist A2,11,Y, !!! Dummy not for Gredi !!!" SLONG FORMULA_0244 0 0 50.0000 160.0000 ECU_ADDRESS 0xC60A48 /end MEASUREMENT
/begin MEASUREMENT dsp_MotDat.auss_st_b1 "Zustand Aussetzererkennung B2.,12,Y, !!! Dummy not for Gredi !!!" ULONG FORMULA_0846 0 0 0.0 511.0 ECU_ADDRESS 0xC60A4C /end MEASUREMENT
/begin MEASUREMENT dsp_MotDat.auss_st_b2 "Zustand Aussetzererkennung B2,13,Y, !!! Dummy not for Gredi !!!" ULONG FORMULA_0846 0 0 0.0 511.0 ECU_ADDRESS 0xC60A50 /end MEASUREMENT
/begin MEASUREMENT dsp_MotDat.kr_asp_cnt "KR Arbeitsspielzaehler,14,Y, !!! Dummy not for Gredi !!!" ULONG FORMULA_0000 0 0 0.0 65535.0000 ECU_ADDRESS 0xC60A54 /end MEASUREMENT
/begin MEASUREMENT dsp_MotDat.kr_st "Status Klopfregelung,15,Y, !!! Dummy not for Gredi !!!" ULONG FORMULA_0847 0 0 0.0 255.0 ECU_ADDRESS 0xC60A58 /end MEASUREMENT
/begin MEASUREMENT dsp_MotDat.auss_erk_tz "Status Ausschwingen Zuendspule,16,Dummy not for Gredi !!!" ULONG FORMULA_0848 0 0 0.0 4095.0 ECU_ADDRESS 0xC60A5C /end MEASUREMENT
/begin MEASUREMENT dsp_MotDat.auss_erk_tz_zyl1 "Status Ausschwingen Zuendspule 1,16,Y, !!! Dummy not for Gredi !!!" ULONG FORMULA_0849 0 0 0.0 1.0 ECU_ADDRESS 0xC60A5C BIT_MASK 0x1 /end MEASUREMENT
/begin MEASUREMENT dsp_MotDat.auss_erk_tz_zyl2 "Status Ausschwingen Zuendspule 2,16,Y, !!! Dummy not for Gredi !!!" ULONG FORMULA_0850 0 0 0.0 1.0 ECU_ADDRESS 0xC60A5C BIT_MASK 0x2 /end MEASUREMENT
/begin MEASUREMENT dsp_MotDat.auss_erk_tz_zyl3 "Status Ausschwingen Zuendspule 3,16,Y, !!! Dummy not for Gredi !!!" ULONG FORMULA_0851 0 0 0.0 1.0 ECU_ADDRESS 0xC60A5C BIT_MASK 0x4 /end MEASUREMENT
/begin MEASUREMENT dsp_MotDat.auss_erk_tz_zyl4 "Status Ausschwingen Zuendspule 4,16,Y, !!! Dummy not for Gredi !!!" ULONG FORMULA_0852 0 0 0.0 1.0 ECU_ADDRESS 0xC60A5C BIT_MASK 0x8 /end MEASUREMENT
/begin MEASUREMENT dsp_MotDat.auss_erk_tz_zyl5 "Status Ausschwingen Zuendspule 5,16,Y, !!! Dummy not for Gredi !!!" ULONG FORMULA_0853 0 0 0.0 1.0 ECU_ADDRESS 0xC60A5C BIT_MASK 0x10 /end MEASUREMENT
/begin MEASUREMENT dsp_MotDat.auss_erk_tz_zyl6 "Status Ausschwingen Zuendspule 6,16,Y, !!! Dummy not for Gredi !!!" ULONG FORMULA_0854 0 0 0.0 1.0 ECU_ADDRESS 0xC60A5C BIT_MASK 0x20 /end MEASUREMENT
/begin MEASUREMENT dsp_MotDat.auss_erk_tz_zyl7 "Status Ausschwingen Zuendspule 7,16,Y, !!! Dummy not for Gredi !!!" ULONG FORMULA_0855 0 0 0.0 1.0 ECU_ADDRESS 0xC60A5C BIT_MASK 0x40 /end MEASUREMENT
/begin MEASUREMENT dsp_MotDat.auss_erk_tz_zyl8 "Status Ausschwingen Zuendspule 8,16,Y, !!! Dummy not for Gredi !!!" ULONG FORMULA_0856 0 0 0.0 1.0 ECU_ADDRESS 0xC60A5C BIT_MASK 0x80 /end MEASUREMENT
/begin MEASUREMENT dsp_MotDat.auss_erk_tz_zyl9 "Status Ausschwingen Zuendspule 9,16,Y, !!! Dummy not for Gredi !!!" ULONG FORMULA_0857 0 0 0.0 1.0 ECU_ADDRESS 0xC60A5C BIT_MASK 0x100 /end MEASUREMENT
/begin MEASUREMENT dsp_MotDat.auss_erk_tz_zyl10 "Status Ausschwingen Zuendspule 10,16,Y, !!! Dummy not for Gredi !!!" ULONG FORMULA_0858 0 0 0.0 1.0 ECU_ADDRESS 0xC60A5C BIT_MASK 0x200 /end MEASUREMENT
/begin MEASUREMENT dsp_MotDat.auss_erk_ti "Status Verbrennungsaussetzer,17,Y, !!! Dummy not for Gredi !!!" ULONG FORMULA_0859 0 0 0.0 4095.0 ECU_ADDRESS 0xC60A60 /end MEASUREMENT
/begin MEASUREMENT dsp_MotDat.auss_erk_ti_zyl1 "Status Verbrennung Zylinder 1,17,Y, !!! Dummy not for Gredi !!!" ULONG FORMULA_0860 0 0 0.0 1.0 ECU_ADDRESS 0xC60A60 BIT_MASK 0x1 /end MEASUREMENT
/begin MEASUREMENT dsp_MotDat.auss_erk_ti_zyl2 "Status Verbrennung Zylinder 2,17,Y, !!! Dummy not for Gredi !!!" ULONG FORMULA_0861 0 0 0.0 1.0 ECU_ADDRESS 0xC60A60 BIT_MASK 0x2 /end MEASUREMENT
/begin MEASUREMENT dsp_MotDat.auss_erk_ti_zyl3 "Status Verbrennung Zylinder 3,17,Y, !!! Dummy not for Gredi !!!" ULONG FORMULA_0862 0 0 0.0 1.0 ECU_ADDRESS 0xC60A60 BIT_MASK 0x4 /end MEASUREMENT
/begin MEASUREMENT dsp_MotDat.auss_erk_ti_zyl4 "Status Verbrennung Zylinder 4,17,Y, !!! Dummy not for Gredi !!!" ULONG FORMULA_0863 0 0 0.0 1.0 ECU_ADDRESS 0xC60A60 BIT_MASK 0x8 /end MEASUREMENT
/begin MEASUREMENT dsp_MotDat.auss_erk_ti_zyl5 "Status Verbrennung Zylinder 5,17,Y, !!! Dummy not for Gredi !!!" ULONG FORMULA_0864 0 0 0.0 1.0 ECU_ADDRESS 0xC60A60 BIT_MASK 0x10 /end MEASUREMENT
/begin MEASUREMENT dsp_MotDat.auss_erk_ti_zyl6 "Status Verbrennung Zylinder 6,17,Y, !!! Dummy not for Gredi !!!" ULONG FORMULA_0865 0 0 0.0 1.0 ECU_ADDRESS 0xC60A60 BIT_MASK 0x20 /end MEASUREMENT
/begin MEASUREMENT dsp_MotDat.auss_erk_ti_zyl7 "Status Verbrennung Zylinder 7,17,Y, !!! Dummy not for Gredi !!!" ULONG FORMULA_0866 0 0 0.0 1.0 ECU_ADDRESS 0xC60A60 BIT_MASK 0x40 /end MEASUREMENT
/begin MEASUREMENT dsp_MotDat.auss_erk_ti_zyl8 "Status Verbrennung Zylinder 8,17,Y, !!! Dummy not for Gredi !!!" ULONG FORMULA_0867 0 0 0.0 1.0 ECU_ADDRESS 0xC60A60 BIT_MASK 0x80 /end MEASUREMENT
/begin MEASUREMENT dsp_MotDat.auss_erk_ti_zyl9 "Status Verbrennung Zylinder 9,17,Y, !!! Dummy not for Gredi !!!" ULONG FORMULA_0868 0 0 0.0 1.0 ECU_ADDRESS 0xC60A60 BIT_MASK 0x100 /end MEASUREMENT
/begin MEASUREMENT dsp_MotDat.auss_erk_ti_zyl10 "Status Verbrennung Zylinder 10,17,Y, !!! Dummy not for Gredi !!!" ULONG FORMULA_0869 0 0 0.0 1.0 ECU_ADDRESS 0xC60A60 BIT_MASK 0x200 /end MEASUREMENT
/begin MEASUREMENT dsp_MotDat.auss_erk_ns "Status Nebenschluss Zuendkerze,18,Y, !!! Dummy not for Gredi !!!" ULONG FORMULA_0870 0 0 0.0 4095.0 ECU_ADDRESS 0xC60A64 /end MEASUREMENT
/begin MEASUREMENT dsp_MotDat.auss_erk_ns_zyl1 "Status Nebenschluss Zuendkerze 1,18,Y, !!! Dummy not for Gredi !!!" ULONG FORMULA_0871 0 0 0.0 1.0 ECU_ADDRESS 0xC60A64 BIT_MASK 0x1 /end MEASUREMENT
/begin MEASUREMENT dsp_MotDat.auss_erk_ns_zyl2 "Status Nebenschluss Zuendkerze 2,18,Y, !!! Dummy not for Gredi !!!" ULONG FORMULA_0872 0 0 0.0 1.0 ECU_ADDRESS 0xC60A64 BIT_MASK 0x2 /end MEASUREMENT
/begin MEASUREMENT dsp_MotDat.auss_erk_ns_zyl3 "Status Nebenschluss Zuendkerze 3,18,Y, !!! Dummy not for Gredi !!!" ULONG FORMULA_0873 0 0 0.0 1.0 ECU_ADDRESS 0xC60A64 BIT_MASK 0x4 /end MEASUREMENT
/begin MEASUREMENT dsp_MotDat.auss_erk_ns_zyl4 "Status Nebenschluss Zuendkerze 4,18,Y, !!! Dummy not for Gredi !!!" ULONG FORMULA_0874 0 0 0.0 1.0 ECU_ADDRESS 0xC60A64 BIT_MASK 0x8 /end MEASUREMENT
/begin MEASUREMENT dsp_MotDat.auss_erk_ns_zyl5 "Status Nebenschluss Zuendkerze 5,18,Y, !!! Dummy not for Gredi !!!" ULONG FORMULA_0875 0 0 0.0 1.0 ECU_ADDRESS 0xC60A64 BIT_MASK 0x10 /end MEASUREMENT
/begin MEASUREMENT dsp_MotDat.auss_erk_ns_zyl6 "Status Nebenschluss Zuendkerze 6,18,Y, !!! Dummy not for Gredi !!!" ULONG FORMULA_0876 0 0 0.0 1.0 ECU_ADDRESS 0xC60A64 BIT_MASK 0x20 /end MEASUREMENT
/begin MEASUREMENT dsp_MotDat.auss_erk_ns_zyl7 "Status Nebenschluss Zuendkerze 7,18,Y, !!! Dummy not for Gredi !!!" ULONG FORMULA_0877 0 0 0.0 1.0 ECU_ADDRESS 0xC60A64 BIT_MASK 0x40 /end MEASUREMENT
/begin MEASUREMENT dsp_MotDat.auss_erk_ns_zyl8 "Status Nebenschluss Zuendkerze 8,18,Y, !!! Dummy not for Gredi !!!" ULONG FORMULA_0878 0 0 0.0 1.0 ECU_ADDRESS 0xC60A64 BIT_MASK 0x80 /end MEASUREMENT
/begin MEASUREMENT dsp_MotDat.auss_erk_ns_zyl9 "Status Nebenschluss Zuendkerze 9,18,Y, !!! Dummy not for Gredi !!!" ULONG FORMULA_0879 0 0 0.0 1.0 ECU_ADDRESS 0xC60A64 BIT_MASK 0x100 /end MEASUREMENT
/begin MEASUREMENT dsp_MotDat.auss_erk_ns_zyl10 "Status Nebenschluss Zuendkerze 10,18,Y, !!! Dummy not for Gredi !!!" ULONG FORMULA_0880 0 0 0.0 1.0 ECU_ADDRESS 0xC60A64 BIT_MASK 0x200 /end MEASUREMENT
/begin MEASUREMENT dsp_MotDat.auss_st_ti_b1 "Zustandsvariable Verbrennungsaussetzererkennung,19,Y, !!! Dummy not for Gredi !!!" ULONG FORMULA_0881 0 0 0.0 511.0 ECU_ADDRESS 0xC60A68 /end MEASUREMENT
/begin MEASUREMENT dsp_MotDat.auss_st_ti_b2 "Zustandsvariable Verbrennungsaussetzererkennung,20,Y, !!! Dummy not for Gredi !!!" ULONG FORMULA_0881 0 0 0.0 511.0 ECU_ADDRESS 0xC60A6C /end MEASUREMENT
/begin MEASUREMENT dsp_ZylDat_1of10_.tz "Z�ndwinkel,0,Y, !!! Dummy not for Gredi !!!" SLONG FORMULA_0882 0 0 -50.0000 60.0000 ECU_ADDRESS 0xC60A70 /end MEASUREMENT
/begin MEASUREMENT dsp_ZylDat_2of10_.tz "Z�ndwinkel,0,Y, !!! Dummy not for Gredi !!!" SLONG FORMULA_0882 0 0 -50.0000 60.0000 ECU_ADDRESS 0xC60AAC /end MEASUREMENT
/begin MEASUREMENT dsp_ZylDat_3of10_.tz "Z�ndwinkel,0,Y, !!! Dummy not for Gredi !!!" SLONG FORMULA_0882 0 0 -50.0000 60.0000 ECU_ADDRESS 0xC60AE8 /end MEASUREMENT
/begin MEASUREMENT dsp_ZylDat_4of10_.tz "Z�ndwinkel,0,Y, !!! Dummy not for Gredi !!!" SLONG FORMULA_0882 0 0 -50.0000 60.0000 ECU_ADDRESS 0xC60B24 /end MEASUREMENT
/begin MEASUREMENT dsp_ZylDat_5of10_.tz "Z�ndwinkel,0,Y, !!! Dummy not for Gredi !!!" SLONG FORMULA_0882 0 0 -50.0000 60.0000 ECU_ADDRESS 0xC60B60 /end MEASUREMENT
/begin MEASUREMENT dsp_ZylDat_6of10_.tz "Z�ndwinkel,0,Y, !!! Dummy not for Gredi !!!" SLONG FORMULA_0882 0 0 -50.0000 60.0000 ECU_ADDRESS 0xC60B9C /end MEASUREMENT
/begin MEASUREMENT dsp_ZylDat_7of10_.tz "Z�ndwinkel,0,Y, !!! Dummy not for Gredi !!!" SLONG FORMULA_0882 0 0 -50.0000 60.0000 ECU_ADDRESS 0xC60BD8 /end MEASUREMENT
/begin MEASUREMENT dsp_ZylDat_8of10_.tz "Z�ndwinkel,0,Y, !!! Dummy not for Gredi !!!" SLONG FORMULA_0882 0 0 -50.0000 60.0000 ECU_ADDRESS 0xC60C14 /end MEASUREMENT
/begin MEASUREMENT dsp_ZylDat_9of10_.tz "Z�ndwinkel,0,Y, !!! Dummy not for Gredi !!!" SLONG FORMULA_0882 0 0 -50.0000 60.0000 ECU_ADDRESS 0xC60C50 /end MEASUREMENT
/begin MEASUREMENT dsp_ZylDat_10of10_.tz "Z�ndwinkel,0,Y, !!! Dummy not for Gredi !!!" SLONG FORMULA_0882 0 0 -50.0000 60.0000 ECU_ADDRESS 0xC60C8C /end MEASUREMENT
/begin MEASUREMENT dsp_ZylDat_1of10_.dsp_lp_start "DSP Start Aussetzerfenster,1,Y, !!! Dummy not for Gredi !!!" ULONG FORMULA_0584 0 0 0.0 24.5760 ECU_ADDRESS 0xC60A74 /end MEASUREMENT
/begin MEASUREMENT dsp_ZylDat_2of10_.dsp_lp_start "DSP Start Aussetzerfenster,1,Y, !!! Dummy not for Gredi !!!" ULONG FORMULA_0584 0 0 0.0 24.5760 ECU_ADDRESS 0xC60AB0 /end MEASUREMENT
/begin MEASUREMENT dsp_ZylDat_3of10_.dsp_lp_start "DSP Start Aussetzerfenster,1,Y, !!! Dummy not for Gredi !!!" ULONG FORMULA_0584 0 0 0.0 24.5760 ECU_ADDRESS 0xC60AEC /end MEASUREMENT
/begin MEASUREMENT dsp_ZylDat_4of10_.dsp_lp_start "DSP Start Aussetzerfenster,1,Y, !!! Dummy not for Gredi !!!" ULONG FORMULA_0584 0 0 0.0 24.5760 ECU_ADDRESS 0xC60B28 /end MEASUREMENT
/begin MEASUREMENT dsp_ZylDat_5of10_.dsp_lp_start "DSP Start Aussetzerfenster,1,Y, !!! Dummy not for Gredi !!!" ULONG FORMULA_0584 0 0 0.0 24.5760 ECU_ADDRESS 0xC60B64 /end MEASUREMENT
/begin MEASUREMENT dsp_ZylDat_6of10_.dsp_lp_start "DSP Start Aussetzerfenster,1,Y, !!! Dummy not for Gredi !!!" ULONG FORMULA_0584 0 0 0.0 24.5760 ECU_ADDRESS 0xC60BA0 /end MEASUREMENT
/begin MEASUREMENT dsp_ZylDat_7of10_.dsp_lp_start "DSP Start Aussetzerfenster,1,Y, !!! Dummy not for Gredi !!!" ULONG FORMULA_0584 0 0 0.0 24.5760 ECU_ADDRESS 0xC60BDC /end MEASUREMENT
/begin MEASUREMENT dsp_ZylDat_8of10_.dsp_lp_start "DSP Start Aussetzerfenster,1,Y, !!! Dummy not for Gredi !!!" ULONG FORMULA_0584 0 0 0.0 24.5760 ECU_ADDRESS 0xC60C18 /end MEASUREMENT
/begin MEASUREMENT dsp_ZylDat_9of10_.dsp_lp_start "DSP Start Aussetzerfenster,1,Y, !!! Dummy not for Gredi !!!" ULONG FORMULA_0584 0 0 0.0 24.5760 ECU_ADDRESS 0xC60C54 /end MEASUREMENT
/begin MEASUREMENT dsp_ZylDat_10of10_.dsp_lp_start "DSP Start Aussetzerfenster,1,Y, !!! Dummy not for Gredi !!!" ULONG FORMULA_0584 0 0 0.0 24.5760 ECU_ADDRESS 0xC60C90 /end MEASUREMENT
/begin MEASUREMENT dsp_ZylDat_1of10_.dsp_lp_length "Aussetzerfenster L�nge,2,Y, !!! Dummy not for Gredi !!!" ULONG FORMULA_0584 0 0 0.0 24.5760 ECU_ADDRESS 0xC60A78 /end MEASUREMENT
/begin MEASUREMENT dsp_ZylDat_2of10_.dsp_lp_length "Aussetzerfenster L�nge,2,Y, !!! Dummy not for Gredi !!!" ULONG FORMULA_0584 0 0 0.0 24.5760 ECU_ADDRESS 0xC60AB4 /end MEASUREMENT
/begin MEASUREMENT dsp_ZylDat_3of10_.dsp_lp_length "Aussetzerfenster L�nge,2,Y, !!! Dummy not for Gredi !!!" ULONG FORMULA_0584 0 0 0.0 24.5760 ECU_ADDRESS 0xC60AF0 /end MEASUREMENT
/begin MEASUREMENT dsp_ZylDat_4of10_.dsp_lp_length "Aussetzerfenster L�nge,2,Y, !!! Dummy not for Gredi !!!" ULONG FORMULA_0584 0 0 0.0 24.5760 ECU_ADDRESS 0xC60B2C /end MEASUREMENT
/begin MEASUREMENT dsp_ZylDat_5of10_.dsp_lp_length "Aussetzerfenster L�nge,2,Y, !!! Dummy not for Gredi !!!" ULONG FORMULA_0584 0 0 0.0 24.5760 ECU_ADDRESS 0xC60B68 /end MEASUREMENT
/begin MEASUREMENT dsp_ZylDat_6of10_.dsp_lp_length "Aussetzerfenster L�nge,2,Y, !!! Dummy not for Gredi !!!" ULONG FORMULA_0584 0 0 0.0 24.5760 ECU_ADDRESS 0xC60BA4 /end MEASUREMENT
/begin MEASUREMENT dsp_ZylDat_7of10_.dsp_lp_length "Aussetzerfenster L�nge,2,Y, !!! Dummy not for Gredi !!!" ULONG FORMULA_0584 0 0 0.0 24.5760 ECU_ADDRESS 0xC60BE0 /end MEASUREMENT
/begin MEASUREMENT dsp_ZylDat_8of10_.dsp_lp_length "Aussetzerfenster L�nge,2,Y, !!! Dummy not for Gredi !!!" ULONG FORMULA_0584 0 0 0.0 24.5760 ECU_ADDRESS 0xC60C1C /end MEASUREMENT
/begin MEASUREMENT dsp_ZylDat_9of10_.dsp_lp_length "Aussetzerfenster L�nge,2,Y, !!! Dummy not for Gredi !!!" ULONG FORMULA_0584 0 0 0.0 24.5760 ECU_ADDRESS 0xC60C58 /end MEASUREMENT
/begin MEASUREMENT dsp_ZylDat_10of10_.dsp_lp_length "Aussetzerfenster L�nge,2,Y, !!! Dummy not for Gredi !!!" ULONG FORMULA_0584 0 0 0.0 24.5760 ECU_ADDRESS 0xC60C94 /end MEASUREMENT
/begin MEASUREMENT dsp_ZylDat_1of10_.dsp_min_avg_int "Minimalintegral im Aussetzerfenster,3,Y, !!! Dummy not for Gredi !!!" SLONG FORMULA_0585 0 0 0.0 50.0000 ECU_ADDRESS 0xC60A7C /end MEASUREMENT
/begin MEASUREMENT dsp_ZylDat_2of10_.dsp_min_avg_int "Minimalintegral im Aussetzerfenster,3,Y, !!! Dummy not for Gredi !!!" SLONG FORMULA_0585 0 0 0.0 50.0000 ECU_ADDRESS 0xC60AB8 /end MEASUREMENT
/begin MEASUREMENT dsp_ZylDat_3of10_.dsp_min_avg_int "Minimalintegral im Aussetzerfenster,3,Y, !!! Dummy not for Gredi !!!" SLONG FORMULA_0585 0 0 0.0 50.0000 ECU_ADDRESS 0xC60AF4 /end MEASUREMENT
/begin MEASUREMENT dsp_ZylDat_4of10_.dsp_min_avg_int "Minimalintegral im Aussetzerfenster,3,Y, !!! Dummy not for Gredi !!!" SLONG FORMULA_0585 0 0 0.0 50.0000 ECU_ADDRESS 0xC60B30 /end MEASUREMENT
/begin MEASUREMENT dsp_ZylDat_5of10_.dsp_min_avg_int "Minimalintegral im Aussetzerfenster,3,Y, !!! Dummy not for Gredi !!!" SLONG FORMULA_0585 0 0 0.0 50.0000 ECU_ADDRESS 0xC60B6C /end MEASUREMENT
/begin MEASUREMENT dsp_ZylDat_6of10_.dsp_min_avg_int "Minimalintegral im Aussetzerfenster,3,Y, !!! Dummy not for Gredi !!!" SLONG FORMULA_0585 0 0 0.0 50.0000 ECU_ADDRESS 0xC60BA8 /end MEASUREMENT
/begin MEASUREMENT dsp_ZylDat_7of10_.dsp_min_avg_int "Minimalintegral im Aussetzerfenster,3,Y, !!! Dummy not for Gredi !!!" SLONG FORMULA_0585 0 0 0.0 50.0000 ECU_ADDRESS 0xC60BE4 /end MEASUREMENT
/begin MEASUREMENT dsp_ZylDat_8of10_.dsp_min_avg_int "Minimalintegral im Aussetzerfenster,3,Y, !!! Dummy not for Gredi !!!" SLONG FORMULA_0585 0 0 0.0 50.0000 ECU_ADDRESS 0xC60C20 /end MEASUREMENT
/begin MEASUREMENT dsp_ZylDat_9of10_.dsp_min_avg_int "Minimalintegral im Aussetzerfenster,3,Y, !!! Dummy not for Gredi !!!" SLONG FORMULA_0585 0 0 0.0 50.0000 ECU_ADDRESS 0xC60C5C /end MEASUREMENT
/begin MEASUREMENT dsp_ZylDat_10of10_.dsp_min_avg_int "Minimalintegral im Aussetzerfenster,3,Y, !!! Dummy not for Gredi !!!" SLONG FORMULA_0585 0 0 0.0 50.0000 ECU_ADDRESS 0xC60C98 /end MEASUREMENT
/begin MEASUREMENT dsp_ZylDat_1of10_.dsp_lp_int_value "TP-Integral im Aussetzerfenster,4,Y, !!! Dummy not for Gredi !!!" SLONG FORMULA_0585 0 0 0.0 50.0000 ECU_ADDRESS 0xC60A80 /end MEASUREMENT
/begin MEASUREMENT dsp_ZylDat_2of10_.dsp_lp_int_value "TP-Integral im Aussetzerfenster,4,Y, !!! Dummy not for Gredi !!!" SLONG FORMULA_0585 0 0 0.0 50.0000 ECU_ADDRESS 0xC60ABC /end MEASUREMENT
/begin MEASUREMENT dsp_ZylDat_3of10_.dsp_lp_int_value "TP-Integral im Aussetzerfenster,4,Y, !!! Dummy not for Gredi !!!" SLONG FORMULA_0585 0 0 0.0 50.0000 ECU_ADDRESS 0xC60AF8 /end MEASUREMENT
/begin MEASUREMENT dsp_ZylDat_4of10_.dsp_lp_int_value "TP-Integral im Aussetzerfenster,4,Y, !!! Dummy not for Gredi !!!" SLONG FORMULA_0585 0 0 0.0 50.0000 ECU_ADDRESS 0xC60B34 /end MEASUREMENT
/begin MEASUREMENT dsp_ZylDat_5of10_.dsp_lp_int_value "TP-Integral im Aussetzerfenster,4,Y, !!! Dummy not for Gredi !!!" SLONG FORMULA_0585 0 0 0.0 50.0000 ECU_ADDRESS 0xC60B70 /end MEASUREMENT
/begin MEASUREMENT dsp_ZylDat_6of10_.dsp_lp_int_value "TP-Integral im Aussetzerfenster,4,Y, !!! Dummy not for Gredi !!!" SLONG FORMULA_0585 0 0 0.0 50.0000 ECU_ADDRESS 0xC60BAC /end MEASUREMENT
/begin MEASUREMENT dsp_ZylDat_7of10_.dsp_lp_int_value "TP-Integral im Aussetzerfenster,4,Y, !!! Dummy not for Gredi !!!" SLONG FORMULA_0585 0 0 0.0 50.0000 ECU_ADDRESS 0xC60BE8 /end MEASUREMENT
/begin MEASUREMENT dsp_ZylDat_8of10_.dsp_lp_int_value "TP-Integral im Aussetzerfenster,4,Y, !!! Dummy not for Gredi !!!" SLONG FORMULA_0585 0 0 0.0 50.0000 ECU_ADDRESS 0xC60C24 /end MEASUREMENT
/begin MEASUREMENT dsp_ZylDat_9of10_.dsp_lp_int_value "TP-Integral im Aussetzerfenster,4,Y, !!! Dummy not for Gredi !!!" SLONG FORMULA_0585 0 0 0.0 50.0000 ECU_ADDRESS 0xC60C60 /end MEASUREMENT
/begin MEASUREMENT dsp_ZylDat_10of10_.dsp_lp_int_value "TP-Integral im Aussetzerfenster,4,Y, !!! Dummy not for Gredi !!!" SLONG FORMULA_0585 0 0 0.0 50.0000 ECU_ADDRESS 0xC60C9C /end MEASUREMENT
/begin MEASUREMENT dsp_ZylDat_1of10_.dsp_vr_start "Start Klopffenster,5,Y, !!! Dummy not for Gredi !!!" ULONG FORMULA_0584 0 0 0.0 24.5760 ECU_ADDRESS 0xC60A84 /end MEASUREMENT
/begin MEASUREMENT dsp_ZylDat_2of10_.dsp_vr_start "Start Klopffenster,5,Y, !!! Dummy not for Gredi !!!" ULONG FORMULA_0584 0 0 0.0 24.5760 ECU_ADDRESS 0xC60AC0 /end MEASUREMENT
/begin MEASUREMENT dsp_ZylDat_3of10_.dsp_vr_start "Start Klopffenster,5,Y, !!! Dummy not for Gredi !!!" ULONG FORMULA_0584 0 0 0.0 24.5760 ECU_ADDRESS 0xC60AFC /end MEASUREMENT
/begin MEASUREMENT dsp_ZylDat_4of10_.dsp_vr_start "Start Klopffenster,5,Y, !!! Dummy not for Gredi !!!" ULONG FORMULA_0584 0 0 0.0 24.5760 ECU_ADDRESS 0xC60B38 /end MEASUREMENT
/begin MEASUREMENT dsp_ZylDat_5of10_.dsp_vr_start "Start Klopffenster,5,Y, !!! Dummy not for Gredi !!!" ULONG FORMULA_0584 0 0 0.0 24.5760 ECU_ADDRESS 0xC60B74 /end MEASUREMENT
/begin MEASUREMENT dsp_ZylDat_6of10_.dsp_vr_start "Start Klopffenster,5,Y, !!! Dummy not for Gredi !!!" ULONG FORMULA_0584 0 0 0.0 24.5760 ECU_ADDRESS 0xC60BB0 /end MEASUREMENT
/begin MEASUREMENT dsp_ZylDat_7of10_.dsp_vr_start "Start Klopffenster,5,Y, !!! Dummy not for Gredi !!!" ULONG FORMULA_0584 0 0 0.0 24.5760 ECU_ADDRESS 0xC60BEC /end MEASUREMENT
/begin MEASUREMENT dsp_ZylDat_8of10_.dsp_vr_start "Start Klopffenster,5,Y, !!! Dummy not for Gredi !!!" ULONG FORMULA_0584 0 0 0.0 24.5760 ECU_ADDRESS 0xC60C28 /end MEASUREMENT
/begin MEASUREMENT dsp_ZylDat_9of10_.dsp_vr_start "Start Klopffenster,5,Y, !!! Dummy not for Gredi !!!" ULONG FORMULA_0584 0 0 0.0 24.5760 ECU_ADDRESS 0xC60C64 /end MEASUREMENT
/begin MEASUREMENT dsp_ZylDat_10of10_.dsp_vr_start "Start Klopffenster,5,Y, !!! Dummy not for Gredi !!!" ULONG FORMULA_0584 0 0 0.0 24.5760 ECU_ADDRESS 0xC60CA0 /end MEASUREMENT
/begin MEASUREMENT dsp_ZylDat_1of10_.dsp_vr_length "Klopffenster L�nge,6,Y, !!! Dummy not for Gredi !!!" ULONG FORMULA_0584 0 0 0.0 24.5760 ECU_ADDRESS 0xC60A88 /end MEASUREMENT
/begin MEASUREMENT dsp_ZylDat_2of10_.dsp_vr_length "Klopffenster L�nge,6,Y, !!! Dummy not for Gredi !!!" ULONG FORMULA_0584 0 0 0.0 24.5760 ECU_ADDRESS 0xC60AC4 /end MEASUREMENT
/begin MEASUREMENT dsp_ZylDat_3of10_.dsp_vr_length "Klopffenster L�nge,6,Y, !!! Dummy not for Gredi !!!" ULONG FORMULA_0584 0 0 0.0 24.5760 ECU_ADDRESS 0xC60B00 /end MEASUREMENT
/begin MEASUREMENT dsp_ZylDat_4of10_.dsp_vr_length "Klopffenster L�nge,6,Y, !!! Dummy not for Gredi !!!" ULONG FORMULA_0584 0 0 0.0 24.5760 ECU_ADDRESS 0xC60B3C /end MEASUREMENT
/begin MEASUREMENT dsp_ZylDat_5of10_.dsp_vr_length "Klopffenster L�nge,6,Y, !!! Dummy not for Gredi !!!" ULONG FORMULA_0584 0 0 0.0 24.5760 ECU_ADDRESS 0xC60B78 /end MEASUREMENT
/begin MEASUREMENT dsp_ZylDat_6of10_.dsp_vr_length "Klopffenster L�nge,6,Y, !!! Dummy not for Gredi !!!" ULONG FORMULA_0584 0 0 0.0 24.5760 ECU_ADDRESS 0xC60BB4 /end MEASUREMENT
/begin MEASUREMENT dsp_ZylDat_7of10_.dsp_vr_length "Klopffenster L�nge,6,Y, !!! Dummy not for Gredi !!!" ULONG FORMULA_0584 0 0 0.0 24.5760 ECU_ADDRESS 0xC60BF0 /end MEASUREMENT
/begin MEASUREMENT dsp_ZylDat_8of10_.dsp_vr_length "Klopffenster L�nge,6,Y, !!! Dummy not for Gredi !!!" ULONG FORMULA_0584 0 0 0.0 24.5760 ECU_ADDRESS 0xC60C2C /end MEASUREMENT
/begin MEASUREMENT dsp_ZylDat_9of10_.dsp_vr_length "Klopffenster L�nge,6,Y, !!! Dummy not for Gredi !!!" ULONG FORMULA_0584 0 0 0.0 24.5760 ECU_ADDRESS 0xC60C68 /end MEASUREMENT
/begin MEASUREMENT dsp_ZylDat_10of10_.dsp_vr_length "Klopffenster L�nge,6,Y, !!! Dummy not for Gredi !!!" ULONG FORMULA_0584 0 0 0.0 24.5760 ECU_ADDRESS 0xC60CA4 /end MEASUREMENT
/begin MEASUREMENT dsp_ZylDat_1of10_.dsp_vr_max_value "Maximalwert im Klopffenster,7,Y, !!! Dummy not for Gredi !!!" SLONG FORMULA_0586 0 0 0.0 3.3000 ECU_ADDRESS 0xC60A8C /end MEASUREMENT
/begin MEASUREMENT dsp_ZylDat_2of10_.dsp_vr_max_value "Maximalwert im Klopffenster,7,Y, !!! Dummy not for Gredi !!!" SLONG FORMULA_0586 0 0 0.0 3.3000 ECU_ADDRESS 0xC60AC8 /end MEASUREMENT
/begin MEASUREMENT dsp_ZylDat_3of10_.dsp_vr_max_value "Maximalwert im Klopffenster,7,Y, !!! Dummy not for Gredi !!!" SLONG FORMULA_0586 0 0 0.0 3.3000 ECU_ADDRESS 0xC60B04 /end MEASUREMENT
/begin MEASUREMENT dsp_ZylDat_4of10_.dsp_vr_max_value "Maximalwert im Klopffenster,7,Y, !!! Dummy not for Gredi !!!" SLONG FORMULA_0586 0 0 0.0 3.3000 ECU_ADDRESS 0xC60B40 /end MEASUREMENT
/begin MEASUREMENT dsp_ZylDat_5of10_.dsp_vr_max_value "Maximalwert im Klopffenster,7,Y, !!! Dummy not for Gredi !!!" SLONG FORMULA_0586 0 0 0.0 3.3000 ECU_ADDRESS 0xC60B7C /end MEASUREMENT
/begin MEASUREMENT dsp_ZylDat_6of10_.dsp_vr_max_value "Maximalwert im Klopffenster,7,Y, !!! Dummy not for Gredi !!!" SLONG FORMULA_0586 0 0 0.0 3.3000 ECU_ADDRESS 0xC60BB8 /end MEASUREMENT
/begin MEASUREMENT dsp_ZylDat_7of10_.dsp_vr_max_value "Maximalwert im Klopffenster,7,Y, !!! Dummy not for Gredi !!!" SLONG FORMULA_0586 0 0 0.0 3.3000 ECU_ADDRESS 0xC60BF4 /end MEASUREMENT
/begin MEASUREMENT dsp_ZylDat_8of10_.dsp_vr_max_value "Maximalwert im Klopffenster,7,Y, !!! Dummy not for Gredi !!!" SLONG FORMULA_0586 0 0 0.0 3.3000 ECU_ADDRESS 0xC60C30 /end MEASUREMENT
/begin MEASUREMENT dsp_ZylDat_9of10_.dsp_vr_max_value "Maximalwert im Klopffenster,7,Y, !!! Dummy not for Gredi !!!" SLONG FORMULA_0586 0 0 0.0 3.3000 ECU_ADDRESS 0xC60C6C /end MEASUREMENT
/begin MEASUREMENT dsp_ZylDat_10of10_.dsp_vr_max_value "Maximalwert im Klopffenster,7,Y, !!! Dummy not for Gredi !!!" SLONG FORMULA_0586 0 0 0.0 3.3000 ECU_ADDRESS 0xC60CA8 /end MEASUREMENT
/begin MEASUREMENT dsp_ZylDat_1of10_.dsp_fbs "DFT Energiespektrum,8,Y, !!! Dummy not for Gredi !!!" FLOAT32_IEEE FORMULA_0041 0 0 -340282346638528860000000000000000000000.0000 340282346638528860000000000000000000000.0000 ECU_ADDRESS 0xC60A90 /end MEASUREMENT
/begin MEASUREMENT dsp_ZylDat_2of10_.dsp_fbs "DFT Energiespektrum,8,Y, !!! Dummy not for Gredi !!!" FLOAT32_IEEE FORMULA_0041 0 0 -340282346638528860000000000000000000000.0000 340282346638528860000000000000000000000.0000 ECU_ADDRESS 0xC60ACC /end MEASUREMENT
/begin MEASUREMENT dsp_ZylDat_3of10_.dsp_fbs "DFT Energiespektrum,8,Y, !!! Dummy not for Gredi !!!" FLOAT32_IEEE FORMULA_0041 0 0 -340282346638528860000000000000000000000.0000 340282346638528860000000000000000000000.0000 ECU_ADDRESS 0xC60B08 /end MEASUREMENT
/begin MEASUREMENT dsp_ZylDat_4of10_.dsp_fbs "DFT Energiespektrum,8,Y, !!! Dummy not for Gredi !!!" FLOAT32_IEEE FORMULA_0041 0 0 -340282346638528860000000000000000000000.0000 340282346638528860000000000000000000000.0000 ECU_ADDRESS 0xC60B44 /end MEASUREMENT
/begin MEASUREMENT dsp_ZylDat_5of10_.dsp_fbs "DFT Energiespektrum,8,Y, !!! Dummy not for Gredi !!!" FLOAT32_IEEE FORMULA_0041 0 0 -340282346638528860000000000000000000000.0000 340282346638528860000000000000000000000.0000 ECU_ADDRESS 0xC60B80 /end MEASUREMENT
/begin MEASUREMENT dsp_ZylDat_6of10_.dsp_fbs "DFT Energiespektrum,8,Y, !!! Dummy not for Gredi !!!" FLOAT32_IEEE FORMULA_0041 0 0 -340282346638528860000000000000000000000.0000 340282346638528860000000000000000000000.0000 ECU_ADDRESS 0xC60BBC /end MEASUREMENT
/begin MEASUREMENT dsp_ZylDat_7of10_.dsp_fbs "DFT Energiespektrum,8,Y, !!! Dummy not for Gredi !!!" FLOAT32_IEEE FORMULA_0041 0 0 -340282346638528860000000000000000000000.0000 340282346638528860000000000000000000000.0000 ECU_ADDRESS 0xC60BF8 /end MEASUREMENT
/begin MEASUREMENT dsp_ZylDat_8of10_.dsp_fbs "DFT Energiespektrum,8,Y, !!! Dummy not for Gredi !!!" FLOAT32_IEEE FORMULA_0041 0 0 -340282346638528860000000000000000000000.0000 340282346638528860000000000000000000000.0000 ECU_ADDRESS 0xC60C34 /end MEASUREMENT
/begin MEASUREMENT dsp_ZylDat_9of10_.dsp_fbs "DFT Energiespektrum,8,Y, !!! Dummy not for Gredi !!!" FLOAT32_IEEE FORMULA_0041 0 0 -340282346638528860000000000000000000000.0000 340282346638528860000000000000000000000.0000 ECU_ADDRESS 0xC60C70 /end MEASUREMENT
/begin MEASUREMENT dsp_ZylDat_10of10_.dsp_fbs "DFT Energiespektrum,8,Y, !!! Dummy not for Gredi !!!" FLOAT32_IEEE FORMULA_0041 0 0 -340282346638528860000000000000000000000.0000 340282346638528860000000000000000000000.0000 ECU_ADDRESS 0xC60CAC /end MEASUREMENT
/begin MEASUREMENT dsp_ZylDat_1of10_.dsp_cam_cycle_cnt "DFT Spannungsspektrum,8,Y, !!! Dummy not for Gredi !!!" ULONG FORMULA_0041 0 0 0.0 4294967295.0000 ECU_ADDRESS 0xC60A94 /end MEASUREMENT
/begin MEASUREMENT dsp_ZylDat_2of10_.dsp_cam_cycle_cnt "DFT Spannungsspektrum,8,Y, !!! Dummy not for Gredi !!!" ULONG FORMULA_0041 0 0 0.0 4294967295.0000 ECU_ADDRESS 0xC60AD0 /end MEASUREMENT
/begin MEASUREMENT dsp_ZylDat_3of10_.dsp_cam_cycle_cnt "DFT Spannungsspektrum,8,Y, !!! Dummy not for Gredi !!!" ULONG FORMULA_0041 0 0 0.0 4294967295.0000 ECU_ADDRESS 0xC60B0C /end MEASUREMENT
/begin MEASUREMENT dsp_ZylDat_4of10_.dsp_cam_cycle_cnt "DFT Spannungsspektrum,8,Y, !!! Dummy not for Gredi !!!" ULONG FORMULA_0041 0 0 0.0 4294967295.0000 ECU_ADDRESS 0xC60B48 /end MEASUREMENT
/begin MEASUREMENT dsp_ZylDat_5of10_.dsp_cam_cycle_cnt "DFT Spannungsspektrum,8,Y, !!! Dummy not for Gredi !!!" ULONG FORMULA_0041 0 0 0.0 4294967295.0000 ECU_ADDRESS 0xC60B84 /end MEASUREMENT
/begin MEASUREMENT dsp_ZylDat_6of10_.dsp_cam_cycle_cnt "DFT Spannungsspektrum,8,Y, !!! Dummy not for Gredi !!!" ULONG FORMULA_0041 0 0 0.0 4294967295.0000 ECU_ADDRESS 0xC60BC0 /end MEASUREMENT
/begin MEASUREMENT dsp_ZylDat_7of10_.dsp_cam_cycle_cnt "DFT Spannungsspektrum,8,Y, !!! Dummy not for Gredi !!!" ULONG FORMULA_0041 0 0 0.0 4294967295.0000 ECU_ADDRESS 0xC60BFC /end MEASUREMENT
/begin MEASUREMENT dsp_ZylDat_8of10_.dsp_cam_cycle_cnt "DFT Spannungsspektrum,8,Y, !!! Dummy not for Gredi !!!" ULONG FORMULA_0041 0 0 0.0 4294967295.0000 ECU_ADDRESS 0xC60C38 /end MEASUREMENT
/begin MEASUREMENT dsp_ZylDat_9of10_.dsp_cam_cycle_cnt "DFT Spannungsspektrum,8,Y, !!! Dummy not for Gredi !!!" ULONG FORMULA_0041 0 0 0.0 4294967295.0000 ECU_ADDRESS 0xC60C74 /end MEASUREMENT
/begin MEASUREMENT dsp_ZylDat_10of10_.dsp_cam_cycle_cnt "DFT Spannungsspektrum,8,Y, !!! Dummy not for Gredi !!!" ULONG FORMULA_0041 0 0 0.0 4294967295.0000 ECU_ADDRESS 0xC60CB0 /end MEASUREMENT
/begin MEASUREMENT dsp_ZylDat_1of10_.kr_st_erk "Status Klopferkennung,10,Y, !!! Dummy not for Gredi !!!" ULONG FORMULA_0883 0 0 0.0 255.0 ECU_ADDRESS 0xC60A98 BIT_MASK 0x1 /end MEASUREMENT
/begin MEASUREMENT dsp_ZylDat_2of10_.kr_st_erk "Status Klopferkennung,10,Y, !!! Dummy not for Gredi !!!" ULONG FORMULA_0883 0 0 0.0 255.0 ECU_ADDRESS 0xC60AD4 BIT_MASK 0x1 /end MEASUREMENT
/begin MEASUREMENT dsp_ZylDat_3of10_.kr_st_erk "Status Klopferkennung,10,Y, !!! Dummy not for Gredi !!!" ULONG FORMULA_0883 0 0 0.0 255.0 ECU_ADDRESS 0xC60B10 BIT_MASK 0x1 /end MEASUREMENT
/begin MEASUREMENT dsp_ZylDat_4of10_.kr_st_erk "Status Klopferkennung,10,Y, !!! Dummy not for Gredi !!!" ULONG FORMULA_0883 0 0 0.0 255.0 ECU_ADDRESS 0xC60B4C BIT_MASK 0x1 /end MEASUREMENT
/begin MEASUREMENT dsp_ZylDat_5of10_.kr_st_erk "Status Klopferkennung,10,Y, !!! Dummy not for Gredi !!!" ULONG FORMULA_0883 0 0 0.0 255.0 ECU_ADDRESS 0xC60B88 BIT_MASK 0x1 /end MEASUREMENT
/begin MEASUREMENT dsp_ZylDat_6of10_.kr_st_erk "Status Klopferkennung,10,Y, !!! Dummy not for Gredi !!!" ULONG FORMULA_0883 0 0 0.0 255.0 ECU_ADDRESS 0xC60BC4 BIT_MASK 0x1 /end MEASUREMENT
/begin MEASUREMENT dsp_ZylDat_7of10_.kr_st_erk "Status Klopferkennung,10,Y, !!! Dummy not for Gredi !!!" ULONG FORMULA_0883 0 0 0.0 255.0 ECU_ADDRESS 0xC60C00 BIT_MASK 0x1 /end MEASUREMENT
/begin MEASUREMENT dsp_ZylDat_8of10_.kr_st_erk "Status Klopferkennung,10,Y, !!! Dummy not for Gredi !!!" ULONG FORMULA_0883 0 0 0.0 255.0 ECU_ADDRESS 0xC60C3C BIT_MASK 0x1 /end MEASUREMENT
/begin MEASUREMENT dsp_ZylDat_9of10_.kr_st_erk "Status Klopferkennung,10,Y, !!! Dummy not for Gredi !!!" ULONG FORMULA_0883 0 0 0.0 255.0 ECU_ADDRESS 0xC60C78 BIT_MASK 0x1 /end MEASUREMENT
/begin MEASUREMENT dsp_ZylDat_10of10_.kr_st_erk "Status Klopferkennung,10,Y, !!! Dummy not for Gredi !!!" ULONG FORMULA_0883 0 0 0.0 255.0 ECU_ADDRESS 0xC60CB4 BIT_MASK 0x1 /end MEASUREMENT
/begin MEASUREMENT dsp_ZylDat_1of10_.kr_dtz "Klopfreglungseingriff,11,Y, !!! Dummy not for Gredi !!!" SLONG FORMULA_0244 0 0 -50.0000 60.0000 ECU_ADDRESS 0xC60A9C /end MEASUREMENT
/begin MEASUREMENT dsp_ZylDat_2of10_.kr_dtz "Klopfreglungseingriff,11,Y, !!! Dummy not for Gredi !!!" SLONG FORMULA_0244 0 0 -50.0000 60.0000 ECU_ADDRESS 0xC60AD8 /end MEASUREMENT
/begin MEASUREMENT dsp_ZylDat_3of10_.kr_dtz "Klopfreglungseingriff,11,Y, !!! Dummy not for Gredi !!!" SLONG FORMULA_0244 0 0 -50.0000 60.0000 ECU_ADDRESS 0xC60B14 /end MEASUREMENT
/begin MEASUREMENT dsp_ZylDat_4of10_.kr_dtz "Klopfreglungseingriff,11,Y, !!! Dummy not for Gredi !!!" SLONG FORMULA_0244 0 0 -50.0000 60.0000 ECU_ADDRESS 0xC60B50 /end MEASUREMENT
/begin MEASUREMENT dsp_ZylDat_5of10_.kr_dtz "Klopfreglungseingriff,11,Y, !!! Dummy not for Gredi !!!" SLONG FORMULA_0244 0 0 -50.0000 60.0000 ECU_ADDRESS 0xC60B8C /end MEASUREMENT
/begin MEASUREMENT dsp_ZylDat_6of10_.kr_dtz "Klopfreglungseingriff,11,Y, !!! Dummy not for Gredi !!!" SLONG FORMULA_0244 0 0 -50.0000 60.0000 ECU_ADDRESS 0xC60BC8 /end MEASUREMENT
/begin MEASUREMENT dsp_ZylDat_7of10_.kr_dtz "Klopfreglungseingriff,11,Y, !!! Dummy not for Gredi !!!" SLONG FORMULA_0244 0 0 -50.0000 60.0000 ECU_ADDRESS 0xC60C04 /end MEASUREMENT
/begin MEASUREMENT dsp_ZylDat_8of10_.kr_dtz "Klopfreglungseingriff,11,Y, !!! Dummy not for Gredi !!!" SLONG FORMULA_0244 0 0 -50.0000 60.0000 ECU_ADDRESS 0xC60C40 /end MEASUREMENT
/begin MEASUREMENT dsp_ZylDat_9of10_.kr_dtz "Klopfreglungseingriff,11,Y, !!! Dummy not for Gredi !!!" SLONG FORMULA_0244 0 0 -50.0000 60.0000 ECU_ADDRESS 0xC60C7C /end MEASUREMENT
/begin MEASUREMENT dsp_ZylDat_10of10_.kr_dtz "Klopfreglungseingriff,11,Y, !!! Dummy not for Gredi !!!" SLONG FORMULA_0244 0 0 -50.0000 60.0000 ECU_ADDRESS 0xC60CB8 /end MEASUREMENT
/begin MEASUREMENT dsp_ZylDat_1of10_.vr_mess_ist "Istverstaerkung,12,Y, !!! Dummy not for Gredi !!!" SLONG FORMULA_0884 0 0 0.0 16.0000 ECU_ADDRESS 0xC60AA0 /end MEASUREMENT
/begin MEASUREMENT dsp_ZylDat_2of10_.vr_mess_ist "Istverstaerkung,12,Y, !!! Dummy not for Gredi !!!" SLONG FORMULA_0884 0 0 0.0 16.0000 ECU_ADDRESS 0xC60ADC /end MEASUREMENT
/begin MEASUREMENT dsp_ZylDat_3of10_.vr_mess_ist "Istverstaerkung,12,Y, !!! Dummy not for Gredi !!!" SLONG FORMULA_0884 0 0 0.0 16.0000 ECU_ADDRESS 0xC60B18 /end MEASUREMENT
/begin MEASUREMENT dsp_ZylDat_4of10_.vr_mess_ist "Istverstaerkung,12,Y, !!! Dummy not for Gredi !!!" SLONG FORMULA_0884 0 0 0.0 16.0000 ECU_ADDRESS 0xC60B54 /end MEASUREMENT
/begin MEASUREMENT dsp_ZylDat_5of10_.vr_mess_ist "Istverstaerkung,12,Y, !!! Dummy not for Gredi !!!" SLONG FORMULA_0884 0 0 0.0 16.0000 ECU_ADDRESS 0xC60B90 /end MEASUREMENT
/begin MEASUREMENT dsp_ZylDat_6of10_.vr_mess_ist "Istverstaerkung,12,Y, !!! Dummy not for Gredi !!!" SLONG FORMULA_0884 0 0 0.0 16.0000 ECU_ADDRESS 0xC60BCC /end MEASUREMENT
/begin MEASUREMENT dsp_ZylDat_7of10_.vr_mess_ist "Istverstaerkung,12,Y, !!! Dummy not for Gredi !!!" SLONG FORMULA_0884 0 0 0.0 16.0000 ECU_ADDRESS 0xC60C08 /end MEASUREMENT
/begin MEASUREMENT dsp_ZylDat_8of10_.vr_mess_ist "Istverstaerkung,12,Y, !!! Dummy not for Gredi !!!" SLONG FORMULA_0884 0 0 0.0 16.0000 ECU_ADDRESS 0xC60C44 /end MEASUREMENT
/begin MEASUREMENT dsp_ZylDat_9of10_.vr_mess_ist "Istverstaerkung,12,Y, !!! Dummy not for Gredi !!!" SLONG FORMULA_0884 0 0 0.0 16.0000 ECU_ADDRESS 0xC60C80 /end MEASUREMENT
/begin MEASUREMENT dsp_ZylDat_10of10_.vr_mess_ist "Istverstaerkung,12,Y, !!! Dummy not for Gredi !!!" SLONG FORMULA_0884 0 0 0.0 16.0000 ECU_ADDRESS 0xC60CBC /end MEASUREMENT
/begin MEASUREMENT dsp_ZylDat_1of10_.auss_spark_time "Funkenbrenndauer,13,Y, !!! Dummy not for Gredi !!!" ULONG FORMULA_0017 0 0 0.0 4.6810 ECU_ADDRESS 0xC60AA4 /end MEASUREMENT
/begin MEASUREMENT dsp_ZylDat_2of10_.auss_spark_time "Funkenbrenndauer,13,Y, !!! Dummy not for Gredi !!!" ULONG FORMULA_0017 0 0 0.0 4.6810 ECU_ADDRESS 0xC60AE0 /end MEASUREMENT
/begin MEASUREMENT dsp_ZylDat_3of10_.auss_spark_time "Funkenbrenndauer,13,Y, !!! Dummy not for Gredi !!!" ULONG FORMULA_0017 0 0 0.0 4.6810 ECU_ADDRESS 0xC60B1C /end MEASUREMENT
/begin MEASUREMENT dsp_ZylDat_4of10_.auss_spark_time "Funkenbrenndauer,13,Y, !!! Dummy not for Gredi !!!" ULONG FORMULA_0017 0 0 0.0 4.6810 ECU_ADDRESS 0xC60B58 /end MEASUREMENT
/begin MEASUREMENT dsp_ZylDat_5of10_.auss_spark_time "Funkenbrenndauer,13,Y, !!! Dummy not for Gredi !!!" ULONG FORMULA_0017 0 0 0.0 4.6810 ECU_ADDRESS 0xC60B94 /end MEASUREMENT
/begin MEASUREMENT dsp_ZylDat_6of10_.auss_spark_time "Funkenbrenndauer,13,Y, !!! Dummy not for Gredi !!!" ULONG FORMULA_0017 0 0 0.0 4.6810 ECU_ADDRESS 0xC60BD0 /end MEASUREMENT
/begin MEASUREMENT dsp_ZylDat_7of10_.auss_spark_time "Funkenbrenndauer,13,Y, !!! Dummy not for Gredi !!!" ULONG FORMULA_0017 0 0 0.0 4.6810 ECU_ADDRESS 0xC60C0C /end MEASUREMENT
/begin MEASUREMENT dsp_ZylDat_8of10_.auss_spark_time "Funkenbrenndauer,13,Y, !!! Dummy not for Gredi !!!" ULONG FORMULA_0017 0 0 0.0 4.6810 ECU_ADDRESS 0xC60C48 /end MEASUREMENT
/begin MEASUREMENT dsp_ZylDat_9of10_.auss_spark_time "Funkenbrenndauer,13,Y, !!! Dummy not for Gredi !!!" ULONG FORMULA_0017 0 0 0.0 4.6810 ECU_ADDRESS 0xC60C84 /end MEASUREMENT
/begin MEASUREMENT dsp_ZylDat_10of10_.auss_spark_time "Funkenbrenndauer,13,Y, !!! Dummy not for Gredi !!!" ULONG FORMULA_0017 0 0 0.0 4.6810 ECU_ADDRESS 0xC60CC0 /end MEASUREMENT
/begin MEASUREMENT dsp_ZylDat_1of10_.min_avg_samples "Anzahl Messpunkte Minimalintegral,14,Y, !!! Dummy not for Gredi !!!" ULONG FORMULA_0584 0 0 0.0 24.5760 ECU_ADDRESS 0xC60AA8 /end MEASUREMENT
/begin MEASUREMENT dsp_ZylDat_2of10_.min_avg_samples "Anzahl Messpunkte Minimalintegral,14,Y, !!! Dummy not for Gredi !!!" ULONG FORMULA_0584 0 0 0.0 24.5760 ECU_ADDRESS 0xC60AE4 /end MEASUREMENT
/begin MEASUREMENT dsp_ZylDat_3of10_.min_avg_samples "Anzahl Messpunkte Minimalintegral,14,Y, !!! Dummy not for Gredi !!!" ULONG FORMULA_0584 0 0 0.0 24.5760 ECU_ADDRESS 0xC60B20 /end MEASUREMENT
/begin MEASUREMENT dsp_ZylDat_4of10_.min_avg_samples "Anzahl Messpunkte Minimalintegral,14,Y, !!! Dummy not for Gredi !!!" ULONG FORMULA_0584 0 0 0.0 24.5760 ECU_ADDRESS 0xC60B5C /end MEASUREMENT
/begin MEASUREMENT dsp_ZylDat_5of10_.min_avg_samples "Anzahl Messpunkte Minimalintegral,14,Y, !!! Dummy not for Gredi !!!" ULONG FORMULA_0584 0 0 0.0 24.5760 ECU_ADDRESS 0xC60B98 /end MEASUREMENT
/begin MEASUREMENT dsp_ZylDat_6of10_.min_avg_samples "Anzahl Messpunkte Minimalintegral,14,Y, !!! Dummy not for Gredi !!!" ULONG FORMULA_0584 0 0 0.0 24.5760 ECU_ADDRESS 0xC60BD4 /end MEASUREMENT
/begin MEASUREMENT dsp_ZylDat_7of10_.min_avg_samples "Anzahl Messpunkte Minimalintegral,14,Y, !!! Dummy not for Gredi !!!" ULONG FORMULA_0584 0 0 0.0 24.5760 ECU_ADDRESS 0xC60C10 /end MEASUREMENT
/begin MEASUREMENT dsp_ZylDat_8of10_.min_avg_samples "Anzahl Messpunkte Minimalintegral,14,Y, !!! Dummy not for Gredi !!!" ULONG FORMULA_0584 0 0 0.0 24.5760 ECU_ADDRESS 0xC60C4C /end MEASUREMENT
/begin MEASUREMENT dsp_ZylDat_9of10_.min_avg_samples "Anzahl Messpunkte Minimalintegral,14,Y, !!! Dummy not for Gredi !!!" ULONG FORMULA_0584 0 0 0.0 24.5760 ECU_ADDRESS 0xC60C88 /end MEASUREMENT
/begin MEASUREMENT dsp_ZylDat_10of10_.min_avg_samples "Anzahl Messpunkte Minimalintegral,14,Y, !!! Dummy not for Gredi !!!" ULONG FORMULA_0584 0 0 0.0 24.5760 ECU_ADDRESS 0xC60CC4 /end MEASUREMENT
/begin MEASUREMENT dsp_100KHzDat_1of10_.dsp_ion "dsp_ion,1,Y, !!! Dummy not for Gredi !!!" UWORD FORMULA_0885 0 0 0.0 5.0000 ECU_ADDRESS 0xC60CC8 /end MEASUREMENT
/begin MEASUREMENT dsp_100KHzDat_2of10_.dsp_ion "dsp_ion,1,Y, !!! Dummy not for Gredi !!!" UWORD FORMULA_0885 0 0 0.0 5.0000 ECU_ADDRESS 0xC60CCC /end MEASUREMENT
/begin MEASUREMENT dsp_100KHzDat_3of10_.dsp_ion "dsp_ion,1,Y, !!! Dummy not for Gredi !!!" UWORD FORMULA_0885 0 0 0.0 5.0000 ECU_ADDRESS 0xC60CD0 /end MEASUREMENT
/begin MEASUREMENT dsp_100KHzDat_4of10_.dsp_ion "dsp_ion,1,Y, !!! Dummy not for Gredi !!!" UWORD FORMULA_0885 0 0 0.0 5.0000 ECU_ADDRESS 0xC60CD4 /end MEASUREMENT
/begin MEASUREMENT dsp_100KHzDat_5of10_.dsp_ion "dsp_ion,1,Y, !!! Dummy not for Gredi !!!" UWORD FORMULA_0885 0 0 0.0 5.0000 ECU_ADDRESS 0xC60CD8 /end MEASUREMENT
/begin MEASUREMENT dsp_100KHzDat_6of10_.dsp_ion "dsp_ion,1,Y, !!! Dummy not for Gredi !!!" UWORD FORMULA_0885 0 0 0.0 5.0000 ECU_ADDRESS 0xC60CDC /end MEASUREMENT
/begin MEASUREMENT dsp_100KHzDat_7of10_.dsp_ion "dsp_ion,1,Y, !!! Dummy not for Gredi !!!" UWORD FORMULA_0885 0 0 0.0 5.0000 ECU_ADDRESS 0xC60CE0 /end MEASUREMENT
/begin MEASUREMENT dsp_100KHzDat_8of10_.dsp_ion "dsp_ion,1,Y, !!! Dummy not for Gredi !!!" UWORD FORMULA_0885 0 0 0.0 5.0000 ECU_ADDRESS 0xC60CE4 /end MEASUREMENT
/begin MEASUREMENT dsp_100KHzDat_9of10_.dsp_ion "dsp_ion,1,Y, !!! Dummy not for Gredi !!!" UWORD FORMULA_0885 0 0 0.0 5.0000 ECU_ADDRESS 0xC60CE8 /end MEASUREMENT
/begin MEASUREMENT dsp_100KHzDat_10of10_.dsp_ion "dsp_ion,1,Y, !!! Dummy not for Gredi !!!" UWORD FORMULA_0885 0 0 0.0 5.0000 ECU_ADDRESS 0xC60CEC /end MEASUREMENT
/begin MEASUREMENT dsp_100KHzDat_1of10_.dsp_p "dsp_p,2,Y, !!! Dummy not for Gredi !!!" UWORD FORMULA_0886 0 0 0.0 150.0000 ECU_ADDRESS 0xC60CCA /end MEASUREMENT
/begin MEASUREMENT dsp_100KHzDat_2of10_.dsp_p "dsp_p,2,Y, !!! Dummy not for Gredi !!!" UWORD FORMULA_0886 0 0 0.0 150.0000 ECU_ADDRESS 0xC60CCE /end MEASUREMENT
/begin MEASUREMENT dsp_100KHzDat_3of10_.dsp_p "dsp_p,2,Y, !!! Dummy not for Gredi !!!" UWORD FORMULA_0886 0 0 0.0 150.0000 ECU_ADDRESS 0xC60CD2 /end MEASUREMENT
/begin MEASUREMENT dsp_100KHzDat_4of10_.dsp_p "dsp_p,2,Y, !!! Dummy not for Gredi !!!" UWORD FORMULA_0886 0 0 0.0 150.0000 ECU_ADDRESS 0xC60CD6 /end MEASUREMENT
/begin MEASUREMENT dsp_100KHzDat_5of10_.dsp_p "dsp_p,2,Y, !!! Dummy not for Gredi !!!" UWORD FORMULA_0886 0 0 0.0 150.0000 ECU_ADDRESS 0xC60CDA /end MEASUREMENT
/begin MEASUREMENT dsp_100KHzDat_6of10_.dsp_p "dsp_p,2,Y, !!! Dummy not for Gredi !!!" UWORD FORMULA_0886 0 0 0.0 150.0000 ECU_ADDRESS 0xC60CDE /end MEASUREMENT
/begin MEASUREMENT dsp_100KHzDat_7of10_.dsp_p "dsp_p,2,Y, !!! Dummy not for Gredi !!!" UWORD FORMULA_0886 0 0 0.0 150.0000 ECU_ADDRESS 0xC60CE2 /end MEASUREMENT
/begin MEASUREMENT dsp_100KHzDat_8of10_.dsp_p "dsp_p,2,Y, !!! Dummy not for Gredi !!!" UWORD FORMULA_0886 0 0 0.0 150.0000 ECU_ADDRESS 0xC60CE6 /end MEASUREMENT
/begin MEASUREMENT dsp_100KHzDat_9of10_.dsp_p "dsp_p,2,Y, !!! Dummy not for Gredi !!!" UWORD FORMULA_0886 0 0 0.0 150.0000 ECU_ADDRESS 0xC60CEA /end MEASUREMENT
/begin MEASUREMENT dsp_100KHzDat_10of10_.dsp_p "dsp_p,2,Y, !!! Dummy not for Gredi !!!" UWORD FORMULA_0886 0 0 0.0 150.0000 ECU_ADDRESS 0xC60CEE /end MEASUREMENT
/begin MEASUREMENT dsp_KWG.KWG "KWG,1,X, !!! Dummy not for Gredi !!!" SWORD FORMULA_0887 0 0 -50.0000 60.0000 ECU_ADDRESS 0xC60CF0 /end MEASUREMENT
/begin MEASUREMENT eth_ok "Ethernet Controller OK" UBYTE FORMULA_0635 0 0 0.0 255.0 ECU_ADDRESS 0x3FA5CC /end MEASUREMENT
/begin FUNCTION DSP "" /begin DEF_CHARACTERISTIC K_DSP_MESSEN /end DEF_CHARACTERISTIC /begin REF_CHARACTERISTIC /end REF_CHARACTERISTIC /begin IN_MEASUREMENT /end IN_MEASUREMENT
 /begin OUT_MEASUREMENT dsp_100KHzDat_10of10_.dsp_ion dsp_100KHzDat_10of10_.dsp_p dsp_100KHzDat_1of10_.dsp_ion dsp_100KHzDat_1of10_.dsp_p dsp_100KHzDat_2of10_.dsp_ion dsp_100KHzDat_2of10_.dsp_p dsp_100KHzDat_3of10_.dsp_ion dsp_100KHzDat_3of10_.dsp_p dsp_100KHzDat_4of10_.dsp_ion dsp_100KHzDat_4of10_.dsp_p dsp_100KHzDat_5of10_.dsp_ion dsp_100KHzDat_5of10_.dsp_p dsp_100KHzDat_6of10_.dsp_ion dsp_100KHzDat_6of10_.dsp_p dsp_100KHzDat_7of10_.dsp_ion dsp_100KHzDat_7of10_.dsp_p dsp_100KHzDat_8of10_.dsp_ion dsp_100KHzDat_8of10_.dsp_p dsp_100KHzDat_9of10_.dsp_ion dsp_100KHzDat_9of10_.dsp_p dsp_KWG.KWG dsp_MotDat.auss_erk_ns dsp_MotDat.auss_erk_ns_zyl1 dsp_MotDat.auss_erk_ns_zyl10 dsp_MotDat.auss_erk_ns_zyl2 dsp_MotDat.auss_erk_ns_zyl3 dsp_MotDat.auss_erk_ns_zyl4 dsp_MotDat.auss_erk_ns_zyl5 dsp_MotDat.auss_erk_ns_zyl6 dsp_MotDat.auss_erk_ns_zyl7 dsp_MotDat.auss_erk_ns_zyl8 dsp_MotDat.auss_erk_ns_zyl9 dsp_MotDat.auss_erk_ti dsp_MotDat.auss_erk_ti_zyl1 dsp_MotDat.auss_erk_ti_zyl10 dsp_MotDat.auss_erk_ti_zyl2 dsp_MotDat.auss_erk_ti_zyl3 dsp_MotDat.auss_erk_ti_zyl4 dsp_MotDat.auss_erk_ti_zyl5 dsp_MotDat.auss_erk_ti_zyl6 dsp_MotDat.auss_erk_ti_zyl7 dsp_MotDat.auss_erk_ti_zyl8 dsp_MotDat.auss_erk_ti_zyl9 dsp_MotDat.auss_erk_tz dsp_MotDat.auss_erk_tz_zyl1 dsp_MotDat.auss_erk_tz_zyl10 dsp_MotDat.auss_erk_tz_zyl2 dsp_MotDat.auss_erk_tz_zyl3 dsp_MotDat.auss_erk_tz_zyl4 dsp_MotDat.auss_erk_tz_zyl5 dsp_MotDat.auss_erk_tz_zyl6 dsp_MotDat.auss_erk_tz_zyl7 dsp_MotDat.auss_erk_tz_zyl8 dsp_MotDat.auss_erk_tz_zyl9 dsp_MotDat.auss_st_b1 dsp_MotDat.auss_st_b2 dsp_MotDat.auss_st_ti_b1 dsp_MotDat.auss_st_ti_b2 dsp_MotDat.dr_rel_b1 dsp_MotDat.dr_rel_b2 dsp_MotDat.kr_asp_cnt dsp_MotDat.kr_st dsp_MotDat.lam_ist_mw_b1 dsp_MotDat.lam_ist_mw_b2 dsp_MotDat.n dsp_MotDat.rf_b1 dsp_MotDat.rf_b2 dsp_MotDat.van_ist_A1 dsp_MotDat.van_ist_A2 dsp_MotDat.van_ist_E1 dsp_MotDat.van_ist_E2 dsp_MotDat.zustand_motor dsp_ZylDat_10of10_.auss_spark_time dsp_ZylDat_10of10_.dsp_cam_cycle_cnt dsp_ZylDat_10of10_.dsp_fbs dsp_ZylDat_10of10_.dsp_lp_int_value dsp_ZylDat_10of10_.dsp_lp_length dsp_ZylDat_10of10_.dsp_lp_start dsp_ZylDat_10of10_.dsp_min_avg_int dsp_ZylDat_10of10_.dsp_vr_length dsp_ZylDat_10of10_.dsp_vr_max_value dsp_ZylDat_10of10_.dsp_vr_start dsp_ZylDat_10of10_.kr_dtz dsp_ZylDat_10of10_.kr_st_erk dsp_ZylDat_10of10_.min_avg_samples dsp_ZylDat_10of10_.tz dsp_ZylDat_10of10_.vr_mess_ist dsp_ZylDat_1of10_.auss_spark_time dsp_ZylDat_1of10_.dsp_cam_cycle_cnt dsp_ZylDat_1of10_.dsp_fbs dsp_ZylDat_1of10_.dsp_lp_int_value dsp_ZylDat_1of10_.dsp_lp_length dsp_ZylDat_1of10_.dsp_lp_start dsp_ZylDat_1of10_.dsp_min_avg_int dsp_ZylDat_1of10_.dsp_vr_length dsp_ZylDat_1of10_.dsp_vr_max_value dsp_ZylDat_1of10_.dsp_vr_start dsp_ZylDat_1of10_.kr_dtz dsp_ZylDat_1of10_.kr_st_erk dsp_ZylDat_1of10_.min_avg_samples dsp_ZylDat_1of10_.tz dsp_ZylDat_1of10_.vr_mess_ist dsp_ZylDat_2of10_.auss_spark_time dsp_ZylDat_2of10_.dsp_cam_cycle_cnt dsp_ZylDat_2of10_.dsp_fbs dsp_ZylDat_2of10_.dsp_lp_int_value dsp_ZylDat_2of10_.dsp_lp_length dsp_ZylDat_2of10_.dsp_lp_start dsp_ZylDat_2of10_.dsp_min_avg_int dsp_ZylDat_2of10_.dsp_vr_length dsp_ZylDat_2of10_.dsp_vr_max_value dsp_ZylDat_2of10_.dsp_vr_start dsp_ZylDat_2of10_.kr_dtz dsp_ZylDat_2of10_.kr_st_erk dsp_ZylDat_2of10_.min_avg_samples dsp_ZylDat_2of10_.tz dsp_ZylDat_2of10_.vr_mess_ist dsp_ZylDat_3of10_.auss_spark_time dsp_ZylDat_3of10_.dsp_cam_cycle_cnt dsp_ZylDat_3of10_.dsp_fbs dsp_ZylDat_3of10_.dsp_lp_int_value dsp_ZylDat_3of10_.dsp_lp_length dsp_ZylDat_3of10_.dsp_lp_start dsp_ZylDat_3of10_.dsp_min_avg_int dsp_ZylDat_3of10_.dsp_vr_length dsp_ZylDat_3of10_.dsp_vr_max_value dsp_ZylDat_3of10_.dsp_vr_start dsp_ZylDat_3of10_.kr_dtz dsp_ZylDat_3of10_.kr_st_erk dsp_ZylDat_3of10_.min_avg_samples dsp_ZylDat_3of10_.tz dsp_ZylDat_3of10_.vr_mess_ist dsp_ZylDat_4of10_.auss_spark_time dsp_ZylDat_4of10_.dsp_cam_cycle_cnt dsp_ZylDat_4of10_.dsp_fbs dsp_ZylDat_4of10_.dsp_lp_int_value dsp_ZylDat_4of10_.dsp_lp_length dsp_ZylDat_4of10_.dsp_lp_start dsp_ZylDat_4of10_.dsp_min_avg_int dsp_ZylDat_4of10_.dsp_vr_length dsp_ZylDat_4of10_.dsp_vr_max_value dsp_ZylDat_4of10_.dsp_vr_start dsp_ZylDat_4of10_.kr_dtz dsp_ZylDat_4of10_.kr_st_erk dsp_ZylDat_4of10_.min_avg_samples dsp_ZylDat_4of10_.tz dsp_ZylDat_4of10_.vr_mess_ist dsp_ZylDat_5of10_.auss_spark_time dsp_ZylDat_5of10_.dsp_cam_cycle_cnt dsp_ZylDat_5of10_.dsp_fbs dsp_ZylDat_5of10_.dsp_lp_int_value dsp_ZylDat_5of10_.dsp_lp_length dsp_ZylDat_5of10_.dsp_lp_start dsp_ZylDat_5of10_.dsp_min_avg_int dsp_ZylDat_5of10_.dsp_vr_length dsp_ZylDat_5of10_.dsp_vr_max_value dsp_ZylDat_5of10_.dsp_vr_start dsp_ZylDat_5of10_.kr_dtz dsp_ZylDat_5of10_.kr_st_erk dsp_ZylDat_5of10_.min_avg_samples dsp_ZylDat_5of10_.tz dsp_ZylDat_5of10_.vr_mess_ist dsp_ZylDat_6of10_.auss_spark_time dsp_ZylDat_6of10_.dsp_cam_cycle_cnt dsp_ZylDat_6of10_.dsp_fbs dsp_ZylDat_6of10_.dsp_lp_int_value dsp_ZylDat_6of10_.dsp_lp_length dsp_ZylDat_6of10_.dsp_lp_start dsp_ZylDat_6of10_.dsp_min_avg_int dsp_ZylDat_6of10_.dsp_vr_length dsp_ZylDat_6of10_.dsp_vr_max_value dsp_ZylDat_6of10_.dsp_vr_start dsp_ZylDat_6of10_.kr_dtz dsp_ZylDat_6of10_.kr_st_erk dsp_ZylDat_6of10_.min_avg_samples dsp_ZylDat_6of10_.tz dsp_ZylDat_6of10_.vr_mess_ist dsp_ZylDat_7of10_.auss_spark_time dsp_ZylDat_7of10_.dsp_cam_cycle_cnt dsp_ZylDat_7of10_.dsp_fbs dsp_ZylDat_7of10_.dsp_lp_int_value dsp_ZylDat_7of10_.dsp_lp_length dsp_ZylDat_7of10_.dsp_lp_start dsp_ZylDat_7of10_.dsp_min_avg_int dsp_ZylDat_7of10_.dsp_vr_length dsp_ZylDat_7of10_.dsp_vr_max_value dsp_ZylDat_7of10_.dsp_vr_start dsp_ZylDat_7of10_.kr_dtz dsp_ZylDat_7of10_.kr_st_erk dsp_ZylDat_7of10_.min_avg_samples dsp_ZylDat_7of10_.tz dsp_ZylDat_7of10_.vr_mess_ist dsp_ZylDat_8of10_.auss_spark_time dsp_ZylDat_8of10_.dsp_cam_cycle_cnt dsp_ZylDat_8of10_.dsp_fbs dsp_ZylDat_8of10_.dsp_lp_int_value dsp_ZylDat_8of10_.dsp_lp_length dsp_ZylDat_8of10_.dsp_lp_start dsp_ZylDat_8of10_.dsp_min_avg_int dsp_ZylDat_8of10_.dsp_vr_length dsp_ZylDat_8of10_.dsp_vr_max_value dsp_ZylDat_8of10_.dsp_vr_start dsp_ZylDat_8of10_.kr_dtz dsp_ZylDat_8of10_.kr_st_erk dsp_ZylDat_8of10_.min_avg_samples dsp_ZylDat_8of10_.tz dsp_ZylDat_8of10_.vr_mess_ist dsp_ZylDat_9of10_.auss_spark_time dsp_ZylDat_9of10_.dsp_cam_cycle_cnt dsp_ZylDat_9of10_.dsp_fbs dsp_ZylDat_9of10_.dsp_lp_int_value dsp_ZylDat_9of10_.dsp_lp_length dsp_ZylDat_9of10_.dsp_lp_start dsp_ZylDat_9of10_.dsp_min_avg_int dsp_ZylDat_9of10_.dsp_vr_length dsp_ZylDat_9of10_.dsp_vr_max_value dsp_ZylDat_9of10_.dsp_vr_start dsp_ZylDat_9of10_.kr_dtz dsp_ZylDat_9of10_.kr_st_erk dsp_ZylDat_9of10_.min_avg_samples dsp_ZylDat_9of10_.tz dsp_ZylDat_9of10_.vr_mess_ist dsp_alive_cnt dsp_alive_cnt_err dsp_alive_cnt_old dsp_bank_cnt_b1 dsp_bank_cnt_b2 dsp_bus_cnt dsp_cnt_b1 dsp_cnt_b2 dsp_d2p_b1.cam_cycle_cnt dsp_d2p_b1.diag_adc_max dsp_d2p_b1.diag_adc_min dsp_d2p_b1.fbs dsp_d2p_b1.lp_int_value dsp_d2p_b1.lp_samples dsp_d2p_b1.min_avg_int dsp_d2p_b1.min_avg_samples dsp_d2p_b1.ns_samples dsp_d2p_b1.spark_time dsp_d2p_b1.vr_int_value dsp_d2p_b1.vr_max_value dsp_d2p_b1.vr_samples dsp_d2p_b2.cam_cycle_cnt dsp_d2p_b2.diag_adc_max dsp_d2p_b2.diag_adc_min dsp_d2p_b2.fbs dsp_d2p_b2.lp_int_value dsp_d2p_b2.lp_samples dsp_d2p_b2.min_avg_int dsp_d2p_b2.min_avg_samples dsp_d2p_b2.ns_samples dsp_d2p_b2.spark_time dsp_d2p_b2.vr_int_value dsp_d2p_b2.vr_max_value dsp_d2p_b2.vr_samples dsp_dma_st dsp_irq_cnt dsp_load dsp_msgr_0 dsp_msgr_1 dsp_msgr_2 dsp_msgr_3 dsp_msgr_4 dsp_msgr_5 dsp_msgr_6 dsp_msgr_7 dsp_stack_cnt_err dsp_stack_unused dsp_status dsp_zyl1 dsp_zyl10 dsp_zyl2 dsp_zyl3 dsp_zyl4 dsp_zyl5 dsp_zyl6 dsp_zyl7 dsp_zyl8 dsp_zyl9 dsp_zyl_err dsp_zyl_st eth_ok /end OUT_MEASUREMENT
/end FUNCTION
/begin FUNCTION Debugging ""
 /begin DEF_CHARACTERISTIC K_DEBUG_READ_ADR K_DEBUG_RW_LENGTH K_DEBUG_WRITE_ADR K_DEBUG_WRITE_VALUE /end DEF_CHARACTERISTIC
 /begin REF_CHARACTERISTIC /end REF_CHARACTERISTIC
 /begin IN_MEASUREMENT /end IN_MEASUREMENT
 /begin OUT_MEASUREMENT bgTaskCtr cana_ctBoffDbounce canb_ctBoffDbounce debug_rw_result hwTaskCtr r100msTaskCtr r10msTaskCtr r1msTaskCtr r1sTaskCtr r5msTaskCtr syncTaskCtr /end OUT_MEASUREMENT
/end FUNCTION
/begin FUNCTION Diag_tr "" /begin DEF_CHARACTERISTIC K_DIAG_TR_UB_MIN /end DEF_CHARACTERISTIC /begin REF_CHARACTERISTIC /end REF_CHARACTERISTIC /begin IN_MEASUREMENT /end IN_MEASUREMENT /begin OUT_MEASUREMENT /end OUT_MEASUREMENT /end FUNCTION
/begin FUNCTION Drehzahl-Ebene_2 "" /begin DEF_CHARACTERISTIC K_N_E2_DELTA K_N_E2_T_MAX /end DEF_CHARACTERISTIC /begin REF_CHARACTERISTIC /end REF_CHARACTERISTIC /begin IN_MEASUREMENT /end IN_MEASUREMENT /begin OUT_MEASUREMENT n_e2_st n_e2_t /end OUT_MEASUREMENT /end FUNCTION
/begin FUNCTION Drehzahlerfassung "" /begin DEF_CHARACTERISTIC K_N_MIN_FREEZE K_N_OBERGRENZE K_N_ZEIT_STOERUNG /end DEF_CHARACTERISTIC /begin REF_CHARACTERISTIC /end REF_CHARACTERISTIC /begin IN_MEASUREMENT /end IN_MEASUREMENT
 /begin OUT_MEASUREMENT n_proz n_segm_a n_segm_b n_st_a n_st_b n_t_segm_a n_t_segm_b n_t_segm_start_a n_t_segm_start_b n_timer_stoerung_a n_timer_stoerung_b n_zahn_a n_zahn_b /end OUT_MEASUREMENT
/end FUNCTION
/begin FUNCTION EEPROM "" /begin DEF_CHARACTERISTIC /end DEF_CHARACTERISTIC /begin REF_CHARACTERISTIC /end REF_CHARACTERISTIC /begin IN_MEASUREMENT /end IN_MEASUREMENT
 /begin OUT_MEASUREMENT eeprom_seite_lesen eeprom_seite_lesen_hdw eeprom_seite_schreiben eeprom_st /end OUT_MEASUREMENT
/end FUNCTION
/begin FUNCTION Egas ""
 /begin DEF_CHARACTERISTIC KF_EGAS_N_AQ_KH_NEG KF_EGAS_N_AQ_KH_POS KF_EGAS_N_AQ_ML_NEG KF_EGAS_N_AQ_ML_POS KF_EGAS_SOLL_AQ KF_EGAS_SOLL_AQ_KH KF_EGAS_SOLL_AQ_NOTL KF_EGAS_SOLL_WL_GEW_F KF_EGAS_SOLL_WL_OFFS KL_EGAS_EXD_VORST_DK_AUF KL_EGAS_EXD_VORST_DK_ZU KL_EGAS_EXD_VORST_LLS_AUF KL_EGAS_EXD_VORST_LLS_ZU KL_EGAS_N_AQ_START_NEG KL_EGAS_N_AQ_START_POS KL_EGAS_SK_DK_DIFF_MAX KL_EGAS_SK_WDK_DIFF K_EGAS_AQ_SOLL_GRAD_TAU K_EGAS_CAN_ALIVE_ERR_MAX K_EGAS_CAN_ED_TSPERR K_EGAS_CAN_ED_UB_MIN K_EGAS_CFG_AQ_SOLL K_EGAS_CFG_DK K_EGAS_CFG_LLS K_EGAS_CFG_MCS_SOLL K_EGAS_CFG_WDK K_EGAS_DK_R_DIAG_CLR K_EGAS_DK_R_DIAG_CLR_MAX K_EGAS_DK_R_DIAG_FAIL K_EGAS_EXD_GS_SOLL K_EGAS_EXD_GS_T_MAX K_EGAS_EXD_KS_SOLL K_EGAS_EXD_KS_T_MAX K_EGAS_EXD_R1_SOLL K_EGAS_EXD_R1_SOLL_TV K_EGAS_EXD_R1_TIME K_EGAS_EXD_R2_SOLL K_EGAS_EXD_R2_TIME K_EGAS_EXD_R3_TIME K_EGAS_EXD_SW_SOLL K_EGAS_EXD_UB_MAX K_EGAS_EXD_UB_MIN K_EGAS_FT_ERR_SCHW K_EGAS_LLS_R_DIAG_CLR K_EGAS_LLS_R_DIAG_CLR_MAX K_EGAS_LLS_R_DIAG_FAIL K_EGAS_SK_CONTROL K_EGAS_SK_DK_OFFEN_1 K_EGAS_SK_DK_OFFEN_2 K_EGAS_SK_FAIL_MAX K_EGAS_SK_IST_DIFF_LLS K_EGAS_SK_NEUINIT_MAX K_EGAS_SK_RF_IO_DK K_EGAS_SK_RF_IO_FAK K_EGAS_SK_RF_IO_OFF K_EGAS_SK_RF_IO_WDK K_EGAS_SK_RF_TSTART K_EGAS_SK_SOLL_DIFF K_EGAS_SK_SOLL_DIFF_LLS K_EGAS_SK_TAU_DK K_EGAS_SK_TAU_LLS K_EGAS_SK_T_IST K_EGAS_SK_T_IST_LLS K_EGAS_SK_T_MODE K_EGAS_SK_T_MODE_INIT K_EGAS_SK_T_NP_MAX K_EGAS_SK_T_OFFEN K_EGAS_SK_T_RGPOS K_EGAS_SK_T_SOLL K_EGAS_SK_T_SOLL_LLS K_EGAS_SK_T_WDK K_EGAS_SOLL_AQ_KH_N_MAX K_EGAS_SOLL_AQ_TI_OFF K_EGAS_SOLL_BOWDEN_LLS_F K_EGAS_SOLL_BOWDEN_MIN K_EGAS_SOLL_ENTDR_SCHW K_EGAS_SOLL_GT_OFF K_EGAS_SOLL_LLS_DELTA K_EGAS_SOLL_LLS_DK_SCHW K_EGAS_SOLL_LLS_OFF K_EGAS_SOLL_MCS_DK K_EGAS_SOLL_MCS_LLS K_EGAS_SOLL_VL_FAK K_EGAS_STM_DK_FT_TMOT K_EGAS_STM_DK_GT_MAX K_EGAS_STM_DK_GT_MIN K_EGAS_STM_DK_GT_TIME K_EGAS_STM_DK_GT_TMOT K_EGAS_STM_DK_GT_UB K_EGAS_STM_DK_MODE_HW K_EGAS_STM_DK_NP_NMAX K_EGAS_STM_DK_NP_PMAX K_EGAS_STM_DK_NP_PMIN K_EGAS_STM_DK_NP_TMOT K_EGAS_STM_DK_NP_TMOT_MIN K_EGAS_STM_DK_NP_UB K_EGAS_STM_DK_N_FAST K_EGAS_STM_DK_N_KL50 K_EGAS_STM_DK_SK_TST K_EGAS_STM_DK_SK_ZU K_EGAS_STM_DK_WAIT_DIS K_EGAS_STM_LLS_DK_SCHW K_EGAS_STM_LLS_T_ADAPT K_EGAS_STM_NOINIT_FAIL K_EGAS_STM_NOINIT_SK K_EGAS_STM_T_ADAPT K_EGAS_T_KL50 K_EGAS_WDK_A0_ANZAHL K_EGAS_WDK_A0_DELTA_MAX K_EGAS_WDK_A0_DFT K_EGAS_WDK_A0_KONST K_EGAS_WDK_A0_MAX K_EGAS_WDK_A0_MIN K_EGAS_WDK_A0_OFF_B1 K_EGAS_WDK_A0_OFF_B2 K_EGAS_WDK_A0_TIME K_EGAS_WDK_MAX K_EGAS_WDK_MIN K_EGAS_WDK_NORM /end DEF_CHARACTERISTIC
 /begin REF_CHARACTERISTIC /end REF_CHARACTERISTIC
 /begin IN_MEASUREMENT /end IN_MEASUREMENT
 /begin OUT_MEASUREMENT egas_aq_rf_wl_f egas_aq_soll_dk_b1 egas_aq_soll_dk_b2 egas_aq_soll_fil_b1 egas_aq_soll_fil_b2 egas_aq_soll_lls_b1 egas_aq_soll_lls_b2 egas_can_ed_tsperr_dk egas_can_ed_tsperr_lls egas_dk.flags_en_b1 egas_dk.flags_en_b2 egas_dk.flags_ftime_b1 egas_dk.flags_ftime_b2 egas_dk.flags_kh_b1 egas_dk.flags_kh_b2 egas_dk.flags_nachadapt_b1 egas_dk.flags_nachadapt_b2 egas_dk.flags_tst_b1 egas_dk.flags_tst_b2 egas_dk_b1.alive_err egas_dk_b1.can_st egas_dk_b1.fail_cnt egas_dk_b1.fail_st egas_dk_b1.flags egas_dk_b1.mode egas_dk_b1.mode_can egas_dk_b1.r_adapt_st egas_dk_b1.r_alive egas_dk_b1.r_diag_clr egas_dk_b1.r_diag_st egas_dk_b1.r_enable egas_dk_b1.r_gpos egas_dk_b1.r_mode egas_dk_b1.r_sollw egas_dk_b1.r_tv egas_dk_b1.state egas_dk_b1.state_time egas_dk_b2.alive_err egas_dk_b2.can_st egas_dk_b2.fail_cnt egas_dk_b2.fail_st egas_dk_b2.flags egas_dk_b2.mode egas_dk_b2.mode_can egas_dk_b2.r_adapt_st egas_dk_b2.r_alive egas_dk_b2.r_diag_clr egas_dk_b2.r_diag_st egas_dk_b2.r_enable egas_dk_b2.r_gpos egas_dk_b2.r_mode egas_dk_b2.r_sollw egas_dk_b2.r_tv egas_dk_b2.state egas_dk_b2.state_time egas_dk_fil_fail egas_dk_neuinit_cnt egas_dk_startup egas_exd_dk_soll egas_exd_dk_state egas_exd_gs_time_dn_b1 egas_exd_gs_time_dn_b2 egas_exd_gs_time_up_b1 egas_exd_gs_time_up_b2 egas_exd_ks_time_dn_b1 egas_exd_ks_time_dn_b2 egas_exd_ks_time_up_b1 egas_exd_ks_time_up_b2 egas_exd_lls_soll egas_exd_lls_state egas_exd_r1_ra_max_b1 egas_exd_r1_ra_max_b2 egas_exd_r1_ra_sum_b1 egas_exd_r1_ra_sum_b2 egas_exd_r1_tv_mw_b1 egas_exd_r1_tv_mw_b2 egas_exd_r1_tv_sum_b1 egas_exd_r1_tv_sum_b2 egas_exd_r2_ra_max_b1 egas_exd_r2_ra_max_b2 egas_exd_r2_ra_sum_b1 egas_exd_r2_ra_sum_b2 egas_exd_r2_tv_mw_b1 egas_exd_r2_tv_mw_b2 egas_exd_r2_tv_sum_b1 egas_exd_r2_tv_sum_b2 egas_exd_r3_ra_max_b1 egas_exd_r3_ra_max_b2 egas_exd_r3_ra_sum_b1 egas_exd_r3_ra_sum_b2 egas_exd_r3_tv_mw_b1 egas_exd_r3_tv_mw_b2 egas_exd_r3_tv_sum_b1 egas_exd_r3_tv_sum_b2 egas_exd_soll_1of4_ egas_exd_soll_2of4_ egas_exd_soll_3of4_ egas_exd_soll_4of4_ egas_exd_timeout_1of4_ egas_exd_timeout_2of4_ egas_exd_timeout_3of4_ egas_exd_timeout_4of4_ egas_exd_timeout_en egas_exd_timer egas_lls.flags_adpt_b1 egas_lls.flags_adpt_b2 egas_lls_b1.alive_err egas_lls_b1.can_st egas_lls_b1.fail_cnt egas_lls_b1.fail_st egas_lls_b1.flags egas_lls_b1.mode egas_lls_b1.mode_can egas_lls_b1.r_adapt_st egas_lls_b1.r_alive egas_lls_b1.r_diag_clr egas_lls_b1.r_diag_st egas_lls_b1.r_gpos egas_lls_b1.r_mode egas_lls_b1.r_sollw egas_lls_b1.r_tv egas_lls_b1.state egas_lls_b1.state_time egas_lls_b2.alive_err egas_lls_b2.can_st egas_lls_b2.fail_cnt egas_lls_b2.fail_st egas_lls_b2.flags egas_lls_b2.mode egas_lls_b2.mode_can egas_lls_b2.r_adapt_st egas_lls_b2.r_alive egas_lls_b2.r_diag_clr egas_lls_b2.r_diag_st egas_lls_b2.r_gpos egas_lls_b2.r_mode egas_lls_b2.r_sollw egas_lls_b2.r_tv egas_lls_b2.state egas_lls_b2.state_time egas_lls_neuinit_cnt egas_lls_startup egas_n_aq egas_rec_dk_b1.cs_err egas_rec_dk_b1.ed egas_rec_dk_b1.r_bank egas_rec_dk_b1.r_cmd egas_rec_dk_b1.r_diag_st egas_rec_dk_b1.r_hw_vers egas_rec_dk_b1.r_ko_vers egas_rec_dk_b1.r_set_vers egas_rec_dk_b1.r_sw_vers egas_rec_dk_b1.rec_ack egas_rec_dk_b1.rec_err egas_rec_dk_b1.status egas_rec_dk_b2.cs_err egas_rec_dk_b2.ed egas_rec_dk_b2.r_bank egas_rec_dk_b2.r_cmd egas_rec_dk_b2.r_diag_st egas_rec_dk_b2.r_hw_vers egas_rec_dk_b2.r_ko_vers egas_rec_dk_b2.r_set_vers egas_rec_dk_b2.r_sw_vers egas_rec_dk_b2.rec_ack egas_rec_dk_b2.rec_err egas_rec_dk_b2.status egas_rec_dk_bX.cs_err egas_rec_dk_bX.ed egas_rec_dk_bX.r_bank egas_rec_dk_bX.r_cmd egas_rec_dk_bX.r_diag_st egas_rec_dk_bX.r_hw_vers egas_rec_dk_bX.r_ko_vers egas_rec_dk_bX.r_set_vers egas_rec_dk_bX.r_sw_vers egas_rec_dk_bX.rec_ack egas_rec_dk_bX.rec_err egas_rec_dk_bX.status egas_rec_lls_b1.cs_err egas_rec_lls_b1.ed egas_rec_lls_b1.r_bank egas_rec_lls_b1.r_cmd egas_rec_lls_b1.r_diag_st egas_rec_lls_b1.r_hw_vers egas_rec_lls_b1.r_ko_vers egas_rec_lls_b1.r_set_vers egas_rec_lls_b1.r_sw_vers egas_rec_lls_b1.rec_ack egas_rec_lls_b1.rec_err egas_rec_lls_b1.status egas_rec_lls_b2.cs_err egas_rec_lls_b2.ed egas_rec_lls_b2.r_bank egas_rec_lls_b2.r_cmd egas_rec_lls_b2.r_diag_st egas_rec_lls_b2.r_hw_vers egas_rec_lls_b2.r_ko_vers egas_rec_lls_b2.r_set_vers egas_rec_lls_b2.r_sw_vers egas_rec_lls_b2.rec_ack egas_rec_lls_b2.rec_err egas_rec_lls_b2.status egas_rec_lls_bX.cs_err egas_rec_lls_bX.ed egas_rec_lls_bX.r_bank egas_rec_lls_bX.r_cmd egas_rec_lls_bX.r_diag_st egas_rec_lls_bX.r_hw_vers egas_rec_lls_bX.r_ko_vers egas_rec_lls_bX.r_set_vers egas_rec_lls_bX.r_sw_vers egas_rec_lls_bX.rec_ack egas_rec_lls_bX.rec_err egas_rec_lls_bX.status egas_sk.fzust_dk_b1 egas_sk.fzust_dk_b2 egas_sk_b1.dk_diff_max egas_sk_b1.dk_off_rampe egas_sk_b1.rf_io egas_sk_b1.rf_io_delta egas_sk_b1.rf_io_ring egas_sk_b1.soll_dk egas_sk_b1.soll_lls egas_sk_b1.t_dk_offen_1 egas_sk_b1.t_dk_offen_2 egas_sk_b1.t_ist_dk egas_sk_b1.t_ist_lls egas_sk_b1.t_mode_dk egas_sk_b1.t_mode_lls egas_sk_b1.t_rgpos_dk egas_sk_b1.t_rgpos_lls egas_sk_b1.t_soll_dk egas_sk_b1.t_soll_lls egas_sk_b1.t_wdk egas_sk_b1.wdk_diff_max egas_sk_b1.zust_dk egas_sk_b1.zust_lls egas_sk_b2.dk_diff_max egas_sk_b2.dk_off_rampe egas_sk_b2.rf_io egas_sk_b2.rf_io_delta egas_sk_b2.rf_io_ring egas_sk_b2.soll_dk egas_sk_b2.soll_lls egas_sk_b2.t_dk_offen_1 egas_sk_b2.t_dk_offen_2 egas_sk_b2.t_ist_dk egas_sk_b2.t_ist_lls egas_sk_b2.t_mode_dk egas_sk_b2.t_mode_lls egas_sk_b2.t_rgpos_dk egas_sk_b2.t_rgpos_lls egas_sk_b2.t_soll_dk egas_sk_b2.t_soll_lls egas_sk_b2.t_wdk egas_sk_b2.wdk_diff_max egas_sk_b2.zust_dk egas_sk_b2.zust_lls egas_snd_dk.cmd_b1 egas_snd_dk.cmd_b1_fifo_1of5_ egas_snd_dk.cmd_b1_fifo_2of5_ egas_snd_dk.cmd_b1_fifo_3of5_ egas_snd_dk.cmd_b1_fifo_4of5_ egas_snd_dk.cmd_b1_fifo_5of5_ egas_snd_dk.cmd_b2 egas_snd_dk.cmd_b2_fifo_1of5_ egas_snd_dk.cmd_b2_fifo_2of5_ egas_snd_dk.cmd_b2_fifo_3of5_ egas_snd_dk.cmd_b2_fifo_4of5_ egas_snd_dk.cmd_b2_fifo_5of5_ egas_snd_dk.time egas_snd_dk.v_bank egas_snd_dk.v_clr_diag_b1 egas_snd_dk.v_clr_diag_b2 egas_snd_dk.v_ko_vers egas_snd_lls.cmd_b1 egas_snd_lls.cmd_b1_fifo_1of5_ egas_snd_lls.cmd_b1_fifo_2of5_ egas_snd_lls.cmd_b1_fifo_3of5_ egas_snd_lls.cmd_b1_fifo_4of5_ egas_snd_lls.cmd_b1_fifo_5of5_ egas_snd_lls.cmd_b2 egas_snd_lls.cmd_b2_fifo_1of5_ egas_snd_lls.cmd_b2_fifo_2of5_ egas_snd_lls.cmd_b2_fifo_3of5_ egas_snd_lls.cmd_b2_fifo_4of5_ egas_snd_lls.cmd_b2_fifo_5of5_ egas_snd_lls.time egas_snd_lls.v_bank egas_snd_lls.v_clr_diag_b1 egas_snd_lls.v_clr_diag_b2 egas_snd_lls.v_ko_vers egas_st_empf egas_st_empf_hys egas_stm_lls_time_oa egas_t_kl50 egas_wdk_b1.a0_cnt egas_wdk_b1.a0_max egas_wdk_b1.a0_min egas_wdk_b1.a0_sum egas_wdk_b1.a0_time egas_wdk_b1.a0_vgl egas_wdk_b1.abs egas_wdk_b1.abs_roh egas_wdk_b2.a0_cnt egas_wdk_b2.a0_max egas_wdk_b2.a0_min egas_wdk_b2.a0_sum egas_wdk_b2.a0_time egas_wdk_b2.a0_vgl egas_wdk_b2.abs egas_wdk_b2.abs_roh /end OUT_MEASUREMENT
/end FUNCTION
/begin FUNCTION Egas-Ebene_2 "" /begin DEF_CHARACTERISTIC /end DEF_CHARACTERISTIC /begin REF_CHARACTERISTIC /end REF_CHARACTERISTIC /begin IN_MEASUREMENT /end IN_MEASUREMENT /begin OUT_MEASUREMENT /end OUT_MEASUREMENT /end FUNCTION
/begin FUNCTION Eigendiagnose "" /begin REF_CHARACTERISTIC /end REF_CHARACTERISTIC /begin IN_MEASUREMENT /end IN_MEASUREMENT /begin OUT_MEASUREMENT ed_debug_laufzeit /end OUT_MEASUREMENT /end FUNCTION
/begin RECORD_LAYOUT TKW_VV_VV_UB FNC_VALUES 1 UBYTE COLUMN_DIR DIRECT /end RECORD_LAYOUT
/begin RECORD_LAYOUT TKW_VV_VV_SB FNC_VALUES 1 SBYTE COLUMN_DIR DIRECT /end RECORD_LAYOUT
/begin RECORD_LAYOUT TKW_VV_VV_UW FNC_VALUES 1 UWORD COLUMN_DIR DIRECT /end RECORD_LAYOUT
/begin RECORD_LAYOUT TKW_VV_VV_SW FNC_VALUES 1 SWORD COLUMN_DIR DIRECT /end RECORD_LAYOUT
/begin RECORD_LAYOUT TKW_VV_VV_UL FNC_VALUES 1 ULONG COLUMN_DIR DIRECT /end RECORD_LAYOUT
/begin RECORD_LAYOUT TKL_SW_VV_UB NO_AXIS_PTS_X 1 UBYTE RESERVED 2 BYTE AXIS_PTS_X 3 SWORD INDEX_INCR DIRECT FNC_VALUES 4 UBYTE COLUMN_DIR DIRECT /end RECORD_LAYOUT
/begin RECORD_LAYOUT TKL_SW_VV_SW NO_AXIS_PTS_X 1 UBYTE RESERVED 2 BYTE AXIS_PTS_X 3 SWORD INDEX_INCR DIRECT FNC_VALUES 4 SWORD COLUMN_DIR DIRECT /end RECORD_LAYOUT
/begin RECORD_LAYOUT TKF_SW_SW_UB NO_AXIS_PTS_X 1 UBYTE NO_AXIS_PTS_Y 2 UBYTE AXIS_PTS_X 3 SWORD INDEX_INCR DIRECT AXIS_PTS_Y 4 SWORD INDEX_INCR DIRECT FNC_VALUES 5 UBYTE COLUMN_DIR DIRECT /end RECORD_LAYOUT
/begin RECORD_LAYOUT TKF_SW_SW_UW NO_AXIS_PTS_X 1 UBYTE NO_AXIS_PTS_Y 2 UBYTE AXIS_PTS_X 3 SWORD INDEX_INCR DIRECT AXIS_PTS_Y 4 SWORD INDEX_INCR DIRECT FNC_VALUES 5 UWORD COLUMN_DIR DIRECT /end RECORD_LAYOUT
/begin RECORD_LAYOUT TKF_SW_SW_SW NO_AXIS_PTS_X 1 UBYTE NO_AXIS_PTS_Y 2 UBYTE AXIS_PTS_X 3 SWORD INDEX_INCR DIRECT AXIS_PTS_Y 4 SWORD INDEX_INCR DIRECT FNC_VALUES 5 SWORD COLUMN_DIR DIRECT /end RECORD_LAYOUT
/end MODULE
/end PROJECT
