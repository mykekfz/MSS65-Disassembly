/begin PROJECT MSS65-ign-V452 "MSS65 IGN - V452.01-B204.00, data set 0569Q60Z160E"
/begin HEADER "" VERSION "V452.01-B204.00" /end HEADER
/begin MODULE _MSS65-ign "MSS65 IGN - V452.01-B204.00, calibration xxxxxxxx"
/begin MOD_COMMON "" BYTE_ORDER MSB_FIRST /* Default byteorder (Motorola) */ /end MOD_COMMON
/begin COMPU_METHOD FORMULA_0003 "FORMULA_0003" RAT_FUNC "%3.0" "-" COEFFS 0 1 0 0 0 1 /end COMPU_METHOD
/begin COMPU_METHOD FORMULA_0010 "FORMULA_0010" RAT_FUNC "%5.0" "-" COEFFS 0 1 0 0 0 1 /end COMPU_METHOD
/* ------------------ Abschnitt erzeugt aus adapt_glob.dat ------------------ */
/begin COMPU_METHOD FORMULA_0023 "FORMULA_0023" RAT_FUNC "%6.1" "�C" COEFFS 0 10 2732 0 0 1 /end COMPU_METHOD
/begin COMPU_METHOD FORMULA_0073 "FORMULA_0073" RAT_FUNC "%6.1" "s" COEFFS 0 10 0 0 0 1 /end COMPU_METHOD
/begin COMPU_METHOD FORMULA_0075 "FORMULA_0075" RAT_FUNC "%8.3" "-" COEFFS 0 1024 0 0 0 1 /end COMPU_METHOD
/begin COMPU_METHOD FORMULA_0076 "FORMULA_0076" RAT_FUNC "%6.1" "Kelvin" COEFFS 0 10 0 0 0 1 /end COMPU_METHOD
/begin COMPU_METHOD FORMULA_0077 "FORMULA_0077" RAT_FUNC "%6.1" "mbar" COEFFS 0 16 0 0 0 1 /end COMPU_METHOD
/begin COMPU_METHOD FORMULA_0078 "FORMULA_0078" RAT_FUNC "%6.1" "km/h" COEFFS 0 16 0 0 0 1 /end COMPU_METHOD
/begin COMPU_METHOD FORMULA_0079 "FORMULA_0079" RAT_FUNC "%6.1" "l" COEFFS 0 2 0 0 0 1 /end COMPU_METHOD
/* ------------------ Abschnitt erzeugt aus ed_glob.dat ------------------ */
/begin CHARACTERISTIC K_ED_SCDN_ABDECKUNG_EINTRAG "Similar Abdeckung fuer Fehlerspeichereintrag  | EN: Similar-conditions coverage for fault-memory entry" VALUE 0x7195E TKW_VV_VV_UW 100.0 FORMULA_0075 0.0 4.0000 FORMAT "%6.3" /end CHARACTERISTIC
/begin CHARACTERISTIC K_ED_SCDN_ABDECKUNG_AUSTRAG "Similar Abdeckung fuer Fehlerspeicheraustrag  | EN: Similar-conditions coverage for fault-memory clearing" VALUE 0x71960 TKW_VV_VV_UW 100.0 FORMULA_0075 0.0 4.0000 FORMAT "%6.3" /end CHARACTERISTIC
/begin CHARACTERISTIC K_ED_RBM_PUMG_MIN "Mindestluftdruck fuer Rate-Based | EN: Minimum air pressure for rate-based OBD monitoring" VALUE 0x71966 TKW_VV_VV_SW 100.0 FORMULA_0077 400.0000 1200.0000 FORMAT "%4.1" /end CHARACTERISTIC
/begin CHARACTERISTIC K_ED_RBM_TUMG_MIN "Mindesttemperatur | EN: Minimum ambient temperature (rate-based monitoring)" VALUE 0x71968 TKW_VV_VV_SW 100.0 FORMULA_0023 -50.0000 170.0000 FORMAT "%4.1" /end CHARACTERISTIC
/begin CHARACTERISTIC K_ED_RBM_TIME "Gesamtzeit fuer Fahrzyklus | EN: Total time for drive cycle (rate-based monitoring)" VALUE 0x7196A TKW_VV_VV_UW 100.0 FORMULA_0073 0.0 6553.5000 FORMAT "%4.1" /end CHARACTERISTIC
/begin CHARACTERISTIC K_ED_RBM_TIME_V "Geschwindigkeitszeit Fahrzyklus | EN: Time at speed in drive cycle (rate-based monitoring)" VALUE 0x7196C TKW_VV_VV_UW 100.0 FORMULA_0073 0.0 6553.5000 FORMAT "%4.1" /end CHARACTERISTIC
/begin CHARACTERISTIC K_ED_RBM_TIME_LL "Mindestleerlauf Fahrzyklus | EN: Minimum idle time in drive cycle (rate-based monitoring)" VALUE 0x7196E TKW_VV_VV_UW 100.0 FORMULA_0073 0.0 6553.5000 FORMAT "%4.1" /end CHARACTERISTIC
/begin CHARACTERISTIC K_ED_RBM_V_MIN "Mindestgeschwindigkeit Fahrzyklus | EN: Minimum vehicle speed in drive cycle (rate-based monitoring)" VALUE 0x71970 TKW_VV_VV_SW 100.0 FORMULA_0078 -80.0000 360.0000 FORMAT "%4.1" /end CHARACTERISTIC
/begin CHARACTERISTIC K_ED_RBM_EVAP_MIN "Mindesttemperatur EVAP | EN: Mindesttemperatur EVAP" VALUE 0x71972 TKW_VV_VV_SW 100.0 FORMULA_0023 -50.0000 170.0000 FORMAT "%4.1" /end CHARACTERISTIC
/begin CHARACTERISTIC K_ED_RBM_EVAP_MAX "Maximaltemperatur EVAP | EN: Maximaltemperatur EVAP" VALUE 0x71974 TKW_VV_VV_SW 100.0 FORMULA_0023 -50.0000 170.0000 FORMAT "%4.1" /end CHARACTERISTIC
/begin CHARACTERISTIC K_ED_RBM_EVAP_TEMP_DELTA "Max. Differenz zwischen tmot und tumg fuer EVAP | EN: Max. Differenz zwischen tmot und tumg fuer EVAP" VALUE 0x71976 TKW_VV_VV_SW 100.0 FORMULA_0076 -1000.0000 1000.0000 FORMAT "%4.1" /end CHARACTERISTIC
/begin CHARACTERISTIC K_ED_FST_MAX "Maximaler Tankfuellstand" VALUE 0x71978 TKW_VV_VV_UW 100.0 FORMULA_0079 0.0 32767.5000 FORMAT "%4.1" /end CHARACTERISTIC
/* ------------------ Abschnitt erzeugt aus ed.dat ------------------ */
/begin CHARACTERISTIC K_ED_SK_TR_IGN.P_CODE_SH_TO_UB "P-Code fuer die Art SH_TO_UB | EN: P-Code fuer die Art SH_TO_UB" VALUE 0x70C60 TKW_VV_VV_UW 100.0 FORMULA_0010 0.0 65535.0000 /end CHARACTERISTIC
/begin CHARACTERISTIC K_ED_PWG1.P_CODE_SH_TO_UB "P-Code fuer die Art SH_TO_UB | EN: Fault code PWG1 - OBD P-code reported for short to battery voltage" VALUE 0x70DB2 TKW_VV_VV_UW 100.0 FORMULA_0010 0.0 65535.0000 /end CHARACTERISTIC
/begin CHARACTERISTIC K_ED_PWG2.P_CODE_SH_TO_UB "P-Code fuer die Art SH_TO_UB | EN: Fault code PWG2 - OBD P-code reported for short to battery voltage" VALUE 0x70DCC TKW_VV_VV_UW 100.0 FORMULA_0010 0.0 65535.0000 /end CHARACTERISTIC
/begin CHARACTERISTIC K_ED_PWG_VGL.P_CODE_SH_TO_UB "P-Code fuer die Art SH_TO_UB | EN: Fault code PWG_VGL - OBD P-code reported for short to battery voltage" VALUE 0x70DE6 TKW_VV_VV_UW 100.0 FORMULA_0010 0.0 65535.0000 /end CHARACTERISTIC
/begin CHARACTERISTIC K_ED_PCTRL_IGN.P_CODE_SH_TO_UB "P-Code fuer die Art SH_TO_UB | EN: Fault code PCTRL_IGN - OBD P-code reported for short to battery voltage" VALUE 0x70E00 TKW_VV_VV_UW 100.0 FORMULA_0010 0.0 65535.0000 /end CHARACTERISTIC
/begin CHARACTERISTIC K_ED_LLS1_CAN.P_CODE_SH_TO_UB "P-Code fuer die Art SH_TO_UB | EN: Fault code LLS1_CAN - OBD P-code reported for short to battery voltage" VALUE 0x70E1A TKW_VV_VV_UW 100.0 FORMULA_0010 0.0 65535.0000 /end CHARACTERISTIC
/begin CHARACTERISTIC K_ED_LLS2_CAN.P_CODE_SH_TO_UB "P-Code fuer die Art SH_TO_UB | EN: Fault code LLS2_CAN - OBD P-code reported for short to battery voltage" VALUE 0x70E34 TKW_VV_VV_UW 100.0 FORMULA_0010 0.0 65535.0000 /end CHARACTERISTIC
/begin CHARACTERISTIC K_ED_LLS1_SK.P_CODE_SH_TO_UB "P-Code fuer die Art SH_TO_UB | EN: Fault code LLS1_SK - OBD P-code reported for short to battery voltage" VALUE 0x70E82 TKW_VV_VV_UW 100.0 FORMULA_0010 0.0 65535.0000 /end CHARACTERISTIC
/begin CHARACTERISTIC K_ED_LLS2_SK.P_CODE_SH_TO_UB "P-Code fuer die Art SH_TO_UB | EN: Fault code LLS2_SK - OBD P-code reported for short to battery voltage" VALUE 0x70E9C TKW_VV_VV_UW 100.0 FORMULA_0010 0.0 65535.0000 /end CHARACTERISTIC
/begin CHARACTERISTIC K_ED_SMG_SCHALTAB.P_CODE_SH_TO_UB "P-Code fuer die Art SH_TO_UB | EN: Fault code SMG_SCHALTAB - OBD P-code reported for short to battery voltage" VALUE 0x70EB6 TKW_VV_VV_UW 100.0 FORMULA_0010 0.0 65535.0000 /end CHARACTERISTIC
/begin CHARACTERISTIC K_ED_DK_INIT.P_CODE_SH_TO_UB "P-Code fuer die Art SH_TO_UB | EN: Fault code DK_INIT - OBD P-code reported for short to battery voltage" VALUE 0x70F38 TKW_VV_VV_UW 100.0 FORMULA_0010 0.0 65535.0000 /end CHARACTERISTIC
/begin CHARACTERISTIC K_ED_DK2_REGLER.P_CODE_SH_TO_UB "P-Code fuer die Art SH_TO_UB | EN: Fault code DK2_REGLER - OBD P-code reported for short to battery voltage" VALUE 0x70F6C TKW_VV_VV_UW 100.0 FORMULA_0010 0.0 65535.0000 /end CHARACTERISTIC
/begin CHARACTERISTIC K_ED_IONVERST_B1.P_CODE_SH_TO_UB "P-Code fuer die Art SH_TO_UB" VALUE 0x70FBA TKW_VV_VV_UW 100.0 FORMULA_0010 0.0 65535.0000 /end CHARACTERISTIC
/begin CHARACTERISTIC K_ED_IONSPG_B1.P_CODE_SH_TO_UB "P-Code fuer die Art SH_TO_UB" VALUE 0x70FD4 TKW_VV_VV_UW 100.0 FORMULA_0010 0.0 65535.0000 /end CHARACTERISTIC
/begin CHARACTERISTIC K_ED_IONVERST_B2.P_CODE_SH_TO_UB "P-Code fuer die Art SH_TO_UB" VALUE 0x70FEE TKW_VV_VV_UW 100.0 FORMULA_0010 0.0 65535.0000 /end CHARACTERISTIC
/begin CHARACTERISTIC K_ED_IONSPG_B2.P_CODE_SH_TO_UB "P-Code fuer die Art SH_TO_UB" VALUE 0x71008 TKW_VV_VV_UW 100.0 FORMULA_0010 0.0 65535.0000 /end CHARACTERISTIC
/begin CHARACTERISTIC K_ED_DK2_WDK.P_CODE_SH_TO_UB "P-Code fuer die Art SH_TO_UB | EN: Fault code DK2_WDK - OBD P-code reported for short to battery voltage" VALUE 0x71070 TKW_VV_VV_UW 100.0 FORMULA_0010 0.0 65535.0000 /end CHARACTERISTIC
/begin CHARACTERISTIC K_ED_LLS1_REGLER.P_CODE_SH_TO_UB "P-Code fuer die Art SH_TO_UB | EN: Fault code LLS1_REGLER - OBD P-code reported for short to battery voltage" VALUE 0x710BE TKW_VV_VV_UW 100.0 FORMULA_0010 0.0 65535.0000 /end CHARACTERISTIC
/begin CHARACTERISTIC K_ED_LLS2_REGLER.P_CODE_SH_TO_UB "P-Code fuer die Art SH_TO_UB | EN: Fault code LLS2_REGLER - OBD P-code reported for short to battery voltage" VALUE 0x710D8 TKW_VV_VV_UW 100.0 FORMULA_0010 0.0 65535.0000 /end CHARACTERISTIC
/begin CHARACTERISTIC K_ED_DK2_SK_ERR.P_CODE_SH_TO_UB "P-Code fuer die Art SH_TO_UB | EN: Fault code DK2_SK_ERR - OBD P-code reported for short to battery voltage" VALUE 0x7110C TKW_VV_VV_UW 100.0 FORMULA_0010 0.0 65535.0000 /end CHARACTERISTIC
/begin CHARACTERISTIC K_ED_MD_SK_ERR.P_CODE_SH_TO_UB "P-Code fuer die Art SH_TO_UB | EN: Fault code MD_SK_ERR - OBD P-code reported for short to battery voltage" VALUE 0x7115A TKW_VV_VV_UW 100.0 FORMULA_0010 0.0 65535.0000 /end CHARACTERISTIC
/begin CHARACTERISTIC K_ED_LLS_INIT.P_CODE_SH_TO_UB "P-Code fuer die Art SH_TO_UB | EN: Fault code LLS_INIT - OBD P-code reported for short to battery voltage" VALUE 0x71174 TKW_VV_VV_UW 100.0 FORMULA_0010 0.0 65535.0000 /end CHARACTERISTIC
/begin CHARACTERISTIC K_ED_DSC_EINGR.P_CODE_SH_TO_UB "P-Code fuer die Art SH_TO_UB | EN: Fault code DSC_EINGR - OBD P-code reported for short to battery voltage" VALUE 0x7118E TKW_VV_VV_UW 100.0 FORMULA_0010 0.0 65535.0000 /end CHARACTERISTIC
/begin CHARACTERISTIC K_ED_LLS1_CMD.P_CODE_SH_TO_UB "P-Code fuer die Art SH_TO_UB | EN: Fault code LLS1_CMD - OBD P-code reported for short to battery voltage" VALUE 0x711DC TKW_VV_VV_UW 100.0 FORMULA_0010 0.0 65535.0000 /end CHARACTERISTIC
/begin CHARACTERISTIC K_ED_LLS2_CMD.P_CODE_SH_TO_UB "P-Code fuer die Art SH_TO_UB | EN: Fault code LLS2_CMD - OBD P-code reported for short to battery voltage" VALUE 0x711F6 TKW_VV_VV_UW 100.0 FORMULA_0010 0.0 65535.0000 /end CHARACTERISTIC
/begin CHARACTERISTIC K_ED_SC_SMG1.P_CODE_SH_TO_UB "P-Code fuer die Art SH_TO_UB | EN: Fault code SC_SMG1 - OBD P-code reported for short to battery voltage" VALUE 0x71210 TKW_VV_VV_UW 100.0 FORMULA_0010 0.0 65535.0000 /end CHARACTERISTIC
/begin CHARACTERISTIC K_ED_SC_SMG2.P_CODE_SH_TO_UB "P-Code fuer die Art SH_TO_UB | EN: Fault code SC_SMG2 - OBD P-code reported for short to battery voltage" VALUE 0x7122A TKW_VV_VV_UW 100.0 FORMULA_0010 0.0 65535.0000 /end CHARACTERISTIC
/begin CHARACTERISTIC K_ED_SC_SMG3.P_CODE_SH_TO_UB "P-Code fuer die Art SH_TO_UB | EN: Fault code SC_SMG3 - OBD P-code reported for short to battery voltage" VALUE 0x71244 TKW_VV_VV_UW 100.0 FORMULA_0010 0.0 65535.0000 /end CHARACTERISTIC
/begin CHARACTERISTIC K_ED_SC_BUSOFF.P_CODE_SH_TO_UB "P-Code fuer die Art SH_TO_UB | EN: Fault code SC_BUSOFF - OBD P-code reported for short to battery voltage" VALUE 0x7125E TKW_VV_VV_UW 100.0 FORMULA_0010 0.0 65535.0000 /end CHARACTERISTIC
/begin CHARACTERISTIC K_ED_EC_BUSOFF.P_CODE_SH_TO_UB "P-Code fuer die Art SH_TO_UB | EN: Fault code EC_BUSOFF - OBD P-code reported for short to battery voltage" VALUE 0x71278 TKW_VV_VV_UW 100.0 FORMULA_0010 0.0 65535.0000 /end CHARACTERISTIC
/begin CHARACTERISTIC K_ED_ION_SIG_B1.P_CODE_SH_TO_UB "P-Code fuer die Art SH_TO_UB" VALUE 0x71396 TKW_VV_VV_UW 100.0 FORMULA_0010 0.0 65535.0000 /end CHARACTERISTIC
/begin CHARACTERISTIC K_ED_ION_SIG_B2.P_CODE_SH_TO_UB "P-Code fuer die Art SH_TO_UB" VALUE 0x713B0 TKW_VV_VV_UW 100.0 FORMULA_0010 0.0 65535.0000 /end CHARACTERISTIC
/begin CHARACTERISTIC K_ED_ION_SAT_B1.P_CODE_SH_TO_UB "P-Code fuer die Art SH_TO_UB" VALUE 0x714E8 TKW_VV_VV_UW 100.0 FORMULA_0010 0.0 65535.0000 /end CHARACTERISTIC
/begin CHARACTERISTIC K_ED_ION_SAT_B2.P_CODE_SH_TO_UB "P-Code fuer die Art SH_TO_UB" VALUE 0x71502 TKW_VV_VV_UW 100.0 FORMULA_0010 0.0 65535.0000 /end CHARACTERISTIC
/begin CHARACTERISTIC K_ED_INDEX_88_IGN.P_CODE_SH_TO_UB "P-Code fuer die Art SH_TO_UB | EN: P-Code fuer die Art SH_TO_UB" VALUE 0x71550 TKW_VV_VV_UW 100.0 FORMULA_0010 0.0 65535.0000 /end CHARACTERISTIC
/begin CHARACTERISTIC K_ED_INDEX_89_IGN.P_CODE_SH_TO_UB "P-Code fuer die Art SH_TO_UB" VALUE 0x7156A TKW_VV_VV_UW 100.0 FORMULA_0010 0.0 65535.0000 /end CHARACTERISTIC
/begin CHARACTERISTIC K_ED_SG_IGN.P_CODE_SH_TO_UB "P-Code fuer die Art SH_TO_UB | EN: Fault code SG_IGN - OBD P-code reported for short to battery voltage" VALUE 0x715B8 TKW_VV_VV_UW 100.0 FORMULA_0010 0.0 65535.0000 /end CHARACTERISTIC
/begin CHARACTERISTIC K_ED_E2_IGN.P_CODE_SH_TO_UB "P-Code fuer die Art SH_TO_UB | EN: Fault code E2_IGN - OBD P-code reported for short to battery voltage" VALUE 0x715D2 TKW_VV_VV_UW 100.0 FORMULA_0010 0.0 65535.0000 /end CHARACTERISTIC
/begin CHARACTERISTIC K_ED_SK_MANAGER_IGN.P_CODE_SH_TO_UB "P-Code fuer die Art SH_TO_UB | EN: Fault code SK_MANAGER_IGN - OBD P-code reported for short to battery voltage" VALUE 0x71606 TKW_VV_VV_UW 100.0 FORMULA_0010 0.0 65535.0000 /end CHARACTERISTIC
/begin CHARACTERISTIC K_ED_LLR_DIAG.P_CODE_SH_TO_UB "P-Code fuer die Art SH_TO_UB | EN: Fault code LLR_DIAG - OBD P-code reported for short to battery voltage" VALUE 0x71620 TKW_VV_VV_UW 100.0 FORMULA_0010 0.0 65535.0000 /end CHARACTERISTIC
/begin CHARACTERISTIC K_ED_DK2_ZUST.P_CODE_SH_TO_UB "P-Code fuer die Art SH_TO_UB | EN: Fault code DK2_ZUST - OBD P-code reported for short to battery voltage" VALUE 0x71688 TKW_VV_VV_UW 100.0 FORMULA_0010 0.0 65535.0000 /end CHARACTERISTIC
/begin CHARACTERISTIC K_ED_FGR_ABWURF.P_CODE_SH_TO_UB "P-Code fuer die Art SH_TO_UB | EN: Fault code FGR_ABWURF - OBD P-code reported for short to battery voltage" VALUE 0x716A2 TKW_VV_VV_UW 100.0 FORMULA_0010 0.0 65535.0000 /end CHARACTERISTIC
/begin CHARACTERISTIC K_ED_PWG_BLS.P_CODE_SH_TO_UB "P-Code fuer die Art SH_TO_UB | EN: Fault code PWG_BLS - OBD P-code reported for short to battery voltage" VALUE 0x716BC TKW_VV_VV_UW 100.0 FORMULA_0010 0.0 65535.0000 /end CHARACTERISTIC
/begin CHARACTERISTIC K_ED_N_GETR_EIN_HS.P_CODE_SH_TO_UB "P-Code fuer die Art SH_TO_UB | EN: Fault code N_GETR_EIN_HS - OBD P-code reported for short to battery voltage" VALUE 0x7170A TKW_VV_VV_UW 100.0 FORMULA_0010 0.0 65535.0000 /end CHARACTERISTIC
/begin CHARACTERISTIC K_ED_LLR_DIAG_CSS.P_CODE_SH_TO_UB "P-Code fuer die Art SH_TO_UB | EN: Fault code LLR_DIAG_CSS - OBD P-code reported for short to battery voltage" VALUE 0x7173E TKW_VV_VV_UW 100.0 FORMULA_0010 0.0 65535.0000 /end CHARACTERISTIC
/begin CHARACTERISTIC K_ED_INDEX_110_IGN.P_CODE_SH_TO_UB "P-Code fuer die Art SH_TO_UB" VALUE 0x7178C TKW_VV_VV_UW 100.0 FORMULA_0010 0.0 65535.0000 /end CHARACTERISTIC
/begin CHARACTERISTIC K_ED_INDEX_111_IGN.P_CODE_SH_TO_UB "P-Code fuer die Art SH_TO_UB" VALUE 0x717A6 TKW_VV_VV_UW 100.0 FORMULA_0010 0.0 65535.0000 /end CHARACTERISTIC
/begin CHARACTERISTIC K_ED_INDEX_112_IGN.P_CODE_SH_TO_UB "P-Code fuer die Art SH_TO_UB" VALUE 0x717C0 TKW_VV_VV_UW 100.0 FORMULA_0010 0.0 65535.0000 /end CHARACTERISTIC
/begin CHARACTERISTIC K_ED_INDEX_113_IGN.P_CODE_SH_TO_UB "P-Code fuer die Art SH_TO_UB" VALUE 0x717DA TKW_VV_VV_UW 100.0 FORMULA_0010 0.0 65535.0000 /end CHARACTERISTIC
/begin CHARACTERISTIC K_ED_INDEX_114_IGN.P_CODE_SH_TO_UB "P-Code fuer die Art SH_TO_UB" VALUE 0x717F4 TKW_VV_VV_UW 100.0 FORMULA_0010 0.0 65535.0000 /end CHARACTERISTIC
/begin CHARACTERISTIC K_ED_INDEX_115_IGN.P_CODE_SH_TO_UB "P-Code fuer die Art SH_TO_UB" VALUE 0x7180E TKW_VV_VV_UW 100.0 FORMULA_0010 0.0 65535.0000 /end CHARACTERISTIC
/begin CHARACTERISTIC K_ED_INDEX_116_IGN.P_CODE_SH_TO_UB "P-Code fuer die Art SH_TO_UB" VALUE 0x71828 TKW_VV_VV_UW 100.0 FORMULA_0010 0.0 65535.0000 /end CHARACTERISTIC
/begin CHARACTERISTIC K_ED_INDEX_117_IGN.P_CODE_SH_TO_UB "P-Code fuer die Art SH_TO_UB" VALUE 0x71842 TKW_VV_VV_UW 100.0 FORMULA_0010 0.0 65535.0000 /end CHARACTERISTIC
/begin CHARACTERISTIC K_ED_INDEX_118_IGN.P_CODE_SH_TO_UB "P-Code fuer die Art SH_TO_UB" VALUE 0x7185C TKW_VV_VV_UW 100.0 FORMULA_0010 0.0 65535.0000 /end CHARACTERISTIC
/begin CHARACTERISTIC K_ED_INDEX_119_IGN.P_CODE_SH_TO_UB "P-Code fuer die Art SH_TO_UB" VALUE 0x71876 TKW_VV_VV_UW 100.0 FORMULA_0010 0.0 65535.0000 /end CHARACTERISTIC
/begin CHARACTERISTIC K_ED_INDEX_120_IGN.P_CODE_SH_TO_UB "P-Code fuer die Art SH_TO_UB" VALUE 0x71890 TKW_VV_VV_UW 100.0 FORMULA_0010 0.0 65535.0000 /end CHARACTERISTIC
/begin CHARACTERISTIC K_ED_INDEX_121_IGN.P_CODE_SH_TO_UB "P-Code fuer die Art SH_TO_UB | EN: Fault code INDEX_121_IGN - OBD P-code reported for short to battery voltage" VALUE 0x718AA TKW_VV_VV_UW 100.0 FORMULA_0010 0.0 65535.0000 /end CHARACTERISTIC
/begin CHARACTERISTIC K_ED_INDEX_122_IGN.P_CODE_SH_TO_UB "P-Code fuer die Art SH_TO_UB | EN: Fault code INDEX_122_IGN - OBD P-code reported for short to battery voltage" VALUE 0x718C4 TKW_VV_VV_UW 100.0 FORMULA_0010 0.0 65535.0000 /end CHARACTERISTIC
/begin CHARACTERISTIC K_ED_INDEX_123_IGN.P_CODE_SH_TO_UB "P-Code fuer die Art SH_TO_UB | EN: Fault code INDEX_123_IGN - OBD P-code reported for short to battery voltage" VALUE 0x718DE TKW_VV_VV_UW 100.0 FORMULA_0010 0.0 65535.0000 /end CHARACTERISTIC
/begin CHARACTERISTIC K_ED_INDEX_124_IGN.P_CODE_SH_TO_UB "P-Code fuer die Art SH_TO_UB | EN: Fault code INDEX_124_IGN - OBD P-code reported for short to battery voltage" VALUE 0x718F8 TKW_VV_VV_UW 100.0 FORMULA_0010 0.0 65535.0000 /end CHARACTERISTIC
/begin CHARACTERISTIC K_ED_INDEX_125_IGN.P_CODE_SH_TO_UB "P-Code fuer die Art SH_TO_UB | EN: Fault code INDEX_125_IGN - OBD P-code reported for short to battery voltage" VALUE 0x71912 TKW_VV_VV_UW 100.0 FORMULA_0010 0.0 65535.0000 /end CHARACTERISTIC
/begin CHARACTERISTIC K_ED_INDEX_126_IGN.P_CODE_SH_TO_UB "P-Code fuer die Art SH_TO_UB | EN: Fault code INDEX_126_IGN - OBD P-code reported for short to battery voltage" VALUE 0x7192C TKW_VV_VV_UW 100.0 FORMULA_0010 0.0 65535.0000 /end CHARACTERISTIC
/begin CHARACTERISTIC K_ED_INDEX_127_IGN.P_CODE_SH_TO_UB "P-Code fuer die Art SH_TO_UB | EN: Fault code INDEX_127_IGN - OBD P-code reported for short to battery voltage" VALUE 0x71946 TKW_VV_VV_UW 100.0 FORMULA_0010 0.0 65535.0000 /end CHARACTERISTIC
/begin CHARACTERISTIC K_ED_SK_TR_IGN.P_CODE_SH_TO_GND "P-Code fuer die Art SH_TO_GND | EN: P-Code fuer die Art SH_TO_GND" VALUE 0x70C62 TKW_VV_VV_UW 100.0 FORMULA_0010 0.0 65535.0000 /end CHARACTERISTIC
/begin CHARACTERISTIC K_ED_PWG1.P_CODE_SH_TO_GND "P-Code fuer die Art SH_TO_GND | EN: Fault code PWG1 - OBD P-code reported for short to ground" VALUE 0x70DB4 TKW_VV_VV_UW 100.0 FORMULA_0010 0.0 65535.0000 /end CHARACTERISTIC
/begin CHARACTERISTIC K_ED_PWG2.P_CODE_SH_TO_GND "P-Code fuer die Art SH_TO_GND | EN: Fault code PWG2 - OBD P-code reported for short to ground" VALUE 0x70DCE TKW_VV_VV_UW 100.0 FORMULA_0010 0.0 65535.0000 /end CHARACTERISTIC
/begin CHARACTERISTIC K_ED_PWG_VGL.P_CODE_SH_TO_GND "P-Code fuer die Art SH_TO_GND | EN: Fault code PWG_VGL - OBD P-code reported for short to ground" VALUE 0x70DE8 TKW_VV_VV_UW 100.0 FORMULA_0010 0.0 65535.0000 /end CHARACTERISTIC
/begin CHARACTERISTIC K_ED_PCTRL_IGN.P_CODE_SH_TO_GND "P-Code fuer die Art SH_TO_GND | EN: Fault code PCTRL_IGN - OBD P-code reported for short to ground" VALUE 0x70E02 TKW_VV_VV_UW 100.0 FORMULA_0010 0.0 65535.0000 /end CHARACTERISTIC
/begin CHARACTERISTIC K_ED_LLS1_CAN.P_CODE_SH_TO_GND "P-Code fuer die Art SH_TO_GND | EN: Fault code LLS1_CAN - OBD P-code reported for short to ground" VALUE 0x70E1C TKW_VV_VV_UW 100.0 FORMULA_0010 0.0 65535.0000 /end CHARACTERISTIC
/begin CHARACTERISTIC K_ED_LLS2_CAN.P_CODE_SH_TO_GND "P-Code fuer die Art SH_TO_GND | EN: Fault code LLS2_CAN - OBD P-code reported for short to ground" VALUE 0x70E36 TKW_VV_VV_UW 100.0 FORMULA_0010 0.0 65535.0000 /end CHARACTERISTIC
/begin CHARACTERISTIC K_ED_LLS1_SK.P_CODE_SH_TO_GND "P-Code fuer die Art SH_TO_GND | EN: Fault code LLS1_SK - OBD P-code reported for short to ground" VALUE 0x70E84 TKW_VV_VV_UW 100.0 FORMULA_0010 0.0 65535.0000 /end CHARACTERISTIC
/begin CHARACTERISTIC K_ED_LLS2_SK.P_CODE_SH_TO_GND "P-Code fuer die Art SH_TO_GND | EN: Fault code LLS2_SK - OBD P-code reported for short to ground" VALUE 0x70E9E TKW_VV_VV_UW 100.0 FORMULA_0010 0.0 65535.0000 /end CHARACTERISTIC
/begin CHARACTERISTIC K_ED_SMG_SCHALTAB.P_CODE_SH_TO_GND "P-Code fuer die Art SH_TO_GND | EN: Fault code SMG_SCHALTAB - OBD P-code reported for short to ground" VALUE 0x70EB8 TKW_VV_VV_UW 100.0 FORMULA_0010 0.0 65535.0000 /end CHARACTERISTIC
/begin CHARACTERISTIC K_ED_DK_INIT.P_CODE_SH_TO_GND "P-Code fuer die Art SH_TO_GND | EN: Fault code DK_INIT - OBD P-code reported for short to ground" VALUE 0x70F3A TKW_VV_VV_UW 100.0 FORMULA_0010 0.0 65535.0000 /end CHARACTERISTIC
/begin CHARACTERISTIC K_ED_DK2_REGLER.P_CODE_SH_TO_GND "P-Code fuer die Art SH_TO_GND | EN: Fault code DK2_REGLER - OBD P-code reported for short to ground" VALUE 0x70F6E TKW_VV_VV_UW 100.0 FORMULA_0010 0.0 65535.0000 /end CHARACTERISTIC
/begin CHARACTERISTIC K_ED_IONVERST_B1.P_CODE_SH_TO_GND "P-Code fuer die Art SH_TO_GND" VALUE 0x70FBC TKW_VV_VV_UW 100.0 FORMULA_0010 0.0 65535.0000 /end CHARACTERISTIC
/begin CHARACTERISTIC K_ED_IONSPG_B1.P_CODE_SH_TO_GND "P-Code fuer die Art SH_TO_GND" VALUE 0x70FD6 TKW_VV_VV_UW 100.0 FORMULA_0010 0.0 65535.0000 /end CHARACTERISTIC
/begin CHARACTERISTIC K_ED_IONVERST_B2.P_CODE_SH_TO_GND "P-Code fuer die Art SH_TO_GND" VALUE 0x70FF0 TKW_VV_VV_UW 100.0 FORMULA_0010 0.0 65535.0000 /end CHARACTERISTIC
/begin CHARACTERISTIC K_ED_IONSPG_B2.P_CODE_SH_TO_GND "P-Code fuer die Art SH_TO_GND" VALUE 0x7100A TKW_VV_VV_UW 100.0 FORMULA_0010 0.0 65535.0000 /end CHARACTERISTIC
/begin CHARACTERISTIC K_ED_DK2_WDK.P_CODE_SH_TO_GND "P-Code fuer die Art SH_TO_GND | EN: Fault code DK2_WDK - OBD P-code reported for short to ground" VALUE 0x71072 TKW_VV_VV_UW 100.0 FORMULA_0010 0.0 65535.0000 /end CHARACTERISTIC
/begin CHARACTERISTIC K_ED_LLS1_REGLER.P_CODE_SH_TO_GND "P-Code fuer die Art SH_TO_GND | EN: Fault code LLS1_REGLER - OBD P-code reported for short to ground" VALUE 0x710C0 TKW_VV_VV_UW 100.0 FORMULA_0010 0.0 65535.0000 /end CHARACTERISTIC
/begin CHARACTERISTIC K_ED_LLS2_REGLER.P_CODE_SH_TO_GND "P-Code fuer die Art SH_TO_GND | EN: Fault code LLS2_REGLER - OBD P-code reported for short to ground" VALUE 0x710DA TKW_VV_VV_UW 100.0 FORMULA_0010 0.0 65535.0000 /end CHARACTERISTIC
/begin CHARACTERISTIC K_ED_DK2_SK_ERR.P_CODE_SH_TO_GND "P-Code fuer die Art SH_TO_GND | EN: Fault code DK2_SK_ERR - OBD P-code reported for short to ground" VALUE 0x7110E TKW_VV_VV_UW 100.0 FORMULA_0010 0.0 65535.0000 /end CHARACTERISTIC
/begin CHARACTERISTIC K_ED_MD_SK_ERR.P_CODE_SH_TO_GND "P-Code fuer die Art SH_TO_GND | EN: Fault code MD_SK_ERR - OBD P-code reported for short to ground" VALUE 0x7115C TKW_VV_VV_UW 100.0 FORMULA_0010 0.0 65535.0000 /end CHARACTERISTIC
/begin CHARACTERISTIC K_ED_LLS_INIT.P_CODE_SH_TO_GND "P-Code fuer die Art SH_TO_GND | EN: Fault code LLS_INIT - OBD P-code reported for short to ground" VALUE 0x71176 TKW_VV_VV_UW 100.0 FORMULA_0010 0.0 65535.0000 /end CHARACTERISTIC
/begin CHARACTERISTIC K_ED_DSC_EINGR.P_CODE_SH_TO_GND "P-Code fuer die Art SH_TO_GND | EN: Fault code DSC_EINGR - OBD P-code reported for short to ground" VALUE 0x71190 TKW_VV_VV_UW 100.0 FORMULA_0010 0.0 65535.0000 /end CHARACTERISTIC
/begin CHARACTERISTIC K_ED_LLS1_CMD.P_CODE_SH_TO_GND "P-Code fuer die Art SH_TO_GND | EN: Fault code LLS1_CMD - OBD P-code reported for short to ground" VALUE 0x711DE TKW_VV_VV_UW 100.0 FORMULA_0010 0.0 65535.0000 /end CHARACTERISTIC
/begin CHARACTERISTIC K_ED_LLS2_CMD.P_CODE_SH_TO_GND "P-Code fuer die Art SH_TO_GND | EN: Fault code LLS2_CMD - OBD P-code reported for short to ground" VALUE 0x711F8 TKW_VV_VV_UW 100.0 FORMULA_0010 0.0 65535.0000 /end CHARACTERISTIC
/begin CHARACTERISTIC K_ED_SC_SMG1.P_CODE_SH_TO_GND "P-Code fuer die Art SH_TO_GND | EN: Fault code SC_SMG1 - OBD P-code reported for short to ground" VALUE 0x71212 TKW_VV_VV_UW 100.0 FORMULA_0010 0.0 65535.0000 /end CHARACTERISTIC
/begin CHARACTERISTIC K_ED_SC_SMG2.P_CODE_SH_TO_GND "P-Code fuer die Art SH_TO_GND | EN: Fault code SC_SMG2 - OBD P-code reported for short to ground" VALUE 0x7122C TKW_VV_VV_UW 100.0 FORMULA_0010 0.0 65535.0000 /end CHARACTERISTIC
/begin CHARACTERISTIC K_ED_SC_SMG3.P_CODE_SH_TO_GND "P-Code fuer die Art SH_TO_GND | EN: Fault code SC_SMG3 - OBD P-code reported for short to ground" VALUE 0x71246 TKW_VV_VV_UW 100.0 FORMULA_0010 0.0 65535.0000 /end CHARACTERISTIC
/begin CHARACTERISTIC K_ED_SC_BUSOFF.P_CODE_SH_TO_GND "P-Code fuer die Art SH_TO_GND | EN: Fault code SC_BUSOFF - OBD P-code reported for short to ground" VALUE 0x71260 TKW_VV_VV_UW 100.0 FORMULA_0010 0.0 65535.0000 /end CHARACTERISTIC
/begin CHARACTERISTIC K_ED_EC_BUSOFF.P_CODE_SH_TO_GND "P-Code fuer die Art SH_TO_GND | EN: Fault code EC_BUSOFF - OBD P-code reported for short to ground" VALUE 0x7127A TKW_VV_VV_UW 100.0 FORMULA_0010 0.0 65535.0000 /end CHARACTERISTIC
/begin CHARACTERISTIC K_ED_ION_SIG_B1.P_CODE_SH_TO_GND "P-Code fuer die Art SH_TO_GND" VALUE 0x71398 TKW_VV_VV_UW 100.0 FORMULA_0010 0.0 65535.0000 /end CHARACTERISTIC
/begin CHARACTERISTIC K_ED_ION_SIG_B2.P_CODE_SH_TO_GND "P-Code fuer die Art SH_TO_GND" VALUE 0x713B2 TKW_VV_VV_UW 100.0 FORMULA_0010 0.0 65535.0000 /end CHARACTERISTIC
/begin CHARACTERISTIC K_ED_ION_SAT_B1.P_CODE_SH_TO_GND "P-Code fuer die Art SH_TO_GND" VALUE 0x714EA TKW_VV_VV_UW 100.0 FORMULA_0010 0.0 65535.0000 /end CHARACTERISTIC
/begin CHARACTERISTIC K_ED_ION_SAT_B2.P_CODE_SH_TO_GND "P-Code fuer die Art SH_TO_GND" VALUE 0x71504 TKW_VV_VV_UW 100.0 FORMULA_0010 0.0 65535.0000 /end CHARACTERISTIC
/begin CHARACTERISTIC K_ED_INDEX_88_IGN.P_CODE_SH_TO_GND "P-Code fuer die Art SH_TO_GND | EN: P-Code fuer die Art SH_TO_GND" VALUE 0x71552 TKW_VV_VV_UW 100.0 FORMULA_0010 0.0 65535.0000 /end CHARACTERISTIC
/begin CHARACTERISTIC K_ED_INDEX_89_IGN.P_CODE_SH_TO_GND "P-Code fuer die Art SH_TO_GND" VALUE 0x7156C TKW_VV_VV_UW 100.0 FORMULA_0010 0.0 65535.0000 /end CHARACTERISTIC
/begin CHARACTERISTIC K_ED_SG_IGN.P_CODE_SH_TO_GND "P-Code fuer die Art SH_TO_GND | EN: Fault code SG_IGN - OBD P-code reported for short to ground" VALUE 0x715BA TKW_VV_VV_UW 100.0 FORMULA_0010 0.0 65535.0000 /end CHARACTERISTIC
/begin CHARACTERISTIC K_ED_E2_IGN.P_CODE_SH_TO_GND "P-Code fuer die Art SH_TO_GND | EN: Fault code E2_IGN - OBD P-code reported for short to ground" VALUE 0x715D4 TKW_VV_VV_UW 100.0 FORMULA_0010 0.0 65535.0000 /end CHARACTERISTIC
/begin CHARACTERISTIC K_ED_SK_MANAGER_IGN.P_CODE_SH_TO_GND "P-Code fuer die Art SH_TO_GND | EN: Fault code SK_MANAGER_IGN - OBD P-code reported for short to ground" VALUE 0x71608 TKW_VV_VV_UW 100.0 FORMULA_0010 0.0 65535.0000 /end CHARACTERISTIC
/begin CHARACTERISTIC K_ED_LLR_DIAG.P_CODE_SH_TO_GND "P-Code fuer die Art SH_TO_GND | EN: Fault code LLR_DIAG - OBD P-code reported for short to ground" VALUE 0x71622 TKW_VV_VV_UW 100.0 FORMULA_0010 0.0 65535.0000 /end CHARACTERISTIC
/begin CHARACTERISTIC K_ED_DK2_ZUST.P_CODE_SH_TO_GND "P-Code fuer die Art SH_TO_GND | EN: Fault code DK2_ZUST - OBD P-code reported for short to ground" VALUE 0x7168A TKW_VV_VV_UW 100.0 FORMULA_0010 0.0 65535.0000 /end CHARACTERISTIC
/begin CHARACTERISTIC K_ED_FGR_ABWURF.P_CODE_SH_TO_GND "P-Code fuer die Art SH_TO_GND | EN: Fault code FGR_ABWURF - OBD P-code reported for short to ground" VALUE 0x716A4 TKW_VV_VV_UW 100.0 FORMULA_0010 0.0 65535.0000 /end CHARACTERISTIC
/begin CHARACTERISTIC K_ED_PWG_BLS.P_CODE_SH_TO_GND "P-Code fuer die Art SH_TO_GND | EN: Fault code PWG_BLS - OBD P-code reported for short to ground" VALUE 0x716BE TKW_VV_VV_UW 100.0 FORMULA_0010 0.0 65535.0000 /end CHARACTERISTIC
/begin CHARACTERISTIC K_ED_N_GETR_EIN_HS.P_CODE_SH_TO_GND "P-Code fuer die Art SH_TO_GND | EN: Fault code N_GETR_EIN_HS - OBD P-code reported for short to ground" VALUE 0x7170C TKW_VV_VV_UW 100.0 FORMULA_0010 0.0 65535.0000 /end CHARACTERISTIC
/begin CHARACTERISTIC K_ED_LLR_DIAG_CSS.P_CODE_SH_TO_GND "P-Code fuer die Art SH_TO_GND | EN: Fault code LLR_DIAG_CSS - OBD P-code reported for short to ground" VALUE 0x71740 TKW_VV_VV_UW 100.0 FORMULA_0010 0.0 65535.0000 /end CHARACTERISTIC
/begin CHARACTERISTIC K_ED_INDEX_110_IGN.P_CODE_SH_TO_GND "P-Code fuer die Art SH_TO_GND" VALUE 0x7178E TKW_VV_VV_UW 100.0 FORMULA_0010 0.0 65535.0000 /end CHARACTERISTIC
/begin CHARACTERISTIC K_ED_INDEX_111_IGN.P_CODE_SH_TO_GND "P-Code fuer die Art SH_TO_GND" VALUE 0x717A8 TKW_VV_VV_UW 100.0 FORMULA_0010 0.0 65535.0000 /end CHARACTERISTIC
/begin CHARACTERISTIC K_ED_INDEX_112_IGN.P_CODE_SH_TO_GND "P-Code fuer die Art SH_TO_GND" VALUE 0x717C2 TKW_VV_VV_UW 100.0 FORMULA_0010 0.0 65535.0000 /end CHARACTERISTIC
/begin CHARACTERISTIC K_ED_INDEX_113_IGN.P_CODE_SH_TO_GND "P-Code fuer die Art SH_TO_GND" VALUE 0x717DC TKW_VV_VV_UW 100.0 FORMULA_0010 0.0 65535.0000 /end CHARACTERISTIC
/begin CHARACTERISTIC K_ED_INDEX_114_IGN.P_CODE_SH_TO_GND "P-Code fuer die Art SH_TO_GND" VALUE 0x717F6 TKW_VV_VV_UW 100.0 FORMULA_0010 0.0 65535.0000 /end CHARACTERISTIC
/begin CHARACTERISTIC K_ED_INDEX_115_IGN.P_CODE_SH_TO_GND "P-Code fuer die Art SH_TO_GND" VALUE 0x71810 TKW_VV_VV_UW 100.0 FORMULA_0010 0.0 65535.0000 /end CHARACTERISTIC
/begin CHARACTERISTIC K_ED_INDEX_116_IGN.P_CODE_SH_TO_GND "P-Code fuer die Art SH_TO_GND" VALUE 0x7182A TKW_VV_VV_UW 100.0 FORMULA_0010 0.0 65535.0000 /end CHARACTERISTIC
/begin CHARACTERISTIC K_ED_INDEX_117_IGN.P_CODE_SH_TO_GND "P-Code fuer die Art SH_TO_GND" VALUE 0x71844 TKW_VV_VV_UW 100.0 FORMULA_0010 0.0 65535.0000 /end CHARACTERISTIC
/begin CHARACTERISTIC K_ED_INDEX_118_IGN.P_CODE_SH_TO_GND "P-Code fuer die Art SH_TO_GND" VALUE 0x7185E TKW_VV_VV_UW 100.0 FORMULA_0010 0.0 65535.0000 /end CHARACTERISTIC
/begin CHARACTERISTIC K_ED_INDEX_119_IGN.P_CODE_SH_TO_GND "P-Code fuer die Art SH_TO_GND" VALUE 0x71878 TKW_VV_VV_UW 100.0 FORMULA_0010 0.0 65535.0000 /end CHARACTERISTIC
/begin CHARACTERISTIC K_ED_INDEX_120_IGN.P_CODE_SH_TO_GND "P-Code fuer die Art SH_TO_GND" VALUE 0x71892 TKW_VV_VV_UW 100.0 FORMULA_0010 0.0 65535.0000 /end CHARACTERISTIC
/begin CHARACTERISTIC K_ED_INDEX_121_IGN.P_CODE_SH_TO_GND "P-Code fuer die Art SH_TO_GND | EN: Fault code INDEX_121_IGN - OBD P-code reported for short to ground" VALUE 0x718AC TKW_VV_VV_UW 100.0 FORMULA_0010 0.0 65535.0000 /end CHARACTERISTIC
/begin CHARACTERISTIC K_ED_INDEX_122_IGN.P_CODE_SH_TO_GND "P-Code fuer die Art SH_TO_GND | EN: Fault code INDEX_122_IGN - OBD P-code reported for short to ground" VALUE 0x718C6 TKW_VV_VV_UW 100.0 FORMULA_0010 0.0 65535.0000 /end CHARACTERISTIC
/begin CHARACTERISTIC K_ED_INDEX_123_IGN.P_CODE_SH_TO_GND "P-Code fuer die Art SH_TO_GND | EN: Fault code INDEX_123_IGN - OBD P-code reported for short to ground" VALUE 0x718E0 TKW_VV_VV_UW 100.0 FORMULA_0010 0.0 65535.0000 /end CHARACTERISTIC
/begin CHARACTERISTIC K_ED_INDEX_124_IGN.P_CODE_SH_TO_GND "P-Code fuer die Art SH_TO_GND | EN: Fault code INDEX_124_IGN - OBD P-code reported for short to ground" VALUE 0x718FA TKW_VV_VV_UW 100.0 FORMULA_0010 0.0 65535.0000 /end CHARACTERISTIC
/begin CHARACTERISTIC K_ED_INDEX_125_IGN.P_CODE_SH_TO_GND "P-Code fuer die Art SH_TO_GND | EN: Fault code INDEX_125_IGN - OBD P-code reported for short to ground" VALUE 0x71914 TKW_VV_VV_UW 100.0 FORMULA_0010 0.0 65535.0000 /end CHARACTERISTIC
/begin CHARACTERISTIC K_ED_INDEX_126_IGN.P_CODE_SH_TO_GND "P-Code fuer die Art SH_TO_GND | EN: Fault code INDEX_126_IGN - OBD P-code reported for short to ground" VALUE 0x7192E TKW_VV_VV_UW 100.0 FORMULA_0010 0.0 65535.0000 /end CHARACTERISTIC
/begin CHARACTERISTIC K_ED_INDEX_127_IGN.P_CODE_SH_TO_GND "P-Code fuer die Art SH_TO_GND | EN: Fault code INDEX_127_IGN - OBD P-code reported for short to ground" VALUE 0x71948 TKW_VV_VV_UW 100.0 FORMULA_0010 0.0 65535.0000 /end CHARACTERISTIC
/begin CHARACTERISTIC K_ED_SK_TR_IGN.P_CODE_OPENLOAD "P-Code fuer die Art OPENLOAD | EN: P-Code fuer die Art OPENLOAD" VALUE 0x70C64 TKW_VV_VV_UW 100.0 FORMULA_0010 0.0 65535.0000 /end CHARACTERISTIC
/begin CHARACTERISTIC K_ED_PWG1.P_CODE_OPENLOAD "P-Code fuer die Art OPENLOAD | EN: Fault code PWG1 - OBD P-code reported for open circuit" VALUE 0x70DB6 TKW_VV_VV_UW 100.0 FORMULA_0010 0.0 65535.0000 /end CHARACTERISTIC
/begin CHARACTERISTIC K_ED_PWG2.P_CODE_OPENLOAD "P-Code fuer die Art OPENLOAD | EN: Fault code PWG2 - OBD P-code reported for open circuit" VALUE 0x70DD0 TKW_VV_VV_UW 100.0 FORMULA_0010 0.0 65535.0000 /end CHARACTERISTIC
/begin CHARACTERISTIC K_ED_PWG_VGL.P_CODE_OPENLOAD "P-Code fuer die Art OPENLOAD | EN: Fault code PWG_VGL - OBD P-code reported for open circuit" VALUE 0x70DEA TKW_VV_VV_UW 100.0 FORMULA_0010 0.0 65535.0000 /end CHARACTERISTIC
/begin CHARACTERISTIC K_ED_PCTRL_IGN.P_CODE_OPENLOAD "P-Code fuer die Art OPENLOAD | EN: Fault code PCTRL_IGN - OBD P-code reported for open circuit" VALUE 0x70E04 TKW_VV_VV_UW 100.0 FORMULA_0010 0.0 65535.0000 /end CHARACTERISTIC
/begin CHARACTERISTIC K_ED_LLS1_CAN.P_CODE_OPENLOAD "P-Code fuer die Art OPENLOAD | EN: Fault code LLS1_CAN - OBD P-code reported for open circuit" VALUE 0x70E1E TKW_VV_VV_UW 100.0 FORMULA_0010 0.0 65535.0000 /end CHARACTERISTIC
/begin CHARACTERISTIC K_ED_LLS2_CAN.P_CODE_OPENLOAD "P-Code fuer die Art OPENLOAD | EN: Fault code LLS2_CAN - OBD P-code reported for open circuit" VALUE 0x70E38 TKW_VV_VV_UW 100.0 FORMULA_0010 0.0 65535.0000 /end CHARACTERISTIC
/begin CHARACTERISTIC K_ED_LLS1_SK.P_CODE_OPENLOAD "P-Code fuer die Art OPENLOAD | EN: Fault code LLS1_SK - OBD P-code reported for open circuit" VALUE 0x70E86 TKW_VV_VV_UW 100.0 FORMULA_0010 0.0 65535.0000 /end CHARACTERISTIC
/begin CHARACTERISTIC K_ED_LLS2_SK.P_CODE_OPENLOAD "P-Code fuer die Art OPENLOAD | EN: Fault code LLS2_SK - OBD P-code reported for open circuit" VALUE 0x70EA0 TKW_VV_VV_UW 100.0 FORMULA_0010 0.0 65535.0000 /end CHARACTERISTIC
/begin CHARACTERISTIC K_ED_SMG_SCHALTAB.P_CODE_OPENLOAD "P-Code fuer die Art OPENLOAD | EN: Fault code SMG_SCHALTAB - OBD P-code reported for open circuit" VALUE 0x70EBA TKW_VV_VV_UW 100.0 FORMULA_0010 0.0 65535.0000 /end CHARACTERISTIC
/begin CHARACTERISTIC K_ED_DK_INIT.P_CODE_OPENLOAD "P-Code fuer die Art OPENLOAD | EN: Fault code DK_INIT - OBD P-code reported for open circuit" VALUE 0x70F3C TKW_VV_VV_UW 100.0 FORMULA_0010 0.0 65535.0000 /end CHARACTERISTIC
/begin CHARACTERISTIC K_ED_DK2_REGLER.P_CODE_OPENLOAD "P-Code fuer die Art OPENLOAD | EN: Fault code DK2_REGLER - OBD P-code reported for open circuit" VALUE 0x70F70 TKW_VV_VV_UW 100.0 FORMULA_0010 0.0 65535.0000 /end CHARACTERISTIC
/begin CHARACTERISTIC K_ED_IONVERST_B1.P_CODE_OPENLOAD "P-Code fuer die Art OPENLOAD" VALUE 0x70FBE TKW_VV_VV_UW 100.0 FORMULA_0010 0.0 65535.0000 /end CHARACTERISTIC
/begin CHARACTERISTIC K_ED_IONSPG_B1.P_CODE_OPENLOAD "P-Code fuer die Art OPENLOAD" VALUE 0x70FD8 TKW_VV_VV_UW 100.0 FORMULA_0010 0.0 65535.0000 /end CHARACTERISTIC
/begin CHARACTERISTIC K_ED_IONVERST_B2.P_CODE_OPENLOAD "P-Code fuer die Art OPENLOAD" VALUE 0x70FF2 TKW_VV_VV_UW 100.0 FORMULA_0010 0.0 65535.0000 /end CHARACTERISTIC
/begin CHARACTERISTIC K_ED_IONSPG_B2.P_CODE_OPENLOAD "P-Code fuer die Art OPENLOAD" VALUE 0x7100C TKW_VV_VV_UW 100.0 FORMULA_0010 0.0 65535.0000 /end CHARACTERISTIC
/begin CHARACTERISTIC K_ED_DK2_WDK.P_CODE_OPENLOAD "P-Code fuer die Art OPENLOAD | EN: Fault code DK2_WDK - OBD P-code reported for open circuit" VALUE 0x71074 TKW_VV_VV_UW 100.0 FORMULA_0010 0.0 65535.0000 /end CHARACTERISTIC
/begin CHARACTERISTIC K_ED_LLS1_REGLER.P_CODE_OPENLOAD "P-Code fuer die Art OPENLOAD | EN: Fault code LLS1_REGLER - OBD P-code reported for open circuit" VALUE 0x710C2 TKW_VV_VV_UW 100.0 FORMULA_0010 0.0 65535.0000 /end CHARACTERISTIC
/begin CHARACTERISTIC K_ED_LLS2_REGLER.P_CODE_OPENLOAD "P-Code fuer die Art OPENLOAD | EN: Fault code LLS2_REGLER - OBD P-code reported for open circuit" VALUE 0x710DC TKW_VV_VV_UW 100.0 FORMULA_0010 0.0 65535.0000 /end CHARACTERISTIC
/begin CHARACTERISTIC K_ED_DK2_SK_ERR.P_CODE_OPENLOAD "P-Code fuer die Art OPENLOAD | EN: Fault code DK2_SK_ERR - OBD P-code reported for open circuit" VALUE 0x71110 TKW_VV_VV_UW 100.0 FORMULA_0010 0.0 65535.0000 /end CHARACTERISTIC
/begin CHARACTERISTIC K_ED_MD_SK_ERR.P_CODE_OPENLOAD "P-Code fuer die Art OPENLOAD | EN: Fault code MD_SK_ERR - OBD P-code reported for open circuit" VALUE 0x7115E TKW_VV_VV_UW 100.0 FORMULA_0010 0.0 65535.0000 /end CHARACTERISTIC
/begin CHARACTERISTIC K_ED_LLS_INIT.P_CODE_OPENLOAD "P-Code fuer die Art OPENLOAD | EN: Fault code LLS_INIT - OBD P-code reported for open circuit" VALUE 0x71178 TKW_VV_VV_UW 100.0 FORMULA_0010 0.0 65535.0000 /end CHARACTERISTIC
/begin CHARACTERISTIC K_ED_DSC_EINGR.P_CODE_OPENLOAD "P-Code fuer die Art OPENLOAD | EN: Fault code DSC_EINGR - OBD P-code reported for open circuit" VALUE 0x71192 TKW_VV_VV_UW 100.0 FORMULA_0010 0.0 65535.0000 /end CHARACTERISTIC
/begin CHARACTERISTIC K_ED_LLS1_CMD.P_CODE_OPENLOAD "P-Code fuer die Art OPENLOAD | EN: Fault code LLS1_CMD - OBD P-code reported for open circuit" VALUE 0x711E0 TKW_VV_VV_UW 100.0 FORMULA_0010 0.0 65535.0000 /end CHARACTERISTIC
/begin CHARACTERISTIC K_ED_LLS2_CMD.P_CODE_OPENLOAD "P-Code fuer die Art OPENLOAD | EN: Fault code LLS2_CMD - OBD P-code reported for open circuit" VALUE 0x711FA TKW_VV_VV_UW 100.0 FORMULA_0010 0.0 65535.0000 /end CHARACTERISTIC
/begin CHARACTERISTIC K_ED_SC_SMG1.P_CODE_OPENLOAD "P-Code fuer die Art OPENLOAD | EN: Fault code SC_SMG1 - OBD P-code reported for open circuit" VALUE 0x71214 TKW_VV_VV_UW 100.0 FORMULA_0010 0.0 65535.0000 /end CHARACTERISTIC
/begin CHARACTERISTIC K_ED_SC_SMG2.P_CODE_OPENLOAD "P-Code fuer die Art OPENLOAD | EN: Fault code SC_SMG2 - OBD P-code reported for open circuit" VALUE 0x7122E TKW_VV_VV_UW 100.0 FORMULA_0010 0.0 65535.0000 /end CHARACTERISTIC
/begin CHARACTERISTIC K_ED_SC_SMG3.P_CODE_OPENLOAD "P-Code fuer die Art OPENLOAD | EN: Fault code SC_SMG3 - OBD P-code reported for open circuit" VALUE 0x71248 TKW_VV_VV_UW 100.0 FORMULA_0010 0.0 65535.0000 /end CHARACTERISTIC
/begin CHARACTERISTIC K_ED_SC_BUSOFF.P_CODE_OPENLOAD "P-Code fuer die Art OPENLOAD | EN: Fault code SC_BUSOFF - OBD P-code reported for open circuit" VALUE 0x71262 TKW_VV_VV_UW 100.0 FORMULA_0010 0.0 65535.0000 /end CHARACTERISTIC
/begin CHARACTERISTIC K_ED_EC_BUSOFF.P_CODE_OPENLOAD "P-Code fuer die Art OPENLOAD | EN: Fault code EC_BUSOFF - OBD P-code reported for open circuit" VALUE 0x7127C TKW_VV_VV_UW 100.0 FORMULA_0010 0.0 65535.0000 /end CHARACTERISTIC
/begin CHARACTERISTIC K_ED_ION_SIG_B1.P_CODE_OPENLOAD "P-Code fuer die Art OPENLOAD" VALUE 0x7139A TKW_VV_VV_UW 100.0 FORMULA_0010 0.0 65535.0000 /end CHARACTERISTIC
/begin CHARACTERISTIC K_ED_ION_SIG_B2.P_CODE_OPENLOAD "P-Code fuer die Art OPENLOAD" VALUE 0x713B4 TKW_VV_VV_UW 100.0 FORMULA_0010 0.0 65535.0000 /end CHARACTERISTIC
/begin CHARACTERISTIC K_ED_ION_SAT_B1.P_CODE_OPENLOAD "P-Code fuer die Art OPENLOAD" VALUE 0x714EC TKW_VV_VV_UW 100.0 FORMULA_0010 0.0 65535.0000 /end CHARACTERISTIC
/begin CHARACTERISTIC K_ED_ION_SAT_B2.P_CODE_OPENLOAD "P-Code fuer die Art OPENLOAD" VALUE 0x71506 TKW_VV_VV_UW 100.0 FORMULA_0010 0.0 65535.0000 /end CHARACTERISTIC
/begin CHARACTERISTIC K_ED_INDEX_88_IGN.P_CODE_OPENLOAD "P-Code fuer die Art OPENLOAD | EN: P-Code fuer die Art OPENLOAD" VALUE 0x71554 TKW_VV_VV_UW 100.0 FORMULA_0010 0.0 65535.0000 /end CHARACTERISTIC
/begin CHARACTERISTIC K_ED_INDEX_89_IGN.P_CODE_OPENLOAD "P-Code fuer die Art OPENLOAD" VALUE 0x7156E TKW_VV_VV_UW 100.0 FORMULA_0010 0.0 65535.0000 /end CHARACTERISTIC
/begin CHARACTERISTIC K_ED_SG_IGN.P_CODE_OPENLOAD "P-Code fuer die Art OPENLOAD | EN: Fault code SG_IGN - OBD P-code reported for open circuit" VALUE 0x715BC TKW_VV_VV_UW 100.0 FORMULA_0010 0.0 65535.0000 /end CHARACTERISTIC
/begin CHARACTERISTIC K_ED_E2_IGN.P_CODE_OPENLOAD "P-Code fuer die Art OPENLOAD | EN: Fault code E2_IGN - OBD P-code reported for open circuit" VALUE 0x715D6 TKW_VV_VV_UW 100.0 FORMULA_0010 0.0 65535.0000 /end CHARACTERISTIC
/begin CHARACTERISTIC K_ED_SK_MANAGER_IGN.P_CODE_OPENLOAD "P-Code fuer die Art OPENLOAD | EN: Fault code SK_MANAGER_IGN - OBD P-code reported for open circuit" VALUE 0x7160A TKW_VV_VV_UW 100.0 FORMULA_0010 0.0 65535.0000 /end CHARACTERISTIC
/begin CHARACTERISTIC K_ED_LLR_DIAG.P_CODE_OPENLOAD "P-Code fuer die Art OPENLOAD | EN: Fault code LLR_DIAG - OBD P-code reported for open circuit" VALUE 0x71624 TKW_VV_VV_UW 100.0 FORMULA_0010 0.0 65535.0000 /end CHARACTERISTIC
/begin CHARACTERISTIC K_ED_DK2_ZUST.P_CODE_OPENLOAD "P-Code fuer die Art OPENLOAD | EN: Fault code DK2_ZUST - OBD P-code reported for open circuit" VALUE 0x7168C TKW_VV_VV_UW 100.0 FORMULA_0010 0.0 65535.0000 /end CHARACTERISTIC
/begin CHARACTERISTIC K_ED_FGR_ABWURF.P_CODE_OPENLOAD "P-Code fuer die Art OPENLOAD | EN: Fault code FGR_ABWURF - OBD P-code reported for open circuit" VALUE 0x716A6 TKW_VV_VV_UW 100.0 FORMULA_0010 0.0 65535.0000 /end CHARACTERISTIC
/begin CHARACTERISTIC K_ED_PWG_BLS.P_CODE_OPENLOAD "P-Code fuer die Art OPENLOAD | EN: Fault code PWG_BLS - OBD P-code reported for open circuit" VALUE 0x716C0 TKW_VV_VV_UW 100.0 FORMULA_0010 0.0 65535.0000 /end CHARACTERISTIC
/begin CHARACTERISTIC K_ED_N_GETR_EIN_HS.P_CODE_OPENLOAD "P-Code fuer die Art OPENLOAD | EN: Fault code N_GETR_EIN_HS - OBD P-code reported for open circuit" VALUE 0x7170E TKW_VV_VV_UW 100.0 FORMULA_0010 0.0 65535.0000 /end CHARACTERISTIC
/begin CHARACTERISTIC K_ED_LLR_DIAG_CSS.P_CODE_OPENLOAD "P-Code fuer die Art OPENLOAD | EN: Fault code LLR_DIAG_CSS - OBD P-code reported for open circuit" VALUE 0x71742 TKW_VV_VV_UW 100.0 FORMULA_0010 0.0 65535.0000 /end CHARACTERISTIC
/begin CHARACTERISTIC K_ED_INDEX_110_IGN.P_CODE_OPENLOAD "P-Code fuer die Art OPENLOAD" VALUE 0x71790 TKW_VV_VV_UW 100.0 FORMULA_0010 0.0 65535.0000 /end CHARACTERISTIC
/begin CHARACTERISTIC K_ED_INDEX_111_IGN.P_CODE_OPENLOAD "P-Code fuer die Art OPENLOAD" VALUE 0x717AA TKW_VV_VV_UW 100.0 FORMULA_0010 0.0 65535.0000 /end CHARACTERISTIC
/begin CHARACTERISTIC K_ED_INDEX_112_IGN.P_CODE_OPENLOAD "P-Code fuer die Art OPENLOAD" VALUE 0x717C4 TKW_VV_VV_UW 100.0 FORMULA_0010 0.0 65535.0000 /end CHARACTERISTIC
/begin CHARACTERISTIC K_ED_INDEX_113_IGN.P_CODE_OPENLOAD "P-Code fuer die Art OPENLOAD" VALUE 0x717DE TKW_VV_VV_UW 100.0 FORMULA_0010 0.0 65535.0000 /end CHARACTERISTIC
/begin CHARACTERISTIC K_ED_INDEX_114_IGN.P_CODE_OPENLOAD "P-Code fuer die Art OPENLOAD" VALUE 0x717F8 TKW_VV_VV_UW 100.0 FORMULA_0010 0.0 65535.0000 /end CHARACTERISTIC
/begin CHARACTERISTIC K_ED_INDEX_115_IGN.P_CODE_OPENLOAD "P-Code fuer die Art OPENLOAD" VALUE 0x71812 TKW_VV_VV_UW 100.0 FORMULA_0010 0.0 65535.0000 /end CHARACTERISTIC
/begin CHARACTERISTIC K_ED_INDEX_116_IGN.P_CODE_OPENLOAD "P-Code fuer die Art OPENLOAD" VALUE 0x7182C TKW_VV_VV_UW 100.0 FORMULA_0010 0.0 65535.0000 /end CHARACTERISTIC
/begin CHARACTERISTIC K_ED_INDEX_117_IGN.P_CODE_OPENLOAD "P-Code fuer die Art OPENLOAD" VALUE 0x71846 TKW_VV_VV_UW 100.0 FORMULA_0010 0.0 65535.0000 /end CHARACTERISTIC
/begin CHARACTERISTIC K_ED_INDEX_118_IGN.P_CODE_OPENLOAD "P-Code fuer die Art OPENLOAD" VALUE 0x71860 TKW_VV_VV_UW 100.0 FORMULA_0010 0.0 65535.0000 /end CHARACTERISTIC
/begin CHARACTERISTIC K_ED_INDEX_119_IGN.P_CODE_OPENLOAD "P-Code fuer die Art OPENLOAD" VALUE 0x7187A TKW_VV_VV_UW 100.0 FORMULA_0010 0.0 65535.0000 /end CHARACTERISTIC
/begin CHARACTERISTIC K_ED_INDEX_120_IGN.P_CODE_OPENLOAD "P-Code fuer die Art OPENLOAD" VALUE 0x71894 TKW_VV_VV_UW 100.0 FORMULA_0010 0.0 65535.0000 /end CHARACTERISTIC
/begin CHARACTERISTIC K_ED_INDEX_121_IGN.P_CODE_OPENLOAD "P-Code fuer die Art OPENLOAD | EN: Fault code INDEX_121_IGN - OBD P-code reported for open circuit" VALUE 0x718AE TKW_VV_VV_UW 100.0 FORMULA_0010 0.0 65535.0000 /end CHARACTERISTIC
/begin CHARACTERISTIC K_ED_INDEX_122_IGN.P_CODE_OPENLOAD "P-Code fuer die Art OPENLOAD | EN: Fault code INDEX_122_IGN - OBD P-code reported for open circuit" VALUE 0x718C8 TKW_VV_VV_UW 100.0 FORMULA_0010 0.0 65535.0000 /end CHARACTERISTIC
/begin CHARACTERISTIC K_ED_INDEX_123_IGN.P_CODE_OPENLOAD "P-Code fuer die Art OPENLOAD | EN: Fault code INDEX_123_IGN - OBD P-code reported for open circuit" VALUE 0x718E2 TKW_VV_VV_UW 100.0 FORMULA_0010 0.0 65535.0000 /end CHARACTERISTIC
/begin CHARACTERISTIC K_ED_INDEX_124_IGN.P_CODE_OPENLOAD "P-Code fuer die Art OPENLOAD | EN: Fault code INDEX_124_IGN - OBD P-code reported for open circuit" VALUE 0x718FC TKW_VV_VV_UW 100.0 FORMULA_0010 0.0 65535.0000 /end CHARACTERISTIC
/begin CHARACTERISTIC K_ED_INDEX_125_IGN.P_CODE_OPENLOAD "P-Code fuer die Art OPENLOAD | EN: Fault code INDEX_125_IGN - OBD P-code reported for open circuit" VALUE 0x71916 TKW_VV_VV_UW 100.0 FORMULA_0010 0.0 65535.0000 /end CHARACTERISTIC
/begin CHARACTERISTIC K_ED_INDEX_126_IGN.P_CODE_OPENLOAD "P-Code fuer die Art OPENLOAD | EN: Fault code INDEX_126_IGN - OBD P-code reported for open circuit" VALUE 0x71930 TKW_VV_VV_UW 100.0 FORMULA_0010 0.0 65535.0000 /end CHARACTERISTIC
/begin CHARACTERISTIC K_ED_INDEX_127_IGN.P_CODE_OPENLOAD "P-Code fuer die Art OPENLOAD | EN: Fault code INDEX_127_IGN - OBD P-code reported for open circuit" VALUE 0x7194A TKW_VV_VV_UW 100.0 FORMULA_0010 0.0 65535.0000 /end CHARACTERISTIC
/begin CHARACTERISTIC K_ED_SK_TR_IGN.P_CODE_UNPLAUSIBEL "P-Code fuer die Art UNPLAUSIBEL | EN: P-Code fuer die Art UNPLAUSIBEL" VALUE 0x70C66 TKW_VV_VV_UW 100.0 FORMULA_0010 0.0 65535.0000 /end CHARACTERISTIC
/begin CHARACTERISTIC K_ED_PWG1.P_CODE_UNPLAUSIBEL "P-Code fuer die Art UNPLAUSIBEL | EN: Fault code PWG1 - OBD P-code reported for implausible signal" VALUE 0x70DB8 TKW_VV_VV_UW 100.0 FORMULA_0010 0.0 65535.0000 /end CHARACTERISTIC
/begin CHARACTERISTIC K_ED_PWG2.P_CODE_UNPLAUSIBEL "P-Code fuer die Art UNPLAUSIBEL | EN: Fault code PWG2 - OBD P-code reported for implausible signal" VALUE 0x70DD2 TKW_VV_VV_UW 100.0 FORMULA_0010 0.0 65535.0000 /end CHARACTERISTIC
/begin CHARACTERISTIC K_ED_PWG_VGL.P_CODE_UNPLAUSIBEL "P-Code fuer die Art UNPLAUSIBEL | EN: Fault code PWG_VGL - OBD P-code reported for implausible signal" VALUE 0x70DEC TKW_VV_VV_UW 100.0 FORMULA_0010 0.0 65535.0000 /end CHARACTERISTIC
/begin CHARACTERISTIC K_ED_PCTRL_IGN.P_CODE_UNPLAUSIBEL "P-Code fuer die Art UNPLAUSIBEL | EN: Fault code PCTRL_IGN - OBD P-code reported for implausible signal" VALUE 0x70E06 TKW_VV_VV_UW 100.0 FORMULA_0010 0.0 65535.0000 /end CHARACTERISTIC
/begin CHARACTERISTIC K_ED_LLS1_CAN.P_CODE_UNPLAUSIBEL "P-Code fuer die Art UNPLAUSIBEL | EN: Fault code LLS1_CAN - OBD P-code reported for implausible signal" VALUE 0x70E20 TKW_VV_VV_UW 100.0 FORMULA_0010 0.0 65535.0000 /end CHARACTERISTIC
/begin CHARACTERISTIC K_ED_LLS2_CAN.P_CODE_UNPLAUSIBEL "P-Code fuer die Art UNPLAUSIBEL | EN: Fault code LLS2_CAN - OBD P-code reported for implausible signal" VALUE 0x70E3A TKW_VV_VV_UW 100.0 FORMULA_0010 0.0 65535.0000 /end CHARACTERISTIC
/begin CHARACTERISTIC K_ED_LLS1_SK.P_CODE_UNPLAUSIBEL "P-Code fuer die Art UNPLAUSIBEL | EN: Fault code LLS1_SK - OBD P-code reported for implausible signal" VALUE 0x70E88 TKW_VV_VV_UW 100.0 FORMULA_0010 0.0 65535.0000 /end CHARACTERISTIC
/begin CHARACTERISTIC K_ED_LLS2_SK.P_CODE_UNPLAUSIBEL "P-Code fuer die Art UNPLAUSIBEL | EN: Fault code LLS2_SK - OBD P-code reported for implausible signal" VALUE 0x70EA2 TKW_VV_VV_UW 100.0 FORMULA_0010 0.0 65535.0000 /end CHARACTERISTIC
/begin CHARACTERISTIC K_ED_SMG_SCHALTAB.P_CODE_UNPLAUSIBEL "P-Code fuer die Art UNPLAUSIBEL | EN: Fault code SMG_SCHALTAB - OBD P-code reported for implausible signal" VALUE 0x70EBC TKW_VV_VV_UW 100.0 FORMULA_0010 0.0 65535.0000 /end CHARACTERISTIC
/begin CHARACTERISTIC K_ED_DK_INIT.P_CODE_UNPLAUSIBEL "P-Code fuer die Art UNPLAUSIBEL | EN: Fault code DK_INIT - OBD P-code reported for implausible signal" VALUE 0x70F3E TKW_VV_VV_UW 100.0 FORMULA_0010 0.0 65535.0000 /end CHARACTERISTIC
/begin CHARACTERISTIC K_ED_DK2_REGLER.P_CODE_UNPLAUSIBEL "P-Code fuer die Art UNPLAUSIBEL | EN: Fault code DK2_REGLER - OBD P-code reported for implausible signal" VALUE 0x70F72 TKW_VV_VV_UW 100.0 FORMULA_0010 0.0 65535.0000 /end CHARACTERISTIC
/begin CHARACTERISTIC K_ED_IONVERST_B1.P_CODE_UNPLAUSIBEL "P-Code fuer die Art UNPLAUSIBEL" VALUE 0x70FC0 TKW_VV_VV_UW 100.0 FORMULA_0010 0.0 65535.0000 /end CHARACTERISTIC
/begin CHARACTERISTIC K_ED_IONSPG_B1.P_CODE_UNPLAUSIBEL "P-Code fuer die Art UNPLAUSIBEL" VALUE 0x70FDA TKW_VV_VV_UW 100.0 FORMULA_0010 0.0 65535.0000 /end CHARACTERISTIC
/begin CHARACTERISTIC K_ED_IONVERST_B2.P_CODE_UNPLAUSIBEL "P-Code fuer die Art UNPLAUSIBEL" VALUE 0x70FF4 TKW_VV_VV_UW 100.0 FORMULA_0010 0.0 65535.0000 /end CHARACTERISTIC
/begin CHARACTERISTIC K_ED_IONSPG_B2.P_CODE_UNPLAUSIBEL "P-Code fuer die Art UNPLAUSIBEL" VALUE 0x7100E TKW_VV_VV_UW 100.0 FORMULA_0010 0.0 65535.0000 /end CHARACTERISTIC
/begin CHARACTERISTIC K_ED_DK2_WDK.P_CODE_UNPLAUSIBEL "P-Code fuer die Art UNPLAUSIBEL | EN: Fault code DK2_WDK - OBD P-code reported for implausible signal" VALUE 0x71076 TKW_VV_VV_UW 100.0 FORMULA_0010 0.0 65535.0000 /end CHARACTERISTIC
/begin CHARACTERISTIC K_ED_LLS1_REGLER.P_CODE_UNPLAUSIBEL "P-Code fuer die Art UNPLAUSIBEL | EN: Fault code LLS1_REGLER - OBD P-code reported for implausible signal" VALUE 0x710C4 TKW_VV_VV_UW 100.0 FORMULA_0010 0.0 65535.0000 /end CHARACTERISTIC
/begin CHARACTERISTIC K_ED_LLS2_REGLER.P_CODE_UNPLAUSIBEL "P-Code fuer die Art UNPLAUSIBEL | EN: Fault code LLS2_REGLER - OBD P-code reported for implausible signal" VALUE 0x710DE TKW_VV_VV_UW 100.0 FORMULA_0010 0.0 65535.0000 /end CHARACTERISTIC
/begin CHARACTERISTIC K_ED_DK2_SK_ERR.P_CODE_UNPLAUSIBEL "P-Code fuer die Art UNPLAUSIBEL | EN: Fault code DK2_SK_ERR - OBD P-code reported for implausible signal" VALUE 0x71112 TKW_VV_VV_UW 100.0 FORMULA_0010 0.0 65535.0000 /end CHARACTERISTIC
/begin CHARACTERISTIC K_ED_MD_SK_ERR.P_CODE_UNPLAUSIBEL "P-Code fuer die Art UNPLAUSIBEL | EN: Fault code MD_SK_ERR - OBD P-code reported for implausible signal" VALUE 0x71160 TKW_VV_VV_UW 100.0 FORMULA_0010 0.0 65535.0000 /end CHARACTERISTIC
/begin CHARACTERISTIC K_ED_LLS_INIT.P_CODE_UNPLAUSIBEL "P-Code fuer die Art UNPLAUSIBEL | EN: Fault code LLS_INIT - OBD P-code reported for implausible signal" VALUE 0x7117A TKW_VV_VV_UW 100.0 FORMULA_0010 0.0 65535.0000 /end CHARACTERISTIC
/begin CHARACTERISTIC K_ED_DSC_EINGR.P_CODE_UNPLAUSIBEL "P-Code fuer die Art UNPLAUSIBEL | EN: Fault code DSC_EINGR - OBD P-code reported for implausible signal" VALUE 0x71194 TKW_VV_VV_UW 100.0 FORMULA_0010 0.0 65535.0000 /end CHARACTERISTIC
/begin CHARACTERISTIC K_ED_LLS1_CMD.P_CODE_UNPLAUSIBEL "P-Code fuer die Art UNPLAUSIBEL | EN: Fault code LLS1_CMD - OBD P-code reported for implausible signal" VALUE 0x711E2 TKW_VV_VV_UW 100.0 FORMULA_0010 0.0 65535.0000 /end CHARACTERISTIC
/begin CHARACTERISTIC K_ED_LLS2_CMD.P_CODE_UNPLAUSIBEL "P-Code fuer die Art UNPLAUSIBEL | EN: Fault code LLS2_CMD - OBD P-code reported for implausible signal" VALUE 0x711FC TKW_VV_VV_UW 100.0 FORMULA_0010 0.0 65535.0000 /end CHARACTERISTIC
/begin CHARACTERISTIC K_ED_SC_SMG1.P_CODE_UNPLAUSIBEL "P-Code fuer die Art UNPLAUSIBEL | EN: Fault code SC_SMG1 - OBD P-code reported for implausible signal" VALUE 0x71216 TKW_VV_VV_UW 100.0 FORMULA_0010 0.0 65535.0000 /end CHARACTERISTIC
/begin CHARACTERISTIC K_ED_SC_SMG2.P_CODE_UNPLAUSIBEL "P-Code fuer die Art UNPLAUSIBEL | EN: Fault code SC_SMG2 - OBD P-code reported for implausible signal" VALUE 0x71230 TKW_VV_VV_UW 100.0 FORMULA_0010 0.0 65535.0000 /end CHARACTERISTIC
/begin CHARACTERISTIC K_ED_SC_SMG3.P_CODE_UNPLAUSIBEL "P-Code fuer die Art UNPLAUSIBEL | EN: Fault code SC_SMG3 - OBD P-code reported for implausible signal" VALUE 0x7124A TKW_VV_VV_UW 100.0 FORMULA_0010 0.0 65535.0000 /end CHARACTERISTIC
/begin CHARACTERISTIC K_ED_SC_BUSOFF.P_CODE_UNPLAUSIBEL "P-Code fuer die Art UNPLAUSIBEL | EN: Fault code SC_BUSOFF - OBD P-code reported for implausible signal" VALUE 0x71264 TKW_VV_VV_UW 100.0 FORMULA_0010 0.0 65535.0000 /end CHARACTERISTIC
/begin CHARACTERISTIC K_ED_EC_BUSOFF.P_CODE_UNPLAUSIBEL "P-Code fuer die Art UNPLAUSIBEL | EN: Fault code EC_BUSOFF - OBD P-code reported for implausible signal" VALUE 0x7127E TKW_VV_VV_UW 100.0 FORMULA_0010 0.0 65535.0000 /end CHARACTERISTIC
/begin CHARACTERISTIC K_ED_ION_SIG_B1.P_CODE_UNPLAUSIBEL "P-Code fuer die Art UNPLAUSIBEL" VALUE 0x7139C TKW_VV_VV_UW 100.0 FORMULA_0010 0.0 65535.0000 /end CHARACTERISTIC
/begin CHARACTERISTIC K_ED_ION_SIG_B2.P_CODE_UNPLAUSIBEL "P-Code fuer die Art UNPLAUSIBEL" VALUE 0x713B6 TKW_VV_VV_UW 100.0 FORMULA_0010 0.0 65535.0000 /end CHARACTERISTIC
/begin CHARACTERISTIC K_ED_ION_SAT_B1.P_CODE_UNPLAUSIBEL "P-Code fuer die Art UNPLAUSIBEL" VALUE 0x714EE TKW_VV_VV_UW 100.0 FORMULA_0010 0.0 65535.0000 /end CHARACTERISTIC
/begin CHARACTERISTIC K_ED_ION_SAT_B2.P_CODE_UNPLAUSIBEL "P-Code fuer die Art UNPLAUSIBEL" VALUE 0x71508 TKW_VV_VV_UW 100.0 FORMULA_0010 0.0 65535.0000 /end CHARACTERISTIC
/begin CHARACTERISTIC K_ED_INDEX_88_IGN.P_CODE_UNPLAUSIBEL "P-Code fuer die Art UNPLAUSIBEL | EN: P-Code fuer die Art UNPLAUSIBEL" VALUE 0x71556 TKW_VV_VV_UW 100.0 FORMULA_0010 0.0 65535.0000 /end CHARACTERISTIC
/begin CHARACTERISTIC K_ED_INDEX_89_IGN.P_CODE_UNPLAUSIBEL "P-Code fuer die Art UNPLAUSIBEL" VALUE 0x71570 TKW_VV_VV_UW 100.0 FORMULA_0010 0.0 65535.0000 /end CHARACTERISTIC
/begin CHARACTERISTIC K_ED_SG_IGN.P_CODE_UNPLAUSIBEL "P-Code fuer die Art UNPLAUSIBEL | EN: Fault code SG_IGN - OBD P-code reported for implausible signal" VALUE 0x715BE TKW_VV_VV_UW 100.0 FORMULA_0010 0.0 65535.0000 /end CHARACTERISTIC
/begin CHARACTERISTIC K_ED_E2_IGN.P_CODE_UNPLAUSIBEL "P-Code fuer die Art UNPLAUSIBEL | EN: Fault code E2_IGN - OBD P-code reported for implausible signal" VALUE 0x715D8 TKW_VV_VV_UW 100.0 FORMULA_0010 0.0 65535.0000 /end CHARACTERISTIC
/begin CHARACTERISTIC K_ED_SK_MANAGER_IGN.P_CODE_UNPLAUSIBEL "P-Code fuer die Art UNPLAUSIBEL | EN: Fault code SK_MANAGER_IGN - OBD P-code reported for implausible signal" VALUE 0x7160C TKW_VV_VV_UW 100.0 FORMULA_0010 0.0 65535.0000 /end CHARACTERISTIC
/begin CHARACTERISTIC K_ED_LLR_DIAG.P_CODE_UNPLAUSIBEL "P-Code fuer die Art UNPLAUSIBEL | EN: Fault code LLR_DIAG - OBD P-code reported for implausible signal" VALUE 0x71626 TKW_VV_VV_UW 100.0 FORMULA_0010 0.0 65535.0000 /end CHARACTERISTIC
/begin CHARACTERISTIC K_ED_DK2_ZUST.P_CODE_UNPLAUSIBEL "P-Code fuer die Art UNPLAUSIBEL | EN: Fault code DK2_ZUST - OBD P-code reported for implausible signal" VALUE 0x7168E TKW_VV_VV_UW 100.0 FORMULA_0010 0.0 65535.0000 /end CHARACTERISTIC
/begin CHARACTERISTIC K_ED_FGR_ABWURF.P_CODE_UNPLAUSIBEL "P-Code fuer die Art UNPLAUSIBEL | EN: Fault code FGR_ABWURF - OBD P-code reported for implausible signal" VALUE 0x716A8 TKW_VV_VV_UW 100.0 FORMULA_0010 0.0 65535.0000 /end CHARACTERISTIC
/begin CHARACTERISTIC K_ED_PWG_BLS.P_CODE_UNPLAUSIBEL "P-Code fuer die Art UNPLAUSIBEL | EN: Fault code PWG_BLS - OBD P-code reported for implausible signal" VALUE 0x716C2 TKW_VV_VV_UW 100.0 FORMULA_0010 0.0 65535.0000 /end CHARACTERISTIC
/begin CHARACTERISTIC K_ED_N_GETR_EIN_HS.P_CODE_UNPLAUSIBEL "P-Code fuer die Art UNPLAUSIBEL | EN: Fault code N_GETR_EIN_HS - OBD P-code reported for implausible signal" VALUE 0x71710 TKW_VV_VV_UW 100.0 FORMULA_0010 0.0 65535.0000 /end CHARACTERISTIC
/begin CHARACTERISTIC K_ED_LLR_DIAG_CSS.P_CODE_UNPLAUSIBEL "P-Code fuer die Art UNPLAUSIBEL | EN: Fault code LLR_DIAG_CSS - OBD P-code reported for implausible signal" VALUE 0x71744 TKW_VV_VV_UW 100.0 FORMULA_0010 0.0 65535.0000 /end CHARACTERISTIC
/begin CHARACTERISTIC K_ED_INDEX_110_IGN.P_CODE_UNPLAUSIBEL "P-Code fuer die Art UNPLAUSIBEL" VALUE 0x71792 TKW_VV_VV_UW 100.0 FORMULA_0010 0.0 65535.0000 /end CHARACTERISTIC
/begin CHARACTERISTIC K_ED_INDEX_111_IGN.P_CODE_UNPLAUSIBEL "P-Code fuer die Art UNPLAUSIBEL" VALUE 0x717AC TKW_VV_VV_UW 100.0 FORMULA_0010 0.0 65535.0000 /end CHARACTERISTIC
/begin CHARACTERISTIC K_ED_INDEX_112_IGN.P_CODE_UNPLAUSIBEL "P-Code fuer die Art UNPLAUSIBEL" VALUE 0x717C6 TKW_VV_VV_UW 100.0 FORMULA_0010 0.0 65535.0000 /end CHARACTERISTIC
/begin CHARACTERISTIC K_ED_INDEX_113_IGN.P_CODE_UNPLAUSIBEL "P-Code fuer die Art UNPLAUSIBEL" VALUE 0x717E0 TKW_VV_VV_UW 100.0 FORMULA_0010 0.0 65535.0000 /end CHARACTERISTIC
/begin CHARACTERISTIC K_ED_INDEX_114_IGN.P_CODE_UNPLAUSIBEL "P-Code fuer die Art UNPLAUSIBEL" VALUE 0x717FA TKW_VV_VV_UW 100.0 FORMULA_0010 0.0 65535.0000 /end CHARACTERISTIC
/begin CHARACTERISTIC K_ED_INDEX_115_IGN.P_CODE_UNPLAUSIBEL "P-Code fuer die Art UNPLAUSIBEL" VALUE 0x71814 TKW_VV_VV_UW 100.0 FORMULA_0010 0.0 65535.0000 /end CHARACTERISTIC
/begin CHARACTERISTIC K_ED_INDEX_116_IGN.P_CODE_UNPLAUSIBEL "P-Code fuer die Art UNPLAUSIBEL" VALUE 0x7182E TKW_VV_VV_UW 100.0 FORMULA_0010 0.0 65535.0000 /end CHARACTERISTIC
/begin CHARACTERISTIC K_ED_INDEX_117_IGN.P_CODE_UNPLAUSIBEL "P-Code fuer die Art UNPLAUSIBEL" VALUE 0x71848 TKW_VV_VV_UW 100.0 FORMULA_0010 0.0 65535.0000 /end CHARACTERISTIC
/begin CHARACTERISTIC K_ED_INDEX_118_IGN.P_CODE_UNPLAUSIBEL "P-Code fuer die Art UNPLAUSIBEL" VALUE 0x71862 TKW_VV_VV_UW 100.0 FORMULA_0010 0.0 65535.0000 /end CHARACTERISTIC
/begin CHARACTERISTIC K_ED_INDEX_119_IGN.P_CODE_UNPLAUSIBEL "P-Code fuer die Art UNPLAUSIBEL" VALUE 0x7187C TKW_VV_VV_UW 100.0 FORMULA_0010 0.0 65535.0000 /end CHARACTERISTIC
/begin CHARACTERISTIC K_ED_INDEX_120_IGN.P_CODE_UNPLAUSIBEL "P-Code fuer die Art UNPLAUSIBEL" VALUE 0x71896 TKW_VV_VV_UW 100.0 FORMULA_0010 0.0 65535.0000 /end CHARACTERISTIC
/begin CHARACTERISTIC K_ED_INDEX_121_IGN.P_CODE_UNPLAUSIBEL "P-Code fuer die Art UNPLAUSIBEL | EN: Fault code INDEX_121_IGN - OBD P-code reported for implausible signal" VALUE 0x718B0 TKW_VV_VV_UW 100.0 FORMULA_0010 0.0 65535.0000 /end CHARACTERISTIC
/begin CHARACTERISTIC K_ED_INDEX_122_IGN.P_CODE_UNPLAUSIBEL "P-Code fuer die Art UNPLAUSIBEL | EN: Fault code INDEX_122_IGN - OBD P-code reported for implausible signal" VALUE 0x718CA TKW_VV_VV_UW 100.0 FORMULA_0010 0.0 65535.0000 /end CHARACTERISTIC
/begin CHARACTERISTIC K_ED_INDEX_123_IGN.P_CODE_UNPLAUSIBEL "P-Code fuer die Art UNPLAUSIBEL | EN: Fault code INDEX_123_IGN - OBD P-code reported for implausible signal" VALUE 0x718E4 TKW_VV_VV_UW 100.0 FORMULA_0010 0.0 65535.0000 /end CHARACTERISTIC
/begin CHARACTERISTIC K_ED_INDEX_124_IGN.P_CODE_UNPLAUSIBEL "P-Code fuer die Art UNPLAUSIBEL | EN: Fault code INDEX_124_IGN - OBD P-code reported for implausible signal" VALUE 0x718FE TKW_VV_VV_UW 100.0 FORMULA_0010 0.0 65535.0000 /end CHARACTERISTIC
/begin CHARACTERISTIC K_ED_INDEX_125_IGN.P_CODE_UNPLAUSIBEL "P-Code fuer die Art UNPLAUSIBEL | EN: Fault code INDEX_125_IGN - OBD P-code reported for implausible signal" VALUE 0x71918 TKW_VV_VV_UW 100.0 FORMULA_0010 0.0 65535.0000 /end CHARACTERISTIC
/begin CHARACTERISTIC K_ED_INDEX_126_IGN.P_CODE_UNPLAUSIBEL "P-Code fuer die Art UNPLAUSIBEL | EN: Fault code INDEX_126_IGN - OBD P-code reported for implausible signal" VALUE 0x71932 TKW_VV_VV_UW 100.0 FORMULA_0010 0.0 65535.0000 /end CHARACTERISTIC
/begin CHARACTERISTIC K_ED_INDEX_127_IGN.P_CODE_UNPLAUSIBEL "P-Code fuer die Art UNPLAUSIBEL | EN: Fault code INDEX_127_IGN - OBD P-code reported for implausible signal" VALUE 0x7194C TKW_VV_VV_UW 100.0 FORMULA_0010 0.0 65535.0000 /end CHARACTERISTIC
/begin CHARACTERISTIC K_ED_SK_TR_IGN.FEHLERSCHWELLE "Filterschwelle fuer Fehlereintrag | EN: Filterschwelle fuer Fehlereintrag" VALUE 0x70C68 TKW_VV_VV_UB 100.0 FORMULA_0003 0.0 255.0000 /end CHARACTERISTIC
/begin CHARACTERISTIC K_ED_PWG1.FEHLERSCHWELLE "Filterschwelle fuer Fehlereintrag | EN: Fault code PWG1 - debounce filter threshold for setting the fault" VALUE 0x70DBA TKW_VV_VV_UB 100.0 FORMULA_0003 0.0 255.0000 /end CHARACTERISTIC
/begin CHARACTERISTIC K_ED_PWG2.FEHLERSCHWELLE "Filterschwelle fuer Fehlereintrag | EN: Fault code PWG2 - debounce filter threshold for setting the fault" VALUE 0x70DD4 TKW_VV_VV_UB 100.0 FORMULA_0003 0.0 255.0000 /end CHARACTERISTIC
/begin CHARACTERISTIC K_ED_PWG_VGL.FEHLERSCHWELLE "Filterschwelle fuer Fehlereintrag | EN: Fault code PWG_VGL - debounce filter threshold for setting the fault" VALUE 0x70DEE TKW_VV_VV_UB 100.0 FORMULA_0003 0.0 255.0000 /end CHARACTERISTIC
/begin CHARACTERISTIC K_ED_PCTRL_IGN.FEHLERSCHWELLE "Filterschwelle fuer Fehlereintrag | EN: Fault code PCTRL_IGN - debounce filter threshold for setting the fault" VALUE 0x70E08 TKW_VV_VV_UB 100.0 FORMULA_0003 0.0 255.0000 /end CHARACTERISTIC
/begin CHARACTERISTIC K_ED_LLS1_CAN.FEHLERSCHWELLE "Filterschwelle fuer Fehlereintrag | EN: Fault code LLS1_CAN - debounce filter threshold for setting the fault" VALUE 0x70E22 TKW_VV_VV_UB 100.0 FORMULA_0003 0.0 255.0000 /end CHARACTERISTIC
/begin CHARACTERISTIC K_ED_LLS2_CAN.FEHLERSCHWELLE "Filterschwelle fuer Fehlereintrag | EN: Fault code LLS2_CAN - debounce filter threshold for setting the fault" VALUE 0x70E3C TKW_VV_VV_UB 100.0 FORMULA_0003 0.0 255.0000 /end CHARACTERISTIC
/begin CHARACTERISTIC K_ED_LLS1_SK.FEHLERSCHWELLE "Filterschwelle fuer Fehlereintrag | EN: Fault code LLS1_SK - debounce filter threshold for setting the fault" VALUE 0x70E8A TKW_VV_VV_UB 100.0 FORMULA_0003 0.0 255.0000 /end CHARACTERISTIC
/begin CHARACTERISTIC K_ED_LLS2_SK.FEHLERSCHWELLE "Filterschwelle fuer Fehlereintrag | EN: Fault code LLS2_SK - debounce filter threshold for setting the fault" VALUE 0x70EA4 TKW_VV_VV_UB 100.0 FORMULA_0003 0.0 255.0000 /end CHARACTERISTIC
/begin CHARACTERISTIC K_ED_SMG_SCHALTAB.FEHLERSCHWELLE "Filterschwelle fuer Fehlereintrag | EN: Fault code SMG_SCHALTAB - debounce filter threshold for setting the fault" VALUE 0x70EBE TKW_VV_VV_UB 100.0 FORMULA_0003 0.0 255.0000 /end CHARACTERISTIC
/begin CHARACTERISTIC K_ED_DK_INIT.FEHLERSCHWELLE "Filterschwelle fuer Fehlereintrag | EN: Fault code DK_INIT - debounce filter threshold for setting the fault" VALUE 0x70F40 TKW_VV_VV_UB 100.0 FORMULA_0003 0.0 255.0000 /end CHARACTERISTIC
/begin CHARACTERISTIC K_ED_IONVERST_B1.FEHLERSCHWELLE "Filterschwelle fuer Fehlereintrag" VALUE 0x70FC2 TKW_VV_VV_UB 100.0 FORMULA_0003 0.0 255.0000 /end CHARACTERISTIC
/begin CHARACTERISTIC K_ED_IONSPG_B1.FEHLERSCHWELLE "Filterschwelle fuer Fehlereintrag" VALUE 0x70FDC TKW_VV_VV_UB 100.0 FORMULA_0003 0.0 255.0000 /end CHARACTERISTIC
/begin CHARACTERISTIC K_ED_IONVERST_B2.FEHLERSCHWELLE "Filterschwelle fuer Fehlereintrag" VALUE 0x70FF6 TKW_VV_VV_UB 100.0 FORMULA_0003 0.0 255.0000 /end CHARACTERISTIC
/begin CHARACTERISTIC K_ED_IONSPG_B2.FEHLERSCHWELLE "Filterschwelle fuer Fehlereintrag" VALUE 0x71010 TKW_VV_VV_UB 100.0 FORMULA_0003 0.0 255.0000 /end CHARACTERISTIC
/begin CHARACTERISTIC K_ED_DK2_WDK.FEHLERSCHWELLE "Filterschwelle fuer Fehlereintrag | EN: Fault code DK2_WDK - debounce filter threshold for setting the fault" VALUE 0x71078 TKW_VV_VV_UB 100.0 FORMULA_0003 0.0 255.0000 /end CHARACTERISTIC
/begin CHARACTERISTIC K_ED_LLS1_REGLER.FEHLERSCHWELLE "Filterschwelle fuer Fehlereintrag | EN: Fault code LLS1_REGLER - debounce filter threshold for setting the fault" VALUE 0x710C6 TKW_VV_VV_UB 100.0 FORMULA_0003 0.0 255.0000 /end CHARACTERISTIC
/begin CHARACTERISTIC K_ED_LLS2_REGLER.FEHLERSCHWELLE "Filterschwelle fuer Fehlereintrag | EN: Fault code LLS2_REGLER - debounce filter threshold for setting the fault" VALUE 0x710E0 TKW_VV_VV_UB 100.0 FORMULA_0003 0.0 255.0000 /end CHARACTERISTIC
/begin CHARACTERISTIC K_ED_DK2_SK_ERR.FEHLERSCHWELLE "Filterschwelle fuer Fehlereintrag | EN: Fault code DK2_SK_ERR - debounce filter threshold for setting the fault" VALUE 0x71114 TKW_VV_VV_UB 100.0 FORMULA_0003 0.0 255.0000 /end CHARACTERISTIC
/begin CHARACTERISTIC K_ED_MD_SK_ERR.FEHLERSCHWELLE "Filterschwelle fuer Fehlereintrag | EN: Fault code MD_SK_ERR - debounce filter threshold for setting the fault" VALUE 0x71162 TKW_VV_VV_UB 100.0 FORMULA_0003 0.0 255.0000 /end CHARACTERISTIC
/begin CHARACTERISTIC K_ED_LLS_INIT.FEHLERSCHWELLE "Filterschwelle fuer Fehlereintrag | EN: Fault code LLS_INIT - debounce filter threshold for setting the fault" VALUE 0x7117C TKW_VV_VV_UB 100.0 FORMULA_0003 0.0 255.0000 /end CHARACTERISTIC
/begin CHARACTERISTIC K_ED_DSC_EINGR.FEHLERSCHWELLE "Filterschwelle fuer Fehlereintrag | EN: Fault code DSC_EINGR - debounce filter threshold for setting the fault" VALUE 0x71196 TKW_VV_VV_UB 100.0 FORMULA_0003 0.0 255.0000 /end CHARACTERISTIC
/begin CHARACTERISTIC K_ED_LLS1_CMD.FEHLERSCHWELLE "Filterschwelle fuer Fehlereintrag | EN: Fault code LLS1_CMD - debounce filter threshold for setting the fault" VALUE 0x711E4 TKW_VV_VV_UB 100.0 FORMULA_0003 0.0 255.0000 /end CHARACTERISTIC
/begin CHARACTERISTIC K_ED_LLS2_CMD.FEHLERSCHWELLE "Filterschwelle fuer Fehlereintrag | EN: Fault code LLS2_CMD - debounce filter threshold for setting the fault" VALUE 0x711FE TKW_VV_VV_UB 100.0 FORMULA_0003 0.0 255.0000 /end CHARACTERISTIC
/begin CHARACTERISTIC K_ED_SC_SMG1.FEHLERSCHWELLE "Filterschwelle fuer Fehlereintrag | EN: Fault code SC_SMG1 - debounce filter threshold for setting the fault" VALUE 0x71218 TKW_VV_VV_UB 100.0 FORMULA_0003 0.0 255.0000 /end CHARACTERISTIC
/begin CHARACTERISTIC K_ED_SC_SMG2.FEHLERSCHWELLE "Filterschwelle fuer Fehlereintrag | EN: Fault code SC_SMG2 - debounce filter threshold for setting the fault" VALUE 0x71232 TKW_VV_VV_UB 100.0 FORMULA_0003 0.0 255.0000 /end CHARACTERISTIC
/begin CHARACTERISTIC K_ED_SC_SMG3.FEHLERSCHWELLE "Filterschwelle fuer Fehlereintrag | EN: Fault code SC_SMG3 - debounce filter threshold for setting the fault" VALUE 0x7124C TKW_VV_VV_UB 100.0 FORMULA_0003 0.0 255.0000 /end CHARACTERISTIC
/begin CHARACTERISTIC K_ED_SC_BUSOFF.FEHLERSCHWELLE "Filterschwelle fuer Fehlereintrag | EN: Fault code SC_BUSOFF - debounce filter threshold for setting the fault" VALUE 0x71266 TKW_VV_VV_UB 100.0 FORMULA_0003 0.0 255.0000 /end CHARACTERISTIC
/begin CHARACTERISTIC K_ED_EC_BUSOFF.FEHLERSCHWELLE "Filterschwelle fuer Fehlereintrag | EN: Fault code EC_BUSOFF - debounce filter threshold for setting the fault" VALUE 0x71280 TKW_VV_VV_UB 100.0 FORMULA_0003 0.0 255.0000 /end CHARACTERISTIC
/begin CHARACTERISTIC K_ED_ION_SIG_B1.FEHLERSCHWELLE "Filterschwelle fuer Fehlereintrag" VALUE 0x7139E TKW_VV_VV_UB 100.0 FORMULA_0003 0.0 255.0000 /end CHARACTERISTIC
/begin CHARACTERISTIC K_ED_ION_SIG_B2.FEHLERSCHWELLE "Filterschwelle fuer Fehlereintrag" VALUE 0x713B8 TKW_VV_VV_UB 100.0 FORMULA_0003 0.0 255.0000 /end CHARACTERISTIC
/begin CHARACTERISTIC K_ED_ION_SAT_B1.FEHLERSCHWELLE "Filterschwelle fuer Fehlereintrag" VALUE 0x714F0 TKW_VV_VV_UB 100.0 FORMULA_0003 0.0 255.0000 /end CHARACTERISTIC
/begin CHARACTERISTIC K_ED_ION_SAT_B2.FEHLERSCHWELLE "Filterschwelle fuer Fehlereintrag" VALUE 0x7150A TKW_VV_VV_UB 100.0 FORMULA_0003 0.0 255.0000 /end CHARACTERISTIC
/begin CHARACTERISTIC K_ED_INDEX_88_IGN.FEHLERSCHWELLE "Filterschwelle fuer Fehlereintrag | EN: Filterschwelle fuer Fehlereintrag" VALUE 0x71558 TKW_VV_VV_UB 100.0 FORMULA_0003 0.0 255.0000 /end CHARACTERISTIC
/begin CHARACTERISTIC K_ED_INDEX_89_IGN.FEHLERSCHWELLE "Filterschwelle fuer Fehlereintrag" VALUE 0x71572 TKW_VV_VV_UB 100.0 FORMULA_0003 0.0 255.0000 /end CHARACTERISTIC
/begin CHARACTERISTIC K_ED_SG_IGN.FEHLERSCHWELLE "Filterschwelle fuer Fehlereintrag | EN: Fault code SG_IGN - debounce filter threshold for setting the fault" VALUE 0x715C0 TKW_VV_VV_UB 100.0 FORMULA_0003 0.0 255.0000 /end CHARACTERISTIC
/begin CHARACTERISTIC K_ED_E2_IGN.FEHLERSCHWELLE "Filterschwelle fuer Fehlereintrag | EN: Fault code E2_IGN - debounce filter threshold for setting the fault" VALUE 0x715DA TKW_VV_VV_UB 100.0 FORMULA_0003 0.0 255.0000 /end CHARACTERISTIC
/begin CHARACTERISTIC K_ED_SK_MANAGER_IGN.FEHLERSCHWELLE "Filterschwelle fuer Fehlereintrag | EN: Fault code SK_MANAGER_IGN - debounce filter threshold for setting the fault" VALUE 0x7160E TKW_VV_VV_UB 100.0 FORMULA_0003 0.0 255.0000 /end CHARACTERISTIC
/begin CHARACTERISTIC K_ED_LLR_DIAG.FEHLERSCHWELLE "Filterschwelle fuer Fehlereintrag | EN: Fault code LLR_DIAG - debounce filter threshold for setting the fault" VALUE 0x71628 TKW_VV_VV_UB 100.0 FORMULA_0003 0.0 255.0000 /end CHARACTERISTIC
/begin CHARACTERISTIC K_ED_DK2_ZUST.FEHLERSCHWELLE "Filterschwelle fuer Fehlereintrag | EN: Fault code DK2_ZUST - debounce filter threshold for setting the fault" VALUE 0x71690 TKW_VV_VV_UB 100.0 FORMULA_0003 0.0 255.0000 /end CHARACTERISTIC
/begin CHARACTERISTIC K_ED_FGR_ABWURF.FEHLERSCHWELLE "Filterschwelle fuer Fehlereintrag | EN: Fault code FGR_ABWURF - debounce filter threshold for setting the fault" VALUE 0x716AA TKW_VV_VV_UB 100.0 FORMULA_0003 0.0 255.0000 /end CHARACTERISTIC
/begin CHARACTERISTIC K_ED_PWG_BLS.FEHLERSCHWELLE "Filterschwelle fuer Fehlereintrag | EN: Fault code PWG_BLS - debounce filter threshold for setting the fault" VALUE 0x716C4 TKW_VV_VV_UB 100.0 FORMULA_0003 0.0 255.0000 /end CHARACTERISTIC
/begin CHARACTERISTIC K_ED_N_GETR_EIN_HS.FEHLERSCHWELLE "Filterschwelle fuer Fehlereintrag | EN: Fault code N_GETR_EIN_HS - debounce filter threshold for setting the fault" VALUE 0x71712 TKW_VV_VV_UB 100.0 FORMULA_0003 0.0 255.0000 /end CHARACTERISTIC
/begin CHARACTERISTIC K_ED_LLR_DIAG_CSS.FEHLERSCHWELLE "Filterschwelle fuer Fehlereintrag | EN: Fault code LLR_DIAG_CSS - debounce filter threshold for setting the fault" VALUE 0x71746 TKW_VV_VV_UB 100.0 FORMULA_0003 0.0 255.0000 /end CHARACTERISTIC
/begin CHARACTERISTIC K_ED_INDEX_110_IGN.FEHLERSCHWELLE "Filterschwelle fuer Fehlereintrag" VALUE 0x71794 TKW_VV_VV_UB 100.0 FORMULA_0003 0.0 255.0000 /end CHARACTERISTIC
/begin CHARACTERISTIC K_ED_INDEX_111_IGN.FEHLERSCHWELLE "Filterschwelle fuer Fehlereintrag" VALUE 0x717AE TKW_VV_VV_UB 100.0 FORMULA_0003 0.0 255.0000 /end CHARACTERISTIC
/begin CHARACTERISTIC K_ED_INDEX_112_IGN.FEHLERSCHWELLE "Filterschwelle fuer Fehlereintrag" VALUE 0x717C8 TKW_VV_VV_UB 100.0 FORMULA_0003 0.0 255.0000 /end CHARACTERISTIC
/begin CHARACTERISTIC K_ED_INDEX_113_IGN.FEHLERSCHWELLE "Filterschwelle fuer Fehlereintrag" VALUE 0x717E2 TKW_VV_VV_UB 100.0 FORMULA_0003 0.0 255.0000 /end CHARACTERISTIC
/begin CHARACTERISTIC K_ED_INDEX_114_IGN.FEHLERSCHWELLE "Filterschwelle fuer Fehlereintrag" VALUE 0x717FC TKW_VV_VV_UB 100.0 FORMULA_0003 0.0 255.0000 /end CHARACTERISTIC
/begin CHARACTERISTIC K_ED_INDEX_115_IGN.FEHLERSCHWELLE "Filterschwelle fuer Fehlereintrag" VALUE 0x71816 TKW_VV_VV_UB 100.0 FORMULA_0003 0.0 255.0000 /end CHARACTERISTIC
/begin CHARACTERISTIC K_ED_INDEX_116_IGN.FEHLERSCHWELLE "Filterschwelle fuer Fehlereintrag" VALUE 0x71830 TKW_VV_VV_UB 100.0 FORMULA_0003 0.0 255.0000 /end CHARACTERISTIC
/begin CHARACTERISTIC K_ED_INDEX_117_IGN.FEHLERSCHWELLE "Filterschwelle fuer Fehlereintrag" VALUE 0x7184A TKW_VV_VV_UB 100.0 FORMULA_0003 0.0 255.0000 /end CHARACTERISTIC
/begin CHARACTERISTIC K_ED_INDEX_118_IGN.FEHLERSCHWELLE "Filterschwelle fuer Fehlereintrag" VALUE 0x71864 TKW_VV_VV_UB 100.0 FORMULA_0003 0.0 255.0000 /end CHARACTERISTIC
/begin CHARACTERISTIC K_ED_INDEX_119_IGN.FEHLERSCHWELLE "Filterschwelle fuer Fehlereintrag" VALUE 0x7187E TKW_VV_VV_UB 100.0 FORMULA_0003 0.0 255.0000 /end CHARACTERISTIC
/begin CHARACTERISTIC K_ED_INDEX_120_IGN.FEHLERSCHWELLE "Filterschwelle fuer Fehlereintrag" VALUE 0x71898 TKW_VV_VV_UB 100.0 FORMULA_0003 0.0 255.0000 /end CHARACTERISTIC
/begin CHARACTERISTIC K_ED_INDEX_121_IGN.FEHLERSCHWELLE "Filterschwelle fuer Fehlereintrag | EN: Fault code INDEX_121_IGN - debounce filter threshold for setting the fault" VALUE 0x718B2 TKW_VV_VV_UB 100.0 FORMULA_0003 0.0 255.0000 /end CHARACTERISTIC
/begin CHARACTERISTIC K_ED_INDEX_122_IGN.FEHLERSCHWELLE "Filterschwelle fuer Fehlereintrag | EN: Fault code INDEX_122_IGN - debounce filter threshold for setting the fault" VALUE 0x718CC TKW_VV_VV_UB 100.0 FORMULA_0003 0.0 255.0000 /end CHARACTERISTIC
/begin CHARACTERISTIC K_ED_INDEX_123_IGN.FEHLERSCHWELLE "Filterschwelle fuer Fehlereintrag | EN: Fault code INDEX_123_IGN - debounce filter threshold for setting the fault" VALUE 0x718E6 TKW_VV_VV_UB 100.0 FORMULA_0003 0.0 255.0000 /end CHARACTERISTIC
/begin CHARACTERISTIC K_ED_INDEX_124_IGN.FEHLERSCHWELLE "Filterschwelle fuer Fehlereintrag | EN: Fault code INDEX_124_IGN - debounce filter threshold for setting the fault" VALUE 0x71900 TKW_VV_VV_UB 100.0 FORMULA_0003 0.0 255.0000 /end CHARACTERISTIC
/begin CHARACTERISTIC K_ED_INDEX_125_IGN.FEHLERSCHWELLE "Filterschwelle fuer Fehlereintrag | EN: Fault code INDEX_125_IGN - debounce filter threshold for setting the fault" VALUE 0x7191A TKW_VV_VV_UB 100.0 FORMULA_0003 0.0 255.0000 /end CHARACTERISTIC
/begin CHARACTERISTIC K_ED_INDEX_126_IGN.FEHLERSCHWELLE "Filterschwelle fuer Fehlereintrag | EN: Fault code INDEX_126_IGN - debounce filter threshold for setting the fault" VALUE 0x71934 TKW_VV_VV_UB 100.0 FORMULA_0003 0.0 255.0000 /end CHARACTERISTIC
/begin CHARACTERISTIC K_ED_INDEX_127_IGN.FEHLERSCHWELLE "Filterschwelle fuer Fehlereintrag | EN: Fault code INDEX_127_IGN - debounce filter threshold for setting the fault" VALUE 0x7194E TKW_VV_VV_UB 100.0 FORMULA_0003 0.0 255.0000 /end CHARACTERISTIC
/begin CHARACTERISTIC K_ED_SK_TR_IGN.OK_SCHWELLE "Filterschwelle fuer Fehleraustrag | EN: Filterschwelle fuer Fehleraustrag" VALUE 0x70C69 TKW_VV_VV_UB 100.0 FORMULA_0003 0.0 255.0000 /end CHARACTERISTIC
/begin CHARACTERISTIC K_ED_PWG1.OK_SCHWELLE "Filterschwelle fuer Fehleraustrag | EN: Fault code PWG1 - debounce filter threshold for clearing (healing) the fault" VALUE 0x70DBB TKW_VV_VV_UB 100.0 FORMULA_0003 0.0 255.0000 /end CHARACTERISTIC
/begin CHARACTERISTIC K_ED_PWG2.OK_SCHWELLE "Filterschwelle fuer Fehleraustrag | EN: Fault code PWG2 - debounce filter threshold for clearing (healing) the fault" VALUE 0x70DD5 TKW_VV_VV_UB 100.0 FORMULA_0003 0.0 255.0000 /end CHARACTERISTIC
/begin CHARACTERISTIC K_ED_PWG_VGL.OK_SCHWELLE "Filterschwelle fuer Fehleraustrag | EN: Fault code PWG_VGL - debounce filter threshold for clearing (healing) the fault" VALUE 0x70DEF TKW_VV_VV_UB 100.0 FORMULA_0003 0.0 255.0000 /end CHARACTERISTIC
/begin CHARACTERISTIC K_ED_PCTRL_IGN.OK_SCHWELLE "Filterschwelle fuer Fehleraustrag | EN: Fault code PCTRL_IGN - debounce filter threshold for clearing (healing) the fault" VALUE 0x70E09 TKW_VV_VV_UB 100.0 FORMULA_0003 0.0 255.0000 /end CHARACTERISTIC
/begin CHARACTERISTIC K_ED_LLS1_CAN.OK_SCHWELLE "Filterschwelle fuer Fehleraustrag | EN: Fault code LLS1_CAN - debounce filter threshold for clearing (healing) the fault" VALUE 0x70E23 TKW_VV_VV_UB 100.0 FORMULA_0003 0.0 255.0000 /end CHARACTERISTIC
/begin CHARACTERISTIC K_ED_LLS2_CAN.OK_SCHWELLE "Filterschwelle fuer Fehleraustrag | EN: Fault code LLS2_CAN - debounce filter threshold for clearing (healing) the fault" VALUE 0x70E3D TKW_VV_VV_UB 100.0 FORMULA_0003 0.0 255.0000 /end CHARACTERISTIC
/begin CHARACTERISTIC K_ED_LLS1_SK.OK_SCHWELLE "Filterschwelle fuer Fehleraustrag | EN: Fault code LLS1_SK - debounce filter threshold for clearing (healing) the fault" VALUE 0x70E8B TKW_VV_VV_UB 100.0 FORMULA_0003 0.0 255.0000 /end CHARACTERISTIC
/begin CHARACTERISTIC K_ED_LLS2_SK.OK_SCHWELLE "Filterschwelle fuer Fehleraustrag | EN: Fault code LLS2_SK - debounce filter threshold for clearing (healing) the fault" VALUE 0x70EA5 TKW_VV_VV_UB 100.0 FORMULA_0003 0.0 255.0000 /end CHARACTERISTIC
/begin CHARACTERISTIC K_ED_SMG_SCHALTAB.OK_SCHWELLE "Filterschwelle fuer Fehleraustrag | EN: Fault code SMG_SCHALTAB - debounce filter threshold for clearing (healing) the fault" VALUE 0x70EBF TKW_VV_VV_UB 100.0 FORMULA_0003 0.0 255.0000 /end CHARACTERISTIC
/begin CHARACTERISTIC K_ED_DK_INIT.OK_SCHWELLE "Filterschwelle fuer Fehleraustrag | EN: Fault code DK_INIT - debounce filter threshold for clearing (healing) the fault" VALUE 0x70F41 TKW_VV_VV_UB 100.0 FORMULA_0003 0.0 255.0000 /end CHARACTERISTIC
/begin CHARACTERISTIC K_ED_DK2_REGLER.OK_SCHWELLE "Filterschwelle fuer Fehleraustrag | EN: Fault code DK2_REGLER - debounce filter threshold for clearing (healing) the fault" VALUE 0x70F75 TKW_VV_VV_UB 100.0 FORMULA_0003 0.0 255.0000 /end CHARACTERISTIC
/begin CHARACTERISTIC K_ED_IONVERST_B1.OK_SCHWELLE "Filterschwelle fuer Fehleraustrag" VALUE 0x70FC3 TKW_VV_VV_UB 100.0 FORMULA_0003 0.0 255.0000 /end CHARACTERISTIC
/begin CHARACTERISTIC K_ED_IONSPG_B1.OK_SCHWELLE "Filterschwelle fuer Fehleraustrag" VALUE 0x70FDD TKW_VV_VV_UB 100.0 FORMULA_0003 0.0 255.0000 /end CHARACTERISTIC
/begin CHARACTERISTIC K_ED_IONVERST_B2.OK_SCHWELLE "Filterschwelle fuer Fehleraustrag" VALUE 0x70FF7 TKW_VV_VV_UB 100.0 FORMULA_0003 0.0 255.0000 /end CHARACTERISTIC
/begin CHARACTERISTIC K_ED_IONSPG_B2.OK_SCHWELLE "Filterschwelle fuer Fehleraustrag" VALUE 0x71011 TKW_VV_VV_UB 100.0 FORMULA_0003 0.0 255.0000 /end CHARACTERISTIC
/begin CHARACTERISTIC K_ED_DK2_WDK.OK_SCHWELLE "Filterschwelle fuer Fehleraustrag | EN: Fault code DK2_WDK - debounce filter threshold for clearing (healing) the fault" VALUE 0x71079 TKW_VV_VV_UB 100.0 FORMULA_0003 0.0 255.0000 /end CHARACTERISTIC
/begin CHARACTERISTIC K_ED_LLS1_REGLER.OK_SCHWELLE "Filterschwelle fuer Fehleraustrag | EN: Fault code LLS1_REGLER - debounce filter threshold for clearing (healing) the fault" VALUE 0x710C7 TKW_VV_VV_UB 100.0 FORMULA_0003 0.0 255.0000 /end CHARACTERISTIC
/begin CHARACTERISTIC K_ED_LLS2_REGLER.OK_SCHWELLE "Filterschwelle fuer Fehleraustrag | EN: Fault code LLS2_REGLER - debounce filter threshold for clearing (healing) the fault" VALUE 0x710E1 TKW_VV_VV_UB 100.0 FORMULA_0003 0.0 255.0000 /end CHARACTERISTIC
/begin CHARACTERISTIC K_ED_DK2_SK_ERR.OK_SCHWELLE "Filterschwelle fuer Fehleraustrag | EN: Fault code DK2_SK_ERR - debounce filter threshold for clearing (healing) the fault" VALUE 0x71115 TKW_VV_VV_UB 100.0 FORMULA_0003 0.0 255.0000 /end CHARACTERISTIC
/begin CHARACTERISTIC K_ED_MD_SK_ERR.OK_SCHWELLE "Filterschwelle fuer Fehleraustrag | EN: Fault code MD_SK_ERR - debounce filter threshold for clearing (healing) the fault" VALUE 0x71163 TKW_VV_VV_UB 100.0 FORMULA_0003 0.0 255.0000 /end CHARACTERISTIC
/begin CHARACTERISTIC K_ED_LLS_INIT.OK_SCHWELLE "Filterschwelle fuer Fehleraustrag | EN: Fault code LLS_INIT - debounce filter threshold for clearing (healing) the fault" VALUE 0x7117D TKW_VV_VV_UB 100.0 FORMULA_0003 0.0 255.0000 /end CHARACTERISTIC
/begin CHARACTERISTIC K_ED_DSC_EINGR.OK_SCHWELLE "Filterschwelle fuer Fehleraustrag | EN: Fault code DSC_EINGR - debounce filter threshold for clearing (healing) the fault" VALUE 0x71197 TKW_VV_VV_UB 100.0 FORMULA_0003 0.0 255.0000 /end CHARACTERISTIC
/begin CHARACTERISTIC K_ED_LLS1_CMD.OK_SCHWELLE "Filterschwelle fuer Fehleraustrag | EN: Fault code LLS1_CMD - debounce filter threshold for clearing (healing) the fault" VALUE 0x711E5 TKW_VV_VV_UB 100.0 FORMULA_0003 0.0 255.0000 /end CHARACTERISTIC
/begin CHARACTERISTIC K_ED_LLS2_CMD.OK_SCHWELLE "Filterschwelle fuer Fehleraustrag | EN: Fault code LLS2_CMD - debounce filter threshold for clearing (healing) the fault" VALUE 0x711FF TKW_VV_VV_UB 100.0 FORMULA_0003 0.0 255.0000 /end CHARACTERISTIC
/begin CHARACTERISTIC K_ED_SC_SMG1.OK_SCHWELLE "Filterschwelle fuer Fehleraustrag | EN: Fault code SC_SMG1 - debounce filter threshold for clearing (healing) the fault" VALUE 0x71219 TKW_VV_VV_UB 100.0 FORMULA_0003 0.0 255.0000 /end CHARACTERISTIC
/begin CHARACTERISTIC K_ED_SC_SMG2.OK_SCHWELLE "Filterschwelle fuer Fehleraustrag | EN: Fault code SC_SMG2 - debounce filter threshold for clearing (healing) the fault" VALUE 0x71233 TKW_VV_VV_UB 100.0 FORMULA_0003 0.0 255.0000 /end CHARACTERISTIC
/begin CHARACTERISTIC K_ED_SC_SMG3.OK_SCHWELLE "Filterschwelle fuer Fehleraustrag | EN: Fault code SC_SMG3 - debounce filter threshold for clearing (healing) the fault" VALUE 0x7124D TKW_VV_VV_UB 100.0 FORMULA_0003 0.0 255.0000 /end CHARACTERISTIC
/begin CHARACTERISTIC K_ED_SC_BUSOFF.OK_SCHWELLE "Filterschwelle fuer Fehleraustrag | EN: Fault code SC_BUSOFF - debounce filter threshold for clearing (healing) the fault" VALUE 0x71267 TKW_VV_VV_UB 100.0 FORMULA_0003 0.0 255.0000 /end CHARACTERISTIC
/begin CHARACTERISTIC K_ED_EC_BUSOFF.OK_SCHWELLE "Filterschwelle fuer Fehleraustrag | EN: Fault code EC_BUSOFF - debounce filter threshold for clearing (healing) the fault" VALUE 0x71281 TKW_VV_VV_UB 100.0 FORMULA_0003 0.0 255.0000 /end CHARACTERISTIC
/begin CHARACTERISTIC K_ED_ION_SIG_B1.OK_SCHWELLE "Filterschwelle fuer Fehleraustrag" VALUE 0x7139F TKW_VV_VV_UB 100.0 FORMULA_0003 0.0 255.0000 /end CHARACTERISTIC
/begin CHARACTERISTIC K_ED_ION_SIG_B2.OK_SCHWELLE "Filterschwelle fuer Fehleraustrag" VALUE 0x713B9 TKW_VV_VV_UB 100.0 FORMULA_0003 0.0 255.0000 /end CHARACTERISTIC
/begin CHARACTERISTIC K_ED_ION_SAT_B1.OK_SCHWELLE "Filterschwelle fuer Fehleraustrag" VALUE 0x714F1 TKW_VV_VV_UB 100.0 FORMULA_0003 0.0 255.0000 /end CHARACTERISTIC
/begin CHARACTERISTIC K_ED_ION_SAT_B2.OK_SCHWELLE "Filterschwelle fuer Fehleraustrag" VALUE 0x7150B TKW_VV_VV_UB 100.0 FORMULA_0003 0.0 255.0000 /end CHARACTERISTIC
/begin CHARACTERISTIC K_ED_INDEX_88_IGN.OK_SCHWELLE "Filterschwelle fuer Fehleraustrag | EN: Filterschwelle fuer Fehleraustrag" VALUE 0x71559 TKW_VV_VV_UB 100.0 FORMULA_0003 0.0 255.0000 /end CHARACTERISTIC
/begin CHARACTERISTIC K_ED_INDEX_89_IGN.OK_SCHWELLE "Filterschwelle fuer Fehleraustrag" VALUE 0x71573 TKW_VV_VV_UB 100.0 FORMULA_0003 0.0 255.0000 /end CHARACTERISTIC
/begin CHARACTERISTIC K_ED_SG_IGN.OK_SCHWELLE "Filterschwelle fuer Fehleraustrag | EN: Fault code SG_IGN - debounce filter threshold for clearing (healing) the fault" VALUE 0x715C1 TKW_VV_VV_UB 100.0 FORMULA_0003 0.0 255.0000 /end CHARACTERISTIC
/begin CHARACTERISTIC K_ED_E2_IGN.OK_SCHWELLE "Filterschwelle fuer Fehleraustrag | EN: Fault code E2_IGN - debounce filter threshold for clearing (healing) the fault" VALUE 0x715DB TKW_VV_VV_UB 100.0 FORMULA_0003 0.0 255.0000 /end CHARACTERISTIC
/begin CHARACTERISTIC K_ED_SK_MANAGER_IGN.OK_SCHWELLE "Filterschwelle fuer Fehleraustrag | EN: Fault code SK_MANAGER_IGN - debounce filter threshold for clearing (healing) the fault" VALUE 0x7160F TKW_VV_VV_UB 100.0 FORMULA_0003 0.0 255.0000 /end CHARACTERISTIC
/begin CHARACTERISTIC K_ED_LLR_DIAG.OK_SCHWELLE "Filterschwelle fuer Fehleraustrag | EN: Fault code LLR_DIAG - debounce filter threshold for clearing (healing) the fault" VALUE 0x71629 TKW_VV_VV_UB 100.0 FORMULA_0003 0.0 255.0000 /end CHARACTERISTIC
/begin CHARACTERISTIC K_ED_DK2_ZUST.OK_SCHWELLE "Filterschwelle fuer Fehleraustrag | EN: Fault code DK2_ZUST - debounce filter threshold for clearing (healing) the fault" VALUE 0x71691 TKW_VV_VV_UB 100.0 FORMULA_0003 0.0 255.0000 /end CHARACTERISTIC
/begin CHARACTERISTIC K_ED_FGR_ABWURF.OK_SCHWELLE "Filterschwelle fuer Fehleraustrag | EN: Fault code FGR_ABWURF - debounce filter threshold for clearing (healing) the fault" VALUE 0x716AB TKW_VV_VV_UB 100.0 FORMULA_0003 0.0 255.0000 /end CHARACTERISTIC
/begin CHARACTERISTIC K_ED_PWG_BLS.OK_SCHWELLE "Filterschwelle fuer Fehleraustrag | EN: Fault code PWG_BLS - debounce filter threshold for clearing (healing) the fault" VALUE 0x716C5 TKW_VV_VV_UB 100.0 FORMULA_0003 0.0 255.0000 /end CHARACTERISTIC
/begin CHARACTERISTIC K_ED_N_GETR_EIN_HS.OK_SCHWELLE "Filterschwelle fuer Fehleraustrag | EN: Fault code N_GETR_EIN_HS - debounce filter threshold for clearing (healing) the fault" VALUE 0x71713 TKW_VV_VV_UB 100.0 FORMULA_0003 0.0 255.0000 /end CHARACTERISTIC
/begin CHARACTERISTIC K_ED_LLR_DIAG_CSS.OK_SCHWELLE "Filterschwelle fuer Fehleraustrag | EN: Fault code LLR_DIAG_CSS - debounce filter threshold for clearing (healing) the fault" VALUE 0x71747 TKW_VV_VV_UB 100.0 FORMULA_0003 0.0 255.0000 /end CHARACTERISTIC
/begin CHARACTERISTIC K_ED_INDEX_110_IGN.OK_SCHWELLE "Filterschwelle fuer Fehleraustrag" VALUE 0x71795 TKW_VV_VV_UB 100.0 FORMULA_0003 0.0 255.0000 /end CHARACTERISTIC
/begin CHARACTERISTIC K_ED_INDEX_111_IGN.OK_SCHWELLE "Filterschwelle fuer Fehleraustrag" VALUE 0x717AF TKW_VV_VV_UB 100.0 FORMULA_0003 0.0 255.0000 /end CHARACTERISTIC
/begin CHARACTERISTIC K_ED_INDEX_112_IGN.OK_SCHWELLE "Filterschwelle fuer Fehleraustrag" VALUE 0x717C9 TKW_VV_VV_UB 100.0 FORMULA_0003 0.0 255.0000 /end CHARACTERISTIC
/begin CHARACTERISTIC K_ED_INDEX_113_IGN.OK_SCHWELLE "Filterschwelle fuer Fehleraustrag" VALUE 0x717E3 TKW_VV_VV_UB 100.0 FORMULA_0003 0.0 255.0000 /end CHARACTERISTIC
/begin CHARACTERISTIC K_ED_INDEX_114_IGN.OK_SCHWELLE "Filterschwelle fuer Fehleraustrag" VALUE 0x717FD TKW_VV_VV_UB 100.0 FORMULA_0003 0.0 255.0000 /end CHARACTERISTIC
/begin CHARACTERISTIC K_ED_INDEX_115_IGN.OK_SCHWELLE "Filterschwelle fuer Fehleraustrag" VALUE 0x71817 TKW_VV_VV_UB 100.0 FORMULA_0003 0.0 255.0000 /end CHARACTERISTIC
/begin CHARACTERISTIC K_ED_INDEX_116_IGN.OK_SCHWELLE "Filterschwelle fuer Fehleraustrag" VALUE 0x71831 TKW_VV_VV_UB 100.0 FORMULA_0003 0.0 255.0000 /end CHARACTERISTIC
/begin CHARACTERISTIC K_ED_INDEX_117_IGN.OK_SCHWELLE "Filterschwelle fuer Fehleraustrag" VALUE 0x7184B TKW_VV_VV_UB 100.0 FORMULA_0003 0.0 255.0000 /end CHARACTERISTIC
/begin CHARACTERISTIC K_ED_INDEX_118_IGN.OK_SCHWELLE "Filterschwelle fuer Fehleraustrag" VALUE 0x71865 TKW_VV_VV_UB 100.0 FORMULA_0003 0.0 255.0000 /end CHARACTERISTIC
/begin CHARACTERISTIC K_ED_INDEX_119_IGN.OK_SCHWELLE "Filterschwelle fuer Fehleraustrag" VALUE 0x7187F TKW_VV_VV_UB 100.0 FORMULA_0003 0.0 255.0000 /end CHARACTERISTIC
/begin CHARACTERISTIC K_ED_INDEX_120_IGN.OK_SCHWELLE "Filterschwelle fuer Fehleraustrag" VALUE 0x71899 TKW_VV_VV_UB 100.0 FORMULA_0003 0.0 255.0000 /end CHARACTERISTIC
/begin CHARACTERISTIC K_ED_INDEX_121_IGN.OK_SCHWELLE "Filterschwelle fuer Fehleraustrag | EN: Fault code INDEX_121_IGN - debounce filter threshold for clearing (healing) the fault" VALUE 0x718B3 TKW_VV_VV_UB 100.0 FORMULA_0003 0.0 255.0000 /end CHARACTERISTIC
/begin CHARACTERISTIC K_ED_INDEX_122_IGN.OK_SCHWELLE "Filterschwelle fuer Fehleraustrag | EN: Fault code INDEX_122_IGN - debounce filter threshold for clearing (healing) the fault" VALUE 0x718CD TKW_VV_VV_UB 100.0 FORMULA_0003 0.0 255.0000 /end CHARACTERISTIC
/begin CHARACTERISTIC K_ED_INDEX_123_IGN.OK_SCHWELLE "Filterschwelle fuer Fehleraustrag | EN: Fault code INDEX_123_IGN - debounce filter threshold for clearing (healing) the fault" VALUE 0x718E7 TKW_VV_VV_UB 100.0 FORMULA_0003 0.0 255.0000 /end CHARACTERISTIC
/begin CHARACTERISTIC K_ED_INDEX_124_IGN.OK_SCHWELLE "Filterschwelle fuer Fehleraustrag | EN: Fault code INDEX_124_IGN - debounce filter threshold for clearing (healing) the fault" VALUE 0x71901 TKW_VV_VV_UB 100.0 FORMULA_0003 0.0 255.0000 /end CHARACTERISTIC
/begin CHARACTERISTIC K_ED_INDEX_125_IGN.OK_SCHWELLE "Filterschwelle fuer Fehleraustrag | EN: Fault code INDEX_125_IGN - debounce filter threshold for clearing (healing) the fault" VALUE 0x7191B TKW_VV_VV_UB 100.0 FORMULA_0003 0.0 255.0000 /end CHARACTERISTIC
/begin CHARACTERISTIC K_ED_INDEX_126_IGN.OK_SCHWELLE "Filterschwelle fuer Fehleraustrag | EN: Fault code INDEX_126_IGN - debounce filter threshold for clearing (healing) the fault" VALUE 0x71935 TKW_VV_VV_UB 100.0 FORMULA_0003 0.0 255.0000 /end CHARACTERISTIC
/begin CHARACTERISTIC K_ED_INDEX_127_IGN.OK_SCHWELLE "Filterschwelle fuer Fehleraustrag | EN: Fault code INDEX_127_IGN - debounce filter threshold for clearing (healing) the fault" VALUE 0x7194F TKW_VV_VV_UB 100.0 FORMULA_0003 0.0 255.0000 /end CHARACTERISTIC
/begin CHARACTERISTIC K_ED_SK_TR_IGN.INC_VOR_EINTRAG "Filtererhoehung vorm Fehlerspeichereintrag | EN: Filtererhoehung vorm Fehlerspeichereintrag" VALUE 0x70C6A TKW_VV_VV_UB 100.0 FORMULA_0003 0.0 255.0000 /end CHARACTERISTIC
/begin CHARACTERISTIC K_ED_PWG1.INC_VOR_EINTRAG "Filtererhoehung vorm Fehlerspeichereintrag | EN: Fault code PWG1 - debounce filter increment before fault-memory entry" VALUE 0x70DBC TKW_VV_VV_UB 100.0 FORMULA_0003 0.0 255.0000 /end CHARACTERISTIC
/begin CHARACTERISTIC K_ED_PWG2.INC_VOR_EINTRAG "Filtererhoehung vorm Fehlerspeichereintrag | EN: Fault code PWG2 - debounce filter increment before fault-memory entry" VALUE 0x70DD6 TKW_VV_VV_UB 100.0 FORMULA_0003 0.0 255.0000 /end CHARACTERISTIC
/begin CHARACTERISTIC K_ED_PWG_VGL.INC_VOR_EINTRAG "Filtererhoehung vorm Fehlerspeichereintrag | EN: Fault code PWG_VGL - debounce filter increment before fault-memory entry" VALUE 0x70DF0 TKW_VV_VV_UB 100.0 FORMULA_0003 0.0 255.0000 /end CHARACTERISTIC
/begin CHARACTERISTIC K_ED_PCTRL_IGN.INC_VOR_EINTRAG "Filtererhoehung vorm Fehlerspeichereintrag | EN: Fault code PCTRL_IGN - debounce filter increment before fault-memory entry" VALUE 0x70E0A TKW_VV_VV_UB 100.0 FORMULA_0003 0.0 255.0000 /end CHARACTERISTIC
/begin CHARACTERISTIC K_ED_LLS1_CAN.INC_VOR_EINTRAG "Filtererhoehung vorm Fehlerspeichereintrag | EN: Fault code LLS1_CAN - debounce filter increment before fault-memory entry" VALUE 0x70E24 TKW_VV_VV_UB 100.0 FORMULA_0003 0.0 255.0000 /end CHARACTERISTIC
/begin CHARACTERISTIC K_ED_LLS2_CAN.INC_VOR_EINTRAG "Filtererhoehung vorm Fehlerspeichereintrag | EN: Fault code LLS2_CAN - debounce filter increment before fault-memory entry" VALUE 0x70E3E TKW_VV_VV_UB 100.0 FORMULA_0003 0.0 255.0000 /end CHARACTERISTIC
/begin CHARACTERISTIC K_ED_LLS1_SK.INC_VOR_EINTRAG "Filtererhoehung vorm Fehlerspeichereintrag | EN: Fault code LLS1_SK - debounce filter increment before fault-memory entry" VALUE 0x70E8C TKW_VV_VV_UB 100.0 FORMULA_0003 0.0 255.0000 /end CHARACTERISTIC
/begin CHARACTERISTIC K_ED_LLS2_SK.INC_VOR_EINTRAG "Filtererhoehung vorm Fehlerspeichereintrag | EN: Fault code LLS2_SK - debounce filter increment before fault-memory entry" VALUE 0x70EA6 TKW_VV_VV_UB 100.0 FORMULA_0003 0.0 255.0000 /end CHARACTERISTIC
/begin CHARACTERISTIC K_ED_SMG_SCHALTAB.INC_VOR_EINTRAG "Filtererhoehung vorm Fehlerspeichereintrag | EN: Fault code SMG_SCHALTAB - debounce filter increment before fault-memory entry" VALUE 0x70EC0 TKW_VV_VV_UB 100.0 FORMULA_0003 0.0 255.0000 /end CHARACTERISTIC
/begin CHARACTERISTIC K_ED_DK_INIT.INC_VOR_EINTRAG "Filtererhoehung vorm Fehlerspeichereintrag | EN: Fault code DK_INIT - debounce filter increment before fault-memory entry" VALUE 0x70F42 TKW_VV_VV_UB 100.0 FORMULA_0003 0.0 255.0000 /end CHARACTERISTIC
/begin CHARACTERISTIC K_ED_IONVERST_B1.INC_VOR_EINTRAG "Filtererhoehung vorm Fehlerspeichereintrag" VALUE 0x70FC4 TKW_VV_VV_UB 100.0 FORMULA_0003 0.0 255.0000 /end CHARACTERISTIC
/begin CHARACTERISTIC K_ED_IONSPG_B1.INC_VOR_EINTRAG "Filtererhoehung vorm Fehlerspeichereintrag" VALUE 0x70FDE TKW_VV_VV_UB 100.0 FORMULA_0003 0.0 255.0000 /end CHARACTERISTIC
/begin CHARACTERISTIC K_ED_IONVERST_B2.INC_VOR_EINTRAG "Filtererhoehung vorm Fehlerspeichereintrag" VALUE 0x70FF8 TKW_VV_VV_UB 100.0 FORMULA_0003 0.0 255.0000 /end CHARACTERISTIC
/begin CHARACTERISTIC K_ED_IONSPG_B2.INC_VOR_EINTRAG "Filtererhoehung vorm Fehlerspeichereintrag" VALUE 0x71012 TKW_VV_VV_UB 100.0 FORMULA_0003 0.0 255.0000 /end CHARACTERISTIC
/begin CHARACTERISTIC K_ED_DK2_WDK.INC_VOR_EINTRAG "Filtererhoehung vorm Fehlerspeichereintrag | EN: Fault code DK2_WDK - debounce filter increment before fault-memory entry" VALUE 0x7107A TKW_VV_VV_UB 100.0 FORMULA_0003 0.0 255.0000 /end CHARACTERISTIC
/begin CHARACTERISTIC K_ED_LLS1_REGLER.INC_VOR_EINTRAG "Filtererhoehung vorm Fehlerspeichereintrag | EN: Fault code LLS1_REGLER - debounce filter increment before fault-memory entry" VALUE 0x710C8 TKW_VV_VV_UB 100.0 FORMULA_0003 0.0 255.0000 /end CHARACTERISTIC
/begin CHARACTERISTIC K_ED_LLS2_REGLER.INC_VOR_EINTRAG "Filtererhoehung vorm Fehlerspeichereintrag | EN: Fault code LLS2_REGLER - debounce filter increment before fault-memory entry" VALUE 0x710E2 TKW_VV_VV_UB 100.0 FORMULA_0003 0.0 255.0000 /end CHARACTERISTIC
/begin CHARACTERISTIC K_ED_DK2_SK_ERR.INC_VOR_EINTRAG "Filtererhoehung vorm Fehlerspeichereintrag | EN: Fault code DK2_SK_ERR - debounce filter increment before fault-memory entry" VALUE 0x71116 TKW_VV_VV_UB 100.0 FORMULA_0003 0.0 255.0000 /end CHARACTERISTIC
/begin CHARACTERISTIC K_ED_MD_SK_ERR.INC_VOR_EINTRAG "Filtererhoehung vorm Fehlerspeichereintrag | EN: Fault code MD_SK_ERR - debounce filter increment before fault-memory entry" VALUE 0x71164 TKW_VV_VV_UB 100.0 FORMULA_0003 0.0 255.0000 /end CHARACTERISTIC
/begin CHARACTERISTIC K_ED_LLS_INIT.INC_VOR_EINTRAG "Filtererhoehung vorm Fehlerspeichereintrag | EN: Fault code LLS_INIT - debounce filter increment before fault-memory entry" VALUE 0x7117E TKW_VV_VV_UB 100.0 FORMULA_0003 0.0 255.0000 /end CHARACTERISTIC
/begin CHARACTERISTIC K_ED_DSC_EINGR.INC_VOR_EINTRAG "Filtererhoehung vorm Fehlerspeichereintrag | EN: Fault code DSC_EINGR - debounce filter increment before fault-memory entry" VALUE 0x71198 TKW_VV_VV_UB 100.0 FORMULA_0003 0.0 255.0000 /end CHARACTERISTIC
/begin CHARACTERISTIC K_ED_LLS1_CMD.INC_VOR_EINTRAG "Filtererhoehung vorm Fehlerspeichereintrag | EN: Fault code LLS1_CMD - debounce filter increment before fault-memory entry" VALUE 0x711E6 TKW_VV_VV_UB 100.0 FORMULA_0003 0.0 255.0000 /end CHARACTERISTIC
/begin CHARACTERISTIC K_ED_LLS2_CMD.INC_VOR_EINTRAG "Filtererhoehung vorm Fehlerspeichereintrag | EN: Fault code LLS2_CMD - debounce filter increment before fault-memory entry" VALUE 0x71200 TKW_VV_VV_UB 100.0 FORMULA_0003 0.0 255.0000 /end CHARACTERISTIC
/begin CHARACTERISTIC K_ED_SC_SMG1.INC_VOR_EINTRAG "Filtererhoehung vorm Fehlerspeichereintrag | EN: Fault code SC_SMG1 - debounce filter increment before fault-memory entry" VALUE 0x7121A TKW_VV_VV_UB 100.0 FORMULA_0003 0.0 255.0000 /end CHARACTERISTIC
/begin CHARACTERISTIC K_ED_SC_SMG2.INC_VOR_EINTRAG "Filtererhoehung vorm Fehlerspeichereintrag | EN: Fault code SC_SMG2 - debounce filter increment before fault-memory entry" VALUE 0x71234 TKW_VV_VV_UB 100.0 FORMULA_0003 0.0 255.0000 /end CHARACTERISTIC
/begin CHARACTERISTIC K_ED_SC_SMG3.INC_VOR_EINTRAG "Filtererhoehung vorm Fehlerspeichereintrag | EN: Fault code SC_SMG3 - debounce filter increment before fault-memory entry" VALUE 0x7124E TKW_VV_VV_UB 100.0 FORMULA_0003 0.0 255.0000 /end CHARACTERISTIC
/begin CHARACTERISTIC K_ED_SC_BUSOFF.INC_VOR_EINTRAG "Filtererhoehung vorm Fehlerspeichereintrag | EN: Fault code SC_BUSOFF - debounce filter increment before fault-memory entry" VALUE 0x71268 TKW_VV_VV_UB 100.0 FORMULA_0003 0.0 255.0000 /end CHARACTERISTIC
/begin CHARACTERISTIC K_ED_EC_BUSOFF.INC_VOR_EINTRAG "Filtererhoehung vorm Fehlerspeichereintrag | EN: Fault code EC_BUSOFF - debounce filter increment before fault-memory entry" VALUE 0x71282 TKW_VV_VV_UB 100.0 FORMULA_0003 0.0 255.0000 /end CHARACTERISTIC
/begin CHARACTERISTIC K_ED_ION_SIG_B1.INC_VOR_EINTRAG "Filtererhoehung vorm Fehlerspeichereintrag" VALUE 0x713A0 TKW_VV_VV_UB 100.0 FORMULA_0003 0.0 255.0000 /end CHARACTERISTIC
/begin CHARACTERISTIC K_ED_ION_SIG_B2.INC_VOR_EINTRAG "Filtererhoehung vorm Fehlerspeichereintrag" VALUE 0x713BA TKW_VV_VV_UB 100.0 FORMULA_0003 0.0 255.0000 /end CHARACTERISTIC
/begin CHARACTERISTIC K_ED_ION_SAT_B1.INC_VOR_EINTRAG "Filtererhoehung vorm Fehlerspeichereintrag" VALUE 0x714F2 TKW_VV_VV_UB 100.0 FORMULA_0003 0.0 255.0000 /end CHARACTERISTIC
/begin CHARACTERISTIC K_ED_ION_SAT_B2.INC_VOR_EINTRAG "Filtererhoehung vorm Fehlerspeichereintrag" VALUE 0x7150C TKW_VV_VV_UB 100.0 FORMULA_0003 0.0 255.0000 /end CHARACTERISTIC
/begin CHARACTERISTIC K_ED_INDEX_88_IGN.INC_VOR_EINTRAG "Filtererhoehung vorm Fehlerspeichereintrag | EN: Filtererhoehung vorm Fehlerspeichereintrag" VALUE 0x7155A TKW_VV_VV_UB 100.0 FORMULA_0003 0.0 255.0000 /end CHARACTERISTIC
/begin CHARACTERISTIC K_ED_INDEX_89_IGN.INC_VOR_EINTRAG "Filtererhoehung vorm Fehlerspeichereintrag" VALUE 0x71574 TKW_VV_VV_UB 100.0 FORMULA_0003 0.0 255.0000 /end CHARACTERISTIC
/begin CHARACTERISTIC K_ED_SG_IGN.INC_VOR_EINTRAG "Filtererhoehung vorm Fehlerspeichereintrag | EN: Fault code SG_IGN - debounce filter increment before fault-memory entry" VALUE 0x715C2 TKW_VV_VV_UB 100.0 FORMULA_0003 0.0 255.0000 /end CHARACTERISTIC
/begin CHARACTERISTIC K_ED_E2_IGN.INC_VOR_EINTRAG "Filtererhoehung vorm Fehlerspeichereintrag | EN: Fault code E2_IGN - debounce filter increment before fault-memory entry" VALUE 0x715DC TKW_VV_VV_UB 100.0 FORMULA_0003 0.0 255.0000 /end CHARACTERISTIC
/begin CHARACTERISTIC K_ED_SK_MANAGER_IGN.INC_VOR_EINTRAG "Filtererhoehung vorm Fehlerspeichereintrag | EN: Fault code SK_MANAGER_IGN - debounce filter increment before fault-memory entry" VALUE 0x71610 TKW_VV_VV_UB 100.0 FORMULA_0003 0.0 255.0000 /end CHARACTERISTIC
/begin CHARACTERISTIC K_ED_LLR_DIAG.INC_VOR_EINTRAG "Filtererhoehung vorm Fehlerspeichereintrag | EN: Fault code LLR_DIAG - debounce filter increment before fault-memory entry" VALUE 0x7162A TKW_VV_VV_UB 100.0 FORMULA_0003 0.0 255.0000 /end CHARACTERISTIC
/begin CHARACTERISTIC K_ED_DK2_ZUST.INC_VOR_EINTRAG "Filtererhoehung vorm Fehlerspeichereintrag | EN: Fault code DK2_ZUST - debounce filter increment before fault-memory entry" VALUE 0x71692 TKW_VV_VV_UB 100.0 FORMULA_0003 0.0 255.0000 /end CHARACTERISTIC
/begin CHARACTERISTIC K_ED_FGR_ABWURF.INC_VOR_EINTRAG "Filtererhoehung vorm Fehlerspeichereintrag | EN: Fault code FGR_ABWURF - debounce filter increment before fault-memory entry" VALUE 0x716AC TKW_VV_VV_UB 100.0 FORMULA_0003 0.0 255.0000 /end CHARACTERISTIC
/begin CHARACTERISTIC K_ED_PWG_BLS.INC_VOR_EINTRAG "Filtererhoehung vorm Fehlerspeichereintrag | EN: Fault code PWG_BLS - debounce filter increment before fault-memory entry" VALUE 0x716C6 TKW_VV_VV_UB 100.0 FORMULA_0003 0.0 255.0000 /end CHARACTERISTIC
/begin CHARACTERISTIC K_ED_N_GETR_EIN_HS.INC_VOR_EINTRAG "Filtererhoehung vorm Fehlerspeichereintrag | EN: Fault code N_GETR_EIN_HS - debounce filter increment before fault-memory entry" VALUE 0x71714 TKW_VV_VV_UB 100.0 FORMULA_0003 0.0 255.0000 /end CHARACTERISTIC
/begin CHARACTERISTIC K_ED_LLR_DIAG_CSS.INC_VOR_EINTRAG "Filtererhoehung vorm Fehlerspeichereintrag | EN: Fault code LLR_DIAG_CSS - debounce filter increment before fault-memory entry" VALUE 0x71748 TKW_VV_VV_UB 100.0 FORMULA_0003 0.0 255.0000 /end CHARACTERISTIC
/begin CHARACTERISTIC K_ED_INDEX_110_IGN.INC_VOR_EINTRAG "Filtererhoehung vorm Fehlerspeichereintrag" VALUE 0x71796 TKW_VV_VV_UB 100.0 FORMULA_0003 0.0 255.0000 /end CHARACTERISTIC
/begin CHARACTERISTIC K_ED_INDEX_111_IGN.INC_VOR_EINTRAG "Filtererhoehung vorm Fehlerspeichereintrag" VALUE 0x717B0 TKW_VV_VV_UB 100.0 FORMULA_0003 0.0 255.0000 /end CHARACTERISTIC
/begin CHARACTERISTIC K_ED_INDEX_112_IGN.INC_VOR_EINTRAG "Filtererhoehung vorm Fehlerspeichereintrag" VALUE 0x717CA TKW_VV_VV_UB 100.0 FORMULA_0003 0.0 255.0000 /end CHARACTERISTIC
/begin CHARACTERISTIC K_ED_INDEX_113_IGN.INC_VOR_EINTRAG "Filtererhoehung vorm Fehlerspeichereintrag" VALUE 0x717E4 TKW_VV_VV_UB 100.0 FORMULA_0003 0.0 255.0000 /end CHARACTERISTIC
/begin CHARACTERISTIC K_ED_INDEX_114_IGN.INC_VOR_EINTRAG "Filtererhoehung vorm Fehlerspeichereintrag" VALUE 0x717FE TKW_VV_VV_UB 100.0 FORMULA_0003 0.0 255.0000 /end CHARACTERISTIC
/begin CHARACTERISTIC K_ED_INDEX_115_IGN.INC_VOR_EINTRAG "Filtererhoehung vorm Fehlerspeichereintrag" VALUE 0x71818 TKW_VV_VV_UB 100.0 FORMULA_0003 0.0 255.0000 /end CHARACTERISTIC
/begin CHARACTERISTIC K_ED_INDEX_116_IGN.INC_VOR_EINTRAG "Filtererhoehung vorm Fehlerspeichereintrag" VALUE 0x71832 TKW_VV_VV_UB 100.0 FORMULA_0003 0.0 255.0000 /end CHARACTERISTIC
/begin CHARACTERISTIC K_ED_INDEX_117_IGN.INC_VOR_EINTRAG "Filtererhoehung vorm Fehlerspeichereintrag" VALUE 0x7184C TKW_VV_VV_UB 100.0 FORMULA_0003 0.0 255.0000 /end CHARACTERISTIC
/begin CHARACTERISTIC K_ED_INDEX_118_IGN.INC_VOR_EINTRAG "Filtererhoehung vorm Fehlerspeichereintrag" VALUE 0x71866 TKW_VV_VV_UB 100.0 FORMULA_0003 0.0 255.0000 /end CHARACTERISTIC
/begin CHARACTERISTIC K_ED_INDEX_119_IGN.INC_VOR_EINTRAG "Filtererhoehung vorm Fehlerspeichereintrag" VALUE 0x71880 TKW_VV_VV_UB 100.0 FORMULA_0003 0.0 255.0000 /end CHARACTERISTIC
/begin CHARACTERISTIC K_ED_INDEX_120_IGN.INC_VOR_EINTRAG "Filtererhoehung vorm Fehlerspeichereintrag" VALUE 0x7189A TKW_VV_VV_UB 100.0 FORMULA_0003 0.0 255.0000 /end CHARACTERISTIC
/begin CHARACTERISTIC K_ED_INDEX_121_IGN.INC_VOR_EINTRAG "Filtererhoehung vorm Fehlerspeichereintrag | EN: Fault code INDEX_121_IGN - debounce filter increment before fault-memory entry" VALUE 0x718B4 TKW_VV_VV_UB 100.0 FORMULA_0003 0.0 255.0000 /end CHARACTERISTIC
/begin CHARACTERISTIC K_ED_INDEX_122_IGN.INC_VOR_EINTRAG "Filtererhoehung vorm Fehlerspeichereintrag | EN: Fault code INDEX_122_IGN - debounce filter increment before fault-memory entry" VALUE 0x718CE TKW_VV_VV_UB 100.0 FORMULA_0003 0.0 255.0000 /end CHARACTERISTIC
/begin CHARACTERISTIC K_ED_INDEX_123_IGN.INC_VOR_EINTRAG "Filtererhoehung vorm Fehlerspeichereintrag | EN: Fault code INDEX_123_IGN - debounce filter increment before fault-memory entry" VALUE 0x718E8 TKW_VV_VV_UB 100.0 FORMULA_0003 0.0 255.0000 /end CHARACTERISTIC
/begin CHARACTERISTIC K_ED_INDEX_124_IGN.INC_VOR_EINTRAG "Filtererhoehung vorm Fehlerspeichereintrag | EN: Fault code INDEX_124_IGN - debounce filter increment before fault-memory entry" VALUE 0x71902 TKW_VV_VV_UB 100.0 FORMULA_0003 0.0 255.0000 /end CHARACTERISTIC
/begin CHARACTERISTIC K_ED_INDEX_125_IGN.INC_VOR_EINTRAG "Filtererhoehung vorm Fehlerspeichereintrag | EN: Fault code INDEX_125_IGN - debounce filter increment before fault-memory entry" VALUE 0x7191C TKW_VV_VV_UB 100.0 FORMULA_0003 0.0 255.0000 /end CHARACTERISTIC
/begin CHARACTERISTIC K_ED_INDEX_126_IGN.INC_VOR_EINTRAG "Filtererhoehung vorm Fehlerspeichereintrag | EN: Fault code INDEX_126_IGN - debounce filter increment before fault-memory entry" VALUE 0x71936 TKW_VV_VV_UB 100.0 FORMULA_0003 0.0 255.0000 /end CHARACTERISTIC
/begin CHARACTERISTIC K_ED_INDEX_127_IGN.INC_VOR_EINTRAG "Filtererhoehung vorm Fehlerspeichereintrag | EN: Fault code INDEX_127_IGN - debounce filter increment before fault-memory entry" VALUE 0x71950 TKW_VV_VV_UB 100.0 FORMULA_0003 0.0 255.0000 /end CHARACTERISTIC
/begin CHARACTERISTIC K_ED_SK_TR_IGN.DEC_VOR_EINTRAG "Filterverringerung vorm Fehlerspeichereintrag | EN: Filterverringerung vorm Fehlerspeichereintrag" VALUE 0x70C6B TKW_VV_VV_UB 100.0 FORMULA_0003 0.0 255.0000 /end CHARACTERISTIC
/begin CHARACTERISTIC K_ED_PWG1.DEC_VOR_EINTRAG "Filterverringerung vorm Fehlerspeichereintrag | EN: Fault code PWG1 - debounce filter decrement before fault-memory entry" VALUE 0x70DBD TKW_VV_VV_UB 100.0 FORMULA_0003 0.0 255.0000 /end CHARACTERISTIC
/begin CHARACTERISTIC K_ED_PWG2.DEC_VOR_EINTRAG "Filterverringerung vorm Fehlerspeichereintrag | EN: Fault code PWG2 - debounce filter decrement before fault-memory entry" VALUE 0x70DD7 TKW_VV_VV_UB 100.0 FORMULA_0003 0.0 255.0000 /end CHARACTERISTIC
/begin CHARACTERISTIC K_ED_PWG_VGL.DEC_VOR_EINTRAG "Filterverringerung vorm Fehlerspeichereintrag | EN: Fault code PWG_VGL - debounce filter decrement before fault-memory entry" VALUE 0x70DF1 TKW_VV_VV_UB 100.0 FORMULA_0003 0.0 255.0000 /end CHARACTERISTIC
/begin CHARACTERISTIC K_ED_PCTRL_IGN.DEC_VOR_EINTRAG "Filterverringerung vorm Fehlerspeichereintrag | EN: Fault code PCTRL_IGN - debounce filter decrement before fault-memory entry" VALUE 0x70E0B TKW_VV_VV_UB 100.0 FORMULA_0003 0.0 255.0000 /end CHARACTERISTIC
/begin CHARACTERISTIC K_ED_LLS1_CAN.DEC_VOR_EINTRAG "Filterverringerung vorm Fehlerspeichereintrag | EN: Fault code LLS1_CAN - debounce filter decrement before fault-memory entry" VALUE 0x70E25 TKW_VV_VV_UB 100.0 FORMULA_0003 0.0 255.0000 /end CHARACTERISTIC
/begin CHARACTERISTIC K_ED_LLS2_CAN.DEC_VOR_EINTRAG "Filterverringerung vorm Fehlerspeichereintrag | EN: Fault code LLS2_CAN - debounce filter decrement before fault-memory entry" VALUE 0x70E3F TKW_VV_VV_UB 100.0 FORMULA_0003 0.0 255.0000 /end CHARACTERISTIC
/begin CHARACTERISTIC K_ED_LLS1_SK.DEC_VOR_EINTRAG "Filterverringerung vorm Fehlerspeichereintrag | EN: Fault code LLS1_SK - debounce filter decrement before fault-memory entry" VALUE 0x70E8D TKW_VV_VV_UB 100.0 FORMULA_0003 0.0 255.0000 /end CHARACTERISTIC
/begin CHARACTERISTIC K_ED_LLS2_SK.DEC_VOR_EINTRAG "Filterverringerung vorm Fehlerspeichereintrag | EN: Fault code LLS2_SK - debounce filter decrement before fault-memory entry" VALUE 0x70EA7 TKW_VV_VV_UB 100.0 FORMULA_0003 0.0 255.0000 /end CHARACTERISTIC
/begin CHARACTERISTIC K_ED_SMG_SCHALTAB.DEC_VOR_EINTRAG "Filterverringerung vorm Fehlerspeichereintrag | EN: Fault code SMG_SCHALTAB - debounce filter decrement before fault-memory entry" VALUE 0x70EC1 TKW_VV_VV_UB 100.0 FORMULA_0003 0.0 255.0000 /end CHARACTERISTIC
/begin CHARACTERISTIC K_ED_SMG_SK.DEC_VOR_EINTRAG "Filterverringerung vorm Fehlerspeichereintrag | EN: Fault code SMG_SK - debounce filter decrement before fault-memory entry" VALUE 0x70EDB TKW_VV_VV_UB 100.0 FORMULA_0003 0.0 255.0000 /end CHARACTERISTIC
/begin CHARACTERISTIC K_ED_DK_INIT.DEC_VOR_EINTRAG "Filterverringerung vorm Fehlerspeichereintrag | EN: Fault code DK_INIT - debounce filter decrement before fault-memory entry" VALUE 0x70F43 TKW_VV_VV_UB 100.0 FORMULA_0003 0.0 255.0000 /end CHARACTERISTIC
/begin CHARACTERISTIC K_ED_IONVERST_B1.DEC_VOR_EINTRAG "Filterverringerung vorm Fehlerspeichereintrag" VALUE 0x70FC5 TKW_VV_VV_UB 100.0 FORMULA_0003 0.0 255.0000 /end CHARACTERISTIC
/begin CHARACTERISTIC K_ED_IONSPG_B1.DEC_VOR_EINTRAG "Filterverringerung vorm Fehlerspeichereintrag" VALUE 0x70FDF TKW_VV_VV_UB 100.0 FORMULA_0003 0.0 255.0000 /end CHARACTERISTIC
/begin CHARACTERISTIC K_ED_IONVERST_B2.DEC_VOR_EINTRAG "Filterverringerung vorm Fehlerspeichereintrag" VALUE 0x70FF9 TKW_VV_VV_UB 100.0 FORMULA_0003 0.0 255.0000 /end CHARACTERISTIC
/begin CHARACTERISTIC K_ED_IONSPG_B2.DEC_VOR_EINTRAG "Filterverringerung vorm Fehlerspeichereintrag" VALUE 0x71013 TKW_VV_VV_UB 100.0 FORMULA_0003 0.0 255.0000 /end CHARACTERISTIC
/begin CHARACTERISTIC K_ED_DK2_WDK.DEC_VOR_EINTRAG "Filterverringerung vorm Fehlerspeichereintrag | EN: Fault code DK2_WDK - debounce filter decrement before fault-memory entry" VALUE 0x7107B TKW_VV_VV_UB 100.0 FORMULA_0003 0.0 255.0000 /end CHARACTERISTIC
/begin CHARACTERISTIC K_ED_LLS1_REGLER.DEC_VOR_EINTRAG "Filterverringerung vorm Fehlerspeichereintrag | EN: Fault code LLS1_REGLER - debounce filter decrement before fault-memory entry" VALUE 0x710C9 TKW_VV_VV_UB 100.0 FORMULA_0003 0.0 255.0000 /end CHARACTERISTIC
/begin CHARACTERISTIC K_ED_LLS2_REGLER.DEC_VOR_EINTRAG "Filterverringerung vorm Fehlerspeichereintrag | EN: Fault code LLS2_REGLER - debounce filter decrement before fault-memory entry" VALUE 0x710E3 TKW_VV_VV_UB 100.0 FORMULA_0003 0.0 255.0000 /end CHARACTERISTIC
/begin CHARACTERISTIC K_ED_DK2_SK_ERR.DEC_VOR_EINTRAG "Filterverringerung vorm Fehlerspeichereintrag | EN: Fault code DK2_SK_ERR - debounce filter decrement before fault-memory entry" VALUE 0x71117 TKW_VV_VV_UB 100.0 FORMULA_0003 0.0 255.0000 /end CHARACTERISTIC
/begin CHARACTERISTIC K_ED_MD_SK_ERR.DEC_VOR_EINTRAG "Filterverringerung vorm Fehlerspeichereintrag | EN: Fault code MD_SK_ERR - debounce filter decrement before fault-memory entry" VALUE 0x71165 TKW_VV_VV_UB 100.0 FORMULA_0003 0.0 255.0000 /end CHARACTERISTIC
/begin CHARACTERISTIC K_ED_LLS_INIT.DEC_VOR_EINTRAG "Filterverringerung vorm Fehlerspeichereintrag | EN: Fault code LLS_INIT - debounce filter decrement before fault-memory entry" VALUE 0x7117F TKW_VV_VV_UB 100.0 FORMULA_0003 0.0 255.0000 /end CHARACTERISTIC
/begin CHARACTERISTIC K_ED_DSC_EINGR.DEC_VOR_EINTRAG "Filterverringerung vorm Fehlerspeichereintrag | EN: Fault code DSC_EINGR - debounce filter decrement before fault-memory entry" VALUE 0x71199 TKW_VV_VV_UB 100.0 FORMULA_0003 0.0 255.0000 /end CHARACTERISTIC
/begin CHARACTERISTIC K_ED_LLS1_CMD.DEC_VOR_EINTRAG "Filterverringerung vorm Fehlerspeichereintrag | EN: Fault code LLS1_CMD - debounce filter decrement before fault-memory entry" VALUE 0x711E7 TKW_VV_VV_UB 100.0 FORMULA_0003 0.0 255.0000 /end CHARACTERISTIC
/begin CHARACTERISTIC K_ED_LLS2_CMD.DEC_VOR_EINTRAG "Filterverringerung vorm Fehlerspeichereintrag | EN: Fault code LLS2_CMD - debounce filter decrement before fault-memory entry" VALUE 0x71201 TKW_VV_VV_UB 100.0 FORMULA_0003 0.0 255.0000 /end CHARACTERISTIC
/begin CHARACTERISTIC K_ED_SC_SMG1.DEC_VOR_EINTRAG "Filterverringerung vorm Fehlerspeichereintrag | EN: Fault code SC_SMG1 - debounce filter decrement before fault-memory entry" VALUE 0x7121B TKW_VV_VV_UB 100.0 FORMULA_0003 0.0 255.0000 /end CHARACTERISTIC
/begin CHARACTERISTIC K_ED_SC_SMG2.DEC_VOR_EINTRAG "Filterverringerung vorm Fehlerspeichereintrag | EN: Fault code SC_SMG2 - debounce filter decrement before fault-memory entry" VALUE 0x71235 TKW_VV_VV_UB 100.0 FORMULA_0003 0.0 255.0000 /end CHARACTERISTIC
/begin CHARACTERISTIC K_ED_SC_SMG3.DEC_VOR_EINTRAG "Filterverringerung vorm Fehlerspeichereintrag | EN: Fault code SC_SMG3 - debounce filter decrement before fault-memory entry" VALUE 0x7124F TKW_VV_VV_UB 100.0 FORMULA_0003 0.0 255.0000 /end CHARACTERISTIC
/begin CHARACTERISTIC K_ED_SC_BUSOFF.DEC_VOR_EINTRAG "Filterverringerung vorm Fehlerspeichereintrag | EN: Fault code SC_BUSOFF - debounce filter decrement before fault-memory entry" VALUE 0x71269 TKW_VV_VV_UB 100.0 FORMULA_0003 0.0 255.0000 /end CHARACTERISTIC
/begin CHARACTERISTIC K_ED_EC_BUSOFF.DEC_VOR_EINTRAG "Filterverringerung vorm Fehlerspeichereintrag | EN: Fault code EC_BUSOFF - debounce filter decrement before fault-memory entry" VALUE 0x71283 TKW_VV_VV_UB 100.0 FORMULA_0003 0.0 255.0000 /end CHARACTERISTIC
/begin CHARACTERISTIC K_ED_ION_SIG_B1.DEC_VOR_EINTRAG "Filterverringerung vorm Fehlerspeichereintrag" VALUE 0x713A1 TKW_VV_VV_UB 100.0 FORMULA_0003 0.0 255.0000 /end CHARACTERISTIC
/begin CHARACTERISTIC K_ED_ION_SIG_B2.DEC_VOR_EINTRAG "Filterverringerung vorm Fehlerspeichereintrag" VALUE 0x713BB TKW_VV_VV_UB 100.0 FORMULA_0003 0.0 255.0000 /end CHARACTERISTIC
/begin CHARACTERISTIC K_ED_ION_SAT_B1.DEC_VOR_EINTRAG "Filterverringerung vorm Fehlerspeichereintrag" VALUE 0x714F3 TKW_VV_VV_UB 100.0 FORMULA_0003 0.0 255.0000 /end CHARACTERISTIC
/begin CHARACTERISTIC K_ED_ION_SAT_B2.DEC_VOR_EINTRAG "Filterverringerung vorm Fehlerspeichereintrag" VALUE 0x7150D TKW_VV_VV_UB 100.0 FORMULA_0003 0.0 255.0000 /end CHARACTERISTIC
/begin CHARACTERISTIC K_ED_INDEX_88_IGN.DEC_VOR_EINTRAG "Filterverringerung vorm Fehlerspeichereintrag | EN: Filterverringerung vorm Fehlerspeichereintrag" VALUE 0x7155B TKW_VV_VV_UB 100.0 FORMULA_0003 0.0 255.0000 /end CHARACTERISTIC
/begin CHARACTERISTIC K_ED_INDEX_89_IGN.DEC_VOR_EINTRAG "Filterverringerung vorm Fehlerspeichereintrag" VALUE 0x71575 TKW_VV_VV_UB 100.0 FORMULA_0003 0.0 255.0000 /end CHARACTERISTIC
/begin CHARACTERISTIC K_ED_SG_IGN.DEC_VOR_EINTRAG "Filterverringerung vorm Fehlerspeichereintrag | EN: Fault code SG_IGN - debounce filter decrement before fault-memory entry" VALUE 0x715C3 TKW_VV_VV_UB 100.0 FORMULA_0003 0.0 255.0000 /end CHARACTERISTIC
/begin CHARACTERISTIC K_ED_E2_IGN.DEC_VOR_EINTRAG "Filterverringerung vorm Fehlerspeichereintrag | EN: Fault code E2_IGN - debounce filter decrement before fault-memory entry" VALUE 0x715DD TKW_VV_VV_UB 100.0 FORMULA_0003 0.0 255.0000 /end CHARACTERISTIC
/begin CHARACTERISTIC K_ED_SK_MANAGER_IGN.DEC_VOR_EINTRAG "Filterverringerung vorm Fehlerspeichereintrag | EN: Fault code SK_MANAGER_IGN - debounce filter decrement before fault-memory entry" VALUE 0x71611 TKW_VV_VV_UB 100.0 FORMULA_0003 0.0 255.0000 /end CHARACTERISTIC
/begin CHARACTERISTIC K_ED_LLR_DIAG.DEC_VOR_EINTRAG "Filterverringerung vorm Fehlerspeichereintrag | EN: Fault code LLR_DIAG - debounce filter decrement before fault-memory entry" VALUE 0x7162B TKW_VV_VV_UB 100.0 FORMULA_0003 0.0 255.0000 /end CHARACTERISTIC
/begin CHARACTERISTIC K_ED_DK2_ZUST.DEC_VOR_EINTRAG "Filterverringerung vorm Fehlerspeichereintrag | EN: Fault code DK2_ZUST - debounce filter decrement before fault-memory entry" VALUE 0x71693 TKW_VV_VV_UB 100.0 FORMULA_0003 0.0 255.0000 /end CHARACTERISTIC
/begin CHARACTERISTIC K_ED_FGR_ABWURF.DEC_VOR_EINTRAG "Filterverringerung vorm Fehlerspeichereintrag | EN: Fault code FGR_ABWURF - debounce filter decrement before fault-memory entry" VALUE 0x716AD TKW_VV_VV_UB 100.0 FORMULA_0003 0.0 255.0000 /end CHARACTERISTIC
/begin CHARACTERISTIC K_ED_PWG_BLS.DEC_VOR_EINTRAG "Filterverringerung vorm Fehlerspeichereintrag | EN: Fault code PWG_BLS - debounce filter decrement before fault-memory entry" VALUE 0x716C7 TKW_VV_VV_UB 100.0 FORMULA_0003 0.0 255.0000 /end CHARACTERISTIC
/begin CHARACTERISTIC K_ED_N_GETR_EIN_HS.DEC_VOR_EINTRAG "Filterverringerung vorm Fehlerspeichereintrag | EN: Fault code N_GETR_EIN_HS - debounce filter decrement before fault-memory entry" VALUE 0x71715 TKW_VV_VV_UB 100.0 FORMULA_0003 0.0 255.0000 /end CHARACTERISTIC
/begin CHARACTERISTIC K_ED_LLR_DIAG_CSS.DEC_VOR_EINTRAG "Filterverringerung vorm Fehlerspeichereintrag | EN: Fault code LLR_DIAG_CSS - debounce filter decrement before fault-memory entry" VALUE 0x71749 TKW_VV_VV_UB 100.0 FORMULA_0003 0.0 255.0000 /end CHARACTERISTIC
/begin CHARACTERISTIC K_ED_INDEX_110_IGN.DEC_VOR_EINTRAG "Filterverringerung vorm Fehlerspeichereintrag" VALUE 0x71797 TKW_VV_VV_UB 100.0 FORMULA_0003 0.0 255.0000 /end CHARACTERISTIC
/begin CHARACTERISTIC K_ED_INDEX_111_IGN.DEC_VOR_EINTRAG "Filterverringerung vorm Fehlerspeichereintrag" VALUE 0x717B1 TKW_VV_VV_UB 100.0 FORMULA_0003 0.0 255.0000 /end CHARACTERISTIC
/begin CHARACTERISTIC K_ED_INDEX_112_IGN.DEC_VOR_EINTRAG "Filterverringerung vorm Fehlerspeichereintrag" VALUE 0x717CB TKW_VV_VV_UB 100.0 FORMULA_0003 0.0 255.0000 /end CHARACTERISTIC
/begin CHARACTERISTIC K_ED_INDEX_113_IGN.DEC_VOR_EINTRAG "Filterverringerung vorm Fehlerspeichereintrag" VALUE 0x717E5 TKW_VV_VV_UB 100.0 FORMULA_0003 0.0 255.0000 /end CHARACTERISTIC
/begin CHARACTERISTIC K_ED_INDEX_114_IGN.DEC_VOR_EINTRAG "Filterverringerung vorm Fehlerspeichereintrag" VALUE 0x717FF TKW_VV_VV_UB 100.0 FORMULA_0003 0.0 255.0000 /end CHARACTERISTIC
/begin CHARACTERISTIC K_ED_INDEX_115_IGN.DEC_VOR_EINTRAG "Filterverringerung vorm Fehlerspeichereintrag" VALUE 0x71819 TKW_VV_VV_UB 100.0 FORMULA_0003 0.0 255.0000 /end CHARACTERISTIC
/begin CHARACTERISTIC K_ED_INDEX_116_IGN.DEC_VOR_EINTRAG "Filterverringerung vorm Fehlerspeichereintrag" VALUE 0x71833 TKW_VV_VV_UB 100.0 FORMULA_0003 0.0 255.0000 /end CHARACTERISTIC
/begin CHARACTERISTIC K_ED_INDEX_117_IGN.DEC_VOR_EINTRAG "Filterverringerung vorm Fehlerspeichereintrag" VALUE 0x7184D TKW_VV_VV_UB 100.0 FORMULA_0003 0.0 255.0000 /end CHARACTERISTIC
/begin CHARACTERISTIC K_ED_INDEX_118_IGN.DEC_VOR_EINTRAG "Filterverringerung vorm Fehlerspeichereintrag" VALUE 0x71867 TKW_VV_VV_UB 100.0 FORMULA_0003 0.0 255.0000 /end CHARACTERISTIC
/begin CHARACTERISTIC K_ED_INDEX_119_IGN.DEC_VOR_EINTRAG "Filterverringerung vorm Fehlerspeichereintrag" VALUE 0x71881 TKW_VV_VV_UB 100.0 FORMULA_0003 0.0 255.0000 /end CHARACTERISTIC
/begin CHARACTERISTIC K_ED_INDEX_120_IGN.DEC_VOR_EINTRAG "Filterverringerung vorm Fehlerspeichereintrag" VALUE 0x7189B TKW_VV_VV_UB 100.0 FORMULA_0003 0.0 255.0000 /end CHARACTERISTIC
/begin CHARACTERISTIC K_ED_INDEX_121_IGN.DEC_VOR_EINTRAG "Filterverringerung vorm Fehlerspeichereintrag | EN: Fault code INDEX_121_IGN - debounce filter decrement before fault-memory entry" VALUE 0x718B5 TKW_VV_VV_UB 100.0 FORMULA_0003 0.0 255.0000 /end CHARACTERISTIC
/begin CHARACTERISTIC K_ED_INDEX_122_IGN.DEC_VOR_EINTRAG "Filterverringerung vorm Fehlerspeichereintrag | EN: Fault code INDEX_122_IGN - debounce filter decrement before fault-memory entry" VALUE 0x718CF TKW_VV_VV_UB 100.0 FORMULA_0003 0.0 255.0000 /end CHARACTERISTIC
/begin CHARACTERISTIC K_ED_INDEX_123_IGN.DEC_VOR_EINTRAG "Filterverringerung vorm Fehlerspeichereintrag | EN: Fault code INDEX_123_IGN - debounce filter decrement before fault-memory entry" VALUE 0x718E9 TKW_VV_VV_UB 100.0 FORMULA_0003 0.0 255.0000 /end CHARACTERISTIC
/begin CHARACTERISTIC K_ED_INDEX_124_IGN.DEC_VOR_EINTRAG "Filterverringerung vorm Fehlerspeichereintrag | EN: Fault code INDEX_124_IGN - debounce filter decrement before fault-memory entry" VALUE 0x71903 TKW_VV_VV_UB 100.0 FORMULA_0003 0.0 255.0000 /end CHARACTERISTIC
/begin CHARACTERISTIC K_ED_INDEX_125_IGN.DEC_VOR_EINTRAG "Filterverringerung vorm Fehlerspeichereintrag | EN: Fault code INDEX_125_IGN - debounce filter decrement before fault-memory entry" VALUE 0x7191D TKW_VV_VV_UB 100.0 FORMULA_0003 0.0 255.0000 /end CHARACTERISTIC
/begin CHARACTERISTIC K_ED_INDEX_126_IGN.DEC_VOR_EINTRAG "Filterverringerung vorm Fehlerspeichereintrag | EN: Fault code INDEX_126_IGN - debounce filter decrement before fault-memory entry" VALUE 0x71937 TKW_VV_VV_UB 100.0 FORMULA_0003 0.0 255.0000 /end CHARACTERISTIC
/begin CHARACTERISTIC K_ED_INDEX_127_IGN.DEC_VOR_EINTRAG "Filterverringerung vorm Fehlerspeichereintrag | EN: Fault code INDEX_127_IGN - debounce filter decrement before fault-memory entry" VALUE 0x71951 TKW_VV_VV_UB 100.0 FORMULA_0003 0.0 255.0000 /end CHARACTERISTIC
/begin CHARACTERISTIC K_ED_SK_TR_IGN.INC_NACH_EINTRAG "Filtererhoehung nach Fehlerspeichereintrag | EN: Filtererhoehung nach Fehlerspeichereintrag" VALUE 0x70C6C TKW_VV_VV_UB 100.0 FORMULA_0003 0.0 255.0000 /end CHARACTERISTIC
/begin CHARACTERISTIC K_ED_PWG1.INC_NACH_EINTRAG "Filtererhoehung nach Fehlerspeichereintrag | EN: Fault code PWG1 - debounce filter increment after fault-memory entry" VALUE 0x70DBE TKW_VV_VV_UB 100.0 FORMULA_0003 0.0 255.0000 /end CHARACTERISTIC
/begin CHARACTERISTIC K_ED_PWG2.INC_NACH_EINTRAG "Filtererhoehung nach Fehlerspeichereintrag | EN: Fault code PWG2 - debounce filter increment after fault-memory entry" VALUE 0x70DD8 TKW_VV_VV_UB 100.0 FORMULA_0003 0.0 255.0000 /end CHARACTERISTIC
/begin CHARACTERISTIC K_ED_PWG_VGL.INC_NACH_EINTRAG "Filtererhoehung nach Fehlerspeichereintrag | EN: Fault code PWG_VGL - debounce filter increment after fault-memory entry" VALUE 0x70DF2 TKW_VV_VV_UB 100.0 FORMULA_0003 0.0 255.0000 /end CHARACTERISTIC
/begin CHARACTERISTIC K_ED_PCTRL_IGN.INC_NACH_EINTRAG "Filtererhoehung nach Fehlerspeichereintrag | EN: Fault code PCTRL_IGN - debounce filter increment after fault-memory entry" VALUE 0x70E0C TKW_VV_VV_UB 100.0 FORMULA_0003 0.0 255.0000 /end CHARACTERISTIC
/begin CHARACTERISTIC K_ED_LLS1_CAN.INC_NACH_EINTRAG "Filtererhoehung nach Fehlerspeichereintrag | EN: Fault code LLS1_CAN - debounce filter increment after fault-memory entry" VALUE 0x70E26 TKW_VV_VV_UB 100.0 FORMULA_0003 0.0 255.0000 /end CHARACTERISTIC
/begin CHARACTERISTIC K_ED_LLS2_CAN.INC_NACH_EINTRAG "Filtererhoehung nach Fehlerspeichereintrag | EN: Fault code LLS2_CAN - debounce filter increment after fault-memory entry" VALUE 0x70E40 TKW_VV_VV_UB 100.0 FORMULA_0003 0.0 255.0000 /end CHARACTERISTIC
/begin CHARACTERISTIC K_ED_LLS1_SK.INC_NACH_EINTRAG "Filtererhoehung nach Fehlerspeichereintrag | EN: Fault code LLS1_SK - debounce filter increment after fault-memory entry" VALUE 0x70E8E TKW_VV_VV_UB 100.0 FORMULA_0003 0.0 255.0000 /end CHARACTERISTIC
/begin CHARACTERISTIC K_ED_LLS2_SK.INC_NACH_EINTRAG "Filtererhoehung nach Fehlerspeichereintrag | EN: Fault code LLS2_SK - debounce filter increment after fault-memory entry" VALUE 0x70EA8 TKW_VV_VV_UB 100.0 FORMULA_0003 0.0 255.0000 /end CHARACTERISTIC
/begin CHARACTERISTIC K_ED_SMG_SCHALTAB.INC_NACH_EINTRAG "Filtererhoehung nach Fehlerspeichereintrag | EN: Fault code SMG_SCHALTAB - debounce filter increment after fault-memory entry" VALUE 0x70EC2 TKW_VV_VV_UB 100.0 FORMULA_0003 0.0 255.0000 /end CHARACTERISTIC
/begin CHARACTERISTIC K_ED_DK_INIT.INC_NACH_EINTRAG "Filtererhoehung nach Fehlerspeichereintrag | EN: Fault code DK_INIT - debounce filter increment after fault-memory entry" VALUE 0x70F44 TKW_VV_VV_UB 100.0 FORMULA_0003 0.0 255.0000 /end CHARACTERISTIC
/begin CHARACTERISTIC K_ED_IONVERST_B1.INC_NACH_EINTRAG "Filtererhoehung nach Fehlerspeichereintrag" VALUE 0x70FC6 TKW_VV_VV_UB 100.0 FORMULA_0003 0.0 255.0000 /end CHARACTERISTIC
/begin CHARACTERISTIC K_ED_IONSPG_B1.INC_NACH_EINTRAG "Filtererhoehung nach Fehlerspeichereintrag" VALUE 0x70FE0 TKW_VV_VV_UB 100.0 FORMULA_0003 0.0 255.0000 /end CHARACTERISTIC
/begin CHARACTERISTIC K_ED_IONVERST_B2.INC_NACH_EINTRAG "Filtererhoehung nach Fehlerspeichereintrag" VALUE 0x70FFA TKW_VV_VV_UB 100.0 FORMULA_0003 0.0 255.0000 /end CHARACTERISTIC
/begin CHARACTERISTIC K_ED_IONSPG_B2.INC_NACH_EINTRAG "Filtererhoehung nach Fehlerspeichereintrag" VALUE 0x71014 TKW_VV_VV_UB 100.0 FORMULA_0003 0.0 255.0000 /end CHARACTERISTIC
/begin CHARACTERISTIC K_ED_DK2_WDK.INC_NACH_EINTRAG "Filtererhoehung nach Fehlerspeichereintrag | EN: Fault code DK2_WDK - debounce filter increment after fault-memory entry" VALUE 0x7107C TKW_VV_VV_UB 100.0 FORMULA_0003 0.0 255.0000 /end CHARACTERISTIC
/begin CHARACTERISTIC K_ED_LLS1_REGLER.INC_NACH_EINTRAG "Filtererhoehung nach Fehlerspeichereintrag | EN: Fault code LLS1_REGLER - debounce filter increment after fault-memory entry" VALUE 0x710CA TKW_VV_VV_UB 100.0 FORMULA_0003 0.0 255.0000 /end CHARACTERISTIC
/begin CHARACTERISTIC K_ED_LLS2_REGLER.INC_NACH_EINTRAG "Filtererhoehung nach Fehlerspeichereintrag | EN: Fault code LLS2_REGLER - debounce filter increment after fault-memory entry" VALUE 0x710E4 TKW_VV_VV_UB 100.0 FORMULA_0003 0.0 255.0000 /end CHARACTERISTIC
/begin CHARACTERISTIC K_ED_DK2_SK_ERR.INC_NACH_EINTRAG "Filtererhoehung nach Fehlerspeichereintrag | EN: Fault code DK2_SK_ERR - debounce filter increment after fault-memory entry" VALUE 0x71118 TKW_VV_VV_UB 100.0 FORMULA_0003 0.0 255.0000 /end CHARACTERISTIC
/begin CHARACTERISTIC K_ED_MD_SK_ERR.INC_NACH_EINTRAG "Filtererhoehung nach Fehlerspeichereintrag | EN: Fault code MD_SK_ERR - debounce filter increment after fault-memory entry" VALUE 0x71166 TKW_VV_VV_UB 100.0 FORMULA_0003 0.0 255.0000 /end CHARACTERISTIC
/begin CHARACTERISTIC K_ED_LLS_INIT.INC_NACH_EINTRAG "Filtererhoehung nach Fehlerspeichereintrag | EN: Fault code LLS_INIT - debounce filter increment after fault-memory entry" VALUE 0x71180 TKW_VV_VV_UB 100.0 FORMULA_0003 0.0 255.0000 /end CHARACTERISTIC
/begin CHARACTERISTIC K_ED_DSC_EINGR.INC_NACH_EINTRAG "Filtererhoehung nach Fehlerspeichereintrag | EN: Fault code DSC_EINGR - debounce filter increment after fault-memory entry" VALUE 0x7119A TKW_VV_VV_UB 100.0 FORMULA_0003 0.0 255.0000 /end CHARACTERISTIC
/begin CHARACTERISTIC K_ED_LLS1_CMD.INC_NACH_EINTRAG "Filtererhoehung nach Fehlerspeichereintrag | EN: Fault code LLS1_CMD - debounce filter increment after fault-memory entry" VALUE 0x711E8 TKW_VV_VV_UB 100.0 FORMULA_0003 0.0 255.0000 /end CHARACTERISTIC
/begin CHARACTERISTIC K_ED_LLS2_CMD.INC_NACH_EINTRAG "Filtererhoehung nach Fehlerspeichereintrag | EN: Fault code LLS2_CMD - debounce filter increment after fault-memory entry" VALUE 0x71202 TKW_VV_VV_UB 100.0 FORMULA_0003 0.0 255.0000 /end CHARACTERISTIC
/begin CHARACTERISTIC K_ED_SC_SMG1.INC_NACH_EINTRAG "Filtererhoehung nach Fehlerspeichereintrag | EN: Fault code SC_SMG1 - debounce filter increment after fault-memory entry" VALUE 0x7121C TKW_VV_VV_UB 100.0 FORMULA_0003 0.0 255.0000 /end CHARACTERISTIC
/begin CHARACTERISTIC K_ED_SC_SMG2.INC_NACH_EINTRAG "Filtererhoehung nach Fehlerspeichereintrag | EN: Fault code SC_SMG2 - debounce filter increment after fault-memory entry" VALUE 0x71236 TKW_VV_VV_UB 100.0 FORMULA_0003 0.0 255.0000 /end CHARACTERISTIC
/begin CHARACTERISTIC K_ED_SC_SMG3.INC_NACH_EINTRAG "Filtererhoehung nach Fehlerspeichereintrag | EN: Fault code SC_SMG3 - debounce filter increment after fault-memory entry" VALUE 0x71250 TKW_VV_VV_UB 100.0 FORMULA_0003 0.0 255.0000 /end CHARACTERISTIC
/begin CHARACTERISTIC K_ED_SC_BUSOFF.INC_NACH_EINTRAG "Filtererhoehung nach Fehlerspeichereintrag | EN: Fault code SC_BUSOFF - debounce filter increment after fault-memory entry" VALUE 0x7126A TKW_VV_VV_UB 100.0 FORMULA_0003 0.0 255.0000 /end CHARACTERISTIC
/begin CHARACTERISTIC K_ED_EC_BUSOFF.INC_NACH_EINTRAG "Filtererhoehung nach Fehlerspeichereintrag | EN: Fault code EC_BUSOFF - debounce filter increment after fault-memory entry" VALUE 0x71284 TKW_VV_VV_UB 100.0 FORMULA_0003 0.0 255.0000 /end CHARACTERISTIC
/begin CHARACTERISTIC K_ED_ION_SIG_B1.INC_NACH_EINTRAG "Filtererhoehung nach Fehlerspeichereintrag" VALUE 0x713A2 TKW_VV_VV_UB 100.0 FORMULA_0003 0.0 255.0000 /end CHARACTERISTIC
/begin CHARACTERISTIC K_ED_ION_SIG_B2.INC_NACH_EINTRAG "Filtererhoehung nach Fehlerspeichereintrag" VALUE 0x713BC TKW_VV_VV_UB 100.0 FORMULA_0003 0.0 255.0000 /end CHARACTERISTIC
/begin CHARACTERISTIC K_ED_ION_SAT_B1.INC_NACH_EINTRAG "Filtererhoehung nach Fehlerspeichereintrag" VALUE 0x714F4 TKW_VV_VV_UB 100.0 FORMULA_0003 0.0 255.0000 /end CHARACTERISTIC
/begin CHARACTERISTIC K_ED_ION_SAT_B2.INC_NACH_EINTRAG "Filtererhoehung nach Fehlerspeichereintrag" VALUE 0x7150E TKW_VV_VV_UB 100.0 FORMULA_0003 0.0 255.0000 /end CHARACTERISTIC
/begin CHARACTERISTIC K_ED_INDEX_88_IGN.INC_NACH_EINTRAG "Filtererhoehung nach Fehlerspeichereintrag | EN: Filtererhoehung nach Fehlerspeichereintrag" VALUE 0x7155C TKW_VV_VV_UB 100.0 FORMULA_0003 0.0 255.0000 /end CHARACTERISTIC
/begin CHARACTERISTIC K_ED_INDEX_89_IGN.INC_NACH_EINTRAG "Filtererhoehung nach Fehlerspeichereintrag" VALUE 0x71576 TKW_VV_VV_UB 100.0 FORMULA_0003 0.0 255.0000 /end CHARACTERISTIC
/begin CHARACTERISTIC K_ED_SG_IGN.INC_NACH_EINTRAG "Filtererhoehung nach Fehlerspeichereintrag | EN: Fault code SG_IGN - debounce filter increment after fault-memory entry" VALUE 0x715C4 TKW_VV_VV_UB 100.0 FORMULA_0003 0.0 255.0000 /end CHARACTERISTIC
/begin CHARACTERISTIC K_ED_E2_IGN.INC_NACH_EINTRAG "Filtererhoehung nach Fehlerspeichereintrag | EN: Fault code E2_IGN - debounce filter increment after fault-memory entry" VALUE 0x715DE TKW_VV_VV_UB 100.0 FORMULA_0003 0.0 255.0000 /end CHARACTERISTIC
/begin CHARACTERISTIC K_ED_SK_MANAGER_IGN.INC_NACH_EINTRAG "Filtererhoehung nach Fehlerspeichereintrag | EN: Fault code SK_MANAGER_IGN - debounce filter increment after fault-memory entry" VALUE 0x71612 TKW_VV_VV_UB 100.0 FORMULA_0003 0.0 255.0000 /end CHARACTERISTIC
/begin CHARACTERISTIC K_ED_LLR_DIAG.INC_NACH_EINTRAG "Filtererhoehung nach Fehlerspeichereintrag | EN: Fault code LLR_DIAG - debounce filter increment after fault-memory entry" VALUE 0x7162C TKW_VV_VV_UB 100.0 FORMULA_0003 0.0 255.0000 /end CHARACTERISTIC
/begin CHARACTERISTIC K_ED_DK2_ZUST.INC_NACH_EINTRAG "Filtererhoehung nach Fehlerspeichereintrag | EN: Fault code DK2_ZUST - debounce filter increment after fault-memory entry" VALUE 0x71694 TKW_VV_VV_UB 100.0 FORMULA_0003 0.0 255.0000 /end CHARACTERISTIC
/begin CHARACTERISTIC K_ED_FGR_ABWURF.INC_NACH_EINTRAG "Filtererhoehung nach Fehlerspeichereintrag | EN: Fault code FGR_ABWURF - debounce filter increment after fault-memory entry" VALUE 0x716AE TKW_VV_VV_UB 100.0 FORMULA_0003 0.0 255.0000 /end CHARACTERISTIC
/begin CHARACTERISTIC K_ED_PWG_BLS.INC_NACH_EINTRAG "Filtererhoehung nach Fehlerspeichereintrag | EN: Fault code PWG_BLS - debounce filter increment after fault-memory entry" VALUE 0x716C8 TKW_VV_VV_UB 100.0 FORMULA_0003 0.0 255.0000 /end CHARACTERISTIC
/begin CHARACTERISTIC K_ED_N_GETR_EIN_HS.INC_NACH_EINTRAG "Filtererhoehung nach Fehlerspeichereintrag | EN: Fault code N_GETR_EIN_HS - debounce filter increment after fault-memory entry" VALUE 0x71716 TKW_VV_VV_UB 100.0 FORMULA_0003 0.0 255.0000 /end CHARACTERISTIC
/begin CHARACTERISTIC K_ED_LLR_DIAG_CSS.INC_NACH_EINTRAG "Filtererhoehung nach Fehlerspeichereintrag | EN: Fault code LLR_DIAG_CSS - debounce filter increment after fault-memory entry" VALUE 0x7174A TKW_VV_VV_UB 100.0 FORMULA_0003 0.0 255.0000 /end CHARACTERISTIC
/begin CHARACTERISTIC K_ED_INDEX_110_IGN.INC_NACH_EINTRAG "Filtererhoehung nach Fehlerspeichereintrag" VALUE 0x71798 TKW_VV_VV_UB 100.0 FORMULA_0003 0.0 255.0000 /end CHARACTERISTIC
/begin CHARACTERISTIC K_ED_INDEX_111_IGN.INC_NACH_EINTRAG "Filtererhoehung nach Fehlerspeichereintrag" VALUE 0x717B2 TKW_VV_VV_UB 100.0 FORMULA_0003 0.0 255.0000 /end CHARACTERISTIC
/begin CHARACTERISTIC K_ED_INDEX_112_IGN.INC_NACH_EINTRAG "Filtererhoehung nach Fehlerspeichereintrag" VALUE 0x717CC TKW_VV_VV_UB 100.0 FORMULA_0003 0.0 255.0000 /end CHARACTERISTIC
/begin CHARACTERISTIC K_ED_INDEX_113_IGN.INC_NACH_EINTRAG "Filtererhoehung nach Fehlerspeichereintrag" VALUE 0x717E6 TKW_VV_VV_UB 100.0 FORMULA_0003 0.0 255.0000 /end CHARACTERISTIC
/begin CHARACTERISTIC K_ED_INDEX_114_IGN.INC_NACH_EINTRAG "Filtererhoehung nach Fehlerspeichereintrag" VALUE 0x71800 TKW_VV_VV_UB 100.0 FORMULA_0003 0.0 255.0000 /end CHARACTERISTIC
/begin CHARACTERISTIC K_ED_INDEX_115_IGN.INC_NACH_EINTRAG "Filtererhoehung nach Fehlerspeichereintrag" VALUE 0x7181A TKW_VV_VV_UB 100.0 FORMULA_0003 0.0 255.0000 /end CHARACTERISTIC
/begin CHARACTERISTIC K_ED_INDEX_116_IGN.INC_NACH_EINTRAG "Filtererhoehung nach Fehlerspeichereintrag" VALUE 0x71834 TKW_VV_VV_UB 100.0 FORMULA_0003 0.0 255.0000 /end CHARACTERISTIC
/begin CHARACTERISTIC K_ED_INDEX_117_IGN.INC_NACH_EINTRAG "Filtererhoehung nach Fehlerspeichereintrag" VALUE 0x7184E TKW_VV_VV_UB 100.0 FORMULA_0003 0.0 255.0000 /end CHARACTERISTIC
/begin CHARACTERISTIC K_ED_INDEX_118_IGN.INC_NACH_EINTRAG "Filtererhoehung nach Fehlerspeichereintrag" VALUE 0x71868 TKW_VV_VV_UB 100.0 FORMULA_0003 0.0 255.0000 /end CHARACTERISTIC
/begin CHARACTERISTIC K_ED_INDEX_119_IGN.INC_NACH_EINTRAG "Filtererhoehung nach Fehlerspeichereintrag" VALUE 0x71882 TKW_VV_VV_UB 100.0 FORMULA_0003 0.0 255.0000 /end CHARACTERISTIC
/begin CHARACTERISTIC K_ED_INDEX_120_IGN.INC_NACH_EINTRAG "Filtererhoehung nach Fehlerspeichereintrag" VALUE 0x7189C TKW_VV_VV_UB 100.0 FORMULA_0003 0.0 255.0000 /end CHARACTERISTIC
/begin CHARACTERISTIC K_ED_INDEX_121_IGN.INC_NACH_EINTRAG "Filtererhoehung nach Fehlerspeichereintrag | EN: Fault code INDEX_121_IGN - debounce filter increment after fault-memory entry" VALUE 0x718B6 TKW_VV_VV_UB 100.0 FORMULA_0003 0.0 255.0000 /end CHARACTERISTIC
/begin CHARACTERISTIC K_ED_INDEX_122_IGN.INC_NACH_EINTRAG "Filtererhoehung nach Fehlerspeichereintrag | EN: Fault code INDEX_122_IGN - debounce filter increment after fault-memory entry" VALUE 0x718D0 TKW_VV_VV_UB 100.0 FORMULA_0003 0.0 255.0000 /end CHARACTERISTIC
/begin CHARACTERISTIC K_ED_INDEX_123_IGN.INC_NACH_EINTRAG "Filtererhoehung nach Fehlerspeichereintrag | EN: Fault code INDEX_123_IGN - debounce filter increment after fault-memory entry" VALUE 0x718EA TKW_VV_VV_UB 100.0 FORMULA_0003 0.0 255.0000 /end CHARACTERISTIC
/begin CHARACTERISTIC K_ED_INDEX_124_IGN.INC_NACH_EINTRAG "Filtererhoehung nach Fehlerspeichereintrag | EN: Fault code INDEX_124_IGN - debounce filter increment after fault-memory entry" VALUE 0x71904 TKW_VV_VV_UB 100.0 FORMULA_0003 0.0 255.0000 /end CHARACTERISTIC
/begin CHARACTERISTIC K_ED_INDEX_125_IGN.INC_NACH_EINTRAG "Filtererhoehung nach Fehlerspeichereintrag | EN: Fault code INDEX_125_IGN - debounce filter increment after fault-memory entry" VALUE 0x7191E TKW_VV_VV_UB 100.0 FORMULA_0003 0.0 255.0000 /end CHARACTERISTIC
/begin CHARACTERISTIC K_ED_INDEX_126_IGN.INC_NACH_EINTRAG "Filtererhoehung nach Fehlerspeichereintrag | EN: Fault code INDEX_126_IGN - debounce filter increment after fault-memory entry" VALUE 0x71938 TKW_VV_VV_UB 100.0 FORMULA_0003 0.0 255.0000 /end CHARACTERISTIC
/begin CHARACTERISTIC K_ED_INDEX_127_IGN.INC_NACH_EINTRAG "Filtererhoehung nach Fehlerspeichereintrag | EN: Fault code INDEX_127_IGN - debounce filter increment after fault-memory entry" VALUE 0x71952 TKW_VV_VV_UB 100.0 FORMULA_0003 0.0 255.0000 /end CHARACTERISTIC
/begin CHARACTERISTIC K_ED_SK_TR_IGN.DEC_NACH_EINTRAG "Filterverringerung nach Fehlerspeichereintrag | EN: Filterverringerung nach Fehlerspeichereintrag" VALUE 0x70C6D TKW_VV_VV_UB 100.0 FORMULA_0003 0.0 255.0000 /end CHARACTERISTIC
/begin CHARACTERISTIC K_ED_PWG1.DEC_NACH_EINTRAG "Filterverringerung nach Fehlerspeichereintrag | EN: Fault code PWG1 - debounce filter decrement after fault-memory entry" VALUE 0x70DBF TKW_VV_VV_UB 100.0 FORMULA_0003 0.0 255.0000 /end CHARACTERISTIC
/begin CHARACTERISTIC K_ED_PWG2.DEC_NACH_EINTRAG "Filterverringerung nach Fehlerspeichereintrag | EN: Fault code PWG2 - debounce filter decrement after fault-memory entry" VALUE 0x70DD9 TKW_VV_VV_UB 100.0 FORMULA_0003 0.0 255.0000 /end CHARACTERISTIC
/begin CHARACTERISTIC K_ED_PWG_VGL.DEC_NACH_EINTRAG "Filterverringerung nach Fehlerspeichereintrag | EN: Fault code PWG_VGL - debounce filter decrement after fault-memory entry" VALUE 0x70DF3 TKW_VV_VV_UB 100.0 FORMULA_0003 0.0 255.0000 /end CHARACTERISTIC
/begin CHARACTERISTIC K_ED_PCTRL_IGN.DEC_NACH_EINTRAG "Filterverringerung nach Fehlerspeichereintrag | EN: Fault code PCTRL_IGN - debounce filter decrement after fault-memory entry" VALUE 0x70E0D TKW_VV_VV_UB 100.0 FORMULA_0003 0.0 255.0000 /end CHARACTERISTIC
/begin CHARACTERISTIC K_ED_LLS1_CAN.DEC_NACH_EINTRAG "Filterverringerung nach Fehlerspeichereintrag | EN: Fault code LLS1_CAN - debounce filter decrement after fault-memory entry" VALUE 0x70E27 TKW_VV_VV_UB 100.0 FORMULA_0003 0.0 255.0000 /end CHARACTERISTIC
/begin CHARACTERISTIC K_ED_LLS2_CAN.DEC_NACH_EINTRAG "Filterverringerung nach Fehlerspeichereintrag | EN: Fault code LLS2_CAN - debounce filter decrement after fault-memory entry" VALUE 0x70E41 TKW_VV_VV_UB 100.0 FORMULA_0003 0.0 255.0000 /end CHARACTERISTIC
/begin CHARACTERISTIC K_ED_LLS1_SK.DEC_NACH_EINTRAG "Filterverringerung nach Fehlerspeichereintrag | EN: Fault code LLS1_SK - debounce filter decrement after fault-memory entry" VALUE 0x70E8F TKW_VV_VV_UB 100.0 FORMULA_0003 0.0 255.0000 /end CHARACTERISTIC
/begin CHARACTERISTIC K_ED_LLS2_SK.DEC_NACH_EINTRAG "Filterverringerung nach Fehlerspeichereintrag | EN: Fault code LLS2_SK - debounce filter decrement after fault-memory entry" VALUE 0x70EA9 TKW_VV_VV_UB 100.0 FORMULA_0003 0.0 255.0000 /end CHARACTERISTIC
/begin CHARACTERISTIC K_ED_SMG_SCHALTAB.DEC_NACH_EINTRAG "Filterverringerung nach Fehlerspeichereintrag | EN: Fault code SMG_SCHALTAB - debounce filter decrement after fault-memory entry" VALUE 0x70EC3 TKW_VV_VV_UB 100.0 FORMULA_0003 0.0 255.0000 /end CHARACTERISTIC
/begin CHARACTERISTIC K_ED_SMG_SK.DEC_NACH_EINTRAG "Filterverringerung nach Fehlerspeichereintrag | EN: Fault code SMG_SK - debounce filter decrement after fault-memory entry" VALUE 0x70EDD TKW_VV_VV_UB 100.0 FORMULA_0003 0.0 255.0000 /end CHARACTERISTIC
/begin CHARACTERISTIC K_ED_DK_INIT.DEC_NACH_EINTRAG "Filterverringerung nach Fehlerspeichereintrag | EN: Fault code DK_INIT - debounce filter decrement after fault-memory entry" VALUE 0x70F45 TKW_VV_VV_UB 100.0 FORMULA_0003 0.0 255.0000 /end CHARACTERISTIC
/begin CHARACTERISTIC K_ED_IONVERST_B1.DEC_NACH_EINTRAG "Filterverringerung nach Fehlerspeichereintrag" VALUE 0x70FC7 TKW_VV_VV_UB 100.0 FORMULA_0003 0.0 255.0000 /end CHARACTERISTIC
/begin CHARACTERISTIC K_ED_IONSPG_B1.DEC_NACH_EINTRAG "Filterverringerung nach Fehlerspeichereintrag" VALUE 0x70FE1 TKW_VV_VV_UB 100.0 FORMULA_0003 0.0 255.0000 /end CHARACTERISTIC
/begin CHARACTERISTIC K_ED_IONVERST_B2.DEC_NACH_EINTRAG "Filterverringerung nach Fehlerspeichereintrag" VALUE 0x70FFB TKW_VV_VV_UB 100.0 FORMULA_0003 0.0 255.0000 /end CHARACTERISTIC
/begin CHARACTERISTIC K_ED_IONSPG_B2.DEC_NACH_EINTRAG "Filterverringerung nach Fehlerspeichereintrag" VALUE 0x71015 TKW_VV_VV_UB 100.0 FORMULA_0003 0.0 255.0000 /end CHARACTERISTIC
/begin CHARACTERISTIC K_ED_DK2_WDK.DEC_NACH_EINTRAG "Filterverringerung nach Fehlerspeichereintrag | EN: Fault code DK2_WDK - debounce filter decrement after fault-memory entry" VALUE 0x7107D TKW_VV_VV_UB 100.0 FORMULA_0003 0.0 255.0000 /end CHARACTERISTIC
/begin CHARACTERISTIC K_ED_LLS1_REGLER.DEC_NACH_EINTRAG "Filterverringerung nach Fehlerspeichereintrag | EN: Fault code LLS1_REGLER - debounce filter decrement after fault-memory entry" VALUE 0x710CB TKW_VV_VV_UB 100.0 FORMULA_0003 0.0 255.0000 /end CHARACTERISTIC
/begin CHARACTERISTIC K_ED_LLS2_REGLER.DEC_NACH_EINTRAG "Filterverringerung nach Fehlerspeichereintrag | EN: Fault code LLS2_REGLER - debounce filter decrement after fault-memory entry" VALUE 0x710E5 TKW_VV_VV_UB 100.0 FORMULA_0003 0.0 255.0000 /end CHARACTERISTIC
/begin CHARACTERISTIC K_ED_DK2_SK_ERR.DEC_NACH_EINTRAG "Filterverringerung nach Fehlerspeichereintrag | EN: Fault code DK2_SK_ERR - debounce filter decrement after fault-memory entry" VALUE 0x71119 TKW_VV_VV_UB 100.0 FORMULA_0003 0.0 255.0000 /end CHARACTERISTIC
/begin CHARACTERISTIC K_ED_MD_SK_ERR.DEC_NACH_EINTRAG "Filterverringerung nach Fehlerspeichereintrag | EN: Fault code MD_SK_ERR - debounce filter decrement after fault-memory entry" VALUE 0x71167 TKW_VV_VV_UB 100.0 FORMULA_0003 0.0 255.0000 /end CHARACTERISTIC
/begin CHARACTERISTIC K_ED_LLS_INIT.DEC_NACH_EINTRAG "Filterverringerung nach Fehlerspeichereintrag | EN: Fault code LLS_INIT - debounce filter decrement after fault-memory entry" VALUE 0x71181 TKW_VV_VV_UB 100.0 FORMULA_0003 0.0 255.0000 /end CHARACTERISTIC
/begin CHARACTERISTIC K_ED_DSC_EINGR.DEC_NACH_EINTRAG "Filterverringerung nach Fehlerspeichereintrag | EN: Fault code DSC_EINGR - debounce filter decrement after fault-memory entry" VALUE 0x7119B TKW_VV_VV_UB 100.0 FORMULA_0003 0.0 255.0000 /end CHARACTERISTIC
/begin CHARACTERISTIC K_ED_LLS1_CMD.DEC_NACH_EINTRAG "Filterverringerung nach Fehlerspeichereintrag | EN: Fault code LLS1_CMD - debounce filter decrement after fault-memory entry" VALUE 0x711E9 TKW_VV_VV_UB 100.0 FORMULA_0003 0.0 255.0000 /end CHARACTERISTIC
/begin CHARACTERISTIC K_ED_LLS2_CMD.DEC_NACH_EINTRAG "Filterverringerung nach Fehlerspeichereintrag | EN: Fault code LLS2_CMD - debounce filter decrement after fault-memory entry" VALUE 0x71203 TKW_VV_VV_UB 100.0 FORMULA_0003 0.0 255.0000 /end CHARACTERISTIC
/begin CHARACTERISTIC K_ED_SC_SMG1.DEC_NACH_EINTRAG "Filterverringerung nach Fehlerspeichereintrag | EN: Fault code SC_SMG1 - debounce filter decrement after fault-memory entry" VALUE 0x7121D TKW_VV_VV_UB 100.0 FORMULA_0003 0.0 255.0000 /end CHARACTERISTIC
/begin CHARACTERISTIC K_ED_SC_SMG2.DEC_NACH_EINTRAG "Filterverringerung nach Fehlerspeichereintrag | EN: Fault code SC_SMG2 - debounce filter decrement after fault-memory entry" VALUE 0x71237 TKW_VV_VV_UB 100.0 FORMULA_0003 0.0 255.0000 /end CHARACTERISTIC
/begin CHARACTERISTIC K_ED_SC_SMG3.DEC_NACH_EINTRAG "Filterverringerung nach Fehlerspeichereintrag | EN: Fault code SC_SMG3 - debounce filter decrement after fault-memory entry" VALUE 0x71251 TKW_VV_VV_UB 100.0 FORMULA_0003 0.0 255.0000 /end CHARACTERISTIC
/begin CHARACTERISTIC K_ED_SC_BUSOFF.DEC_NACH_EINTRAG "Filterverringerung nach Fehlerspeichereintrag | EN: Fault code SC_BUSOFF - debounce filter decrement after fault-memory entry" VALUE 0x7126B TKW_VV_VV_UB 100.0 FORMULA_0003 0.0 255.0000 /end CHARACTERISTIC
/begin CHARACTERISTIC K_ED_EC_BUSOFF.DEC_NACH_EINTRAG "Filterverringerung nach Fehlerspeichereintrag | EN: Fault code EC_BUSOFF - debounce filter decrement after fault-memory entry" VALUE 0x71285 TKW_VV_VV_UB 100.0 FORMULA_0003 0.0 255.0000 /end CHARACTERISTIC
/begin CHARACTERISTIC K_ED_ION_SIG_B1.DEC_NACH_EINTRAG "Filterverringerung nach Fehlerspeichereintrag" VALUE 0x713A3 TKW_VV_VV_UB 100.0 FORMULA_0003 0.0 255.0000 /end CHARACTERISTIC
/begin CHARACTERISTIC K_ED_ION_SIG_B2.DEC_NACH_EINTRAG "Filterverringerung nach Fehlerspeichereintrag" VALUE 0x713BD TKW_VV_VV_UB 100.0 FORMULA_0003 0.0 255.0000 /end CHARACTERISTIC
/begin CHARACTERISTIC K_ED_ION_SAT_B1.DEC_NACH_EINTRAG "Filterverringerung nach Fehlerspeichereintrag" VALUE 0x714F5 TKW_VV_VV_UB 100.0 FORMULA_0003 0.0 255.0000 /end CHARACTERISTIC
/begin CHARACTERISTIC K_ED_ION_SAT_B2.DEC_NACH_EINTRAG "Filterverringerung nach Fehlerspeichereintrag" VALUE 0x7150F TKW_VV_VV_UB 100.0 FORMULA_0003 0.0 255.0000 /end CHARACTERISTIC
/begin CHARACTERISTIC K_ED_INDEX_88_IGN.DEC_NACH_EINTRAG "Filterverringerung nach Fehlerspeichereintrag | EN: Filterverringerung nach Fehlerspeichereintrag" VALUE 0x7155D TKW_VV_VV_UB 100.0 FORMULA_0003 0.0 255.0000 /end CHARACTERISTIC
/begin CHARACTERISTIC K_ED_INDEX_89_IGN.DEC_NACH_EINTRAG "Filterverringerung nach Fehlerspeichereintrag" VALUE 0x71577 TKW_VV_VV_UB 100.0 FORMULA_0003 0.0 255.0000 /end CHARACTERISTIC
/begin CHARACTERISTIC K_ED_SG_IGN.DEC_NACH_EINTRAG "Filterverringerung nach Fehlerspeichereintrag | EN: Fault code SG_IGN - debounce filter decrement after fault-memory entry" VALUE 0x715C5 TKW_VV_VV_UB 100.0 FORMULA_0003 0.0 255.0000 /end CHARACTERISTIC
/begin CHARACTERISTIC K_ED_E2_IGN.DEC_NACH_EINTRAG "Filterverringerung nach Fehlerspeichereintrag | EN: Fault code E2_IGN - debounce filter decrement after fault-memory entry" VALUE 0x715DF TKW_VV_VV_UB 100.0 FORMULA_0003 0.0 255.0000 /end CHARACTERISTIC
/begin CHARACTERISTIC K_ED_SK_MANAGER_IGN.DEC_NACH_EINTRAG "Filterverringerung nach Fehlerspeichereintrag | EN: Fault code SK_MANAGER_IGN - debounce filter decrement after fault-memory entry" VALUE 0x71613 TKW_VV_VV_UB 100.0 FORMULA_0003 0.0 255.0000 /end CHARACTERISTIC
/begin CHARACTERISTIC K_ED_LLR_DIAG.DEC_NACH_EINTRAG "Filterverringerung nach Fehlerspeichereintrag | EN: Fault code LLR_DIAG - debounce filter decrement after fault-memory entry" VALUE 0x7162D TKW_VV_VV_UB 100.0 FORMULA_0003 0.0 255.0000 /end CHARACTERISTIC
/begin CHARACTERISTIC K_ED_DK2_ZUST.DEC_NACH_EINTRAG "Filterverringerung nach Fehlerspeichereintrag | EN: Fault code DK2_ZUST - debounce filter decrement after fault-memory entry" VALUE 0x71695 TKW_VV_VV_UB 100.0 FORMULA_0003 0.0 255.0000 /end CHARACTERISTIC
/begin CHARACTERISTIC K_ED_FGR_ABWURF.DEC_NACH_EINTRAG "Filterverringerung nach Fehlerspeichereintrag | EN: Fault code FGR_ABWURF - debounce filter decrement after fault-memory entry" VALUE 0x716AF TKW_VV_VV_UB 100.0 FORMULA_0003 0.0 255.0000 /end CHARACTERISTIC
/begin CHARACTERISTIC K_ED_PWG_BLS.DEC_NACH_EINTRAG "Filterverringerung nach Fehlerspeichereintrag | EN: Fault code PWG_BLS - debounce filter decrement after fault-memory entry" VALUE 0x716C9 TKW_VV_VV_UB 100.0 FORMULA_0003 0.0 255.0000 /end CHARACTERISTIC
/begin CHARACTERISTIC K_ED_N_GETR_EIN_HS.DEC_NACH_EINTRAG "Filterverringerung nach Fehlerspeichereintrag | EN: Fault code N_GETR_EIN_HS - debounce filter decrement after fault-memory entry" VALUE 0x71717 TKW_VV_VV_UB 100.0 FORMULA_0003 0.0 255.0000 /end CHARACTERISTIC
/begin CHARACTERISTIC K_ED_LLR_DIAG_CSS.DEC_NACH_EINTRAG "Filterverringerung nach Fehlerspeichereintrag | EN: Fault code LLR_DIAG_CSS - debounce filter decrement after fault-memory entry" VALUE 0x7174B TKW_VV_VV_UB 100.0 FORMULA_0003 0.0 255.0000 /end CHARACTERISTIC
/begin CHARACTERISTIC K_ED_INDEX_110_IGN.DEC_NACH_EINTRAG "Filterverringerung nach Fehlerspeichereintrag" VALUE 0x71799 TKW_VV_VV_UB 100.0 FORMULA_0003 0.0 255.0000 /end CHARACTERISTIC
/begin CHARACTERISTIC K_ED_INDEX_111_IGN.DEC_NACH_EINTRAG "Filterverringerung nach Fehlerspeichereintrag" VALUE 0x717B3 TKW_VV_VV_UB 100.0 FORMULA_0003 0.0 255.0000 /end CHARACTERISTIC
/begin CHARACTERISTIC K_ED_INDEX_112_IGN.DEC_NACH_EINTRAG "Filterverringerung nach Fehlerspeichereintrag" VALUE 0x717CD TKW_VV_VV_UB 100.0 FORMULA_0003 0.0 255.0000 /end CHARACTERISTIC
/begin CHARACTERISTIC K_ED_INDEX_113_IGN.DEC_NACH_EINTRAG "Filterverringerung nach Fehlerspeichereintrag" VALUE 0x717E7 TKW_VV_VV_UB 100.0 FORMULA_0003 0.0 255.0000 /end CHARACTERISTIC
/begin CHARACTERISTIC K_ED_INDEX_114_IGN.DEC_NACH_EINTRAG "Filterverringerung nach Fehlerspeichereintrag" VALUE 0x71801 TKW_VV_VV_UB 100.0 FORMULA_0003 0.0 255.0000 /end CHARACTERISTIC
/begin CHARACTERISTIC K_ED_INDEX_115_IGN.DEC_NACH_EINTRAG "Filterverringerung nach Fehlerspeichereintrag" VALUE 0x7181B TKW_VV_VV_UB 100.0 FORMULA_0003 0.0 255.0000 /end CHARACTERISTIC
/begin CHARACTERISTIC K_ED_INDEX_116_IGN.DEC_NACH_EINTRAG "Filterverringerung nach Fehlerspeichereintrag" VALUE 0x71835 TKW_VV_VV_UB 100.0 FORMULA_0003 0.0 255.0000 /end CHARACTERISTIC
/begin CHARACTERISTIC K_ED_INDEX_117_IGN.DEC_NACH_EINTRAG "Filterverringerung nach Fehlerspeichereintrag" VALUE 0x7184F TKW_VV_VV_UB 100.0 FORMULA_0003 0.0 255.0000 /end CHARACTERISTIC
/begin CHARACTERISTIC K_ED_INDEX_118_IGN.DEC_NACH_EINTRAG "Filterverringerung nach Fehlerspeichereintrag" VALUE 0x71869 TKW_VV_VV_UB 100.0 FORMULA_0003 0.0 255.0000 /end CHARACTERISTIC
/begin CHARACTERISTIC K_ED_INDEX_119_IGN.DEC_NACH_EINTRAG "Filterverringerung nach Fehlerspeichereintrag" VALUE 0x71883 TKW_VV_VV_UB 100.0 FORMULA_0003 0.0 255.0000 /end CHARACTERISTIC
/begin CHARACTERISTIC K_ED_INDEX_120_IGN.DEC_NACH_EINTRAG "Filterverringerung nach Fehlerspeichereintrag" VALUE 0x7189D TKW_VV_VV_UB 100.0 FORMULA_0003 0.0 255.0000 /end CHARACTERISTIC
/begin CHARACTERISTIC K_ED_INDEX_121_IGN.DEC_NACH_EINTRAG "Filterverringerung nach Fehlerspeichereintrag | EN: Fault code INDEX_121_IGN - debounce filter decrement after fault-memory entry" VALUE 0x718B7 TKW_VV_VV_UB 100.0 FORMULA_0003 0.0 255.0000 /end CHARACTERISTIC
/begin CHARACTERISTIC K_ED_INDEX_122_IGN.DEC_NACH_EINTRAG "Filterverringerung nach Fehlerspeichereintrag | EN: Fault code INDEX_122_IGN - debounce filter decrement after fault-memory entry" VALUE 0x718D1 TKW_VV_VV_UB 100.0 FORMULA_0003 0.0 255.0000 /end CHARACTERISTIC
/begin CHARACTERISTIC K_ED_INDEX_123_IGN.DEC_NACH_EINTRAG "Filterverringerung nach Fehlerspeichereintrag | EN: Fault code INDEX_123_IGN - debounce filter decrement after fault-memory entry" VALUE 0x718EB TKW_VV_VV_UB 100.0 FORMULA_0003 0.0 255.0000 /end CHARACTERISTIC
/begin CHARACTERISTIC K_ED_INDEX_124_IGN.DEC_NACH_EINTRAG "Filterverringerung nach Fehlerspeichereintrag | EN: Fault code INDEX_124_IGN - debounce filter decrement after fault-memory entry" VALUE 0x71905 TKW_VV_VV_UB 100.0 FORMULA_0003 0.0 255.0000 /end CHARACTERISTIC
/begin CHARACTERISTIC K_ED_INDEX_125_IGN.DEC_NACH_EINTRAG "Filterverringerung nach Fehlerspeichereintrag | EN: Fault code INDEX_125_IGN - debounce filter decrement after fault-memory entry" VALUE 0x7191F TKW_VV_VV_UB 100.0 FORMULA_0003 0.0 255.0000 /end CHARACTERISTIC
/begin CHARACTERISTIC K_ED_INDEX_126_IGN.DEC_NACH_EINTRAG "Filterverringerung nach Fehlerspeichereintrag | EN: Fault code INDEX_126_IGN - debounce filter decrement after fault-memory entry" VALUE 0x71939 TKW_VV_VV_UB 100.0 FORMULA_0003 0.0 255.0000 /end CHARACTERISTIC
/begin CHARACTERISTIC K_ED_INDEX_127_IGN.DEC_NACH_EINTRAG "Filterverringerung nach Fehlerspeichereintrag | EN: Fault code INDEX_127_IGN - debounce filter decrement after fault-memory entry" VALUE 0x71953 TKW_VV_VV_UB 100.0 FORMULA_0003 0.0 255.0000 /end CHARACTERISTIC
/begin CHARACTERISTIC K_ED_SK_TR_IGN.KLASSENINDEX "Auswahl der Fehlerklasse | EN: Fault code SK_TR_IGN - fault class selection (lamp / warning behaviour)" VALUE 0x70C6E TKW_VV_VV_UB 100.0 FORMULA_0003 0.0 8.0000 /end CHARACTERISTIC
/begin CHARACTERISTIC K_ED_PWG1.KLASSENINDEX "Auswahl der Fehlerklasse | EN: Fault code PWG1 - fault class selection (lamp / warning behaviour)" VALUE 0x70DC0 TKW_VV_VV_UB 100.0 FORMULA_0003 0.0 8.0000 /end CHARACTERISTIC
/begin CHARACTERISTIC K_ED_PWG2.KLASSENINDEX "Auswahl der Fehlerklasse | EN: Fault code PWG2 - fault class selection (lamp / warning behaviour)" VALUE 0x70DDA TKW_VV_VV_UB 100.0 FORMULA_0003 0.0 8.0000 /end CHARACTERISTIC
/begin CHARACTERISTIC K_ED_PWG_VGL.KLASSENINDEX "Auswahl der Fehlerklasse | EN: Fault code PWG_VGL - fault class selection (lamp / warning behaviour)" VALUE 0x70DF4 TKW_VV_VV_UB 100.0 FORMULA_0003 0.0 8.0000 /end CHARACTERISTIC
/begin CHARACTERISTIC K_ED_PCTRL_IGN.KLASSENINDEX "Auswahl der Fehlerklasse | EN: Fault code PCTRL_IGN - fault class selection (lamp / warning behaviour)" VALUE 0x70E0E TKW_VV_VV_UB 100.0 FORMULA_0003 0.0 8.0000 /end CHARACTERISTIC
/begin CHARACTERISTIC K_ED_LLS1_CAN.KLASSENINDEX "Auswahl der Fehlerklasse | EN: Fault code LLS1_CAN - fault class selection (lamp / warning behaviour)" VALUE 0x70E28 TKW_VV_VV_UB 100.0 FORMULA_0003 0.0 8.0000 /end CHARACTERISTIC
/begin CHARACTERISTIC K_ED_LLS2_CAN.KLASSENINDEX "Auswahl der Fehlerklasse | EN: Fault code LLS2_CAN - fault class selection (lamp / warning behaviour)" VALUE 0x70E42 TKW_VV_VV_UB 100.0 FORMULA_0003 0.0 8.0000 /end CHARACTERISTIC
/begin CHARACTERISTIC K_ED_LLS1_SK.KLASSENINDEX "Auswahl der Fehlerklasse | EN: Fault code LLS1_SK - fault class selection (lamp / warning behaviour)" VALUE 0x70E90 TKW_VV_VV_UB 100.0 FORMULA_0003 0.0 8.0000 /end CHARACTERISTIC
/begin CHARACTERISTIC K_ED_LLS2_SK.KLASSENINDEX "Auswahl der Fehlerklasse | EN: Fault code LLS2_SK - fault class selection (lamp / warning behaviour)" VALUE 0x70EAA TKW_VV_VV_UB 100.0 FORMULA_0003 0.0 8.0000 /end CHARACTERISTIC
/begin CHARACTERISTIC K_ED_SMG_SCHALTAB.KLASSENINDEX "Auswahl der Fehlerklasse | EN: Fault code SMG_SCHALTAB - fault class selection (lamp / warning behaviour)" VALUE 0x70EC4 TKW_VV_VV_UB 100.0 FORMULA_0003 0.0 8.0000 /end CHARACTERISTIC
/begin CHARACTERISTIC K_ED_DK_INIT.KLASSENINDEX "Auswahl der Fehlerklasse | EN: Fault code DK_INIT - fault class selection (lamp / warning behaviour)" VALUE 0x70F46 TKW_VV_VV_UB 100.0 FORMULA_0003 0.0 8.0000 /end CHARACTERISTIC
/begin CHARACTERISTIC K_ED_DK2_REGLER.KLASSENINDEX "Auswahl der Fehlerklasse | EN: Fault code DK2_REGLER - fault class selection (lamp / warning behaviour)" VALUE 0x70F7A TKW_VV_VV_UB 100.0 FORMULA_0003 0.0 8.0000 /end CHARACTERISTIC
/begin CHARACTERISTIC K_ED_IONVERST_B1.KLASSENINDEX "Auswahl der Fehlerklasse" VALUE 0x70FC8 TKW_VV_VV_UB 100.0 FORMULA_0003 0.0 8.0000 /end CHARACTERISTIC
/begin CHARACTERISTIC K_ED_IONSPG_B1.KLASSENINDEX "Auswahl der Fehlerklasse" VALUE 0x70FE2 TKW_VV_VV_UB 100.0 FORMULA_0003 0.0 8.0000 /end CHARACTERISTIC
/begin CHARACTERISTIC K_ED_IONVERST_B2.KLASSENINDEX "Auswahl der Fehlerklasse" VALUE 0x70FFC TKW_VV_VV_UB 100.0 FORMULA_0003 0.0 8.0000 /end CHARACTERISTIC
/begin CHARACTERISTIC K_ED_IONSPG_B2.KLASSENINDEX "Auswahl der Fehlerklasse" VALUE 0x71016 TKW_VV_VV_UB 100.0 FORMULA_0003 0.0 8.0000 /end CHARACTERISTIC
/begin CHARACTERISTIC K_ED_DK2_WDK.KLASSENINDEX "Auswahl der Fehlerklasse | EN: Fault code DK2_WDK - fault class selection (lamp / warning behaviour)" VALUE 0x7107E TKW_VV_VV_UB 100.0 FORMULA_0003 0.0 8.0000 /end CHARACTERISTIC
/begin CHARACTERISTIC K_ED_LLS1_REGLER.KLASSENINDEX "Auswahl der Fehlerklasse | EN: Fault code LLS1_REGLER - fault class selection (lamp / warning behaviour)" VALUE 0x710CC TKW_VV_VV_UB 100.0 FORMULA_0003 0.0 8.0000 /end CHARACTERISTIC
/begin CHARACTERISTIC K_ED_LLS2_REGLER.KLASSENINDEX "Auswahl der Fehlerklasse | EN: Fault code LLS2_REGLER - fault class selection (lamp / warning behaviour)" VALUE 0x710E6 TKW_VV_VV_UB 100.0 FORMULA_0003 0.0 8.0000 /end CHARACTERISTIC
/begin CHARACTERISTIC K_ED_DK2_SK_ERR.KLASSENINDEX "Auswahl der Fehlerklasse | EN: Fault code DK2_SK_ERR - fault class selection (lamp / warning behaviour)" VALUE 0x7111A TKW_VV_VV_UB 100.0 FORMULA_0003 0.0 8.0000 /end CHARACTERISTIC
/begin CHARACTERISTIC K_ED_MD_SK_ERR.KLASSENINDEX "Auswahl der Fehlerklasse | EN: Fault code MD_SK_ERR - fault class selection (lamp / warning behaviour)" VALUE 0x71168 TKW_VV_VV_UB 100.0 FORMULA_0003 0.0 8.0000 /end CHARACTERISTIC
/begin CHARACTERISTIC K_ED_LLS_INIT.KLASSENINDEX "Auswahl der Fehlerklasse | EN: Fault code LLS_INIT - fault class selection (lamp / warning behaviour)" VALUE 0x71182 TKW_VV_VV_UB 100.0 FORMULA_0003 0.0 8.0000 /end CHARACTERISTIC
/begin CHARACTERISTIC K_ED_DSC_EINGR.KLASSENINDEX "Auswahl der Fehlerklasse | EN: Fault code DSC_EINGR - fault class selection (lamp / warning behaviour)" VALUE 0x7119C TKW_VV_VV_UB 100.0 FORMULA_0003 0.0 8.0000 /end CHARACTERISTIC
/begin CHARACTERISTIC K_ED_LLS1_CMD.KLASSENINDEX "Auswahl der Fehlerklasse | EN: Fault code LLS1_CMD - fault class selection (lamp / warning behaviour)" VALUE 0x711EA TKW_VV_VV_UB 100.0 FORMULA_0003 0.0 8.0000 /end CHARACTERISTIC
/begin CHARACTERISTIC K_ED_LLS2_CMD.KLASSENINDEX "Auswahl der Fehlerklasse | EN: Fault code LLS2_CMD - fault class selection (lamp / warning behaviour)" VALUE 0x71204 TKW_VV_VV_UB 100.0 FORMULA_0003 0.0 8.0000 /end CHARACTERISTIC
/begin CHARACTERISTIC K_ED_SC_SMG1.KLASSENINDEX "Auswahl der Fehlerklasse | EN: Fault code SC_SMG1 - fault class selection (lamp / warning behaviour)" VALUE 0x7121E TKW_VV_VV_UB 100.0 FORMULA_0003 0.0 8.0000 /end CHARACTERISTIC
/begin CHARACTERISTIC K_ED_SC_SMG2.KLASSENINDEX "Auswahl der Fehlerklasse | EN: Fault code SC_SMG2 - fault class selection (lamp / warning behaviour)" VALUE 0x71238 TKW_VV_VV_UB 100.0 FORMULA_0003 0.0 8.0000 /end CHARACTERISTIC
/begin CHARACTERISTIC K_ED_SC_SMG3.KLASSENINDEX "Auswahl der Fehlerklasse | EN: Fault code SC_SMG3 - fault class selection (lamp / warning behaviour)" VALUE 0x71252 TKW_VV_VV_UB 100.0 FORMULA_0003 0.0 8.0000 /end CHARACTERISTIC
/begin CHARACTERISTIC K_ED_SC_BUSOFF.KLASSENINDEX "Auswahl der Fehlerklasse | EN: Fault code SC_BUSOFF - fault class selection (lamp / warning behaviour)" VALUE 0x7126C TKW_VV_VV_UB 100.0 FORMULA_0003 0.0 8.0000 /end CHARACTERISTIC
/begin CHARACTERISTIC K_ED_EC_BUSOFF.KLASSENINDEX "Auswahl der Fehlerklasse | EN: Fault code EC_BUSOFF - fault class selection (lamp / warning behaviour)" VALUE 0x71286 TKW_VV_VV_UB 100.0 FORMULA_0003 0.0 8.0000 /end CHARACTERISTIC
/begin CHARACTERISTIC K_ED_ION_SIG_B1.KLASSENINDEX "Auswahl der Fehlerklasse" VALUE 0x713A4 TKW_VV_VV_UB 100.0 FORMULA_0003 0.0 8.0000 /end CHARACTERISTIC
/begin CHARACTERISTIC K_ED_ION_SIG_B2.KLASSENINDEX "Auswahl der Fehlerklasse" VALUE 0x713BE TKW_VV_VV_UB 100.0 FORMULA_0003 0.0 8.0000 /end CHARACTERISTIC
/begin CHARACTERISTIC K_ED_ION_SAT_B1.KLASSENINDEX "Auswahl der Fehlerklasse" VALUE 0x714F6 TKW_VV_VV_UB 100.0 FORMULA_0003 0.0 8.0000 /end CHARACTERISTIC
/begin CHARACTERISTIC K_ED_ION_SAT_B2.KLASSENINDEX "Auswahl der Fehlerklasse" VALUE 0x71510 TKW_VV_VV_UB 100.0 FORMULA_0003 0.0 8.0000 /end CHARACTERISTIC
/begin CHARACTERISTIC K_ED_INDEX_88_IGN.KLASSENINDEX "Auswahl der Fehlerklasse | EN: Auswahl der Fehlerklasse" VALUE 0x7155E TKW_VV_VV_UB 100.0 FORMULA_0003 0.0 8.0000 /end CHARACTERISTIC
/begin CHARACTERISTIC K_ED_INDEX_89_IGN.KLASSENINDEX "Auswahl der Fehlerklasse" VALUE 0x71578 TKW_VV_VV_UB 100.0 FORMULA_0003 0.0 8.0000 /end CHARACTERISTIC
/begin CHARACTERISTIC K_ED_SG_IGN.KLASSENINDEX "Auswahl der Fehlerklasse | EN: Fault code SG_IGN - fault class selection (lamp / warning behaviour)" VALUE 0x715C6 TKW_VV_VV_UB 100.0 FORMULA_0003 0.0 8.0000 /end CHARACTERISTIC
/begin CHARACTERISTIC K_ED_E2_IGN.KLASSENINDEX "Auswahl der Fehlerklasse | EN: Fault code E2_IGN - fault class selection (lamp / warning behaviour)" VALUE 0x715E0 TKW_VV_VV_UB 100.0 FORMULA_0003 0.0 8.0000 /end CHARACTERISTIC
/begin CHARACTERISTIC K_ED_SK_MANAGER_IGN.KLASSENINDEX "Auswahl der Fehlerklasse | EN: Fault code SK_MANAGER_IGN - fault class selection (lamp / warning behaviour)" VALUE 0x71614 TKW_VV_VV_UB 100.0 FORMULA_0003 0.0 8.0000 /end CHARACTERISTIC
/begin CHARACTERISTIC K_ED_LLR_DIAG.KLASSENINDEX "Auswahl der Fehlerklasse | EN: Fault code LLR_DIAG - fault class selection (lamp / warning behaviour)" VALUE 0x7162E TKW_VV_VV_UB 100.0 FORMULA_0003 0.0 8.0000 /end CHARACTERISTIC
/begin CHARACTERISTIC K_ED_DK2_ZUST.KLASSENINDEX "Auswahl der Fehlerklasse | EN: Fault code DK2_ZUST - fault class selection (lamp / warning behaviour)" VALUE 0x71696 TKW_VV_VV_UB 100.0 FORMULA_0003 0.0 8.0000 /end CHARACTERISTIC
/begin CHARACTERISTIC K_ED_FGR_ABWURF.KLASSENINDEX "Auswahl der Fehlerklasse | EN: Fault code FGR_ABWURF - fault class selection (lamp / warning behaviour)" VALUE 0x716B0 TKW_VV_VV_UB 100.0 FORMULA_0003 0.0 8.0000 /end CHARACTERISTIC
/begin CHARACTERISTIC K_ED_PWG_BLS.KLASSENINDEX "Auswahl der Fehlerklasse | EN: Fault code PWG_BLS - fault class selection (lamp / warning behaviour)" VALUE 0x716CA TKW_VV_VV_UB 100.0 FORMULA_0003 0.0 8.0000 /end CHARACTERISTIC
/begin CHARACTERISTIC K_ED_N_GETR_EIN_HS.KLASSENINDEX "Auswahl der Fehlerklasse | EN: Fault code N_GETR_EIN_HS - fault class selection (lamp / warning behaviour)" VALUE 0x71718 TKW_VV_VV_UB 100.0 FORMULA_0003 0.0 8.0000 /end CHARACTERISTIC
/begin CHARACTERISTIC K_ED_LLR_DIAG_CSS.KLASSENINDEX "Auswahl der Fehlerklasse | EN: Fault code LLR_DIAG_CSS - fault class selection (lamp / warning behaviour)" VALUE 0x7174C TKW_VV_VV_UB 100.0 FORMULA_0003 0.0 8.0000 /end CHARACTERISTIC
/begin CHARACTERISTIC K_ED_INDEX_110_IGN.KLASSENINDEX "Auswahl der Fehlerklasse" VALUE 0x7179A TKW_VV_VV_UB 100.0 FORMULA_0003 0.0 8.0000 /end CHARACTERISTIC
/begin CHARACTERISTIC K_ED_INDEX_111_IGN.KLASSENINDEX "Auswahl der Fehlerklasse" VALUE 0x717B4 TKW_VV_VV_UB 100.0 FORMULA_0003 0.0 8.0000 /end CHARACTERISTIC
/begin CHARACTERISTIC K_ED_INDEX_112_IGN.KLASSENINDEX "Auswahl der Fehlerklasse" VALUE 0x717CE TKW_VV_VV_UB 100.0 FORMULA_0003 0.0 8.0000 /end CHARACTERISTIC
/begin CHARACTERISTIC K_ED_INDEX_113_IGN.KLASSENINDEX "Auswahl der Fehlerklasse" VALUE 0x717E8 TKW_VV_VV_UB 100.0 FORMULA_0003 0.0 8.0000 /end CHARACTERISTIC
/begin CHARACTERISTIC K_ED_INDEX_114_IGN.KLASSENINDEX "Auswahl der Fehlerklasse" VALUE 0x71802 TKW_VV_VV_UB 100.0 FORMULA_0003 0.0 8.0000 /end CHARACTERISTIC
/begin CHARACTERISTIC K_ED_INDEX_115_IGN.KLASSENINDEX "Auswahl der Fehlerklasse" VALUE 0x7181C TKW_VV_VV_UB 100.0 FORMULA_0003 0.0 8.0000 /end CHARACTERISTIC
/begin CHARACTERISTIC K_ED_INDEX_116_IGN.KLASSENINDEX "Auswahl der Fehlerklasse" VALUE 0x71836 TKW_VV_VV_UB 100.0 FORMULA_0003 0.0 8.0000 /end CHARACTERISTIC
/begin CHARACTERISTIC K_ED_INDEX_117_IGN.KLASSENINDEX "Auswahl der Fehlerklasse" VALUE 0x71850 TKW_VV_VV_UB 100.0 FORMULA_0003 0.0 8.0000 /end CHARACTERISTIC
/begin CHARACTERISTIC K_ED_INDEX_118_IGN.KLASSENINDEX "Auswahl der Fehlerklasse" VALUE 0x7186A TKW_VV_VV_UB 100.0 FORMULA_0003 0.0 8.0000 /end CHARACTERISTIC
/begin CHARACTERISTIC K_ED_INDEX_119_IGN.KLASSENINDEX "Auswahl der Fehlerklasse" VALUE 0x71884 TKW_VV_VV_UB 100.0 FORMULA_0003 0.0 8.0000 /end CHARACTERISTIC
/begin CHARACTERISTIC K_ED_INDEX_120_IGN.KLASSENINDEX "Auswahl der Fehlerklasse" VALUE 0x7189E TKW_VV_VV_UB 100.0 FORMULA_0003 0.0 8.0000 /end CHARACTERISTIC
/begin CHARACTERISTIC K_ED_INDEX_121_IGN.KLASSENINDEX "Auswahl der Fehlerklasse | EN: Fault code INDEX_121_IGN - fault class selection (lamp / warning behaviour)" VALUE 0x718B8 TKW_VV_VV_UB 100.0 FORMULA_0003 0.0 8.0000 /end CHARACTERISTIC
/begin CHARACTERISTIC K_ED_INDEX_122_IGN.KLASSENINDEX "Auswahl der Fehlerklasse | EN: Fault code INDEX_122_IGN - fault class selection (lamp / warning behaviour)" VALUE 0x718D2 TKW_VV_VV_UB 100.0 FORMULA_0003 0.0 8.0000 /end CHARACTERISTIC
/begin CHARACTERISTIC K_ED_INDEX_123_IGN.KLASSENINDEX "Auswahl der Fehlerklasse | EN: Fault code INDEX_123_IGN - fault class selection (lamp / warning behaviour)" VALUE 0x718EC TKW_VV_VV_UB 100.0 FORMULA_0003 0.0 8.0000 /end CHARACTERISTIC
/begin CHARACTERISTIC K_ED_INDEX_124_IGN.KLASSENINDEX "Auswahl der Fehlerklasse | EN: Fault code INDEX_124_IGN - fault class selection (lamp / warning behaviour)" VALUE 0x71906 TKW_VV_VV_UB 100.0 FORMULA_0003 0.0 8.0000 /end CHARACTERISTIC
/begin CHARACTERISTIC K_ED_INDEX_125_IGN.KLASSENINDEX "Auswahl der Fehlerklasse | EN: Fault code INDEX_125_IGN - fault class selection (lamp / warning behaviour)" VALUE 0x71920 TKW_VV_VV_UB 100.0 FORMULA_0003 0.0 8.0000 /end CHARACTERISTIC
/begin CHARACTERISTIC K_ED_INDEX_126_IGN.KLASSENINDEX "Auswahl der Fehlerklasse | EN: Fault code INDEX_126_IGN - fault class selection (lamp / warning behaviour)" VALUE 0x7193A TKW_VV_VV_UB 100.0 FORMULA_0003 0.0 8.0000 /end CHARACTERISTIC
/begin CHARACTERISTIC K_ED_INDEX_127_IGN.KLASSENINDEX "Auswahl der Fehlerklasse | EN: Fault code INDEX_127_IGN - fault class selection (lamp / warning behaviour)" VALUE 0x71954 TKW_VV_VV_UB 100.0 FORMULA_0003 0.0 8.0000 /end CHARACTERISTIC
/begin FUNCTION Eigendiagnose ""
 /begin DEF_CHARACTERISTIC K_ED_DK2_REGLER.KLASSENINDEX K_ED_DK2_REGLER.OK_SCHWELLE K_ED_DK2_REGLER.P_CODE_OPENLOAD K_ED_DK2_REGLER.P_CODE_SH_TO_GND K_ED_DK2_REGLER.P_CODE_SH_TO_UB K_ED_DK2_REGLER.P_CODE_UNPLAUSIBEL K_ED_DK2_SK_ERR.DEC_NACH_EINTRAG K_ED_DK2_SK_ERR.DEC_VOR_EINTRAG K_ED_DK2_SK_ERR.FEHLERSCHWELLE K_ED_DK2_SK_ERR.INC_NACH_EINTRAG K_ED_DK2_SK_ERR.INC_VOR_EINTRAG K_ED_DK2_SK_ERR.KLASSENINDEX K_ED_DK2_SK_ERR.OK_SCHWELLE K_ED_DK2_SK_ERR.P_CODE_OPENLOAD K_ED_DK2_SK_ERR.P_CODE_SH_TO_GND K_ED_DK2_SK_ERR.P_CODE_SH_TO_UB K_ED_DK2_SK_ERR.P_CODE_UNPLAUSIBEL K_ED_DK2_WDK.DEC_NACH_EINTRAG K_ED_DK2_WDK.DEC_VOR_EINTRAG K_ED_DK2_WDK.FEHLERSCHWELLE K_ED_DK2_WDK.INC_NACH_EINTRAG K_ED_DK2_WDK.INC_VOR_EINTRAG K_ED_DK2_WDK.KLASSENINDEX K_ED_DK2_WDK.OK_SCHWELLE K_ED_DK2_WDK.P_CODE_OPENLOAD K_ED_DK2_WDK.P_CODE_SH_TO_GND K_ED_DK2_WDK.P_CODE_SH_TO_UB K_ED_DK2_WDK.P_CODE_UNPLAUSIBEL K_ED_DK2_ZUST.DEC_NACH_EINTRAG K_ED_DK2_ZUST.DEC_VOR_EINTRAG K_ED_DK2_ZUST.FEHLERSCHWELLE K_ED_DK2_ZUST.INC_NACH_EINTRAG K_ED_DK2_ZUST.INC_VOR_EINTRAG K_ED_DK2_ZUST.KLASSENINDEX K_ED_DK2_ZUST.OK_SCHWELLE K_ED_DK2_ZUST.P_CODE_OPENLOAD K_ED_DK2_ZUST.P_CODE_SH_TO_GND K_ED_DK2_ZUST.P_CODE_SH_TO_UB K_ED_DK2_ZUST.P_CODE_UNPLAUSIBEL K_ED_DK_INIT.DEC_NACH_EINTRAG K_ED_DK_INIT.DEC_VOR_EINTRAG K_ED_DK_INIT.FEHLERSCHWELLE K_ED_DK_INIT.INC_NACH_EINTRAG K_ED_DK_INIT.INC_VOR_EINTRAG K_ED_DK_INIT.KLASSENINDEX K_ED_DK_INIT.OK_SCHWELLE K_ED_DK_INIT.P_CODE_OPENLOAD K_ED_DK_INIT.P_CODE_SH_TO_GND K_ED_DK_INIT.P_CODE_SH_TO_UB K_ED_DK_INIT.P_CODE_UNPLAUSIBEL K_ED_DSC_EINGR.DEC_NACH_EINTRAG K_ED_DSC_EINGR.DEC_VOR_EINTRAG K_ED_DSC_EINGR.FEHLERSCHWELLE K_ED_DSC_EINGR.INC_NACH_EINTRAG K_ED_DSC_EINGR.INC_VOR_EINTRAG K_ED_DSC_EINGR.KLASSENINDEX K_ED_DSC_EINGR.OK_SCHWELLE K_ED_DSC_EINGR.P_CODE_OPENLOAD K_ED_DSC_EINGR.P_CODE_SH_TO_GND K_ED_DSC_EINGR.P_CODE_SH_TO_UB K_ED_DSC_EINGR.P_CODE_UNPLAUSIBEL K_ED_E2_IGN.DEC_NACH_EINTRAG K_ED_E2_IGN.DEC_VOR_EINTRAG K_ED_E2_IGN.FEHLERSCHWELLE K_ED_E2_IGN.INC_NACH_EINTRAG K_ED_E2_IGN.INC_VOR_EINTRAG K_ED_E2_IGN.KLASSENINDEX K_ED_E2_IGN.OK_SCHWELLE K_ED_E2_IGN.P_CODE_OPENLOAD K_ED_E2_IGN.P_CODE_SH_TO_GND K_ED_E2_IGN.P_CODE_SH_TO_UB K_ED_E2_IGN.P_CODE_UNPLAUSIBEL K_ED_EC_BUSOFF.DEC_NACH_EINTRAG K_ED_EC_BUSOFF.DEC_VOR_EINTRAG K_ED_EC_BUSOFF.FEHLERSCHWELLE K_ED_EC_BUSOFF.INC_NACH_EINTRAG K_ED_EC_BUSOFF.INC_VOR_EINTRAG K_ED_EC_BUSOFF.KLASSENINDEX K_ED_EC_BUSOFF.OK_SCHWELLE K_ED_EC_BUSOFF.P_CODE_OPENLOAD K_ED_EC_BUSOFF.P_CODE_SH_TO_GND K_ED_EC_BUSOFF.P_CODE_SH_TO_UB K_ED_EC_BUSOFF.P_CODE_UNPLAUSIBEL K_ED_FGR_ABWURF.DEC_NACH_EINTRAG K_ED_FGR_ABWURF.DEC_VOR_EINTRAG K_ED_FGR_ABWURF.FEHLERSCHWELLE K_ED_FGR_ABWURF.INC_NACH_EINTRAG K_ED_FGR_ABWURF.INC_VOR_EINTRAG K_ED_FGR_ABWURF.KLASSENINDEX K_ED_FGR_ABWURF.OK_SCHWELLE K_ED_FGR_ABWURF.P_CODE_OPENLOAD K_ED_FGR_ABWURF.P_CODE_SH_TO_GND K_ED_FGR_ABWURF.P_CODE_SH_TO_UB K_ED_FGR_ABWURF.P_CODE_UNPLAUSIBEL K_ED_FST_MAX K_ED_INDEX_110_IGN.DEC_NACH_EINTRAG K_ED_INDEX_110_IGN.DEC_VOR_EINTRAG K_ED_INDEX_110_IGN.FEHLERSCHWELLE K_ED_INDEX_110_IGN.INC_NACH_EINTRAG K_ED_INDEX_110_IGN.INC_VOR_EINTRAG K_ED_INDEX_110_IGN.KLASSENINDEX K_ED_INDEX_110_IGN.OK_SCHWELLE K_ED_INDEX_110_IGN.P_CODE_OPENLOAD K_ED_INDEX_110_IGN.P_CODE_SH_TO_GND K_ED_INDEX_110_IGN.P_CODE_SH_TO_UB K_ED_INDEX_110_IGN.P_CODE_UNPLAUSIBEL K_ED_INDEX_111_IGN.DEC_NACH_EINTRAG K_ED_INDEX_111_IGN.DEC_VOR_EINTRAG K_ED_INDEX_111_IGN.FEHLERSCHWELLE K_ED_INDEX_111_IGN.INC_NACH_EINTRAG K_ED_INDEX_111_IGN.INC_VOR_EINTRAG K_ED_INDEX_111_IGN.KLASSENINDEX K_ED_INDEX_111_IGN.OK_SCHWELLE K_ED_INDEX_111_IGN.P_CODE_OPENLOAD K_ED_INDEX_111_IGN.P_CODE_SH_TO_GND K_ED_INDEX_111_IGN.P_CODE_SH_TO_UB K_ED_INDEX_111_IGN.P_CODE_UNPLAUSIBEL K_ED_INDEX_112_IGN.DEC_NACH_EINTRAG K_ED_INDEX_112_IGN.DEC_VOR_EINTRAG K_ED_INDEX_112_IGN.FEHLERSCHWELLE K_ED_INDEX_112_IGN.INC_NACH_EINTRAG K_ED_INDEX_112_IGN.INC_VOR_EINTRAG K_ED_INDEX_112_IGN.KLASSENINDEX K_ED_INDEX_112_IGN.OK_SCHWELLE K_ED_INDEX_112_IGN.P_CODE_OPENLOAD K_ED_INDEX_112_IGN.P_CODE_SH_TO_GND K_ED_INDEX_112_IGN.P_CODE_SH_TO_UB K_ED_INDEX_112_IGN.P_CODE_UNPLAUSIBEL K_ED_INDEX_113_IGN.DEC_NACH_EINTRAG K_ED_INDEX_113_IGN.DEC_VOR_EINTRAG K_ED_INDEX_113_IGN.FEHLERSCHWELLE K_ED_INDEX_113_IGN.INC_NACH_EINTRAG K_ED_INDEX_113_IGN.INC_VOR_EINTRAG K_ED_INDEX_113_IGN.KLASSENINDEX K_ED_INDEX_113_IGN.OK_SCHWELLE K_ED_INDEX_113_IGN.P_CODE_OPENLOAD K_ED_INDEX_113_IGN.P_CODE_SH_TO_GND K_ED_INDEX_113_IGN.P_CODE_SH_TO_UB K_ED_INDEX_113_IGN.P_CODE_UNPLAUSIBEL K_ED_INDEX_114_IGN.DEC_NACH_EINTRAG K_ED_INDEX_114_IGN.DEC_VOR_EINTRAG K_ED_INDEX_114_IGN.FEHLERSCHWELLE K_ED_INDEX_114_IGN.INC_NACH_EINTRAG K_ED_INDEX_114_IGN.INC_VOR_EINTRAG K_ED_INDEX_114_IGN.KLASSENINDEX K_ED_INDEX_114_IGN.OK_SCHWELLE K_ED_INDEX_114_IGN.P_CODE_OPENLOAD K_ED_INDEX_114_IGN.P_CODE_SH_TO_GND K_ED_INDEX_114_IGN.P_CODE_SH_TO_UB K_ED_INDEX_114_IGN.P_CODE_UNPLAUSIBEL K_ED_INDEX_115_IGN.DEC_NACH_EINTRAG K_ED_INDEX_115_IGN.DEC_VOR_EINTRAG K_ED_INDEX_115_IGN.FEHLERSCHWELLE K_ED_INDEX_115_IGN.INC_NACH_EINTRAG K_ED_INDEX_115_IGN.INC_VOR_EINTRAG K_ED_INDEX_115_IGN.KLASSENINDEX K_ED_INDEX_115_IGN.OK_SCHWELLE K_ED_INDEX_115_IGN.P_CODE_OPENLOAD K_ED_INDEX_115_IGN.P_CODE_SH_TO_GND K_ED_INDEX_115_IGN.P_CODE_SH_TO_UB K_ED_INDEX_115_IGN.P_CODE_UNPLAUSIBEL K_ED_INDEX_116_IGN.DEC_NACH_EINTRAG K_ED_INDEX_116_IGN.DEC_VOR_EINTRAG K_ED_INDEX_116_IGN.FEHLERSCHWELLE K_ED_INDEX_116_IGN.INC_NACH_EINTRAG K_ED_INDEX_116_IGN.INC_VOR_EINTRAG K_ED_INDEX_116_IGN.KLASSENINDEX K_ED_INDEX_116_IGN.OK_SCHWELLE K_ED_INDEX_116_IGN.P_CODE_OPENLOAD K_ED_INDEX_116_IGN.P_CODE_SH_TO_GND K_ED_INDEX_116_IGN.P_CODE_SH_TO_UB K_ED_INDEX_116_IGN.P_CODE_UNPLAUSIBEL K_ED_INDEX_117_IGN.DEC_NACH_EINTRAG K_ED_INDEX_117_IGN.DEC_VOR_EINTRAG K_ED_INDEX_117_IGN.FEHLERSCHWELLE K_ED_INDEX_117_IGN.INC_NACH_EINTRAG K_ED_INDEX_117_IGN.INC_VOR_EINTRAG K_ED_INDEX_117_IGN.KLASSENINDEX K_ED_INDEX_117_IGN.OK_SCHWELLE K_ED_INDEX_117_IGN.P_CODE_OPENLOAD K_ED_INDEX_117_IGN.P_CODE_SH_TO_GND K_ED_INDEX_117_IGN.P_CODE_SH_TO_UB K_ED_INDEX_117_IGN.P_CODE_UNPLAUSIBEL K_ED_INDEX_118_IGN.DEC_NACH_EINTRAG K_ED_INDEX_118_IGN.DEC_VOR_EINTRAG K_ED_INDEX_118_IGN.FEHLERSCHWELLE K_ED_INDEX_118_IGN.INC_NACH_EINTRAG K_ED_INDEX_118_IGN.INC_VOR_EINTRAG K_ED_INDEX_118_IGN.KLASSENINDEX K_ED_INDEX_118_IGN.OK_SCHWELLE K_ED_INDEX_118_IGN.P_CODE_OPENLOAD K_ED_INDEX_118_IGN.P_CODE_SH_TO_GND K_ED_INDEX_118_IGN.P_CODE_SH_TO_UB K_ED_INDEX_118_IGN.P_CODE_UNPLAUSIBEL K_ED_INDEX_119_IGN.DEC_NACH_EINTRAG K_ED_INDEX_119_IGN.DEC_VOR_EINTRAG K_ED_INDEX_119_IGN.FEHLERSCHWELLE K_ED_INDEX_119_IGN.INC_NACH_EINTRAG K_ED_INDEX_119_IGN.INC_VOR_EINTRAG K_ED_INDEX_119_IGN.KLASSENINDEX K_ED_INDEX_119_IGN.OK_SCHWELLE K_ED_INDEX_119_IGN.P_CODE_OPENLOAD K_ED_INDEX_119_IGN.P_CODE_SH_TO_GND K_ED_INDEX_119_IGN.P_CODE_SH_TO_UB K_ED_INDEX_119_IGN.P_CODE_UNPLAUSIBEL K_ED_INDEX_120_IGN.DEC_NACH_EINTRAG K_ED_INDEX_120_IGN.DEC_VOR_EINTRAG K_ED_INDEX_120_IGN.FEHLERSCHWELLE K_ED_INDEX_120_IGN.INC_NACH_EINTRAG K_ED_INDEX_120_IGN.INC_VOR_EINTRAG K_ED_INDEX_120_IGN.KLASSENINDEX K_ED_INDEX_120_IGN.OK_SCHWELLE K_ED_INDEX_120_IGN.P_CODE_OPENLOAD K_ED_INDEX_120_IGN.P_CODE_SH_TO_GND K_ED_INDEX_120_IGN.P_CODE_SH_TO_UB K_ED_INDEX_120_IGN.P_CODE_UNPLAUSIBEL K_ED_INDEX_121_IGN.DEC_NACH_EINTRAG K_ED_INDEX_121_IGN.DEC_VOR_EINTRAG K_ED_INDEX_121_IGN.FEHLERSCHWELLE K_ED_INDEX_121_IGN.INC_NACH_EINTRAG K_ED_INDEX_121_IGN.INC_VOR_EINTRAG K_ED_INDEX_121_IGN.KLASSENINDEX K_ED_INDEX_121_IGN.OK_SCHWELLE K_ED_INDEX_121_IGN.P_CODE_OPENLOAD K_ED_INDEX_121_IGN.P_CODE_SH_TO_GND K_ED_INDEX_121_IGN.P_CODE_SH_TO_UB K_ED_INDEX_121_IGN.P_CODE_UNPLAUSIBEL K_ED_INDEX_122_IGN.DEC_NACH_EINTRAG K_ED_INDEX_122_IGN.DEC_VOR_EINTRAG K_ED_INDEX_122_IGN.FEHLERSCHWELLE K_ED_INDEX_122_IGN.INC_NACH_EINTRAG K_ED_INDEX_122_IGN.INC_VOR_EINTRAG K_ED_INDEX_122_IGN.KLASSENINDEX K_ED_INDEX_122_IGN.OK_SCHWELLE K_ED_INDEX_122_IGN.P_CODE_OPENLOAD K_ED_INDEX_122_IGN.P_CODE_SH_TO_GND K_ED_INDEX_122_IGN.P_CODE_SH_TO_UB K_ED_INDEX_122_IGN.P_CODE_UNPLAUSIBEL K_ED_INDEX_123_IGN.DEC_NACH_EINTRAG K_ED_INDEX_123_IGN.DEC_VOR_EINTRAG K_ED_INDEX_123_IGN.FEHLERSCHWELLE K_ED_INDEX_123_IGN.INC_NACH_EINTRAG K_ED_INDEX_123_IGN.INC_VOR_EINTRAG K_ED_INDEX_123_IGN.KLASSENINDEX K_ED_INDEX_123_IGN.OK_SCHWELLE K_ED_INDEX_123_IGN.P_CODE_OPENLOAD K_ED_INDEX_123_IGN.P_CODE_SH_TO_GND K_ED_INDEX_123_IGN.P_CODE_SH_TO_UB K_ED_INDEX_123_IGN.P_CODE_UNPLAUSIBEL K_ED_INDEX_124_IGN.DEC_NACH_EINTRAG K_ED_INDEX_124_IGN.DEC_VOR_EINTRAG K_ED_INDEX_124_IGN.FEHLERSCHWELLE K_ED_INDEX_124_IGN.INC_NACH_EINTRAG K_ED_INDEX_124_IGN.INC_VOR_EINTRAG K_ED_INDEX_124_IGN.KLASSENINDEX K_ED_INDEX_124_IGN.OK_SCHWELLE K_ED_INDEX_124_IGN.P_CODE_OPENLOAD K_ED_INDEX_124_IGN.P_CODE_SH_TO_GND K_ED_INDEX_124_IGN.P_CODE_SH_TO_UB K_ED_INDEX_124_IGN.P_CODE_UNPLAUSIBEL K_ED_INDEX_125_IGN.DEC_NACH_EINTRAG K_ED_INDEX_125_IGN.DEC_VOR_EINTRAG K_ED_INDEX_125_IGN.FEHLERSCHWELLE K_ED_INDEX_125_IGN.INC_NACH_EINTRAG K_ED_INDEX_125_IGN.INC_VOR_EINTRAG K_ED_INDEX_125_IGN.KLASSENINDEX K_ED_INDEX_125_IGN.OK_SCHWELLE K_ED_INDEX_125_IGN.P_CODE_OPENLOAD K_ED_INDEX_125_IGN.P_CODE_SH_TO_GND K_ED_INDEX_125_IGN.P_CODE_SH_TO_UB K_ED_INDEX_125_IGN.P_CODE_UNPLAUSIBEL K_ED_INDEX_126_IGN.DEC_NACH_EINTRAG K_ED_INDEX_126_IGN.DEC_VOR_EINTRAG K_ED_INDEX_126_IGN.FEHLERSCHWELLE K_ED_INDEX_126_IGN.INC_NACH_EINTRAG K_ED_INDEX_126_IGN.INC_VOR_EINTRAG K_ED_INDEX_126_IGN.KLASSENINDEX K_ED_INDEX_126_IGN.OK_SCHWELLE K_ED_INDEX_126_IGN.P_CODE_OPENLOAD K_ED_INDEX_126_IGN.P_CODE_SH_TO_GND K_ED_INDEX_126_IGN.P_CODE_SH_TO_UB K_ED_INDEX_126_IGN.P_CODE_UNPLAUSIBEL K_ED_INDEX_127_IGN.DEC_NACH_EINTRAG K_ED_INDEX_127_IGN.DEC_VOR_EINTRAG K_ED_INDEX_127_IGN.FEHLERSCHWELLE K_ED_INDEX_127_IGN.INC_NACH_EINTRAG K_ED_INDEX_127_IGN.INC_VOR_EINTRAG K_ED_INDEX_127_IGN.KLASSENINDEX K_ED_INDEX_127_IGN.OK_SCHWELLE K_ED_INDEX_127_IGN.P_CODE_OPENLOAD K_ED_INDEX_127_IGN.P_CODE_SH_TO_GND K_ED_INDEX_127_IGN.P_CODE_SH_TO_UB K_ED_INDEX_127_IGN.P_CODE_UNPLAUSIBEL K_ED_INDEX_88_IGN.DEC_NACH_EINTRAG K_ED_INDEX_88_IGN.DEC_VOR_EINTRAG K_ED_INDEX_88_IGN.FEHLERSCHWELLE K_ED_INDEX_88_IGN.INC_NACH_EINTRAG K_ED_INDEX_88_IGN.INC_VOR_EINTRAG K_ED_INDEX_88_IGN.KLASSENINDEX K_ED_INDEX_88_IGN.OK_SCHWELLE K_ED_INDEX_88_IGN.P_CODE_OPENLOAD K_ED_INDEX_88_IGN.P_CODE_SH_TO_GND K_ED_INDEX_88_IGN.P_CODE_SH_TO_UB K_ED_INDEX_88_IGN.P_CODE_UNPLAUSIBEL K_ED_INDEX_89_IGN.DEC_NACH_EINTRAG K_ED_INDEX_89_IGN.DEC_VOR_EINTRAG K_ED_INDEX_89_IGN.FEHLERSCHWELLE K_ED_INDEX_89_IGN.INC_NACH_EINTRAG K_ED_INDEX_89_IGN.INC_VOR_EINTRAG K_ED_INDEX_89_IGN.KLASSENINDEX K_ED_INDEX_89_IGN.OK_SCHWELLE K_ED_INDEX_89_IGN.P_CODE_OPENLOAD K_ED_INDEX_89_IGN.P_CODE_SH_TO_GND K_ED_INDEX_89_IGN.P_CODE_SH_TO_UB K_ED_INDEX_89_IGN.P_CODE_UNPLAUSIBEL K_ED_IONSPG_B1.DEC_NACH_EINTRAG K_ED_IONSPG_B1.DEC_VOR_EINTRAG K_ED_IONSPG_B1.FEHLERSCHWELLE K_ED_IONSPG_B1.INC_NACH_EINTRAG K_ED_IONSPG_B1.INC_VOR_EINTRAG K_ED_IONSPG_B1.KLASSENINDEX K_ED_IONSPG_B1.OK_SCHWELLE K_ED_IONSPG_B1.P_CODE_OPENLOAD K_ED_IONSPG_B1.P_CODE_SH_TO_GND K_ED_IONSPG_B1.P_CODE_SH_TO_UB K_ED_IONSPG_B1.P_CODE_UNPLAUSIBEL K_ED_IONSPG_B2.DEC_NACH_EINTRAG K_ED_IONSPG_B2.DEC_VOR_EINTRAG K_ED_IONSPG_B2.FEHLERSCHWELLE K_ED_IONSPG_B2.INC_NACH_EINTRAG K_ED_IONSPG_B2.INC_VOR_EINTRAG K_ED_IONSPG_B2.KLASSENINDEX K_ED_IONSPG_B2.OK_SCHWELLE K_ED_IONSPG_B2.P_CODE_OPENLOAD K_ED_IONSPG_B2.P_CODE_SH_TO_GND K_ED_IONSPG_B2.P_CODE_SH_TO_UB K_ED_IONSPG_B2.P_CODE_UNPLAUSIBEL K_ED_IONVERST_B1.DEC_NACH_EINTRAG K_ED_IONVERST_B1.DEC_VOR_EINTRAG K_ED_IONVERST_B1.FEHLERSCHWELLE K_ED_IONVERST_B1.INC_NACH_EINTRAG K_ED_IONVERST_B1.INC_VOR_EINTRAG K_ED_IONVERST_B1.KLASSENINDEX K_ED_IONVERST_B1.OK_SCHWELLE K_ED_IONVERST_B1.P_CODE_OPENLOAD K_ED_IONVERST_B1.P_CODE_SH_TO_GND K_ED_IONVERST_B1.P_CODE_SH_TO_UB K_ED_IONVERST_B1.P_CODE_UNPLAUSIBEL K_ED_IONVERST_B2.DEC_NACH_EINTRAG K_ED_IONVERST_B2.DEC_VOR_EINTRAG K_ED_IONVERST_B2.FEHLERSCHWELLE K_ED_IONVERST_B2.INC_NACH_EINTRAG K_ED_IONVERST_B2.INC_VOR_EINTRAG K_ED_IONVERST_B2.KLASSENINDEX K_ED_IONVERST_B2.OK_SCHWELLE K_ED_IONVERST_B2.P_CODE_OPENLOAD K_ED_IONVERST_B2.P_CODE_SH_TO_GND K_ED_IONVERST_B2.P_CODE_SH_TO_UB K_ED_IONVERST_B2.P_CODE_UNPLAUSIBEL K_ED_ION_SAT_B1.DEC_NACH_EINTRAG K_ED_ION_SAT_B1.DEC_VOR_EINTRAG K_ED_ION_SAT_B1.FEHLERSCHWELLE K_ED_ION_SAT_B1.INC_NACH_EINTRAG K_ED_ION_SAT_B1.INC_VOR_EINTRAG K_ED_ION_SAT_B1.KLASSENINDEX K_ED_ION_SAT_B1.OK_SCHWELLE K_ED_ION_SAT_B1.P_CODE_OPENLOAD K_ED_ION_SAT_B1.P_CODE_SH_TO_GND K_ED_ION_SAT_B1.P_CODE_SH_TO_UB K_ED_ION_SAT_B1.P_CODE_UNPLAUSIBEL K_ED_ION_SAT_B2.DEC_NACH_EINTRAG K_ED_ION_SAT_B2.DEC_VOR_EINTRAG K_ED_ION_SAT_B2.FEHLERSCHWELLE K_ED_ION_SAT_B2.INC_NACH_EINTRAG K_ED_ION_SAT_B2.INC_VOR_EINTRAG K_ED_ION_SAT_B2.KLASSENINDEX K_ED_ION_SAT_B2.OK_SCHWELLE K_ED_ION_SAT_B2.P_CODE_OPENLOAD K_ED_ION_SAT_B2.P_CODE_SH_TO_GND K_ED_ION_SAT_B2.P_CODE_SH_TO_UB K_ED_ION_SAT_B2.P_CODE_UNPLAUSIBEL K_ED_ION_SIG_B1.DEC_NACH_EINTRAG K_ED_ION_SIG_B1.DEC_VOR_EINTRAG K_ED_ION_SIG_B1.FEHLERSCHWELLE K_ED_ION_SIG_B1.INC_NACH_EINTRAG K_ED_ION_SIG_B1.INC_VOR_EINTRAG K_ED_ION_SIG_B1.KLASSENINDEX K_ED_ION_SIG_B1.OK_SCHWELLE K_ED_ION_SIG_B1.P_CODE_OPENLOAD K_ED_ION_SIG_B1.P_CODE_SH_TO_GND K_ED_ION_SIG_B1.P_CODE_SH_TO_UB K_ED_ION_SIG_B1.P_CODE_UNPLAUSIBEL K_ED_ION_SIG_B2.DEC_NACH_EINTRAG K_ED_ION_SIG_B2.DEC_VOR_EINTRAG K_ED_ION_SIG_B2.FEHLERSCHWELLE K_ED_ION_SIG_B2.INC_NACH_EINTRAG K_ED_ION_SIG_B2.INC_VOR_EINTRAG K_ED_ION_SIG_B2.KLASSENINDEX K_ED_ION_SIG_B2.OK_SCHWELLE K_ED_ION_SIG_B2.P_CODE_OPENLOAD K_ED_ION_SIG_B2.P_CODE_SH_TO_GND K_ED_ION_SIG_B2.P_CODE_SH_TO_UB K_ED_ION_SIG_B2.P_CODE_UNPLAUSIBEL K_ED_LLR_DIAG.DEC_NACH_EINTRAG K_ED_LLR_DIAG.DEC_VOR_EINTRAG K_ED_LLR_DIAG.FEHLERSCHWELLE K_ED_LLR_DIAG.INC_NACH_EINTRAG K_ED_LLR_DIAG.INC_VOR_EINTRAG K_ED_LLR_DIAG.KLASSENINDEX K_ED_LLR_DIAG.OK_SCHWELLE K_ED_LLR_DIAG.P_CODE_OPENLOAD K_ED_LLR_DIAG.P_CODE_SH_TO_GND K_ED_LLR_DIAG.P_CODE_SH_TO_UB K_ED_LLR_DIAG.P_CODE_UNPLAUSIBEL K_ED_LLR_DIAG_CSS.DEC_NACH_EINTRAG K_ED_LLR_DIAG_CSS.DEC_VOR_EINTRAG K_ED_LLR_DIAG_CSS.FEHLERSCHWELLE K_ED_LLR_DIAG_CSS.INC_NACH_EINTRAG K_ED_LLR_DIAG_CSS.INC_VOR_EINTRAG K_ED_LLR_DIAG_CSS.KLASSENINDEX K_ED_LLR_DIAG_CSS.OK_SCHWELLE K_ED_LLR_DIAG_CSS.P_CODE_OPENLOAD K_ED_LLR_DIAG_CSS.P_CODE_SH_TO_GND K_ED_LLR_DIAG_CSS.P_CODE_SH_TO_UB K_ED_LLR_DIAG_CSS.P_CODE_UNPLAUSIBEL K_ED_LLS1_CAN.DEC_NACH_EINTRAG K_ED_LLS1_CAN.DEC_VOR_EINTRAG K_ED_LLS1_CAN.FEHLERSCHWELLE K_ED_LLS1_CAN.INC_NACH_EINTRAG K_ED_LLS1_CAN.INC_VOR_EINTRAG K_ED_LLS1_CAN.KLASSENINDEX K_ED_LLS1_CAN.OK_SCHWELLE K_ED_LLS1_CAN.P_CODE_OPENLOAD K_ED_LLS1_CAN.P_CODE_SH_TO_GND K_ED_LLS1_CAN.P_CODE_SH_TO_UB K_ED_LLS1_CAN.P_CODE_UNPLAUSIBEL K_ED_LLS1_CMD.DEC_NACH_EINTRAG K_ED_LLS1_CMD.DEC_VOR_EINTRAG K_ED_LLS1_CMD.FEHLERSCHWELLE K_ED_LLS1_CMD.INC_NACH_EINTRAG K_ED_LLS1_CMD.INC_VOR_EINTRAG K_ED_LLS1_CMD.KLASSENINDEX K_ED_LLS1_CMD.OK_SCHWELLE K_ED_LLS1_CMD.P_CODE_OPENLOAD K_ED_LLS1_CMD.P_CODE_SH_TO_GND K_ED_LLS1_CMD.P_CODE_SH_TO_UB K_ED_LLS1_CMD.P_CODE_UNPLAUSIBEL K_ED_LLS1_REGLER.DEC_NACH_EINTRAG K_ED_LLS1_REGLER.DEC_VOR_EINTRAG K_ED_LLS1_REGLER.FEHLERSCHWELLE K_ED_LLS1_REGLER.INC_NACH_EINTRAG K_ED_LLS1_REGLER.INC_VOR_EINTRAG K_ED_LLS1_REGLER.KLASSENINDEX K_ED_LLS1_REGLER.OK_SCHWELLE K_ED_LLS1_REGLER.P_CODE_OPENLOAD K_ED_LLS1_REGLER.P_CODE_SH_TO_GND K_ED_LLS1_REGLER.P_CODE_SH_TO_UB K_ED_LLS1_REGLER.P_CODE_UNPLAUSIBEL K_ED_LLS1_SK.DEC_NACH_EINTRAG K_ED_LLS1_SK.DEC_VOR_EINTRAG K_ED_LLS1_SK.FEHLERSCHWELLE K_ED_LLS1_SK.INC_NACH_EINTRAG K_ED_LLS1_SK.INC_VOR_EINTRAG K_ED_LLS1_SK.KLASSENINDEX K_ED_LLS1_SK.OK_SCHWELLE K_ED_LLS1_SK.P_CODE_OPENLOAD K_ED_LLS1_SK.P_CODE_SH_TO_GND K_ED_LLS1_SK.P_CODE_SH_TO_UB K_ED_LLS1_SK.P_CODE_UNPLAUSIBEL K_ED_LLS2_CAN.DEC_NACH_EINTRAG K_ED_LLS2_CAN.DEC_VOR_EINTRAG K_ED_LLS2_CAN.FEHLERSCHWELLE K_ED_LLS2_CAN.INC_NACH_EINTRAG K_ED_LLS2_CAN.INC_VOR_EINTRAG K_ED_LLS2_CAN.KLASSENINDEX K_ED_LLS2_CAN.OK_SCHWELLE K_ED_LLS2_CAN.P_CODE_OPENLOAD K_ED_LLS2_CAN.P_CODE_SH_TO_GND K_ED_LLS2_CAN.P_CODE_SH_TO_UB K_ED_LLS2_CAN.P_CODE_UNPLAUSIBEL K_ED_LLS2_CMD.DEC_NACH_EINTRAG K_ED_LLS2_CMD.DEC_VOR_EINTRAG K_ED_LLS2_CMD.FEHLERSCHWELLE K_ED_LLS2_CMD.INC_NACH_EINTRAG K_ED_LLS2_CMD.INC_VOR_EINTRAG K_ED_LLS2_CMD.KLASSENINDEX K_ED_LLS2_CMD.OK_SCHWELLE K_ED_LLS2_CMD.P_CODE_OPENLOAD K_ED_LLS2_CMD.P_CODE_SH_TO_GND K_ED_LLS2_CMD.P_CODE_SH_TO_UB K_ED_LLS2_CMD.P_CODE_UNPLAUSIBEL K_ED_LLS2_REGLER.DEC_NACH_EINTRAG K_ED_LLS2_REGLER.DEC_VOR_EINTRAG K_ED_LLS2_REGLER.FEHLERSCHWELLE K_ED_LLS2_REGLER.INC_NACH_EINTRAG K_ED_LLS2_REGLER.INC_VOR_EINTRAG K_ED_LLS2_REGLER.KLASSENINDEX K_ED_LLS2_REGLER.OK_SCHWELLE K_ED_LLS2_REGLER.P_CODE_OPENLOAD K_ED_LLS2_REGLER.P_CODE_SH_TO_GND K_ED_LLS2_REGLER.P_CODE_SH_TO_UB K_ED_LLS2_REGLER.P_CODE_UNPLAUSIBEL K_ED_LLS2_SK.DEC_NACH_EINTRAG K_ED_LLS2_SK.DEC_VOR_EINTRAG K_ED_LLS2_SK.FEHLERSCHWELLE K_ED_LLS2_SK.INC_NACH_EINTRAG K_ED_LLS2_SK.INC_VOR_EINTRAG K_ED_LLS2_SK.KLASSENINDEX K_ED_LLS2_SK.OK_SCHWELLE K_ED_LLS2_SK.P_CODE_OPENLOAD K_ED_LLS2_SK.P_CODE_SH_TO_GND K_ED_LLS2_SK.P_CODE_SH_TO_UB K_ED_LLS2_SK.P_CODE_UNPLAUSIBEL K_ED_LLS_INIT.DEC_NACH_EINTRAG K_ED_LLS_INIT.DEC_VOR_EINTRAG K_ED_LLS_INIT.FEHLERSCHWELLE K_ED_LLS_INIT.INC_NACH_EINTRAG K_ED_LLS_INIT.INC_VOR_EINTRAG K_ED_LLS_INIT.KLASSENINDEX K_ED_LLS_INIT.OK_SCHWELLE K_ED_LLS_INIT.P_CODE_OPENLOAD K_ED_LLS_INIT.P_CODE_SH_TO_GND K_ED_LLS_INIT.P_CODE_SH_TO_UB K_ED_LLS_INIT.P_CODE_UNPLAUSIBEL K_ED_MD_SK_ERR.DEC_NACH_EINTRAG K_ED_MD_SK_ERR.DEC_VOR_EINTRAG K_ED_MD_SK_ERR.FEHLERSCHWELLE K_ED_MD_SK_ERR.INC_NACH_EINTRAG K_ED_MD_SK_ERR.INC_VOR_EINTRAG K_ED_MD_SK_ERR.KLASSENINDEX K_ED_MD_SK_ERR.OK_SCHWELLE K_ED_MD_SK_ERR.P_CODE_OPENLOAD K_ED_MD_SK_ERR.P_CODE_SH_TO_GND K_ED_MD_SK_ERR.P_CODE_SH_TO_UB K_ED_MD_SK_ERR.P_CODE_UNPLAUSIBEL K_ED_N_GETR_EIN_HS.DEC_NACH_EINTRAG K_ED_N_GETR_EIN_HS.DEC_VOR_EINTRAG K_ED_N_GETR_EIN_HS.FEHLERSCHWELLE K_ED_N_GETR_EIN_HS.INC_NACH_EINTRAG K_ED_N_GETR_EIN_HS.INC_VOR_EINTRAG K_ED_N_GETR_EIN_HS.KLASSENINDEX K_ED_N_GETR_EIN_HS.OK_SCHWELLE K_ED_N_GETR_EIN_HS.P_CODE_OPENLOAD K_ED_N_GETR_EIN_HS.P_CODE_SH_TO_GND K_ED_N_GETR_EIN_HS.P_CODE_SH_TO_UB K_ED_N_GETR_EIN_HS.P_CODE_UNPLAUSIBEL K_ED_PCTRL_IGN.DEC_NACH_EINTRAG K_ED_PCTRL_IGN.DEC_VOR_EINTRAG K_ED_PCTRL_IGN.FEHLERSCHWELLE K_ED_PCTRL_IGN.INC_NACH_EINTRAG K_ED_PCTRL_IGN.INC_VOR_EINTRAG K_ED_PCTRL_IGN.KLASSENINDEX K_ED_PCTRL_IGN.OK_SCHWELLE K_ED_PCTRL_IGN.P_CODE_OPENLOAD K_ED_PCTRL_IGN.P_CODE_SH_TO_GND K_ED_PCTRL_IGN.P_CODE_SH_TO_UB K_ED_PCTRL_IGN.P_CODE_UNPLAUSIBEL K_ED_PWG1.DEC_NACH_EINTRAG K_ED_PWG1.DEC_VOR_EINTRAG K_ED_PWG1.FEHLERSCHWELLE K_ED_PWG1.INC_NACH_EINTRAG K_ED_PWG1.INC_VOR_EINTRAG K_ED_PWG1.KLASSENINDEX K_ED_PWG1.OK_SCHWELLE K_ED_PWG1.P_CODE_OPENLOAD K_ED_PWG1.P_CODE_SH_TO_GND K_ED_PWG1.P_CODE_SH_TO_UB K_ED_PWG1.P_CODE_UNPLAUSIBEL K_ED_PWG2.DEC_NACH_EINTRAG K_ED_PWG2.DEC_VOR_EINTRAG K_ED_PWG2.FEHLERSCHWELLE K_ED_PWG2.INC_NACH_EINTRAG K_ED_PWG2.INC_VOR_EINTRAG K_ED_PWG2.KLASSENINDEX K_ED_PWG2.OK_SCHWELLE K_ED_PWG2.P_CODE_OPENLOAD K_ED_PWG2.P_CODE_SH_TO_GND K_ED_PWG2.P_CODE_SH_TO_UB K_ED_PWG2.P_CODE_UNPLAUSIBEL K_ED_PWG_BLS.DEC_NACH_EINTRAG K_ED_PWG_BLS.DEC_VOR_EINTRAG K_ED_PWG_BLS.FEHLERSCHWELLE K_ED_PWG_BLS.INC_NACH_EINTRAG K_ED_PWG_BLS.INC_VOR_EINTRAG K_ED_PWG_BLS.KLASSENINDEX K_ED_PWG_BLS.OK_SCHWELLE K_ED_PWG_BLS.P_CODE_OPENLOAD K_ED_PWG_BLS.P_CODE_SH_TO_GND K_ED_PWG_BLS.P_CODE_SH_TO_UB K_ED_PWG_BLS.P_CODE_UNPLAUSIBEL K_ED_PWG_VGL.DEC_NACH_EINTRAG K_ED_PWG_VGL.DEC_VOR_EINTRAG K_ED_PWG_VGL.FEHLERSCHWELLE K_ED_PWG_VGL.INC_NACH_EINTRAG K_ED_PWG_VGL.INC_VOR_EINTRAG K_ED_PWG_VGL.KLASSENINDEX K_ED_PWG_VGL.OK_SCHWELLE K_ED_PWG_VGL.P_CODE_OPENLOAD K_ED_PWG_VGL.P_CODE_SH_TO_GND K_ED_PWG_VGL.P_CODE_SH_TO_UB K_ED_PWG_VGL.P_CODE_UNPLAUSIBEL K_ED_RBM_EVAP_MAX K_ED_RBM_EVAP_MIN K_ED_RBM_EVAP_TEMP_DELTA K_ED_RBM_PUMG_MIN K_ED_RBM_TIME K_ED_RBM_TIME_LL K_ED_RBM_TIME_V K_ED_RBM_TUMG_MIN K_ED_RBM_V_MIN K_ED_SCDN_ABDECKUNG_AUSTRAG K_ED_SCDN_ABDECKUNG_EINTRAG K_ED_SC_BUSOFF.DEC_NACH_EINTRAG K_ED_SC_BUSOFF.DEC_VOR_EINTRAG K_ED_SC_BUSOFF.FEHLERSCHWELLE K_ED_SC_BUSOFF.INC_NACH_EINTRAG K_ED_SC_BUSOFF.INC_VOR_EINTRAG K_ED_SC_BUSOFF.KLASSENINDEX K_ED_SC_BUSOFF.OK_SCHWELLE K_ED_SC_BUSOFF.P_CODE_OPENLOAD K_ED_SC_BUSOFF.P_CODE_SH_TO_GND K_ED_SC_BUSOFF.P_CODE_SH_TO_UB K_ED_SC_BUSOFF.P_CODE_UNPLAUSIBEL K_ED_SC_SMG1.DEC_NACH_EINTRAG K_ED_SC_SMG1.DEC_VOR_EINTRAG K_ED_SC_SMG1.FEHLERSCHWELLE K_ED_SC_SMG1.INC_NACH_EINTRAG K_ED_SC_SMG1.INC_VOR_EINTRAG K_ED_SC_SMG1.KLASSENINDEX K_ED_SC_SMG1.OK_SCHWELLE K_ED_SC_SMG1.P_CODE_OPENLOAD K_ED_SC_SMG1.P_CODE_SH_TO_GND K_ED_SC_SMG1.P_CODE_SH_TO_UB K_ED_SC_SMG1.P_CODE_UNPLAUSIBEL K_ED_SC_SMG2.DEC_NACH_EINTRAG K_ED_SC_SMG2.DEC_VOR_EINTRAG K_ED_SC_SMG2.FEHLERSCHWELLE K_ED_SC_SMG2.INC_NACH_EINTRAG K_ED_SC_SMG2.INC_VOR_EINTRAG K_ED_SC_SMG2.KLASSENINDEX K_ED_SC_SMG2.OK_SCHWELLE K_ED_SC_SMG2.P_CODE_OPENLOAD K_ED_SC_SMG2.P_CODE_SH_TO_GND K_ED_SC_SMG2.P_CODE_SH_TO_UB K_ED_SC_SMG2.P_CODE_UNPLAUSIBEL K_ED_SC_SMG3.DEC_NACH_EINTRAG K_ED_SC_SMG3.DEC_VOR_EINTRAG K_ED_SC_SMG3.FEHLERSCHWELLE K_ED_SC_SMG3.INC_NACH_EINTRAG K_ED_SC_SMG3.INC_VOR_EINTRAG K_ED_SC_SMG3.KLASSENINDEX K_ED_SC_SMG3.OK_SCHWELLE K_ED_SC_SMG3.P_CODE_OPENLOAD K_ED_SC_SMG3.P_CODE_SH_TO_GND K_ED_SC_SMG3.P_CODE_SH_TO_UB K_ED_SC_SMG3.P_CODE_UNPLAUSIBEL K_ED_SG_IGN.DEC_NACH_EINTRAG K_ED_SG_IGN.DEC_VOR_EINTRAG K_ED_SG_IGN.FEHLERSCHWELLE K_ED_SG_IGN.INC_NACH_EINTRAG K_ED_SG_IGN.INC_VOR_EINTRAG K_ED_SG_IGN.KLASSENINDEX K_ED_SG_IGN.OK_SCHWELLE K_ED_SG_IGN.P_CODE_OPENLOAD K_ED_SG_IGN.P_CODE_SH_TO_GND K_ED_SG_IGN.P_CODE_SH_TO_UB K_ED_SG_IGN.P_CODE_UNPLAUSIBEL K_ED_SK_MANAGER_IGN.DEC_NACH_EINTRAG K_ED_SK_MANAGER_IGN.DEC_VOR_EINTRAG K_ED_SK_MANAGER_IGN.FEHLERSCHWELLE K_ED_SK_MANAGER_IGN.INC_NACH_EINTRAG K_ED_SK_MANAGER_IGN.INC_VOR_EINTRAG K_ED_SK_MANAGER_IGN.KLASSENINDEX K_ED_SK_MANAGER_IGN.OK_SCHWELLE K_ED_SK_MANAGER_IGN.P_CODE_OPENLOAD K_ED_SK_MANAGER_IGN.P_CODE_SH_TO_GND K_ED_SK_MANAGER_IGN.P_CODE_SH_TO_UB K_ED_SK_MANAGER_IGN.P_CODE_UNPLAUSIBEL K_ED_SK_TR_IGN.DEC_NACH_EINTRAG K_ED_SK_TR_IGN.DEC_VOR_EINTRAG K_ED_SK_TR_IGN.FEHLERSCHWELLE K_ED_SK_TR_IGN.INC_NACH_EINTRAG K_ED_SK_TR_IGN.INC_VOR_EINTRAG K_ED_SK_TR_IGN.KLASSENINDEX K_ED_SK_TR_IGN.OK_SCHWELLE K_ED_SK_TR_IGN.P_CODE_OPENLOAD K_ED_SK_TR_IGN.P_CODE_SH_TO_GND K_ED_SK_TR_IGN.P_CODE_SH_TO_UB K_ED_SK_TR_IGN.P_CODE_UNPLAUSIBEL K_ED_SMG_SCHALTAB.DEC_NACH_EINTRAG K_ED_SMG_SCHALTAB.DEC_VOR_EINTRAG K_ED_SMG_SCHALTAB.FEHLERSCHWELLE K_ED_SMG_SCHALTAB.INC_NACH_EINTRAG K_ED_SMG_SCHALTAB.INC_VOR_EINTRAG K_ED_SMG_SCHALTAB.KLASSENINDEX K_ED_SMG_SCHALTAB.OK_SCHWELLE K_ED_SMG_SCHALTAB.P_CODE_OPENLOAD K_ED_SMG_SCHALTAB.P_CODE_SH_TO_GND K_ED_SMG_SCHALTAB.P_CODE_SH_TO_UB K_ED_SMG_SCHALTAB.P_CODE_UNPLAUSIBEL K_ED_SMG_SK.DEC_NACH_EINTRAG K_ED_SMG_SK.DEC_VOR_EINTRAG /end DEF_CHARACTERISTIC
/end FUNCTION
/begin RECORD_LAYOUT TKW_VV_VV_UB FNC_VALUES 1 UBYTE COLUMN_DIR DIRECT /end RECORD_LAYOUT
/begin RECORD_LAYOUT TKW_VV_VV_UW FNC_VALUES 1 UWORD COLUMN_DIR DIRECT /end RECORD_LAYOUT
/begin RECORD_LAYOUT TKW_VV_VV_SW FNC_VALUES 1 SWORD COLUMN_DIR DIRECT /end RECORD_LAYOUT
/end MODULE
/end PROJECT
