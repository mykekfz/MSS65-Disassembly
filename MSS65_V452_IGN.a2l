/begin PROJECT MSS65-ign-V452 "MSS65 IGN - V452.01-B204.00, data set 0569Q60Z160E"
/begin HEADER "" VERSION "V452.01-B204.00" /end HEADER
/begin MODULE _MSS65-ign "MSS65 IGN - V452.01-B204.00, calibration xxxxxxxx"
/begin MOD_COMMON "" BYTE_ORDER MSB_FIRST /* Default byteorder (Motorola) */ /end MOD_COMMON
/* ------------------ Abschnitt erzeugt aus adapt_common.dat ------------------ */
/begin COMPU_METHOD FORMULA_0000 "FORMULA_0000" RAT_FUNC "%7.0" "-" COEFFS 0 1 0 0 0 1 /end COMPU_METHOD
/begin COMPU_METHOD FORMULA_0003 "FORMULA_0003" RAT_FUNC "%3.0" "-" COEFFS 0 1 0 0 0 1 /end COMPU_METHOD
/begin COMPU_METHOD FORMULA_0010 "FORMULA_0010" RAT_FUNC "%5.0" "-" COEFFS 0 1 0 0 0 1 /end COMPU_METHOD
/begin COMPU_METHOD FORMULA_0027 "FORMULA_0027" RAT_FUNC "%7.0" "km" COEFFS 0 1 0 0 0 1 /end COMPU_METHOD
/begin COMPU_METHOD FORMULA_0033 "FORMULA_0033" RAT_FUNC "%5.2" "-" COEFFS 0 1 0 0 0 1 /end COMPU_METHOD
/* ------------------ Abschnitt erzeugt aus ed_glob.dat ------------------ */
/begin COMPU_METHOD FORMULA_0042 "FORMULA_0042" TAB_VERB "%5.2" "-" COMPU_TAB_REF FORMULA_0042_VTAB /end COMPU_METHOD
/begin COMPU_VTAB FORMULA_0042_VTAB "FORMULA_0042_VTAB" TAB_VERB 1 0 "kein WUC" DEFAULT_VALUE "Warmcycle" /end COMPU_VTAB
/begin COMPU_METHOD FORMULA_0043 "FORMULA_0043" TAB_VERB "%5.2" "-" COMPU_TAB_REF FORMULA_0043_VTAB /end COMPU_METHOD
/begin COMPU_VTAB FORMULA_0043_VTAB "FORMULA_0043_VTAB" TAB_VERB 1 0 "Kein Cycle" DEFAULT_VALUE "Rate-Based-DCY" /end COMPU_VTAB
/begin COMPU_METHOD FORMULA_0044 "FORMULA_0044" TAB_VERB "%5.2" "-" COMPU_TAB_REF FORMULA_0044_VTAB /end COMPU_METHOD
/begin COMPU_VTAB FORMULA_0044_VTAB "FORMULA_0044_VTAB" TAB_VERB 1 0 "Kein RBM-EVAP" DEFAULT_VALUE "RBM-EVAP" /end COMPU_VTAB
/begin COMPU_METHOD FORMULA_0045 "FORMULA_0045" TAB_VERB "%5.2" "-" COMPU_TAB_REF FORMULA_0045_VTAB /end COMPU_METHOD
/begin COMPU_VTAB FORMULA_0045_VTAB "FORMULA_0045_VTAB" TAB_VERB 1 0 "Kein RBM-SLP" DEFAULT_VALUE "RBM-SLP" /end COMPU_VTAB
/begin COMPU_METHOD FORMULA_0046 "FORMULA_0046" TAB_VERB "%5.2" "-" COMPU_TAB_REF FORMULA_0046_VTAB /end COMPU_METHOD
/begin COMPU_VTAB FORMULA_0046_VTAB "FORMULA_0046_VTAB" TAB_VERB 1 0 "Kein Abbruch" DEFAULT_VALUE "Abbruch" /end COMPU_VTAB
/begin COMPU_METHOD FORMULA_0047 "FORMULA_0047" TAB_VERB "%5.2" "-" COMPU_TAB_REF FORMULA_0047_VTAB /end COMPU_METHOD
/begin COMPU_VTAB FORMULA_0047_VTAB "FORMULA_0047_VTAB" TAB_VERB 1 0 "Kein CSS-DEN" DEFAULT_VALUE "CSS-DEN" /end COMPU_VTAB
/begin COMPU_METHOD FORMULA_0048 "FORMULA_0048" TAB_VERB "%5.2" "-" COMPU_TAB_REF FORMULA_0048_VTAB /end COMPU_METHOD
/begin COMPU_VTAB FORMULA_0048_VTAB "FORMULA_0048_VTAB" TAB_VERB 1 0 "Kein CSS-NUM" DEFAULT_VALUE "CSS-NUM" /end COMPU_VTAB
/begin COMPU_METHOD FORMULA_0051 "FORMULA_0051" RAT_FUNC "%5.0" "km" COEFFS 0 1 0 0 0 8 /end COMPU_METHOD
/begin COMPU_METHOD FORMULA_0067 "FORMULA_0067" TAB_VERB "%5.2" "-" COMPU_TAB_REF FORMULA_0067_VTAB /end COMPU_METHOD
/begin COMPU_VTAB FORMULA_0067_VTAB "FORMULA_0067_VTAB" TAB_VERB 1 0 "MIL aus" DEFAULT_VALUE "MIL an" /end COMPU_VTAB
/begin COMPU_METHOD FORMULA_0068 "FORMULA_0068" TAB_VERB "%5.2" "-" COMPU_TAB_REF FORMULA_0068_VTAB /end COMPU_METHOD
/begin COMPU_VTAB FORMULA_0068_VTAB "FORMULA_0068_VTAB" TAB_VERB 1 0 "PRE-MIL aus" DEFAULT_VALUE "PRE-MIL an" /end COMPU_VTAB
/begin COMPU_METHOD FORMULA_0069 "FORMULA_0069" TAB_VERB "%5.2" "-" COMPU_TAB_REF FORMULA_0069_VTAB /end COMPU_METHOD
/begin COMPU_VTAB FORMULA_0069_VTAB "FORMULA_0069_VTAB" TAB_VERB 1 0 "DME-MIL aus" DEFAULT_VALUE "DME-MIL an" /end COMPU_VTAB
/begin COMPU_METHOD FORMULA_0070 "FORMULA_0070" TAB_VERB "%5.2" "-" COMPU_TAB_REF FORMULA_0070_VTAB /end COMPU_METHOD
/begin COMPU_VTAB FORMULA_0070_VTAB "FORMULA_0070_VTAB" TAB_VERB 1 0 "ZYL_OFF-MIL aus" DEFAULT_VALUE "ZYL_OFF-MIL an" /end COMPU_VTAB
/begin COMPU_METHOD FORMULA_0071 "FORMULA_0071" TAB_VERB "%5.2" "-" COMPU_TAB_REF FORMULA_0071_VTAB /end COMPU_METHOD
/begin COMPU_VTAB FORMULA_0071_VTAB "FORMULA_0071_VTAB" TAB_VERB 1 0 "SMG-MIL aus" DEFAULT_VALUE "SMG-MIL an" /end COMPU_VTAB
/begin COMPU_METHOD FORMULA_0072 "FORMULA_0072" TAB_VERB "%3.0" "-" COMPU_TAB_REF FORMULA_0072_VTAB /end COMPU_METHOD
/begin COMPU_VTAB FORMULA_0072_VTAB "FORMULA_0072_VTAB" TAB_VERB 1 165 "fsp_loeschen" DEFAULT_VALUE "fsp_sichern" /end COMPU_VTAB
/begin COMPU_METHOD FORMULA_0073 "FORMULA_0073" RAT_FUNC "%6.1" "s" COEFFS 0 10 0 0 0 1 /end COMPU_METHOD
/begin MEASUREMENT ed_st_nv "Status-Eigendiagnose" UBYTE FORMULA_0033 0 0 0.0 255.0000 ECU_ADDRESS 0x3F9268 /end MEASUREMENT
/begin MEASUREMENT ed_st_nv_wuc "Warmupcycleerkennung" UBYTE FORMULA_0042 0 0 0.0 255.0 ECU_ADDRESS 0x3F9268 BIT_MASK 0x1 /end MEASUREMENT
/begin MEASUREMENT ed_st_nv_rbm_dcy "Rate-Based-DCY" UBYTE FORMULA_0043 0 0 0.0 255.0 ECU_ADDRESS 0x3F9268 BIT_MASK 0x2 /end MEASUREMENT
/begin MEASUREMENT ed_st_nv_rbm_evap "RBM-EVAP-Bedingung" UBYTE FORMULA_0044 0 0 0.0 255.0 ECU_ADDRESS 0x3F9268 BIT_MASK 0x4 /end MEASUREMENT
/begin MEASUREMENT ed_st_nv_rbm_slp "RBM-SLP-Bedingung" UBYTE FORMULA_0045 0 0 0.0 255.0 ECU_ADDRESS 0x3F9268 BIT_MASK 0x8 /end MEASUREMENT
/begin MEASUREMENT ed_st_nv_rbm_abbruch "Abbruch des RBM" UBYTE FORMULA_0046 0 0 0.0 255.0 ECU_ADDRESS 0x3F9268 BIT_MASK 0x10 /end MEASUREMENT
/begin MEASUREMENT ed_st_nv_css_den "CSS-Denominator" UBYTE FORMULA_0047 0 0 0.0 255.0 ECU_ADDRESS 0x3F9268 BIT_MASK 0x20 /end MEASUREMENT
/begin MEASUREMENT ed_st_nv_css_num "CSS-Numerator" UBYTE FORMULA_0048 0 0 0.0 255.0 ECU_ADDRESS 0x3F9268 BIT_MASK 0x40 /end MEASUREMENT
/begin MEASUREMENT ed_rbm_denominator_nv "Status der Denominatorerhoehung" UBYTE FORMULA_0003 0 0 0.0 255.0000 ECU_ADDRESS 0x3F9269 /end MEASUREMENT
/begin MEASUREMENT ed_mil_on_km_stand_nv "Kilometerstand MIL on" ULONG FORMULA_0027 0 0 0.0 16777214.0000 ECU_ADDRESS 0x3F926C /end MEASUREMENT
/begin MEASUREMENT ed_mil_off_km_stand_nv "Kilometerstand MIL off" ULONG FORMULA_0027 0 0 0.0 16777214.0000 ECU_ADDRESS 0x3F9270 /end MEASUREMENT
/begin MEASUREMENT ed_scdn_st_nv "Welche Fehler muessen mit similar Conditions behandelt werden" ULONG FORMULA_0000 0 0 0.0 4294967295.0000 ECU_ADDRESS 0x3F9274 /end MEASUREMENT
/begin MEASUREMENT ed_rbm_sk_tr_ign.numerator_nv "Diagnosezyklen" UWORD FORMULA_0010 0 0 0.0 65535.0000 ECU_ADDRESS 0x3F9578 /end MEASUREMENT
/begin MEASUREMENT ed_rbm_tmot.numerator_nv "Diagnosezyklen" UWORD FORMULA_0010 0 0 0.0 65535.0000 ECU_ADDRESS 0x3F957C /end MEASUREMENT
/begin MEASUREMENT ed_rbm_tmot_obd.numerator_nv "Diagnosezyklen" UWORD FORMULA_0010 0 0 0.0 65535.0000 ECU_ADDRESS 0x3F9580 /end MEASUREMENT
/begin MEASUREMENT ed_rbm_tan1.numerator_nv "Diagnosezyklen" UWORD FORMULA_0010 0 0 0.0 65535.0000 ECU_ADDRESS 0x3F9584 /end MEASUREMENT
/begin MEASUREMENT ed_rbm_tan2.numerator_nv "Diagnosezyklen" UWORD FORMULA_0010 0 0 0.0 65535.0000 ECU_ADDRESS 0x3F9588 /end MEASUREMENT
/begin MEASUREMENT ed_rbm_time_rel_obd.numerator_nv "Diagnosezyklen" UWORD FORMULA_0010 0 0 0.0 65535.0000 ECU_ADDRESS 0x3F958C /end MEASUREMENT
/begin MEASUREMENT ed_rbm_ub.numerator_nv "Diagnosezyklen" UWORD FORMULA_0010 0 0 0.0 65535.0000 ECU_ADDRESS 0x3F9590 /end MEASUREMENT
/begin MEASUREMENT ed_rbm_tka.numerator_nv "Diagnosezyklen" UWORD FORMULA_0010 0 0 0.0 65535.0000 ECU_ADDRESS 0x3F9594 /end MEASUREMENT
/begin MEASUREMENT ed_rbm_tdme.numerator_nv "Diagnosezyklen" UWORD FORMULA_0010 0 0 0.0 65535.0000 ECU_ADDRESS 0x3F9598 /end MEASUREMENT
/begin MEASUREMENT ed_rbm_uext_111219514.numerator_nv "Diagnosezyklen" UWORD FORMULA_0010 0 0 0.0 65535.0000 ECU_ADDRESS 0x3F959C /end MEASUREMENT
/begin MEASUREMENT ed_rbm_uext_124_512.numerator_nv "Diagnosezyklen" UWORD FORMULA_0010 0 0 0.0 65535.0000 ECU_ADDRESS 0x3F95A0 /end MEASUREMENT
/begin MEASUREMENT ed_rbm_appl_data_ign.numerator_nv "Diagnosezyklen" UWORD FORMULA_0010 0 0 0.0 65535.0000 ECU_ADDRESS 0x3F95A4 /end MEASUREMENT
/begin MEASUREMENT ed_rbm_tka_obd.numerator_nv "Diagnosezyklen" UWORD FORMULA_0010 0 0 0.0 65535.0000 ECU_ADDRESS 0x3F95A8 /end MEASUREMENT
/begin MEASUREMENT ed_rbm_pwg1.numerator_nv "Diagnosezyklen" UWORD FORMULA_0010 0 0 0.0 65535.0000 ECU_ADDRESS 0x3F95AC /end MEASUREMENT
/begin MEASUREMENT ed_rbm_pwg2.numerator_nv "Diagnosezyklen" UWORD FORMULA_0010 0 0 0.0 65535.0000 ECU_ADDRESS 0x3F95B0 /end MEASUREMENT
/begin MEASUREMENT ed_rbm_pwg_vgl.numerator_nv "Diagnosezyklen" UWORD FORMULA_0010 0 0 0.0 65535.0000 ECU_ADDRESS 0x3F95B4 /end MEASUREMENT
/begin MEASUREMENT ed_rbm_pctrl_ign.numerator_nv "Diagnosezyklen" UWORD FORMULA_0010 0 0 0.0 65535.0000 ECU_ADDRESS 0x3F95B8 /end MEASUREMENT
/begin MEASUREMENT ed_rbm_lls1_can.numerator_nv "Diagnosezyklen" UWORD FORMULA_0010 0 0 0.0 65535.0000 ECU_ADDRESS 0x3F95BC /end MEASUREMENT
/begin MEASUREMENT ed_rbm_lls2_can.numerator_nv "Diagnosezyklen" UWORD FORMULA_0010 0 0 0.0 65535.0000 ECU_ADDRESS 0x3F95C0 /end MEASUREMENT
/begin MEASUREMENT ed_rbm_dk1_can.numerator_nv "Diagnosezyklen" UWORD FORMULA_0010 0 0 0.0 65535.0000 ECU_ADDRESS 0x3F95C4 /end MEASUREMENT
/begin MEASUREMENT ed_rbm_dk2_can.numerator_nv "Diagnosezyklen" UWORD FORMULA_0010 0 0 0.0 65535.0000 ECU_ADDRESS 0x3F95C8 /end MEASUREMENT
/begin MEASUREMENT ed_rbm_lls1_sk.numerator_nv "Diagnosezyklen" UWORD FORMULA_0010 0 0 0.0 65535.0000 ECU_ADDRESS 0x3F95CC /end MEASUREMENT
/begin MEASUREMENT ed_rbm_lls2_sk.numerator_nv "Diagnosezyklen" UWORD FORMULA_0010 0 0 0.0 65535.0000 ECU_ADDRESS 0x3F95D0 /end MEASUREMENT
/begin MEASUREMENT ed_rbm_smg_schaltab.numerator_nv "Diagnosezyklen" UWORD FORMULA_0010 0 0 0.0 65535.0000 ECU_ADDRESS 0x3F95D4 /end MEASUREMENT
/begin MEASUREMENT ed_rbm_smg_sk.numerator_nv "Diagnosezyklen" UWORD FORMULA_0010 0 0 0.0 65535.0000 ECU_ADDRESS 0x3F95D8 /end MEASUREMENT
/begin MEASUREMENT ed_rbm_smg_sk_n.numerator_nv "Diagnosezyklen" UWORD FORMULA_0010 0 0 0.0 65535.0000 ECU_ADDRESS 0x3F95DC /end MEASUREMENT
/begin MEASUREMENT ed_rbm_tumg_obd.numerator_nv "Diagnosezyklen" UWORD FORMULA_0010 0 0 0.0 65535.0000 ECU_ADDRESS 0x3F95E0 /end MEASUREMENT
/begin MEASUREMENT ed_rbm_v_direkt.numerator_nv "Diagnosezyklen" UWORD FORMULA_0010 0 0 0.0 65535.0000 ECU_ADDRESS 0x3F95E4 /end MEASUREMENT
/begin MEASUREMENT ed_rbm_dk_init.numerator_nv "Diagnosezyklen" UWORD FORMULA_0010 0 0 0.0 65535.0000 ECU_ADDRESS 0x3F95E8 /end MEASUREMENT
/begin MEASUREMENT ed_rbm_dk1_regler.numerator_nv "Diagnosezyklen" UWORD FORMULA_0010 0 0 0.0 65535.0000 ECU_ADDRESS 0x3F95EC /end MEASUREMENT
/begin MEASUREMENT ed_rbm_dk2_regler.numerator_nv "Diagnosezyklen" UWORD FORMULA_0010 0 0 0.0 65535.0000 ECU_ADDRESS 0x3F95F0 /end MEASUREMENT
/begin MEASUREMENT ed_rbm_dk1_adapt.numerator_nv "Diagnosezyklen" UWORD FORMULA_0010 0 0 0.0 65535.0000 ECU_ADDRESS 0x3F95F4 /end MEASUREMENT
/begin MEASUREMENT ed_rbm_dk2_adapt.numerator_nv "Diagnosezyklen" UWORD FORMULA_0010 0 0 0.0 65535.0000 ECU_ADDRESS 0x3F95F8 /end MEASUREMENT
/begin MEASUREMENT ed_rbm_ionverst_b1.numerator_nv "Diagnosezyklen" UWORD FORMULA_0010 0 0 0.0 65535.0000 ECU_ADDRESS 0x3F95FC /end MEASUREMENT
/begin MEASUREMENT ed_rbm_ionspg_b1.numerator_nv "Diagnosezyklen" UWORD FORMULA_0010 0 0 0.0 65535.0000 ECU_ADDRESS 0x3F9600 /end MEASUREMENT
/begin MEASUREMENT ed_rbm_ionverst_b2.numerator_nv "Diagnosezyklen" UWORD FORMULA_0010 0 0 0.0 65535.0000 ECU_ADDRESS 0x3F9604 /end MEASUREMENT
/begin MEASUREMENT ed_rbm_ionspg_b2.numerator_nv "Diagnosezyklen" UWORD FORMULA_0010 0 0 0.0 65535.0000 ECU_ADDRESS 0x3F9608 /end MEASUREMENT
/begin MEASUREMENT ed_rbm_tabg1.numerator_nv "Diagnosezyklen" UWORD FORMULA_0010 0 0 0.0 65535.0000 ECU_ADDRESS 0x3F960C /end MEASUREMENT
/begin MEASUREMENT ed_rbm_tabg2.numerator_nv "Diagnosezyklen" UWORD FORMULA_0010 0 0 0.0 65535.0000 ECU_ADDRESS 0x3F9610 /end MEASUREMENT
/begin MEASUREMENT ed_rbm_dk1_wdk.numerator_nv "Diagnosezyklen" UWORD FORMULA_0010 0 0 0.0 65535.0000 ECU_ADDRESS 0x3F9614 /end MEASUREMENT
/begin MEASUREMENT ed_rbm_dk2_wdk.numerator_nv "Diagnosezyklen" UWORD FORMULA_0010 0 0 0.0 65535.0000 ECU_ADDRESS 0x3F9618 /end MEASUREMENT
/begin MEASUREMENT ed_rbm_dk1_pdr.numerator_nv "Diagnosezyklen" UWORD FORMULA_0010 0 0 0.0 65535.0000 ECU_ADDRESS 0x3F961C /end MEASUREMENT
/begin MEASUREMENT ed_rbm_dk2_pdr.numerator_nv "Diagnosezyklen" UWORD FORMULA_0010 0 0 0.0 65535.0000 ECU_ADDRESS 0x3F9620 /end MEASUREMENT
/begin MEASUREMENT ed_rbm_lls1_regler.numerator_nv "Diagnosezyklen" UWORD FORMULA_0010 0 0 0.0 65535.0000 ECU_ADDRESS 0x3F9624 /end MEASUREMENT
/begin MEASUREMENT ed_rbm_lls2_regler.numerator_nv "Diagnosezyklen" UWORD FORMULA_0010 0 0 0.0 65535.0000 ECU_ADDRESS 0x3F9628 /end MEASUREMENT
/begin MEASUREMENT ed_rbm_dk1_sk_err.numerator_nv "Diagnosezyklen" UWORD FORMULA_0010 0 0 0.0 65535.0000 ECU_ADDRESS 0x3F962C /end MEASUREMENT
/begin MEASUREMENT ed_rbm_dk2_sk_err.numerator_nv "Diagnosezyklen" UWORD FORMULA_0010 0 0 0.0 65535.0000 ECU_ADDRESS 0x3F9630 /end MEASUREMENT
/begin MEASUREMENT ed_rbm_dk1_federn.numerator_nv "Diagnosezyklen" UWORD FORMULA_0010 0 0 0.0 65535.0000 ECU_ADDRESS 0x3F9634 /end MEASUREMENT
/begin MEASUREMENT ed_rbm_dk2_federn.numerator_nv "Diagnosezyklen" UWORD FORMULA_0010 0 0 0.0 65535.0000 ECU_ADDRESS 0x3F9638 /end MEASUREMENT
/begin MEASUREMENT ed_rbm_md_sk_err.numerator_nv "Diagnosezyklen" UWORD FORMULA_0010 0 0 0.0 65535.0000 ECU_ADDRESS 0x3F963C /end MEASUREMENT
/begin MEASUREMENT ed_rbm_lls_init.numerator_nv "Diagnosezyklen" UWORD FORMULA_0010 0 0 0.0 65535.0000 ECU_ADDRESS 0x3F9640 /end MEASUREMENT
/begin MEASUREMENT ed_rbm_dsc_eingr.numerator_nv "Diagnosezyklen" UWORD FORMULA_0010 0 0 0.0 65535.0000 ECU_ADDRESS 0x3F9644 /end MEASUREMENT
/begin MEASUREMENT ed_rbm_dk1_cmd.numerator_nv "Diagnosezyklen" UWORD FORMULA_0010 0 0 0.0 65535.0000 ECU_ADDRESS 0x3F9648 /end MEASUREMENT
/begin MEASUREMENT ed_rbm_dk2_cmd.numerator_nv "Diagnosezyklen" UWORD FORMULA_0010 0 0 0.0 65535.0000 ECU_ADDRESS 0x3F964C /end MEASUREMENT
/begin MEASUREMENT ed_rbm_lls1_cmd.numerator_nv "Diagnosezyklen" UWORD FORMULA_0010 0 0 0.0 65535.0000 ECU_ADDRESS 0x3F9650 /end MEASUREMENT
/begin MEASUREMENT ed_rbm_lls2_cmd.numerator_nv "Diagnosezyklen" UWORD FORMULA_0010 0 0 0.0 65535.0000 ECU_ADDRESS 0x3F9654 /end MEASUREMENT
/begin MEASUREMENT ed_rbm_sc_smg1.numerator_nv "Diagnosezyklen" UWORD FORMULA_0010 0 0 0.0 65535.0000 ECU_ADDRESS 0x3F9658 /end MEASUREMENT
/begin MEASUREMENT ed_rbm_sc_smg2.numerator_nv "Diagnosezyklen" UWORD FORMULA_0010 0 0 0.0 65535.0000 ECU_ADDRESS 0x3F965C /end MEASUREMENT
/begin MEASUREMENT ed_rbm_sc_smg3.numerator_nv "Diagnosezyklen" UWORD FORMULA_0010 0 0 0.0 65535.0000 ECU_ADDRESS 0x3F9660 /end MEASUREMENT
/begin MEASUREMENT ed_rbm_sc_busoff.numerator_nv "Diagnosezyklen" UWORD FORMULA_0010 0 0 0.0 65535.0000 ECU_ADDRESS 0x3F9664 /end MEASUREMENT
/begin MEASUREMENT ed_rbm_ec_busoff.numerator_nv "Diagnosezyklen" UWORD FORMULA_0010 0 0 0.0 65535.0000 ECU_ADDRESS 0x3F9668 /end MEASUREMENT
/begin MEASUREMENT ed_rbm_auss_kat_z1.numerator_nv "Diagnosezyklen" UWORD FORMULA_0010 0 0 0.0 65535.0000 ECU_ADDRESS 0x3F966C /end MEASUREMENT
/begin MEASUREMENT ed_rbm_auss_kat_z2.numerator_nv "Diagnosezyklen" UWORD FORMULA_0010 0 0 0.0 65535.0000 ECU_ADDRESS 0x3F9670 /end MEASUREMENT
/begin MEASUREMENT ed_rbm_auss_kat_z3.numerator_nv "Diagnosezyklen" UWORD FORMULA_0010 0 0 0.0 65535.0000 ECU_ADDRESS 0x3F9674 /end MEASUREMENT
/begin MEASUREMENT ed_rbm_auss_kat_z4.numerator_nv "Diagnosezyklen" UWORD FORMULA_0010 0 0 0.0 65535.0000 ECU_ADDRESS 0x3F9678 /end MEASUREMENT
/begin MEASUREMENT ed_rbm_auss_kat_z5.numerator_nv "Diagnosezyklen" UWORD FORMULA_0010 0 0 0.0 65535.0000 ECU_ADDRESS 0x3F967C /end MEASUREMENT
/begin MEASUREMENT ed_rbm_auss_kat_z6.numerator_nv "Diagnosezyklen" UWORD FORMULA_0010 0 0 0.0 65535.0000 ECU_ADDRESS 0x3F9680 /end MEASUREMENT
/begin MEASUREMENT ed_rbm_auss_kat_z7.numerator_nv "Diagnosezyklen" UWORD FORMULA_0010 0 0 0.0 65535.0000 ECU_ADDRESS 0x3F9684 /end MEASUREMENT
/begin MEASUREMENT ed_rbm_auss_kat_z8.numerator_nv "Diagnosezyklen" UWORD FORMULA_0010 0 0 0.0 65535.0000 ECU_ADDRESS 0x3F9688 /end MEASUREMENT
/begin MEASUREMENT ed_rbm_auss_kat_z9.numerator_nv "Diagnosezyklen" UWORD FORMULA_0010 0 0 0.0 65535.0000 ECU_ADDRESS 0x3F968C /end MEASUREMENT
/begin MEASUREMENT ed_rbm_auss_kat_z10.numerator_nv "Diagnosezyklen" UWORD FORMULA_0010 0 0 0.0 65535.0000 ECU_ADDRESS 0x3F9690 /end MEASUREMENT
/begin MEASUREMENT ed_rbm_ion_sig_b1.numerator_nv "Diagnosezyklen" UWORD FORMULA_0010 0 0 0.0 65535.0000 ECU_ADDRESS 0x3F9694 /end MEASUREMENT
/begin MEASUREMENT ed_rbm_ion_sig_b2.numerator_nv "Diagnosezyklen" UWORD FORMULA_0010 0 0 0.0 65535.0000 ECU_ADDRESS 0x3F9698 /end MEASUREMENT
/begin MEASUREMENT ed_rbm_auss_kat_mult.numerator_nv "Diagnosezyklen" UWORD FORMULA_0010 0 0 0.0 65535.0000 ECU_ADDRESS 0x3F969C /end MEASUREMENT
/begin MEASUREMENT ed_rbm_auss_abg_z1.numerator_nv "Diagnosezyklen" UWORD FORMULA_0010 0 0 0.0 65535.0000 ECU_ADDRESS 0x3F96A0 /end MEASUREMENT
/begin MEASUREMENT ed_rbm_auss_abg_z2.numerator_nv "Diagnosezyklen" UWORD FORMULA_0010 0 0 0.0 65535.0000 ECU_ADDRESS 0x3F96A4 /end MEASUREMENT
/begin MEASUREMENT ed_rbm_auss_abg_z3.numerator_nv "Diagnosezyklen" UWORD FORMULA_0010 0 0 0.0 65535.0000 ECU_ADDRESS 0x3F96A8 /end MEASUREMENT
/begin MEASUREMENT ed_rbm_auss_abg_z4.numerator_nv "Diagnosezyklen" UWORD FORMULA_0010 0 0 0.0 65535.0000 ECU_ADDRESS 0x3F96AC /end MEASUREMENT
/begin MEASUREMENT ed_rbm_auss_abg_z5.numerator_nv "Diagnosezyklen" UWORD FORMULA_0010 0 0 0.0 65535.0000 ECU_ADDRESS 0x3F96B0 /end MEASUREMENT
/begin MEASUREMENT ed_rbm_auss_abg_z6.numerator_nv "Diagnosezyklen" UWORD FORMULA_0010 0 0 0.0 65535.0000 ECU_ADDRESS 0x3F96B4 /end MEASUREMENT
/begin MEASUREMENT ed_rbm_auss_abg_z7.numerator_nv "Diagnosezyklen" UWORD FORMULA_0010 0 0 0.0 65535.0000 ECU_ADDRESS 0x3F96B8 /end MEASUREMENT
/begin MEASUREMENT ed_rbm_auss_abg_z8.numerator_nv "Diagnosezyklen" UWORD FORMULA_0010 0 0 0.0 65535.0000 ECU_ADDRESS 0x3F96BC /end MEASUREMENT
/begin MEASUREMENT ed_rbm_auss_abg_z9.numerator_nv "Diagnosezyklen" UWORD FORMULA_0010 0 0 0.0 65535.0000 ECU_ADDRESS 0x3F96C0 /end MEASUREMENT
/begin MEASUREMENT ed_rbm_auss_abg_z10.numerator_nv "Diagnosezyklen" UWORD FORMULA_0010 0 0 0.0 65535.0000 ECU_ADDRESS 0x3F96C4 /end MEASUREMENT
/begin MEASUREMENT ed_rbm_ion_sat_b1.numerator_nv "Diagnosezyklen" UWORD FORMULA_0010 0 0 0.0 65535.0000 ECU_ADDRESS 0x3F96C8 /end MEASUREMENT
/begin MEASUREMENT ed_rbm_ion_sat_b2.numerator_nv "Diagnosezyklen" UWORD FORMULA_0010 0 0 0.0 65535.0000 ECU_ADDRESS 0x3F96CC /end MEASUREMENT
/begin MEASUREMENT ed_rbm_auss_abg_mult.numerator_nv "Diagnosezyklen" UWORD FORMULA_0010 0 0 0.0 65535.0000 ECU_ADDRESS 0x3F96D0 /end MEASUREMENT
/begin MEASUREMENT ed_rbm_tan_obd_b1.numerator_nv "Diagnosezyklen" UWORD FORMULA_0010 0 0 0.0 65535.0000 ECU_ADDRESS 0x3F96D4 /end MEASUREMENT
/begin MEASUREMENT ed_rbm_index_88_ign.numerator_nv "Diagnosezyklen" UWORD FORMULA_0010 0 0 0.0 65535.0000 ECU_ADDRESS 0x3F96D8 /end MEASUREMENT
/begin MEASUREMENT ed_rbm_index_89_ign.numerator_nv "Diagnosezyklen" UWORD FORMULA_0010 0 0 0.0 65535.0000 ECU_ADDRESS 0x3F96DC /end MEASUREMENT
/begin MEASUREMENT ed_rbm_zoelp1.numerator_nv "Diagnosezyklen" UWORD FORMULA_0010 0 0 0.0 65535.0000 ECU_ADDRESS 0x3F96E0 /end MEASUREMENT
/begin MEASUREMENT ed_rbm_zoelp2.numerator_nv "Diagnosezyklen" UWORD FORMULA_0010 0 0 0.0 65535.0000 ECU_ADDRESS 0x3F96E4 /end MEASUREMENT
/begin MEASUREMENT ed_rbm_sg_ign.numerator_nv "Diagnosezyklen" UWORD FORMULA_0010 0 0 0.0 65535.0000 ECU_ADDRESS 0x3F96E8 /end MEASUREMENT
/begin MEASUREMENT ed_rbm_e2_ign.numerator_nv "Diagnosezyklen" UWORD FORMULA_0010 0 0 0.0 65535.0000 ECU_ADDRESS 0x3F96EC /end MEASUREMENT
/begin MEASUREMENT ed_rbm_bls_plau.numerator_nv "Diagnosezyklen" UWORD FORMULA_0010 0 0 0.0 65535.0000 ECU_ADDRESS 0x3F96F0 /end MEASUREMENT
/begin MEASUREMENT ed_rbm_sk_manager_ign.numerator_nv "Diagnosezyklen" UWORD FORMULA_0010 0 0 0.0 65535.0000 ECU_ADDRESS 0x3F96F4 /end MEASUREMENT
/begin MEASUREMENT ed_rbm_llr_diag.numerator_nv "Diagnosezyklen" UWORD FORMULA_0010 0 0 0.0 65535.0000 ECU_ADDRESS 0x3F96F8 /end MEASUREMENT
/begin MEASUREMENT ed_rbm_thermostat.numerator_nv "Diagnosezyklen" UWORD FORMULA_0010 0 0 0.0 65535.0000 ECU_ADDRESS 0x3F96FC /end MEASUREMENT
/begin MEASUREMENT ed_rbm_tan_obd_b2.numerator_nv "Diagnosezyklen" UWORD FORMULA_0010 0 0 0.0 65535.0000 ECU_ADDRESS 0x3F9700 /end MEASUREMENT
/begin MEASUREMENT ed_rbm_dk1_zust.numerator_nv "Diagnosezyklen" UWORD FORMULA_0010 0 0 0.0 65535.0000 ECU_ADDRESS 0x3F9704 /end MEASUREMENT
/begin MEASUREMENT ed_rbm_dk2_zust.numerator_nv "Diagnosezyklen" UWORD FORMULA_0010 0 0 0.0 65535.0000 ECU_ADDRESS 0x3F9708 /end MEASUREMENT
/begin MEASUREMENT ed_rbm_fgr_abwurf.numerator_nv "Diagnosezyklen" UWORD FORMULA_0010 0 0 0.0 65535.0000 ECU_ADDRESS 0x3F970C /end MEASUREMENT
/begin MEASUREMENT ed_rbm_pwg_bls.numerator_nv "Diagnosezyklen" UWORD FORMULA_0010 0 0 0.0 65535.0000 ECU_ADDRESS 0x3F9710 /end MEASUREMENT
/begin MEASUREMENT ed_rbm_start_rl.numerator_nv "Diagnosezyklen" UWORD FORMULA_0010 0 0 0.0 65535.0000 ECU_ADDRESS 0x3F9714 /end MEASUREMENT
/begin MEASUREMENT ed_rbm_afz_hs.numerator_nv "Diagnosezyklen" UWORD FORMULA_0010 0 0 0.0 65535.0000 ECU_ADDRESS 0x3F9718 /end MEASUREMENT
/begin MEASUREMENT ed_rbm_n_getr_ein_hs.numerator_nv "Diagnosezyklen" UWORD FORMULA_0010 0 0 0.0 65535.0000 ECU_ADDRESS 0x3F971C /end MEASUREMENT
/begin MEASUREMENT ed_rbm_tumg.numerator_nv "Diagnosezyklen" UWORD FORMULA_0010 0 0 0.0 65535.0000 ECU_ADDRESS 0x3F9720 /end MEASUREMENT
/begin MEASUREMENT ed_rbm_llr_diag_css.numerator_nv "Diagnosezyklen" UWORD FORMULA_0010 0 0 0.0 65535.0000 ECU_ADDRESS 0x3F9724 /end MEASUREMENT
/begin MEASUREMENT ed_rbm_tmot_obd_high.numerator_nv "Diagnosezyklen" UWORD FORMULA_0010 0 0 0.0 65535.0000 ECU_ADDRESS 0x3F9728 /end MEASUREMENT
/begin MEASUREMENT ed_rbm_afz_hs_na.numerator_nv "Diagnosezyklen" UWORD FORMULA_0010 0 0 0.0 65535.0000 ECU_ADDRESS 0x3F972C /end MEASUREMENT
/begin MEASUREMENT ed_rbm_index_110_ign.numerator_nv "Diagnosezyklen" UWORD FORMULA_0010 0 0 0.0 65535.0000 ECU_ADDRESS 0x3F9730 /end MEASUREMENT
/begin MEASUREMENT ed_rbm_index_111_ign.numerator_nv "Diagnosezyklen" UWORD FORMULA_0010 0 0 0.0 65535.0000 ECU_ADDRESS 0x3F9734 /end MEASUREMENT
/begin MEASUREMENT ed_rbm_index_112_ign.numerator_nv "Diagnosezyklen" UWORD FORMULA_0010 0 0 0.0 65535.0000 ECU_ADDRESS 0x3F9738 /end MEASUREMENT
/begin MEASUREMENT ed_rbm_index_113_ign.numerator_nv "Diagnosezyklen" UWORD FORMULA_0010 0 0 0.0 65535.0000 ECU_ADDRESS 0x3F973C /end MEASUREMENT
/begin MEASUREMENT ed_rbm_index_114_ign.numerator_nv "Diagnosezyklen" UWORD FORMULA_0010 0 0 0.0 65535.0000 ECU_ADDRESS 0x3F9740 /end MEASUREMENT
/begin MEASUREMENT ed_rbm_index_115_ign.numerator_nv "Diagnosezyklen" UWORD FORMULA_0010 0 0 0.0 65535.0000 ECU_ADDRESS 0x3F9744 /end MEASUREMENT
/begin MEASUREMENT ed_rbm_index_116_ign.numerator_nv "Diagnosezyklen" UWORD FORMULA_0010 0 0 0.0 65535.0000 ECU_ADDRESS 0x3F9748 /end MEASUREMENT
/begin MEASUREMENT ed_rbm_index_117_ign.numerator_nv "Diagnosezyklen" UWORD FORMULA_0010 0 0 0.0 65535.0000 ECU_ADDRESS 0x3F974C /end MEASUREMENT
/begin MEASUREMENT ed_rbm_index_118_ign.numerator_nv "Diagnosezyklen" UWORD FORMULA_0010 0 0 0.0 65535.0000 ECU_ADDRESS 0x3F9750 /end MEASUREMENT
/begin MEASUREMENT ed_rbm_index_119_ign.numerator_nv "Diagnosezyklen" UWORD FORMULA_0010 0 0 0.0 65535.0000 ECU_ADDRESS 0x3F9754 /end MEASUREMENT
/begin MEASUREMENT ed_rbm_index_120_ign.numerator_nv "Diagnosezyklen" UWORD FORMULA_0010 0 0 0.0 65535.0000 ECU_ADDRESS 0x3F9758 /end MEASUREMENT
/begin MEASUREMENT ed_rbm_index_121_ign.numerator_nv "Diagnosezyklen" UWORD FORMULA_0010 0 0 0.0 65535.0000 ECU_ADDRESS 0x3F975C /end MEASUREMENT
/begin MEASUREMENT ed_rbm_index_122_ign.numerator_nv "Diagnosezyklen" UWORD FORMULA_0010 0 0 0.0 65535.0000 ECU_ADDRESS 0x3F9760 /end MEASUREMENT
/begin MEASUREMENT ed_rbm_index_123_ign.numerator_nv "Diagnosezyklen" UWORD FORMULA_0010 0 0 0.0 65535.0000 ECU_ADDRESS 0x3F9764 /end MEASUREMENT
/begin MEASUREMENT ed_rbm_index_124_ign.numerator_nv "Diagnosezyklen" UWORD FORMULA_0010 0 0 0.0 65535.0000 ECU_ADDRESS 0x3F9768 /end MEASUREMENT
/begin MEASUREMENT ed_rbm_index_125_ign.numerator_nv "Diagnosezyklen" UWORD FORMULA_0010 0 0 0.0 65535.0000 ECU_ADDRESS 0x3F976C /end MEASUREMENT
/begin MEASUREMENT ed_rbm_index_126_ign.numerator_nv "Diagnosezyklen" UWORD FORMULA_0010 0 0 0.0 65535.0000 ECU_ADDRESS 0x3F9770 /end MEASUREMENT
/begin MEASUREMENT ed_rbm_index_127_ign.numerator_nv "Diagnosezyklen" UWORD FORMULA_0010 0 0 0.0 65535.0000 ECU_ADDRESS 0x3F9774 /end MEASUREMENT
/begin MEASUREMENT ed_rbm_sk_tr_ign.denominator_nv "Fahrzyklen" UWORD FORMULA_0010 0 0 0.0 65535.0000 ECU_ADDRESS 0x3F957A /end MEASUREMENT
/begin MEASUREMENT ed_rbm_tmot.denominator_nv "Fahrzyklen" UWORD FORMULA_0010 0 0 0.0 65535.0000 ECU_ADDRESS 0x3F957E /end MEASUREMENT
/begin MEASUREMENT ed_rbm_tmot_obd.denominator_nv "Fahrzyklen" UWORD FORMULA_0010 0 0 0.0 65535.0000 ECU_ADDRESS 0x3F9582 /end MEASUREMENT
/begin MEASUREMENT ed_rbm_tan1.denominator_nv "Fahrzyklen" UWORD FORMULA_0010 0 0 0.0 65535.0000 ECU_ADDRESS 0x3F9586 /end MEASUREMENT
/begin MEASUREMENT ed_rbm_tan2.denominator_nv "Fahrzyklen" UWORD FORMULA_0010 0 0 0.0 65535.0000 ECU_ADDRESS 0x3F958A /end MEASUREMENT
/begin MEASUREMENT ed_rbm_time_rel_obd.denominator_nv "Fahrzyklen" UWORD FORMULA_0010 0 0 0.0 65535.0000 ECU_ADDRESS 0x3F958E /end MEASUREMENT
/begin MEASUREMENT ed_rbm_ub.denominator_nv "Fahrzyklen" UWORD FORMULA_0010 0 0 0.0 65535.0000 ECU_ADDRESS 0x3F9592 /end MEASUREMENT
/begin MEASUREMENT ed_rbm_tka.denominator_nv "Fahrzyklen" UWORD FORMULA_0010 0 0 0.0 65535.0000 ECU_ADDRESS 0x3F9596 /end MEASUREMENT
/begin MEASUREMENT ed_rbm_tdme.denominator_nv "Fahrzyklen" UWORD FORMULA_0010 0 0 0.0 65535.0000 ECU_ADDRESS 0x3F959A /end MEASUREMENT
/begin MEASUREMENT ed_rbm_uext_111219514.denominator_nv "Fahrzyklen" UWORD FORMULA_0010 0 0 0.0 65535.0000 ECU_ADDRESS 0x3F959E /end MEASUREMENT
/begin MEASUREMENT ed_rbm_uext_124_512.denominator_nv "Fahrzyklen" UWORD FORMULA_0010 0 0 0.0 65535.0000 ECU_ADDRESS 0x3F95A2 /end MEASUREMENT
/begin MEASUREMENT ed_rbm_appl_data_ign.denominator_nv "Fahrzyklen" UWORD FORMULA_0010 0 0 0.0 65535.0000 ECU_ADDRESS 0x3F95A6 /end MEASUREMENT
/begin MEASUREMENT ed_rbm_tka_obd.denominator_nv "Fahrzyklen" UWORD FORMULA_0010 0 0 0.0 65535.0000 ECU_ADDRESS 0x3F95AA /end MEASUREMENT
/begin MEASUREMENT ed_rbm_pwg1.denominator_nv "Fahrzyklen" UWORD FORMULA_0010 0 0 0.0 65535.0000 ECU_ADDRESS 0x3F95AE /end MEASUREMENT
/begin MEASUREMENT ed_rbm_pwg2.denominator_nv "Fahrzyklen" UWORD FORMULA_0010 0 0 0.0 65535.0000 ECU_ADDRESS 0x3F95B2 /end MEASUREMENT
/begin MEASUREMENT ed_rbm_pwg_vgl.denominator_nv "Fahrzyklen" UWORD FORMULA_0010 0 0 0.0 65535.0000 ECU_ADDRESS 0x3F95B6 /end MEASUREMENT
/begin MEASUREMENT ed_rbm_pctrl_ign.denominator_nv "Fahrzyklen" UWORD FORMULA_0010 0 0 0.0 65535.0000 ECU_ADDRESS 0x3F95BA /end MEASUREMENT
/begin MEASUREMENT ed_rbm_lls1_can.denominator_nv "Fahrzyklen" UWORD FORMULA_0010 0 0 0.0 65535.0000 ECU_ADDRESS 0x3F95BE /end MEASUREMENT
/begin MEASUREMENT ed_rbm_lls2_can.denominator_nv "Fahrzyklen" UWORD FORMULA_0010 0 0 0.0 65535.0000 ECU_ADDRESS 0x3F95C2 /end MEASUREMENT
/begin MEASUREMENT ed_rbm_dk1_can.denominator_nv "Fahrzyklen" UWORD FORMULA_0010 0 0 0.0 65535.0000 ECU_ADDRESS 0x3F95C6 /end MEASUREMENT
/begin MEASUREMENT ed_rbm_dk2_can.denominator_nv "Fahrzyklen" UWORD FORMULA_0010 0 0 0.0 65535.0000 ECU_ADDRESS 0x3F95CA /end MEASUREMENT
/begin MEASUREMENT ed_rbm_lls1_sk.denominator_nv "Fahrzyklen" UWORD FORMULA_0010 0 0 0.0 65535.0000 ECU_ADDRESS 0x3F95CE /end MEASUREMENT
/begin MEASUREMENT ed_rbm_lls2_sk.denominator_nv "Fahrzyklen" UWORD FORMULA_0010 0 0 0.0 65535.0000 ECU_ADDRESS 0x3F95D2 /end MEASUREMENT
/begin MEASUREMENT ed_rbm_smg_schaltab.denominator_nv "Fahrzyklen" UWORD FORMULA_0010 0 0 0.0 65535.0000 ECU_ADDRESS 0x3F95D6 /end MEASUREMENT
/begin MEASUREMENT ed_rbm_smg_sk.denominator_nv "Fahrzyklen" UWORD FORMULA_0010 0 0 0.0 65535.0000 ECU_ADDRESS 0x3F95DA /end MEASUREMENT
/begin MEASUREMENT ed_rbm_smg_sk_n.denominator_nv "Fahrzyklen" UWORD FORMULA_0010 0 0 0.0 65535.0000 ECU_ADDRESS 0x3F95DE /end MEASUREMENT
/begin MEASUREMENT ed_rbm_tumg_obd.denominator_nv "Fahrzyklen" UWORD FORMULA_0010 0 0 0.0 65535.0000 ECU_ADDRESS 0x3F95E2 /end MEASUREMENT
/begin MEASUREMENT ed_rbm_v_direkt.denominator_nv "Fahrzyklen" UWORD FORMULA_0010 0 0 0.0 65535.0000 ECU_ADDRESS 0x3F95E6 /end MEASUREMENT
/begin MEASUREMENT ed_rbm_dk_init.denominator_nv "Fahrzyklen" UWORD FORMULA_0010 0 0 0.0 65535.0000 ECU_ADDRESS 0x3F95EA /end MEASUREMENT
/begin MEASUREMENT ed_rbm_dk1_regler.denominator_nv "Fahrzyklen" UWORD FORMULA_0010 0 0 0.0 65535.0000 ECU_ADDRESS 0x3F95EE /end MEASUREMENT
/begin MEASUREMENT ed_rbm_dk2_regler.denominator_nv "Fahrzyklen" UWORD FORMULA_0010 0 0 0.0 65535.0000 ECU_ADDRESS 0x3F95F2 /end MEASUREMENT
/begin MEASUREMENT ed_rbm_dk1_adapt.denominator_nv "Fahrzyklen" UWORD FORMULA_0010 0 0 0.0 65535.0000 ECU_ADDRESS 0x3F95F6 /end MEASUREMENT
/begin MEASUREMENT ed_rbm_dk2_adapt.denominator_nv "Fahrzyklen" UWORD FORMULA_0010 0 0 0.0 65535.0000 ECU_ADDRESS 0x3F95FA /end MEASUREMENT
/begin MEASUREMENT ed_rbm_ionverst_b1.denominator_nv "Fahrzyklen" UWORD FORMULA_0010 0 0 0.0 65535.0000 ECU_ADDRESS 0x3F95FE /end MEASUREMENT
/begin MEASUREMENT ed_rbm_ionspg_b1.denominator_nv "Fahrzyklen" UWORD FORMULA_0010 0 0 0.0 65535.0000 ECU_ADDRESS 0x3F9602 /end MEASUREMENT
/begin MEASUREMENT ed_rbm_ionverst_b2.denominator_nv "Fahrzyklen" UWORD FORMULA_0010 0 0 0.0 65535.0000 ECU_ADDRESS 0x3F9606 /end MEASUREMENT
/begin MEASUREMENT ed_rbm_ionspg_b2.denominator_nv "Fahrzyklen" UWORD FORMULA_0010 0 0 0.0 65535.0000 ECU_ADDRESS 0x3F960A /end MEASUREMENT
/begin MEASUREMENT ed_rbm_tabg1.denominator_nv "Fahrzyklen" UWORD FORMULA_0010 0 0 0.0 65535.0000 ECU_ADDRESS 0x3F960E /end MEASUREMENT
/begin MEASUREMENT ed_rbm_tabg2.denominator_nv "Fahrzyklen" UWORD FORMULA_0010 0 0 0.0 65535.0000 ECU_ADDRESS 0x3F9612 /end MEASUREMENT
/begin MEASUREMENT ed_rbm_dk1_wdk.denominator_nv "Fahrzyklen" UWORD FORMULA_0010 0 0 0.0 65535.0000 ECU_ADDRESS 0x3F9616 /end MEASUREMENT
/begin MEASUREMENT ed_rbm_dk2_wdk.denominator_nv "Fahrzyklen" UWORD FORMULA_0010 0 0 0.0 65535.0000 ECU_ADDRESS 0x3F961A /end MEASUREMENT
/begin MEASUREMENT ed_rbm_dk1_pdr.denominator_nv "Fahrzyklen" UWORD FORMULA_0010 0 0 0.0 65535.0000 ECU_ADDRESS 0x3F961E /end MEASUREMENT
/begin MEASUREMENT ed_rbm_dk2_pdr.denominator_nv "Fahrzyklen" UWORD FORMULA_0010 0 0 0.0 65535.0000 ECU_ADDRESS 0x3F9622 /end MEASUREMENT
/begin MEASUREMENT ed_rbm_lls1_regler.denominator_nv "Fahrzyklen" UWORD FORMULA_0010 0 0 0.0 65535.0000 ECU_ADDRESS 0x3F9626 /end MEASUREMENT
/begin MEASUREMENT ed_rbm_lls2_regler.denominator_nv "Fahrzyklen" UWORD FORMULA_0010 0 0 0.0 65535.0000 ECU_ADDRESS 0x3F962A /end MEASUREMENT
/begin MEASUREMENT ed_rbm_dk1_sk_err.denominator_nv "Fahrzyklen" UWORD FORMULA_0010 0 0 0.0 65535.0000 ECU_ADDRESS 0x3F962E /end MEASUREMENT
/begin MEASUREMENT ed_rbm_dk2_sk_err.denominator_nv "Fahrzyklen" UWORD FORMULA_0010 0 0 0.0 65535.0000 ECU_ADDRESS 0x3F9632 /end MEASUREMENT
/begin MEASUREMENT ed_rbm_dk1_federn.denominator_nv "Fahrzyklen" UWORD FORMULA_0010 0 0 0.0 65535.0000 ECU_ADDRESS 0x3F9636 /end MEASUREMENT
/begin MEASUREMENT ed_rbm_dk2_federn.denominator_nv "Fahrzyklen" UWORD FORMULA_0010 0 0 0.0 65535.0000 ECU_ADDRESS 0x3F963A /end MEASUREMENT
/begin MEASUREMENT ed_rbm_md_sk_err.denominator_nv "Fahrzyklen" UWORD FORMULA_0010 0 0 0.0 65535.0000 ECU_ADDRESS 0x3F963E /end MEASUREMENT
/begin MEASUREMENT ed_rbm_lls_init.denominator_nv "Fahrzyklen" UWORD FORMULA_0010 0 0 0.0 65535.0000 ECU_ADDRESS 0x3F9642 /end MEASUREMENT
/begin MEASUREMENT ed_rbm_dsc_eingr.denominator_nv "Fahrzyklen" UWORD FORMULA_0010 0 0 0.0 65535.0000 ECU_ADDRESS 0x3F9646 /end MEASUREMENT
/begin MEASUREMENT ed_rbm_dk1_cmd.denominator_nv "Fahrzyklen" UWORD FORMULA_0010 0 0 0.0 65535.0000 ECU_ADDRESS 0x3F964A /end MEASUREMENT
/begin MEASUREMENT ed_rbm_dk2_cmd.denominator_nv "Fahrzyklen" UWORD FORMULA_0010 0 0 0.0 65535.0000 ECU_ADDRESS 0x3F964E /end MEASUREMENT
/begin MEASUREMENT ed_rbm_lls1_cmd.denominator_nv "Fahrzyklen" UWORD FORMULA_0010 0 0 0.0 65535.0000 ECU_ADDRESS 0x3F9652 /end MEASUREMENT
/begin MEASUREMENT ed_rbm_lls2_cmd.denominator_nv "Fahrzyklen" UWORD FORMULA_0010 0 0 0.0 65535.0000 ECU_ADDRESS 0x3F9656 /end MEASUREMENT
/begin MEASUREMENT ed_rbm_sc_smg1.denominator_nv "Fahrzyklen" UWORD FORMULA_0010 0 0 0.0 65535.0000 ECU_ADDRESS 0x3F965A /end MEASUREMENT
/begin MEASUREMENT ed_rbm_sc_smg2.denominator_nv "Fahrzyklen" UWORD FORMULA_0010 0 0 0.0 65535.0000 ECU_ADDRESS 0x3F965E /end MEASUREMENT
/begin MEASUREMENT ed_rbm_sc_smg3.denominator_nv "Fahrzyklen" UWORD FORMULA_0010 0 0 0.0 65535.0000 ECU_ADDRESS 0x3F9662 /end MEASUREMENT
/begin MEASUREMENT ed_rbm_sc_busoff.denominator_nv "Fahrzyklen" UWORD FORMULA_0010 0 0 0.0 65535.0000 ECU_ADDRESS 0x3F9666 /end MEASUREMENT
/begin MEASUREMENT ed_rbm_ec_busoff.denominator_nv "Fahrzyklen" UWORD FORMULA_0010 0 0 0.0 65535.0000 ECU_ADDRESS 0x3F966A /end MEASUREMENT
/begin MEASUREMENT ed_rbm_auss_kat_z1.denominator_nv "Fahrzyklen" UWORD FORMULA_0010 0 0 0.0 65535.0000 ECU_ADDRESS 0x3F966E /end MEASUREMENT
/begin MEASUREMENT ed_rbm_auss_kat_z2.denominator_nv "Fahrzyklen" UWORD FORMULA_0010 0 0 0.0 65535.0000 ECU_ADDRESS 0x3F9672 /end MEASUREMENT
/begin MEASUREMENT ed_rbm_auss_kat_z3.denominator_nv "Fahrzyklen" UWORD FORMULA_0010 0 0 0.0 65535.0000 ECU_ADDRESS 0x3F9676 /end MEASUREMENT
/begin MEASUREMENT ed_rbm_auss_kat_z4.denominator_nv "Fahrzyklen" UWORD FORMULA_0010 0 0 0.0 65535.0000 ECU_ADDRESS 0x3F967A /end MEASUREMENT
/begin MEASUREMENT ed_rbm_auss_kat_z5.denominator_nv "Fahrzyklen" UWORD FORMULA_0010 0 0 0.0 65535.0000 ECU_ADDRESS 0x3F967E /end MEASUREMENT
/begin MEASUREMENT ed_rbm_auss_kat_z6.denominator_nv "Fahrzyklen" UWORD FORMULA_0010 0 0 0.0 65535.0000 ECU_ADDRESS 0x3F9682 /end MEASUREMENT
/begin MEASUREMENT ed_rbm_auss_kat_z7.denominator_nv "Fahrzyklen" UWORD FORMULA_0010 0 0 0.0 65535.0000 ECU_ADDRESS 0x3F9686 /end MEASUREMENT
/begin MEASUREMENT ed_rbm_auss_kat_z8.denominator_nv "Fahrzyklen" UWORD FORMULA_0010 0 0 0.0 65535.0000 ECU_ADDRESS 0x3F968A /end MEASUREMENT
/begin MEASUREMENT ed_rbm_auss_kat_z9.denominator_nv "Fahrzyklen" UWORD FORMULA_0010 0 0 0.0 65535.0000 ECU_ADDRESS 0x3F968E /end MEASUREMENT
/begin MEASUREMENT ed_rbm_auss_kat_z10.denominator_nv "Fahrzyklen" UWORD FORMULA_0010 0 0 0.0 65535.0000 ECU_ADDRESS 0x3F9692 /end MEASUREMENT
/begin MEASUREMENT ed_rbm_ion_sig_b1.denominator_nv "Fahrzyklen" UWORD FORMULA_0010 0 0 0.0 65535.0000 ECU_ADDRESS 0x3F9696 /end MEASUREMENT
/begin MEASUREMENT ed_rbm_ion_sig_b2.denominator_nv "Fahrzyklen" UWORD FORMULA_0010 0 0 0.0 65535.0000 ECU_ADDRESS 0x3F969A /end MEASUREMENT
/begin MEASUREMENT ed_rbm_auss_kat_mult.denominator_nv "Fahrzyklen" UWORD FORMULA_0010 0 0 0.0 65535.0000 ECU_ADDRESS 0x3F969E /end MEASUREMENT
/begin MEASUREMENT ed_rbm_auss_abg_z1.denominator_nv "Fahrzyklen" UWORD FORMULA_0010 0 0 0.0 65535.0000 ECU_ADDRESS 0x3F96A2 /end MEASUREMENT
/begin MEASUREMENT ed_rbm_auss_abg_z2.denominator_nv "Fahrzyklen" UWORD FORMULA_0010 0 0 0.0 65535.0000 ECU_ADDRESS 0x3F96A6 /end MEASUREMENT
/begin MEASUREMENT ed_rbm_auss_abg_z3.denominator_nv "Fahrzyklen" UWORD FORMULA_0010 0 0 0.0 65535.0000 ECU_ADDRESS 0x3F96AA /end MEASUREMENT
/begin MEASUREMENT ed_rbm_auss_abg_z4.denominator_nv "Fahrzyklen" UWORD FORMULA_0010 0 0 0.0 65535.0000 ECU_ADDRESS 0x3F96AE /end MEASUREMENT
/begin MEASUREMENT ed_rbm_auss_abg_z5.denominator_nv "Fahrzyklen" UWORD FORMULA_0010 0 0 0.0 65535.0000 ECU_ADDRESS 0x3F96B2 /end MEASUREMENT
/begin MEASUREMENT ed_rbm_auss_abg_z6.denominator_nv "Fahrzyklen" UWORD FORMULA_0010 0 0 0.0 65535.0000 ECU_ADDRESS 0x3F96B6 /end MEASUREMENT
/begin MEASUREMENT ed_rbm_auss_abg_z7.denominator_nv "Fahrzyklen" UWORD FORMULA_0010 0 0 0.0 65535.0000 ECU_ADDRESS 0x3F96BA /end MEASUREMENT
/begin MEASUREMENT ed_rbm_auss_abg_z8.denominator_nv "Fahrzyklen" UWORD FORMULA_0010 0 0 0.0 65535.0000 ECU_ADDRESS 0x3F96BE /end MEASUREMENT
/begin MEASUREMENT ed_rbm_auss_abg_z9.denominator_nv "Fahrzyklen" UWORD FORMULA_0010 0 0 0.0 65535.0000 ECU_ADDRESS 0x3F96C2 /end MEASUREMENT
/begin MEASUREMENT ed_rbm_auss_abg_z10.denominator_nv "Fahrzyklen" UWORD FORMULA_0010 0 0 0.0 65535.0000 ECU_ADDRESS 0x3F96C6 /end MEASUREMENT
/begin MEASUREMENT ed_rbm_ion_sat_b1.denominator_nv "Fahrzyklen" UWORD FORMULA_0010 0 0 0.0 65535.0000 ECU_ADDRESS 0x3F96CA /end MEASUREMENT
/begin MEASUREMENT ed_rbm_ion_sat_b2.denominator_nv "Fahrzyklen" UWORD FORMULA_0010 0 0 0.0 65535.0000 ECU_ADDRESS 0x3F96CE /end MEASUREMENT
/begin MEASUREMENT ed_rbm_auss_abg_mult.denominator_nv "Fahrzyklen" UWORD FORMULA_0010 0 0 0.0 65535.0000 ECU_ADDRESS 0x3F96D2 /end MEASUREMENT
/begin MEASUREMENT ed_rbm_tan_obd_b1.denominator_nv "Fahrzyklen" UWORD FORMULA_0010 0 0 0.0 65535.0000 ECU_ADDRESS 0x3F96D6 /end MEASUREMENT
/begin MEASUREMENT ed_rbm_index_88_ign.denominator_nv "Fahrzyklen" UWORD FORMULA_0010 0 0 0.0 65535.0000 ECU_ADDRESS 0x3F96DA /end MEASUREMENT
/begin MEASUREMENT ed_rbm_index_89_ign.denominator_nv "Fahrzyklen" UWORD FORMULA_0010 0 0 0.0 65535.0000 ECU_ADDRESS 0x3F96DE /end MEASUREMENT
/begin MEASUREMENT ed_rbm_zoelp1.denominator_nv "Fahrzyklen" UWORD FORMULA_0010 0 0 0.0 65535.0000 ECU_ADDRESS 0x3F96E2 /end MEASUREMENT
/begin MEASUREMENT ed_rbm_zoelp2.denominator_nv "Fahrzyklen" UWORD FORMULA_0010 0 0 0.0 65535.0000 ECU_ADDRESS 0x3F96E6 /end MEASUREMENT
/begin MEASUREMENT ed_rbm_sg_ign.denominator_nv "Fahrzyklen" UWORD FORMULA_0010 0 0 0.0 65535.0000 ECU_ADDRESS 0x3F96EA /end MEASUREMENT
/begin MEASUREMENT ed_rbm_e2_ign.denominator_nv "Fahrzyklen" UWORD FORMULA_0010 0 0 0.0 65535.0000 ECU_ADDRESS 0x3F96EE /end MEASUREMENT
/begin MEASUREMENT ed_rbm_bls_plau.denominator_nv "Fahrzyklen" UWORD FORMULA_0010 0 0 0.0 65535.0000 ECU_ADDRESS 0x3F96F2 /end MEASUREMENT
/begin MEASUREMENT ed_rbm_sk_manager_ign.denominator_nv "Fahrzyklen" UWORD FORMULA_0010 0 0 0.0 65535.0000 ECU_ADDRESS 0x3F96F6 /end MEASUREMENT
/begin MEASUREMENT ed_rbm_llr_diag.denominator_nv "Fahrzyklen" UWORD FORMULA_0010 0 0 0.0 65535.0000 ECU_ADDRESS 0x3F96FA /end MEASUREMENT
/begin MEASUREMENT ed_rbm_thermostat.denominator_nv "Fahrzyklen" UWORD FORMULA_0010 0 0 0.0 65535.0000 ECU_ADDRESS 0x3F96FE /end MEASUREMENT
/begin MEASUREMENT ed_rbm_tan_obd_b2.denominator_nv "Fahrzyklen" UWORD FORMULA_0010 0 0 0.0 65535.0000 ECU_ADDRESS 0x3F9702 /end MEASUREMENT
/begin MEASUREMENT ed_rbm_dk1_zust.denominator_nv "Fahrzyklen" UWORD FORMULA_0010 0 0 0.0 65535.0000 ECU_ADDRESS 0x3F9706 /end MEASUREMENT
/begin MEASUREMENT ed_rbm_dk2_zust.denominator_nv "Fahrzyklen" UWORD FORMULA_0010 0 0 0.0 65535.0000 ECU_ADDRESS 0x3F970A /end MEASUREMENT
/begin MEASUREMENT ed_rbm_fgr_abwurf.denominator_nv "Fahrzyklen" UWORD FORMULA_0010 0 0 0.0 65535.0000 ECU_ADDRESS 0x3F970E /end MEASUREMENT
/begin MEASUREMENT ed_rbm_pwg_bls.denominator_nv "Fahrzyklen" UWORD FORMULA_0010 0 0 0.0 65535.0000 ECU_ADDRESS 0x3F9712 /end MEASUREMENT
/begin MEASUREMENT ed_rbm_start_rl.denominator_nv "Fahrzyklen" UWORD FORMULA_0010 0 0 0.0 65535.0000 ECU_ADDRESS 0x3F9716 /end MEASUREMENT
/begin MEASUREMENT ed_rbm_afz_hs.denominator_nv "Fahrzyklen" UWORD FORMULA_0010 0 0 0.0 65535.0000 ECU_ADDRESS 0x3F971A /end MEASUREMENT
/begin MEASUREMENT ed_rbm_n_getr_ein_hs.denominator_nv "Fahrzyklen" UWORD FORMULA_0010 0 0 0.0 65535.0000 ECU_ADDRESS 0x3F971E /end MEASUREMENT
/begin MEASUREMENT ed_rbm_tumg.denominator_nv "Fahrzyklen" UWORD FORMULA_0010 0 0 0.0 65535.0000 ECU_ADDRESS 0x3F9722 /end MEASUREMENT
/begin MEASUREMENT ed_rbm_llr_diag_css.denominator_nv "Fahrzyklen" UWORD FORMULA_0010 0 0 0.0 65535.0000 ECU_ADDRESS 0x3F9726 /end MEASUREMENT
/begin MEASUREMENT ed_rbm_tmot_obd_high.denominator_nv "Fahrzyklen" UWORD FORMULA_0010 0 0 0.0 65535.0000 ECU_ADDRESS 0x3F972A /end MEASUREMENT
/begin MEASUREMENT ed_rbm_afz_hs_na.denominator_nv "Fahrzyklen" UWORD FORMULA_0010 0 0 0.0 65535.0000 ECU_ADDRESS 0x3F972E /end MEASUREMENT
/begin MEASUREMENT ed_rbm_index_110_ign.denominator_nv "Fahrzyklen" UWORD FORMULA_0010 0 0 0.0 65535.0000 ECU_ADDRESS 0x3F9732 /end MEASUREMENT
/begin MEASUREMENT ed_rbm_index_111_ign.denominator_nv "Fahrzyklen" UWORD FORMULA_0010 0 0 0.0 65535.0000 ECU_ADDRESS 0x3F9736 /end MEASUREMENT
/begin MEASUREMENT ed_rbm_index_112_ign.denominator_nv "Fahrzyklen" UWORD FORMULA_0010 0 0 0.0 65535.0000 ECU_ADDRESS 0x3F973A /end MEASUREMENT
/begin MEASUREMENT ed_rbm_index_113_ign.denominator_nv "Fahrzyklen" UWORD FORMULA_0010 0 0 0.0 65535.0000 ECU_ADDRESS 0x3F973E /end MEASUREMENT
/begin MEASUREMENT ed_rbm_index_114_ign.denominator_nv "Fahrzyklen" UWORD FORMULA_0010 0 0 0.0 65535.0000 ECU_ADDRESS 0x3F9742 /end MEASUREMENT
/begin MEASUREMENT ed_rbm_index_115_ign.denominator_nv "Fahrzyklen" UWORD FORMULA_0010 0 0 0.0 65535.0000 ECU_ADDRESS 0x3F9746 /end MEASUREMENT
/begin MEASUREMENT ed_rbm_index_116_ign.denominator_nv "Fahrzyklen" UWORD FORMULA_0010 0 0 0.0 65535.0000 ECU_ADDRESS 0x3F974A /end MEASUREMENT
/begin MEASUREMENT ed_rbm_index_117_ign.denominator_nv "Fahrzyklen" UWORD FORMULA_0010 0 0 0.0 65535.0000 ECU_ADDRESS 0x3F974E /end MEASUREMENT
/begin MEASUREMENT ed_rbm_index_118_ign.denominator_nv "Fahrzyklen" UWORD FORMULA_0010 0 0 0.0 65535.0000 ECU_ADDRESS 0x3F9752 /end MEASUREMENT
/begin MEASUREMENT ed_rbm_index_119_ign.denominator_nv "Fahrzyklen" UWORD FORMULA_0010 0 0 0.0 65535.0000 ECU_ADDRESS 0x3F9756 /end MEASUREMENT
/begin MEASUREMENT ed_rbm_index_120_ign.denominator_nv "Fahrzyklen" UWORD FORMULA_0010 0 0 0.0 65535.0000 ECU_ADDRESS 0x3F975A /end MEASUREMENT
/begin MEASUREMENT ed_rbm_index_121_ign.denominator_nv "Fahrzyklen" UWORD FORMULA_0010 0 0 0.0 65535.0000 ECU_ADDRESS 0x3F975E /end MEASUREMENT
/begin MEASUREMENT ed_rbm_index_122_ign.denominator_nv "Fahrzyklen" UWORD FORMULA_0010 0 0 0.0 65535.0000 ECU_ADDRESS 0x3F9762 /end MEASUREMENT
/begin MEASUREMENT ed_rbm_index_123_ign.denominator_nv "Fahrzyklen" UWORD FORMULA_0010 0 0 0.0 65535.0000 ECU_ADDRESS 0x3F9766 /end MEASUREMENT
/begin MEASUREMENT ed_rbm_index_124_ign.denominator_nv "Fahrzyklen" UWORD FORMULA_0010 0 0 0.0 65535.0000 ECU_ADDRESS 0x3F976A /end MEASUREMENT
/begin MEASUREMENT ed_rbm_index_125_ign.denominator_nv "Fahrzyklen" UWORD FORMULA_0010 0 0 0.0 65535.0000 ECU_ADDRESS 0x3F976E /end MEASUREMENT
/begin MEASUREMENT ed_rbm_index_126_ign.denominator_nv "Fahrzyklen" UWORD FORMULA_0010 0 0 0.0 65535.0000 ECU_ADDRESS 0x3F9772 /end MEASUREMENT
/begin MEASUREMENT ed_rbm_index_127_ign.denominator_nv "Fahrzyklen" UWORD FORMULA_0010 0 0 0.0 65535.0000 ECU_ADDRESS 0x3F9776 /end MEASUREMENT
/begin MEASUREMENT ed_fsp_9of20_.uw_satz_3of3_.uw_km_stand_nv "Kilometerstand beim Fehlereintrag" UWORD FORMULA_0051 0 0 0.0 524280.0000 ECU_ADDRESS 0x3F9A22 /end MEASUREMENT
/begin MEASUREMENT ed_fsp_9of20_.uw_satz_2of3_.uw_wert_nv_1of4_ "Umweltbedingung beim Fehlereintrag" UWORD FORMULA_0010 0 0 0.0 65535.0000 ECU_ADDRESS 0x3F9A1A /end MEASUREMENT
/begin MEASUREMENT ed_fsp_9of20_.uw_satz_2of3_.uw_wert_nv_2of4_ "Umweltbedingung beim Fehlereintrag" UWORD FORMULA_0010 0 0 0.0 65535.0000 ECU_ADDRESS 0x3F9A1C /end MEASUREMENT
/begin MEASUREMENT ed_fsp_9of20_.uw_satz_2of3_.uw_wert_nv_3of4_ "Umweltbedingung beim Fehlereintrag" UWORD FORMULA_0010 0 0 0.0 65535.0000 ECU_ADDRESS 0x3F9A1E /end MEASUREMENT
/begin MEASUREMENT ed_fsp_9of20_.uw_satz_2of3_.uw_wert_nv_4of4_ "Umweltbedingung beim Fehlereintrag" UWORD FORMULA_0010 0 0 0.0 65535.0000 ECU_ADDRESS 0x3F9A20 /end MEASUREMENT
/begin MEASUREMENT ed_fsp_9of20_.uw_satz_3of3_.uw_wert_nv_1of4_ "Umweltbedingung beim Fehlereintrag" UWORD FORMULA_0010 0 0 0.0 65535.0000 ECU_ADDRESS 0x3F9A24 /end MEASUREMENT
/begin MEASUREMENT ed_fsp_9of20_.uw_satz_3of3_.uw_wert_nv_2of4_ "Umweltbedingung beim Fehlereintrag" UWORD FORMULA_0010 0 0 0.0 65535.0000 ECU_ADDRESS 0x3F9A26 /end MEASUREMENT
/begin MEASUREMENT ed_fsp_9of20_.uw_satz_3of3_.uw_wert_nv_3of4_ "Umweltbedingung beim Fehlereintrag" UWORD FORMULA_0010 0 0 0.0 65535.0000 ECU_ADDRESS 0x3F9A28 /end MEASUREMENT
/begin MEASUREMENT ed_fsp_9of20_.uw_satz_3of3_.uw_wert_nv_4of4_ "Umweltbedingung beim Fehlereintrag" UWORD FORMULA_0010 0 0 0.0 65535.0000 ECU_ADDRESS 0x3F9A2A /end MEASUREMENT
/begin MEASUREMENT ed_st_fehler_inj_1of7_ "ED-Gesamtstatus INJ-Fehler" ULONG FORMULA_0000 0 0 0.0 4294967295.0000 ECU_ADDRESS 0x3F84E4 /end MEASUREMENT
/begin MEASUREMENT ed_st_fehler_inj_2of7_ "ED-Gesamtstatus INJ-Fehler" ULONG FORMULA_0000 0 0 0.0 4294967295.0000 ECU_ADDRESS 0x3F84E8 /end MEASUREMENT
/begin MEASUREMENT ed_st_fehler_inj_3of7_ "ED-Gesamtstatus INJ-Fehler" ULONG FORMULA_0000 0 0 0.0 4294967295.0000 ECU_ADDRESS 0x3F84EC /end MEASUREMENT
/begin MEASUREMENT ed_st_fehler_inj_4of7_ "ED-Gesamtstatus INJ-Fehler" ULONG FORMULA_0000 0 0 0.0 4294967295.0000 ECU_ADDRESS 0x3F84F0 /end MEASUREMENT
/begin MEASUREMENT ed_st_fehler_inj_5of7_ "ED-Gesamtstatus INJ-Fehler" ULONG FORMULA_0000 0 0 0.0 4294967295.0000 ECU_ADDRESS 0x3F84F4 /end MEASUREMENT
/begin MEASUREMENT ed_st_fehler_inj_6of7_ "ED-Gesamtstatus INJ-Fehler" ULONG FORMULA_0000 0 0 0.0 4294967295.0000 ECU_ADDRESS 0x3F84F8 /end MEASUREMENT
/begin MEASUREMENT ed_st_fehler_inj_7of7_ "ED-Gesamtstatus INJ-Fehler" ULONG FORMULA_0000 0 0 0.0 4294967295.0000 ECU_ADDRESS 0x3F84FC /end MEASUREMENT
/begin MEASUREMENT ed_st_filter_inj_1of7_ "ED-Gesamtstatus INJ-Filter" ULONG FORMULA_0000 0 0 0.0 4294967295.0000 ECU_ADDRESS 0x3F8500 /end MEASUREMENT
/begin MEASUREMENT ed_st_filter_inj_2of7_ "ED-Gesamtstatus INJ-Filter" ULONG FORMULA_0000 0 0 0.0 4294967295.0000 ECU_ADDRESS 0x3F8504 /end MEASUREMENT
/begin MEASUREMENT ed_st_filter_inj_3of7_ "ED-Gesamtstatus INJ-Filter" ULONG FORMULA_0000 0 0 0.0 4294967295.0000 ECU_ADDRESS 0x3F8508 /end MEASUREMENT
/begin MEASUREMENT ed_st_filter_inj_4of7_ "ED-Gesamtstatus INJ-Filter" ULONG FORMULA_0000 0 0 0.0 4294967295.0000 ECU_ADDRESS 0x3F850C /end MEASUREMENT
/begin MEASUREMENT ed_st_filter_inj_5of7_ "ED-Gesamtstatus INJ-Filter" ULONG FORMULA_0000 0 0 0.0 4294967295.0000 ECU_ADDRESS 0x3F8510 /end MEASUREMENT
/begin MEASUREMENT ed_st_filter_inj_6of7_ "ED-Gesamtstatus INJ-Filter" ULONG FORMULA_0000 0 0 0.0 4294967295.0000 ECU_ADDRESS 0x3F8514 /end MEASUREMENT
/begin MEASUREMENT ed_st_filter_inj_7of7_ "ED-Gesamtstatus INJ-Filter" ULONG FORMULA_0000 0 0 0.0 4294967295.0000 ECU_ADDRESS 0x3F8518 /end MEASUREMENT
/begin MEASUREMENT ed_mil_st_inj "Mil-Status INJ" UBYTE FORMULA_0033 0 0 0.0 255.0000 ECU_ADDRESS 0x3F851C /end MEASUREMENT
/begin MEASUREMENT ed_mil_bmw_inj "Mil-Status INJ" UBYTE FORMULA_0067 0 0 0.0 255.0 ECU_ADDRESS 0x3F851C BIT_MASK 0x1 /end MEASUREMENT
/begin MEASUREMENT ed_mil_predrive_inj "Mil-Status INJ" UBYTE FORMULA_0068 0 0 0.0 255.0 ECU_ADDRESS 0x3F851C BIT_MASK 0x2 /end MEASUREMENT
/begin MEASUREMENT ed_mil_dme_inj "Mil-Status INJ" UBYTE FORMULA_0069 0 0 0.0 255.0 ECU_ADDRESS 0x3F851C BIT_MASK 0x80 /end MEASUREMENT
/begin MEASUREMENT ed_st_fehler_ign_1of4_ "ED-Gesamtstatus IGN-Fehler" ULONG FORMULA_0000 0 0 0.0 4294967295.0000 ECU_ADDRESS 0x3F821C /end MEASUREMENT
/begin MEASUREMENT ed_st_fehler_ign_2of4_ "ED-Gesamtstatus IGN-Fehler" ULONG FORMULA_0000 0 0 0.0 4294967295.0000 ECU_ADDRESS 0x3F8220 /end MEASUREMENT
/begin MEASUREMENT ed_st_fehler_ign_3of4_ "ED-Gesamtstatus IGN-Fehler" ULONG FORMULA_0000 0 0 0.0 4294967295.0000 ECU_ADDRESS 0x3F8224 /end MEASUREMENT
/begin MEASUREMENT ed_st_fehler_ign_4of4_ "ED-Gesamtstatus IGN-Fehler" ULONG FORMULA_0000 0 0 0.0 4294967295.0000 ECU_ADDRESS 0x3F8228 /end MEASUREMENT
/begin MEASUREMENT ed_st_filter_ign_1of4_ "ED-Gesamtstatus IGN-Filter" ULONG FORMULA_0000 0 0 0.0 4294967295.0000 ECU_ADDRESS 0x3F822C /end MEASUREMENT
/begin MEASUREMENT ed_st_filter_ign_2of4_ "ED-Gesamtstatus IGN-Filter" ULONG FORMULA_0000 0 0 0.0 4294967295.0000 ECU_ADDRESS 0x3F8230 /end MEASUREMENT
/begin MEASUREMENT ed_st_filter_ign_3of4_ "ED-Gesamtstatus IGN-Filter" ULONG FORMULA_0000 0 0 0.0 4294967295.0000 ECU_ADDRESS 0x3F8234 /end MEASUREMENT
/begin MEASUREMENT ed_st_filter_ign_4of4_ "ED-Gesamtstatus IGN-Filter" ULONG FORMULA_0000 0 0 0.0 4294967295.0000 ECU_ADDRESS 0x3F8238 /end MEASUREMENT
/begin MEASUREMENT ed_mil_st_ign "Mil-Status IGN" UBYTE FORMULA_0033 0 0 0.0 255.0000 ECU_ADDRESS 0x3F823C /end MEASUREMENT
/begin MEASUREMENT ed_mil_bmw_ign "Mil-Status IGN" UBYTE FORMULA_0067 0 0 0.0 255.0 ECU_ADDRESS 0x3F823C BIT_MASK 0x1 /end MEASUREMENT
/begin MEASUREMENT ed_mil_predrive_ign "Mil-Status IGN" UBYTE FORMULA_0068 0 0 0.0 255.0 ECU_ADDRESS 0x3F823C BIT_MASK 0x2 /end MEASUREMENT
/begin MEASUREMENT ed_mil_zyl_off_ign "Mil-Status IGN" UBYTE FORMULA_0070 0 0 0.0 255.0 ECU_ADDRESS 0x3F823C BIT_MASK 0x4 /end MEASUREMENT
/begin MEASUREMENT ed_mil_smg_ign "Mil-Status IGN" UBYTE FORMULA_0071 0 0 0.0 255.0 ECU_ADDRESS 0x3F823C BIT_MASK 0x8 /end MEASUREMENT
/begin MEASUREMENT ed_mil_dme_ign "Mil-Status IGN" UBYTE FORMULA_0069 0 0 0.0 255.0 ECU_ADDRESS 0x3F823C BIT_MASK 0x80 /end MEASUREMENT
/begin MEASUREMENT ed_loeschen "Uebergangsloesung zum Loeschen" UBYTE FORMULA_0072 0 0 0.0 255.0 ECU_ADDRESS 0x3FB614 /end MEASUREMENT
/begin MEASUREMENT ed_rbm_time "Motor laeuft fuer Rate Based" UWORD FORMULA_0073 0 0 0.0 6553.5000 ECU_ADDRESS 0x3FB616 /end MEASUREMENT
/begin MEASUREMENT ed_rbm_time_ll "Zeit im Leerlauf" UWORD FORMULA_0073 0 0 0.0 6553.5000 ECU_ADDRESS 0x3FB618 /end MEASUREMENT
/begin MEASUREMENT ed_rbm_time_v "Zeit mit Mindestgeschwindigkeit" UWORD FORMULA_0073 0 0 0.0 6553.5000 ECU_ADDRESS 0x3FB61A /end MEASUREMENT
/begin CHARACTERISTIC K_ED_APPL_DATA_IGN.P_CODE_SH_TO_UB "P-Code fuer die Art SH_TO_UB | EN: Fault code APPL_DATA_IGN - OBD P-code reported for short to battery voltage" VALUE 0x70D7E TKW_VV_VV_UW 100.0 FORMULA_0010 0.0 65535.0000 /end CHARACTERISTIC
/begin CHARACTERISTIC K_ED_DK1_CAN.P_CODE_SH_TO_UB "P-Code fuer die Art SH_TO_UB | EN: Fault code DK1_CAN - OBD P-code reported for short to battery voltage" VALUE 0x70E4E TKW_VV_VV_UW 100.0 FORMULA_0010 0.0 65535.0000 /end CHARACTERISTIC
/begin CHARACTERISTIC K_ED_DK2_CAN.P_CODE_SH_TO_UB "P-Code fuer die Art SH_TO_UB | EN: Fault code DK2_CAN - OBD P-code reported for short to battery voltage" VALUE 0x70E68 TKW_VV_VV_UW 100.0 FORMULA_0010 0.0 65535.0000 /end CHARACTERISTIC
/begin CHARACTERISTIC K_ED_DK1_REGLER.P_CODE_SH_TO_UB "P-Code fuer die Art SH_TO_UB | EN: Fault code DK1_REGLER - OBD P-code reported for short to battery voltage" VALUE 0x70F52 TKW_VV_VV_UW 100.0 FORMULA_0010 0.0 65535.0000 /end CHARACTERISTIC
/begin CHARACTERISTIC K_ED_DK1_ADAPT.P_CODE_SH_TO_UB "P-Code fuer die Art SH_TO_UB | EN: Fault code DK1_ADAPT - OBD P-code reported for short to battery voltage" VALUE 0x70F86 TKW_VV_VV_UW 100.0 FORMULA_0010 0.0 65535.0000 /end CHARACTERISTIC
/begin CHARACTERISTIC K_ED_DK2_ADAPT.P_CODE_SH_TO_UB "P-Code fuer die Art SH_TO_UB | EN: Fault code DK2_ADAPT - OBD P-code reported for short to battery voltage" VALUE 0x70FA0 TKW_VV_VV_UW 100.0 FORMULA_0010 0.0 65535.0000 /end CHARACTERISTIC
/begin CHARACTERISTIC K_ED_DK1_WDK.P_CODE_SH_TO_UB "P-Code fuer die Art SH_TO_UB | EN: Fault code DK1_WDK - OBD P-code reported for short to battery voltage" VALUE 0x71056 TKW_VV_VV_UW 100.0 FORMULA_0010 0.0 65535.0000 /end CHARACTERISTIC
/begin CHARACTERISTIC K_ED_DK1_PDR.P_CODE_SH_TO_UB "P-Code fuer die Art SH_TO_UB | EN: Fault code DK1_PDR - OBD P-code reported for short to battery voltage" VALUE 0x7108A TKW_VV_VV_UW 100.0 FORMULA_0010 0.0 65535.0000 /end CHARACTERISTIC
/begin CHARACTERISTIC K_ED_DK2_PDR.P_CODE_SH_TO_UB "P-Code fuer die Art SH_TO_UB | EN: Fault code DK2_PDR - OBD P-code reported for short to battery voltage" VALUE 0x710A4 TKW_VV_VV_UW 100.0 FORMULA_0010 0.0 65535.0000 /end CHARACTERISTIC
/begin CHARACTERISTIC K_ED_DK1_SK_ERR.P_CODE_SH_TO_UB "P-Code fuer die Art SH_TO_UB | EN: Fault code DK1_SK_ERR - OBD P-code reported for short to battery voltage" VALUE 0x710F2 TKW_VV_VV_UW 100.0 FORMULA_0010 0.0 65535.0000 /end CHARACTERISTIC
/begin CHARACTERISTIC K_ED_DK1_FEDERN.P_CODE_SH_TO_UB "P-Code fuer die Art SH_TO_UB | EN: Fault code DK1_FEDERN - OBD P-code reported for short to battery voltage" VALUE 0x71126 TKW_VV_VV_UW 100.0 FORMULA_0010 0.0 65535.0000 /end CHARACTERISTIC
/begin CHARACTERISTIC K_ED_DK2_FEDERN.P_CODE_SH_TO_UB "P-Code fuer die Art SH_TO_UB | EN: Fault code DK2_FEDERN - OBD P-code reported for short to battery voltage" VALUE 0x71140 TKW_VV_VV_UW 100.0 FORMULA_0010 0.0 65535.0000 /end CHARACTERISTIC
/begin CHARACTERISTIC K_ED_DK1_CMD.P_CODE_SH_TO_UB "P-Code fuer die Art SH_TO_UB | EN: Fault code DK1_CMD - OBD P-code reported for short to battery voltage" VALUE 0x711A8 TKW_VV_VV_UW 100.0 FORMULA_0010 0.0 65535.0000 /end CHARACTERISTIC
/begin CHARACTERISTIC K_ED_DK2_CMD.P_CODE_SH_TO_UB "P-Code fuer die Art SH_TO_UB | EN: Fault code DK2_CMD - OBD P-code reported for short to battery voltage" VALUE 0x711C2 TKW_VV_VV_UW 100.0 FORMULA_0010 0.0 65535.0000 /end CHARACTERISTIC
/begin CHARACTERISTIC K_ED_AUSS_KAT_Z1.P_CODE_SH_TO_UB "P-Code fuer die Art SH_TO_UB | EN: Fault code AUSS_KAT_Z1 - OBD P-code reported for short to battery voltage" VALUE 0x71292 TKW_VV_VV_UW 100.0 FORMULA_0010 0.0 65535.0000 /end CHARACTERISTIC
/begin CHARACTERISTIC K_ED_AUSS_KAT_Z2.P_CODE_SH_TO_UB "P-Code fuer die Art SH_TO_UB | EN: Fault code AUSS_KAT_Z2 - OBD P-code reported for short to battery voltage" VALUE 0x712AC TKW_VV_VV_UW 100.0 FORMULA_0010 0.0 65535.0000 /end CHARACTERISTIC
/begin CHARACTERISTIC K_ED_AUSS_KAT_Z3.P_CODE_SH_TO_UB "P-Code fuer die Art SH_TO_UB | EN: Fault code AUSS_KAT_Z3 - OBD P-code reported for short to battery voltage" VALUE 0x712C6 TKW_VV_VV_UW 100.0 FORMULA_0010 0.0 65535.0000 /end CHARACTERISTIC
/begin CHARACTERISTIC K_ED_AUSS_KAT_Z4.P_CODE_SH_TO_UB "P-Code fuer die Art SH_TO_UB | EN: Fault code AUSS_KAT_Z4 - OBD P-code reported for short to battery voltage" VALUE 0x712E0 TKW_VV_VV_UW 100.0 FORMULA_0010 0.0 65535.0000 /end CHARACTERISTIC
/begin CHARACTERISTIC K_ED_AUSS_KAT_Z5.P_CODE_SH_TO_UB "P-Code fuer die Art SH_TO_UB | EN: Fault code AUSS_KAT_Z5 - OBD P-code reported for short to battery voltage" VALUE 0x712FA TKW_VV_VV_UW 100.0 FORMULA_0010 0.0 65535.0000 /end CHARACTERISTIC
/begin CHARACTERISTIC K_ED_AUSS_KAT_Z6.P_CODE_SH_TO_UB "P-Code fuer die Art SH_TO_UB | EN: Fault code AUSS_KAT_Z6 - OBD P-code reported for short to battery voltage" VALUE 0x71314 TKW_VV_VV_UW 100.0 FORMULA_0010 0.0 65535.0000 /end CHARACTERISTIC
/begin CHARACTERISTIC K_ED_AUSS_KAT_Z7.P_CODE_SH_TO_UB "P-Code fuer die Art SH_TO_UB | EN: Fault code AUSS_KAT_Z7 - OBD P-code reported for short to battery voltage" VALUE 0x7132E TKW_VV_VV_UW 100.0 FORMULA_0010 0.0 65535.0000 /end CHARACTERISTIC
/begin CHARACTERISTIC K_ED_AUSS_KAT_Z8.P_CODE_SH_TO_UB "P-Code fuer die Art SH_TO_UB | EN: Fault code AUSS_KAT_Z8 - OBD P-code reported for short to battery voltage" VALUE 0x71348 TKW_VV_VV_UW 100.0 FORMULA_0010 0.0 65535.0000 /end CHARACTERISTIC
/begin CHARACTERISTIC K_ED_AUSS_KAT_Z9.P_CODE_SH_TO_UB "P-Code fuer die Art SH_TO_UB | EN: Fault code AUSS_KAT_Z9 - OBD P-code reported for short to battery voltage" VALUE 0x71362 TKW_VV_VV_UW 100.0 FORMULA_0010 0.0 65535.0000 /end CHARACTERISTIC
/begin CHARACTERISTIC K_ED_AUSS_KAT_Z10.P_CODE_SH_TO_UB "P-Code fuer die Art SH_TO_UB | EN: Fault code AUSS_KAT_Z10 - OBD P-code reported for short to battery voltage" VALUE 0x7137C TKW_VV_VV_UW 100.0 FORMULA_0010 0.0 65535.0000 /end CHARACTERISTIC
/begin CHARACTERISTIC K_ED_AUSS_KAT_MULT.P_CODE_SH_TO_UB "P-Code fuer die Art SH_TO_UB | EN: Fault code AUSS_KAT_MULT - OBD P-code reported for short to battery voltage" VALUE 0x713CA TKW_VV_VV_UW 100.0 FORMULA_0010 0.0 65535.0000 /end CHARACTERISTIC
/begin CHARACTERISTIC K_ED_AUSS_ABG_Z1.P_CODE_SH_TO_UB "P-Code fuer die Art SH_TO_UB | EN: Fault code AUSS_ABG_Z1 - OBD P-code reported for short to battery voltage" VALUE 0x713E4 TKW_VV_VV_UW 100.0 FORMULA_0010 0.0 65535.0000 /end CHARACTERISTIC
/begin CHARACTERISTIC K_ED_AUSS_ABG_Z2.P_CODE_SH_TO_UB "P-Code fuer die Art SH_TO_UB | EN: Fault code AUSS_ABG_Z2 - OBD P-code reported for short to battery voltage" VALUE 0x713FE TKW_VV_VV_UW 100.0 FORMULA_0010 0.0 65535.0000 /end CHARACTERISTIC
/begin CHARACTERISTIC K_ED_AUSS_ABG_Z3.P_CODE_SH_TO_UB "P-Code fuer die Art SH_TO_UB | EN: Fault code AUSS_ABG_Z3 - OBD P-code reported for short to battery voltage" VALUE 0x71418 TKW_VV_VV_UW 100.0 FORMULA_0010 0.0 65535.0000 /end CHARACTERISTIC
/begin CHARACTERISTIC K_ED_AUSS_ABG_Z4.P_CODE_SH_TO_UB "P-Code fuer die Art SH_TO_UB | EN: Fault code AUSS_ABG_Z4 - OBD P-code reported for short to battery voltage" VALUE 0x71432 TKW_VV_VV_UW 100.0 FORMULA_0010 0.0 65535.0000 /end CHARACTERISTIC
/begin CHARACTERISTIC K_ED_AUSS_ABG_Z5.P_CODE_SH_TO_UB "P-Code fuer die Art SH_TO_UB | EN: Fault code AUSS_ABG_Z5 - OBD P-code reported for short to battery voltage" VALUE 0x7144C TKW_VV_VV_UW 100.0 FORMULA_0010 0.0 65535.0000 /end CHARACTERISTIC
/begin CHARACTERISTIC K_ED_AUSS_ABG_Z6.P_CODE_SH_TO_UB "P-Code fuer die Art SH_TO_UB | EN: Fault code AUSS_ABG_Z6 - OBD P-code reported for short to battery voltage" VALUE 0x71466 TKW_VV_VV_UW 100.0 FORMULA_0010 0.0 65535.0000 /end CHARACTERISTIC
/begin CHARACTERISTIC K_ED_AUSS_ABG_Z7.P_CODE_SH_TO_UB "P-Code fuer die Art SH_TO_UB | EN: Fault code AUSS_ABG_Z7 - OBD P-code reported for short to battery voltage" VALUE 0x71480 TKW_VV_VV_UW 100.0 FORMULA_0010 0.0 65535.0000 /end CHARACTERISTIC
/begin CHARACTERISTIC K_ED_AUSS_ABG_Z8.P_CODE_SH_TO_UB "P-Code fuer die Art SH_TO_UB | EN: Fault code AUSS_ABG_Z8 - OBD P-code reported for short to battery voltage" VALUE 0x7149A TKW_VV_VV_UW 100.0 FORMULA_0010 0.0 65535.0000 /end CHARACTERISTIC
/begin CHARACTERISTIC K_ED_AUSS_ABG_Z9.P_CODE_SH_TO_UB "P-Code fuer die Art SH_TO_UB" VALUE 0x714B4 TKW_VV_VV_UW 100.0 FORMULA_0010 0.0 65535.0000 /end CHARACTERISTIC
/begin CHARACTERISTIC K_ED_AUSS_ABG_Z10.P_CODE_SH_TO_UB "P-Code fuer die Art SH_TO_UB" VALUE 0x714CE TKW_VV_VV_UW 100.0 FORMULA_0010 0.0 65535.0000 /end CHARACTERISTIC
/begin CHARACTERISTIC K_ED_AUSS_ABG_MULT.P_CODE_SH_TO_UB "P-Code fuer die Art SH_TO_UB" VALUE 0x7151C TKW_VV_VV_UW 100.0 FORMULA_0010 0.0 65535.0000 /end CHARACTERISTIC
/begin CHARACTERISTIC K_ED_BLS_PLAU.P_CODE_SH_TO_UB "P-Code fuer die Art SH_TO_UB | EN: Fault code BLS_PLAU - OBD P-code reported for short to battery voltage" VALUE 0x715EC TKW_VV_VV_UW 100.0 FORMULA_0010 0.0 65535.0000 /end CHARACTERISTIC
/begin CHARACTERISTIC K_ED_DK1_ZUST.P_CODE_SH_TO_UB "P-Code fuer die Art SH_TO_UB | EN: Fault code DK1_ZUST - OBD P-code reported for short to battery voltage" VALUE 0x7166E TKW_VV_VV_UW 100.0 FORMULA_0010 0.0 65535.0000 /end CHARACTERISTIC
/begin CHARACTERISTIC K_ED_AFZ_HS.P_CODE_SH_TO_UB "P-Code fuer die Art SH_TO_UB | EN: Fault code AFZ_HS - OBD P-code reported for short to battery voltage" VALUE 0x716F0 TKW_VV_VV_UW 100.0 FORMULA_0010 0.0 65535.0000 /end CHARACTERISTIC
/begin CHARACTERISTIC K_ED_AFZ_HS_NA.P_CODE_SH_TO_UB "P-Code fuer die Art SH_TO_UB" VALUE 0x71772 TKW_VV_VV_UW 100.0 FORMULA_0010 0.0 65535.0000 /end CHARACTERISTIC
/begin CHARACTERISTIC K_ED_APPL_DATA_IGN.P_CODE_SH_TO_GND "P-Code fuer die Art SH_TO_GND | EN: Fault code APPL_DATA_IGN - OBD P-code reported for short to ground" VALUE 0x70D80 TKW_VV_VV_UW 100.0 FORMULA_0010 0.0 65535.0000 /end CHARACTERISTIC
/begin CHARACTERISTIC K_ED_DK1_CAN.P_CODE_SH_TO_GND "P-Code fuer die Art SH_TO_GND | EN: Fault code DK1_CAN - OBD P-code reported for short to ground" VALUE 0x70E50 TKW_VV_VV_UW 100.0 FORMULA_0010 0.0 65535.0000 /end CHARACTERISTIC
/begin CHARACTERISTIC K_ED_DK2_CAN.P_CODE_SH_TO_GND "P-Code fuer die Art SH_TO_GND | EN: Fault code DK2_CAN - OBD P-code reported for short to ground" VALUE 0x70E6A TKW_VV_VV_UW 100.0 FORMULA_0010 0.0 65535.0000 /end CHARACTERISTIC
/begin CHARACTERISTIC K_ED_DK1_REGLER.P_CODE_SH_TO_GND "P-Code fuer die Art SH_TO_GND | EN: Fault code DK1_REGLER - OBD P-code reported for short to ground" VALUE 0x70F54 TKW_VV_VV_UW 100.0 FORMULA_0010 0.0 65535.0000 /end CHARACTERISTIC
/begin CHARACTERISTIC K_ED_DK1_ADAPT.P_CODE_SH_TO_GND "P-Code fuer die Art SH_TO_GND | EN: Fault code DK1_ADAPT - OBD P-code reported for short to ground" VALUE 0x70F88 TKW_VV_VV_UW 100.0 FORMULA_0010 0.0 65535.0000 /end CHARACTERISTIC
/begin CHARACTERISTIC K_ED_DK2_ADAPT.P_CODE_SH_TO_GND "P-Code fuer die Art SH_TO_GND | EN: Fault code DK2_ADAPT - OBD P-code reported for short to ground" VALUE 0x70FA2 TKW_VV_VV_UW 100.0 FORMULA_0010 0.0 65535.0000 /end CHARACTERISTIC
/begin CHARACTERISTIC K_ED_DK1_WDK.P_CODE_SH_TO_GND "P-Code fuer die Art SH_TO_GND | EN: Fault code DK1_WDK - OBD P-code reported for short to ground" VALUE 0x71058 TKW_VV_VV_UW 100.0 FORMULA_0010 0.0 65535.0000 /end CHARACTERISTIC
/begin CHARACTERISTIC K_ED_DK1_PDR.P_CODE_SH_TO_GND "P-Code fuer die Art SH_TO_GND | EN: Fault code DK1_PDR - OBD P-code reported for short to ground" VALUE 0x7108C TKW_VV_VV_UW 100.0 FORMULA_0010 0.0 65535.0000 /end CHARACTERISTIC
/begin CHARACTERISTIC K_ED_DK2_PDR.P_CODE_SH_TO_GND "P-Code fuer die Art SH_TO_GND | EN: Fault code DK2_PDR - OBD P-code reported for short to ground" VALUE 0x710A6 TKW_VV_VV_UW 100.0 FORMULA_0010 0.0 65535.0000 /end CHARACTERISTIC
/begin CHARACTERISTIC K_ED_DK1_SK_ERR.P_CODE_SH_TO_GND "P-Code fuer die Art SH_TO_GND | EN: Fault code DK1_SK_ERR - OBD P-code reported for short to ground" VALUE 0x710F4 TKW_VV_VV_UW 100.0 FORMULA_0010 0.0 65535.0000 /end CHARACTERISTIC
/begin CHARACTERISTIC K_ED_DK1_FEDERN.P_CODE_SH_TO_GND "P-Code fuer die Art SH_TO_GND | EN: Fault code DK1_FEDERN - OBD P-code reported for short to ground" VALUE 0x71128 TKW_VV_VV_UW 100.0 FORMULA_0010 0.0 65535.0000 /end CHARACTERISTIC
/begin CHARACTERISTIC K_ED_DK2_FEDERN.P_CODE_SH_TO_GND "P-Code fuer die Art SH_TO_GND | EN: Fault code DK2_FEDERN - OBD P-code reported for short to ground" VALUE 0x71142 TKW_VV_VV_UW 100.0 FORMULA_0010 0.0 65535.0000 /end CHARACTERISTIC
/begin CHARACTERISTIC K_ED_DK1_CMD.P_CODE_SH_TO_GND "P-Code fuer die Art SH_TO_GND | EN: Fault code DK1_CMD - OBD P-code reported for short to ground" VALUE 0x711AA TKW_VV_VV_UW 100.0 FORMULA_0010 0.0 65535.0000 /end CHARACTERISTIC
/begin CHARACTERISTIC K_ED_DK2_CMD.P_CODE_SH_TO_GND "P-Code fuer die Art SH_TO_GND | EN: Fault code DK2_CMD - OBD P-code reported for short to ground" VALUE 0x711C4 TKW_VV_VV_UW 100.0 FORMULA_0010 0.0 65535.0000 /end CHARACTERISTIC
/begin CHARACTERISTIC K_ED_AUSS_KAT_Z1.P_CODE_SH_TO_GND "P-Code fuer die Art SH_TO_GND | EN: Fault code AUSS_KAT_Z1 - OBD P-code reported for short to ground" VALUE 0x71294 TKW_VV_VV_UW 100.0 FORMULA_0010 0.0 65535.0000 /end CHARACTERISTIC
/begin CHARACTERISTIC K_ED_AUSS_KAT_Z2.P_CODE_SH_TO_GND "P-Code fuer die Art SH_TO_GND | EN: Fault code AUSS_KAT_Z2 - OBD P-code reported for short to ground" VALUE 0x712AE TKW_VV_VV_UW 100.0 FORMULA_0010 0.0 65535.0000 /end CHARACTERISTIC
/begin CHARACTERISTIC K_ED_AUSS_KAT_Z3.P_CODE_SH_TO_GND "P-Code fuer die Art SH_TO_GND | EN: Fault code AUSS_KAT_Z3 - OBD P-code reported for short to ground" VALUE 0x712C8 TKW_VV_VV_UW 100.0 FORMULA_0010 0.0 65535.0000 /end CHARACTERISTIC
/begin CHARACTERISTIC K_ED_AUSS_KAT_Z4.P_CODE_SH_TO_GND "P-Code fuer die Art SH_TO_GND | EN: Fault code AUSS_KAT_Z4 - OBD P-code reported for short to ground" VALUE 0x712E2 TKW_VV_VV_UW 100.0 FORMULA_0010 0.0 65535.0000 /end CHARACTERISTIC
/begin CHARACTERISTIC K_ED_AUSS_KAT_Z5.P_CODE_SH_TO_GND "P-Code fuer die Art SH_TO_GND | EN: Fault code AUSS_KAT_Z5 - OBD P-code reported for short to ground" VALUE 0x712FC TKW_VV_VV_UW 100.0 FORMULA_0010 0.0 65535.0000 /end CHARACTERISTIC
/begin CHARACTERISTIC K_ED_AUSS_KAT_Z6.P_CODE_SH_TO_GND "P-Code fuer die Art SH_TO_GND | EN: Fault code AUSS_KAT_Z6 - OBD P-code reported for short to ground" VALUE 0x71316 TKW_VV_VV_UW 100.0 FORMULA_0010 0.0 65535.0000 /end CHARACTERISTIC
/begin CHARACTERISTIC K_ED_AUSS_KAT_Z7.P_CODE_SH_TO_GND "P-Code fuer die Art SH_TO_GND | EN: Fault code AUSS_KAT_Z7 - OBD P-code reported for short to ground" VALUE 0x71330 TKW_VV_VV_UW 100.0 FORMULA_0010 0.0 65535.0000 /end CHARACTERISTIC
/begin CHARACTERISTIC K_ED_AUSS_KAT_Z8.P_CODE_SH_TO_GND "P-Code fuer die Art SH_TO_GND | EN: Fault code AUSS_KAT_Z8 - OBD P-code reported for short to ground" VALUE 0x7134A TKW_VV_VV_UW 100.0 FORMULA_0010 0.0 65535.0000 /end CHARACTERISTIC
/begin CHARACTERISTIC K_ED_AUSS_KAT_Z9.P_CODE_SH_TO_GND "P-Code fuer die Art SH_TO_GND | EN: Fault code AUSS_KAT_Z9 - OBD P-code reported for short to ground" VALUE 0x71364 TKW_VV_VV_UW 100.0 FORMULA_0010 0.0 65535.0000 /end CHARACTERISTIC
/begin CHARACTERISTIC K_ED_AUSS_KAT_Z10.P_CODE_SH_TO_GND "P-Code fuer die Art SH_TO_GND | EN: Fault code AUSS_KAT_Z10 - OBD P-code reported for short to ground" VALUE 0x7137E TKW_VV_VV_UW 100.0 FORMULA_0010 0.0 65535.0000 /end CHARACTERISTIC
/begin CHARACTERISTIC K_ED_AUSS_KAT_MULT.P_CODE_SH_TO_GND "P-Code fuer die Art SH_TO_GND | EN: Fault code AUSS_KAT_MULT - OBD P-code reported for short to ground" VALUE 0x713CC TKW_VV_VV_UW 100.0 FORMULA_0010 0.0 65535.0000 /end CHARACTERISTIC
/begin CHARACTERISTIC K_ED_AUSS_ABG_Z1.P_CODE_SH_TO_GND "P-Code fuer die Art SH_TO_GND | EN: Fault code AUSS_ABG_Z1 - OBD P-code reported for short to ground" VALUE 0x713E6 TKW_VV_VV_UW 100.0 FORMULA_0010 0.0 65535.0000 /end CHARACTERISTIC
/begin CHARACTERISTIC K_ED_AUSS_ABG_Z2.P_CODE_SH_TO_GND "P-Code fuer die Art SH_TO_GND | EN: Fault code AUSS_ABG_Z2 - OBD P-code reported for short to ground" VALUE 0x71400 TKW_VV_VV_UW 100.0 FORMULA_0010 0.0 65535.0000 /end CHARACTERISTIC
/begin CHARACTERISTIC K_ED_AUSS_ABG_Z3.P_CODE_SH_TO_GND "P-Code fuer die Art SH_TO_GND | EN: Fault code AUSS_ABG_Z3 - OBD P-code reported for short to ground" VALUE 0x7141A TKW_VV_VV_UW 100.0 FORMULA_0010 0.0 65535.0000 /end CHARACTERISTIC
/begin CHARACTERISTIC K_ED_AUSS_ABG_Z4.P_CODE_SH_TO_GND "P-Code fuer die Art SH_TO_GND | EN: Fault code AUSS_ABG_Z4 - OBD P-code reported for short to ground" VALUE 0x71434 TKW_VV_VV_UW 100.0 FORMULA_0010 0.0 65535.0000 /end CHARACTERISTIC
/begin CHARACTERISTIC K_ED_AUSS_ABG_Z5.P_CODE_SH_TO_GND "P-Code fuer die Art SH_TO_GND | EN: Fault code AUSS_ABG_Z5 - OBD P-code reported for short to ground" VALUE 0x7144E TKW_VV_VV_UW 100.0 FORMULA_0010 0.0 65535.0000 /end CHARACTERISTIC
/begin CHARACTERISTIC K_ED_AUSS_ABG_Z6.P_CODE_SH_TO_GND "P-Code fuer die Art SH_TO_GND | EN: Fault code AUSS_ABG_Z6 - OBD P-code reported for short to ground" VALUE 0x71468 TKW_VV_VV_UW 100.0 FORMULA_0010 0.0 65535.0000 /end CHARACTERISTIC
/begin CHARACTERISTIC K_ED_AUSS_ABG_Z7.P_CODE_SH_TO_GND "P-Code fuer die Art SH_TO_GND | EN: Fault code AUSS_ABG_Z7 - OBD P-code reported for short to ground" VALUE 0x71482 TKW_VV_VV_UW 100.0 FORMULA_0010 0.0 65535.0000 /end CHARACTERISTIC
/begin CHARACTERISTIC K_ED_AUSS_ABG_Z8.P_CODE_SH_TO_GND "P-Code fuer die Art SH_TO_GND | EN: Fault code AUSS_ABG_Z8 - OBD P-code reported for short to ground" VALUE 0x7149C TKW_VV_VV_UW 100.0 FORMULA_0010 0.0 65535.0000 /end CHARACTERISTIC
/begin CHARACTERISTIC K_ED_AUSS_ABG_Z9.P_CODE_SH_TO_GND "P-Code fuer die Art SH_TO_GND" VALUE 0x714B6 TKW_VV_VV_UW 100.0 FORMULA_0010 0.0 65535.0000 /end CHARACTERISTIC
/begin CHARACTERISTIC K_ED_AUSS_ABG_Z10.P_CODE_SH_TO_GND "P-Code fuer die Art SH_TO_GND" VALUE 0x714D0 TKW_VV_VV_UW 100.0 FORMULA_0010 0.0 65535.0000 /end CHARACTERISTIC
/begin CHARACTERISTIC K_ED_AUSS_ABG_MULT.P_CODE_SH_TO_GND "P-Code fuer die Art SH_TO_GND" VALUE 0x7151E TKW_VV_VV_UW 100.0 FORMULA_0010 0.0 65535.0000 /end CHARACTERISTIC
/begin CHARACTERISTIC K_ED_BLS_PLAU.P_CODE_SH_TO_GND "P-Code fuer die Art SH_TO_GND | EN: Fault code BLS_PLAU - OBD P-code reported for short to ground" VALUE 0x715EE TKW_VV_VV_UW 100.0 FORMULA_0010 0.0 65535.0000 /end CHARACTERISTIC
/begin CHARACTERISTIC K_ED_DK1_ZUST.P_CODE_SH_TO_GND "P-Code fuer die Art SH_TO_GND | EN: Fault code DK1_ZUST - OBD P-code reported for short to ground" VALUE 0x71670 TKW_VV_VV_UW 100.0 FORMULA_0010 0.0 65535.0000 /end CHARACTERISTIC
/begin CHARACTERISTIC K_ED_AFZ_HS.P_CODE_SH_TO_GND "P-Code fuer die Art SH_TO_GND | EN: Fault code AFZ_HS - OBD P-code reported for short to ground" VALUE 0x716F2 TKW_VV_VV_UW 100.0 FORMULA_0010 0.0 65535.0000 /end CHARACTERISTIC
/begin CHARACTERISTIC K_ED_AFZ_HS_NA.P_CODE_SH_TO_GND "P-Code fuer die Art SH_TO_GND" VALUE 0x71774 TKW_VV_VV_UW 100.0 FORMULA_0010 0.0 65535.0000 /end CHARACTERISTIC
/begin CHARACTERISTIC K_ED_APPL_DATA_IGN.P_CODE_OPENLOAD "P-Code fuer die Art OPENLOAD | EN: Fault code APPL_DATA_IGN - OBD P-code reported for open circuit" VALUE 0x70D82 TKW_VV_VV_UW 100.0 FORMULA_0010 0.0 65535.0000 /end CHARACTERISTIC
/begin CHARACTERISTIC K_ED_DK1_CAN.P_CODE_OPENLOAD "P-Code fuer die Art OPENLOAD | EN: Fault code DK1_CAN - OBD P-code reported for open circuit" VALUE 0x70E52 TKW_VV_VV_UW 100.0 FORMULA_0010 0.0 65535.0000 /end CHARACTERISTIC
/begin CHARACTERISTIC K_ED_DK2_CAN.P_CODE_OPENLOAD "P-Code fuer die Art OPENLOAD | EN: Fault code DK2_CAN - OBD P-code reported for open circuit" VALUE 0x70E6C TKW_VV_VV_UW 100.0 FORMULA_0010 0.0 65535.0000 /end CHARACTERISTIC
/begin CHARACTERISTIC K_ED_DK1_REGLER.P_CODE_OPENLOAD "P-Code fuer die Art OPENLOAD | EN: Fault code DK1_REGLER - OBD P-code reported for open circuit" VALUE 0x70F56 TKW_VV_VV_UW 100.0 FORMULA_0010 0.0 65535.0000 /end CHARACTERISTIC
/begin CHARACTERISTIC K_ED_DK1_ADAPT.P_CODE_OPENLOAD "P-Code fuer die Art OPENLOAD | EN: Fault code DK1_ADAPT - OBD P-code reported for open circuit" VALUE 0x70F8A TKW_VV_VV_UW 100.0 FORMULA_0010 0.0 65535.0000 /end CHARACTERISTIC
/begin CHARACTERISTIC K_ED_DK2_ADAPT.P_CODE_OPENLOAD "P-Code fuer die Art OPENLOAD | EN: Fault code DK2_ADAPT - OBD P-code reported for open circuit" VALUE 0x70FA4 TKW_VV_VV_UW 100.0 FORMULA_0010 0.0 65535.0000 /end CHARACTERISTIC
/begin CHARACTERISTIC K_ED_DK1_WDK.P_CODE_OPENLOAD "P-Code fuer die Art OPENLOAD | EN: Fault code DK1_WDK - OBD P-code reported for open circuit" VALUE 0x7105A TKW_VV_VV_UW 100.0 FORMULA_0010 0.0 65535.0000 /end CHARACTERISTIC
/begin CHARACTERISTIC K_ED_DK1_PDR.P_CODE_OPENLOAD "P-Code fuer die Art OPENLOAD | EN: Fault code DK1_PDR - OBD P-code reported for open circuit" VALUE 0x7108E TKW_VV_VV_UW 100.0 FORMULA_0010 0.0 65535.0000 /end CHARACTERISTIC
/begin CHARACTERISTIC K_ED_DK2_PDR.P_CODE_OPENLOAD "P-Code fuer die Art OPENLOAD | EN: Fault code DK2_PDR - OBD P-code reported for open circuit" VALUE 0x710A8 TKW_VV_VV_UW 100.0 FORMULA_0010 0.0 65535.0000 /end CHARACTERISTIC
/begin CHARACTERISTIC K_ED_DK1_SK_ERR.P_CODE_OPENLOAD "P-Code fuer die Art OPENLOAD | EN: Fault code DK1_SK_ERR - OBD P-code reported for open circuit" VALUE 0x710F6 TKW_VV_VV_UW 100.0 FORMULA_0010 0.0 65535.0000 /end CHARACTERISTIC
/begin CHARACTERISTIC K_ED_DK1_FEDERN.P_CODE_OPENLOAD "P-Code fuer die Art OPENLOAD | EN: Fault code DK1_FEDERN - OBD P-code reported for open circuit" VALUE 0x7112A TKW_VV_VV_UW 100.0 FORMULA_0010 0.0 65535.0000 /end CHARACTERISTIC
/begin CHARACTERISTIC K_ED_DK2_FEDERN.P_CODE_OPENLOAD "P-Code fuer die Art OPENLOAD | EN: Fault code DK2_FEDERN - OBD P-code reported for open circuit" VALUE 0x71144 TKW_VV_VV_UW 100.0 FORMULA_0010 0.0 65535.0000 /end CHARACTERISTIC
/begin CHARACTERISTIC K_ED_DK1_CMD.P_CODE_OPENLOAD "P-Code fuer die Art OPENLOAD | EN: Fault code DK1_CMD - OBD P-code reported for open circuit" VALUE 0x711AC TKW_VV_VV_UW 100.0 FORMULA_0010 0.0 65535.0000 /end CHARACTERISTIC
/begin CHARACTERISTIC K_ED_DK2_CMD.P_CODE_OPENLOAD "P-Code fuer die Art OPENLOAD | EN: Fault code DK2_CMD - OBD P-code reported for open circuit" VALUE 0x711C6 TKW_VV_VV_UW 100.0 FORMULA_0010 0.0 65535.0000 /end CHARACTERISTIC
/begin CHARACTERISTIC K_ED_AUSS_KAT_Z1.P_CODE_OPENLOAD "P-Code fuer die Art OPENLOAD | EN: Fault code AUSS_KAT_Z1 - OBD P-code reported for open circuit" VALUE 0x71296 TKW_VV_VV_UW 100.0 FORMULA_0010 0.0 65535.0000 /end CHARACTERISTIC
/begin CHARACTERISTIC K_ED_AUSS_KAT_Z2.P_CODE_OPENLOAD "P-Code fuer die Art OPENLOAD | EN: Fault code AUSS_KAT_Z2 - OBD P-code reported for open circuit" VALUE 0x712B0 TKW_VV_VV_UW 100.0 FORMULA_0010 0.0 65535.0000 /end CHARACTERISTIC
/begin CHARACTERISTIC K_ED_AUSS_KAT_Z3.P_CODE_OPENLOAD "P-Code fuer die Art OPENLOAD | EN: Fault code AUSS_KAT_Z3 - OBD P-code reported for open circuit" VALUE 0x712CA TKW_VV_VV_UW 100.0 FORMULA_0010 0.0 65535.0000 /end CHARACTERISTIC
/begin CHARACTERISTIC K_ED_AUSS_KAT_Z4.P_CODE_OPENLOAD "P-Code fuer die Art OPENLOAD | EN: Fault code AUSS_KAT_Z4 - OBD P-code reported for open circuit" VALUE 0x712E4 TKW_VV_VV_UW 100.0 FORMULA_0010 0.0 65535.0000 /end CHARACTERISTIC
/begin CHARACTERISTIC K_ED_AUSS_KAT_Z5.P_CODE_OPENLOAD "P-Code fuer die Art OPENLOAD | EN: Fault code AUSS_KAT_Z5 - OBD P-code reported for open circuit" VALUE 0x712FE TKW_VV_VV_UW 100.0 FORMULA_0010 0.0 65535.0000 /end CHARACTERISTIC
/begin CHARACTERISTIC K_ED_AUSS_KAT_Z6.P_CODE_OPENLOAD "P-Code fuer die Art OPENLOAD | EN: Fault code AUSS_KAT_Z6 - OBD P-code reported for open circuit" VALUE 0x71318 TKW_VV_VV_UW 100.0 FORMULA_0010 0.0 65535.0000 /end CHARACTERISTIC
/begin CHARACTERISTIC K_ED_AUSS_KAT_Z7.P_CODE_OPENLOAD "P-Code fuer die Art OPENLOAD | EN: Fault code AUSS_KAT_Z7 - OBD P-code reported for open circuit" VALUE 0x71332 TKW_VV_VV_UW 100.0 FORMULA_0010 0.0 65535.0000 /end CHARACTERISTIC
/begin CHARACTERISTIC K_ED_AUSS_KAT_Z8.P_CODE_OPENLOAD "P-Code fuer die Art OPENLOAD | EN: Fault code AUSS_KAT_Z8 - OBD P-code reported for open circuit" VALUE 0x7134C TKW_VV_VV_UW 100.0 FORMULA_0010 0.0 65535.0000 /end CHARACTERISTIC
/begin CHARACTERISTIC K_ED_AUSS_KAT_Z9.P_CODE_OPENLOAD "P-Code fuer die Art OPENLOAD | EN: Fault code AUSS_KAT_Z9 - OBD P-code reported for open circuit" VALUE 0x71366 TKW_VV_VV_UW 100.0 FORMULA_0010 0.0 65535.0000 /end CHARACTERISTIC
/begin CHARACTERISTIC K_ED_AUSS_KAT_Z10.P_CODE_OPENLOAD "P-Code fuer die Art OPENLOAD | EN: Fault code AUSS_KAT_Z10 - OBD P-code reported for open circuit" VALUE 0x71380 TKW_VV_VV_UW 100.0 FORMULA_0010 0.0 65535.0000 /end CHARACTERISTIC
/begin CHARACTERISTIC K_ED_AUSS_KAT_MULT.P_CODE_OPENLOAD "P-Code fuer die Art OPENLOAD | EN: Fault code AUSS_KAT_MULT - OBD P-code reported for open circuit" VALUE 0x713CE TKW_VV_VV_UW 100.0 FORMULA_0010 0.0 65535.0000 /end CHARACTERISTIC
/begin CHARACTERISTIC K_ED_AUSS_ABG_Z1.P_CODE_OPENLOAD "P-Code fuer die Art OPENLOAD | EN: Fault code AUSS_ABG_Z1 - OBD P-code reported for open circuit" VALUE 0x713E8 TKW_VV_VV_UW 100.0 FORMULA_0010 0.0 65535.0000 /end CHARACTERISTIC
/begin CHARACTERISTIC K_ED_AUSS_ABG_Z2.P_CODE_OPENLOAD "P-Code fuer die Art OPENLOAD | EN: Fault code AUSS_ABG_Z2 - OBD P-code reported for open circuit" VALUE 0x71402 TKW_VV_VV_UW 100.0 FORMULA_0010 0.0 65535.0000 /end CHARACTERISTIC
/begin CHARACTERISTIC K_ED_AUSS_ABG_Z3.P_CODE_OPENLOAD "P-Code fuer die Art OPENLOAD | EN: Fault code AUSS_ABG_Z3 - OBD P-code reported for open circuit" VALUE 0x7141C TKW_VV_VV_UW 100.0 FORMULA_0010 0.0 65535.0000 /end CHARACTERISTIC
/begin CHARACTERISTIC K_ED_AUSS_ABG_Z4.P_CODE_OPENLOAD "P-Code fuer die Art OPENLOAD | EN: Fault code AUSS_ABG_Z4 - OBD P-code reported for open circuit" VALUE 0x71436 TKW_VV_VV_UW 100.0 FORMULA_0010 0.0 65535.0000 /end CHARACTERISTIC
/begin CHARACTERISTIC K_ED_AUSS_ABG_Z5.P_CODE_OPENLOAD "P-Code fuer die Art OPENLOAD | EN: Fault code AUSS_ABG_Z5 - OBD P-code reported for open circuit" VALUE 0x71450 TKW_VV_VV_UW 100.0 FORMULA_0010 0.0 65535.0000 /end CHARACTERISTIC
/begin CHARACTERISTIC K_ED_AUSS_ABG_Z6.P_CODE_OPENLOAD "P-Code fuer die Art OPENLOAD | EN: Fault code AUSS_ABG_Z6 - OBD P-code reported for open circuit" VALUE 0x7146A TKW_VV_VV_UW 100.0 FORMULA_0010 0.0 65535.0000 /end CHARACTERISTIC
/begin CHARACTERISTIC K_ED_AUSS_ABG_Z7.P_CODE_OPENLOAD "P-Code fuer die Art OPENLOAD | EN: Fault code AUSS_ABG_Z7 - OBD P-code reported for open circuit" VALUE 0x71484 TKW_VV_VV_UW 100.0 FORMULA_0010 0.0 65535.0000 /end CHARACTERISTIC
/begin CHARACTERISTIC K_ED_AUSS_ABG_Z8.P_CODE_OPENLOAD "P-Code fuer die Art OPENLOAD | EN: Fault code AUSS_ABG_Z8 - OBD P-code reported for open circuit" VALUE 0x7149E TKW_VV_VV_UW 100.0 FORMULA_0010 0.0 65535.0000 /end CHARACTERISTIC
/begin CHARACTERISTIC K_ED_AUSS_ABG_Z9.P_CODE_OPENLOAD "P-Code fuer die Art OPENLOAD" VALUE 0x714B8 TKW_VV_VV_UW 100.0 FORMULA_0010 0.0 65535.0000 /end CHARACTERISTIC
/begin CHARACTERISTIC K_ED_AUSS_ABG_Z10.P_CODE_OPENLOAD "P-Code fuer die Art OPENLOAD" VALUE 0x714D2 TKW_VV_VV_UW 100.0 FORMULA_0010 0.0 65535.0000 /end CHARACTERISTIC
/begin CHARACTERISTIC K_ED_AUSS_ABG_MULT.P_CODE_OPENLOAD "P-Code fuer die Art OPENLOAD" VALUE 0x71520 TKW_VV_VV_UW 100.0 FORMULA_0010 0.0 65535.0000 /end CHARACTERISTIC
/begin CHARACTERISTIC K_ED_BLS_PLAU.P_CODE_OPENLOAD "P-Code fuer die Art OPENLOAD | EN: Fault code BLS_PLAU - OBD P-code reported for open circuit" VALUE 0x715F0 TKW_VV_VV_UW 100.0 FORMULA_0010 0.0 65535.0000 /end CHARACTERISTIC
/begin CHARACTERISTIC K_ED_DK1_ZUST.P_CODE_OPENLOAD "P-Code fuer die Art OPENLOAD | EN: Fault code DK1_ZUST - OBD P-code reported for open circuit" VALUE 0x71672 TKW_VV_VV_UW 100.0 FORMULA_0010 0.0 65535.0000 /end CHARACTERISTIC
/begin CHARACTERISTIC K_ED_AFZ_HS.P_CODE_OPENLOAD "P-Code fuer die Art OPENLOAD | EN: Fault code AFZ_HS - OBD P-code reported for open circuit" VALUE 0x716F4 TKW_VV_VV_UW 100.0 FORMULA_0010 0.0 65535.0000 /end CHARACTERISTIC
/begin CHARACTERISTIC K_ED_AFZ_HS_NA.P_CODE_OPENLOAD "P-Code fuer die Art OPENLOAD" VALUE 0x71776 TKW_VV_VV_UW 100.0 FORMULA_0010 0.0 65535.0000 /end CHARACTERISTIC
/begin CHARACTERISTIC K_ED_APPL_DATA_IGN.P_CODE_UNPLAUSIBEL "P-Code fuer die Art UNPLAUSIBEL | EN: Fault code APPL_DATA_IGN - OBD P-code reported for implausible signal" VALUE 0x70D84 TKW_VV_VV_UW 100.0 FORMULA_0010 0.0 65535.0000 /end CHARACTERISTIC
/begin CHARACTERISTIC K_ED_DK1_CAN.P_CODE_UNPLAUSIBEL "P-Code fuer die Art UNPLAUSIBEL | EN: Fault code DK1_CAN - OBD P-code reported for implausible signal" VALUE 0x70E54 TKW_VV_VV_UW 100.0 FORMULA_0010 0.0 65535.0000 /end CHARACTERISTIC
/begin CHARACTERISTIC K_ED_DK2_CAN.P_CODE_UNPLAUSIBEL "P-Code fuer die Art UNPLAUSIBEL | EN: Fault code DK2_CAN - OBD P-code reported for implausible signal" VALUE 0x70E6E TKW_VV_VV_UW 100.0 FORMULA_0010 0.0 65535.0000 /end CHARACTERISTIC
/begin CHARACTERISTIC K_ED_DK1_REGLER.P_CODE_UNPLAUSIBEL "P-Code fuer die Art UNPLAUSIBEL | EN: Fault code DK1_REGLER - OBD P-code reported for implausible signal" VALUE 0x70F58 TKW_VV_VV_UW 100.0 FORMULA_0010 0.0 65535.0000 /end CHARACTERISTIC
/begin CHARACTERISTIC K_ED_DK1_ADAPT.P_CODE_UNPLAUSIBEL "P-Code fuer die Art UNPLAUSIBEL | EN: Fault code DK1_ADAPT - OBD P-code reported for implausible signal" VALUE 0x70F8C TKW_VV_VV_UW 100.0 FORMULA_0010 0.0 65535.0000 /end CHARACTERISTIC
/begin CHARACTERISTIC K_ED_DK2_ADAPT.P_CODE_UNPLAUSIBEL "P-Code fuer die Art UNPLAUSIBEL | EN: Fault code DK2_ADAPT - OBD P-code reported for implausible signal" VALUE 0x70FA6 TKW_VV_VV_UW 100.0 FORMULA_0010 0.0 65535.0000 /end CHARACTERISTIC
/begin CHARACTERISTIC K_ED_DK1_WDK.P_CODE_UNPLAUSIBEL "P-Code fuer die Art UNPLAUSIBEL | EN: Fault code DK1_WDK - OBD P-code reported for implausible signal" VALUE 0x7105C TKW_VV_VV_UW 100.0 FORMULA_0010 0.0 65535.0000 /end CHARACTERISTIC
/begin CHARACTERISTIC K_ED_DK1_PDR.P_CODE_UNPLAUSIBEL "P-Code fuer die Art UNPLAUSIBEL | EN: Fault code DK1_PDR - OBD P-code reported for implausible signal" VALUE 0x71090 TKW_VV_VV_UW 100.0 FORMULA_0010 0.0 65535.0000 /end CHARACTERISTIC
/begin CHARACTERISTIC K_ED_DK2_PDR.P_CODE_UNPLAUSIBEL "P-Code fuer die Art UNPLAUSIBEL | EN: Fault code DK2_PDR - OBD P-code reported for implausible signal" VALUE 0x710AA TKW_VV_VV_UW 100.0 FORMULA_0010 0.0 65535.0000 /end CHARACTERISTIC
/begin CHARACTERISTIC K_ED_DK1_SK_ERR.P_CODE_UNPLAUSIBEL "P-Code fuer die Art UNPLAUSIBEL | EN: Fault code DK1_SK_ERR - OBD P-code reported for implausible signal" VALUE 0x710F8 TKW_VV_VV_UW 100.0 FORMULA_0010 0.0 65535.0000 /end CHARACTERISTIC
/begin CHARACTERISTIC K_ED_DK1_FEDERN.P_CODE_UNPLAUSIBEL "P-Code fuer die Art UNPLAUSIBEL | EN: Fault code DK1_FEDERN - OBD P-code reported for implausible signal" VALUE 0x7112C TKW_VV_VV_UW 100.0 FORMULA_0010 0.0 65535.0000 /end CHARACTERISTIC
/begin CHARACTERISTIC K_ED_DK2_FEDERN.P_CODE_UNPLAUSIBEL "P-Code fuer die Art UNPLAUSIBEL | EN: Fault code DK2_FEDERN - OBD P-code reported for implausible signal" VALUE 0x71146 TKW_VV_VV_UW 100.0 FORMULA_0010 0.0 65535.0000 /end CHARACTERISTIC
/begin CHARACTERISTIC K_ED_DK1_CMD.P_CODE_UNPLAUSIBEL "P-Code fuer die Art UNPLAUSIBEL | EN: Fault code DK1_CMD - OBD P-code reported for implausible signal" VALUE 0x711AE TKW_VV_VV_UW 100.0 FORMULA_0010 0.0 65535.0000 /end CHARACTERISTIC
/begin CHARACTERISTIC K_ED_DK2_CMD.P_CODE_UNPLAUSIBEL "P-Code fuer die Art UNPLAUSIBEL | EN: Fault code DK2_CMD - OBD P-code reported for implausible signal" VALUE 0x711C8 TKW_VV_VV_UW 100.0 FORMULA_0010 0.0 65535.0000 /end CHARACTERISTIC
/begin CHARACTERISTIC K_ED_AUSS_KAT_Z1.P_CODE_UNPLAUSIBEL "P-Code fuer die Art UNPLAUSIBEL | EN: Fault code AUSS_KAT_Z1 - OBD P-code reported for implausible signal" VALUE 0x71298 TKW_VV_VV_UW 100.0 FORMULA_0010 0.0 65535.0000 /end CHARACTERISTIC
/begin CHARACTERISTIC K_ED_AUSS_KAT_Z2.P_CODE_UNPLAUSIBEL "P-Code fuer die Art UNPLAUSIBEL | EN: Fault code AUSS_KAT_Z2 - OBD P-code reported for implausible signal" VALUE 0x712B2 TKW_VV_VV_UW 100.0 FORMULA_0010 0.0 65535.0000 /end CHARACTERISTIC
/begin CHARACTERISTIC K_ED_AUSS_KAT_Z3.P_CODE_UNPLAUSIBEL "P-Code fuer die Art UNPLAUSIBEL | EN: Fault code AUSS_KAT_Z3 - OBD P-code reported for implausible signal" VALUE 0x712CC TKW_VV_VV_UW 100.0 FORMULA_0010 0.0 65535.0000 /end CHARACTERISTIC
/begin CHARACTERISTIC K_ED_AUSS_KAT_Z4.P_CODE_UNPLAUSIBEL "P-Code fuer die Art UNPLAUSIBEL | EN: Fault code AUSS_KAT_Z4 - OBD P-code reported for implausible signal" VALUE 0x712E6 TKW_VV_VV_UW 100.0 FORMULA_0010 0.0 65535.0000 /end CHARACTERISTIC
/begin CHARACTERISTIC K_ED_AUSS_KAT_Z5.P_CODE_UNPLAUSIBEL "P-Code fuer die Art UNPLAUSIBEL | EN: Fault code AUSS_KAT_Z5 - OBD P-code reported for implausible signal" VALUE 0x71300 TKW_VV_VV_UW 100.0 FORMULA_0010 0.0 65535.0000 /end CHARACTERISTIC
/begin CHARACTERISTIC K_ED_AUSS_KAT_Z6.P_CODE_UNPLAUSIBEL "P-Code fuer die Art UNPLAUSIBEL | EN: Fault code AUSS_KAT_Z6 - OBD P-code reported for implausible signal" VALUE 0x7131A TKW_VV_VV_UW 100.0 FORMULA_0010 0.0 65535.0000 /end CHARACTERISTIC
/begin CHARACTERISTIC K_ED_AUSS_KAT_Z7.P_CODE_UNPLAUSIBEL "P-Code fuer die Art UNPLAUSIBEL | EN: Fault code AUSS_KAT_Z7 - OBD P-code reported for implausible signal" VALUE 0x71334 TKW_VV_VV_UW 100.0 FORMULA_0010 0.0 65535.0000 /end CHARACTERISTIC
/begin CHARACTERISTIC K_ED_AUSS_KAT_Z8.P_CODE_UNPLAUSIBEL "P-Code fuer die Art UNPLAUSIBEL | EN: Fault code AUSS_KAT_Z8 - OBD P-code reported for implausible signal" VALUE 0x7134E TKW_VV_VV_UW 100.0 FORMULA_0010 0.0 65535.0000 /end CHARACTERISTIC
/begin CHARACTERISTIC K_ED_AUSS_KAT_Z9.P_CODE_UNPLAUSIBEL "P-Code fuer die Art UNPLAUSIBEL | EN: Fault code AUSS_KAT_Z9 - OBD P-code reported for implausible signal" VALUE 0x71368 TKW_VV_VV_UW 100.0 FORMULA_0010 0.0 65535.0000 /end CHARACTERISTIC
/begin CHARACTERISTIC K_ED_AUSS_KAT_Z10.P_CODE_UNPLAUSIBEL "P-Code fuer die Art UNPLAUSIBEL | EN: Fault code AUSS_KAT_Z10 - OBD P-code reported for implausible signal" VALUE 0x71382 TKW_VV_VV_UW 100.0 FORMULA_0010 0.0 65535.0000 /end CHARACTERISTIC
/begin CHARACTERISTIC K_ED_AUSS_KAT_MULT.P_CODE_UNPLAUSIBEL "P-Code fuer die Art UNPLAUSIBEL | EN: Fault code AUSS_KAT_MULT - OBD P-code reported for implausible signal" VALUE 0x713D0 TKW_VV_VV_UW 100.0 FORMULA_0010 0.0 65535.0000 /end CHARACTERISTIC
/begin CHARACTERISTIC K_ED_AUSS_ABG_Z1.P_CODE_UNPLAUSIBEL "P-Code fuer die Art UNPLAUSIBEL | EN: Fault code AUSS_ABG_Z1 - OBD P-code reported for implausible signal" VALUE 0x713EA TKW_VV_VV_UW 100.0 FORMULA_0010 0.0 65535.0000 /end CHARACTERISTIC
/begin CHARACTERISTIC K_ED_AUSS_ABG_Z2.P_CODE_UNPLAUSIBEL "P-Code fuer die Art UNPLAUSIBEL | EN: Fault code AUSS_ABG_Z2 - OBD P-code reported for implausible signal" VALUE 0x71404 TKW_VV_VV_UW 100.0 FORMULA_0010 0.0 65535.0000 /end CHARACTERISTIC
/begin CHARACTERISTIC K_ED_AUSS_ABG_Z3.P_CODE_UNPLAUSIBEL "P-Code fuer die Art UNPLAUSIBEL | EN: Fault code AUSS_ABG_Z3 - OBD P-code reported for implausible signal" VALUE 0x7141E TKW_VV_VV_UW 100.0 FORMULA_0010 0.0 65535.0000 /end CHARACTERISTIC
/begin CHARACTERISTIC K_ED_AUSS_ABG_Z4.P_CODE_UNPLAUSIBEL "P-Code fuer die Art UNPLAUSIBEL | EN: Fault code AUSS_ABG_Z4 - OBD P-code reported for implausible signal" VALUE 0x71438 TKW_VV_VV_UW 100.0 FORMULA_0010 0.0 65535.0000 /end CHARACTERISTIC
/begin CHARACTERISTIC K_ED_AUSS_ABG_Z5.P_CODE_UNPLAUSIBEL "P-Code fuer die Art UNPLAUSIBEL | EN: Fault code AUSS_ABG_Z5 - OBD P-code reported for implausible signal" VALUE 0x71452 TKW_VV_VV_UW 100.0 FORMULA_0010 0.0 65535.0000 /end CHARACTERISTIC
/begin CHARACTERISTIC K_ED_AUSS_ABG_Z6.P_CODE_UNPLAUSIBEL "P-Code fuer die Art UNPLAUSIBEL | EN: Fault code AUSS_ABG_Z6 - OBD P-code reported for implausible signal" VALUE 0x7146C TKW_VV_VV_UW 100.0 FORMULA_0010 0.0 65535.0000 /end CHARACTERISTIC
/begin CHARACTERISTIC K_ED_AUSS_ABG_Z7.P_CODE_UNPLAUSIBEL "P-Code fuer die Art UNPLAUSIBEL | EN: Fault code AUSS_ABG_Z7 - OBD P-code reported for implausible signal" VALUE 0x71486 TKW_VV_VV_UW 100.0 FORMULA_0010 0.0 65535.0000 /end CHARACTERISTIC
/begin CHARACTERISTIC K_ED_AUSS_ABG_Z8.P_CODE_UNPLAUSIBEL "P-Code fuer die Art UNPLAUSIBEL | EN: Fault code AUSS_ABG_Z8 - OBD P-code reported for implausible signal" VALUE 0x714A0 TKW_VV_VV_UW 100.0 FORMULA_0010 0.0 65535.0000 /end CHARACTERISTIC
/begin CHARACTERISTIC K_ED_AUSS_ABG_Z9.P_CODE_UNPLAUSIBEL "P-Code fuer die Art UNPLAUSIBEL" VALUE 0x714BA TKW_VV_VV_UW 100.0 FORMULA_0010 0.0 65535.0000 /end CHARACTERISTIC
/begin CHARACTERISTIC K_ED_AUSS_ABG_Z10.P_CODE_UNPLAUSIBEL "P-Code fuer die Art UNPLAUSIBEL" VALUE 0x714D4 TKW_VV_VV_UW 100.0 FORMULA_0010 0.0 65535.0000 /end CHARACTERISTIC
/begin CHARACTERISTIC K_ED_AUSS_ABG_MULT.P_CODE_UNPLAUSIBEL "P-Code fuer die Art UNPLAUSIBEL" VALUE 0x71522 TKW_VV_VV_UW 100.0 FORMULA_0010 0.0 65535.0000 /end CHARACTERISTIC
/begin CHARACTERISTIC K_ED_BLS_PLAU.P_CODE_UNPLAUSIBEL "P-Code fuer die Art UNPLAUSIBEL | EN: Fault code BLS_PLAU - OBD P-code reported for implausible signal" VALUE 0x715F2 TKW_VV_VV_UW 100.0 FORMULA_0010 0.0 65535.0000 /end CHARACTERISTIC
/begin CHARACTERISTIC K_ED_DK1_ZUST.P_CODE_UNPLAUSIBEL "P-Code fuer die Art UNPLAUSIBEL | EN: Fault code DK1_ZUST - OBD P-code reported for implausible signal" VALUE 0x71674 TKW_VV_VV_UW 100.0 FORMULA_0010 0.0 65535.0000 /end CHARACTERISTIC
/begin CHARACTERISTIC K_ED_AFZ_HS.P_CODE_UNPLAUSIBEL "P-Code fuer die Art UNPLAUSIBEL | EN: Fault code AFZ_HS - OBD P-code reported for implausible signal" VALUE 0x716F6 TKW_VV_VV_UW 100.0 FORMULA_0010 0.0 65535.0000 /end CHARACTERISTIC
/begin CHARACTERISTIC K_ED_AFZ_HS_NA.P_CODE_UNPLAUSIBEL "P-Code fuer die Art UNPLAUSIBEL" VALUE 0x71778 TKW_VV_VV_UW 100.0 FORMULA_0010 0.0 65535.0000 /end CHARACTERISTIC
/begin CHARACTERISTIC K_ED_APPL_DATA_IGN.FEHLERSCHWELLE "Filterschwelle fuer Fehlereintrag | EN: Fault code APPL_DATA_IGN - debounce filter threshold for setting the fault" VALUE 0x70D86 TKW_VV_VV_UB 100.0 FORMULA_0003 0.0 255.0000 /end CHARACTERISTIC
/begin CHARACTERISTIC K_ED_DK1_CAN.FEHLERSCHWELLE "Filterschwelle fuer Fehlereintrag | EN: Fault code DK1_CAN - debounce filter threshold for setting the fault" VALUE 0x70E56 TKW_VV_VV_UB 100.0 FORMULA_0003 0.0 255.0000 /end CHARACTERISTIC
/begin CHARACTERISTIC K_ED_DK2_CAN.FEHLERSCHWELLE "Filterschwelle fuer Fehlereintrag | EN: Fault code DK2_CAN - debounce filter threshold for setting the fault" VALUE 0x70E70 TKW_VV_VV_UB 100.0 FORMULA_0003 0.0 255.0000 /end CHARACTERISTIC
/begin CHARACTERISTIC K_ED_DK1_REGLER.FEHLERSCHWELLE "Filterschwelle fuer Fehlereintrag | EN: Fault code DK1_REGLER - debounce filter threshold for setting the fault" VALUE 0x70F5A TKW_VV_VV_UB 100.0 FORMULA_0003 0.0 255.0000 /end CHARACTERISTIC
/begin CHARACTERISTIC K_ED_DK2_REGLER.FEHLERSCHWELLE "Filterschwelle fuer Fehlereintrag | EN: Fault code DK2_REGLER - debounce filter threshold for setting the fault" VALUE 0x70F74 TKW_VV_VV_UB 100.0 FORMULA_0003 0.0 255.0000 /end CHARACTERISTIC
/begin CHARACTERISTIC K_ED_DK1_ADAPT.FEHLERSCHWELLE "Filterschwelle fuer Fehlereintrag | EN: Fault code DK1_ADAPT - debounce filter threshold for setting the fault" VALUE 0x70F8E TKW_VV_VV_UB 100.0 FORMULA_0003 0.0 255.0000 /end CHARACTERISTIC
/begin CHARACTERISTIC K_ED_DK2_ADAPT.FEHLERSCHWELLE "Filterschwelle fuer Fehlereintrag | EN: Fault code DK2_ADAPT - debounce filter threshold for setting the fault" VALUE 0x70FA8 TKW_VV_VV_UB 100.0 FORMULA_0003 0.0 255.0000 /end CHARACTERISTIC
/begin CHARACTERISTIC K_ED_DK1_WDK.FEHLERSCHWELLE "Filterschwelle fuer Fehlereintrag | EN: Fault code DK1_WDK - debounce filter threshold for setting the fault" VALUE 0x7105E TKW_VV_VV_UB 100.0 FORMULA_0003 0.0 255.0000 /end CHARACTERISTIC
/begin CHARACTERISTIC K_ED_DK1_PDR.FEHLERSCHWELLE "Filterschwelle fuer Fehlereintrag | EN: Fault code DK1_PDR - debounce filter threshold for setting the fault" VALUE 0x71092 TKW_VV_VV_UB 100.0 FORMULA_0003 0.0 255.0000 /end CHARACTERISTIC
/begin CHARACTERISTIC K_ED_DK2_PDR.FEHLERSCHWELLE "Filterschwelle fuer Fehlereintrag | EN: Fault code DK2_PDR - debounce filter threshold for setting the fault" VALUE 0x710AC TKW_VV_VV_UB 100.0 FORMULA_0003 0.0 255.0000 /end CHARACTERISTIC
/begin CHARACTERISTIC K_ED_DK1_SK_ERR.FEHLERSCHWELLE "Filterschwelle fuer Fehlereintrag | EN: Fault code DK1_SK_ERR - debounce filter threshold for setting the fault" VALUE 0x710FA TKW_VV_VV_UB 100.0 FORMULA_0003 0.0 255.0000 /end CHARACTERISTIC
/begin CHARACTERISTIC K_ED_DK1_FEDERN.FEHLERSCHWELLE "Filterschwelle fuer Fehlereintrag | EN: Fault code DK1_FEDERN - debounce filter threshold for setting the fault" VALUE 0x7112E TKW_VV_VV_UB 100.0 FORMULA_0003 0.0 255.0000 /end CHARACTERISTIC
/begin CHARACTERISTIC K_ED_DK2_FEDERN.FEHLERSCHWELLE "Filterschwelle fuer Fehlereintrag | EN: Fault code DK2_FEDERN - debounce filter threshold for setting the fault" VALUE 0x71148 TKW_VV_VV_UB 100.0 FORMULA_0003 0.0 255.0000 /end CHARACTERISTIC
/begin CHARACTERISTIC K_ED_DK1_CMD.FEHLERSCHWELLE "Filterschwelle fuer Fehlereintrag | EN: Fault code DK1_CMD - debounce filter threshold for setting the fault" VALUE 0x711B0 TKW_VV_VV_UB 100.0 FORMULA_0003 0.0 255.0000 /end CHARACTERISTIC
/begin CHARACTERISTIC K_ED_DK2_CMD.FEHLERSCHWELLE "Filterschwelle fuer Fehlereintrag | EN: Fault code DK2_CMD - debounce filter threshold for setting the fault" VALUE 0x711CA TKW_VV_VV_UB 100.0 FORMULA_0003 0.0 255.0000 /end CHARACTERISTIC
/begin CHARACTERISTIC K_ED_AUSS_KAT_Z1.FEHLERSCHWELLE "Filterschwelle fuer Fehlereintrag | EN: Fault code AUSS_KAT_Z1 - debounce filter threshold for setting the fault" VALUE 0x7129A TKW_VV_VV_UB 100.0 FORMULA_0003 0.0 255.0000 /end CHARACTERISTIC
/begin CHARACTERISTIC K_ED_AUSS_KAT_Z2.FEHLERSCHWELLE "Filterschwelle fuer Fehlereintrag | EN: Fault code AUSS_KAT_Z2 - debounce filter threshold for setting the fault" VALUE 0x712B4 TKW_VV_VV_UB 100.0 FORMULA_0003 0.0 255.0000 /end CHARACTERISTIC
/begin CHARACTERISTIC K_ED_AUSS_KAT_Z3.FEHLERSCHWELLE "Filterschwelle fuer Fehlereintrag | EN: Fault code AUSS_KAT_Z3 - debounce filter threshold for setting the fault" VALUE 0x712CE TKW_VV_VV_UB 100.0 FORMULA_0003 0.0 255.0000 /end CHARACTERISTIC
/begin CHARACTERISTIC K_ED_AUSS_KAT_Z4.FEHLERSCHWELLE "Filterschwelle fuer Fehlereintrag | EN: Fault code AUSS_KAT_Z4 - debounce filter threshold for setting the fault" VALUE 0x712E8 TKW_VV_VV_UB 100.0 FORMULA_0003 0.0 255.0000 /end CHARACTERISTIC
/begin CHARACTERISTIC K_ED_AUSS_KAT_Z5.FEHLERSCHWELLE "Filterschwelle fuer Fehlereintrag | EN: Fault code AUSS_KAT_Z5 - debounce filter threshold for setting the fault" VALUE 0x71302 TKW_VV_VV_UB 100.0 FORMULA_0003 0.0 255.0000 /end CHARACTERISTIC
/begin CHARACTERISTIC K_ED_AUSS_KAT_Z6.FEHLERSCHWELLE "Filterschwelle fuer Fehlereintrag | EN: Fault code AUSS_KAT_Z6 - debounce filter threshold for setting the fault" VALUE 0x7131C TKW_VV_VV_UB 100.0 FORMULA_0003 0.0 255.0000 /end CHARACTERISTIC
/begin CHARACTERISTIC K_ED_AUSS_KAT_Z7.FEHLERSCHWELLE "Filterschwelle fuer Fehlereintrag | EN: Fault code AUSS_KAT_Z7 - debounce filter threshold for setting the fault" VALUE 0x71336 TKW_VV_VV_UB 100.0 FORMULA_0003 0.0 255.0000 /end CHARACTERISTIC
/begin CHARACTERISTIC K_ED_AUSS_KAT_Z8.FEHLERSCHWELLE "Filterschwelle fuer Fehlereintrag | EN: Fault code AUSS_KAT_Z8 - debounce filter threshold for setting the fault" VALUE 0x71350 TKW_VV_VV_UB 100.0 FORMULA_0003 0.0 255.0000 /end CHARACTERISTIC
/begin CHARACTERISTIC K_ED_AUSS_KAT_Z9.FEHLERSCHWELLE "Filterschwelle fuer Fehlereintrag | EN: Fault code AUSS_KAT_Z9 - debounce filter threshold for setting the fault" VALUE 0x7136A TKW_VV_VV_UB 100.0 FORMULA_0003 0.0 255.0000 /end CHARACTERISTIC
/begin CHARACTERISTIC K_ED_AUSS_KAT_Z10.FEHLERSCHWELLE "Filterschwelle fuer Fehlereintrag | EN: Fault code AUSS_KAT_Z10 - debounce filter threshold for setting the fault" VALUE 0x71384 TKW_VV_VV_UB 100.0 FORMULA_0003 0.0 255.0000 /end CHARACTERISTIC
/begin CHARACTERISTIC K_ED_AUSS_KAT_MULT.FEHLERSCHWELLE "Filterschwelle fuer Fehlereintrag | EN: Fault code AUSS_KAT_MULT - debounce filter threshold for setting the fault" VALUE 0x713D2 TKW_VV_VV_UB 100.0 FORMULA_0003 0.0 255.0000 /end CHARACTERISTIC
/begin CHARACTERISTIC K_ED_AUSS_ABG_Z1.FEHLERSCHWELLE "Filterschwelle fuer Fehlereintrag | EN: Fault code AUSS_ABG_Z1 - debounce filter threshold for setting the fault" VALUE 0x713EC TKW_VV_VV_UB 100.0 FORMULA_0003 0.0 255.0000 /end CHARACTERISTIC
/begin CHARACTERISTIC K_ED_AUSS_ABG_Z2.FEHLERSCHWELLE "Filterschwelle fuer Fehlereintrag | EN: Fault code AUSS_ABG_Z2 - debounce filter threshold for setting the fault" VALUE 0x71406 TKW_VV_VV_UB 100.0 FORMULA_0003 0.0 255.0000 /end CHARACTERISTIC
/begin CHARACTERISTIC K_ED_AUSS_ABG_Z3.FEHLERSCHWELLE "Filterschwelle fuer Fehlereintrag | EN: Fault code AUSS_ABG_Z3 - debounce filter threshold for setting the fault" VALUE 0x71420 TKW_VV_VV_UB 100.0 FORMULA_0003 0.0 255.0000 /end CHARACTERISTIC
/begin CHARACTERISTIC K_ED_AUSS_ABG_Z4.FEHLERSCHWELLE "Filterschwelle fuer Fehlereintrag | EN: Fault code AUSS_ABG_Z4 - debounce filter threshold for setting the fault" VALUE 0x7143A TKW_VV_VV_UB 100.0 FORMULA_0003 0.0 255.0000 /end CHARACTERISTIC
/begin CHARACTERISTIC K_ED_AUSS_ABG_Z5.FEHLERSCHWELLE "Filterschwelle fuer Fehlereintrag | EN: Fault code AUSS_ABG_Z5 - debounce filter threshold for setting the fault" VALUE 0x71454 TKW_VV_VV_UB 100.0 FORMULA_0003 0.0 255.0000 /end CHARACTERISTIC
/begin CHARACTERISTIC K_ED_AUSS_ABG_Z6.FEHLERSCHWELLE "Filterschwelle fuer Fehlereintrag | EN: Fault code AUSS_ABG_Z6 - debounce filter threshold for setting the fault" VALUE 0x7146E TKW_VV_VV_UB 100.0 FORMULA_0003 0.0 255.0000 /end CHARACTERISTIC
/begin CHARACTERISTIC K_ED_AUSS_ABG_Z7.FEHLERSCHWELLE "Filterschwelle fuer Fehlereintrag | EN: Fault code AUSS_ABG_Z7 - debounce filter threshold for setting the fault" VALUE 0x71488 TKW_VV_VV_UB 100.0 FORMULA_0003 0.0 255.0000 /end CHARACTERISTIC
/begin CHARACTERISTIC K_ED_AUSS_ABG_Z8.FEHLERSCHWELLE "Filterschwelle fuer Fehlereintrag | EN: Fault code AUSS_ABG_Z8 - debounce filter threshold for setting the fault" VALUE 0x714A2 TKW_VV_VV_UB 100.0 FORMULA_0003 0.0 255.0000 /end CHARACTERISTIC
/begin CHARACTERISTIC K_ED_AUSS_ABG_Z9.FEHLERSCHWELLE "Filterschwelle fuer Fehlereintrag" VALUE 0x714BC TKW_VV_VV_UB 100.0 FORMULA_0003 0.0 255.0000 /end CHARACTERISTIC
/begin CHARACTERISTIC K_ED_AUSS_ABG_Z10.FEHLERSCHWELLE "Filterschwelle fuer Fehlereintrag" VALUE 0x714D6 TKW_VV_VV_UB 100.0 FORMULA_0003 0.0 255.0000 /end CHARACTERISTIC
/begin CHARACTERISTIC K_ED_AUSS_ABG_MULT.FEHLERSCHWELLE "Filterschwelle fuer Fehlereintrag | EN: Filterschwelle fuer Fehlereintrag" VALUE 0x71524 TKW_VV_VV_UB 100.0 FORMULA_0003 0.0 255.0000 /end CHARACTERISTIC
/begin CHARACTERISTIC K_ED_BLS_PLAU.FEHLERSCHWELLE "Filterschwelle fuer Fehlereintrag | EN: Fault code BLS_PLAU - debounce filter threshold for setting the fault" VALUE 0x715F4 TKW_VV_VV_UB 100.0 FORMULA_0003 0.0 255.0000 /end CHARACTERISTIC
/begin CHARACTERISTIC K_ED_DK1_ZUST.FEHLERSCHWELLE "Filterschwelle fuer Fehlereintrag | EN: Fault code DK1_ZUST - debounce filter threshold for setting the fault" VALUE 0x71676 TKW_VV_VV_UB 100.0 FORMULA_0003 0.0 255.0000 /end CHARACTERISTIC
/begin CHARACTERISTIC K_ED_AFZ_HS.FEHLERSCHWELLE "Filterschwelle fuer Fehlereintrag | EN: Fault code AFZ_HS - debounce filter threshold for setting the fault" VALUE 0x716F8 TKW_VV_VV_UB 100.0 FORMULA_0003 0.0 255.0000 /end CHARACTERISTIC
/begin CHARACTERISTIC K_ED_AFZ_HS_NA.FEHLERSCHWELLE "Filterschwelle fuer Fehlereintrag" VALUE 0x7177A TKW_VV_VV_UB 100.0 FORMULA_0003 0.0 255.0000 /end CHARACTERISTIC
/begin CHARACTERISTIC K_ED_APPL_DATA_IGN.OK_SCHWELLE "Filterschwelle fuer Fehleraustrag | EN: Fault code APPL_DATA_IGN - debounce filter threshold for clearing (healing) the fault" VALUE 0x70D87 TKW_VV_VV_UB 100.0 FORMULA_0003 0.0 255.0000 /end CHARACTERISTIC
/begin CHARACTERISTIC K_ED_DK1_CAN.OK_SCHWELLE "Filterschwelle fuer Fehleraustrag | EN: Fault code DK1_CAN - debounce filter threshold for clearing (healing) the fault" VALUE 0x70E57 TKW_VV_VV_UB 100.0 FORMULA_0003 0.0 255.0000 /end CHARACTERISTIC
/begin CHARACTERISTIC K_ED_DK2_CAN.OK_SCHWELLE "Filterschwelle fuer Fehleraustrag | EN: Fault code DK2_CAN - debounce filter threshold for clearing (healing) the fault" VALUE 0x70E71 TKW_VV_VV_UB 100.0 FORMULA_0003 0.0 255.0000 /end CHARACTERISTIC
/begin CHARACTERISTIC K_ED_DK1_REGLER.OK_SCHWELLE "Filterschwelle fuer Fehleraustrag | EN: Fault code DK1_REGLER - debounce filter threshold for clearing (healing) the fault" VALUE 0x70F5B TKW_VV_VV_UB 100.0 FORMULA_0003 0.0 255.0000 /end CHARACTERISTIC
/begin CHARACTERISTIC K_ED_DK1_ADAPT.OK_SCHWELLE "Filterschwelle fuer Fehleraustrag | EN: Fault code DK1_ADAPT - debounce filter threshold for clearing (healing) the fault" VALUE 0x70F8F TKW_VV_VV_UB 100.0 FORMULA_0003 0.0 255.0000 /end CHARACTERISTIC
/begin CHARACTERISTIC K_ED_DK2_ADAPT.OK_SCHWELLE "Filterschwelle fuer Fehleraustrag | EN: Fault code DK2_ADAPT - debounce filter threshold for clearing (healing) the fault" VALUE 0x70FA9 TKW_VV_VV_UB 100.0 FORMULA_0003 0.0 255.0000 /end CHARACTERISTIC
/begin CHARACTERISTIC K_ED_DK1_WDK.OK_SCHWELLE "Filterschwelle fuer Fehleraustrag | EN: Fault code DK1_WDK - debounce filter threshold for clearing (healing) the fault" VALUE 0x7105F TKW_VV_VV_UB 100.0 FORMULA_0003 0.0 255.0000 /end CHARACTERISTIC
/begin CHARACTERISTIC K_ED_DK1_PDR.OK_SCHWELLE "Filterschwelle fuer Fehleraustrag | EN: Fault code DK1_PDR - debounce filter threshold for clearing (healing) the fault" VALUE 0x71093 TKW_VV_VV_UB 100.0 FORMULA_0003 0.0 255.0000 /end CHARACTERISTIC
/begin CHARACTERISTIC K_ED_DK2_PDR.OK_SCHWELLE "Filterschwelle fuer Fehleraustrag | EN: Fault code DK2_PDR - debounce filter threshold for clearing (healing) the fault" VALUE 0x710AD TKW_VV_VV_UB 100.0 FORMULA_0003 0.0 255.0000 /end CHARACTERISTIC
/begin CHARACTERISTIC K_ED_DK1_SK_ERR.OK_SCHWELLE "Filterschwelle fuer Fehleraustrag | EN: Fault code DK1_SK_ERR - debounce filter threshold for clearing (healing) the fault" VALUE 0x710FB TKW_VV_VV_UB 100.0 FORMULA_0003 0.0 255.0000 /end CHARACTERISTIC
/begin CHARACTERISTIC K_ED_DK1_FEDERN.OK_SCHWELLE "Filterschwelle fuer Fehleraustrag | EN: Fault code DK1_FEDERN - debounce filter threshold for clearing (healing) the fault" VALUE 0x7112F TKW_VV_VV_UB 100.0 FORMULA_0003 0.0 255.0000 /end CHARACTERISTIC
/begin CHARACTERISTIC K_ED_DK2_FEDERN.OK_SCHWELLE "Filterschwelle fuer Fehleraustrag | EN: Fault code DK2_FEDERN - debounce filter threshold for clearing (healing) the fault" VALUE 0x71149 TKW_VV_VV_UB 100.0 FORMULA_0003 0.0 255.0000 /end CHARACTERISTIC
/begin CHARACTERISTIC K_ED_DK1_CMD.OK_SCHWELLE "Filterschwelle fuer Fehleraustrag | EN: Fault code DK1_CMD - debounce filter threshold for clearing (healing) the fault" VALUE 0x711B1 TKW_VV_VV_UB 100.0 FORMULA_0003 0.0 255.0000 /end CHARACTERISTIC
/begin CHARACTERISTIC K_ED_DK2_CMD.OK_SCHWELLE "Filterschwelle fuer Fehleraustrag | EN: Fault code DK2_CMD - debounce filter threshold for clearing (healing) the fault" VALUE 0x711CB TKW_VV_VV_UB 100.0 FORMULA_0003 0.0 255.0000 /end CHARACTERISTIC
/begin CHARACTERISTIC K_ED_AUSS_KAT_Z1.OK_SCHWELLE "Filterschwelle fuer Fehleraustrag | EN: Fault code AUSS_KAT_Z1 - debounce filter threshold for clearing (healing) the fault" VALUE 0x7129B TKW_VV_VV_UB 100.0 FORMULA_0003 0.0 255.0000 /end CHARACTERISTIC
/begin CHARACTERISTIC K_ED_AUSS_KAT_Z2.OK_SCHWELLE "Filterschwelle fuer Fehleraustrag | EN: Fault code AUSS_KAT_Z2 - debounce filter threshold for clearing (healing) the fault" VALUE 0x712B5 TKW_VV_VV_UB 100.0 FORMULA_0003 0.0 255.0000 /end CHARACTERISTIC
/begin CHARACTERISTIC K_ED_AUSS_KAT_Z3.OK_SCHWELLE "Filterschwelle fuer Fehleraustrag | EN: Fault code AUSS_KAT_Z3 - debounce filter threshold for clearing (healing) the fault" VALUE 0x712CF TKW_VV_VV_UB 100.0 FORMULA_0003 0.0 255.0000 /end CHARACTERISTIC
/begin CHARACTERISTIC K_ED_AUSS_KAT_Z4.OK_SCHWELLE "Filterschwelle fuer Fehleraustrag | EN: Fault code AUSS_KAT_Z4 - debounce filter threshold for clearing (healing) the fault" VALUE 0x712E9 TKW_VV_VV_UB 100.0 FORMULA_0003 0.0 255.0000 /end CHARACTERISTIC
/begin CHARACTERISTIC K_ED_AUSS_KAT_Z5.OK_SCHWELLE "Filterschwelle fuer Fehleraustrag | EN: Fault code AUSS_KAT_Z5 - debounce filter threshold for clearing (healing) the fault" VALUE 0x71303 TKW_VV_VV_UB 100.0 FORMULA_0003 0.0 255.0000 /end CHARACTERISTIC
/begin CHARACTERISTIC K_ED_AUSS_KAT_Z6.OK_SCHWELLE "Filterschwelle fuer Fehleraustrag | EN: Fault code AUSS_KAT_Z6 - debounce filter threshold for clearing (healing) the fault" VALUE 0x7131D TKW_VV_VV_UB 100.0 FORMULA_0003 0.0 255.0000 /end CHARACTERISTIC
/begin CHARACTERISTIC K_ED_AUSS_KAT_Z7.OK_SCHWELLE "Filterschwelle fuer Fehleraustrag | EN: Fault code AUSS_KAT_Z7 - debounce filter threshold for clearing (healing) the fault" VALUE 0x71337 TKW_VV_VV_UB 100.0 FORMULA_0003 0.0 255.0000 /end CHARACTERISTIC
/begin CHARACTERISTIC K_ED_AUSS_KAT_Z8.OK_SCHWELLE "Filterschwelle fuer Fehleraustrag | EN: Fault code AUSS_KAT_Z8 - debounce filter threshold for clearing (healing) the fault" VALUE 0x71351 TKW_VV_VV_UB 100.0 FORMULA_0003 0.0 255.0000 /end CHARACTERISTIC
/begin CHARACTERISTIC K_ED_AUSS_KAT_Z9.OK_SCHWELLE "Filterschwelle fuer Fehleraustrag | EN: Fault code AUSS_KAT_Z9 - debounce filter threshold for clearing (healing) the fault" VALUE 0x7136B TKW_VV_VV_UB 100.0 FORMULA_0003 0.0 255.0000 /end CHARACTERISTIC
/begin CHARACTERISTIC K_ED_AUSS_KAT_Z10.OK_SCHWELLE "Filterschwelle fuer Fehleraustrag | EN: Fault code AUSS_KAT_Z10 - debounce filter threshold for clearing (healing) the fault" VALUE 0x71385 TKW_VV_VV_UB 100.0 FORMULA_0003 0.0 255.0000 /end CHARACTERISTIC
/begin CHARACTERISTIC K_ED_AUSS_KAT_MULT.OK_SCHWELLE "Filterschwelle fuer Fehleraustrag | EN: Fault code AUSS_KAT_MULT - debounce filter threshold for clearing (healing) the fault" VALUE 0x713D3 TKW_VV_VV_UB 100.0 FORMULA_0003 0.0 255.0000 /end CHARACTERISTIC
/begin CHARACTERISTIC K_ED_AUSS_ABG_Z1.OK_SCHWELLE "Filterschwelle fuer Fehleraustrag | EN: Fault code AUSS_ABG_Z1 - debounce filter threshold for clearing (healing) the fault" VALUE 0x713ED TKW_VV_VV_UB 100.0 FORMULA_0003 0.0 255.0000 /end CHARACTERISTIC
/begin CHARACTERISTIC K_ED_AUSS_ABG_Z2.OK_SCHWELLE "Filterschwelle fuer Fehleraustrag | EN: Fault code AUSS_ABG_Z2 - debounce filter threshold for clearing (healing) the fault" VALUE 0x71407 TKW_VV_VV_UB 100.0 FORMULA_0003 0.0 255.0000 /end CHARACTERISTIC
/begin CHARACTERISTIC K_ED_AUSS_ABG_Z3.OK_SCHWELLE "Filterschwelle fuer Fehleraustrag | EN: Fault code AUSS_ABG_Z3 - debounce filter threshold for clearing (healing) the fault" VALUE 0x71421 TKW_VV_VV_UB 100.0 FORMULA_0003 0.0 255.0000 /end CHARACTERISTIC
/begin CHARACTERISTIC K_ED_AUSS_ABG_Z4.OK_SCHWELLE "Filterschwelle fuer Fehleraustrag | EN: Fault code AUSS_ABG_Z4 - debounce filter threshold for clearing (healing) the fault" VALUE 0x7143B TKW_VV_VV_UB 100.0 FORMULA_0003 0.0 255.0000 /end CHARACTERISTIC
/begin CHARACTERISTIC K_ED_AUSS_ABG_Z5.OK_SCHWELLE "Filterschwelle fuer Fehleraustrag | EN: Fault code AUSS_ABG_Z5 - debounce filter threshold for clearing (healing) the fault" VALUE 0x71455 TKW_VV_VV_UB 100.0 FORMULA_0003 0.0 255.0000 /end CHARACTERISTIC
/begin CHARACTERISTIC K_ED_AUSS_ABG_Z6.OK_SCHWELLE "Filterschwelle fuer Fehleraustrag | EN: Fault code AUSS_ABG_Z6 - debounce filter threshold for clearing (healing) the fault" VALUE 0x7146F TKW_VV_VV_UB 100.0 FORMULA_0003 0.0 255.0000 /end CHARACTERISTIC
/begin CHARACTERISTIC K_ED_AUSS_ABG_Z7.OK_SCHWELLE "Filterschwelle fuer Fehleraustrag | EN: Fault code AUSS_ABG_Z7 - debounce filter threshold for clearing (healing) the fault" VALUE 0x71489 TKW_VV_VV_UB 100.0 FORMULA_0003 0.0 255.0000 /end CHARACTERISTIC
/begin CHARACTERISTIC K_ED_AUSS_ABG_Z8.OK_SCHWELLE "Filterschwelle fuer Fehleraustrag | EN: Fault code AUSS_ABG_Z8 - debounce filter threshold for clearing (healing) the fault" VALUE 0x714A3 TKW_VV_VV_UB 100.0 FORMULA_0003 0.0 255.0000 /end CHARACTERISTIC
/begin CHARACTERISTIC K_ED_AUSS_ABG_Z9.OK_SCHWELLE "Filterschwelle fuer Fehleraustrag" VALUE 0x714BD TKW_VV_VV_UB 100.0 FORMULA_0003 0.0 255.0000 /end CHARACTERISTIC
/begin CHARACTERISTIC K_ED_AUSS_ABG_Z10.OK_SCHWELLE "Filterschwelle fuer Fehleraustrag" VALUE 0x714D7 TKW_VV_VV_UB 100.0 FORMULA_0003 0.0 255.0000 /end CHARACTERISTIC
/begin CHARACTERISTIC K_ED_AUSS_ABG_MULT.OK_SCHWELLE "Filterschwelle fuer Fehleraustrag | EN: Filterschwelle fuer Fehleraustrag" VALUE 0x71525 TKW_VV_VV_UB 100.0 FORMULA_0003 0.0 255.0000 /end CHARACTERISTIC
/begin CHARACTERISTIC K_ED_BLS_PLAU.OK_SCHWELLE "Filterschwelle fuer Fehleraustrag | EN: Fault code BLS_PLAU - debounce filter threshold for clearing (healing) the fault" VALUE 0x715F5 TKW_VV_VV_UB 100.0 FORMULA_0003 0.0 255.0000 /end CHARACTERISTIC
/begin CHARACTERISTIC K_ED_DK1_ZUST.OK_SCHWELLE "Filterschwelle fuer Fehleraustrag | EN: Fault code DK1_ZUST - debounce filter threshold for clearing (healing) the fault" VALUE 0x71677 TKW_VV_VV_UB 100.0 FORMULA_0003 0.0 255.0000 /end CHARACTERISTIC
/begin CHARACTERISTIC K_ED_AFZ_HS.OK_SCHWELLE "Filterschwelle fuer Fehleraustrag | EN: Fault code AFZ_HS - debounce filter threshold for clearing (healing) the fault" VALUE 0x716F9 TKW_VV_VV_UB 100.0 FORMULA_0003 0.0 255.0000 /end CHARACTERISTIC
/begin CHARACTERISTIC K_ED_AFZ_HS_NA.OK_SCHWELLE "Filterschwelle fuer Fehleraustrag" VALUE 0x7177B TKW_VV_VV_UB 100.0 FORMULA_0003 0.0 255.0000 /end CHARACTERISTIC
/begin CHARACTERISTIC K_ED_APPL_DATA_IGN.INC_VOR_EINTRAG "Filtererhoehung vorm Fehlerspeichereintrag | EN: Fault code APPL_DATA_IGN - debounce filter increment before fault-memory entry" VALUE 0x70D88 TKW_VV_VV_UB 100.0 FORMULA_0003 0.0 255.0000 /end CHARACTERISTIC
/begin CHARACTERISTIC K_ED_DK1_CAN.INC_VOR_EINTRAG "Filtererhoehung vorm Fehlerspeichereintrag | EN: Fault code DK1_CAN - debounce filter increment before fault-memory entry" VALUE 0x70E58 TKW_VV_VV_UB 100.0 FORMULA_0003 0.0 255.0000 /end CHARACTERISTIC
/begin CHARACTERISTIC K_ED_DK2_CAN.INC_VOR_EINTRAG "Filtererhoehung vorm Fehlerspeichereintrag | EN: Fault code DK2_CAN - debounce filter increment before fault-memory entry" VALUE 0x70E72 TKW_VV_VV_UB 100.0 FORMULA_0003 0.0 255.0000 /end CHARACTERISTIC
/begin CHARACTERISTIC K_ED_DK1_REGLER.INC_VOR_EINTRAG "Filtererhoehung vorm Fehlerspeichereintrag | EN: Fault code DK1_REGLER - debounce filter increment before fault-memory entry" VALUE 0x70F5C TKW_VV_VV_UB 100.0 FORMULA_0003 0.0 255.0000 /end CHARACTERISTIC
/begin CHARACTERISTIC K_ED_DK2_REGLER.INC_VOR_EINTRAG "Filtererhoehung vorm Fehlerspeichereintrag | EN: Fault code DK2_REGLER - debounce filter increment before fault-memory entry" VALUE 0x70F76 TKW_VV_VV_UB 100.0 FORMULA_0003 0.0 255.0000 /end CHARACTERISTIC
/begin CHARACTERISTIC K_ED_DK1_ADAPT.INC_VOR_EINTRAG "Filtererhoehung vorm Fehlerspeichereintrag | EN: Fault code DK1_ADAPT - debounce filter increment before fault-memory entry" VALUE 0x70F90 TKW_VV_VV_UB 100.0 FORMULA_0003 0.0 255.0000 /end CHARACTERISTIC
/begin CHARACTERISTIC K_ED_DK2_ADAPT.INC_VOR_EINTRAG "Filtererhoehung vorm Fehlerspeichereintrag | EN: Fault code DK2_ADAPT - debounce filter increment before fault-memory entry" VALUE 0x70FAA TKW_VV_VV_UB 100.0 FORMULA_0003 0.0 255.0000 /end CHARACTERISTIC
/begin CHARACTERISTIC K_ED_DK1_WDK.INC_VOR_EINTRAG "Filtererhoehung vorm Fehlerspeichereintrag | EN: Fault code DK1_WDK - debounce filter increment before fault-memory entry" VALUE 0x71060 TKW_VV_VV_UB 100.0 FORMULA_0003 0.0 255.0000 /end CHARACTERISTIC
/begin CHARACTERISTIC K_ED_DK1_PDR.INC_VOR_EINTRAG "Filtererhoehung vorm Fehlerspeichereintrag | EN: Fault code DK1_PDR - debounce filter increment before fault-memory entry" VALUE 0x71094 TKW_VV_VV_UB 100.0 FORMULA_0003 0.0 255.0000 /end CHARACTERISTIC
/begin CHARACTERISTIC K_ED_DK2_PDR.INC_VOR_EINTRAG "Filtererhoehung vorm Fehlerspeichereintrag | EN: Fault code DK2_PDR - debounce filter increment before fault-memory entry" VALUE 0x710AE TKW_VV_VV_UB 100.0 FORMULA_0003 0.0 255.0000 /end CHARACTERISTIC
/begin CHARACTERISTIC K_ED_DK1_SK_ERR.INC_VOR_EINTRAG "Filtererhoehung vorm Fehlerspeichereintrag | EN: Fault code DK1_SK_ERR - debounce filter increment before fault-memory entry" VALUE 0x710FC TKW_VV_VV_UB 100.0 FORMULA_0003 0.0 255.0000 /end CHARACTERISTIC
/begin CHARACTERISTIC K_ED_DK1_FEDERN.INC_VOR_EINTRAG "Filtererhoehung vorm Fehlerspeichereintrag | EN: Fault code DK1_FEDERN - debounce filter increment before fault-memory entry" VALUE 0x71130 TKW_VV_VV_UB 100.0 FORMULA_0003 0.0 255.0000 /end CHARACTERISTIC
/begin CHARACTERISTIC K_ED_DK2_FEDERN.INC_VOR_EINTRAG "Filtererhoehung vorm Fehlerspeichereintrag | EN: Fault code DK2_FEDERN - debounce filter increment before fault-memory entry" VALUE 0x7114A TKW_VV_VV_UB 100.0 FORMULA_0003 0.0 255.0000 /end CHARACTERISTIC
/begin CHARACTERISTIC K_ED_DK1_CMD.INC_VOR_EINTRAG "Filtererhoehung vorm Fehlerspeichereintrag | EN: Fault code DK1_CMD - debounce filter increment before fault-memory entry" VALUE 0x711B2 TKW_VV_VV_UB 100.0 FORMULA_0003 0.0 255.0000 /end CHARACTERISTIC
/begin CHARACTERISTIC K_ED_DK2_CMD.INC_VOR_EINTRAG "Filtererhoehung vorm Fehlerspeichereintrag | EN: Fault code DK2_CMD - debounce filter increment before fault-memory entry" VALUE 0x711CC TKW_VV_VV_UB 100.0 FORMULA_0003 0.0 255.0000 /end CHARACTERISTIC
/begin CHARACTERISTIC K_ED_AUSS_KAT_Z1.INC_VOR_EINTRAG "Filtererhoehung vorm Fehlerspeichereintrag | EN: Fault code AUSS_KAT_Z1 - debounce filter increment before fault-memory entry" VALUE 0x7129C TKW_VV_VV_UB 100.0 FORMULA_0003 0.0 255.0000 /end CHARACTERISTIC
/begin CHARACTERISTIC K_ED_AUSS_KAT_Z2.INC_VOR_EINTRAG "Filtererhoehung vorm Fehlerspeichereintrag | EN: Fault code AUSS_KAT_Z2 - debounce filter increment before fault-memory entry" VALUE 0x712B6 TKW_VV_VV_UB 100.0 FORMULA_0003 0.0 255.0000 /end CHARACTERISTIC
/begin CHARACTERISTIC K_ED_AUSS_KAT_Z3.INC_VOR_EINTRAG "Filtererhoehung vorm Fehlerspeichereintrag | EN: Fault code AUSS_KAT_Z3 - debounce filter increment before fault-memory entry" VALUE 0x712D0 TKW_VV_VV_UB 100.0 FORMULA_0003 0.0 255.0000 /end CHARACTERISTIC
/begin CHARACTERISTIC K_ED_AUSS_KAT_Z4.INC_VOR_EINTRAG "Filtererhoehung vorm Fehlerspeichereintrag | EN: Fault code AUSS_KAT_Z4 - debounce filter increment before fault-memory entry" VALUE 0x712EA TKW_VV_VV_UB 100.0 FORMULA_0003 0.0 255.0000 /end CHARACTERISTIC
/begin CHARACTERISTIC K_ED_AUSS_KAT_Z5.INC_VOR_EINTRAG "Filtererhoehung vorm Fehlerspeichereintrag | EN: Fault code AUSS_KAT_Z5 - debounce filter increment before fault-memory entry" VALUE 0x71304 TKW_VV_VV_UB 100.0 FORMULA_0003 0.0 255.0000 /end CHARACTERISTIC
/begin CHARACTERISTIC K_ED_AUSS_KAT_Z6.INC_VOR_EINTRAG "Filtererhoehung vorm Fehlerspeichereintrag | EN: Fault code AUSS_KAT_Z6 - debounce filter increment before fault-memory entry" VALUE 0x7131E TKW_VV_VV_UB 100.0 FORMULA_0003 0.0 255.0000 /end CHARACTERISTIC
/begin CHARACTERISTIC K_ED_AUSS_KAT_Z7.INC_VOR_EINTRAG "Filtererhoehung vorm Fehlerspeichereintrag | EN: Fault code AUSS_KAT_Z7 - debounce filter increment before fault-memory entry" VALUE 0x71338 TKW_VV_VV_UB 100.0 FORMULA_0003 0.0 255.0000 /end CHARACTERISTIC
/begin CHARACTERISTIC K_ED_AUSS_KAT_Z8.INC_VOR_EINTRAG "Filtererhoehung vorm Fehlerspeichereintrag | EN: Fault code AUSS_KAT_Z8 - debounce filter increment before fault-memory entry" VALUE 0x71352 TKW_VV_VV_UB 100.0 FORMULA_0003 0.0 255.0000 /end CHARACTERISTIC
/begin CHARACTERISTIC K_ED_AUSS_KAT_Z9.INC_VOR_EINTRAG "Filtererhoehung vorm Fehlerspeichereintrag | EN: Fault code AUSS_KAT_Z9 - debounce filter increment before fault-memory entry" VALUE 0x7136C TKW_VV_VV_UB 100.0 FORMULA_0003 0.0 255.0000 /end CHARACTERISTIC
/begin CHARACTERISTIC K_ED_AUSS_KAT_Z10.INC_VOR_EINTRAG "Filtererhoehung vorm Fehlerspeichereintrag | EN: Fault code AUSS_KAT_Z10 - debounce filter increment before fault-memory entry" VALUE 0x71386 TKW_VV_VV_UB 100.0 FORMULA_0003 0.0 255.0000 /end CHARACTERISTIC
/begin CHARACTERISTIC K_ED_AUSS_KAT_MULT.INC_VOR_EINTRAG "Filtererhoehung vorm Fehlerspeichereintrag | EN: Fault code AUSS_KAT_MULT - debounce filter increment before fault-memory entry" VALUE 0x713D4 TKW_VV_VV_UB 100.0 FORMULA_0003 0.0 255.0000 /end CHARACTERISTIC
/begin CHARACTERISTIC K_ED_AUSS_ABG_Z1.INC_VOR_EINTRAG "Filtererhoehung vorm Fehlerspeichereintrag | EN: Fault code AUSS_ABG_Z1 - debounce filter increment before fault-memory entry" VALUE 0x713EE TKW_VV_VV_UB 100.0 FORMULA_0003 0.0 255.0000 /end CHARACTERISTIC
/begin CHARACTERISTIC K_ED_AUSS_ABG_Z2.INC_VOR_EINTRAG "Filtererhoehung vorm Fehlerspeichereintrag | EN: Fault code AUSS_ABG_Z2 - debounce filter increment before fault-memory entry" VALUE 0x71408 TKW_VV_VV_UB 100.0 FORMULA_0003 0.0 255.0000 /end CHARACTERISTIC
/begin CHARACTERISTIC K_ED_AUSS_ABG_Z3.INC_VOR_EINTRAG "Filtererhoehung vorm Fehlerspeichereintrag | EN: Fault code AUSS_ABG_Z3 - debounce filter increment before fault-memory entry" VALUE 0x71422 TKW_VV_VV_UB 100.0 FORMULA_0003 0.0 255.0000 /end CHARACTERISTIC
/begin CHARACTERISTIC K_ED_AUSS_ABG_Z4.INC_VOR_EINTRAG "Filtererhoehung vorm Fehlerspeichereintrag | EN: Fault code AUSS_ABG_Z4 - debounce filter increment before fault-memory entry" VALUE 0x7143C TKW_VV_VV_UB 100.0 FORMULA_0003 0.0 255.0000 /end CHARACTERISTIC
/begin CHARACTERISTIC K_ED_AUSS_ABG_Z5.INC_VOR_EINTRAG "Filtererhoehung vorm Fehlerspeichereintrag | EN: Fault code AUSS_ABG_Z5 - debounce filter increment before fault-memory entry" VALUE 0x71456 TKW_VV_VV_UB 100.0 FORMULA_0003 0.0 255.0000 /end CHARACTERISTIC
/begin CHARACTERISTIC K_ED_AUSS_ABG_Z6.INC_VOR_EINTRAG "Filtererhoehung vorm Fehlerspeichereintrag | EN: Fault code AUSS_ABG_Z6 - debounce filter increment before fault-memory entry" VALUE 0x71470 TKW_VV_VV_UB 100.0 FORMULA_0003 0.0 255.0000 /end CHARACTERISTIC
/begin CHARACTERISTIC K_ED_AUSS_ABG_Z7.INC_VOR_EINTRAG "Filtererhoehung vorm Fehlerspeichereintrag | EN: Fault code AUSS_ABG_Z7 - debounce filter increment before fault-memory entry" VALUE 0x7148A TKW_VV_VV_UB 100.0 FORMULA_0003 0.0 255.0000 /end CHARACTERISTIC
/begin CHARACTERISTIC K_ED_AUSS_ABG_Z8.INC_VOR_EINTRAG "Filtererhoehung vorm Fehlerspeichereintrag | EN: Fault code AUSS_ABG_Z8 - debounce filter increment before fault-memory entry" VALUE 0x714A4 TKW_VV_VV_UB 100.0 FORMULA_0003 0.0 255.0000 /end CHARACTERISTIC
/begin CHARACTERISTIC K_ED_AUSS_ABG_Z9.INC_VOR_EINTRAG "Filtererhoehung vorm Fehlerspeichereintrag" VALUE 0x714BE TKW_VV_VV_UB 100.0 FORMULA_0003 0.0 255.0000 /end CHARACTERISTIC
/begin CHARACTERISTIC K_ED_AUSS_ABG_Z10.INC_VOR_EINTRAG "Filtererhoehung vorm Fehlerspeichereintrag" VALUE 0x714D8 TKW_VV_VV_UB 100.0 FORMULA_0003 0.0 255.0000 /end CHARACTERISTIC
/begin CHARACTERISTIC K_ED_AUSS_ABG_MULT.INC_VOR_EINTRAG "Filtererhoehung vorm Fehlerspeichereintrag | EN: Filtererhoehung vorm Fehlerspeichereintrag" VALUE 0x71526 TKW_VV_VV_UB 100.0 FORMULA_0003 0.0 255.0000 /end CHARACTERISTIC
/begin CHARACTERISTIC K_ED_BLS_PLAU.INC_VOR_EINTRAG "Filtererhoehung vorm Fehlerspeichereintrag | EN: Fault code BLS_PLAU - debounce filter increment before fault-memory entry" VALUE 0x715F6 TKW_VV_VV_UB 100.0 FORMULA_0003 0.0 255.0000 /end CHARACTERISTIC
/begin CHARACTERISTIC K_ED_DK1_ZUST.INC_VOR_EINTRAG "Filtererhoehung vorm Fehlerspeichereintrag | EN: Fault code DK1_ZUST - debounce filter increment before fault-memory entry" VALUE 0x71678 TKW_VV_VV_UB 100.0 FORMULA_0003 0.0 255.0000 /end CHARACTERISTIC
/begin CHARACTERISTIC K_ED_AFZ_HS.INC_VOR_EINTRAG "Filtererhoehung vorm Fehlerspeichereintrag | EN: Fault code AFZ_HS - debounce filter increment before fault-memory entry" VALUE 0x716FA TKW_VV_VV_UB 100.0 FORMULA_0003 0.0 255.0000 /end CHARACTERISTIC
/begin CHARACTERISTIC K_ED_AFZ_HS_NA.INC_VOR_EINTRAG "Filtererhoehung vorm Fehlerspeichereintrag" VALUE 0x7177C TKW_VV_VV_UB 100.0 FORMULA_0003 0.0 255.0000 /end CHARACTERISTIC
/begin CHARACTERISTIC K_ED_APPL_DATA_IGN.DEC_VOR_EINTRAG "Filterverringerung vorm Fehlerspeichereintrag | EN: Fault code APPL_DATA_IGN - debounce filter decrement before fault-memory entry" VALUE 0x70D89 TKW_VV_VV_UB 100.0 FORMULA_0003 0.0 255.0000 /end CHARACTERISTIC
/begin CHARACTERISTIC K_ED_DK1_CAN.DEC_VOR_EINTRAG "Filterverringerung vorm Fehlerspeichereintrag | EN: Fault code DK1_CAN - debounce filter decrement before fault-memory entry" VALUE 0x70E59 TKW_VV_VV_UB 100.0 FORMULA_0003 0.0 255.0000 /end CHARACTERISTIC
/begin CHARACTERISTIC K_ED_DK2_CAN.DEC_VOR_EINTRAG "Filterverringerung vorm Fehlerspeichereintrag | EN: Fault code DK2_CAN - debounce filter decrement before fault-memory entry" VALUE 0x70E73 TKW_VV_VV_UB 100.0 FORMULA_0003 0.0 255.0000 /end CHARACTERISTIC
/begin CHARACTERISTIC K_ED_DK1_REGLER.DEC_VOR_EINTRAG "Filterverringerung vorm Fehlerspeichereintrag | EN: Fault code DK1_REGLER - debounce filter decrement before fault-memory entry" VALUE 0x70F5D TKW_VV_VV_UB 100.0 FORMULA_0003 0.0 255.0000 /end CHARACTERISTIC
/begin CHARACTERISTIC K_ED_DK2_REGLER.DEC_VOR_EINTRAG "Filterverringerung vorm Fehlerspeichereintrag | EN: Fault code DK2_REGLER - debounce filter decrement before fault-memory entry" VALUE 0x70F77 TKW_VV_VV_UB 100.0 FORMULA_0003 0.0 255.0000 /end CHARACTERISTIC
/begin CHARACTERISTIC K_ED_DK1_ADAPT.DEC_VOR_EINTRAG "Filterverringerung vorm Fehlerspeichereintrag | EN: Fault code DK1_ADAPT - debounce filter decrement before fault-memory entry" VALUE 0x70F91 TKW_VV_VV_UB 100.0 FORMULA_0003 0.0 255.0000 /end CHARACTERISTIC
/begin CHARACTERISTIC K_ED_DK2_ADAPT.DEC_VOR_EINTRAG "Filterverringerung vorm Fehlerspeichereintrag | EN: Fault code DK2_ADAPT - debounce filter decrement before fault-memory entry" VALUE 0x70FAB TKW_VV_VV_UB 100.0 FORMULA_0003 0.0 255.0000 /end CHARACTERISTIC
/begin CHARACTERISTIC K_ED_DK1_WDK.DEC_VOR_EINTRAG "Filterverringerung vorm Fehlerspeichereintrag | EN: Fault code DK1_WDK - debounce filter decrement before fault-memory entry" VALUE 0x71061 TKW_VV_VV_UB 100.0 FORMULA_0003 0.0 255.0000 /end CHARACTERISTIC
/begin CHARACTERISTIC K_ED_DK1_PDR.DEC_VOR_EINTRAG "Filterverringerung vorm Fehlerspeichereintrag | EN: Fault code DK1_PDR - debounce filter decrement before fault-memory entry" VALUE 0x71095 TKW_VV_VV_UB 100.0 FORMULA_0003 0.0 255.0000 /end CHARACTERISTIC
/begin CHARACTERISTIC K_ED_DK2_PDR.DEC_VOR_EINTRAG "Filterverringerung vorm Fehlerspeichereintrag | EN: Fault code DK2_PDR - debounce filter decrement before fault-memory entry" VALUE 0x710AF TKW_VV_VV_UB 100.0 FORMULA_0003 0.0 255.0000 /end CHARACTERISTIC
/begin CHARACTERISTIC K_ED_DK1_SK_ERR.DEC_VOR_EINTRAG "Filterverringerung vorm Fehlerspeichereintrag | EN: Fault code DK1_SK_ERR - debounce filter decrement before fault-memory entry" VALUE 0x710FD TKW_VV_VV_UB 100.0 FORMULA_0003 0.0 255.0000 /end CHARACTERISTIC
/begin CHARACTERISTIC K_ED_DK1_FEDERN.DEC_VOR_EINTRAG "Filterverringerung vorm Fehlerspeichereintrag | EN: Fault code DK1_FEDERN - debounce filter decrement before fault-memory entry" VALUE 0x71131 TKW_VV_VV_UB 100.0 FORMULA_0003 0.0 255.0000 /end CHARACTERISTIC
/begin CHARACTERISTIC K_ED_DK2_FEDERN.DEC_VOR_EINTRAG "Filterverringerung vorm Fehlerspeichereintrag | EN: Fault code DK2_FEDERN - debounce filter decrement before fault-memory entry" VALUE 0x7114B TKW_VV_VV_UB 100.0 FORMULA_0003 0.0 255.0000 /end CHARACTERISTIC
/begin CHARACTERISTIC K_ED_DK1_CMD.DEC_VOR_EINTRAG "Filterverringerung vorm Fehlerspeichereintrag | EN: Fault code DK1_CMD - debounce filter decrement before fault-memory entry" VALUE 0x711B3 TKW_VV_VV_UB 100.0 FORMULA_0003 0.0 255.0000 /end CHARACTERISTIC
/begin CHARACTERISTIC K_ED_DK2_CMD.DEC_VOR_EINTRAG "Filterverringerung vorm Fehlerspeichereintrag | EN: Fault code DK2_CMD - debounce filter decrement before fault-memory entry" VALUE 0x711CD TKW_VV_VV_UB 100.0 FORMULA_0003 0.0 255.0000 /end CHARACTERISTIC
/begin CHARACTERISTIC K_ED_AUSS_KAT_Z1.DEC_VOR_EINTRAG "Filterverringerung vorm Fehlerspeichereintrag | EN: Fault code AUSS_KAT_Z1 - debounce filter decrement before fault-memory entry" VALUE 0x7129D TKW_VV_VV_UB 100.0 FORMULA_0003 0.0 255.0000 /end CHARACTERISTIC
/begin CHARACTERISTIC K_ED_AUSS_KAT_Z2.DEC_VOR_EINTRAG "Filterverringerung vorm Fehlerspeichereintrag | EN: Fault code AUSS_KAT_Z2 - debounce filter decrement before fault-memory entry" VALUE 0x712B7 TKW_VV_VV_UB 100.0 FORMULA_0003 0.0 255.0000 /end CHARACTERISTIC
/begin CHARACTERISTIC K_ED_AUSS_KAT_Z3.DEC_VOR_EINTRAG "Filterverringerung vorm Fehlerspeichereintrag | EN: Fault code AUSS_KAT_Z3 - debounce filter decrement before fault-memory entry" VALUE 0x712D1 TKW_VV_VV_UB 100.0 FORMULA_0003 0.0 255.0000 /end CHARACTERISTIC
/begin CHARACTERISTIC K_ED_AUSS_KAT_Z4.DEC_VOR_EINTRAG "Filterverringerung vorm Fehlerspeichereintrag | EN: Fault code AUSS_KAT_Z4 - debounce filter decrement before fault-memory entry" VALUE 0x712EB TKW_VV_VV_UB 100.0 FORMULA_0003 0.0 255.0000 /end CHARACTERISTIC
/begin CHARACTERISTIC K_ED_AUSS_KAT_Z5.DEC_VOR_EINTRAG "Filterverringerung vorm Fehlerspeichereintrag | EN: Fault code AUSS_KAT_Z5 - debounce filter decrement before fault-memory entry" VALUE 0x71305 TKW_VV_VV_UB 100.0 FORMULA_0003 0.0 255.0000 /end CHARACTERISTIC
/begin CHARACTERISTIC K_ED_AUSS_KAT_Z6.DEC_VOR_EINTRAG "Filterverringerung vorm Fehlerspeichereintrag | EN: Fault code AUSS_KAT_Z6 - debounce filter decrement before fault-memory entry" VALUE 0x7131F TKW_VV_VV_UB 100.0 FORMULA_0003 0.0 255.0000 /end CHARACTERISTIC
/begin CHARACTERISTIC K_ED_AUSS_KAT_Z7.DEC_VOR_EINTRAG "Filterverringerung vorm Fehlerspeichereintrag | EN: Fault code AUSS_KAT_Z7 - debounce filter decrement before fault-memory entry" VALUE 0x71339 TKW_VV_VV_UB 100.0 FORMULA_0003 0.0 255.0000 /end CHARACTERISTIC
/begin CHARACTERISTIC K_ED_AUSS_KAT_Z8.DEC_VOR_EINTRAG "Filterverringerung vorm Fehlerspeichereintrag | EN: Fault code AUSS_KAT_Z8 - debounce filter decrement before fault-memory entry" VALUE 0x71353 TKW_VV_VV_UB 100.0 FORMULA_0003 0.0 255.0000 /end CHARACTERISTIC
/begin CHARACTERISTIC K_ED_AUSS_KAT_Z9.DEC_VOR_EINTRAG "Filterverringerung vorm Fehlerspeichereintrag | EN: Fault code AUSS_KAT_Z9 - debounce filter decrement before fault-memory entry" VALUE 0x7136D TKW_VV_VV_UB 100.0 FORMULA_0003 0.0 255.0000 /end CHARACTERISTIC
/begin CHARACTERISTIC K_ED_AUSS_KAT_Z10.DEC_VOR_EINTRAG "Filterverringerung vorm Fehlerspeichereintrag | EN: Fault code AUSS_KAT_Z10 - debounce filter decrement before fault-memory entry" VALUE 0x71387 TKW_VV_VV_UB 100.0 FORMULA_0003 0.0 255.0000 /end CHARACTERISTIC
/begin CHARACTERISTIC K_ED_AUSS_KAT_MULT.DEC_VOR_EINTRAG "Filterverringerung vorm Fehlerspeichereintrag | EN: Fault code AUSS_KAT_MULT - debounce filter decrement before fault-memory entry" VALUE 0x713D5 TKW_VV_VV_UB 100.0 FORMULA_0003 0.0 255.0000 /end CHARACTERISTIC
/begin CHARACTERISTIC K_ED_AUSS_ABG_Z1.DEC_VOR_EINTRAG "Filterverringerung vorm Fehlerspeichereintrag | EN: Fault code AUSS_ABG_Z1 - debounce filter decrement before fault-memory entry" VALUE 0x713EF TKW_VV_VV_UB 100.0 FORMULA_0003 0.0 255.0000 /end CHARACTERISTIC
/begin CHARACTERISTIC K_ED_AUSS_ABG_Z2.DEC_VOR_EINTRAG "Filterverringerung vorm Fehlerspeichereintrag | EN: Fault code AUSS_ABG_Z2 - debounce filter decrement before fault-memory entry" VALUE 0x71409 TKW_VV_VV_UB 100.0 FORMULA_0003 0.0 255.0000 /end CHARACTERISTIC
/begin CHARACTERISTIC K_ED_AUSS_ABG_Z3.DEC_VOR_EINTRAG "Filterverringerung vorm Fehlerspeichereintrag | EN: Fault code AUSS_ABG_Z3 - debounce filter decrement before fault-memory entry" VALUE 0x71423 TKW_VV_VV_UB 100.0 FORMULA_0003 0.0 255.0000 /end CHARACTERISTIC
/begin CHARACTERISTIC K_ED_AUSS_ABG_Z4.DEC_VOR_EINTRAG "Filterverringerung vorm Fehlerspeichereintrag | EN: Fault code AUSS_ABG_Z4 - debounce filter decrement before fault-memory entry" VALUE 0x7143D TKW_VV_VV_UB 100.0 FORMULA_0003 0.0 255.0000 /end CHARACTERISTIC
/begin CHARACTERISTIC K_ED_AUSS_ABG_Z5.DEC_VOR_EINTRAG "Filterverringerung vorm Fehlerspeichereintrag | EN: Fault code AUSS_ABG_Z5 - debounce filter decrement before fault-memory entry" VALUE 0x71457 TKW_VV_VV_UB 100.0 FORMULA_0003 0.0 255.0000 /end CHARACTERISTIC
/begin CHARACTERISTIC K_ED_AUSS_ABG_Z6.DEC_VOR_EINTRAG "Filterverringerung vorm Fehlerspeichereintrag | EN: Fault code AUSS_ABG_Z6 - debounce filter decrement before fault-memory entry" VALUE 0x71471 TKW_VV_VV_UB 100.0 FORMULA_0003 0.0 255.0000 /end CHARACTERISTIC
/begin CHARACTERISTIC K_ED_AUSS_ABG_Z7.DEC_VOR_EINTRAG "Filterverringerung vorm Fehlerspeichereintrag | EN: Fault code AUSS_ABG_Z7 - debounce filter decrement before fault-memory entry" VALUE 0x7148B TKW_VV_VV_UB 100.0 FORMULA_0003 0.0 255.0000 /end CHARACTERISTIC
/begin CHARACTERISTIC K_ED_AUSS_ABG_Z8.DEC_VOR_EINTRAG "Filterverringerung vorm Fehlerspeichereintrag | EN: Fault code AUSS_ABG_Z8 - debounce filter decrement before fault-memory entry" VALUE 0x714A5 TKW_VV_VV_UB 100.0 FORMULA_0003 0.0 255.0000 /end CHARACTERISTIC
/begin CHARACTERISTIC K_ED_AUSS_ABG_Z9.DEC_VOR_EINTRAG "Filterverringerung vorm Fehlerspeichereintrag" VALUE 0x714BF TKW_VV_VV_UB 100.0 FORMULA_0003 0.0 255.0000 /end CHARACTERISTIC
/begin CHARACTERISTIC K_ED_AUSS_ABG_Z10.DEC_VOR_EINTRAG "Filterverringerung vorm Fehlerspeichereintrag" VALUE 0x714D9 TKW_VV_VV_UB 100.0 FORMULA_0003 0.0 255.0000 /end CHARACTERISTIC
/begin CHARACTERISTIC K_ED_AUSS_ABG_MULT.DEC_VOR_EINTRAG "Filterverringerung vorm Fehlerspeichereintrag" VALUE 0x71527 TKW_VV_VV_UB 100.0 FORMULA_0003 0.0 255.0000 /end CHARACTERISTIC
/begin CHARACTERISTIC K_ED_BLS_PLAU.DEC_VOR_EINTRAG "Filterverringerung vorm Fehlerspeichereintrag | EN: Fault code BLS_PLAU - debounce filter decrement before fault-memory entry" VALUE 0x715F7 TKW_VV_VV_UB 100.0 FORMULA_0003 0.0 255.0000 /end CHARACTERISTIC
/begin CHARACTERISTIC K_ED_DK1_ZUST.DEC_VOR_EINTRAG "Filterverringerung vorm Fehlerspeichereintrag | EN: Fault code DK1_ZUST - debounce filter decrement before fault-memory entry" VALUE 0x71679 TKW_VV_VV_UB 100.0 FORMULA_0003 0.0 255.0000 /end CHARACTERISTIC
/begin CHARACTERISTIC K_ED_AFZ_HS.DEC_VOR_EINTRAG "Filterverringerung vorm Fehlerspeichereintrag | EN: Fault code AFZ_HS - debounce filter decrement before fault-memory entry" VALUE 0x716FB TKW_VV_VV_UB 100.0 FORMULA_0003 0.0 255.0000 /end CHARACTERISTIC
/begin CHARACTERISTIC K_ED_AFZ_HS_NA.DEC_VOR_EINTRAG "Filterverringerung vorm Fehlerspeichereintrag" VALUE 0x7177D TKW_VV_VV_UB 100.0 FORMULA_0003 0.0 255.0000 /end CHARACTERISTIC
/begin CHARACTERISTIC K_ED_APPL_DATA_IGN.INC_NACH_EINTRAG "Filtererhoehung nach Fehlerspeichereintrag | EN: Fault code APPL_DATA_IGN - debounce filter increment after fault-memory entry" VALUE 0x70D8A TKW_VV_VV_UB 100.0 FORMULA_0003 0.0 255.0000 /end CHARACTERISTIC
/begin CHARACTERISTIC K_ED_DK1_CAN.INC_NACH_EINTRAG "Filtererhoehung nach Fehlerspeichereintrag | EN: Fault code DK1_CAN - debounce filter increment after fault-memory entry" VALUE 0x70E5A TKW_VV_VV_UB 100.0 FORMULA_0003 0.0 255.0000 /end CHARACTERISTIC
/begin CHARACTERISTIC K_ED_DK2_CAN.INC_NACH_EINTRAG "Filtererhoehung nach Fehlerspeichereintrag | EN: Fault code DK2_CAN - debounce filter increment after fault-memory entry" VALUE 0x70E74 TKW_VV_VV_UB 100.0 FORMULA_0003 0.0 255.0000 /end CHARACTERISTIC
/begin CHARACTERISTIC K_ED_DK1_REGLER.INC_NACH_EINTRAG "Filtererhoehung nach Fehlerspeichereintrag | EN: Fault code DK1_REGLER - debounce filter increment after fault-memory entry" VALUE 0x70F5E TKW_VV_VV_UB 100.0 FORMULA_0003 0.0 255.0000 /end CHARACTERISTIC
/begin CHARACTERISTIC K_ED_DK2_REGLER.INC_NACH_EINTRAG "Filtererhoehung nach Fehlerspeichereintrag | EN: Fault code DK2_REGLER - debounce filter increment after fault-memory entry" VALUE 0x70F78 TKW_VV_VV_UB 100.0 FORMULA_0003 0.0 255.0000 /end CHARACTERISTIC
/begin CHARACTERISTIC K_ED_DK1_ADAPT.INC_NACH_EINTRAG "Filtererhoehung nach Fehlerspeichereintrag | EN: Fault code DK1_ADAPT - debounce filter increment after fault-memory entry" VALUE 0x70F92 TKW_VV_VV_UB 100.0 FORMULA_0003 0.0 255.0000 /end CHARACTERISTIC
/begin CHARACTERISTIC K_ED_DK2_ADAPT.INC_NACH_EINTRAG "Filtererhoehung nach Fehlerspeichereintrag | EN: Fault code DK2_ADAPT - debounce filter increment after fault-memory entry" VALUE 0x70FAC TKW_VV_VV_UB 100.0 FORMULA_0003 0.0 255.0000 /end CHARACTERISTIC
/begin CHARACTERISTIC K_ED_DK1_WDK.INC_NACH_EINTRAG "Filtererhoehung nach Fehlerspeichereintrag | EN: Fault code DK1_WDK - debounce filter increment after fault-memory entry" VALUE 0x71062 TKW_VV_VV_UB 100.0 FORMULA_0003 0.0 255.0000 /end CHARACTERISTIC
/begin CHARACTERISTIC K_ED_DK1_PDR.INC_NACH_EINTRAG "Filtererhoehung nach Fehlerspeichereintrag | EN: Fault code DK1_PDR - debounce filter increment after fault-memory entry" VALUE 0x71096 TKW_VV_VV_UB 100.0 FORMULA_0003 0.0 255.0000 /end CHARACTERISTIC
/begin CHARACTERISTIC K_ED_DK2_PDR.INC_NACH_EINTRAG "Filtererhoehung nach Fehlerspeichereintrag | EN: Fault code DK2_PDR - debounce filter increment after fault-memory entry" VALUE 0x710B0 TKW_VV_VV_UB 100.0 FORMULA_0003 0.0 255.0000 /end CHARACTERISTIC
/begin CHARACTERISTIC K_ED_DK1_SK_ERR.INC_NACH_EINTRAG "Filtererhoehung nach Fehlerspeichereintrag | EN: Fault code DK1_SK_ERR - debounce filter increment after fault-memory entry" VALUE 0x710FE TKW_VV_VV_UB 100.0 FORMULA_0003 0.0 255.0000 /end CHARACTERISTIC
/begin CHARACTERISTIC K_ED_DK1_FEDERN.INC_NACH_EINTRAG "Filtererhoehung nach Fehlerspeichereintrag | EN: Fault code DK1_FEDERN - debounce filter increment after fault-memory entry" VALUE 0x71132 TKW_VV_VV_UB 100.0 FORMULA_0003 0.0 255.0000 /end CHARACTERISTIC
/begin CHARACTERISTIC K_ED_DK2_FEDERN.INC_NACH_EINTRAG "Filtererhoehung nach Fehlerspeichereintrag | EN: Fault code DK2_FEDERN - debounce filter increment after fault-memory entry" VALUE 0x7114C TKW_VV_VV_UB 100.0 FORMULA_0003 0.0 255.0000 /end CHARACTERISTIC
/begin CHARACTERISTIC K_ED_DK1_CMD.INC_NACH_EINTRAG "Filtererhoehung nach Fehlerspeichereintrag | EN: Fault code DK1_CMD - debounce filter increment after fault-memory entry" VALUE 0x711B4 TKW_VV_VV_UB 100.0 FORMULA_0003 0.0 255.0000 /end CHARACTERISTIC
/begin CHARACTERISTIC K_ED_DK2_CMD.INC_NACH_EINTRAG "Filtererhoehung nach Fehlerspeichereintrag | EN: Fault code DK2_CMD - debounce filter increment after fault-memory entry" VALUE 0x711CE TKW_VV_VV_UB 100.0 FORMULA_0003 0.0 255.0000 /end CHARACTERISTIC
/begin CHARACTERISTIC K_ED_AUSS_KAT_Z1.INC_NACH_EINTRAG "Filtererhoehung nach Fehlerspeichereintrag | EN: Fault code AUSS_KAT_Z1 - debounce filter increment after fault-memory entry" VALUE 0x7129E TKW_VV_VV_UB 100.0 FORMULA_0003 0.0 255.0000 /end CHARACTERISTIC
/begin CHARACTERISTIC K_ED_AUSS_KAT_Z2.INC_NACH_EINTRAG "Filtererhoehung nach Fehlerspeichereintrag | EN: Fault code AUSS_KAT_Z2 - debounce filter increment after fault-memory entry" VALUE 0x712B8 TKW_VV_VV_UB 100.0 FORMULA_0003 0.0 255.0000 /end CHARACTERISTIC
/begin CHARACTERISTIC K_ED_AUSS_KAT_Z3.INC_NACH_EINTRAG "Filtererhoehung nach Fehlerspeichereintrag | EN: Fault code AUSS_KAT_Z3 - debounce filter increment after fault-memory entry" VALUE 0x712D2 TKW_VV_VV_UB 100.0 FORMULA_0003 0.0 255.0000 /end CHARACTERISTIC
/begin CHARACTERISTIC K_ED_AUSS_KAT_Z4.INC_NACH_EINTRAG "Filtererhoehung nach Fehlerspeichereintrag | EN: Fault code AUSS_KAT_Z4 - debounce filter increment after fault-memory entry" VALUE 0x712EC TKW_VV_VV_UB 100.0 FORMULA_0003 0.0 255.0000 /end CHARACTERISTIC
/begin CHARACTERISTIC K_ED_AUSS_KAT_Z5.INC_NACH_EINTRAG "Filtererhoehung nach Fehlerspeichereintrag | EN: Fault code AUSS_KAT_Z5 - debounce filter increment after fault-memory entry" VALUE 0x71306 TKW_VV_VV_UB 100.0 FORMULA_0003 0.0 255.0000 /end CHARACTERISTIC
/begin CHARACTERISTIC K_ED_AUSS_KAT_Z6.INC_NACH_EINTRAG "Filtererhoehung nach Fehlerspeichereintrag | EN: Fault code AUSS_KAT_Z6 - debounce filter increment after fault-memory entry" VALUE 0x71320 TKW_VV_VV_UB 100.0 FORMULA_0003 0.0 255.0000 /end CHARACTERISTIC
/begin CHARACTERISTIC K_ED_AUSS_KAT_Z7.INC_NACH_EINTRAG "Filtererhoehung nach Fehlerspeichereintrag | EN: Fault code AUSS_KAT_Z7 - debounce filter increment after fault-memory entry" VALUE 0x7133A TKW_VV_VV_UB 100.0 FORMULA_0003 0.0 255.0000 /end CHARACTERISTIC
/begin CHARACTERISTIC K_ED_AUSS_KAT_Z8.INC_NACH_EINTRAG "Filtererhoehung nach Fehlerspeichereintrag | EN: Fault code AUSS_KAT_Z8 - debounce filter increment after fault-memory entry" VALUE 0x71354 TKW_VV_VV_UB 100.0 FORMULA_0003 0.0 255.0000 /end CHARACTERISTIC
/begin CHARACTERISTIC K_ED_AUSS_KAT_Z9.INC_NACH_EINTRAG "Filtererhoehung nach Fehlerspeichereintrag | EN: Fault code AUSS_KAT_Z9 - debounce filter increment after fault-memory entry" VALUE 0x7136E TKW_VV_VV_UB 100.0 FORMULA_0003 0.0 255.0000 /end CHARACTERISTIC
/begin CHARACTERISTIC K_ED_AUSS_KAT_Z10.INC_NACH_EINTRAG "Filtererhoehung nach Fehlerspeichereintrag | EN: Fault code AUSS_KAT_Z10 - debounce filter increment after fault-memory entry" VALUE 0x71388 TKW_VV_VV_UB 100.0 FORMULA_0003 0.0 255.0000 /end CHARACTERISTIC
/begin CHARACTERISTIC K_ED_AUSS_KAT_MULT.INC_NACH_EINTRAG "Filtererhoehung nach Fehlerspeichereintrag | EN: Fault code AUSS_KAT_MULT - debounce filter increment after fault-memory entry" VALUE 0x713D6 TKW_VV_VV_UB 100.0 FORMULA_0003 0.0 255.0000 /end CHARACTERISTIC
/begin CHARACTERISTIC K_ED_AUSS_ABG_Z1.INC_NACH_EINTRAG "Filtererhoehung nach Fehlerspeichereintrag | EN: Fault code AUSS_ABG_Z1 - debounce filter increment after fault-memory entry" VALUE 0x713F0 TKW_VV_VV_UB 100.0 FORMULA_0003 0.0 255.0000 /end CHARACTERISTIC
/begin CHARACTERISTIC K_ED_AUSS_ABG_Z2.INC_NACH_EINTRAG "Filtererhoehung nach Fehlerspeichereintrag | EN: Fault code AUSS_ABG_Z2 - debounce filter increment after fault-memory entry" VALUE 0x7140A TKW_VV_VV_UB 100.0 FORMULA_0003 0.0 255.0000 /end CHARACTERISTIC
/begin CHARACTERISTIC K_ED_AUSS_ABG_Z3.INC_NACH_EINTRAG "Filtererhoehung nach Fehlerspeichereintrag | EN: Fault code AUSS_ABG_Z3 - debounce filter increment after fault-memory entry" VALUE 0x71424 TKW_VV_VV_UB 100.0 FORMULA_0003 0.0 255.0000 /end CHARACTERISTIC
/begin CHARACTERISTIC K_ED_AUSS_ABG_Z4.INC_NACH_EINTRAG "Filtererhoehung nach Fehlerspeichereintrag | EN: Fault code AUSS_ABG_Z4 - debounce filter increment after fault-memory entry" VALUE 0x7143E TKW_VV_VV_UB 100.0 FORMULA_0003 0.0 255.0000 /end CHARACTERISTIC
/begin CHARACTERISTIC K_ED_AUSS_ABG_Z5.INC_NACH_EINTRAG "Filtererhoehung nach Fehlerspeichereintrag | EN: Fault code AUSS_ABG_Z5 - debounce filter increment after fault-memory entry" VALUE 0x71458 TKW_VV_VV_UB 100.0 FORMULA_0003 0.0 255.0000 /end CHARACTERISTIC
/begin CHARACTERISTIC K_ED_AUSS_ABG_Z6.INC_NACH_EINTRAG "Filtererhoehung nach Fehlerspeichereintrag | EN: Fault code AUSS_ABG_Z6 - debounce filter increment after fault-memory entry" VALUE 0x71472 TKW_VV_VV_UB 100.0 FORMULA_0003 0.0 255.0000 /end CHARACTERISTIC
/begin CHARACTERISTIC K_ED_AUSS_ABG_Z7.INC_NACH_EINTRAG "Filtererhoehung nach Fehlerspeichereintrag | EN: Fault code AUSS_ABG_Z7 - debounce filter increment after fault-memory entry" VALUE 0x7148C TKW_VV_VV_UB 100.0 FORMULA_0003 0.0 255.0000 /end CHARACTERISTIC
/begin CHARACTERISTIC K_ED_AUSS_ABG_Z8.INC_NACH_EINTRAG "Filtererhoehung nach Fehlerspeichereintrag | EN: Fault code AUSS_ABG_Z8 - debounce filter increment after fault-memory entry" VALUE 0x714A6 TKW_VV_VV_UB 100.0 FORMULA_0003 0.0 255.0000 /end CHARACTERISTIC
/begin CHARACTERISTIC K_ED_AUSS_ABG_Z9.INC_NACH_EINTRAG "Filtererhoehung nach Fehlerspeichereintrag" VALUE 0x714C0 TKW_VV_VV_UB 100.0 FORMULA_0003 0.0 255.0000 /end CHARACTERISTIC
/begin CHARACTERISTIC K_ED_AUSS_ABG_Z10.INC_NACH_EINTRAG "Filtererhoehung nach Fehlerspeichereintrag" VALUE 0x714DA TKW_VV_VV_UB 100.0 FORMULA_0003 0.0 255.0000 /end CHARACTERISTIC
/begin CHARACTERISTIC K_ED_AUSS_ABG_MULT.INC_NACH_EINTRAG "Filtererhoehung nach Fehlerspeichereintrag" VALUE 0x71528 TKW_VV_VV_UB 100.0 FORMULA_0003 0.0 255.0000 /end CHARACTERISTIC
/begin CHARACTERISTIC K_ED_BLS_PLAU.INC_NACH_EINTRAG "Filtererhoehung nach Fehlerspeichereintrag | EN: Fault code BLS_PLAU - debounce filter increment after fault-memory entry" VALUE 0x715F8 TKW_VV_VV_UB 100.0 FORMULA_0003 0.0 255.0000 /end CHARACTERISTIC
/begin CHARACTERISTIC K_ED_DK1_ZUST.INC_NACH_EINTRAG "Filtererhoehung nach Fehlerspeichereintrag | EN: Fault code DK1_ZUST - debounce filter increment after fault-memory entry" VALUE 0x7167A TKW_VV_VV_UB 100.0 FORMULA_0003 0.0 255.0000 /end CHARACTERISTIC
/begin CHARACTERISTIC K_ED_AFZ_HS.INC_NACH_EINTRAG "Filtererhoehung nach Fehlerspeichereintrag | EN: Fault code AFZ_HS - debounce filter increment after fault-memory entry" VALUE 0x716FC TKW_VV_VV_UB 100.0 FORMULA_0003 0.0 255.0000 /end CHARACTERISTIC
/begin CHARACTERISTIC K_ED_AFZ_HS_NA.INC_NACH_EINTRAG "Filtererhoehung nach Fehlerspeichereintrag" VALUE 0x7177E TKW_VV_VV_UB 100.0 FORMULA_0003 0.0 255.0000 /end CHARACTERISTIC
/begin CHARACTERISTIC K_ED_APPL_DATA_IGN.DEC_NACH_EINTRAG "Filterverringerung nach Fehlerspeichereintrag | EN: Fault code APPL_DATA_IGN - debounce filter decrement after fault-memory entry" VALUE 0x70D8B TKW_VV_VV_UB 100.0 FORMULA_0003 0.0 255.0000 /end CHARACTERISTIC
/begin CHARACTERISTIC K_ED_DK1_CAN.DEC_NACH_EINTRAG "Filterverringerung nach Fehlerspeichereintrag | EN: Fault code DK1_CAN - debounce filter decrement after fault-memory entry" VALUE 0x70E5B TKW_VV_VV_UB 100.0 FORMULA_0003 0.0 255.0000 /end CHARACTERISTIC
/begin CHARACTERISTIC K_ED_DK2_CAN.DEC_NACH_EINTRAG "Filterverringerung nach Fehlerspeichereintrag | EN: Fault code DK2_CAN - debounce filter decrement after fault-memory entry" VALUE 0x70E75 TKW_VV_VV_UB 100.0 FORMULA_0003 0.0 255.0000 /end CHARACTERISTIC
/begin CHARACTERISTIC K_ED_DK1_REGLER.DEC_NACH_EINTRAG "Filterverringerung nach Fehlerspeichereintrag | EN: Fault code DK1_REGLER - debounce filter decrement after fault-memory entry" VALUE 0x70F5F TKW_VV_VV_UB 100.0 FORMULA_0003 0.0 255.0000 /end CHARACTERISTIC
/begin CHARACTERISTIC K_ED_DK2_REGLER.DEC_NACH_EINTRAG "Filterverringerung nach Fehlerspeichereintrag | EN: Fault code DK2_REGLER - debounce filter decrement after fault-memory entry" VALUE 0x70F79 TKW_VV_VV_UB 100.0 FORMULA_0003 0.0 255.0000 /end CHARACTERISTIC
/begin CHARACTERISTIC K_ED_DK1_ADAPT.DEC_NACH_EINTRAG "Filterverringerung nach Fehlerspeichereintrag | EN: Fault code DK1_ADAPT - debounce filter decrement after fault-memory entry" VALUE 0x70F93 TKW_VV_VV_UB 100.0 FORMULA_0003 0.0 255.0000 /end CHARACTERISTIC
/begin CHARACTERISTIC K_ED_DK2_ADAPT.DEC_NACH_EINTRAG "Filterverringerung nach Fehlerspeichereintrag | EN: Fault code DK2_ADAPT - debounce filter decrement after fault-memory entry" VALUE 0x70FAD TKW_VV_VV_UB 100.0 FORMULA_0003 0.0 255.0000 /end CHARACTERISTIC
/begin CHARACTERISTIC K_ED_DK1_WDK.DEC_NACH_EINTRAG "Filterverringerung nach Fehlerspeichereintrag | EN: Fault code DK1_WDK - debounce filter decrement after fault-memory entry" VALUE 0x71063 TKW_VV_VV_UB 100.0 FORMULA_0003 0.0 255.0000 /end CHARACTERISTIC
/begin CHARACTERISTIC K_ED_DK1_PDR.DEC_NACH_EINTRAG "Filterverringerung nach Fehlerspeichereintrag | EN: Fault code DK1_PDR - debounce filter decrement after fault-memory entry" VALUE 0x71097 TKW_VV_VV_UB 100.0 FORMULA_0003 0.0 255.0000 /end CHARACTERISTIC
/begin CHARACTERISTIC K_ED_DK2_PDR.DEC_NACH_EINTRAG "Filterverringerung nach Fehlerspeichereintrag | EN: Fault code DK2_PDR - debounce filter decrement after fault-memory entry" VALUE 0x710B1 TKW_VV_VV_UB 100.0 FORMULA_0003 0.0 255.0000 /end CHARACTERISTIC
/begin CHARACTERISTIC K_ED_DK1_SK_ERR.DEC_NACH_EINTRAG "Filterverringerung nach Fehlerspeichereintrag | EN: Fault code DK1_SK_ERR - debounce filter decrement after fault-memory entry" VALUE 0x710FF TKW_VV_VV_UB 100.0 FORMULA_0003 0.0 255.0000 /end CHARACTERISTIC
/begin CHARACTERISTIC K_ED_DK1_FEDERN.DEC_NACH_EINTRAG "Filterverringerung nach Fehlerspeichereintrag | EN: Fault code DK1_FEDERN - debounce filter decrement after fault-memory entry" VALUE 0x71133 TKW_VV_VV_UB 100.0 FORMULA_0003 0.0 255.0000 /end CHARACTERISTIC
/begin CHARACTERISTIC K_ED_DK2_FEDERN.DEC_NACH_EINTRAG "Filterverringerung nach Fehlerspeichereintrag | EN: Fault code DK2_FEDERN - debounce filter decrement after fault-memory entry" VALUE 0x7114D TKW_VV_VV_UB 100.0 FORMULA_0003 0.0 255.0000 /end CHARACTERISTIC
/begin CHARACTERISTIC K_ED_DK1_CMD.DEC_NACH_EINTRAG "Filterverringerung nach Fehlerspeichereintrag | EN: Fault code DK1_CMD - debounce filter decrement after fault-memory entry" VALUE 0x711B5 TKW_VV_VV_UB 100.0 FORMULA_0003 0.0 255.0000 /end CHARACTERISTIC
/begin CHARACTERISTIC K_ED_DK2_CMD.DEC_NACH_EINTRAG "Filterverringerung nach Fehlerspeichereintrag | EN: Fault code DK2_CMD - debounce filter decrement after fault-memory entry" VALUE 0x711CF TKW_VV_VV_UB 100.0 FORMULA_0003 0.0 255.0000 /end CHARACTERISTIC
/begin CHARACTERISTIC K_ED_AUSS_KAT_Z1.DEC_NACH_EINTRAG "Filterverringerung nach Fehlerspeichereintrag | EN: Fault code AUSS_KAT_Z1 - debounce filter decrement after fault-memory entry" VALUE 0x7129F TKW_VV_VV_UB 100.0 FORMULA_0003 0.0 255.0000 /end CHARACTERISTIC
/begin CHARACTERISTIC K_ED_AUSS_KAT_Z2.DEC_NACH_EINTRAG "Filterverringerung nach Fehlerspeichereintrag | EN: Fault code AUSS_KAT_Z2 - debounce filter decrement after fault-memory entry" VALUE 0x712B9 TKW_VV_VV_UB 100.0 FORMULA_0003 0.0 255.0000 /end CHARACTERISTIC
/begin CHARACTERISTIC K_ED_AUSS_KAT_Z3.DEC_NACH_EINTRAG "Filterverringerung nach Fehlerspeichereintrag | EN: Fault code AUSS_KAT_Z3 - debounce filter decrement after fault-memory entry" VALUE 0x712D3 TKW_VV_VV_UB 100.0 FORMULA_0003 0.0 255.0000 /end CHARACTERISTIC
/begin CHARACTERISTIC K_ED_AUSS_KAT_Z4.DEC_NACH_EINTRAG "Filterverringerung nach Fehlerspeichereintrag | EN: Fault code AUSS_KAT_Z4 - debounce filter decrement after fault-memory entry" VALUE 0x712ED TKW_VV_VV_UB 100.0 FORMULA_0003 0.0 255.0000 /end CHARACTERISTIC
/begin CHARACTERISTIC K_ED_AUSS_KAT_Z5.DEC_NACH_EINTRAG "Filterverringerung nach Fehlerspeichereintrag | EN: Fault code AUSS_KAT_Z5 - debounce filter decrement after fault-memory entry" VALUE 0x71307 TKW_VV_VV_UB 100.0 FORMULA_0003 0.0 255.0000 /end CHARACTERISTIC
/begin CHARACTERISTIC K_ED_AUSS_KAT_Z6.DEC_NACH_EINTRAG "Filterverringerung nach Fehlerspeichereintrag | EN: Fault code AUSS_KAT_Z6 - debounce filter decrement after fault-memory entry" VALUE 0x71321 TKW_VV_VV_UB 100.0 FORMULA_0003 0.0 255.0000 /end CHARACTERISTIC
/begin CHARACTERISTIC K_ED_AUSS_KAT_Z7.DEC_NACH_EINTRAG "Filterverringerung nach Fehlerspeichereintrag | EN: Fault code AUSS_KAT_Z7 - debounce filter decrement after fault-memory entry" VALUE 0x7133B TKW_VV_VV_UB 100.0 FORMULA_0003 0.0 255.0000 /end CHARACTERISTIC
/begin CHARACTERISTIC K_ED_AUSS_KAT_Z8.DEC_NACH_EINTRAG "Filterverringerung nach Fehlerspeichereintrag | EN: Fault code AUSS_KAT_Z8 - debounce filter decrement after fault-memory entry" VALUE 0x71355 TKW_VV_VV_UB 100.0 FORMULA_0003 0.0 255.0000 /end CHARACTERISTIC
/begin CHARACTERISTIC K_ED_AUSS_KAT_Z9.DEC_NACH_EINTRAG "Filterverringerung nach Fehlerspeichereintrag | EN: Fault code AUSS_KAT_Z9 - debounce filter decrement after fault-memory entry" VALUE 0x7136F TKW_VV_VV_UB 100.0 FORMULA_0003 0.0 255.0000 /end CHARACTERISTIC
/begin CHARACTERISTIC K_ED_AUSS_KAT_Z10.DEC_NACH_EINTRAG "Filterverringerung nach Fehlerspeichereintrag | EN: Fault code AUSS_KAT_Z10 - debounce filter decrement after fault-memory entry" VALUE 0x71389 TKW_VV_VV_UB 100.0 FORMULA_0003 0.0 255.0000 /end CHARACTERISTIC
/begin CHARACTERISTIC K_ED_AUSS_KAT_MULT.DEC_NACH_EINTRAG "Filterverringerung nach Fehlerspeichereintrag | EN: Fault code AUSS_KAT_MULT - debounce filter decrement after fault-memory entry" VALUE 0x713D7 TKW_VV_VV_UB 100.0 FORMULA_0003 0.0 255.0000 /end CHARACTERISTIC
/begin CHARACTERISTIC K_ED_AUSS_ABG_Z1.DEC_NACH_EINTRAG "Filterverringerung nach Fehlerspeichereintrag | EN: Fault code AUSS_ABG_Z1 - debounce filter decrement after fault-memory entry" VALUE 0x713F1 TKW_VV_VV_UB 100.0 FORMULA_0003 0.0 255.0000 /end CHARACTERISTIC
/begin CHARACTERISTIC K_ED_AUSS_ABG_Z2.DEC_NACH_EINTRAG "Filterverringerung nach Fehlerspeichereintrag | EN: Fault code AUSS_ABG_Z2 - debounce filter decrement after fault-memory entry" VALUE 0x7140B TKW_VV_VV_UB 100.0 FORMULA_0003 0.0 255.0000 /end CHARACTERISTIC
/begin CHARACTERISTIC K_ED_AUSS_ABG_Z3.DEC_NACH_EINTRAG "Filterverringerung nach Fehlerspeichereintrag | EN: Fault code AUSS_ABG_Z3 - debounce filter decrement after fault-memory entry" VALUE 0x71425 TKW_VV_VV_UB 100.0 FORMULA_0003 0.0 255.0000 /end CHARACTERISTIC
/begin CHARACTERISTIC K_ED_AUSS_ABG_Z4.DEC_NACH_EINTRAG "Filterverringerung nach Fehlerspeichereintrag | EN: Fault code AUSS_ABG_Z4 - debounce filter decrement after fault-memory entry" VALUE 0x7143F TKW_VV_VV_UB 100.0 FORMULA_0003 0.0 255.0000 /end CHARACTERISTIC
/begin CHARACTERISTIC K_ED_AUSS_ABG_Z5.DEC_NACH_EINTRAG "Filterverringerung nach Fehlerspeichereintrag | EN: Fault code AUSS_ABG_Z5 - debounce filter decrement after fault-memory entry" VALUE 0x71459 TKW_VV_VV_UB 100.0 FORMULA_0003 0.0 255.0000 /end CHARACTERISTIC
/begin CHARACTERISTIC K_ED_AUSS_ABG_Z6.DEC_NACH_EINTRAG "Filterverringerung nach Fehlerspeichereintrag | EN: Fault code AUSS_ABG_Z6 - debounce filter decrement after fault-memory entry" VALUE 0x71473 TKW_VV_VV_UB 100.0 FORMULA_0003 0.0 255.0000 /end CHARACTERISTIC
/begin CHARACTERISTIC K_ED_AUSS_ABG_Z7.DEC_NACH_EINTRAG "Filterverringerung nach Fehlerspeichereintrag | EN: Fault code AUSS_ABG_Z7 - debounce filter decrement after fault-memory entry" VALUE 0x7148D TKW_VV_VV_UB 100.0 FORMULA_0003 0.0 255.0000 /end CHARACTERISTIC
/begin CHARACTERISTIC K_ED_AUSS_ABG_Z8.DEC_NACH_EINTRAG "Filterverringerung nach Fehlerspeichereintrag | EN: Fault code AUSS_ABG_Z8 - debounce filter decrement after fault-memory entry" VALUE 0x714A7 TKW_VV_VV_UB 100.0 FORMULA_0003 0.0 255.0000 /end CHARACTERISTIC
/begin CHARACTERISTIC K_ED_AUSS_ABG_Z9.DEC_NACH_EINTRAG "Filterverringerung nach Fehlerspeichereintrag" VALUE 0x714C1 TKW_VV_VV_UB 100.0 FORMULA_0003 0.0 255.0000 /end CHARACTERISTIC
/begin CHARACTERISTIC K_ED_AUSS_ABG_Z10.DEC_NACH_EINTRAG "Filterverringerung nach Fehlerspeichereintrag" VALUE 0x714DB TKW_VV_VV_UB 100.0 FORMULA_0003 0.0 255.0000 /end CHARACTERISTIC
/begin CHARACTERISTIC K_ED_AUSS_ABG_MULT.DEC_NACH_EINTRAG "Filterverringerung nach Fehlerspeichereintrag" VALUE 0x71529 TKW_VV_VV_UB 100.0 FORMULA_0003 0.0 255.0000 /end CHARACTERISTIC
/begin CHARACTERISTIC K_ED_BLS_PLAU.DEC_NACH_EINTRAG "Filterverringerung nach Fehlerspeichereintrag | EN: Fault code BLS_PLAU - debounce filter decrement after fault-memory entry" VALUE 0x715F9 TKW_VV_VV_UB 100.0 FORMULA_0003 0.0 255.0000 /end CHARACTERISTIC
/begin CHARACTERISTIC K_ED_DK1_ZUST.DEC_NACH_EINTRAG "Filterverringerung nach Fehlerspeichereintrag | EN: Fault code DK1_ZUST - debounce filter decrement after fault-memory entry" VALUE 0x7167B TKW_VV_VV_UB 100.0 FORMULA_0003 0.0 255.0000 /end CHARACTERISTIC
/begin CHARACTERISTIC K_ED_AFZ_HS.DEC_NACH_EINTRAG "Filterverringerung nach Fehlerspeichereintrag | EN: Fault code AFZ_HS - debounce filter decrement after fault-memory entry" VALUE 0x716FD TKW_VV_VV_UB 100.0 FORMULA_0003 0.0 255.0000 /end CHARACTERISTIC
/begin CHARACTERISTIC K_ED_AFZ_HS_NA.DEC_NACH_EINTRAG "Filterverringerung nach Fehlerspeichereintrag" VALUE 0x7177F TKW_VV_VV_UB 100.0 FORMULA_0003 0.0 255.0000 /end CHARACTERISTIC
/begin CHARACTERISTIC K_ED_APPL_DATA_IGN.KLASSENINDEX "Auswahl der Fehlerklasse | EN: Fault code APPL_DATA_IGN - fault class selection (lamp / warning behaviour)" VALUE 0x70D8C TKW_VV_VV_UB 100.0 FORMULA_0003 0.0 8.0000 /end CHARACTERISTIC
/begin CHARACTERISTIC K_ED_DK1_CAN.KLASSENINDEX "Auswahl der Fehlerklasse | EN: Fault code DK1_CAN - fault class selection (lamp / warning behaviour)" VALUE 0x70E5C TKW_VV_VV_UB 100.0 FORMULA_0003 0.0 8.0000 /end CHARACTERISTIC
/begin CHARACTERISTIC K_ED_DK2_CAN.KLASSENINDEX "Auswahl der Fehlerklasse | EN: Fault code DK2_CAN - fault class selection (lamp / warning behaviour)" VALUE 0x70E76 TKW_VV_VV_UB 100.0 FORMULA_0003 0.0 8.0000 /end CHARACTERISTIC
/begin CHARACTERISTIC K_ED_DK1_REGLER.KLASSENINDEX "Auswahl der Fehlerklasse | EN: Fault code DK1_REGLER - fault class selection (lamp / warning behaviour)" VALUE 0x70F60 TKW_VV_VV_UB 100.0 FORMULA_0003 0.0 8.0000 /end CHARACTERISTIC
/begin CHARACTERISTIC K_ED_DK1_ADAPT.KLASSENINDEX "Auswahl der Fehlerklasse | EN: Fault code DK1_ADAPT - fault class selection (lamp / warning behaviour)" VALUE 0x70F94 TKW_VV_VV_UB 100.0 FORMULA_0003 0.0 8.0000 /end CHARACTERISTIC
/begin CHARACTERISTIC K_ED_DK2_ADAPT.KLASSENINDEX "Auswahl der Fehlerklasse | EN: Fault code DK2_ADAPT - fault class selection (lamp / warning behaviour)" VALUE 0x70FAE TKW_VV_VV_UB 100.0 FORMULA_0003 0.0 8.0000 /end CHARACTERISTIC
/begin CHARACTERISTIC K_ED_DK1_WDK.KLASSENINDEX "Auswahl der Fehlerklasse | EN: Fault code DK1_WDK - fault class selection (lamp / warning behaviour)" VALUE 0x71064 TKW_VV_VV_UB 100.0 FORMULA_0003 0.0 8.0000 /end CHARACTERISTIC
/begin CHARACTERISTIC K_ED_DK1_PDR.KLASSENINDEX "Auswahl der Fehlerklasse | EN: Fault code DK1_PDR - fault class selection (lamp / warning behaviour)" VALUE 0x71098 TKW_VV_VV_UB 100.0 FORMULA_0003 0.0 8.0000 /end CHARACTERISTIC
/begin CHARACTERISTIC K_ED_DK2_PDR.KLASSENINDEX "Auswahl der Fehlerklasse | EN: Fault code DK2_PDR - fault class selection (lamp / warning behaviour)" VALUE 0x710B2 TKW_VV_VV_UB 100.0 FORMULA_0003 0.0 8.0000 /end CHARACTERISTIC
/begin CHARACTERISTIC K_ED_DK1_SK_ERR.KLASSENINDEX "Auswahl der Fehlerklasse | EN: Fault code DK1_SK_ERR - fault class selection (lamp / warning behaviour)" VALUE 0x71100 TKW_VV_VV_UB 100.0 FORMULA_0003 0.0 8.0000 /end CHARACTERISTIC
/begin CHARACTERISTIC K_ED_DK1_FEDERN.KLASSENINDEX "Auswahl der Fehlerklasse | EN: Fault code DK1_FEDERN - fault class selection (lamp / warning behaviour)" VALUE 0x71134 TKW_VV_VV_UB 100.0 FORMULA_0003 0.0 8.0000 /end CHARACTERISTIC
/begin CHARACTERISTIC K_ED_DK2_FEDERN.KLASSENINDEX "Auswahl der Fehlerklasse | EN: Fault code DK2_FEDERN - fault class selection (lamp / warning behaviour)" VALUE 0x7114E TKW_VV_VV_UB 100.0 FORMULA_0003 0.0 8.0000 /end CHARACTERISTIC
/begin CHARACTERISTIC K_ED_DK1_CMD.KLASSENINDEX "Auswahl der Fehlerklasse | EN: Fault code DK1_CMD - fault class selection (lamp / warning behaviour)" VALUE 0x711B6 TKW_VV_VV_UB 100.0 FORMULA_0003 0.0 8.0000 /end CHARACTERISTIC
/begin CHARACTERISTIC K_ED_DK2_CMD.KLASSENINDEX "Auswahl der Fehlerklasse | EN: Fault code DK2_CMD - fault class selection (lamp / warning behaviour)" VALUE 0x711D0 TKW_VV_VV_UB 100.0 FORMULA_0003 0.0 8.0000 /end CHARACTERISTIC
/begin CHARACTERISTIC K_ED_AUSS_KAT_Z1.KLASSENINDEX "Auswahl der Fehlerklasse | EN: Fault code AUSS_KAT_Z1 - fault class selection (lamp / warning behaviour)" VALUE 0x712A0 TKW_VV_VV_UB 100.0 FORMULA_0003 0.0 8.0000 /end CHARACTERISTIC
/begin CHARACTERISTIC K_ED_AUSS_KAT_Z2.KLASSENINDEX "Auswahl der Fehlerklasse | EN: Fault code AUSS_KAT_Z2 - fault class selection (lamp / warning behaviour)" VALUE 0x712BA TKW_VV_VV_UB 100.0 FORMULA_0003 0.0 8.0000 /end CHARACTERISTIC
/begin CHARACTERISTIC K_ED_AUSS_KAT_Z3.KLASSENINDEX "Auswahl der Fehlerklasse | EN: Fault code AUSS_KAT_Z3 - fault class selection (lamp / warning behaviour)" VALUE 0x712D4 TKW_VV_VV_UB 100.0 FORMULA_0003 0.0 8.0000 /end CHARACTERISTIC
/begin CHARACTERISTIC K_ED_AUSS_KAT_Z4.KLASSENINDEX "Auswahl der Fehlerklasse | EN: Fault code AUSS_KAT_Z4 - fault class selection (lamp / warning behaviour)" VALUE 0x712EE TKW_VV_VV_UB 100.0 FORMULA_0003 0.0 8.0000 /end CHARACTERISTIC
/begin CHARACTERISTIC K_ED_AUSS_KAT_Z5.KLASSENINDEX "Auswahl der Fehlerklasse | EN: Fault code AUSS_KAT_Z5 - fault class selection (lamp / warning behaviour)" VALUE 0x71308 TKW_VV_VV_UB 100.0 FORMULA_0003 0.0 8.0000 /end CHARACTERISTIC
/begin CHARACTERISTIC K_ED_AUSS_KAT_Z6.KLASSENINDEX "Auswahl der Fehlerklasse | EN: Fault code AUSS_KAT_Z6 - fault class selection (lamp / warning behaviour)" VALUE 0x71322 TKW_VV_VV_UB 100.0 FORMULA_0003 0.0 8.0000 /end CHARACTERISTIC
/begin CHARACTERISTIC K_ED_AUSS_KAT_Z7.KLASSENINDEX "Auswahl der Fehlerklasse | EN: Fault code AUSS_KAT_Z7 - fault class selection (lamp / warning behaviour)" VALUE 0x7133C TKW_VV_VV_UB 100.0 FORMULA_0003 0.0 8.0000 /end CHARACTERISTIC
/begin CHARACTERISTIC K_ED_AUSS_KAT_Z8.KLASSENINDEX "Auswahl der Fehlerklasse | EN: Fault code AUSS_KAT_Z8 - fault class selection (lamp / warning behaviour)" VALUE 0x71356 TKW_VV_VV_UB 100.0 FORMULA_0003 0.0 8.0000 /end CHARACTERISTIC
/begin CHARACTERISTIC K_ED_AUSS_KAT_Z9.KLASSENINDEX "Auswahl der Fehlerklasse | EN: Fault code AUSS_KAT_Z9 - fault class selection (lamp / warning behaviour)" VALUE 0x71370 TKW_VV_VV_UB 100.0 FORMULA_0003 0.0 8.0000 /end CHARACTERISTIC
/begin CHARACTERISTIC K_ED_AUSS_KAT_Z10.KLASSENINDEX "Auswahl der Fehlerklasse | EN: Fault code AUSS_KAT_Z10 - fault class selection (lamp / warning behaviour)" VALUE 0x7138A TKW_VV_VV_UB 100.0 FORMULA_0003 0.0 8.0000 /end CHARACTERISTIC
/begin CHARACTERISTIC K_ED_AUSS_KAT_MULT.KLASSENINDEX "Auswahl der Fehlerklasse | EN: Fault code AUSS_KAT_MULT - fault class selection (lamp / warning behaviour)" VALUE 0x713D8 TKW_VV_VV_UB 100.0 FORMULA_0003 0.0 8.0000 /end CHARACTERISTIC
/begin CHARACTERISTIC K_ED_AUSS_ABG_Z1.KLASSENINDEX "Auswahl der Fehlerklasse | EN: Fault code AUSS_ABG_Z1 - fault class selection (lamp / warning behaviour)" VALUE 0x713F2 TKW_VV_VV_UB 100.0 FORMULA_0003 0.0 8.0000 /end CHARACTERISTIC
/begin CHARACTERISTIC K_ED_AUSS_ABG_Z2.KLASSENINDEX "Auswahl der Fehlerklasse | EN: Fault code AUSS_ABG_Z2 - fault class selection (lamp / warning behaviour)" VALUE 0x7140C TKW_VV_VV_UB 100.0 FORMULA_0003 0.0 8.0000 /end CHARACTERISTIC
/begin CHARACTERISTIC K_ED_AUSS_ABG_Z3.KLASSENINDEX "Auswahl der Fehlerklasse | EN: Fault code AUSS_ABG_Z3 - fault class selection (lamp / warning behaviour)" VALUE 0x71426 TKW_VV_VV_UB 100.0 FORMULA_0003 0.0 8.0000 /end CHARACTERISTIC
/begin CHARACTERISTIC K_ED_AUSS_ABG_Z4.KLASSENINDEX "Auswahl der Fehlerklasse | EN: Fault code AUSS_ABG_Z4 - fault class selection (lamp / warning behaviour)" VALUE 0x71440 TKW_VV_VV_UB 100.0 FORMULA_0003 0.0 8.0000 /end CHARACTERISTIC
/begin CHARACTERISTIC K_ED_AUSS_ABG_Z5.KLASSENINDEX "Auswahl der Fehlerklasse | EN: Fault code AUSS_ABG_Z5 - fault class selection (lamp / warning behaviour)" VALUE 0x7145A TKW_VV_VV_UB 100.0 FORMULA_0003 0.0 8.0000 /end CHARACTERISTIC
/begin CHARACTERISTIC K_ED_AUSS_ABG_Z6.KLASSENINDEX "Auswahl der Fehlerklasse | EN: Fault code AUSS_ABG_Z6 - fault class selection (lamp / warning behaviour)" VALUE 0x71474 TKW_VV_VV_UB 100.0 FORMULA_0003 0.0 8.0000 /end CHARACTERISTIC
/begin CHARACTERISTIC K_ED_AUSS_ABG_Z7.KLASSENINDEX "Auswahl der Fehlerklasse | EN: Fault code AUSS_ABG_Z7 - fault class selection (lamp / warning behaviour)" VALUE 0x7148E TKW_VV_VV_UB 100.0 FORMULA_0003 0.0 8.0000 /end CHARACTERISTIC
/begin CHARACTERISTIC K_ED_AUSS_ABG_Z8.KLASSENINDEX "Auswahl der Fehlerklasse | EN: Fault code AUSS_ABG_Z8 - fault class selection (lamp / warning behaviour)" VALUE 0x714A8 TKW_VV_VV_UB 100.0 FORMULA_0003 0.0 8.0000 /end CHARACTERISTIC
/begin CHARACTERISTIC K_ED_AUSS_ABG_Z9.KLASSENINDEX "Auswahl der Fehlerklasse" VALUE 0x714C2 TKW_VV_VV_UB 100.0 FORMULA_0003 0.0 8.0000 /end CHARACTERISTIC
/begin CHARACTERISTIC K_ED_AUSS_ABG_Z10.KLASSENINDEX "Auswahl der Fehlerklasse" VALUE 0x714DC TKW_VV_VV_UB 100.0 FORMULA_0003 0.0 8.0000 /end CHARACTERISTIC
/begin CHARACTERISTIC K_ED_AUSS_ABG_MULT.KLASSENINDEX "Auswahl der Fehlerklasse" VALUE 0x7152A TKW_VV_VV_UB 100.0 FORMULA_0003 0.0 8.0000 /end CHARACTERISTIC
/begin CHARACTERISTIC K_ED_BLS_PLAU.KLASSENINDEX "Auswahl der Fehlerklasse | EN: Fault code BLS_PLAU - fault class selection (lamp / warning behaviour)" VALUE 0x715FA TKW_VV_VV_UB 100.0 FORMULA_0003 0.0 8.0000 /end CHARACTERISTIC
/begin CHARACTERISTIC K_ED_DK1_ZUST.KLASSENINDEX "Auswahl der Fehlerklasse | EN: Fault code DK1_ZUST - fault class selection (lamp / warning behaviour)" VALUE 0x7167C TKW_VV_VV_UB 100.0 FORMULA_0003 0.0 8.0000 /end CHARACTERISTIC
/begin CHARACTERISTIC K_ED_AFZ_HS.KLASSENINDEX "Auswahl der Fehlerklasse | EN: Fault code AFZ_HS - fault class selection (lamp / warning behaviour)" VALUE 0x716FE TKW_VV_VV_UB 100.0 FORMULA_0003 0.0 8.0000 /end CHARACTERISTIC
/begin CHARACTERISTIC K_ED_AFZ_HS_NA.KLASSENINDEX "Auswahl der Fehlerklasse" VALUE 0x71780 TKW_VV_VV_UB 100.0 FORMULA_0003 0.0 8.0000 /end CHARACTERISTIC
/begin FUNCTION Eigendiagnose ""
 /begin DEF_CHARACTERISTIC K_ED_AFZ_HS.DEC_NACH_EINTRAG K_ED_AFZ_HS.DEC_VOR_EINTRAG K_ED_AFZ_HS.FEHLERSCHWELLE K_ED_AFZ_HS.INC_NACH_EINTRAG K_ED_AFZ_HS.INC_VOR_EINTRAG K_ED_AFZ_HS.KLASSENINDEX K_ED_AFZ_HS.OK_SCHWELLE K_ED_AFZ_HS.P_CODE_OPENLOAD K_ED_AFZ_HS.P_CODE_SH_TO_GND K_ED_AFZ_HS.P_CODE_SH_TO_UB K_ED_AFZ_HS.P_CODE_UNPLAUSIBEL K_ED_AFZ_HS_NA.DEC_NACH_EINTRAG K_ED_AFZ_HS_NA.DEC_VOR_EINTRAG K_ED_AFZ_HS_NA.FEHLERSCHWELLE K_ED_AFZ_HS_NA.INC_NACH_EINTRAG K_ED_AFZ_HS_NA.INC_VOR_EINTRAG K_ED_AFZ_HS_NA.KLASSENINDEX K_ED_AFZ_HS_NA.OK_SCHWELLE K_ED_AFZ_HS_NA.P_CODE_OPENLOAD K_ED_AFZ_HS_NA.P_CODE_SH_TO_GND K_ED_AFZ_HS_NA.P_CODE_SH_TO_UB K_ED_AFZ_HS_NA.P_CODE_UNPLAUSIBEL K_ED_APPL_DATA_IGN.DEC_NACH_EINTRAG K_ED_APPL_DATA_IGN.DEC_VOR_EINTRAG K_ED_APPL_DATA_IGN.FEHLERSCHWELLE K_ED_APPL_DATA_IGN.INC_NACH_EINTRAG K_ED_APPL_DATA_IGN.INC_VOR_EINTRAG K_ED_APPL_DATA_IGN.KLASSENINDEX K_ED_APPL_DATA_IGN.OK_SCHWELLE K_ED_APPL_DATA_IGN.P_CODE_OPENLOAD K_ED_APPL_DATA_IGN.P_CODE_SH_TO_GND K_ED_APPL_DATA_IGN.P_CODE_SH_TO_UB K_ED_APPL_DATA_IGN.P_CODE_UNPLAUSIBEL K_ED_AUSS_ABG_MULT.DEC_NACH_EINTRAG K_ED_AUSS_ABG_MULT.DEC_VOR_EINTRAG K_ED_AUSS_ABG_MULT.FEHLERSCHWELLE K_ED_AUSS_ABG_MULT.INC_NACH_EINTRAG K_ED_AUSS_ABG_MULT.INC_VOR_EINTRAG K_ED_AUSS_ABG_MULT.KLASSENINDEX K_ED_AUSS_ABG_MULT.OK_SCHWELLE K_ED_AUSS_ABG_MULT.P_CODE_OPENLOAD K_ED_AUSS_ABG_MULT.P_CODE_SH_TO_GND K_ED_AUSS_ABG_MULT.P_CODE_SH_TO_UB K_ED_AUSS_ABG_MULT.P_CODE_UNPLAUSIBEL K_ED_AUSS_ABG_Z1.DEC_NACH_EINTRAG K_ED_AUSS_ABG_Z1.DEC_VOR_EINTRAG K_ED_AUSS_ABG_Z1.FEHLERSCHWELLE K_ED_AUSS_ABG_Z1.INC_NACH_EINTRAG K_ED_AUSS_ABG_Z1.INC_VOR_EINTRAG K_ED_AUSS_ABG_Z1.KLASSENINDEX K_ED_AUSS_ABG_Z1.OK_SCHWELLE K_ED_AUSS_ABG_Z1.P_CODE_OPENLOAD K_ED_AUSS_ABG_Z1.P_CODE_SH_TO_GND K_ED_AUSS_ABG_Z1.P_CODE_SH_TO_UB K_ED_AUSS_ABG_Z1.P_CODE_UNPLAUSIBEL K_ED_AUSS_ABG_Z10.DEC_NACH_EINTRAG K_ED_AUSS_ABG_Z10.DEC_VOR_EINTRAG K_ED_AUSS_ABG_Z10.FEHLERSCHWELLE K_ED_AUSS_ABG_Z10.INC_NACH_EINTRAG K_ED_AUSS_ABG_Z10.INC_VOR_EINTRAG K_ED_AUSS_ABG_Z10.KLASSENINDEX K_ED_AUSS_ABG_Z10.OK_SCHWELLE K_ED_AUSS_ABG_Z10.P_CODE_OPENLOAD K_ED_AUSS_ABG_Z10.P_CODE_SH_TO_GND K_ED_AUSS_ABG_Z10.P_CODE_SH_TO_UB K_ED_AUSS_ABG_Z10.P_CODE_UNPLAUSIBEL K_ED_AUSS_ABG_Z2.DEC_NACH_EINTRAG K_ED_AUSS_ABG_Z2.DEC_VOR_EINTRAG K_ED_AUSS_ABG_Z2.FEHLERSCHWELLE K_ED_AUSS_ABG_Z2.INC_NACH_EINTRAG K_ED_AUSS_ABG_Z2.INC_VOR_EINTRAG K_ED_AUSS_ABG_Z2.KLASSENINDEX K_ED_AUSS_ABG_Z2.OK_SCHWELLE K_ED_AUSS_ABG_Z2.P_CODE_OPENLOAD K_ED_AUSS_ABG_Z2.P_CODE_SH_TO_GND K_ED_AUSS_ABG_Z2.P_CODE_SH_TO_UB K_ED_AUSS_ABG_Z2.P_CODE_UNPLAUSIBEL K_ED_AUSS_ABG_Z3.DEC_NACH_EINTRAG K_ED_AUSS_ABG_Z3.DEC_VOR_EINTRAG K_ED_AUSS_ABG_Z3.FEHLERSCHWELLE K_ED_AUSS_ABG_Z3.INC_NACH_EINTRAG K_ED_AUSS_ABG_Z3.INC_VOR_EINTRAG K_ED_AUSS_ABG_Z3.KLASSENINDEX K_ED_AUSS_ABG_Z3.OK_SCHWELLE K_ED_AUSS_ABG_Z3.P_CODE_OPENLOAD K_ED_AUSS_ABG_Z3.P_CODE_SH_TO_GND K_ED_AUSS_ABG_Z3.P_CODE_SH_TO_UB K_ED_AUSS_ABG_Z3.P_CODE_UNPLAUSIBEL K_ED_AUSS_ABG_Z4.DEC_NACH_EINTRAG K_ED_AUSS_ABG_Z4.DEC_VOR_EINTRAG K_ED_AUSS_ABG_Z4.FEHLERSCHWELLE K_ED_AUSS_ABG_Z4.INC_NACH_EINTRAG K_ED_AUSS_ABG_Z4.INC_VOR_EINTRAG K_ED_AUSS_ABG_Z4.KLASSENINDEX K_ED_AUSS_ABG_Z4.OK_SCHWELLE K_ED_AUSS_ABG_Z4.P_CODE_OPENLOAD K_ED_AUSS_ABG_Z4.P_CODE_SH_TO_GND K_ED_AUSS_ABG_Z4.P_CODE_SH_TO_UB K_ED_AUSS_ABG_Z4.P_CODE_UNPLAUSIBEL K_ED_AUSS_ABG_Z5.DEC_NACH_EINTRAG K_ED_AUSS_ABG_Z5.DEC_VOR_EINTRAG K_ED_AUSS_ABG_Z5.FEHLERSCHWELLE K_ED_AUSS_ABG_Z5.INC_NACH_EINTRAG K_ED_AUSS_ABG_Z5.INC_VOR_EINTRAG K_ED_AUSS_ABG_Z5.KLASSENINDEX K_ED_AUSS_ABG_Z5.OK_SCHWELLE K_ED_AUSS_ABG_Z5.P_CODE_OPENLOAD K_ED_AUSS_ABG_Z5.P_CODE_SH_TO_GND K_ED_AUSS_ABG_Z5.P_CODE_SH_TO_UB K_ED_AUSS_ABG_Z5.P_CODE_UNPLAUSIBEL K_ED_AUSS_ABG_Z6.DEC_NACH_EINTRAG K_ED_AUSS_ABG_Z6.DEC_VOR_EINTRAG K_ED_AUSS_ABG_Z6.FEHLERSCHWELLE K_ED_AUSS_ABG_Z6.INC_NACH_EINTRAG K_ED_AUSS_ABG_Z6.INC_VOR_EINTRAG K_ED_AUSS_ABG_Z6.KLASSENINDEX K_ED_AUSS_ABG_Z6.OK_SCHWELLE K_ED_AUSS_ABG_Z6.P_CODE_OPENLOAD K_ED_AUSS_ABG_Z6.P_CODE_SH_TO_GND K_ED_AUSS_ABG_Z6.P_CODE_SH_TO_UB K_ED_AUSS_ABG_Z6.P_CODE_UNPLAUSIBEL K_ED_AUSS_ABG_Z7.DEC_NACH_EINTRAG K_ED_AUSS_ABG_Z7.DEC_VOR_EINTRAG K_ED_AUSS_ABG_Z7.FEHLERSCHWELLE K_ED_AUSS_ABG_Z7.INC_NACH_EINTRAG K_ED_AUSS_ABG_Z7.INC_VOR_EINTRAG K_ED_AUSS_ABG_Z7.KLASSENINDEX K_ED_AUSS_ABG_Z7.OK_SCHWELLE K_ED_AUSS_ABG_Z7.P_CODE_OPENLOAD K_ED_AUSS_ABG_Z7.P_CODE_SH_TO_GND K_ED_AUSS_ABG_Z7.P_CODE_SH_TO_UB K_ED_AUSS_ABG_Z7.P_CODE_UNPLAUSIBEL K_ED_AUSS_ABG_Z8.DEC_NACH_EINTRAG K_ED_AUSS_ABG_Z8.DEC_VOR_EINTRAG K_ED_AUSS_ABG_Z8.FEHLERSCHWELLE K_ED_AUSS_ABG_Z8.INC_NACH_EINTRAG K_ED_AUSS_ABG_Z8.INC_VOR_EINTRAG K_ED_AUSS_ABG_Z8.KLASSENINDEX K_ED_AUSS_ABG_Z8.OK_SCHWELLE K_ED_AUSS_ABG_Z8.P_CODE_OPENLOAD K_ED_AUSS_ABG_Z8.P_CODE_SH_TO_GND K_ED_AUSS_ABG_Z8.P_CODE_SH_TO_UB K_ED_AUSS_ABG_Z8.P_CODE_UNPLAUSIBEL K_ED_AUSS_ABG_Z9.DEC_NACH_EINTRAG K_ED_AUSS_ABG_Z9.DEC_VOR_EINTRAG K_ED_AUSS_ABG_Z9.FEHLERSCHWELLE K_ED_AUSS_ABG_Z9.INC_NACH_EINTRAG K_ED_AUSS_ABG_Z9.INC_VOR_EINTRAG K_ED_AUSS_ABG_Z9.KLASSENINDEX K_ED_AUSS_ABG_Z9.OK_SCHWELLE K_ED_AUSS_ABG_Z9.P_CODE_OPENLOAD K_ED_AUSS_ABG_Z9.P_CODE_SH_TO_GND K_ED_AUSS_ABG_Z9.P_CODE_SH_TO_UB K_ED_AUSS_ABG_Z9.P_CODE_UNPLAUSIBEL K_ED_AUSS_KAT_MULT.DEC_NACH_EINTRAG K_ED_AUSS_KAT_MULT.DEC_VOR_EINTRAG K_ED_AUSS_KAT_MULT.FEHLERSCHWELLE K_ED_AUSS_KAT_MULT.INC_NACH_EINTRAG K_ED_AUSS_KAT_MULT.INC_VOR_EINTRAG K_ED_AUSS_KAT_MULT.KLASSENINDEX K_ED_AUSS_KAT_MULT.OK_SCHWELLE K_ED_AUSS_KAT_MULT.P_CODE_OPENLOAD K_ED_AUSS_KAT_MULT.P_CODE_SH_TO_GND K_ED_AUSS_KAT_MULT.P_CODE_SH_TO_UB K_ED_AUSS_KAT_MULT.P_CODE_UNPLAUSIBEL K_ED_AUSS_KAT_Z1.DEC_NACH_EINTRAG K_ED_AUSS_KAT_Z1.DEC_VOR_EINTRAG K_ED_AUSS_KAT_Z1.FEHLERSCHWELLE K_ED_AUSS_KAT_Z1.INC_NACH_EINTRAG K_ED_AUSS_KAT_Z1.INC_VOR_EINTRAG K_ED_AUSS_KAT_Z1.KLASSENINDEX K_ED_AUSS_KAT_Z1.OK_SCHWELLE K_ED_AUSS_KAT_Z1.P_CODE_OPENLOAD K_ED_AUSS_KAT_Z1.P_CODE_SH_TO_GND K_ED_AUSS_KAT_Z1.P_CODE_SH_TO_UB K_ED_AUSS_KAT_Z1.P_CODE_UNPLAUSIBEL K_ED_AUSS_KAT_Z10.DEC_NACH_EINTRAG K_ED_AUSS_KAT_Z10.DEC_VOR_EINTRAG K_ED_AUSS_KAT_Z10.FEHLERSCHWELLE K_ED_AUSS_KAT_Z10.INC_NACH_EINTRAG K_ED_AUSS_KAT_Z10.INC_VOR_EINTRAG K_ED_AUSS_KAT_Z10.KLASSENINDEX K_ED_AUSS_KAT_Z10.OK_SCHWELLE K_ED_AUSS_KAT_Z10.P_CODE_OPENLOAD K_ED_AUSS_KAT_Z10.P_CODE_SH_TO_GND K_ED_AUSS_KAT_Z10.P_CODE_SH_TO_UB K_ED_AUSS_KAT_Z10.P_CODE_UNPLAUSIBEL K_ED_AUSS_KAT_Z2.DEC_NACH_EINTRAG K_ED_AUSS_KAT_Z2.DEC_VOR_EINTRAG K_ED_AUSS_KAT_Z2.FEHLERSCHWELLE K_ED_AUSS_KAT_Z2.INC_NACH_EINTRAG K_ED_AUSS_KAT_Z2.INC_VOR_EINTRAG K_ED_AUSS_KAT_Z2.KLASSENINDEX K_ED_AUSS_KAT_Z2.OK_SCHWELLE K_ED_AUSS_KAT_Z2.P_CODE_OPENLOAD K_ED_AUSS_KAT_Z2.P_CODE_SH_TO_GND K_ED_AUSS_KAT_Z2.P_CODE_SH_TO_UB K_ED_AUSS_KAT_Z2.P_CODE_UNPLAUSIBEL K_ED_AUSS_KAT_Z3.DEC_NACH_EINTRAG K_ED_AUSS_KAT_Z3.DEC_VOR_EINTRAG K_ED_AUSS_KAT_Z3.FEHLERSCHWELLE K_ED_AUSS_KAT_Z3.INC_NACH_EINTRAG K_ED_AUSS_KAT_Z3.INC_VOR_EINTRAG K_ED_AUSS_KAT_Z3.KLASSENINDEX K_ED_AUSS_KAT_Z3.OK_SCHWELLE K_ED_AUSS_KAT_Z3.P_CODE_OPENLOAD K_ED_AUSS_KAT_Z3.P_CODE_SH_TO_GND K_ED_AUSS_KAT_Z3.P_CODE_SH_TO_UB K_ED_AUSS_KAT_Z3.P_CODE_UNPLAUSIBEL K_ED_AUSS_KAT_Z4.DEC_NACH_EINTRAG K_ED_AUSS_KAT_Z4.DEC_VOR_EINTRAG K_ED_AUSS_KAT_Z4.FEHLERSCHWELLE K_ED_AUSS_KAT_Z4.INC_NACH_EINTRAG K_ED_AUSS_KAT_Z4.INC_VOR_EINTRAG K_ED_AUSS_KAT_Z4.KLASSENINDEX K_ED_AUSS_KAT_Z4.OK_SCHWELLE K_ED_AUSS_KAT_Z4.P_CODE_OPENLOAD K_ED_AUSS_KAT_Z4.P_CODE_SH_TO_GND K_ED_AUSS_KAT_Z4.P_CODE_SH_TO_UB K_ED_AUSS_KAT_Z4.P_CODE_UNPLAUSIBEL K_ED_AUSS_KAT_Z5.DEC_NACH_EINTRAG K_ED_AUSS_KAT_Z5.DEC_VOR_EINTRAG K_ED_AUSS_KAT_Z5.FEHLERSCHWELLE K_ED_AUSS_KAT_Z5.INC_NACH_EINTRAG K_ED_AUSS_KAT_Z5.INC_VOR_EINTRAG K_ED_AUSS_KAT_Z5.KLASSENINDEX K_ED_AUSS_KAT_Z5.OK_SCHWELLE K_ED_AUSS_KAT_Z5.P_CODE_OPENLOAD K_ED_AUSS_KAT_Z5.P_CODE_SH_TO_GND K_ED_AUSS_KAT_Z5.P_CODE_SH_TO_UB K_ED_AUSS_KAT_Z5.P_CODE_UNPLAUSIBEL K_ED_AUSS_KAT_Z6.DEC_NACH_EINTRAG K_ED_AUSS_KAT_Z6.DEC_VOR_EINTRAG K_ED_AUSS_KAT_Z6.FEHLERSCHWELLE K_ED_AUSS_KAT_Z6.INC_NACH_EINTRAG K_ED_AUSS_KAT_Z6.INC_VOR_EINTRAG K_ED_AUSS_KAT_Z6.KLASSENINDEX K_ED_AUSS_KAT_Z6.OK_SCHWELLE K_ED_AUSS_KAT_Z6.P_CODE_OPENLOAD K_ED_AUSS_KAT_Z6.P_CODE_SH_TO_GND K_ED_AUSS_KAT_Z6.P_CODE_SH_TO_UB K_ED_AUSS_KAT_Z6.P_CODE_UNPLAUSIBEL K_ED_AUSS_KAT_Z7.DEC_NACH_EINTRAG K_ED_AUSS_KAT_Z7.DEC_VOR_EINTRAG K_ED_AUSS_KAT_Z7.FEHLERSCHWELLE K_ED_AUSS_KAT_Z7.INC_NACH_EINTRAG K_ED_AUSS_KAT_Z7.INC_VOR_EINTRAG K_ED_AUSS_KAT_Z7.KLASSENINDEX K_ED_AUSS_KAT_Z7.OK_SCHWELLE K_ED_AUSS_KAT_Z7.P_CODE_OPENLOAD K_ED_AUSS_KAT_Z7.P_CODE_SH_TO_GND K_ED_AUSS_KAT_Z7.P_CODE_SH_TO_UB K_ED_AUSS_KAT_Z7.P_CODE_UNPLAUSIBEL K_ED_AUSS_KAT_Z8.DEC_NACH_EINTRAG K_ED_AUSS_KAT_Z8.DEC_VOR_EINTRAG K_ED_AUSS_KAT_Z8.FEHLERSCHWELLE K_ED_AUSS_KAT_Z8.INC_NACH_EINTRAG K_ED_AUSS_KAT_Z8.INC_VOR_EINTRAG K_ED_AUSS_KAT_Z8.KLASSENINDEX K_ED_AUSS_KAT_Z8.OK_SCHWELLE K_ED_AUSS_KAT_Z8.P_CODE_OPENLOAD K_ED_AUSS_KAT_Z8.P_CODE_SH_TO_GND K_ED_AUSS_KAT_Z8.P_CODE_SH_TO_UB K_ED_AUSS_KAT_Z8.P_CODE_UNPLAUSIBEL K_ED_AUSS_KAT_Z9.DEC_NACH_EINTRAG K_ED_AUSS_KAT_Z9.DEC_VOR_EINTRAG K_ED_AUSS_KAT_Z9.FEHLERSCHWELLE K_ED_AUSS_KAT_Z9.INC_NACH_EINTRAG K_ED_AUSS_KAT_Z9.INC_VOR_EINTRAG K_ED_AUSS_KAT_Z9.KLASSENINDEX K_ED_AUSS_KAT_Z9.OK_SCHWELLE K_ED_AUSS_KAT_Z9.P_CODE_OPENLOAD K_ED_AUSS_KAT_Z9.P_CODE_SH_TO_GND K_ED_AUSS_KAT_Z9.P_CODE_SH_TO_UB K_ED_AUSS_KAT_Z9.P_CODE_UNPLAUSIBEL K_ED_BLS_PLAU.DEC_NACH_EINTRAG K_ED_BLS_PLAU.DEC_VOR_EINTRAG K_ED_BLS_PLAU.FEHLERSCHWELLE K_ED_BLS_PLAU.INC_NACH_EINTRAG K_ED_BLS_PLAU.INC_VOR_EINTRAG K_ED_BLS_PLAU.KLASSENINDEX K_ED_BLS_PLAU.OK_SCHWELLE K_ED_BLS_PLAU.P_CODE_OPENLOAD K_ED_BLS_PLAU.P_CODE_SH_TO_GND K_ED_BLS_PLAU.P_CODE_SH_TO_UB K_ED_BLS_PLAU.P_CODE_UNPLAUSIBEL K_ED_DK1_ADAPT.DEC_NACH_EINTRAG K_ED_DK1_ADAPT.DEC_VOR_EINTRAG K_ED_DK1_ADAPT.FEHLERSCHWELLE K_ED_DK1_ADAPT.INC_NACH_EINTRAG K_ED_DK1_ADAPT.INC_VOR_EINTRAG K_ED_DK1_ADAPT.KLASSENINDEX K_ED_DK1_ADAPT.OK_SCHWELLE K_ED_DK1_ADAPT.P_CODE_OPENLOAD K_ED_DK1_ADAPT.P_CODE_SH_TO_GND K_ED_DK1_ADAPT.P_CODE_SH_TO_UB K_ED_DK1_ADAPT.P_CODE_UNPLAUSIBEL K_ED_DK1_CAN.DEC_NACH_EINTRAG K_ED_DK1_CAN.DEC_VOR_EINTRAG K_ED_DK1_CAN.FEHLERSCHWELLE K_ED_DK1_CAN.INC_NACH_EINTRAG K_ED_DK1_CAN.INC_VOR_EINTRAG K_ED_DK1_CAN.KLASSENINDEX K_ED_DK1_CAN.OK_SCHWELLE K_ED_DK1_CAN.P_CODE_OPENLOAD K_ED_DK1_CAN.P_CODE_SH_TO_GND K_ED_DK1_CAN.P_CODE_SH_TO_UB K_ED_DK1_CAN.P_CODE_UNPLAUSIBEL K_ED_DK1_CMD.DEC_NACH_EINTRAG K_ED_DK1_CMD.DEC_VOR_EINTRAG K_ED_DK1_CMD.FEHLERSCHWELLE K_ED_DK1_CMD.INC_NACH_EINTRAG K_ED_DK1_CMD.INC_VOR_EINTRAG K_ED_DK1_CMD.KLASSENINDEX K_ED_DK1_CMD.OK_SCHWELLE K_ED_DK1_CMD.P_CODE_OPENLOAD K_ED_DK1_CMD.P_CODE_SH_TO_GND K_ED_DK1_CMD.P_CODE_SH_TO_UB K_ED_DK1_CMD.P_CODE_UNPLAUSIBEL K_ED_DK1_FEDERN.DEC_NACH_EINTRAG K_ED_DK1_FEDERN.DEC_VOR_EINTRAG K_ED_DK1_FEDERN.FEHLERSCHWELLE K_ED_DK1_FEDERN.INC_NACH_EINTRAG K_ED_DK1_FEDERN.INC_VOR_EINTRAG K_ED_DK1_FEDERN.KLASSENINDEX K_ED_DK1_FEDERN.OK_SCHWELLE K_ED_DK1_FEDERN.P_CODE_OPENLOAD K_ED_DK1_FEDERN.P_CODE_SH_TO_GND K_ED_DK1_FEDERN.P_CODE_SH_TO_UB K_ED_DK1_FEDERN.P_CODE_UNPLAUSIBEL K_ED_DK1_PDR.DEC_NACH_EINTRAG K_ED_DK1_PDR.DEC_VOR_EINTRAG K_ED_DK1_PDR.FEHLERSCHWELLE K_ED_DK1_PDR.INC_NACH_EINTRAG K_ED_DK1_PDR.INC_VOR_EINTRAG K_ED_DK1_PDR.KLASSENINDEX K_ED_DK1_PDR.OK_SCHWELLE K_ED_DK1_PDR.P_CODE_OPENLOAD K_ED_DK1_PDR.P_CODE_SH_TO_GND K_ED_DK1_PDR.P_CODE_SH_TO_UB K_ED_DK1_PDR.P_CODE_UNPLAUSIBEL K_ED_DK1_REGLER.DEC_NACH_EINTRAG K_ED_DK1_REGLER.DEC_VOR_EINTRAG K_ED_DK1_REGLER.FEHLERSCHWELLE K_ED_DK1_REGLER.INC_NACH_EINTRAG K_ED_DK1_REGLER.INC_VOR_EINTRAG K_ED_DK1_REGLER.KLASSENINDEX K_ED_DK1_REGLER.OK_SCHWELLE K_ED_DK1_REGLER.P_CODE_OPENLOAD K_ED_DK1_REGLER.P_CODE_SH_TO_GND K_ED_DK1_REGLER.P_CODE_SH_TO_UB K_ED_DK1_REGLER.P_CODE_UNPLAUSIBEL K_ED_DK1_SK_ERR.DEC_NACH_EINTRAG K_ED_DK1_SK_ERR.DEC_VOR_EINTRAG K_ED_DK1_SK_ERR.FEHLERSCHWELLE K_ED_DK1_SK_ERR.INC_NACH_EINTRAG K_ED_DK1_SK_ERR.INC_VOR_EINTRAG K_ED_DK1_SK_ERR.KLASSENINDEX K_ED_DK1_SK_ERR.OK_SCHWELLE K_ED_DK1_SK_ERR.P_CODE_OPENLOAD K_ED_DK1_SK_ERR.P_CODE_SH_TO_GND K_ED_DK1_SK_ERR.P_CODE_SH_TO_UB K_ED_DK1_SK_ERR.P_CODE_UNPLAUSIBEL K_ED_DK1_WDK.DEC_NACH_EINTRAG K_ED_DK1_WDK.DEC_VOR_EINTRAG K_ED_DK1_WDK.FEHLERSCHWELLE K_ED_DK1_WDK.INC_NACH_EINTRAG K_ED_DK1_WDK.INC_VOR_EINTRAG K_ED_DK1_WDK.KLASSENINDEX K_ED_DK1_WDK.OK_SCHWELLE K_ED_DK1_WDK.P_CODE_OPENLOAD K_ED_DK1_WDK.P_CODE_SH_TO_GND K_ED_DK1_WDK.P_CODE_SH_TO_UB K_ED_DK1_WDK.P_CODE_UNPLAUSIBEL K_ED_DK1_ZUST.DEC_NACH_EINTRAG K_ED_DK1_ZUST.DEC_VOR_EINTRAG K_ED_DK1_ZUST.FEHLERSCHWELLE K_ED_DK1_ZUST.INC_NACH_EINTRAG K_ED_DK1_ZUST.INC_VOR_EINTRAG K_ED_DK1_ZUST.KLASSENINDEX K_ED_DK1_ZUST.OK_SCHWELLE K_ED_DK1_ZUST.P_CODE_OPENLOAD K_ED_DK1_ZUST.P_CODE_SH_TO_GND K_ED_DK1_ZUST.P_CODE_SH_TO_UB K_ED_DK1_ZUST.P_CODE_UNPLAUSIBEL K_ED_DK2_ADAPT.DEC_NACH_EINTRAG K_ED_DK2_ADAPT.DEC_VOR_EINTRAG K_ED_DK2_ADAPT.FEHLERSCHWELLE K_ED_DK2_ADAPT.INC_NACH_EINTRAG K_ED_DK2_ADAPT.INC_VOR_EINTRAG K_ED_DK2_ADAPT.KLASSENINDEX K_ED_DK2_ADAPT.OK_SCHWELLE K_ED_DK2_ADAPT.P_CODE_OPENLOAD K_ED_DK2_ADAPT.P_CODE_SH_TO_GND K_ED_DK2_ADAPT.P_CODE_SH_TO_UB K_ED_DK2_ADAPT.P_CODE_UNPLAUSIBEL K_ED_DK2_CAN.DEC_NACH_EINTRAG K_ED_DK2_CAN.DEC_VOR_EINTRAG K_ED_DK2_CAN.FEHLERSCHWELLE K_ED_DK2_CAN.INC_NACH_EINTRAG K_ED_DK2_CAN.INC_VOR_EINTRAG K_ED_DK2_CAN.KLASSENINDEX K_ED_DK2_CAN.OK_SCHWELLE K_ED_DK2_CAN.P_CODE_OPENLOAD K_ED_DK2_CAN.P_CODE_SH_TO_GND K_ED_DK2_CAN.P_CODE_SH_TO_UB K_ED_DK2_CAN.P_CODE_UNPLAUSIBEL K_ED_DK2_CMD.DEC_NACH_EINTRAG K_ED_DK2_CMD.DEC_VOR_EINTRAG K_ED_DK2_CMD.FEHLERSCHWELLE K_ED_DK2_CMD.INC_NACH_EINTRAG K_ED_DK2_CMD.INC_VOR_EINTRAG K_ED_DK2_CMD.KLASSENINDEX K_ED_DK2_CMD.OK_SCHWELLE K_ED_DK2_CMD.P_CODE_OPENLOAD K_ED_DK2_CMD.P_CODE_SH_TO_GND K_ED_DK2_CMD.P_CODE_SH_TO_UB K_ED_DK2_CMD.P_CODE_UNPLAUSIBEL K_ED_DK2_FEDERN.DEC_NACH_EINTRAG K_ED_DK2_FEDERN.DEC_VOR_EINTRAG K_ED_DK2_FEDERN.FEHLERSCHWELLE K_ED_DK2_FEDERN.INC_NACH_EINTRAG K_ED_DK2_FEDERN.INC_VOR_EINTRAG K_ED_DK2_FEDERN.KLASSENINDEX K_ED_DK2_FEDERN.OK_SCHWELLE K_ED_DK2_FEDERN.P_CODE_OPENLOAD K_ED_DK2_FEDERN.P_CODE_SH_TO_GND K_ED_DK2_FEDERN.P_CODE_SH_TO_UB K_ED_DK2_FEDERN.P_CODE_UNPLAUSIBEL K_ED_DK2_PDR.DEC_NACH_EINTRAG K_ED_DK2_PDR.DEC_VOR_EINTRAG K_ED_DK2_PDR.FEHLERSCHWELLE K_ED_DK2_PDR.INC_NACH_EINTRAG K_ED_DK2_PDR.INC_VOR_EINTRAG K_ED_DK2_PDR.KLASSENINDEX K_ED_DK2_PDR.OK_SCHWELLE K_ED_DK2_PDR.P_CODE_OPENLOAD K_ED_DK2_PDR.P_CODE_SH_TO_GND K_ED_DK2_PDR.P_CODE_SH_TO_UB K_ED_DK2_PDR.P_CODE_UNPLAUSIBEL K_ED_DK2_REGLER.DEC_NACH_EINTRAG K_ED_DK2_REGLER.DEC_VOR_EINTRAG K_ED_DK2_REGLER.FEHLERSCHWELLE K_ED_DK2_REGLER.INC_NACH_EINTRAG K_ED_DK2_REGLER.INC_VOR_EINTRAG /end DEF_CHARACTERISTIC
 /begin OUT_MEASUREMENT ed_fsp_9of20_.uw_satz_2of3_.uw_wert_nv_1of4_ ed_fsp_9of20_.uw_satz_2of3_.uw_wert_nv_2of4_ ed_fsp_9of20_.uw_satz_2of3_.uw_wert_nv_3of4_ ed_fsp_9of20_.uw_satz_2of3_.uw_wert_nv_4of4_ ed_fsp_9of20_.uw_satz_3of3_.uw_km_stand_nv ed_fsp_9of20_.uw_satz_3of3_.uw_wert_nv_1of4_ ed_fsp_9of20_.uw_satz_3of3_.uw_wert_nv_2of4_ ed_fsp_9of20_.uw_satz_3of3_.uw_wert_nv_3of4_ ed_fsp_9of20_.uw_satz_3of3_.uw_wert_nv_4of4_ ed_loeschen ed_mil_bmw_ign ed_mil_bmw_inj ed_mil_dme_ign ed_mil_dme_inj ed_mil_off_km_stand_nv ed_mil_on_km_stand_nv ed_mil_predrive_ign ed_mil_predrive_inj ed_mil_smg_ign ed_mil_st_ign ed_mil_st_inj ed_mil_zyl_off_ign ed_rbm_afz_hs.denominator_nv ed_rbm_afz_hs.numerator_nv ed_rbm_afz_hs_na.denominator_nv ed_rbm_afz_hs_na.numerator_nv ed_rbm_appl_data_ign.denominator_nv ed_rbm_appl_data_ign.numerator_nv ed_rbm_auss_abg_mult.denominator_nv ed_rbm_auss_abg_mult.numerator_nv ed_rbm_auss_abg_z1.denominator_nv ed_rbm_auss_abg_z1.numerator_nv ed_rbm_auss_abg_z10.denominator_nv ed_rbm_auss_abg_z10.numerator_nv ed_rbm_auss_abg_z2.denominator_nv ed_rbm_auss_abg_z2.numerator_nv ed_rbm_auss_abg_z3.denominator_nv ed_rbm_auss_abg_z3.numerator_nv ed_rbm_auss_abg_z4.denominator_nv ed_rbm_auss_abg_z4.numerator_nv ed_rbm_auss_abg_z5.denominator_nv ed_rbm_auss_abg_z5.numerator_nv ed_rbm_auss_abg_z6.denominator_nv ed_rbm_auss_abg_z6.numerator_nv ed_rbm_auss_abg_z7.denominator_nv ed_rbm_auss_abg_z7.numerator_nv ed_rbm_auss_abg_z8.denominator_nv ed_rbm_auss_abg_z8.numerator_nv ed_rbm_auss_abg_z9.denominator_nv ed_rbm_auss_abg_z9.numerator_nv ed_rbm_auss_kat_mult.denominator_nv ed_rbm_auss_kat_mult.numerator_nv ed_rbm_auss_kat_z1.denominator_nv ed_rbm_auss_kat_z1.numerator_nv ed_rbm_auss_kat_z10.denominator_nv ed_rbm_auss_kat_z10.numerator_nv ed_rbm_auss_kat_z2.denominator_nv ed_rbm_auss_kat_z2.numerator_nv ed_rbm_auss_kat_z3.denominator_nv ed_rbm_auss_kat_z3.numerator_nv ed_rbm_auss_kat_z4.denominator_nv ed_rbm_auss_kat_z4.numerator_nv ed_rbm_auss_kat_z5.denominator_nv ed_rbm_auss_kat_z5.numerator_nv ed_rbm_auss_kat_z6.denominator_nv ed_rbm_auss_kat_z6.numerator_nv ed_rbm_auss_kat_z7.denominator_nv ed_rbm_auss_kat_z7.numerator_nv ed_rbm_auss_kat_z8.denominator_nv ed_rbm_auss_kat_z8.numerator_nv ed_rbm_auss_kat_z9.denominator_nv ed_rbm_auss_kat_z9.numerator_nv ed_rbm_bls_plau.denominator_nv ed_rbm_bls_plau.numerator_nv ed_rbm_denominator_nv ed_rbm_dk1_adapt.denominator_nv ed_rbm_dk1_adapt.numerator_nv ed_rbm_dk1_can.denominator_nv ed_rbm_dk1_can.numerator_nv ed_rbm_dk1_cmd.denominator_nv ed_rbm_dk1_cmd.numerator_nv ed_rbm_dk1_federn.denominator_nv ed_rbm_dk1_federn.numerator_nv ed_rbm_dk1_pdr.denominator_nv ed_rbm_dk1_pdr.numerator_nv ed_rbm_dk1_regler.denominator_nv ed_rbm_dk1_regler.numerator_nv ed_rbm_dk1_sk_err.denominator_nv ed_rbm_dk1_sk_err.numerator_nv ed_rbm_dk1_wdk.denominator_nv ed_rbm_dk1_wdk.numerator_nv ed_rbm_dk1_zust.denominator_nv ed_rbm_dk1_zust.numerator_nv ed_rbm_dk2_adapt.denominator_nv ed_rbm_dk2_adapt.numerator_nv ed_rbm_dk2_can.denominator_nv ed_rbm_dk2_can.numerator_nv ed_rbm_dk2_cmd.denominator_nv ed_rbm_dk2_cmd.numerator_nv ed_rbm_dk2_federn.denominator_nv ed_rbm_dk2_federn.numerator_nv ed_rbm_dk2_pdr.denominator_nv ed_rbm_dk2_pdr.numerator_nv ed_rbm_dk2_regler.denominator_nv ed_rbm_dk2_regler.numerator_nv ed_rbm_dk2_sk_err.denominator_nv ed_rbm_dk2_sk_err.numerator_nv ed_rbm_dk2_wdk.denominator_nv ed_rbm_dk2_wdk.numerator_nv ed_rbm_dk2_zust.denominator_nv ed_rbm_dk2_zust.numerator_nv ed_rbm_dk_init.denominator_nv ed_rbm_dk_init.numerator_nv ed_rbm_dsc_eingr.denominator_nv ed_rbm_dsc_eingr.numerator_nv ed_rbm_e2_ign.denominator_nv ed_rbm_e2_ign.numerator_nv ed_rbm_ec_busoff.denominator_nv ed_rbm_ec_busoff.numerator_nv ed_rbm_fgr_abwurf.denominator_nv ed_rbm_fgr_abwurf.numerator_nv ed_rbm_index_110_ign.denominator_nv ed_rbm_index_110_ign.numerator_nv ed_rbm_index_111_ign.denominator_nv ed_rbm_index_111_ign.numerator_nv ed_rbm_index_112_ign.denominator_nv ed_rbm_index_112_ign.numerator_nv ed_rbm_index_113_ign.denominator_nv ed_rbm_index_113_ign.numerator_nv ed_rbm_index_114_ign.denominator_nv ed_rbm_index_114_ign.numerator_nv ed_rbm_index_115_ign.denominator_nv ed_rbm_index_115_ign.numerator_nv ed_rbm_index_116_ign.denominator_nv ed_rbm_index_116_ign.numerator_nv ed_rbm_index_117_ign.denominator_nv ed_rbm_index_117_ign.numerator_nv ed_rbm_index_118_ign.denominator_nv ed_rbm_index_118_ign.numerator_nv ed_rbm_index_119_ign.denominator_nv ed_rbm_index_119_ign.numerator_nv ed_rbm_index_120_ign.denominator_nv ed_rbm_index_120_ign.numerator_nv ed_rbm_index_121_ign.denominator_nv ed_rbm_index_121_ign.numerator_nv ed_rbm_index_122_ign.denominator_nv ed_rbm_index_122_ign.numerator_nv ed_rbm_index_123_ign.denominator_nv ed_rbm_index_123_ign.numerator_nv ed_rbm_index_124_ign.denominator_nv ed_rbm_index_124_ign.numerator_nv ed_rbm_index_125_ign.denominator_nv ed_rbm_index_125_ign.numerator_nv ed_rbm_index_126_ign.denominator_nv ed_rbm_index_126_ign.numerator_nv ed_rbm_index_127_ign.denominator_nv ed_rbm_index_127_ign.numerator_nv ed_rbm_index_88_ign.denominator_nv ed_rbm_index_88_ign.numerator_nv ed_rbm_index_89_ign.denominator_nv ed_rbm_index_89_ign.numerator_nv ed_rbm_ion_sat_b1.denominator_nv ed_rbm_ion_sat_b1.numerator_nv ed_rbm_ion_sat_b2.denominator_nv ed_rbm_ion_sat_b2.numerator_nv ed_rbm_ion_sig_b1.denominator_nv ed_rbm_ion_sig_b1.numerator_nv ed_rbm_ion_sig_b2.denominator_nv ed_rbm_ion_sig_b2.numerator_nv ed_rbm_ionspg_b1.denominator_nv ed_rbm_ionspg_b1.numerator_nv ed_rbm_ionspg_b2.denominator_nv ed_rbm_ionspg_b2.numerator_nv ed_rbm_ionverst_b1.denominator_nv ed_rbm_ionverst_b1.numerator_nv ed_rbm_ionverst_b2.denominator_nv ed_rbm_ionverst_b2.numerator_nv ed_rbm_llr_diag.denominator_nv ed_rbm_llr_diag.numerator_nv ed_rbm_llr_diag_css.denominator_nv ed_rbm_llr_diag_css.numerator_nv ed_rbm_lls1_can.denominator_nv ed_rbm_lls1_can.numerator_nv ed_rbm_lls1_cmd.denominator_nv ed_rbm_lls1_cmd.numerator_nv ed_rbm_lls1_regler.denominator_nv ed_rbm_lls1_regler.numerator_nv ed_rbm_lls1_sk.denominator_nv ed_rbm_lls1_sk.numerator_nv ed_rbm_lls2_can.denominator_nv ed_rbm_lls2_can.numerator_nv ed_rbm_lls2_cmd.denominator_nv ed_rbm_lls2_cmd.numerator_nv ed_rbm_lls2_regler.denominator_nv ed_rbm_lls2_regler.numerator_nv ed_rbm_lls2_sk.denominator_nv ed_rbm_lls2_sk.numerator_nv ed_rbm_lls_init.denominator_nv ed_rbm_lls_init.numerator_nv ed_rbm_md_sk_err.denominator_nv ed_rbm_md_sk_err.numerator_nv ed_rbm_n_getr_ein_hs.denominator_nv ed_rbm_n_getr_ein_hs.numerator_nv ed_rbm_pctrl_ign.denominator_nv ed_rbm_pctrl_ign.numerator_nv ed_rbm_pwg1.denominator_nv ed_rbm_pwg1.numerator_nv ed_rbm_pwg2.denominator_nv ed_rbm_pwg2.numerator_nv ed_rbm_pwg_bls.denominator_nv ed_rbm_pwg_bls.numerator_nv ed_rbm_pwg_vgl.denominator_nv ed_rbm_pwg_vgl.numerator_nv ed_rbm_sc_busoff.denominator_nv ed_rbm_sc_busoff.numerator_nv ed_rbm_sc_smg1.denominator_nv ed_rbm_sc_smg1.numerator_nv ed_rbm_sc_smg2.denominator_nv ed_rbm_sc_smg2.numerator_nv ed_rbm_sc_smg3.denominator_nv ed_rbm_sc_smg3.numerator_nv ed_rbm_sg_ign.denominator_nv ed_rbm_sg_ign.numerator_nv ed_rbm_sk_manager_ign.denominator_nv ed_rbm_sk_manager_ign.numerator_nv ed_rbm_sk_tr_ign.denominator_nv ed_rbm_sk_tr_ign.numerator_nv ed_rbm_smg_schaltab.denominator_nv ed_rbm_smg_schaltab.numerator_nv ed_rbm_smg_sk.denominator_nv ed_rbm_smg_sk.numerator_nv ed_rbm_smg_sk_n.denominator_nv ed_rbm_smg_sk_n.numerator_nv ed_rbm_start_rl.denominator_nv ed_rbm_start_rl.numerator_nv ed_rbm_tabg1.denominator_nv ed_rbm_tabg1.numerator_nv ed_rbm_tabg2.denominator_nv ed_rbm_tabg2.numerator_nv ed_rbm_tan1.denominator_nv ed_rbm_tan1.numerator_nv ed_rbm_tan2.denominator_nv ed_rbm_tan2.numerator_nv ed_rbm_tan_obd_b1.denominator_nv ed_rbm_tan_obd_b1.numerator_nv ed_rbm_tan_obd_b2.denominator_nv ed_rbm_tan_obd_b2.numerator_nv ed_rbm_tdme.denominator_nv ed_rbm_tdme.numerator_nv ed_rbm_thermostat.denominator_nv ed_rbm_thermostat.numerator_nv ed_rbm_time ed_rbm_time_ll ed_rbm_time_rel_obd.denominator_nv ed_rbm_time_rel_obd.numerator_nv ed_rbm_time_v ed_rbm_tka.denominator_nv ed_rbm_tka.numerator_nv ed_rbm_tka_obd.denominator_nv ed_rbm_tka_obd.numerator_nv ed_rbm_tmot.denominator_nv ed_rbm_tmot.numerator_nv ed_rbm_tmot_obd.denominator_nv ed_rbm_tmot_obd.numerator_nv ed_rbm_tmot_obd_high.denominator_nv ed_rbm_tmot_obd_high.numerator_nv ed_rbm_tumg.denominator_nv ed_rbm_tumg.numerator_nv ed_rbm_tumg_obd.denominator_nv ed_rbm_tumg_obd.numerator_nv ed_rbm_ub.denominator_nv ed_rbm_ub.numerator_nv ed_rbm_uext_111219514.denominator_nv ed_rbm_uext_111219514.numerator_nv ed_rbm_uext_124_512.denominator_nv ed_rbm_uext_124_512.numerator_nv ed_rbm_v_direkt.denominator_nv ed_rbm_v_direkt.numerator_nv ed_rbm_zoelp1.denominator_nv ed_rbm_zoelp1.numerator_nv ed_rbm_zoelp2.denominator_nv ed_rbm_zoelp2.numerator_nv ed_scdn_st_nv ed_st_fehler_ign_1of4_ ed_st_fehler_ign_2of4_ ed_st_fehler_ign_3of4_ ed_st_fehler_ign_4of4_ ed_st_fehler_inj_1of7_ ed_st_fehler_inj_2of7_ ed_st_fehler_inj_3of7_ ed_st_fehler_inj_4of7_ ed_st_fehler_inj_5of7_ ed_st_fehler_inj_6of7_ ed_st_fehler_inj_7of7_ ed_st_filter_ign_1of4_ ed_st_filter_ign_2of4_ ed_st_filter_ign_3of4_ ed_st_filter_ign_4of4_ ed_st_filter_inj_1of7_ ed_st_filter_inj_2of7_ ed_st_filter_inj_3of7_ ed_st_filter_inj_4of7_ ed_st_filter_inj_5of7_ ed_st_filter_inj_6of7_ ed_st_filter_inj_7of7_ ed_st_nv ed_st_nv_css_den ed_st_nv_css_num ed_st_nv_rbm_abbruch ed_st_nv_rbm_dcy ed_st_nv_rbm_evap ed_st_nv_rbm_slp ed_st_nv_wuc /end OUT_MEASUREMENT
/end FUNCTION
/begin RECORD_LAYOUT TKW_VV_VV_UB FNC_VALUES 1 UBYTE COLUMN_DIR DIRECT /end RECORD_LAYOUT
/begin RECORD_LAYOUT TKW_VV_VV_UW FNC_VALUES 1 UWORD COLUMN_DIR DIRECT /end RECORD_LAYOUT
/end MODULE
/end PROJECT
