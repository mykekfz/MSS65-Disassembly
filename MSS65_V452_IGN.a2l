/begin PROJECT MSS65-ign-V452 "MSS65 IGN - V452.01-B204.00, data set 0569Q60Z160E"
/begin HEADER "" VERSION "V452.01-B204.00" /end HEADER
/begin MODULE _MSS65-ign "MSS65 IGN - V452.01-B204.00, calibration xxxxxxxx"
/begin MOD_COMMON "" BYTE_ORDER MSB_FIRST /* Default byteorder (Motorola) */ /end MOD_COMMON
/* ------------------ Abschnitt erzeugt aus adapt_common.dat ------------------ */
/begin COMPU_METHOD FORMULA_0000 "FORMULA_0000" RAT_FUNC "%7.0" "-" COEFFS 0 1 0 0 0 1 /end COMPU_METHOD
/begin COMPU_METHOD FORMULA_0003 "FORMULA_0003" RAT_FUNC "%3.0" "-" COEFFS 0 1 0 0 0 1 /end COMPU_METHOD
/begin COMPU_METHOD FORMULA_0006 "FORMULA_0006" RAT_FUNC "%5.0" "Upm" COEFFS 0 1 0 0 0 1 /end COMPU_METHOD
/begin COMPU_METHOD FORMULA_0007 "FORMULA_0007" RAT_FUNC "%8.3" "-" COEFFS 0 10000 0 0 0 1 /end COMPU_METHOD
/begin COMPU_METHOD FORMULA_0009 "FORMULA_0009" RAT_FUNC "%6.1" "Nm" COEFFS 0 10 0 0 0 1 /end COMPU_METHOD
/begin COMPU_METHOD FORMULA_0010 "FORMULA_0010" RAT_FUNC "%5.0" "-" COEFFS 0 1 0 0 0 1 /end COMPU_METHOD
/begin COMPU_METHOD FORMULA_0021 "FORMULA_0021" RAT_FUNC "%7.2" "s" COEFFS 0 100 0 0 0 1 /end COMPU_METHOD
/* ------------------ Abschnitt erzeugt aus adapt_glob.dat ------------------ */
/begin COMPU_METHOD FORMULA_0023 "FORMULA_0023" RAT_FUNC "%6.1" "�C" COEFFS 0 10 2732 0 0 1 /end COMPU_METHOD
/begin COMPU_METHOD FORMULA_0025 "FORMULA_0025" RAT_FUNC "%8.3" "-" COEFFS 0 16384 0 0 0 1 /end COMPU_METHOD
/begin COMPU_METHOD FORMULA_0027 "FORMULA_0027" RAT_FUNC "%7.0" "km" COEFFS 0 1 0 0 0 1 /end COMPU_METHOD
/begin COMPU_METHOD FORMULA_0033 "FORMULA_0033" RAT_FUNC "%5.2" "-" COEFFS 0 1 0 0 0 1 /end COMPU_METHOD
/* ------------------ Abschnitt erzeugt aus crc32.dat ------------------ */
/begin COMPU_METHOD FORMULA_0039 "FORMULA_0039" TAB_VERB "%3.0" "-" COMPU_TAB_REF FORMULA_0039_VTAB /end COMPU_METHOD
/begin COMPU_VTAB FORMULA_0039_VTAB "FORMULA_0039_VTAB" TAB_VERB 4 0 "CRC iO" 1 "Daten falsch" 2 "Prog falsch" 4 "Booter falsch" DEFAULT_VALUE "Mehrfachfehler" /end COMPU_VTAB
/begin COMPU_METHOD FORMULA_0040 "FORMULA_0040" TAB_VERB "%3.0" "-" COMPU_TAB_REF FORMULA_0040_VTAB /end COMPU_METHOD
/begin COMPU_VTAB FORMULA_0040_VTAB "FORMULA_0040_VTAB" TAB_VERB 4 0 "Inaktiv" 1 "Start" 2 "Aktiv" 3 "Ende" DEFAULT_VALUE "undef" /end COMPU_VTAB
/begin COMPU_METHOD FORMULA_0075 "FORMULA_0075" RAT_FUNC "%8.3" "-" COEFFS 0 1024 0 0 0 1 /end COMPU_METHOD
/begin COMPU_METHOD FORMULA_0077 "FORMULA_0077" RAT_FUNC "%6.1" "mbar" COEFFS 0 16 0 0 0 1 /end COMPU_METHOD
/begin COMPU_METHOD FORMULA_0078 "FORMULA_0078" RAT_FUNC "%6.1" "km/h" COEFFS 0 16 0 0 0 1 /end COMPU_METHOD
/begin COMPU_METHOD FORMULA_0111 "FORMULA_0111" RAT_FUNC "%6.1" "�KW" COEFFS 0 10 0 0 0 1 /end COMPU_METHOD
/begin COMPU_METHOD FORMULA_0117 "FORMULA_0117" RAT_FUNC "%7.2" "s" COEFFS 0 200 0 0 0 1 /end COMPU_METHOD
/begin COMPU_METHOD FORMULA_0123 "FORMULA_0123" RAT_FUNC "%5.0" "digit" COEFFS 0 1 0 0 0 1 /end COMPU_METHOD
/begin COMPU_METHOD FORMULA_0132 "FORMULA_0132" RAT_FUNC "%7.2" "m/(s*s)" COEFFS 0 40 0 0 0 1 /end COMPU_METHOD
/begin COMPU_METHOD FORMULA_0138 "FORMULA_0138" RAT_FUNC "%3.0" "bar" COEFFS 0 1 0 0 0 1 /end COMPU_METHOD
/begin COMPU_METHOD FORMULA_0152 "FORMULA_0152" RAT_FUNC "%9.2" "s" COEFFS 0 100 0 0 0 1 /end COMPU_METHOD
/begin COMPU_METHOD FORMULA_0232 "FORMULA_0232" RAT_FUNC "%3.0" "s" COEFFS 0 1 0 0 0 1 /end COMPU_METHOD
/begin COMPU_METHOD FORMULA_0245 "FORMULA_0245" RAT_FUNC "%7.2" "nSs" COEFFS 0 1 0 0 0 0.01952206 /end COMPU_METHOD
/begin COMPU_METHOD FORMULA_0249 "FORMULA_0249" RAT_FUNC "%8.3" "�KW/Segm" COEFFS 0 10 0 0 0 1 /end COMPU_METHOD
/begin COMPU_METHOD FORMULA_0277 "FORMULA_0277" RAT_FUNC "%8.3" "V" COEFFS 0 1 0 0 0 0.00155892 /end COMPU_METHOD
/begin COMPU_METHOD FORMULA_0295 "FORMULA_0295" RAT_FUNC "%9.4" "-" COEFFS 0 16384 0 0 0 1 /end COMPU_METHOD
/begin COMPU_METHOD FORMULA_0318 "FORMULA_0318" RAT_FUNC "%3.0" ".Gang" COEFFS 0 1 0 0 0 1 /end COMPU_METHOD
/* ------------------ Abschnitt erzeugt aus os.dat ------------------ */
/begin COMPU_METHOD FORMULA_0350 "FORMULA_0350" TAB_VERB "%3.0" "-" COMPU_TAB_REF FORMULA_0350_VTAB /end COMPU_METHOD
/begin COMPU_VTAB FORMULA_0350_VTAB "FORMULA_0350_VTAB" TAB_VERB 11 0 "Ok" 1 "Sync1" 2 "Sync2" 3 "SyncMS" 4 "1ms-Task" 5 "5ms-Task" 6 "10ms-Task" 7 "100ms-Task" 8 "1s-Task" 9 "Bgnd-Task" 10 "undef" /end COMPU_VTAB
/begin COMPU_METHOD FORMULA_0351 "FORMULA_0351" TAB_VERB "%3.0" "-" COMPU_TAB_REF FORMULA_0351_VTAB /end COMPU_METHOD
/begin COMPU_VTAB FORMULA_0351_VTAB "FORMULA_0351_VTAB" TAB_VERB 13 0 "Ok" 1 "Access" 2 "Level" 3 "ID" 4 "Limit" 5 "NoFnc" 6 "Resource" 7 "State" 8 "Value" 9 "TT missing" 10 "TT active" 11 "Overrun" 14 "Stack" /end COMPU_VTAB
/begin COMPU_METHOD FORMULA_0403 "FORMULA_0403" RAT_FUNC "%3.0" "-" COEFFS 0 -1 1 0 0 -1 /end COMPU_METHOD
/begin COMPU_METHOD FORMULA_0443 "FORMULA_0443" RAT_FUNC "%7.2" "V" COEFFS 0 1 0 0 0 0.00080566 /end COMPU_METHOD
/begin COMPU_METHOD FORMULA_0447 "FORMULA_0447" RAT_FUNC "%7.2" "ms" COEFFS 0 7000 0 0 0 1 /end COMPU_METHOD
/begin COMPU_METHOD FORMULA_0448 "FORMULA_0448" RAT_FUNC "%7.2" "ms" COEFFS 0 250 0 0 0 1 /end COMPU_METHOD
/begin COMPU_METHOD FORMULA_0452 "FORMULA_0452" RAT_FUNC "%6.1" "trmp" COEFFS 0 16 0 0 0 1 /end COMPU_METHOD
/begin COMPU_METHOD FORMULA_0458 "FORMULA_0458" RAT_FUNC "%7.2" "m/(s*s)" COEFFS 0 286720 0 0 0 19613 /end COMPU_METHOD
/* ------------------ Abschnitt erzeugt aus afz.dat ------------------ */
/begin COMPU_METHOD FORMULA_0459 "FORMULA_0459" RAT_FUNC "%7.2" "m/(s*s)" COEFFS 0 4587520 0 0 0 19613 /end COMPU_METHOD
/begin COMPU_METHOD FORMULA_0460 "FORMULA_0460" RAT_FUNC "%8.1" "m" COEFFS 0 1600 0 0 0 1 /end COMPU_METHOD
/begin COMPU_METHOD FORMULA_0461 "FORMULA_0461" RAT_FUNC "%7.2" "m/(s*s)" COEFFS 0 640 0 0 0 1 /end COMPU_METHOD
/begin COMPU_METHOD FORMULA_0462 "FORMULA_0462" RAT_FUNC "%5.2" "s" COEFFS 0 0 2.56 0 1 0 /end COMPU_METHOD
/begin COMPU_METHOD FORMULA_0463 "FORMULA_0463" RAT_FUNC "%6.1" "%" COEFFS 0 100 0 0 0 1 /end COMPU_METHOD
/* ------------------ Abschnitt erzeugt aus ag_tz.dat ------------------ */
/begin COMPU_METHOD FORMULA_0464 "FORMULA_0464" TAB_VERB "%3.0" "-" COMPU_TAB_REF FORMULA_0464_VTAB /end COMPU_METHOD
/begin COMPU_VTAB FORMULA_0464_VTAB "FORMULA_0464_VTAB" TAB_VERB 5 0 "Inaktiv" 1 "Key" 5 "Aktiv" 8 "Fehler" 9 "Beendet" DEFAULT_VALUE "undefined" /end COMPU_VTAB
/begin COMPU_METHOD FORMULA_0465 "FORMULA_0465" TAB_VERB "%3.0" "-" COMPU_TAB_REF FORMULA_0465_VTAB /end COMPU_METHOD
/begin COMPU_VTAB FORMULA_0465_VTAB "FORMULA_0465_VTAB" TAB_VERB 4 0 "Aus" 1 "Statisch" 2 "Sequentiell" 3 "Sporadisch" DEFAULT_VALUE "undefined" /end COMPU_VTAB
/begin COMPU_METHOD FORMULA_0466 "FORMULA_0466" TAB_VERB "%5.0" "-" COMPU_TAB_REF FORMULA_0466_VTAB /end COMPU_METHOD
/begin COMPU_VTAB FORMULA_0466_VTAB "FORMULA_0466_VTAB" TAB_VERB 1 0 "keine Ausblendung." DEFAULT_VALUE "Ausblendungen aktiv." /end COMPU_VTAB
/begin COMPU_METHOD FORMULA_0467 "FORMULA_0467" TAB_VERB "%5.0" "-" COMPU_TAB_REF FORMULA_0467_VTAB /end COMPU_METHOD
/begin COMPU_VTAB FORMULA_0467_VTAB "FORMULA_0467_VTAB" TAB_VERB 1 0 "Zyl. 1 an." DEFAULT_VALUE "Zyl. 1 aus." /end COMPU_VTAB
/begin COMPU_METHOD FORMULA_0468 "FORMULA_0468" TAB_VERB "%5.0" "-" COMPU_TAB_REF FORMULA_0468_VTAB /end COMPU_METHOD
/begin COMPU_VTAB FORMULA_0468_VTAB "FORMULA_0468_VTAB" TAB_VERB 1 0 "Zyl. 2 an." DEFAULT_VALUE "Zyl. 2 aus." /end COMPU_VTAB
/begin COMPU_METHOD FORMULA_0469 "FORMULA_0469" TAB_VERB "%5.0" "-" COMPU_TAB_REF FORMULA_0469_VTAB /end COMPU_METHOD
/begin COMPU_VTAB FORMULA_0469_VTAB "FORMULA_0469_VTAB" TAB_VERB 1 0 "Zyl. 3 an." DEFAULT_VALUE "Zyl. 3 aus." /end COMPU_VTAB
/begin COMPU_METHOD FORMULA_0470 "FORMULA_0470" TAB_VERB "%5.0" "-" COMPU_TAB_REF FORMULA_0470_VTAB /end COMPU_METHOD
/begin COMPU_VTAB FORMULA_0470_VTAB "FORMULA_0470_VTAB" TAB_VERB 1 0 "Zyl. 4 an." DEFAULT_VALUE "Zyl. 4 aus." /end COMPU_VTAB
/begin COMPU_METHOD FORMULA_0471 "FORMULA_0471" TAB_VERB "%5.0" "-" COMPU_TAB_REF FORMULA_0471_VTAB /end COMPU_METHOD
/begin COMPU_VTAB FORMULA_0471_VTAB "FORMULA_0471_VTAB" TAB_VERB 1 0 "Zyl. 5 an." DEFAULT_VALUE "Zyl. 5 aus." /end COMPU_VTAB
/begin COMPU_METHOD FORMULA_0472 "FORMULA_0472" TAB_VERB "%5.0" "-" COMPU_TAB_REF FORMULA_0472_VTAB /end COMPU_METHOD
/begin COMPU_VTAB FORMULA_0472_VTAB "FORMULA_0472_VTAB" TAB_VERB 1 0 "Zyl. 6 an." DEFAULT_VALUE "Zyl. 6 aus." /end COMPU_VTAB
/begin COMPU_METHOD FORMULA_0473 "FORMULA_0473" TAB_VERB "%5.0" "-" COMPU_TAB_REF FORMULA_0473_VTAB /end COMPU_METHOD
/begin COMPU_VTAB FORMULA_0473_VTAB "FORMULA_0473_VTAB" TAB_VERB 1 0 "Zyl. 7 an." DEFAULT_VALUE "Zyl. 7 aus." /end COMPU_VTAB
/begin COMPU_METHOD FORMULA_0474 "FORMULA_0474" TAB_VERB "%5.0" "-" COMPU_TAB_REF FORMULA_0474_VTAB /end COMPU_METHOD
/begin COMPU_VTAB FORMULA_0474_VTAB "FORMULA_0474_VTAB" TAB_VERB 1 0 "Zyl. 8 an." DEFAULT_VALUE "Zyl. 8 aus." /end COMPU_VTAB
/begin COMPU_METHOD FORMULA_0475 "FORMULA_0475" TAB_VERB "%5.0" "-" COMPU_TAB_REF FORMULA_0475_VTAB /end COMPU_METHOD
/begin COMPU_VTAB FORMULA_0475_VTAB "FORMULA_0475_VTAB" TAB_VERB 1 0 "Zyl. 9 an." DEFAULT_VALUE "Zyl. 9 aus." /end COMPU_VTAB
/begin COMPU_METHOD FORMULA_0476 "FORMULA_0476" TAB_VERB "%5.0" "-" COMPU_TAB_REF FORMULA_0476_VTAB /end COMPU_METHOD
/begin COMPU_VTAB FORMULA_0476_VTAB "FORMULA_0476_VTAB" TAB_VERB 1 0 "Zyl. 10 an." DEFAULT_VALUE "Zyl. 10 aus." /end COMPU_VTAB
/begin COMPU_METHOD FORMULA_0478 "FORMULA_0478" RAT_FUNC "%6.3" "s" COEFFS 0 0 1.28 0 1 0 /end COMPU_METHOD
/* ------------------ Abschnitt erzeugt aus ar.dat ------------------ */
/begin COMPU_METHOD FORMULA_0480 "FORMULA_0480" TAB_VERB "%3.0" "-" COMPU_TAB_REF FORMULA_0480_VTAB /end COMPU_METHOD
/begin COMPU_VTAB FORMULA_0480_VTAB "FORMULA_0480_VTAB" TAB_VERB 7 0 "Warten" 1 "Init" 2 "Gesperrt" 3 "Init+Gesperrt" 4 "Frei" 8 "Aktiv" 12 "Frei+Aktiv" /end COMPU_VTAB
/begin COMPU_METHOD FORMULA_0481 "FORMULA_0481" TAB_VERB "%3.0" "-" COMPU_TAB_REF FORMULA_0481_VTAB /end COMPU_METHOD
/begin COMPU_VTAB FORMULA_0481_VTAB "FORMULA_0481_VTAB" TAB_VERB 4 0 "Erwarte_1" 1 "Aktiv" 2 "Erwarte_2B" 3 "Erwarte_2V" /end COMPU_VTAB
/begin COMPU_METHOD FORMULA_0482 "FORMULA_0482" RAT_FUNC "%5.0" "Upm/s" COEFFS 0 1 0 0 0 200 /end COMPU_METHOD
/begin COMPU_METHOD FORMULA_0483 "FORMULA_0483" TAB_VERB "%5.2" "-" COMPU_TAB_REF FORMULA_0483_VTAB /end COMPU_METHOD
/begin COMPU_VTAB FORMULA_0483_VTAB "FORMULA_0483_VTAB" TAB_VERB 5 0 "AR aus" 1 "1B+1V" 3 "2B+1V" 5 "1B+2V" 7 "2B+2V" DEFAULT_VALUE "undef" /end COMPU_VTAB
/begin COMPU_METHOD FORMULA_0484 "FORMULA_0484" RAT_FUNC "%7.2" "Nm/Upm" COEFFS 0 5120 0 0 0 1 /end COMPU_METHOD
/begin COMPU_METHOD FORMULA_0485 "FORMULA_0485" RAT_FUNC "%9.4" "-" COEFFS 0 1048576 0 0 0 1 /end COMPU_METHOD
/begin COMPU_METHOD FORMULA_0486 "FORMULA_0486" RAT_FUNC "%5.0" ".Gang" COEFFS 0 1 0 0 0 1 /end COMPU_METHOD
/* ------------------ Abschnitt erzeugt aus at.dat ------------------ */
/begin COMPU_METHOD FORMULA_0487 "FORMULA_0487" TAB_VERB "%5.2" "-" COMPU_TAB_REF FORMULA_0487_VTAB /end COMPU_METHOD
/begin COMPU_VTAB FORMULA_0487_VTAB "FORMULA_0487_VTAB" TAB_VERB 2 0 "AT gesperrt" 1 "AT freigegeben" /end COMPU_VTAB
/begin COMPU_METHOD FORMULA_0488 "FORMULA_0488" TAB_VERB "%5.2" "-" COMPU_TAB_REF FORMULA_0488_VTAB /end COMPU_METHOD
/begin COMPU_VTAB FORMULA_0488_VTAB "FORMULA_0488_VTAB" TAB_VERB 2 0 "AT kein Eingriff" 1 "AT Eingriff" /end COMPU_VTAB
/begin COMPU_METHOD FORMULA_0489 "FORMULA_0489" TAB_VERB "%5.2" "-" COMPU_TAB_REF FORMULA_0489_VTAB /end COMPU_METHOD
/begin COMPU_VTAB FORMULA_0489_VTAB "FORMULA_0489_VTAB" TAB_VERB 2 0 "AT kein Eingriff Zug" 1 "AT Eingriff Zug" /end COMPU_VTAB
/begin COMPU_METHOD FORMULA_0490 "FORMULA_0490" TAB_VERB "%5.2" "-" COMPU_TAB_REF FORMULA_0490_VTAB /end COMPU_METHOD
/begin COMPU_VTAB FORMULA_0490_VTAB "FORMULA_0490_VTAB" TAB_VERB 2 0 "AT kein Eingriff Schub" 1 "AT Eingriff Schub" /end COMPU_VTAB
/begin COMPU_METHOD FORMULA_0491 "FORMULA_0491" RAT_FUNC "%9.4" "-" COEFFS 0 8192 0 0 0 1 /end COMPU_METHOD
/begin COMPU_METHOD FORMULA_0492 "FORMULA_0492" RAT_FUNC "%10.3" "Nm/trmp" COEFFS 0 1000 0 0 0 1 /end COMPU_METHOD
/begin COMPU_METHOD FORMULA_0493 "FORMULA_0493" TAB_VERB "%3.0" "-" COMPU_TAB_REF FORMULA_0493_VTAB /end COMPU_METHOD
/begin COMPU_VTAB FORMULA_0493_VTAB "FORMULA_0493_VTAB" TAB_VERB 2 0 "inaktiv" 1 "aktiv" /end COMPU_VTAB
/begin COMPU_METHOD FORMULA_0494 "FORMULA_0494" RAT_FUNC "%8.1" "trmp" COEFFS 0 16 0 0 0 1 /end COMPU_METHOD
/begin COMPU_METHOD FORMULA_0495 "FORMULA_0495" TAB_VERB "%3.0" "-" COMPU_TAB_REF FORMULA_0495_VTAB /end COMPU_METHOD
/begin COMPU_VTAB FORMULA_0495_VTAB "FORMULA_0495_VTAB" TAB_VERB 3 0 "Aus" 1 "immer Aktiv" 2 "HS Aktiv" /end COMPU_VTAB
/begin COMPU_METHOD FORMULA_0496 "FORMULA_0496" RAT_FUNC "%3.0" "Hz" COEFFS 0 1 0 0 0 1 /end COMPU_METHOD
/begin COMPU_METHOD FORMULA_0497 "FORMULA_0497" RAT_FUNC "%7.2" "-" COEFFS 0 100 0 0 0 1 /end COMPU_METHOD
/begin COMPU_METHOD FORMULA_0498 "FORMULA_0498" RAT_FUNC "%7.2" "Nm/trmp" COEFFS 0 100 0 0 0 1 /end COMPU_METHOD
/begin COMPU_METHOD FORMULA_0499 "FORMULA_0499" RAT_FUNC "%8.3" "s" COEFFS 0 1000 0 0 0 1 /end COMPU_METHOD
/* ------------------ Abschnitt erzeugt aus auss.dat ------------------ */
/begin COMPU_METHOD FORMULA_0500 "FORMULA_0500" TAB_VERB "%3.0" "-" COMPU_TAB_REF FORMULA_0500_VTAB /end COMPU_METHOD
/begin COMPU_VTAB FORMULA_0500_VTAB "FORMULA_0500_VTAB" TAB_VERB 1 0 "Erster Intervall 1" DEFAULT_VALUE "Folge Intervalle" /end COMPU_VTAB
/begin COMPU_METHOD FORMULA_0501 "FORMULA_0501" RAT_FUNC "%4.1" "s" COEFFS 0 10 0 0 0 1 /end COMPU_METHOD
/begin COMPU_METHOD FORMULA_0502 "FORMULA_0502" RAT_FUNC "%5.2" "-" COEFFS 0 255 0 0 0 1 /end COMPU_METHOD
/begin COMPU_METHOD FORMULA_0503 "FORMULA_0503" TAB_VERB "%5.0" "-" COMPU_TAB_REF FORMULA_0503_VTAB /end COMPU_METHOD
/begin COMPU_VTAB FORMULA_0503_VTAB "FORMULA_0503_VTAB" TAB_VERB 1 0 "Ausschwingen ok." DEFAULT_VALUE "Fehler Ausschwingen." /end COMPU_VTAB
/begin COMPU_METHOD FORMULA_0504 "FORMULA_0504" TAB_VERB "%5.0" "-" COMPU_TAB_REF FORMULA_0504_VTAB /end COMPU_METHOD
/begin COMPU_VTAB FORMULA_0504_VTAB "FORMULA_0504_VTAB" TAB_VERB 1 0 "Zyl. 1 ok." DEFAULT_VALUE "Fehler Ausschw. Zyl. 1." /end COMPU_VTAB
/begin COMPU_METHOD FORMULA_0505 "FORMULA_0505" TAB_VERB "%5.0" "-" COMPU_TAB_REF FORMULA_0505_VTAB /end COMPU_METHOD
/begin COMPU_VTAB FORMULA_0505_VTAB "FORMULA_0505_VTAB" TAB_VERB 1 0 "Zyl. 2 ok." DEFAULT_VALUE "Fehler Ausschw. Zyl. 2." /end COMPU_VTAB
/begin COMPU_METHOD FORMULA_0506 "FORMULA_0506" TAB_VERB "%5.0" "-" COMPU_TAB_REF FORMULA_0506_VTAB /end COMPU_METHOD
/begin COMPU_VTAB FORMULA_0506_VTAB "FORMULA_0506_VTAB" TAB_VERB 1 0 "Zyl. 3 ok." DEFAULT_VALUE "Fehler Ausschw. Zyl. 3." /end COMPU_VTAB
/begin COMPU_METHOD FORMULA_0507 "FORMULA_0507" TAB_VERB "%5.0" "-" COMPU_TAB_REF FORMULA_0507_VTAB /end COMPU_METHOD
/begin COMPU_VTAB FORMULA_0507_VTAB "FORMULA_0507_VTAB" TAB_VERB 1 0 "Zyl. 4 ok." DEFAULT_VALUE "Fehler Ausschw. Zyl. 4." /end COMPU_VTAB
/begin COMPU_METHOD FORMULA_0508 "FORMULA_0508" TAB_VERB "%5.0" "-" COMPU_TAB_REF FORMULA_0508_VTAB /end COMPU_METHOD
/begin COMPU_VTAB FORMULA_0508_VTAB "FORMULA_0508_VTAB" TAB_VERB 1 0 "Zyl. 5 ok." DEFAULT_VALUE "Fehler Ausschw. Zyl. 5." /end COMPU_VTAB
/begin COMPU_METHOD FORMULA_0509 "FORMULA_0509" TAB_VERB "%5.0" "-" COMPU_TAB_REF FORMULA_0509_VTAB /end COMPU_METHOD
/begin COMPU_VTAB FORMULA_0509_VTAB "FORMULA_0509_VTAB" TAB_VERB 1 0 "Zyl. 6 ok." DEFAULT_VALUE "Fehler Ausschw. Zyl. 6." /end COMPU_VTAB
/begin COMPU_METHOD FORMULA_0510 "FORMULA_0510" TAB_VERB "%5.0" "-" COMPU_TAB_REF FORMULA_0510_VTAB /end COMPU_METHOD
/begin COMPU_VTAB FORMULA_0510_VTAB "FORMULA_0510_VTAB" TAB_VERB 1 0 "Zyl. 7 ok." DEFAULT_VALUE "Fehler Ausschw. Zyl. 7." /end COMPU_VTAB
/begin COMPU_METHOD FORMULA_0511 "FORMULA_0511" TAB_VERB "%5.0" "-" COMPU_TAB_REF FORMULA_0511_VTAB /end COMPU_METHOD
/begin COMPU_VTAB FORMULA_0511_VTAB "FORMULA_0511_VTAB" TAB_VERB 1 0 "Zyl. 8 ok." DEFAULT_VALUE "Fehler Ausschw. Zyl. 8." /end COMPU_VTAB
/begin COMPU_METHOD FORMULA_0512 "FORMULA_0512" TAB_VERB "%5.0" "-" COMPU_TAB_REF FORMULA_0512_VTAB /end COMPU_METHOD
/begin COMPU_VTAB FORMULA_0512_VTAB "FORMULA_0512_VTAB" TAB_VERB 1 0 "Zyl. 9 ok." DEFAULT_VALUE "Fehler Ausschw. Zyl. 9." /end COMPU_VTAB
/begin COMPU_METHOD FORMULA_0513 "FORMULA_0513" TAB_VERB "%5.0" "-" COMPU_TAB_REF FORMULA_0513_VTAB /end COMPU_METHOD
/begin COMPU_VTAB FORMULA_0513_VTAB "FORMULA_0513_VTAB" TAB_VERB 1 0 "Zyl. 10 ok." DEFAULT_VALUE "Fehler Ausschw. Zyl. 10." /end COMPU_VTAB
/begin COMPU_METHOD FORMULA_0514 "FORMULA_0514" TAB_VERB "%5.0" "-" COMPU_TAB_REF FORMULA_0514_VTAB /end COMPU_METHOD
/begin COMPU_VTAB FORMULA_0514_VTAB "FORMULA_0514_VTAB" TAB_VERB 1 0 "Verbrennung ok." DEFAULT_VALUE "Fehler Verbrennung." /end COMPU_VTAB
/begin COMPU_METHOD FORMULA_0515 "FORMULA_0515" TAB_VERB "%5.0" "-" COMPU_TAB_REF FORMULA_0515_VTAB /end COMPU_METHOD
/begin COMPU_VTAB FORMULA_0515_VTAB "FORMULA_0515_VTAB" TAB_VERB 1 0 "Zyl. 1 ok." DEFAULT_VALUE "Fehler Verbr. Zyl. 1." /end COMPU_VTAB
/begin COMPU_METHOD FORMULA_0516 "FORMULA_0516" TAB_VERB "%5.0" "-" COMPU_TAB_REF FORMULA_0516_VTAB /end COMPU_METHOD
/begin COMPU_VTAB FORMULA_0516_VTAB "FORMULA_0516_VTAB" TAB_VERB 1 0 "Zyl. 2 ok." DEFAULT_VALUE "Fehler Verbr. Zyl. 2." /end COMPU_VTAB
/begin COMPU_METHOD FORMULA_0517 "FORMULA_0517" TAB_VERB "%5.0" "-" COMPU_TAB_REF FORMULA_0517_VTAB /end COMPU_METHOD
/begin COMPU_VTAB FORMULA_0517_VTAB "FORMULA_0517_VTAB" TAB_VERB 1 0 "Zyl. 3 ok." DEFAULT_VALUE "Fehler Verbr. Zyl. 3." /end COMPU_VTAB
/begin COMPU_METHOD FORMULA_0518 "FORMULA_0518" TAB_VERB "%5.0" "-" COMPU_TAB_REF FORMULA_0518_VTAB /end COMPU_METHOD
/begin COMPU_VTAB FORMULA_0518_VTAB "FORMULA_0518_VTAB" TAB_VERB 1 0 "Zyl. 4 ok." DEFAULT_VALUE "Fehler Verbr. Zyl. 4." /end COMPU_VTAB
/begin COMPU_METHOD FORMULA_0519 "FORMULA_0519" TAB_VERB "%5.0" "-" COMPU_TAB_REF FORMULA_0519_VTAB /end COMPU_METHOD
/begin COMPU_VTAB FORMULA_0519_VTAB "FORMULA_0519_VTAB" TAB_VERB 1 0 "Zyl. 5 ok." DEFAULT_VALUE "Fehler Verbr. Zyl. 5." /end COMPU_VTAB
/begin COMPU_METHOD FORMULA_0520 "FORMULA_0520" TAB_VERB "%5.0" "-" COMPU_TAB_REF FORMULA_0520_VTAB /end COMPU_METHOD
/begin COMPU_VTAB FORMULA_0520_VTAB "FORMULA_0520_VTAB" TAB_VERB 1 0 "Zyl. 6 ok." DEFAULT_VALUE "Fehler Verbr. Zyl. 6." /end COMPU_VTAB
/begin COMPU_METHOD FORMULA_0521 "FORMULA_0521" TAB_VERB "%5.0" "-" COMPU_TAB_REF FORMULA_0521_VTAB /end COMPU_METHOD
/begin COMPU_VTAB FORMULA_0521_VTAB "FORMULA_0521_VTAB" TAB_VERB 1 0 "Zyl. 7 ok." DEFAULT_VALUE "Fehler Verbr. Zyl. 7." /end COMPU_VTAB
/begin COMPU_METHOD FORMULA_0522 "FORMULA_0522" TAB_VERB "%5.0" "-" COMPU_TAB_REF FORMULA_0522_VTAB /end COMPU_METHOD
/begin COMPU_VTAB FORMULA_0522_VTAB "FORMULA_0522_VTAB" TAB_VERB 1 0 "Zyl. 8 ok." DEFAULT_VALUE "Fehler Verbr. Zyl. 8." /end COMPU_VTAB
/begin COMPU_METHOD FORMULA_0523 "FORMULA_0523" TAB_VERB "%5.0" "-" COMPU_TAB_REF FORMULA_0523_VTAB /end COMPU_METHOD
/begin COMPU_VTAB FORMULA_0523_VTAB "FORMULA_0523_VTAB" TAB_VERB 1 0 "Zyl. 9 ok." DEFAULT_VALUE "Fehler Verbr. Zyl. 9." /end COMPU_VTAB
/begin COMPU_METHOD FORMULA_0524 "FORMULA_0524" TAB_VERB "%5.0" "-" COMPU_TAB_REF FORMULA_0524_VTAB /end COMPU_METHOD
/begin COMPU_VTAB FORMULA_0524_VTAB "FORMULA_0524_VTAB" TAB_VERB 1 0 "Zyl. 10 ok." DEFAULT_VALUE "Fehler Verbr. Zyl. 10." /end COMPU_VTAB
/begin COMPU_METHOD FORMULA_0525 "FORMULA_0525" TAB_VERB "%5.0" "-" COMPU_TAB_REF FORMULA_0525_VTAB /end COMPU_METHOD
/begin COMPU_VTAB FORMULA_0525_VTAB "FORMULA_0525_VTAB" TAB_VERB 1 0 "Kein Nebenschluss." DEFAULT_VALUE "Fehler Nebenschluss." /end COMPU_VTAB
/begin COMPU_METHOD FORMULA_0526 "FORMULA_0526" TAB_VERB "%5.0" "-" COMPU_TAB_REF FORMULA_0526_VTAB /end COMPU_METHOD
/begin COMPU_VTAB FORMULA_0526_VTAB "FORMULA_0526_VTAB" TAB_VERB 1 0 "Zyl. 1 ok." DEFAULT_VALUE "Nebenschluss. Zyl. 1." /end COMPU_VTAB
/begin COMPU_METHOD FORMULA_0527 "FORMULA_0527" TAB_VERB "%5.0" "-" COMPU_TAB_REF FORMULA_0527_VTAB /end COMPU_METHOD
/begin COMPU_VTAB FORMULA_0527_VTAB "FORMULA_0527_VTAB" TAB_VERB 1 0 "Zyl. 2 ok." DEFAULT_VALUE "Nebenschluss. Zyl. 2." /end COMPU_VTAB
/begin COMPU_METHOD FORMULA_0528 "FORMULA_0528" TAB_VERB "%5.0" "-" COMPU_TAB_REF FORMULA_0528_VTAB /end COMPU_METHOD
/begin COMPU_VTAB FORMULA_0528_VTAB "FORMULA_0528_VTAB" TAB_VERB 1 0 "Zyl. 3 ok." DEFAULT_VALUE "Nebenschluss. Zyl. 3." /end COMPU_VTAB
/begin COMPU_METHOD FORMULA_0529 "FORMULA_0529" TAB_VERB "%5.0" "-" COMPU_TAB_REF FORMULA_0529_VTAB /end COMPU_METHOD
/begin COMPU_VTAB FORMULA_0529_VTAB "FORMULA_0529_VTAB" TAB_VERB 1 0 "Zyl. 4 ok." DEFAULT_VALUE "Nebenschluss. Zyl. 4." /end COMPU_VTAB
/begin COMPU_METHOD FORMULA_0530 "FORMULA_0530" TAB_VERB "%5.0" "-" COMPU_TAB_REF FORMULA_0530_VTAB /end COMPU_METHOD
/begin COMPU_VTAB FORMULA_0530_VTAB "FORMULA_0530_VTAB" TAB_VERB 1 0 "Zyl. 5 ok." DEFAULT_VALUE "Nebenschluss. Zyl. 5." /end COMPU_VTAB
/begin COMPU_METHOD FORMULA_0531 "FORMULA_0531" TAB_VERB "%5.0" "-" COMPU_TAB_REF FORMULA_0531_VTAB /end COMPU_METHOD
/begin COMPU_VTAB FORMULA_0531_VTAB "FORMULA_0531_VTAB" TAB_VERB 1 0 "Zyl. 6 ok." DEFAULT_VALUE "Nebenschluss. Zyl. 6." /end COMPU_VTAB
/begin COMPU_METHOD FORMULA_0532 "FORMULA_0532" TAB_VERB "%5.0" "-" COMPU_TAB_REF FORMULA_0532_VTAB /end COMPU_METHOD
/begin COMPU_VTAB FORMULA_0532_VTAB "FORMULA_0532_VTAB" TAB_VERB 1 0 "Zyl. 7 ok." DEFAULT_VALUE "Nebenschluss. Zyl. 7." /end COMPU_VTAB
/begin COMPU_METHOD FORMULA_0533 "FORMULA_0533" TAB_VERB "%5.0" "-" COMPU_TAB_REF FORMULA_0533_VTAB /end COMPU_METHOD
/begin COMPU_VTAB FORMULA_0533_VTAB "FORMULA_0533_VTAB" TAB_VERB 1 0 "Zyl. 8 ok." DEFAULT_VALUE "Nebenschluss. Zyl. 8." /end COMPU_VTAB
/begin COMPU_METHOD FORMULA_0534 "FORMULA_0534" TAB_VERB "%5.0" "-" COMPU_TAB_REF FORMULA_0534_VTAB /end COMPU_METHOD
/begin COMPU_VTAB FORMULA_0534_VTAB "FORMULA_0534_VTAB" TAB_VERB 1 0 "Zyl. 9 ok." DEFAULT_VALUE "Nebenschluss. Zyl. 9." /end COMPU_VTAB
/begin COMPU_METHOD FORMULA_0535 "FORMULA_0535" TAB_VERB "%5.0" "-" COMPU_TAB_REF FORMULA_0535_VTAB /end COMPU_METHOD
/begin COMPU_VTAB FORMULA_0535_VTAB "FORMULA_0535_VTAB" TAB_VERB 1 0 "Zyl. 10 ok." DEFAULT_VALUE "Nebenschluss. Zyl. 10." /end COMPU_VTAB
/begin COMPU_METHOD FORMULA_0536 "FORMULA_0536" TAB_VERB "%5.0" "-" COMPU_TAB_REF FORMULA_0536_VTAB /end COMPU_METHOD
/begin COMPU_VTAB FORMULA_0536_VTAB "FORMULA_0536_VTAB" TAB_VERB 1 0 "kein Kat-Aussetzer" DEFAULT_VALUE "Kat-Aussetzer erkannt" /end COMPU_VTAB
/begin COMPU_METHOD FORMULA_0537 "FORMULA_0537" TAB_VERB "%5.0" "-" COMPU_TAB_REF FORMULA_0537_VTAB /end COMPU_METHOD
/begin COMPU_VTAB FORMULA_0537_VTAB "FORMULA_0537_VTAB" TAB_VERB 1 0 "Zyl. 1 ok." DEFAULT_VALUE "Kat-Auss. Zyl. 1." /end COMPU_VTAB
/begin COMPU_METHOD FORMULA_0538 "FORMULA_0538" TAB_VERB "%5.0" "-" COMPU_TAB_REF FORMULA_0538_VTAB /end COMPU_METHOD
/begin COMPU_VTAB FORMULA_0538_VTAB "FORMULA_0538_VTAB" TAB_VERB 1 0 "Zyl. 2 ok." DEFAULT_VALUE "Kat-Auss. Zyl. 2." /end COMPU_VTAB
/begin COMPU_METHOD FORMULA_0539 "FORMULA_0539" TAB_VERB "%5.0" "-" COMPU_TAB_REF FORMULA_0539_VTAB /end COMPU_METHOD
/begin COMPU_VTAB FORMULA_0539_VTAB "FORMULA_0539_VTAB" TAB_VERB 1 0 "Zyl. 3 ok." DEFAULT_VALUE "Kat-Auss. Zyl. 3." /end COMPU_VTAB
/begin COMPU_METHOD FORMULA_0540 "FORMULA_0540" TAB_VERB "%5.0" "-" COMPU_TAB_REF FORMULA_0540_VTAB /end COMPU_METHOD
/begin COMPU_VTAB FORMULA_0540_VTAB "FORMULA_0540_VTAB" TAB_VERB 1 0 "Zyl. 4 ok." DEFAULT_VALUE "Kat-Auss. Zyl. 4." /end COMPU_VTAB
/begin COMPU_METHOD FORMULA_0541 "FORMULA_0541" TAB_VERB "%5.0" "-" COMPU_TAB_REF FORMULA_0541_VTAB /end COMPU_METHOD
/begin COMPU_VTAB FORMULA_0541_VTAB "FORMULA_0541_VTAB" TAB_VERB 1 0 "Zyl. 5 ok." DEFAULT_VALUE "Kat-Auss. Zyl. 5." /end COMPU_VTAB
/begin COMPU_METHOD FORMULA_0542 "FORMULA_0542" TAB_VERB "%5.0" "-" COMPU_TAB_REF FORMULA_0542_VTAB /end COMPU_METHOD
/begin COMPU_VTAB FORMULA_0542_VTAB "FORMULA_0542_VTAB" TAB_VERB 1 0 "Zyl. 6 ok." DEFAULT_VALUE "Kat-Auss. Zyl. 6." /end COMPU_VTAB
/begin COMPU_METHOD FORMULA_0543 "FORMULA_0543" TAB_VERB "%5.0" "-" COMPU_TAB_REF FORMULA_0543_VTAB /end COMPU_METHOD
/begin COMPU_VTAB FORMULA_0543_VTAB "FORMULA_0543_VTAB" TAB_VERB 1 0 "Zyl. 7 ok." DEFAULT_VALUE "Kat-Auss. Zyl. 7." /end COMPU_VTAB
/begin COMPU_METHOD FORMULA_0544 "FORMULA_0544" TAB_VERB "%5.0" "-" COMPU_TAB_REF FORMULA_0544_VTAB /end COMPU_METHOD
/begin COMPU_VTAB FORMULA_0544_VTAB "FORMULA_0544_VTAB" TAB_VERB 1 0 "Zyl. 8 ok." DEFAULT_VALUE "Kat-Auss. Zyl. 8." /end COMPU_VTAB
/begin COMPU_METHOD FORMULA_0545 "FORMULA_0545" TAB_VERB "%5.0" "-" COMPU_TAB_REF FORMULA_0545_VTAB /end COMPU_METHOD
/begin COMPU_VTAB FORMULA_0545_VTAB "FORMULA_0545_VTAB" TAB_VERB 1 0 "Zyl. 9 ok." DEFAULT_VALUE "Kat-Auss. Zyl. 9." /end COMPU_VTAB
/begin COMPU_METHOD FORMULA_0546 "FORMULA_0546" TAB_VERB "%5.0" "-" COMPU_TAB_REF FORMULA_0546_VTAB /end COMPU_METHOD
/begin COMPU_VTAB FORMULA_0546_VTAB "FORMULA_0546_VTAB" TAB_VERB 1 0 "Zyl. 10 ok." DEFAULT_VALUE "Kat-Auss. Zyl. 10." /end COMPU_VTAB
/begin COMPU_METHOD FORMULA_0547 "FORMULA_0547" TAB_VERB "%5.0" "-" COMPU_TAB_REF FORMULA_0547_VTAB /end COMPU_METHOD
/begin COMPU_VTAB FORMULA_0547_VTAB "FORMULA_0547_VTAB" TAB_VERB 1 0 "kein Abgas-Aussetzer" DEFAULT_VALUE "Abgas-Aussetzer erkannt" /end COMPU_VTAB
/begin COMPU_METHOD FORMULA_0548 "FORMULA_0548" TAB_VERB "%5.0" "-" COMPU_TAB_REF FORMULA_0548_VTAB /end COMPU_METHOD
/begin COMPU_VTAB FORMULA_0548_VTAB "FORMULA_0548_VTAB" TAB_VERB 1 0 "Zyl. 1 ok." DEFAULT_VALUE "Abgas-Auss. Zyl. 1." /end COMPU_VTAB
/begin COMPU_METHOD FORMULA_0549 "FORMULA_0549" TAB_VERB "%5.0" "-" COMPU_TAB_REF FORMULA_0549_VTAB /end COMPU_METHOD
/begin COMPU_VTAB FORMULA_0549_VTAB "FORMULA_0549_VTAB" TAB_VERB 1 0 "Zyl. 2 ok." DEFAULT_VALUE "Abgas-Auss. Zyl. 2." /end COMPU_VTAB
/begin COMPU_METHOD FORMULA_0550 "FORMULA_0550" TAB_VERB "%5.0" "-" COMPU_TAB_REF FORMULA_0550_VTAB /end COMPU_METHOD
/begin COMPU_VTAB FORMULA_0550_VTAB "FORMULA_0550_VTAB" TAB_VERB 1 0 "Zyl. 3 ok." DEFAULT_VALUE "Abgas-Auss. Zyl. 3." /end COMPU_VTAB
/begin COMPU_METHOD FORMULA_0551 "FORMULA_0551" TAB_VERB "%5.0" "-" COMPU_TAB_REF FORMULA_0551_VTAB /end COMPU_METHOD
/begin COMPU_VTAB FORMULA_0551_VTAB "FORMULA_0551_VTAB" TAB_VERB 1 0 "Zyl. 4 ok." DEFAULT_VALUE "Abgas-Auss. Zyl. 4." /end COMPU_VTAB
/begin COMPU_METHOD FORMULA_0552 "FORMULA_0552" TAB_VERB "%5.0" "-" COMPU_TAB_REF FORMULA_0552_VTAB /end COMPU_METHOD
/begin COMPU_VTAB FORMULA_0552_VTAB "FORMULA_0552_VTAB" TAB_VERB 1 0 "Zyl. 5 ok." DEFAULT_VALUE "Abgas-Auss. Zyl. 5." /end COMPU_VTAB
/begin COMPU_METHOD FORMULA_0553 "FORMULA_0553" TAB_VERB "%5.0" "-" COMPU_TAB_REF FORMULA_0553_VTAB /end COMPU_METHOD
/begin COMPU_VTAB FORMULA_0553_VTAB "FORMULA_0553_VTAB" TAB_VERB 1 0 "Zyl. 6 ok." DEFAULT_VALUE "Abgas-Auss. Zyl. 6." /end COMPU_VTAB
/begin COMPU_METHOD FORMULA_0554 "FORMULA_0554" TAB_VERB "%5.0" "-" COMPU_TAB_REF FORMULA_0554_VTAB /end COMPU_METHOD
/begin COMPU_VTAB FORMULA_0554_VTAB "FORMULA_0554_VTAB" TAB_VERB 1 0 "Zyl. 7 ok." DEFAULT_VALUE "Abgas-Auss. Zyl. 7." /end COMPU_VTAB
/begin COMPU_METHOD FORMULA_0555 "FORMULA_0555" TAB_VERB "%5.0" "-" COMPU_TAB_REF FORMULA_0555_VTAB /end COMPU_METHOD
/begin COMPU_VTAB FORMULA_0555_VTAB "FORMULA_0555_VTAB" TAB_VERB 1 0 "Zyl. 8 ok." DEFAULT_VALUE "Abgas-Auss. Zyl. 8." /end COMPU_VTAB
/begin COMPU_METHOD FORMULA_0556 "FORMULA_0556" TAB_VERB "%5.0" "-" COMPU_TAB_REF FORMULA_0556_VTAB /end COMPU_METHOD
/begin COMPU_VTAB FORMULA_0556_VTAB "FORMULA_0556_VTAB" TAB_VERB 1 0 "Zyl. 9 ok." DEFAULT_VALUE "Abgas-Auss. Zyl. 9." /end COMPU_VTAB
/begin COMPU_METHOD FORMULA_0557 "FORMULA_0557" TAB_VERB "%5.0" "-" COMPU_TAB_REF FORMULA_0557_VTAB /end COMPU_METHOD
/begin COMPU_VTAB FORMULA_0557_VTAB "FORMULA_0557_VTAB" TAB_VERB 1 0 "Zyl. 10 ok." DEFAULT_VALUE "Abgas-Auss. Zyl. 10." /end COMPU_VTAB
/begin COMPU_METHOD FORMULA_0558 "FORMULA_0558" TAB_VERB "%5.0" "-" COMPU_TAB_REF FORMULA_0558_VTAB /end COMPU_METHOD
/begin COMPU_VTAB FORMULA_0558_VTAB "FORMULA_0558_VTAB" TAB_VERB 1 0 "dtz ok" DEFAULT_VALUE "dtz zu gross" /end COMPU_VTAB
/begin COMPU_METHOD FORMULA_0559 "FORMULA_0559" TAB_VERB "%5.0" "-" COMPU_TAB_REF FORMULA_0559_VTAB /end COMPU_METHOD
/begin COMPU_VTAB FORMULA_0559_VTAB "FORMULA_0559_VTAB" TAB_VERB 1 0 "Zyl. 1 ok." DEFAULT_VALUE "dtz zu gross Zyl. 1." /end COMPU_VTAB
/begin COMPU_METHOD FORMULA_0560 "FORMULA_0560" TAB_VERB "%5.0" "-" COMPU_TAB_REF FORMULA_0560_VTAB /end COMPU_METHOD
/begin COMPU_VTAB FORMULA_0560_VTAB "FORMULA_0560_VTAB" TAB_VERB 1 0 "Zyl. 2 ok." DEFAULT_VALUE "dtz zu gross Zyl. 2." /end COMPU_VTAB
/begin COMPU_METHOD FORMULA_0561 "FORMULA_0561" TAB_VERB "%5.0" "-" COMPU_TAB_REF FORMULA_0561_VTAB /end COMPU_METHOD
/begin COMPU_VTAB FORMULA_0561_VTAB "FORMULA_0561_VTAB" TAB_VERB 1 0 "Zyl. 3 ok." DEFAULT_VALUE "dtz zu gross Zyl. 3." /end COMPU_VTAB
/begin COMPU_METHOD FORMULA_0562 "FORMULA_0562" TAB_VERB "%5.0" "-" COMPU_TAB_REF FORMULA_0562_VTAB /end COMPU_METHOD
/begin COMPU_VTAB FORMULA_0562_VTAB "FORMULA_0562_VTAB" TAB_VERB 1 0 "Zyl. 4 ok." DEFAULT_VALUE "dtz zu gross Zyl. 4." /end COMPU_VTAB
/begin COMPU_METHOD FORMULA_0563 "FORMULA_0563" TAB_VERB "%5.0" "-" COMPU_TAB_REF FORMULA_0563_VTAB /end COMPU_METHOD
/begin COMPU_VTAB FORMULA_0563_VTAB "FORMULA_0563_VTAB" TAB_VERB 1 0 "Zyl. 5 ok." DEFAULT_VALUE "dtz zu gross Zyl. 5." /end COMPU_VTAB
/begin COMPU_METHOD FORMULA_0564 "FORMULA_0564" TAB_VERB "%5.0" "-" COMPU_TAB_REF FORMULA_0564_VTAB /end COMPU_METHOD
/begin COMPU_VTAB FORMULA_0564_VTAB "FORMULA_0564_VTAB" TAB_VERB 1 0 "Zyl. 6 ok." DEFAULT_VALUE "dtz zu gross Zyl. 6." /end COMPU_VTAB
/begin COMPU_METHOD FORMULA_0565 "FORMULA_0565" TAB_VERB "%5.0" "-" COMPU_TAB_REF FORMULA_0565_VTAB /end COMPU_METHOD
/begin COMPU_VTAB FORMULA_0565_VTAB "FORMULA_0565_VTAB" TAB_VERB 1 0 "Zyl. 7 ok." DEFAULT_VALUE "dtz zu gross Zyl. 7." /end COMPU_VTAB
/begin COMPU_METHOD FORMULA_0566 "FORMULA_0566" TAB_VERB "%5.0" "-" COMPU_TAB_REF FORMULA_0566_VTAB /end COMPU_METHOD
/begin COMPU_VTAB FORMULA_0566_VTAB "FORMULA_0566_VTAB" TAB_VERB 1 0 "Zyl. 8 ok." DEFAULT_VALUE "dtz zu gross Zyl. 8." /end COMPU_VTAB
/begin COMPU_METHOD FORMULA_0567 "FORMULA_0567" TAB_VERB "%5.0" "-" COMPU_TAB_REF FORMULA_0567_VTAB /end COMPU_METHOD
/begin COMPU_VTAB FORMULA_0567_VTAB "FORMULA_0567_VTAB" TAB_VERB 1 0 "Zyl. 9 ok." DEFAULT_VALUE "dtz zu gross Zyl. 9." /end COMPU_VTAB
/begin COMPU_METHOD FORMULA_0568 "FORMULA_0568" TAB_VERB "%5.0" "-" COMPU_TAB_REF FORMULA_0568_VTAB /end COMPU_METHOD
/begin COMPU_VTAB FORMULA_0568_VTAB "FORMULA_0568_VTAB" TAB_VERB 1 0 "Zyl. 10 ok." DEFAULT_VALUE "dtz zu gross Zyl. 10." /end COMPU_VTAB
/begin COMPU_METHOD FORMULA_0569 "FORMULA_0569" RAT_FUNC "%5.0" "us" COEFFS 0 1 0 0 0 4 /end COMPU_METHOD
/begin COMPU_METHOD FORMULA_0570 "FORMULA_0570" RAT_FUNC "%7.2" "%" COEFFS 0 163.84 0 0 0 1 /end COMPU_METHOD
/begin COMPU_METHOD FORMULA_0571 "FORMULA_0571" RAT_FUNC "%5.0" "Nm/s" COEFFS 0 1 0 0 0 20 /end COMPU_METHOD
/begin COMPU_METHOD FORMULA_0572 "FORMULA_0572" RAT_FUNC "%7.2" "-" COEFFS 0 255 0 0 0 1 /end COMPU_METHOD
/begin COMPU_METHOD FORMULA_0573 "FORMULA_0573" RAT_FUNC "%9.4" "V" COEFFS 0 1 0 0 0 0.00080566 /end COMPU_METHOD
/begin COMPU_METHOD FORMULA_0574 "FORMULA_0574" TAB_VERB "%3.0" "-" COMPU_TAB_REF FORMULA_0574_VTAB /end COMPU_METHOD
/begin COMPU_VTAB FORMULA_0574_VTAB "FORMULA_0574_VTAB" TAB_VERB 2 0 "Aus" 1 "Ein" DEFAULT_VALUE "undefiniert" /end COMPU_VTAB
/begin COMPU_METHOD FORMULA_0575 "FORMULA_0575" TAB_VERB "%3.0" "-" COMPU_TAB_REF FORMULA_0575_VTAB /end COMPU_METHOD
/begin COMPU_VTAB FORMULA_0575_VTAB "FORMULA_0575_VTAB" TAB_VERB 2 0 "Fest" 1 "Adaptiert" DEFAULT_VALUE "undefiniert" /end COMPU_VTAB
/begin COMPU_METHOD FORMULA_0576 "FORMULA_0576" RAT_FUNC "%6.3" "-/asp" COEFFS 0 256 0 0 0 1 /end COMPU_METHOD
/begin COMPU_METHOD FORMULA_0577 "FORMULA_0577" RAT_FUNC "%7.2" "-" COEFFS 0 256 0 0 0 1 /end COMPU_METHOD
/begin COMPU_METHOD FORMULA_0578 "FORMULA_0578" RAT_FUNC "%7.2" "%" COEFFS 0 40.95 0 0 0 1 /end COMPU_METHOD
/begin COMPU_METHOD FORMULA_0579 "FORMULA_0579" RAT_FUNC "%11.4" "-" COEFFS 0 1 0 0 0 1 /end COMPU_METHOD
/begin COMPU_METHOD FORMULA_0590 "FORMULA_0590" RAT_FUNC "%3.0" "ms" COEFFS 0 1 0 0 0 5 /end COMPU_METHOD
/* ------------------ Abschnitt erzeugt aus ub.dat ------------------ */
/begin COMPU_METHOD FORMULA_1044 "FORMULA_1044" RAT_FUNC "%8.3" "V/5ms" COEFFS 0 1 0 0 0 0.00155892 /end COMPU_METHOD
/* ------------------ Abschnitt erzeugt aus crc32.dat ------------------ */
/begin MEASUREMENT crc32_result "Ergebnis der CRC-Berechnungen" UBYTE FORMULA_0039 0 0 0.0 255.0 ECU_ADDRESS 0x3FB52C /end MEASUREMENT
/begin MEASUREMENT crc32_data_st "Status CRC-Berechnung" UBYTE FORMULA_0040 0 0 0.0 255.0 ECU_ADDRESS 0x3FB52D /end MEASUREMENT
/begin MEASUREMENT crc32_prog_st "Status CRC-Berechnung" UBYTE FORMULA_0040 0 0 0.0 255.0 ECU_ADDRESS 0x3FB52E /end MEASUREMENT
/begin MEASUREMENT crc32_boot_st "Status CRC-Berechnung" UBYTE FORMULA_0040 0 0 0.0 255.0 ECU_ADDRESS 0x3FB52F /end MEASUREMENT
/begin MEASUREMENT crc32_boot "Booter-CRC" ULONG FORMULA_0000 0 0 0.0 4294967295.0000 ECU_ADDRESS 0x3FB530 /end MEASUREMENT
/begin MEASUREMENT crc32_prog "Programm-CRC" ULONG FORMULA_0000 0 0 0.0 4294967295.0000 ECU_ADDRESS 0x3FB534 /end MEASUREMENT
/begin MEASUREMENT crc32_data "Daten-CRC" ULONG FORMULA_0000 0 0 0.0 4294967295.0000 ECU_ADDRESS 0x3FB538 /end MEASUREMENT
/* ------------------ Abschnitt erzeugt aus os.dat ------------------ */
/begin MEASUREMENT os_err.id.cnt "OS-Err: ID" UBYTE FORMULA_0003 0 0 0.0 255.0000 ECU_ADDRESS 0x3FC15C /end MEASUREMENT
/begin MEASUREMENT os_err.id.task "OS-Err: ID" UBYTE FORMULA_0350 0 0 0.0 255.0 ECU_ADDRESS 0x3FC15D /end MEASUREMENT
/begin MEASUREMENT os_err.limit.cnt "OS-Err: Limit" UBYTE FORMULA_0003 0 0 0.0 255.0000 ECU_ADDRESS 0x3FC15E /end MEASUREMENT
/begin MEASUREMENT os_err.limit.task "OS-Err: Limit" UBYTE FORMULA_0350 0 0 0.0 255.0 ECU_ADDRESS 0x3FC15F /end MEASUREMENT
/begin MEASUREMENT os_err.tt_act.cnt "OS-Err: TT aktiv" UBYTE FORMULA_0003 0 0 0.0 255.0000 ECU_ADDRESS 0x3FC160 /end MEASUREMENT
/begin MEASUREMENT os_err.tt_act.task "OS-Err: TT aktiv" UBYTE FORMULA_0350 0 0 0.0 255.0 ECU_ADDRESS 0x3FC161 /end MEASUREMENT
/begin MEASUREMENT os_err.no_fnc.cnt "OS-Err: No Fkt" UBYTE FORMULA_0003 0 0 0.0 255.0000 ECU_ADDRESS 0x3FC162 /end MEASUREMENT
/begin MEASUREMENT os_err.no_fnc.task "OS-Err: No Fkt" UBYTE FORMULA_0350 0 0 0.0 255.0 ECU_ADDRESS 0x3FC163 /end MEASUREMENT
/begin MEASUREMENT os_err.tt_miss.cnt "OS-Err: TT missing" UBYTE FORMULA_0003 0 0 0.0 255.0000 ECU_ADDRESS 0x3FC164 /end MEASUREMENT
/begin MEASUREMENT os_err.tt_miss.task "OS-Err: TT missing" UBYTE FORMULA_0350 0 0 0.0 255.0 ECU_ADDRESS 0x3FC165 /end MEASUREMENT
/begin MEASUREMENT os_err.stack.cnt "OS-Err: Stack" UBYTE FORMULA_0003 0 0 0.0 255.0000 ECU_ADDRESS 0x3FC166 /end MEASUREMENT
/begin MEASUREMENT os_err.stack.task "OS-Err: Stack" UBYTE FORMULA_0350 0 0 0.0 255.0 ECU_ADDRESS 0x3FC167 /end MEASUREMENT
/begin MEASUREMENT os_err.fifo.cnt "OS-Err: FIFO full" UBYTE FORMULA_0003 0 0 0.0 255.0000 ECU_ADDRESS 0x3FC168 /end MEASUREMENT
/begin MEASUREMENT os_err.fifo.task "OS-Err: FIFO full" UBYTE FORMULA_0350 0 0 0.0 255.0 ECU_ADDRESS 0x3FC169 /end MEASUREMENT
/begin MEASUREMENT os_err.value.cnt "OS-Err: Value" UBYTE FORMULA_0003 0 0 0.0 255.0000 ECU_ADDRESS 0x3FC16A /end MEASUREMENT
/begin MEASUREMENT os_err.value.task "OS-Err: Value" UBYTE FORMULA_0350 0 0 0.0 255.0 ECU_ADDRESS 0x3FC16B /end MEASUREMENT
/begin MEASUREMENT os_err.deadline.cnt "OS-Err: Deadline" UBYTE FORMULA_0003 0 0 0.0 255.0000 ECU_ADDRESS 0x3FC16C /end MEASUREMENT
/begin MEASUREMENT os_err.deadline.task "OS-Err: Deadline" UBYTE FORMULA_0350 0 0 0.0 255.0 ECU_ADDRESS 0x3FC16D /end MEASUREMENT
/begin MEASUREMENT os_err.dflt.cnt "OS-Err: Default" UBYTE FORMULA_0003 0 0 0.0 255.0000 ECU_ADDRESS 0x3FC16E /end MEASUREMENT
/begin MEASUREMENT os_err.dflt.task "OS-Err: Default" UBYTE FORMULA_0350 0 0 0.0 255.0 ECU_ADDRESS 0x3FC16F /end MEASUREMENT
/begin MEASUREMENT os_err.addr "OS-Err: Adresse" ULONG FORMULA_0000 0 0 0.0 4294967295.0000 ECU_ADDRESS 0x3FC170 /end MEASUREMENT
/begin MEASUREMENT os_err.sum_cnt "OS-Err: Summe" UBYTE FORMULA_0003 0 0 0.0 255.0000 ECU_ADDRESS 0x3FC174 /end MEASUREMENT
/begin MEASUREMENT os_err.type "Fehlertyp" UBYTE FORMULA_0351 0 0 0.0 255.0 ECU_ADDRESS 0x3FC175 /end MEASUREMENT
/* ------------------ Abschnitt erzeugt aus afz.dat ------------------ */
/begin CHARACTERISTIC K_AFZ_TAU "Filterkonstante fuer die Beschleunigung Fahrzeug" VALUE 0x70294 TKW_VV_VV_UB 100.0 FORMULA_0462 0.0101 2.5600 /end CHARACTERISTIC
/begin CHARACTERISTIC K_AFZ_BERG_TAU "Filterkonstante fuer die Fahrbahnneigung" VALUE 0x70295 TKW_VV_VV_UB 100.0 FORMULA_0462 0.0101 2.5600 /end CHARACTERISTIC
/begin CHARACTERISTIC K_AFZ_A0_MIN "minimaler Nullpunktadaptionwert" VALUE 0x70296 TKW_VV_VV_SW 100.0 FORMULA_0123 0.0 1023.0000 /end CHARACTERISTIC
/begin CHARACTERISTIC K_AFZ_A0_MAX "maximaler Nullpunktadaptionwert" VALUE 0x70298 TKW_VV_VV_SW 100.0 FORMULA_0123 0.0 1023.0000 /end CHARACTERISTIC
/begin CHARACTERISTIC K_AFZ_DIAG_MIN "elektrische Diagnoseschwelle short-to-gnd" VALUE 0x7029A TKW_VV_VV_SW 100.0 FORMULA_0123 0.0 1023.0000 /end CHARACTERISTIC
/begin CHARACTERISTIC K_AFZ_DIAG_MAX "elektrische Diagnoseschwelle short-to-ub" VALUE 0x7029C TKW_VV_VV_SW 100.0 FORMULA_0123 0.0 1023.0000 /end CHARACTERISTIC
/begin CHARACTERISTIC K_AFZ_DIAG_AX "Bandgrenze Beschl. Fzg - Beschl. DSC" VALUE 0x7029E TKW_VV_VV_SW 100.0 FORMULA_0132 -50.0000 50.0000 FORMAT "%5.2" /end CHARACTERISTIC
/begin CHARACTERISTIC K_AFZ_DIAG_T "Timergrenze, um Diagnose zu beenden" VALUE 0x702A0 TKW_VV_VV_UW 100.0 FORMULA_0021 0.0 655.0000 FORMAT "%5.2" /end CHARACTERISTIC
/begin CHARACTERISTIC K_AFZ_F_KONV_ZAEHLER "Konvertierungsfaktor Zaehler AD-Wert nach Beschleunigung" VALUE 0x702A2 TKW_VV_VV_SW 100.0 FORMULA_0010 -32768.0000 32767.0000 /end CHARACTERISTIC
/begin CHARACTERISTIC K_AFZ_F_KONV_NENNER "Konvertierungsfaktor Nenner AD-Wert nach Beschleunigung" VALUE 0x702A4 TKW_VV_VV_SW 100.0 FORMULA_0010 -32768.0000 32767.0000 /end CHARACTERISTIC
/begin CHARACTERISTIC K_AFZ_A0 "applizierbarer Adaptionswert" VALUE 0x702A6 TKW_VV_VV_SW 100.0 FORMULA_0458 -50.0000 50.0000 FORMAT "%5.2" /end CHARACTERISTIC
/begin CHARACTERISTIC K_AFZ_A0_CNT_MAX "Zaehlerwert zum Beenden der Adaption" VALUE 0x702A8 TKW_VV_VV_UB 100.0 FORMULA_0003 0.0 255.0000 /end CHARACTERISTIC
/begin CHARACTERISTIC K_AFZ_MD_KUPP_WUNSCH_GES_MAX "max. Wunschmoment fuer Nachadaption" VALUE 0x702AA TKW_VV_VV_SW 100.0 FORMULA_0009 -100.0000 1000.0000 FORMAT "%4.1" /end CHARACTERISTIC
/begin CHARACTERISTIC K_AFZ_CAN_BRP_MAX "max. Bremsdruck fuer Nachadaption" VALUE 0x702AC TKW_VV_VV_UB 100.0 FORMULA_0138 0.0 200.0000 /end CHARACTERISTIC
/begin CHARACTERISTIC K_AFZ_V_DIREKT_WEG "Wegintervall fuer Nachadaption" VALUE 0x702B0 TKW_VV_VV_UL 100.0 FORMULA_0460 0.0 2684354.5593 FORMAT "%4.1" /end CHARACTERISTIC
/begin CHARACTERISTIC K_AFZ_NA0_CNT2_MAX "Anzahl der Durchschnittswerte fuer Nachadaption" VALUE 0x702B4 TKW_VV_VV_UW 100.0 FORMULA_0010 0.0 65535.0000 /end CHARACTERISTIC
/begin CHARACTERISTIC K_AFZ_NA0_FAK "Faktor Nachadaption" VALUE 0x702B6 TKW_VV_VV_SW 100.0 FORMULA_0463 -200.0000 200.0000 FORMAT "%4.1" /end CHARACTERISTIC
/begin MEASUREMENT afz_ad "AD-Wert fuer Laengsbeschleunigung Fahrzeug" SWORD FORMULA_0123 0 0 0.0 1023.0000 ECU_ADDRESS 0x3FB15C /end MEASUREMENT
/begin MEASUREMENT afz_roh "entspr. Versorgungsspg korrigierte Laengsbeschleunigung" SWORD FORMULA_0123 0 0 0.0 1023.0000 ECU_ADDRESS 0x3FB15E /end MEASUREMENT
/begin MEASUREMENT afz_diag_timer "Diagnosetimer Laengsbeschleunigung Fahrzeug" UWORD FORMULA_0021 0 0 0.0 655.0000 ECU_ADDRESS 0x3FB160 /end MEASUREMENT
/begin MEASUREMENT afz_fil_pt1 "Filter Messwert der Laengsbeschleunigung Fahrzeug" SWORD FORMULA_0459 0 0 -50.0000 50.0000 ECU_ADDRESS 0x3FB162 /end MEASUREMENT
/begin MEASUREMENT afz_fil "Gefilterter Messwert der Laengsbeschleunigung Fahrzeug" SWORD FORMULA_0458 0 0 -50.0000 50.0000 ECU_ADDRESS 0x3FB164 /end MEASUREMENT
/begin MEASUREMENT afz_berech "Laengsbeschleunigung Fahrzeug, berechnet" SWORD FORMULA_0132 0 0 -50.0000 50.0000 ECU_ADDRESS 0x3FB166 /end MEASUREMENT
/begin MEASUREMENT afz_a0_cnt "Zaehler zum Starten/Beenden der Adaption" UBYTE FORMULA_0003 0 0 0.0 255.0000 ECU_ADDRESS 0x3FB168 /end MEASUREMENT
/begin MEASUREMENT afz_a0_sum "Zwischensumme zum Berechnen des Adaptionswertes" SWORD FORMULA_0010 0 0 -32768.0000 32767.0000 ECU_ADDRESS 0x3FB16A /end MEASUREMENT
/begin MEASUREMENT afz_v_direkt_weg_alt "Wegmessung ueber v_direkt_weg" ULONG FORMULA_0460 0 0 0.0 2684354.5593 ECU_ADDRESS 0x3FB16C /end MEASUREMENT
/begin MEASUREMENT afz_na0_avg1 "kurzfristige, durchschn. Laengsbeschleunigung" SWORD FORMULA_0458 0 0 -50.0000 50.0000 ECU_ADDRESS 0x3FB170 /end MEASUREMENT
/begin MEASUREMENT afz_na0_avg2 "langfristige, durchschn. Laengsbeschleunigung; Nachadaptionswert" SWORD FORMULA_0458 0 0 -50.0000 50.0000 ECU_ADDRESS 0x3FB172 /end MEASUREMENT
/begin MEASUREMENT afz_can_ax_fil_pt1 "Filter Laengsbeschleunigung DSC" SWORD FORMULA_0461 0 0 -50.0000 50.0000 ECU_ADDRESS 0x3FB174 /end MEASUREMENT
/begin MEASUREMENT afz_can_ax_fil "Laengsbeschleunigung DSC, gefiltert" SWORD FORMULA_0132 0 0 -50.0000 50.0000 ECU_ADDRESS 0x3FB176 /end MEASUREMENT
/begin MEASUREMENT afz_berg_pt1 "Filter Laengsbeschleunigung Fahrbahnneigung" SWORD FORMULA_0461 0 0 -50.0000 50.0000 ECU_ADDRESS 0x3FB178 /end MEASUREMENT
/* ------------------ Abschnitt erzeugt aus ag_tz.dat ------------------ */
/begin CHARACTERISTIC K_AG_TZ_CFG "Welcher Aussetzergenerator" VALUE 0x702B8 TKW_VV_VV_UB 100.0 FORMULA_0465 0.0 3.0 /end CHARACTERISTIC
/begin CHARACTERISTIC K_AG_TZ_ZYL "Statisches Ausblendmuster. | EN: Static suppression pattern" VALUE 0x702BA TKW_VV_VV_UW 100.0 FORMULA_0010 0.0 65535.0000 /end CHARACTERISTIC
/begin CHARACTERISTIC K_AG_TZ_ANZ "Anzahl der unmittelbar aufeinanderfolgenden Ausblendungen. | EN: Number of directly consecutive suppressions" VALUE 0x702BC TKW_VV_VV_UW 100.0 FORMULA_0010 0.0 65535.0000 /end CHARACTERISTIC
/begin CHARACTERISTIC K_AG_TZ_PAUSE "Anzahl der Arbeitsspiele zwischen Ausblendungen. | EN: Number of working cycles between suppressions" VALUE 0x702BE TKW_VV_VV_UW 100.0 FORMULA_0010 0.0 65535.0000 /end CHARACTERISTIC
/begin CHARACTERISTIC K_AG_TZ_V_MIN "Minimale Geschwindigkeitsschwelle. | EN: Minimum vehicle speed threshold [km/h]" VALUE 0x702C0 TKW_VV_VV_SW 100.0 FORMULA_0078 -80.0000 360.0000 FORMAT "%4.1" /end CHARACTERISTIC
/begin MEASUREMENT ag_tz_zyl "Naechster Zylinder der ausgeblendet wird." UBYTE FORMULA_0403 0 0 1.0000 12.0000 ECU_ADDRESS 0x3FB17A /end MEASUREMENT
/begin MEASUREMENT ag_tz_exd_state "Exd-State." UBYTE FORMULA_0464 0 0 0.0 255.0 ECU_ADDRESS 0x3FB17B /end MEASUREMENT
/begin MEASUREMENT ag_tz_cfg_ctrl "Welcher Aussetzergenerator" UBYTE FORMULA_0465 0 0 0.0 3.0 ECU_ADDRESS 0x3FB17C /end MEASUREMENT
/begin MEASUREMENT ag_tz_zyl_ctrl "Statisches Ausblendmuster." UWORD FORMULA_0010 0 0 0.0 65535.0000 ECU_ADDRESS 0x3FB17E /end MEASUREMENT
/begin MEASUREMENT ag_tz_anz_ctrl "Anzahl der unmittelbar aufeinanderfolgenden Ausblendungen." UWORD FORMULA_0010 0 0 0.0 65535.0000 ECU_ADDRESS 0x3FB180 /end MEASUREMENT
/begin MEASUREMENT ag_tz_pause_ctrl "Anzahl der Arbeitsspiele zwischen Ausblendungen." UWORD FORMULA_0010 0 0 0.0 65535.0000 ECU_ADDRESS 0x3FB182 /end MEASUREMENT
/begin MEASUREMENT ag_tz_anz "Zaehler der unmittelbar aufeinanderfolgenden Ausblendungen." UWORD FORMULA_0010 0 0 0.0 65535.0000 ECU_ADDRESS 0x3FB184 /end MEASUREMENT
/begin MEASUREMENT ag_tz_pause "Zaehler der Arbeitsspiele zwischen Ausblendungen." UWORD FORMULA_0010 0 0 0.0 65535.0000 ECU_ADDRESS 0x3FB186 /end MEASUREMENT
/begin MEASUREMENT ag_tz_mask "Status Aussetzergenerator." UWORD FORMULA_0466 0 0 0.0 4095.0 ECU_ADDRESS 0x3FB188 /end MEASUREMENT
/begin MEASUREMENT ag_tz_mask_zyl1 "Ausblendung Zylinder 1." UWORD FORMULA_0467 0 0 0.0 1.0 ECU_ADDRESS 0x3FB188 BIT_MASK 0x1 /end MEASUREMENT
/begin MEASUREMENT ag_tz_mask_zyl2 "Ausblendung Zylinder 2." UWORD FORMULA_0468 0 0 0.0 1.0 ECU_ADDRESS 0x3FB188 BIT_MASK 0x2 /end MEASUREMENT
/begin MEASUREMENT ag_tz_mask_zyl3 "Ausblendung Zylinder 3." UWORD FORMULA_0469 0 0 0.0 1.0 ECU_ADDRESS 0x3FB188 BIT_MASK 0x4 /end MEASUREMENT
/begin MEASUREMENT ag_tz_mask_zyl4 "Ausblendung Zylinder 4." UWORD FORMULA_0470 0 0 0.0 1.0 ECU_ADDRESS 0x3FB188 BIT_MASK 0x8 /end MEASUREMENT
/begin MEASUREMENT ag_tz_mask_zyl5 "Ausblendung Zylinder 5." UWORD FORMULA_0471 0 0 0.0 1.0 ECU_ADDRESS 0x3FB188 BIT_MASK 0x10 /end MEASUREMENT
/begin MEASUREMENT ag_tz_mask_zyl6 "Ausblendung Zylinder 6." UWORD FORMULA_0472 0 0 0.0 1.0 ECU_ADDRESS 0x3FB188 BIT_MASK 0x20 /end MEASUREMENT
/begin MEASUREMENT ag_tz_mask_zyl7 "Ausblendung Zylinder 7." UWORD FORMULA_0473 0 0 0.0 1.0 ECU_ADDRESS 0x3FB188 BIT_MASK 0x40 /end MEASUREMENT
/begin MEASUREMENT ag_tz_mask_zyl8 "Ausblendung Zylinder 8." UWORD FORMULA_0474 0 0 0.0 1.0 ECU_ADDRESS 0x3FB188 BIT_MASK 0x80 /end MEASUREMENT
/begin MEASUREMENT ag_tz_mask_zyl9 "Ausblendung Zylinder 9." UWORD FORMULA_0475 0 0 0.0 1.0 ECU_ADDRESS 0x3FB188 BIT_MASK 0x100 /end MEASUREMENT
/begin MEASUREMENT ag_tz_mask_zyl10 "Ausblendung Zylinder 10." UWORD FORMULA_0476 0 0 0.0 1.0 ECU_ADDRESS 0x3FB188 BIT_MASK 0x200 /end MEASUREMENT
/* ------------------ Abschnitt erzeugt aus ar.dat ------------------ */
/begin CHARACTERISTIC K_AR_CFG "Konfiguration | EN: Configuration" VALUE 0x7039A TKW_VV_VV_UB 100.0 FORMULA_0483 0.0 255.0 /end CHARACTERISTIC
/begin CHARACTERISTIC K_AR_N_MIN "min. Schwelle | EN: Minimum threshold" VALUE 0x7039C TKW_VV_VV_SW 100.0 FORMULA_0006 0.0 10000.0000 /end CHARACTERISTIC
/begin CHARACTERISTIC K_AR_N_MAX "max. Schwelle | EN: Maximum threshold" VALUE 0x7039E TKW_VV_VV_SW 100.0 FORMULA_0006 0.0 10000.0000 /end CHARACTERISTIC
/begin CHARACTERISTIC K_AR_T_PAS_DELAY "Delay nach Sperre | EN: Delay after lock-out" VALUE 0x703A0 TKW_VV_VV_UW 100.0 FORMULA_0117 0.0 325.0000 FORMAT "%5.2" /end CHARACTERISTIC
/begin CHARACTERISTIC K_AR_T_MAX "max. AR-Eingriffszeit | EN: Maximum anti-jerk intervention time" VALUE 0x703A2 TKW_VV_VV_UW 100.0 FORMULA_0117 0.0 325.0000 FORMAT "%5.2" /end CHARACTERISTIC
/begin CHARACTERISTIC K_AR_N_DIF_BESCHL_1 "Schwelle fuer 1. BWelle | EN: Threshold for 1st acceleration wave" VALUE 0x703A4 TKW_VV_VV_SW 100.0 FORMULA_0006 -10000.0000 10000.0000 /end CHARACTERISTIC
/begin CHARACTERISTIC K_AR_N_DIF_BESCHL_2 "Schwelle fuer 2. BWelle | EN: Threshold for 2nd acceleration wave" VALUE 0x703A6 TKW_VV_VV_SW 100.0 FORMULA_0006 -10000.0000 10000.0000 /end CHARACTERISTIC
/begin CHARACTERISTIC K_AR_N_DIF_VERZ_1 "Schwelle fuer 1. VWelle | EN: Threshold for 1st deceleration wave" VALUE 0x703A8 TKW_VV_VV_SW 100.0 FORMULA_0006 -10000.0000 10000.0000 /end CHARACTERISTIC
/begin CHARACTERISTIC K_AR_N_DIF_VERZ_2 "Schwelle fuer 2. VWelle | EN: Threshold for 2nd deceleration wave" VALUE 0x703AA TKW_VV_VV_SW 100.0 FORMULA_0006 -10000.0000 10000.0000 /end CHARACTERISTIC
/begin CHARACTERISTIC K_AR_N_DIF_REF_MIN "min. Differenz | EN: Minimum difference" VALUE 0x703AC TKW_VV_VV_SW 100.0 FORMULA_0006 -10000.0000 10000.0000 /end CHARACTERISTIC
/begin CHARACTERISTIC K_AR_N_DIF_REF_MAX "max. Differenz | EN: Maximum difference" VALUE 0x703AE TKW_VV_VV_SW 100.0 FORMULA_0006 -10000.0000 10000.0000 /end CHARACTERISTIC
/begin CHARACTERISTIC K_AR_KORR_P_R "P-Anteil zum Aufregeln auf n | EN: P share for ramping up to target rpm" VALUE 0x703B0 TKW_VV_VV_UW 100.0 FORMULA_0484 0.0 8.0000 FORMAT "%5.2" /end CHARACTERISTIC
/begin CHARACTERISTIC K_AR_KORR_P_N "P-Anteil zum Aufregeln auf n | EN: P share for ramping up to target rpm" VALUE 0x703B2 TKW_VV_VV_UW 100.0 FORMULA_0484 0.0 8.0000 FORMAT "%5.2" /end CHARACTERISTIC
/begin CHARACTERISTIC K_AR_KORR_P_1 "P-Anteil zum Aufregeln auf n | EN: P share for ramping up to target rpm" VALUE 0x703B4 TKW_VV_VV_UW 100.0 FORMULA_0484 0.0 8.0000 FORMAT "%5.2" /end CHARACTERISTIC
/begin CHARACTERISTIC K_AR_KORR_P_2 "P-Anteil zum Aufregeln auf n | EN: P share for ramping up to target rpm" VALUE 0x703B6 TKW_VV_VV_UW 100.0 FORMULA_0484 0.0 8.0000 FORMAT "%5.2" /end CHARACTERISTIC
/begin CHARACTERISTIC K_AR_KORR_P_3 "P-Anteil zum Aufregeln auf n | EN: P share for ramping up to target rpm" VALUE 0x703B8 TKW_VV_VV_UW 100.0 FORMULA_0484 0.0 8.0000 FORMAT "%5.2" /end CHARACTERISTIC
/begin CHARACTERISTIC K_AR_KORR_P_4 "P-Anteil zum Aufregeln auf n | EN: P share for ramping up to target rpm" VALUE 0x703BA TKW_VV_VV_UW 100.0 FORMULA_0484 0.0 8.0000 FORMAT "%5.2" /end CHARACTERISTIC
/begin CHARACTERISTIC K_AR_KORR_P_5 "P-Anteil zum Aufregeln auf n | EN: P share for ramping up to target rpm" VALUE 0x703BC TKW_VV_VV_UW 100.0 FORMULA_0484 0.0 8.0000 FORMAT "%5.2" /end CHARACTERISTIC
/begin CHARACTERISTIC K_AR_KORR_P_6 "P-Anteil zum Aufregeln auf n | EN: P share for ramping up to target rpm" VALUE 0x703BE TKW_VV_VV_UW 100.0 FORMULA_0484 0.0 8.0000 FORMAT "%5.2" /end CHARACTERISTIC
/begin CHARACTERISTIC K_AR_KORR_P_7 "P-Anteil zum Aufregeln auf n | EN: P share for ramping up to target rpm" VALUE 0x703C0 TKW_VV_VV_UW 100.0 FORMULA_0484 0.0 8.0000 FORMAT "%5.2" /end CHARACTERISTIC
/begin CHARACTERISTIC K_AR_N_FIL_0 "Filterkonstante | EN: Filter constant" VALUE 0x703C2 TKW_VV_VV_SW 100.0 FORMULA_0485 -0.0300 0.0300 FORMAT "%7.4" /end CHARACTERISTIC
/begin CHARACTERISTIC K_AR_N_FIL_1 "Filterkonstante | EN: Filter constant" VALUE 0x703C4 TKW_VV_VV_SW 100.0 FORMULA_0485 -0.0300 0.0300 FORMAT "%7.4" /end CHARACTERISTIC
/begin CHARACTERISTIC K_AR_N_FIL_2 "Filterkonstante | EN: Filter constant" VALUE 0x703C6 TKW_VV_VV_SW 100.0 FORMULA_0485 -0.0300 0.0300 FORMAT "%7.4" /end CHARACTERISTIC
/begin CHARACTERISTIC K_AR_N_FIL_3 "Filterkonstante | EN: Filter constant" VALUE 0x703C8 TKW_VV_VV_SW 100.0 FORMULA_0295 -2.0000 1.9900 FORMAT "%7.4" /end CHARACTERISTIC
/begin CHARACTERISTIC K_AR_N_FIL_4 "Filterkonstante | EN: Filter constant" VALUE 0x703CA TKW_VV_VV_SW 100.0 FORMULA_0295 -2.0000 1.9900 FORMAT "%7.4" /end CHARACTERISTIC
/begin CHARACTERISTIC K_AR_FAK_KOMFORT "Wichtungsfaktor bei Komfort | EN: Weighting factor in Comfort mode" VALUE 0x703CC TKW_VV_VV_UW 100.0 FORMULA_0075 0.0 4.0000 FORMAT "%6.3" /end CHARACTERISTIC
/begin CHARACTERISTIC K_AR_FAK_SPORT "Wichtungsfaktor bei Sport | EN: Weighting factor in Sport mode" VALUE 0x703CE TKW_VV_VV_UW 100.0 FORMULA_0075 0.0 4.0000 FORMAT "%6.3" /end CHARACTERISTIC
/begin CHARACTERISTIC K_AR_MD_MIN "min. Momentenanforderung | EN: Minimum torque request" VALUE 0x703D0 TKW_VV_VV_SW 100.0 FORMULA_0009 -100.0000 1000.0000 FORMAT "%4.1" /end CHARACTERISTIC
/begin CHARACTERISTIC K_AR_MD_MAX "max. Momentenanforderung | EN: Maximum torque request" VALUE 0x703D2 TKW_VV_VV_SW 100.0 FORMULA_0009 -100.0000 1000.0000 FORMAT "%4.1" /end CHARACTERISTIC
/begin CHARACTERISTIC KF_AR_MD_FAKTOR "P-Regler | EN: P controller" MAP 0x703D4 TKF_SW_SW_SW 100.0 FORMULA_0484 -2.0000 2.0000 /begin AXIS_DESCR STD_AXIS n FORMULA_0006 8 0.0 10000.0000 /end AXIS_DESCR /begin AXIS_DESCR STD_AXIS gang FORMULA_0486 8 -1.0000 10.0000 /end AXIS_DESCR FORMAT "%5.2" /end CHARACTERISTIC
/begin MEASUREMENT ar_st "Status AR" UBYTE FORMULA_0480 0 0 0.0 255.0 ECU_ADDRESS 0x3FB1D4 /end MEASUREMENT
/begin MEASUREMENT ar_state "State AR" UBYTE FORMULA_0481 0 0 0.0 255.0 ECU_ADDRESS 0x3FB1D5 /end MEASUREMENT
/begin MEASUREMENT ar_t_pas_delay "Delay nach Sperre" UWORD FORMULA_0117 0 0 0.0 325.0000 ECU_ADDRESS 0x3FB1D6 /end MEASUREMENT
/begin MEASUREMENT ar_t_max "max. AR-Eingriffszeit" UWORD FORMULA_0117 0 0 0.0 325.0000 ECU_ADDRESS 0x3FB1D8 /end MEASUREMENT
/begin MEASUREMENT ar_n_dif "Differenz" SWORD FORMULA_0006 0 0 -10000.0000 10000.0000 ECU_ADDRESS 0x3FB1DA /end MEASUREMENT
/begin MEASUREMENT ar_n_dif_last "letzte Differenz" SWORD FORMULA_0006 0 0 -10000.0000 10000.0000 ECU_ADDRESS 0x3FB1DC /end MEASUREMENT
/begin MEASUREMENT ar_md_kupp_korr "Korrektur fuer nRef" SWORD FORMULA_0009 0 0 -100.0000 1000.0000 ECU_ADDRESS 0x3FB1DE /end MEASUREMENT
/begin MEASUREMENT ar_dn "nDelta" SWORD FORMULA_0482 0 0 -10000.0000 10000.0000 ECU_ADDRESS 0x3FB1E0 /end MEASUREMENT
/begin MEASUREMENT ar_n_ref "Referenzdrehzahl" SWORD FORMULA_0006 0 0 0.0 10000.0000 ECU_ADDRESS 0x3FB1E2 /end MEASUREMENT
/begin MEASUREMENT ar_n_dif_ref_temp "Differenz ohne Begr" SWORD FORMULA_0006 0 0 -10000.0000 10000.0000 ECU_ADDRESS 0x3FB1E4 /end MEASUREMENT
/begin MEASUREMENT ar_n_dif_ref "Differenz zu nRef" SWORD FORMULA_0006 0 0 -10000.0000 10000.0000 ECU_ADDRESS 0x3FB1E6 /end MEASUREMENT
/begin MEASUREMENT ar_n_dif_ref_filt "gefilt. Differenz zu nRef" SWORD FORMULA_0006 0 0 -10000.0000 10000.0000 ECU_ADDRESS 0x3FB1E8 /end MEASUREMENT
/begin MEASUREMENT ar_md "Stellgroesse" SWORD FORMULA_0009 0 0 -100.0000 1000.0000 ECU_ADDRESS 0x3FB1EA /end MEASUREMENT
/* ------------------ Abschnitt erzeugt aus at.dat ------------------ */
/begin CHARACTERISTIC K_AT_CFG "Schalter Konfiguration Anti-Trampel-Funktion" VALUE 0x70476 TKW_VV_VV_UB 100.0 FORMULA_0495 0.0 255.0 /end CHARACTERISTIC
/begin CHARACTERISTIC K_AT_N_MIN "Minimale Motordrehzahl fuer Anti-Trampeln Eingriff" VALUE 0x70478 TKW_VV_VV_SW 100.0 FORMULA_0006 0.0 10000.0000 /end CHARACTERISTIC
/begin CHARACTERISTIC K_AT_N_MAX "Maximale Motordrehzahl fuer Anti-Trampeln Eingriff | EN: Maximale Motordrehzahl fuer Anti-Trampeln Eingriff" VALUE 0x7047A TKW_VV_VV_SW 100.0 FORMULA_0006 0.0 10000.0000 /end CHARACTERISTIC
/begin CHARACTERISTIC K_AT_SK_MAX "Maximales Notprogramm fuer Anti-Trampeln Eingriff" VALUE 0x7047C TKW_VV_VV_UB 100.0 FORMULA_0003 0.0 255.0000 /end CHARACTERISTIC
/begin CHARACTERISTIC K_AT_FG_TP_V "Grenzfrequenz TP Radgeschwindigkeit" VALUE 0x7047D TKW_VV_VV_UB 100.0 FORMULA_0496 0.0 255.0000 /end CHARACTERISTIC
/begin CHARACTERISTIC K_AT_FG_TP_N "Grenzfrequenz TP Motordrehzahl" VALUE 0x7047E TKW_VV_VV_UB 100.0 FORMULA_0496 0.0 255.0000 /end CHARACTERISTIC
/begin CHARACTERISTIC K_AT_FG_TP_TRAMPIN "Grenzfrequenz TP Trampeln" VALUE 0x7047F TKW_VV_VV_UB 100.0 FORMULA_0496 0.0 255.0000 /end CHARACTERISTIC
/begin CHARACTERISTIC K_AT_FG_TP_V_GRAD "Grenzfrequenz TP Radgeschwindigkeitsgradient" VALUE 0x70480 TKW_VV_VV_UB 100.0 FORMULA_0496 0.0 255.0000 /end CHARACTERISTIC
/begin CHARACTERISTIC K_AT_V_GRAD_UP_TAU "Zeitkonstante positiver Radgeschwindigkeitsgradient" VALUE 0x70481 TKW_VV_VV_UB 100.0 FORMULA_0478 0.0051 1.2800 /end CHARACTERISTIC
/begin CHARACTERISTIC K_AT_V_GRAD_DOWN_TAU "Zeitkonstante negativer Radgeschwindigkeitsgradient" VALUE 0x70482 TKW_VV_VV_UB 100.0 FORMULA_0478 0.0051 1.2800 /end CHARACTERISTIC
/begin CHARACTERISTIC K_AT_V_GRAD_INT_TGL "Gradientenumschaltung 80ms / 100ms Periode" VALUE 0x70484 TKW_VV_VV_SW 100.0 FORMULA_0078 -80.0000 360.0000 FORMAT "%4.1" /end CHARACTERISTIC
/begin CHARACTERISTIC K_AT_V_GRAD_INT_TAU "Zeitkonstante negativer Radgeschwindigkeitsgradient" VALUE 0x70486 TKW_VV_VV_UB 100.0 FORMULA_0478 0.0051 1.2800 /end CHARACTERISTIC
/begin CHARACTERISTIC K_AT_TRAMPIN_SOLL_START "Startschwelle AT Eingriff | EN: Startschwelle AT Eingriff" VALUE 0x70488 TKW_VV_VV_SW 100.0 FORMULA_0452 -80.0000 360.0000 FORMAT "%4.1" /end CHARACTERISTIC
/begin CHARACTERISTIC K_AT_TRAMPIN_SOLL_STOP "Startschwelle AT Eingriff" VALUE 0x7048A TKW_VV_VV_SW 100.0 FORMULA_0452 -80.0000 360.0000 FORMAT "%4.1" /end CHARACTERISTIC
/begin CHARACTERISTIC K_AT_TRAMPIN_SOLL_SCHUB "Schwelle Schubabschaltung AT Eingriff" VALUE 0x7048C TKW_VV_VV_SW 100.0 FORMULA_0452 -80.0000 360.0000 FORMAT "%4.1" /end CHARACTERISTIC
/begin CHARACTERISTIC K_AT_MD_BEGR_A1 "Koeffizient a1, PID-Regler | EN: Koeffizient a1, PID-Regler" VALUE 0x7048E TKW_VV_VV_SW 100.0 FORMULA_0497 -10.0000 10.0000 FORMAT "%5.2" /end CHARACTERISTIC
/begin CHARACTERISTIC K_AT_MD_GRAD_TAU_POS "PT1 Filterkonstante f�r positive Gradienten" VALUE 0x70490 TKW_VV_VV_UB 100.0 FORMULA_0478 0.0051 1.2800 /end CHARACTERISTIC
/begin CHARACTERISTIC K_AT_MD_GRAD_TAU_NEG "PT1 Filterkonstante f�r positive Gradienten" VALUE 0x70491 TKW_VV_VV_UB 100.0 FORMULA_0478 0.0051 1.2800 /end CHARACTERISTIC
/begin CHARACTERISTIC KL_AT_V_TP_A2 "Filterkoeffizient A2" CURVE 0x70492 TKL_UB_VV_SW 100.0 FORMULA_0491 -4.0000 3.9998 /begin AXIS_DESCR STD_AXIS Grenzfrequenz FORMULA_0496 12 0.0 255.0000 /end AXIS_DESCR FORMAT "%7.4" /end CHARACTERISTIC
/begin CHARACTERISTIC KL_AT_V_TP_A3 "Filterkoeffizient A3" CURVE 0x704B8 TKL_UB_VV_SW 100.0 FORMULA_0491 -4.0000 3.9998 /begin AXIS_DESCR STD_AXIS Grenzfrequenz FORMULA_0496 12 0.0 255.0000 /end AXIS_DESCR FORMAT "%7.4" /end CHARACTERISTIC
/begin CHARACTERISTIC KL_AT_V_TP_B1 "Filterkoeffizient B1" CURVE 0x704DE TKL_UB_VV_SW 100.0 FORMULA_0491 -4.0000 3.9998 /begin AXIS_DESCR STD_AXIS Grenzfrequenz FORMULA_0496 12 0.0 255.0000 /end AXIS_DESCR FORMAT "%7.4" /end CHARACTERISTIC
/begin CHARACTERISTIC KL_AT_V_TP_B2 "Filterkoeffizient B2" CURVE 0x70504 TKL_UB_VV_SW 100.0 FORMULA_0491 -4.0000 3.9998 /begin AXIS_DESCR STD_AXIS Grenzfrequenz FORMULA_0496 12 0.0 255.0000 /end AXIS_DESCR FORMAT "%7.4" /end CHARACTERISTIC
/begin CHARACTERISTIC KL_AT_V_TP_B3 "Filterkoeffizient B3" CURVE 0x7052A TKL_UB_VV_SW 100.0 FORMULA_0491 -4.0000 3.9998 /begin AXIS_DESCR STD_AXIS Grenzfrequenz FORMULA_0496 12 0.0 255.0000 /end AXIS_DESCR FORMAT "%7.4" /end CHARACTERISTIC
/begin CHARACTERISTIC KL_AT_N_FAK "Drehzahlwichtung" CURVE 0x70550 TKL_SW_VV_SW 100.0 FORMULA_0075 -2.0000 2.0000 /begin AXIS_DESCR STD_AXIS Trampeln_n FORMULA_0006 6 0.0 10000.0000 /end AXIS_DESCR FORMAT "%6.3" /end CHARACTERISTIC
/begin CHARACTERISTIC KL_AT_SCHLUPF_FAK "Schlupfwichtung" CURVE 0x7056A TKL_SW_VV_SW 100.0 FORMULA_0075 -2.0000 2.0000
 /begin AXIS_DESCR STD_AXIS Schlupf FORMULA_0463 6 -300.0000 300.0000 FORMAT "%4.1" /end AXIS_DESCR
 FORMAT "%6.3" /end CHARACTERISTIC
/begin CHARACTERISTIC KL_AT_V_GRAD_FAK "Wichtung Radgeschwindigkeitsgradient" CURVE 0x70584 TKL_SW_VV_SW 100.0 FORMULA_0075 -2.0000 2.0000
 /begin AXIS_DESCR STD_AXIS Gradient FORMULA_0078 6 -80.0000 360.0000 FORMAT "%4.1" /end AXIS_DESCR
 FORMAT "%6.3" /end CHARACTERISTIC
/begin CHARACTERISTIC KL_AT_V_GRAD_INT_FAK "Wichtung Gradientensumme HL und HR" CURVE 0x7059E TKL_SW_VV_SW 100.0 FORMULA_0075 -2.0000 2.0000
 /begin AXIS_DESCR STD_AXIS Gradient FORMULA_0078 6 -80.0000 360.0000 FORMAT "%4.1" /end AXIS_DESCR
 FORMAT "%6.3" /end CHARACTERISTIC
/begin CHARACTERISTIC KL_AT_MD_KUPP_MIN "minimales Moment durch AT Begrenzung" CURVE 0x705B8 TKL_SW_VV_SW 100.0 FORMULA_0009 -100.0000 1000.0000
 /begin AXIS_DESCR STD_AXIS Fahrerwunsch FORMULA_0009 4 -100.0000 1000.0000 FORMAT "%4.1" /end AXIS_DESCR
 FORMAT "%4.1" /end CHARACTERISTIC
/begin CHARACTERISTIC KL_AT_TRAMPIN_SCHUB "Momenteneingriff bei Schubtrampeln" CURVE 0x705CA TKL_SW_VV_SW 100.0 FORMULA_0009 -100.0000 1000.0000
 /begin AXIS_DESCR STD_AXIS Trampelintensitaet FORMULA_0452 8 -80.0000 360.0000 FORMAT "%4.1" /end AXIS_DESCR
 FORMAT "%4.1" /end CHARACTERISTIC
/begin CHARACTERISTIC KL_AT_MD_BEGR_KR_FAK "Faktor auf KR" CURVE 0x705EC TKL_SW_VV_UW 100.0 FORMULA_0075 0.0 20.0000
 /begin AXIS_DESCR STD_AXIS Regelabweichung FORMULA_0452 5 -360.0000 360.0000 FORMAT "%4.1" /end AXIS_DESCR
 FORMAT "%6.3" /end CHARACTERISTIC
/begin CHARACTERISTIC KL_AT_MD_BEGR_TN_FAK "Faktor auf TN" CURVE 0x70602 TKL_SW_VV_UW 100.0 FORMULA_0075 0.0 20.0000
 /begin AXIS_DESCR STD_AXIS Regelabweichung FORMULA_0452 5 -360.0000 360.0000 FORMAT "%4.1" /end AXIS_DESCR
 FORMAT "%6.3" /end CHARACTERISTIC
/begin CHARACTERISTIC KL_AT_MD_BEGR_TV_FAK "Faktor auf TV" CURVE 0x70618 TKL_SW_VV_UW 100.0 FORMULA_0075 0.0 20.0000
 /begin AXIS_DESCR STD_AXIS Regelabweichung FORMULA_0452 5 -360.0000 360.0000 FORMAT "%4.1" /end AXIS_DESCR
 FORMAT "%6.3" /end CHARACTERISTIC
/begin CHARACTERISTIC KF_AT_MD_BEGR_KR "Regelparameter KR" MAP 0x7062E TKF_SW_SW_SW 100.0 FORMULA_0498 0.0 20.0000 /begin AXIS_DESCR STD_AXIS Gang FORMULA_0486 6 -1.0000 10.0000 /end AXIS_DESCR
 /begin AXIS_DESCR STD_AXIS Wunschmoment FORMULA_0009 6 -100.0000 1000.0000 FORMAT "%4.1" /end AXIS_DESCR
 FORMAT "%5.2" /end CHARACTERISTIC
/begin CHARACTERISTIC KF_AT_MD_BEGR_TN "Regelparameter TN" MAP 0x70690 TKF_SW_SW_SW 100.0 FORMULA_0499 0.0030 30.0000 /begin AXIS_DESCR STD_AXIS Gang FORMULA_0486 6 -1.0000 10.0000 /end AXIS_DESCR
 /begin AXIS_DESCR STD_AXIS Wunschmoment FORMULA_0009 6 -100.0000 1000.0000 FORMAT "%4.1" /end AXIS_DESCR
 FORMAT "%6.3" /end CHARACTERISTIC
/begin CHARACTERISTIC KF_AT_MD_BEGR_TV "Regelparameter TV" MAP 0x706F2 TKF_SW_SW_SW 100.0 FORMULA_0499 0.0 20.0000 /begin AXIS_DESCR STD_AXIS Gang FORMULA_0486 6 -1.0000 10.0000 /end AXIS_DESCR
 /begin AXIS_DESCR STD_AXIS Wunschmoment FORMULA_0009 6 -100.0000 1000.0000 FORMAT "%4.1" /end AXIS_DESCR
 FORMAT "%6.3" /end CHARACTERISTIC
/begin MEASUREMENT at_st "Status Anti-Trampel-Funktion" UBYTE FORMULA_0033 0 0 0.0 255.0000 ECU_ADDRESS 0x3FB1EC /end MEASUREMENT
/begin MEASUREMENT at_st_enable "Status Anti-Trampel-Funktion Enable" UBYTE FORMULA_0487 0 0 0.0 255.0 ECU_ADDRESS 0x3FB1EC BIT_MASK 0x1 /end MEASUREMENT
/begin MEASUREMENT at_st_eingriff "Status Anti-Trampel-Funktion Eingriff" UBYTE FORMULA_0488 0 0 0.0 255.0 ECU_ADDRESS 0x3FB1EC BIT_MASK 0x2 /end MEASUREMENT
/begin MEASUREMENT at_st_eingriff_zug "Status Anti-Trampel-Funktion Eingriff Zugtrampeln" UBYTE FORMULA_0489 0 0 0.0 255.0 ECU_ADDRESS 0x3FB1EC BIT_MASK 0x4 /end MEASUREMENT
/begin MEASUREMENT at_st_eingriff_schub "Status Anti-Trampel-Funktion Eingriff Schubtrampeln" UBYTE FORMULA_0490 0 0 0.0 255.0 ECU_ADDRESS 0x3FB1EC BIT_MASK 0x8 /end MEASUREMENT
/begin MEASUREMENT at_koeff_tp_v_a2 "Koeffizientensatz TP Radgeschwindigkeit" SWORD FORMULA_0491 0 0 -4.0000 3.9998 ECU_ADDRESS 0x3FB1EE /end MEASUREMENT
/begin MEASUREMENT at_koeff_tp_v_a3 "Koeffizientensatz TP Radgeschwindigkeit" SWORD FORMULA_0491 0 0 -4.0000 3.9998 ECU_ADDRESS 0x3FB1F0 /end MEASUREMENT
/begin MEASUREMENT at_koeff_tp_v_b1 "Koeffizientensatz TP Radgeschwindigkeit" SWORD FORMULA_0491 0 0 -4.0000 3.9998 ECU_ADDRESS 0x3FB1F2 /end MEASUREMENT
/begin MEASUREMENT at_koeff_tp_v_b2 "Koeffizientensatz TP Radgeschwindigkeit" SWORD FORMULA_0491 0 0 -4.0000 3.9998 ECU_ADDRESS 0x3FB1F4 /end MEASUREMENT
/begin MEASUREMENT at_koeff_tp_v_b3 "Koeffizientensatz TP Radgeschwindigkeit" SWORD FORMULA_0491 0 0 -4.0000 3.9998 ECU_ADDRESS 0x3FB1F6 /end MEASUREMENT
/begin MEASUREMENT at_koeff_tp_n_a2 "Koeffizientensatz TP Motordrehzahl" SWORD FORMULA_0491 0 0 -4.0000 3.9998 ECU_ADDRESS 0x3FB1F8 /end MEASUREMENT
/begin MEASUREMENT at_koeff_tp_n_a3 "Koeffizientensatz TP Motordrehzahl" SWORD FORMULA_0491 0 0 -4.0000 3.9998 ECU_ADDRESS 0x3FB1FA /end MEASUREMENT
/begin MEASUREMENT at_koeff_tp_n_b1 "Koeffizientensatz TP Motordrehzahl" SWORD FORMULA_0491 0 0 -4.0000 3.9998 ECU_ADDRESS 0x3FB1FC /end MEASUREMENT
/begin MEASUREMENT at_koeff_tp_n_b2 "Koeffizientensatz TP Motordrehzahl" SWORD FORMULA_0491 0 0 -4.0000 3.9998 ECU_ADDRESS 0x3FB1FE /end MEASUREMENT
/begin MEASUREMENT at_koeff_tp_n_b3 "Koeffizientensatz TP Motordrehzahl" SWORD FORMULA_0491 0 0 -4.0000 3.9998 ECU_ADDRESS 0x3FB200 /end MEASUREMENT
/begin MEASUREMENT at_koeff_tp_trampin_a2 "Koeffizientensatz TP Trampeln" SWORD FORMULA_0491 0 0 -4.0000 3.9998 ECU_ADDRESS 0x3FB202 /end MEASUREMENT
/begin MEASUREMENT at_koeff_tp_trampin_a3 "Koeffizientensatz TP Trampeln" SWORD FORMULA_0491 0 0 -4.0000 3.9998 ECU_ADDRESS 0x3FB204 /end MEASUREMENT
/begin MEASUREMENT at_koeff_tp_trampin_b1 "Koeffizientensatz TP Trampeln" SWORD FORMULA_0491 0 0 -4.0000 3.9998 ECU_ADDRESS 0x3FB206 /end MEASUREMENT
/begin MEASUREMENT at_koeff_tp_trampin_b2 "Koeffizientensatz TP Trampeln" SWORD FORMULA_0491 0 0 -4.0000 3.9998 ECU_ADDRESS 0x3FB208 /end MEASUREMENT
/begin MEASUREMENT at_koeff_tp_trampin_b3 "Koeffizientensatz TP Trampeln" SWORD FORMULA_0491 0 0 -4.0000 3.9998 ECU_ADDRESS 0x3FB20A /end MEASUREMENT
/begin MEASUREMENT at_koeff_tp_v_grad_a2 "Koeffizientensatz TP Radgeschwindigkeitsgradient" SWORD FORMULA_0491 0 0 -4.0000 3.9998 ECU_ADDRESS 0x3FB20C /end MEASUREMENT
/begin MEASUREMENT at_koeff_tp_v_grad_a3 "Koeffizientensatz TP Radgeschwindigkeitsgradient" SWORD FORMULA_0491 0 0 -4.0000 3.9998 ECU_ADDRESS 0x3FB20E /end MEASUREMENT
/begin MEASUREMENT at_koeff_tp_v_grad_b1 "Koeffizientensatz TP Radgeschwindigkeitsgradient" SWORD FORMULA_0491 0 0 -4.0000 3.9998 ECU_ADDRESS 0x3FB210 /end MEASUREMENT
/begin MEASUREMENT at_koeff_tp_v_grad_b2 "Koeffizientensatz TP Radgeschwindigkeitsgradient" SWORD FORMULA_0491 0 0 -4.0000 3.9998 ECU_ADDRESS 0x3FB212 /end MEASUREMENT
/begin MEASUREMENT at_koeff_tp_v_grad_b3 "Koeffizientensatz TP Radgeschwindigkeitsgradient" SWORD FORMULA_0491 0 0 -4.0000 3.9998 ECU_ADDRESS 0x3FB214 /end MEASUREMENT
/begin MEASUREMENT at_tp_verz_v_vl1 "Tiefpass-Verzoegerungsglieder fuer Trampelerkennung" SLONG FORMULA_0000 0 0 -2147483648.0000 2147483647.0000 ECU_ADDRESS 0x3FB218 /end MEASUREMENT
/begin MEASUREMENT at_tp_verz_v_vl2 "Tiefpass-Verzoegerungsglieder fuer Trampelerkennung" SLONG FORMULA_0000 0 0 -2147483648.0000 2147483647.0000 ECU_ADDRESS 0x3FB21C /end MEASUREMENT
/begin MEASUREMENT at_tp_verz_trampin_vl1 "Tiefpass-Verzoegerungsglieder fuer Trampelerkennung" SLONG FORMULA_0000 0 0 -2147483648.0000 2147483647.0000 ECU_ADDRESS 0x3FB220 /end MEASUREMENT
/begin MEASUREMENT at_tp_verz_trampin_vl2 "Tiefpass-Verzoegerungsglieder fuer Trampelerkennung" SLONG FORMULA_0000 0 0 -2147483648.0000 2147483647.0000 ECU_ADDRESS 0x3FB224 /end MEASUREMENT
/begin MEASUREMENT at_tp_verz_v_vr1 "Tiefpass-Verzoegerungsglieder fuer Trampelerkennung" SLONG FORMULA_0000 0 0 -2147483648.0000 2147483647.0000 ECU_ADDRESS 0x3FB228 /end MEASUREMENT
/begin MEASUREMENT at_tp_verz_v_vr2 "Tiefpass-Verzoegerungsglieder fuer Trampelerkennung" SLONG FORMULA_0000 0 0 -2147483648.0000 2147483647.0000 ECU_ADDRESS 0x3FB22C /end MEASUREMENT
/begin MEASUREMENT at_tp_verz_trampin_vr1 "Tiefpass-Verzoegerungsglieder fuer Trampelerkennung" SLONG FORMULA_0000 0 0 -2147483648.0000 2147483647.0000 ECU_ADDRESS 0x3FB230 /end MEASUREMENT
/begin MEASUREMENT at_tp_verz_trampin_vr2 "Tiefpass-Verzoegerungsglieder fuer Trampelerkennung" SLONG FORMULA_0000 0 0 -2147483648.0000 2147483647.0000 ECU_ADDRESS 0x3FB234 /end MEASUREMENT
/begin MEASUREMENT at_tp_verz_v_hl1 "Tiefpass-Verzoegerungsglieder fuer Trampelerkennung" SLONG FORMULA_0000 0 0 -2147483648.0000 2147483647.0000 ECU_ADDRESS 0x3FB238 /end MEASUREMENT
/begin MEASUREMENT at_tp_verz_v_hl2 "Tiefpass-Verzoegerungsglieder fuer Trampelerkennung" SLONG FORMULA_0000 0 0 -2147483648.0000 2147483647.0000 ECU_ADDRESS 0x3FB23C /end MEASUREMENT
/begin MEASUREMENT at_tp_verz_v_hr1 "Tiefpass-Verzoegerungsglieder fuer Trampelerkennung" SLONG FORMULA_0000 0 0 -2147483648.0000 2147483647.0000 ECU_ADDRESS 0x3FB240 /end MEASUREMENT
/begin MEASUREMENT at_tp_verz_v_hr2 "Tiefpass-Verzoegerungsglieder fuer Trampelerkennung" SLONG FORMULA_0000 0 0 -2147483648.0000 2147483647.0000 ECU_ADDRESS 0x3FB244 /end MEASUREMENT
/begin MEASUREMENT at_tp_verz_trampin_ha1 "Tiefpass-Verzoegerungsglieder fuer Trampelerkennung" SLONG FORMULA_0000 0 0 -2147483648.0000 2147483647.0000 ECU_ADDRESS 0x3FB248 /end MEASUREMENT
/begin MEASUREMENT at_tp_verz_trampin_ha2 "Tiefpass-Verzoegerungsglieder fuer Trampelerkennung" SLONG FORMULA_0000 0 0 -2147483648.0000 2147483647.0000 ECU_ADDRESS 0x3FB24C /end MEASUREMENT
/begin MEASUREMENT at_tp_verz_n1 "Tiefpass-Verzoegerungsglieder fuer Trampelerkennung" SLONG FORMULA_0000 0 0 -2147483648.0000 2147483647.0000 ECU_ADDRESS 0x3FB250 /end MEASUREMENT
/begin MEASUREMENT at_tp_verz_n2 "Tiefpass-Verzoegerungsglieder fuer Trampelerkennung" SLONG FORMULA_0000 0 0 -2147483648.0000 2147483647.0000 ECU_ADDRESS 0x3FB254 /end MEASUREMENT
/begin MEASUREMENT at_tp_verz_trampin_n1 "Tiefpass-Verzoegerungsglieder fuer Trampelerkennung" SLONG FORMULA_0000 0 0 -2147483648.0000 2147483647.0000 ECU_ADDRESS 0x3FB258 /end MEASUREMENT
/begin MEASUREMENT at_tp_verz_trampin_n2 "Tiefpass-Verzoegerungsglieder fuer Trampelerkennung" SLONG FORMULA_0000 0 0 -2147483648.0000 2147483647.0000 ECU_ADDRESS 0x3FB25C /end MEASUREMENT
/begin MEASUREMENT at_tp_verz_v_grad_vl1 "Tiefpass-Verzoegerungsglieder fuer Trampelerkennung" SLONG FORMULA_0000 0 0 -2147483648.0000 2147483647.0000 ECU_ADDRESS 0x3FB260 /end MEASUREMENT
/begin MEASUREMENT at_tp_verz_v_grad_vl2 "Tiefpass-Verzoegerungsglieder fuer Trampelerkennung" SLONG FORMULA_0000 0 0 -2147483648.0000 2147483647.0000 ECU_ADDRESS 0x3FB264 /end MEASUREMENT
/begin MEASUREMENT at_tp_verz_v_grad_vr1 "Tiefpass-Verzoegerungsglieder fuer Trampelerkennung" SLONG FORMULA_0000 0 0 -2147483648.0000 2147483647.0000 ECU_ADDRESS 0x3FB268 /end MEASUREMENT
/begin MEASUREMENT at_tp_verz_v_grad_vr2 "Tiefpass-Verzoegerungsglieder fuer Trampelerkennung" SLONG FORMULA_0000 0 0 -2147483648.0000 2147483647.0000 ECU_ADDRESS 0x3FB26C /end MEASUREMENT
/begin MEASUREMENT at_tp_verz_v_grad_hl1 "Tiefpass-Verzoegerungsglieder fuer Trampelerkennung" SLONG FORMULA_0000 0 0 -2147483648.0000 2147483647.0000 ECU_ADDRESS 0x3FB270 /end MEASUREMENT
/begin MEASUREMENT at_tp_verz_v_grad_hl2 "Tiefpass-Verzoegerungsglieder fuer Trampelerkennung" SLONG FORMULA_0000 0 0 -2147483648.0000 2147483647.0000 ECU_ADDRESS 0x3FB274 /end MEASUREMENT
/begin MEASUREMENT at_tp_verz_v_grad_hr1 "Tiefpass-Verzoegerungsglieder fuer Trampelerkennung" SLONG FORMULA_0000 0 0 -2147483648.0000 2147483647.0000 ECU_ADDRESS 0x3FB278 /end MEASUREMENT
/begin MEASUREMENT at_tp_verz_v_grad_hr2 "Tiefpass-Verzoegerungsglieder fuer Trampelerkennung" SLONG FORMULA_0000 0 0 -2147483648.0000 2147483647.0000 ECU_ADDRESS 0x3FB27C /end MEASUREMENT
/begin MEASUREMENT at_v_rad_vl_hp "Radgeschwindigkeit VL, hochpassgefiltert" SWORD FORMULA_0078 0 0 -80.0000 360.0000 ECU_ADDRESS 0x3FB280 /end MEASUREMENT
/begin MEASUREMENT at_trampin_vl "Trampelintensitaet VL, tiefpassgefiltert" SWORD FORMULA_0452 0 0 -80.0000 360.0000 ECU_ADDRESS 0x3FB282 /end MEASUREMENT
/begin MEASUREMENT at_v_rad_vr_hp "Radgeschwindigkeit VR, hochpassgefiltert" SWORD FORMULA_0078 0 0 -80.0000 360.0000 ECU_ADDRESS 0x3FB284 /end MEASUREMENT
/begin MEASUREMENT at_trampin_vr "Trampelintensitaet VR, tiefpassgefiltert" SWORD FORMULA_0452 0 0 -80.0000 360.0000 ECU_ADDRESS 0x3FB286 /end MEASUREMENT
/begin MEASUREMENT at_trampin_va "mittlere Trampelintensit�t an der Vorderachse" SWORD FORMULA_0452 0 0 -80.0000 360.0000 ECU_ADDRESS 0x3FB288 /end MEASUREMENT
/begin MEASUREMENT at_v_rad_hl_hp "Radgeschwindigkeit HL, hochpassgefiltert" SWORD FORMULA_0078 0 0 -80.0000 360.0000 ECU_ADDRESS 0x3FB28A /end MEASUREMENT
/begin MEASUREMENT at_v_rad_hr_hp "Radgeschwindigkeit HR, hochpassgefiltert" SWORD FORMULA_0078 0 0 -80.0000 360.0000 ECU_ADDRESS 0x3FB28C /end MEASUREMENT
/begin MEASUREMENT at_trampin_ha_roh "Summe Radgeschwindigkeiten HA, hochpassgefiltert" SWORD FORMULA_0078 0 0 -80.0000 360.0000 ECU_ADDRESS 0x3FB28E /end MEASUREMENT
/begin MEASUREMENT at_trampin_ha_tp "Trampelintensitaet HA, tiefpassgefiltert" SWORD FORMULA_0452 0 0 -80.0000 360.0000 ECU_ADDRESS 0x3FB290 /end MEASUREMENT
/begin MEASUREMENT at_n_hp "Motordrehzahl, hochpassgefiltert" SWORD FORMULA_0006 0 0 0.0 10000.0000 ECU_ADDRESS 0x3FB292 /end MEASUREMENT
/begin MEASUREMENT at_n_hp_abs_fil "Trampelintensitaet Motordrehzahl, tiefpassgefiltert" SWORD FORMULA_0006 0 0 0.0 10000.0000 ECU_ADDRESS 0x3FB294 /end MEASUREMENT
/begin MEASUREMENT at_n_fak "Drehzahlwichtung abh. von Trampelintensitaet" SWORD FORMULA_0075 0 0 -32.0000 31.9990 ECU_ADDRESS 0x3FB296 /end MEASUREMENT
/begin MEASUREMENT at_v_rad_vl_tp "Radgeschwindigkeit VL, tiefpassgefiltert" SWORD FORMULA_0078 0 0 -80.0000 360.0000 ECU_ADDRESS 0x3FB298 /end MEASUREMENT
/begin MEASUREMENT at_v_rad_vl_grad "Radgeschwindigkeitsgradient VL, (delta v / 5ms)" SWORD FORMULA_0078 0 0 -80.0000 360.0000 ECU_ADDRESS 0x3FB29A /end MEASUREMENT
/begin MEASUREMENT at_v_rad_vl_tp_verz_1of4_ "verzoegerte Radgeschwindigkeit VL, tiefpassgefiltert" SWORD FORMULA_0078 0 0 -80.0000 360.0000 ECU_ADDRESS 0x3FB29C /end MEASUREMENT
/begin MEASUREMENT at_v_rad_vl_tp_verz_2of4_ "verzoegerte Radgeschwindigkeit VL, tiefpassgefiltert" SWORD FORMULA_0078 0 0 -80.0000 360.0000 ECU_ADDRESS 0x3FB29E /end MEASUREMENT
/begin MEASUREMENT at_v_rad_vl_tp_verz_3of4_ "verzoegerte Radgeschwindigkeit VL, tiefpassgefiltert" SWORD FORMULA_0078 0 0 -80.0000 360.0000 ECU_ADDRESS 0x3FB2A0 /end MEASUREMENT
/begin MEASUREMENT at_v_rad_vl_tp_verz_4of4_ "verzoegerte Radgeschwindigkeit VL, tiefpassgefiltert" SWORD FORMULA_0078 0 0 -80.0000 360.0000 ECU_ADDRESS 0x3FB2A2 /end MEASUREMENT
/begin MEASUREMENT at_v_rad_vl_grad_fil "gemittelter Radgeschwindigkeitsgradient VL, (delta v / 5ms)" SWORD FORMULA_0078 0 0 -80.0000 360.0000 ECU_ADDRESS 0x3FB2A4 /end MEASUREMENT
/begin MEASUREMENT at_v_rad_vr_tp "Radgeschwindigkeit VR, tiefpassgefiltert" SWORD FORMULA_0078 0 0 -80.0000 360.0000 ECU_ADDRESS 0x3FB2A6 /end MEASUREMENT
/begin MEASUREMENT at_v_rad_vr_grad "Radgeschwindigkeitsgradient VR, (delta v / 5ms)" SWORD FORMULA_0078 0 0 -80.0000 360.0000 ECU_ADDRESS 0x3FB2A8 /end MEASUREMENT
/begin MEASUREMENT at_v_rad_vr_tp_verz_1of4_ "verzoegerte Radgeschwindigkeit VR, tiefpassgefiltert" SWORD FORMULA_0078 0 0 -80.0000 360.0000 ECU_ADDRESS 0x3FB2AA /end MEASUREMENT
/begin MEASUREMENT at_v_rad_vr_tp_verz_2of4_ "verzoegerte Radgeschwindigkeit VR, tiefpassgefiltert" SWORD FORMULA_0078 0 0 -80.0000 360.0000 ECU_ADDRESS 0x3FB2AC /end MEASUREMENT
/begin MEASUREMENT at_v_rad_vr_tp_verz_3of4_ "verzoegerte Radgeschwindigkeit VR, tiefpassgefiltert" SWORD FORMULA_0078 0 0 -80.0000 360.0000 ECU_ADDRESS 0x3FB2AE /end MEASUREMENT
/begin MEASUREMENT at_v_rad_vr_tp_verz_4of4_ "verzoegerte Radgeschwindigkeit VR, tiefpassgefiltert" SWORD FORMULA_0078 0 0 -80.0000 360.0000 ECU_ADDRESS 0x3FB2B0 /end MEASUREMENT
/begin MEASUREMENT at_v_rad_vr_grad_fil "gemittelter Radgeschwindigkeitsgradient VR, (delta v / 5ms)" SWORD FORMULA_0078 0 0 -80.0000 360.0000 ECU_ADDRESS 0x3FB2B2 /end MEASUREMENT
/begin MEASUREMENT at_v_rad_hl_tp "Radgeschwindigkeit HL, tiefpassgefiltert" SWORD FORMULA_0078 0 0 -80.0000 360.0000 ECU_ADDRESS 0x3FB2B4 /end MEASUREMENT
/begin MEASUREMENT at_v_rad_hl_grad "Radgeschwindigkeitsgradient HL, (delta v / 5ms)" SWORD FORMULA_0078 0 0 -80.0000 360.0000 ECU_ADDRESS 0x3FB2B6 /end MEASUREMENT
/begin MEASUREMENT at_v_rad_hl_tp_verz_1of4_ "verzoegerte Radgeschwindigkeit HL, tiefpassgefiltert" SWORD FORMULA_0078 0 0 -80.0000 360.0000 ECU_ADDRESS 0x3FB2B8 /end MEASUREMENT
/begin MEASUREMENT at_v_rad_hl_tp_verz_2of4_ "verzoegerte Radgeschwindigkeit HL, tiefpassgefiltert" SWORD FORMULA_0078 0 0 -80.0000 360.0000 ECU_ADDRESS 0x3FB2BA /end MEASUREMENT
/begin MEASUREMENT at_v_rad_hl_tp_verz_3of4_ "verzoegerte Radgeschwindigkeit HL, tiefpassgefiltert" SWORD FORMULA_0078 0 0 -80.0000 360.0000 ECU_ADDRESS 0x3FB2BC /end MEASUREMENT
/begin MEASUREMENT at_v_rad_hl_tp_verz_4of4_ "verzoegerte Radgeschwindigkeit HL, tiefpassgefiltert" SWORD FORMULA_0078 0 0 -80.0000 360.0000 ECU_ADDRESS 0x3FB2BE /end MEASUREMENT
/begin MEASUREMENT at_v_rad_hl_grad_fil "gemittelter Radgeschwindigkeitsgradient HL, (delta v / 5ms)" SWORD FORMULA_0078 0 0 -80.0000 360.0000 ECU_ADDRESS 0x3FB2C0 /end MEASUREMENT
/begin MEASUREMENT at_v_rad_hr_tp "Radgeschwindigkeit HR, tiefpassgefiltert" SWORD FORMULA_0078 0 0 -80.0000 360.0000 ECU_ADDRESS 0x3FB2C2 /end MEASUREMENT
/begin MEASUREMENT at_v_rad_hr_grad "Radgeschwindigkeitsgradient HR, (delta v / 5ms)" SWORD FORMULA_0078 0 0 -80.0000 360.0000 ECU_ADDRESS 0x3FB2C4 /end MEASUREMENT
/begin MEASUREMENT at_v_rad_hr_tp_verz_1of4_ "verzoegerte Radgeschwindigkeit HR, tiefpassgefiltert" SWORD FORMULA_0078 0 0 -80.0000 360.0000 ECU_ADDRESS 0x3FB2C6 /end MEASUREMENT
/begin MEASUREMENT at_v_rad_hr_tp_verz_2of4_ "verzoegerte Radgeschwindigkeit HR, tiefpassgefiltert" SWORD FORMULA_0078 0 0 -80.0000 360.0000 ECU_ADDRESS 0x3FB2C8 /end MEASUREMENT
/begin MEASUREMENT at_v_rad_hr_tp_verz_3of4_ "verzoegerte Radgeschwindigkeit HR, tiefpassgefiltert" SWORD FORMULA_0078 0 0 -80.0000 360.0000 ECU_ADDRESS 0x3FB2CA /end MEASUREMENT
/begin MEASUREMENT at_v_rad_hr_tp_verz_4of4_ "verzoegerte Radgeschwindigkeit HR, tiefpassgefiltert" SWORD FORMULA_0078 0 0 -80.0000 360.0000 ECU_ADDRESS 0x3FB2CC /end MEASUREMENT
/begin MEASUREMENT at_v_rad_hr_grad_fil "gemittelter Radgeschwindigkeitsgradient HR, (delta v / 5ms)" SWORD FORMULA_0078 0 0 -80.0000 360.0000 ECU_ADDRESS 0x3FB2CE /end MEASUREMENT
/begin MEASUREMENT at_schlupf_li "Schlupf links" SWORD FORMULA_0463 0 0 -300.0000 300.0000 ECU_ADDRESS 0x3FB2D0 /end MEASUREMENT
/begin MEASUREMENT at_schlupf_re "Schlupf rechts" SWORD FORMULA_0463 0 0 -300.0000 300.0000 ECU_ADDRESS 0x3FB2D2 /end MEASUREMENT
/begin MEASUREMENT at_schlupf_min "minimaler Schlupf" SWORD FORMULA_0463 0 0 -300.0000 300.0000 ECU_ADDRESS 0x3FB2D4 /end MEASUREMENT
/begin MEASUREMENT at_schlupf_fak "Schlupfwichtung" SWORD FORMULA_0075 0 0 -32.0000 31.9990 ECU_ADDRESS 0x3FB2D6 /end MEASUREMENT
/begin MEASUREMENT at_v_grad_li "Gradient links" SWORD FORMULA_0078 0 0 -80.0000 360.0000 ECU_ADDRESS 0x3FB2D8 /end MEASUREMENT
/begin MEASUREMENT at_v_grad_re "Gradient rechts" SWORD FORMULA_0078 0 0 -80.0000 360.0000 ECU_ADDRESS 0x3FB2DA /end MEASUREMENT
/begin MEASUREMENT at_v_grad_max "maximaler Gradient" SWORD FORMULA_0078 0 0 -80.0000 360.0000 ECU_ADDRESS 0x3FB2DC /end MEASUREMENT
/begin MEASUREMENT at_v_grad_fak "Wichtung, maximaler Gradient" SWORD FORMULA_0075 0 0 -32.0000 31.9990 ECU_ADDRESS 0x3FB2DE /end MEASUREMENT
/begin MEASUREMENT at_sample_cnt "Intervallzaehler fuer Gradientenintegration" UBYTE FORMULA_0003 0 0 0.0 255.0000 ECU_ADDRESS 0x3FB2E0 /end MEASUREMENT
/begin MEASUREMENT at_v_rad_hl_verz_1of5_ "verzoegerte Radgeschwindigkeit HL" SWORD FORMULA_0078 0 0 -80.0000 360.0000 ECU_ADDRESS 0x3FB2E2 /end MEASUREMENT
/begin MEASUREMENT at_v_rad_hl_verz_2of5_ "verzoegerte Radgeschwindigkeit HL" SWORD FORMULA_0078 0 0 -80.0000 360.0000 ECU_ADDRESS 0x3FB2E4 /end MEASUREMENT
/begin MEASUREMENT at_v_rad_hl_verz_3of5_ "verzoegerte Radgeschwindigkeit HL" SWORD FORMULA_0078 0 0 -80.0000 360.0000 ECU_ADDRESS 0x3FB2E6 /end MEASUREMENT
/begin MEASUREMENT at_v_rad_hl_verz_4of5_ "verzoegerte Radgeschwindigkeit HL" SWORD FORMULA_0078 0 0 -80.0000 360.0000 ECU_ADDRESS 0x3FB2E8 /end MEASUREMENT
/begin MEASUREMENT at_v_rad_hl_verz_5of5_ "verzoegerte Radgeschwindigkeit HL" SWORD FORMULA_0078 0 0 -80.0000 360.0000 ECU_ADDRESS 0x3FB2EA /end MEASUREMENT
/begin MEASUREMENT at_v_rad_hr_verz_1of5_ "verzoegerte Radgeschwindigkeit HR" SWORD FORMULA_0078 0 0 -80.0000 360.0000 ECU_ADDRESS 0x3FB2EC /end MEASUREMENT
/begin MEASUREMENT at_v_rad_hr_verz_2of5_ "verzoegerte Radgeschwindigkeit HR" SWORD FORMULA_0078 0 0 -80.0000 360.0000 ECU_ADDRESS 0x3FB2EE /end MEASUREMENT
/begin MEASUREMENT at_v_rad_hr_verz_3of5_ "verzoegerte Radgeschwindigkeit HR" SWORD FORMULA_0078 0 0 -80.0000 360.0000 ECU_ADDRESS 0x3FB2F0 /end MEASUREMENT
/begin MEASUREMENT at_v_rad_hr_verz_4of5_ "verzoegerte Radgeschwindigkeit HR" SWORD FORMULA_0078 0 0 -80.0000 360.0000 ECU_ADDRESS 0x3FB2F2 /end MEASUREMENT
/begin MEASUREMENT at_v_rad_hr_verz_5of5_ "verzoegerte Radgeschwindigkeit HR" SWORD FORMULA_0078 0 0 -80.0000 360.0000 ECU_ADDRESS 0x3FB2F4 /end MEASUREMENT
/begin MEASUREMENT at_v_grad_int_80ms "Summe der Gradienten HL und HR, 80ms Periode" SWORD FORMULA_0078 0 0 -80.0000 360.0000 ECU_ADDRESS 0x3FB2F6 /end MEASUREMENT
/begin MEASUREMENT at_v_grad_int_100ms "Summe der Gradienten HL und HR, 100ms Periode" SWORD FORMULA_0078 0 0 -80.0000 360.0000 ECU_ADDRESS 0x3FB2F8 /end MEASUREMENT
/begin MEASUREMENT at_v_grad_int_80ms_fil "gefilterte Summe der Gradienten HL und HR, 80ms Periode" SWORD FORMULA_0078 0 0 -80.0000 360.0000 ECU_ADDRESS 0x3FB2FA /end MEASUREMENT
/begin MEASUREMENT at_v_grad_int_100ms_fil "gefilterte Summe der Gradienten HL und HR, 100ms Periode" SWORD FORMULA_0078 0 0 -80.0000 360.0000 ECU_ADDRESS 0x3FB2FC /end MEASUREMENT
/begin MEASUREMENT at_v_grad_int_fil "selektierte, gefilterte Summe der Gradienten HL und HR" SWORD FORMULA_0078 0 0 -80.0000 360.0000 ECU_ADDRESS 0x3FB2FE /end MEASUREMENT
/begin MEASUREMENT at_v_grad_int_fak "Wichtung, Summe der Gradienten HL und HR" SWORD FORMULA_0075 0 0 -32.0000 31.9990 ECU_ADDRESS 0x3FB300 /end MEASUREMENT
/begin MEASUREMENT at_trampin_ha "gewichtete Trampelintensitaet HA" SWORD FORMULA_0452 0 0 -80.0000 360.0000 ECU_ADDRESS 0x3FB302 /end MEASUREMENT
/begin MEASUREMENT at_trampin "Trampelintensitaet HA - VA" SWORD FORMULA_0452 0 0 -80.0000 360.0000 ECU_ADDRESS 0x3FB304 /end MEASUREMENT
/begin MEASUREMENT at_trampin_schub "Trampelintensitaet Schubbetrieb" SWORD FORMULA_0452 0 0 -80.0000 360.0000 ECU_ADDRESS 0x3FB306 /end MEASUREMENT
/begin MEASUREMENT at_md_kupp_wunsch "Minimum Wunschmoment" SWORD FORMULA_0009 0 0 -100.0000 1000.0000 ECU_ADDRESS 0x3FB308 /end MEASUREMENT
/begin MEASUREMENT at_md_kupp_min "minimales Moment durch Anti-Trampel Begrenzung" SWORD FORMULA_0009 0 0 -100.0000 1000.0000 ECU_ADDRESS 0x3FB30A /end MEASUREMENT
/begin MEASUREMENT at_md_kupp_ml "Reduktionsmoment fuer den Luftpfad" SWORD FORMULA_0009 0 0 -100.0000 1000.0000 ECU_ADDRESS 0x3FB30C /end MEASUREMENT
/begin MEASUREMENT at_md_kupp_tz "Reduktionsmoment fuer Zuendwinkelpfad" SWORD FORMULA_0009 0 0 -100.0000 1000.0000 ECU_ADDRESS 0x3FB30E /end MEASUREMENT
/begin MEASUREMENT at_trampin_dif "gew. Trampelintensitaet HA ueber Trampelschwelle" SWORD FORMULA_0452 0 0 -80.0000 360.0000 ECU_ADDRESS 0x3FB310 /end MEASUREMENT
/begin MEASUREMENT at_trampin_dif_verz1 "Trampelintensitaet, einmal verzoegert" SWORD FORMULA_0452 0 0 -80.0000 360.0000 ECU_ADDRESS 0x3FB312 /end MEASUREMENT
/begin MEASUREMENT at_trampin_dif_verz2 "Trampelintensitaet, zweimal verzoegert" SWORD FORMULA_0452 0 0 -80.0000 360.0000 ECU_ADDRESS 0x3FB314 /end MEASUREMENT
/begin MEASUREMENT at_md_begr_b0 "Koeffizient b0, PID-Regler" SLONG FORMULA_0492 0 0 -2147483.6480 2147483.6470 ECU_ADDRESS 0x3FB318 /end MEASUREMENT
/begin MEASUREMENT at_md_begr_b1 "Koeffizient b1, PID-Regler" SLONG FORMULA_0492 0 0 -2147483.6480 2147483.6470 ECU_ADDRESS 0x3FB31C /end MEASUREMENT
/begin MEASUREMENT at_md_begr_b2 "Koeffizient b2, PID-Regler" SLONG FORMULA_0492 0 0 -2147483.6480 2147483.6470 ECU_ADDRESS 0x3FB320 /end MEASUREMENT
/begin MEASUREMENT at_md_begr "Moment durch Anti-Trampel Funktion begrenzt" SWORD FORMULA_0009 0 0 -100.0000 1000.0000 ECU_ADDRESS 0x3FB324 /end MEASUREMENT
/begin MEASUREMENT at_ff_trampin_dif "gew. Trampelintensitaet HA ueber Trampelschwelle" SWORD FORMULA_0452 0 0 -80.0000 360.0000 ECU_ADDRESS 0x3FB326 /end MEASUREMENT
/begin MEASUREMENT at_ff_st "Status Freeze Frame" UBYTE FORMULA_0493 0 0 0.0 255.0 ECU_ADDRESS 0x3FB328 BIT_MASK 0x1 /end MEASUREMENT
/begin MEASUREMENT at_ff_st_alt "alter Status Freeze Frame" UBYTE FORMULA_0493 0 0 0.0 255.0 ECU_ADDRESS 0x3FB329 BIT_MASK 0x1 /end MEASUREMENT
/begin MEASUREMENT at_ff_dauer "Dauer des Trampelns" UWORD FORMULA_0117 0 0 0.0 325.0000 ECU_ADDRESS 0x3FB32A /end MEASUREMENT
/begin MEASUREMENT at_ff_trmp_max "max. Trampelintensitaet des Trampelns" SWORD FORMULA_0452 0 0 -80.0000 360.0000 ECU_ADDRESS 0x3FB32C /end MEASUREMENT
/begin MEASUREMENT at_ff_trmp_sum "Integral Trampelintensitaet des Trampelns" SLONG FORMULA_0494 0 0 -80.0000 23592600.0000 ECU_ADDRESS 0x3FB330 /end MEASUREMENT
/begin MEASUREMENT at_ff_trmp_avg "mittlere Trampelintensitaet des Trampelns" SWORD FORMULA_0452 0 0 -80.0000 360.0000 ECU_ADDRESS 0x3FB334 /end MEASUREMENT
/begin MEASUREMENT at_ff_tumg "Umgebungstemperatur waehrend des Trampelns" SWORD FORMULA_0023 0 0 -50.0000 170.0000 ECU_ADDRESS 0x3FB336 /end MEASUREMENT
/begin MEASUREMENT at_ff_tgetr "Getriebetemperatur waehrend des Trampelns" SWORD FORMULA_0023 0 0 -50.0000 190.0000 ECU_ADDRESS 0x3FB338 /end MEASUREMENT
/begin MEASUREMENT at_ff_km_stand "Kilometerstand des Trampelns" ULONG FORMULA_0027 0 0 0.0 16777214.0000 ECU_ADDRESS 0x3FB33C /end MEASUREMENT
/begin MEASUREMENT at_ff_gang "Gang beim Trampeln" SBYTE FORMULA_0318 0 0 -1.0000 10.0000 ECU_ADDRESS 0x3FB340 /end MEASUREMENT
/begin MEASUREMENT at_ff_v_vorne "v-Vorderachse beim Trampeln" SWORD FORMULA_0078 0 0 -80.0000 360.0000 ECU_ADDRESS 0x3FB342 /end MEASUREMENT
/begin MEASUREMENT at_ff_md_kupp_wunsch_ges "Wunschmoment beim Trampeln" SWORD FORMULA_0009 0 0 -100.0000 1000.0000 ECU_ADDRESS 0x3FB344 /end MEASUREMENT
/* ------------------ Abschnitt erzeugt aus auss.dat ------------------ */
/begin CHARACTERISTIC K_AUSS_SPARK_TIME_MIN "Min zulaessige Funkenbrenndauer bei Verbrennungsaussetzer" VALUE 0x70754 TKW_VV_VV_SW 100.0 FORMULA_0447 0.0 4.6810 FORMAT "%5.2" /end CHARACTERISTIC
/begin CHARACTERISTIC K_AUSS_LP_MIN_BEGR "Minimalbegrenzung Aussetzer-Integralschwelle." VALUE 0x70756 TKW_VV_VV_SW 100.0 FORMULA_0245 0.0 4.0000 FORMAT "%5.2" /end CHARACTERISTIC
/begin CHARACTERISTIC K_AUSS_ED_LP_INT_MIN "Aussetzer-Integralschwelle bei Fehler Verstaerkungsumschaltung." VALUE 0x70758 TKW_VV_VV_SW 100.0 FORMULA_0245 0.0 4.0000 FORMAT "%5.2" /end CHARACTERISTIC
/begin CHARACTERISTIC K_AUSS_LP_MAX_OFFSET "Maximal zul. Offset des Tiefpassgefilterteren Leitwertes." VALUE 0x7075A TKW_VV_VV_SW 100.0 FORMULA_0443 0.0 3.3000 FORMAT "%5.2" /end CHARACTERISTIC
/begin CHARACTERISTIC K_AUSS_LP_NV_OFFSET "Offset zu auss_lp_min_sa_max_nv." VALUE 0x7075C TKW_VV_VV_SW 100.0 FORMULA_0443 0.0 3.3000 FORMAT "%5.2" /end CHARACTERISTIC
/begin CHARACTERISTIC K_AUSS_LP_MIN_NV_TREPP "Stufe fuer zuruecklernen von auss_lp_min_sa_max_nv." VALUE 0x7075E TKW_VV_VV_SW 100.0 FORMULA_0573 0.0 3.3000 FORMAT "%7.4" /end CHARACTERISTIC
/begin CHARACTERISTIC K_AUSS_OBD_CFG "Schalter Freigabe Aussetzererkennung: 0 = Aus; 1 = Aktiv | EN: Schalter Freigabe Aussetzererkennung: 0 = Aus; 1 = Aktiv" VALUE 0x70760 TKW_VV_VV_UB 100.0 FORMULA_0574 0.0 1.0 /end CHARACTERISTIC
/begin CHARACTERISTIC K_AUSS_MAX_OFFSET_CFG "Schalter Minimalwertbegrenzung | EN: Schalter Minimalwertbegrenzung" VALUE 0x70761 TKW_VV_VV_UB 100.0 FORMULA_0575 0.0 255.0 /end CHARACTERISTIC
/begin CHARACTERISTIC K_AUSS_OBD_RATE_ABG_ZYL "Rate Aussetzer je Zylinder Abgas. | EN: Rate Aussetzer je Zylinder Abgas." VALUE 0x70762 TKW_VV_VV_UB 100.0 FORMULA_0003 0.0 255.0000 /end CHARACTERISTIC
/begin CHARACTERISTIC K_AUSS_OBD_ABG_1 "Schwelle Aussetzer Abgas 1.Intervall. | EN: Schwelle Aussetzer Abgas 1.Intervall." VALUE 0x70763 TKW_VV_VV_UB 100.0 FORMULA_0003 0.0 255.0000 /end CHARACTERISTIC
/begin CHARACTERISTIC K_AUSS_OBD_ABG_4 "Schwelle Aussetzer je 1000er Intervall. | EN: Schwelle Aussetzer je 1000er Intervall." VALUE 0x70764 TKW_VV_VV_UB 100.0 FORMULA_0003 0.0 255.0000 /end CHARACTERISTIC
/begin CHARACTERISTIC K_AUSS_OBD_SA_CNT "Anzahl der SA-Bereiche fuer Wiedereinsetzen. | EN: Anzahl der SA-Bereiche fuer Wiedereinsetzen." VALUE 0x70765 TKW_VV_VV_UB 100.0 FORMULA_0003 0.0 255.0000 /end CHARACTERISTIC
/begin CHARACTERISTIC K_AUSS_OBD_SA_T_MIN "Min. Dauer fuer SA-Bereiche fuer Wiedereinsetzen. | EN: Min. Dauer fuer SA-Bereiche fuer Wiedereinsetzen." VALUE 0x70766 TKW_VV_VV_UB 100.0 FORMULA_0501 0.0 25.5000 /end CHARACTERISTIC
/begin CHARACTERISTIC K_AUSS_RF_TAU "Tau fuer auss_rf_fil" VALUE 0x70767 TKW_VV_VV_UB 100.0 FORMULA_0462 0.0101 2.5600 /end CHARACTERISTIC
/begin CHARACTERISTIC K_AUSS_SPARK_TIME_TAU "Tau fuer auss_spark_time_fil" VALUE 0x70768 TKW_VV_VV_UB 100.0 FORMULA_0576 0.0040 0.9960 /end CHARACTERISTIC
/begin CHARACTERISTIC K_AUSS_NS_TIME_MAX_SAT_0 "Maximal zulaessige Nebenschlusszeit im Aussetzerfenster." VALUE 0x7076A TKW_VV_VV_UW 100.0 FORMULA_0448 0.0 24.5760 FORMAT "%5.2" /end CHARACTERISTIC
/begin CHARACTERISTIC K_AUSS_NS_TIME_MAX_SAT_1 "Maximal zulaessige Nebenschlusszeit im Aussetzerfenster." VALUE 0x7076C TKW_VV_VV_UW 100.0 FORMULA_0448 0.0 24.5760 FORMAT "%5.2" /end CHARACTERISTIC
/begin CHARACTERISTIC K_AUSS_NS_TIME_MAX_SAT_2 "Maximal zulaessige Nebenschlusszeit im Aussetzerfenster." VALUE 0x7076E TKW_VV_VV_UW 100.0 FORMULA_0448 0.0 24.5760 FORMAT "%5.2" /end CHARACTERISTIC
/begin CHARACTERISTIC K_AUSS_NS_TIME_MAX_SAT_3 "Maximal zulaessige Nebenschlusszeit im Aussetzerfenster." VALUE 0x70770 TKW_VV_VV_UW 100.0 FORMULA_0448 0.0 24.5760 FORMAT "%5.2" /end CHARACTERISTIC
/begin CHARACTERISTIC K_AUSS_NS_TIME_MAX_IC_0 "Maximal zulaessige Nebenschlusszeit im Aussetzerfenster." VALUE 0x70772 TKW_VV_VV_UW 100.0 FORMULA_0448 0.0 24.5760 FORMAT "%5.2" /end CHARACTERISTIC
/begin CHARACTERISTIC K_AUSS_NS_TIME_MAX_IC_1 "Maximal zulaessige Nebenschlusszeit im Aussetzerfenster." VALUE 0x70774 TKW_VV_VV_UW 100.0 FORMULA_0448 0.0 24.5760 FORMAT "%5.2" /end CHARACTERISTIC
/begin CHARACTERISTIC K_AUSS_NS_TIME_MAX_IC_2 "Maximal zulaessige Nebenschlusszeit im Aussetzerfenster." VALUE 0x70776 TKW_VV_VV_UW 100.0 FORMULA_0448 0.0 24.5760 FORMAT "%5.2" /end CHARACTERISTIC
/begin CHARACTERISTIC K_AUSS_NS_TIME_MAX_IC_3 "Maximal zulaessige Nebenschlusszeit im Aussetzerfenster." VALUE 0x70778 TKW_VV_VV_UW 100.0 FORMULA_0448 0.0 24.5760 FORMAT "%5.2" /end CHARACTERISTIC
/begin CHARACTERISTIC K_AUSS_NS_TIME_MAX_IC_4 "Maximal zulaessige Nebenschlusszeit im Aussetzerfenster." VALUE 0x7077A TKW_VV_VV_UW 100.0 FORMULA_0448 0.0 24.5760 FORMAT "%5.2" /end CHARACTERISTIC
/begin CHARACTERISTIC K_AUSS_NS_TIME_MAX_IC_5 "Maximal zulaessige Nebenschlusszeit im Aussetzerfenster." VALUE 0x7077C TKW_VV_VV_UW 100.0 FORMULA_0448 0.0 24.5760 FORMAT "%5.2" /end CHARACTERISTIC
/begin CHARACTERISTIC K_AUSS_NS_TIME_MAX_IC_6 "Maximal zulaessige Nebenschlusszeit im Aussetzerfenster." VALUE 0x7077E TKW_VV_VV_UW 100.0 FORMULA_0448 0.0 24.5760 FORMAT "%5.2" /end CHARACTERISTIC
/begin CHARACTERISTIC K_AUSS_NS_TIME_MAX_IC_7 "Maximal zulaessige Nebenschlusszeit im Aussetzerfenster." VALUE 0x70780 TKW_VV_VV_UW 100.0 FORMULA_0448 0.0 24.5760 FORMAT "%5.2" /end CHARACTERISTIC
/begin CHARACTERISTIC K_AUSS_NS_TIME_MAX_IC_8 "Maximal zulaessige Nebenschlusszeit im Aussetzerfenster." VALUE 0x70782 TKW_VV_VV_UW 100.0 FORMULA_0448 0.0 24.5760 FORMAT "%5.2" /end CHARACTERISTIC
/begin CHARACTERISTIC K_AUSS_NS_TIME_MAX_IC_9 "Maximal zulaessige Nebenschlusszeit im Aussetzerfenster." VALUE 0x70784 TKW_VV_VV_UW 100.0 FORMULA_0448 0.0 24.5760 FORMAT "%5.2" /end CHARACTERISTIC
/begin CHARACTERISTIC K_AUSS_MIN_LAM "Minimal zul. Lambda | EN: Minimal zul. Lambda" VALUE 0x70786 TKW_VV_VV_UW 100.0 FORMULA_0025 0.0 3.9990 FORMAT "%6.3" /end CHARACTERISTIC
/begin CHARACTERISTIC K_AUSS_NS_MAX_ASP "Anzahl Arbeitspiele nach Start zur Aktivierung der Nebenschlusserkennung. | EN: Anzahl Arbeitspiele nach Start zur Aktivierung der Nebenschlusserkennung." VALUE 0x70788 TKW_VV_VV_UW 100.0 FORMULA_0010 0.0 65535.0000 /end CHARACTERISTIC
/begin CHARACTERISTIC K_AUSS_ED_WICHT_SPARK "Gewichtungsfaktors fuer Fehlereintrag Zuendauss. | EN: Gewichtungsfaktors fuer Fehlereintrag Zuendauss." VALUE 0x7078A TKW_VV_VV_UW 100.0 FORMULA_0577 0.0 255.9960 FORMAT "%5.2" /end CHARACTERISTIC
/begin CHARACTERISTIC K_AUSS_OBD_WICHT_SPARK "Gewichtungsfaktors fuer Zuendauss. | EN: Gewichtungsfaktors fuer Zuendauss." VALUE 0x7078C TKW_VV_VV_UW 100.0 FORMULA_0577 0.0 255.9960 FORMAT "%5.2" /end CHARACTERISTIC
/begin CHARACTERISTIC K_AUSS_OBD_WICHT_NS "Gewichtungsfaktors fuer Nebenschluss. | EN: Gewichtungsfaktors fuer Nebenschluss." VALUE 0x7078E TKW_VV_VV_UW 100.0 FORMULA_0577 0.0 255.9960 FORMAT "%5.2" /end CHARACTERISTIC
/begin CHARACTERISTIC K_AUSS_OBD_WICHT_EV "Gewichtungsfaktors fuer Einspritzauss." VALUE 0x70790 TKW_VV_VV_UW 100.0 FORMULA_0577 0.0 255.9960 FORMAT "%5.2" /end CHARACTERISTIC
/begin CHARACTERISTIC K_AUSS_OBD_N_MAX "Obere Aktivierungsdrehzahlschwelle. | EN: Obere Aktivierungsdrehzahlschwelle." VALUE 0x70792 TKW_VV_VV_SW 100.0 FORMULA_0006 0.0 10000.0000 /end CHARACTERISTIC
/begin CHARACTERISTIC K_AUSS_OBD_N_MIN "Untere Aktivierungsdrehzahlschwelle. | EN: Untere Aktivierungsdrehzahlschwelle." VALUE 0x70794 TKW_VV_VV_SW 100.0 FORMULA_0006 0.0 10000.0000 /end CHARACTERISTIC
/begin CHARACTERISTIC K_AUSS_OBD_T_IDLE "Zeit seit Deaktivierungsbedingung. | EN: Zeit seit Deaktivierungsbedingung." VALUE 0x70796 TKW_VV_VV_UW 100.0 FORMULA_0021 0.0 655.0000 FORMAT "%5.2" /end CHARACTERISTIC
/begin CHARACTERISTIC K_AUSS_OBD_T_MIN_LAM "Maximale Abschaltzeit wegen Lamda-Unterschreitung. | EN: Maximale Abschaltzeit wegen Lamda-Unterschreitung." VALUE 0x70798 TKW_VV_VV_UW 100.0 FORMULA_0021 0.0 655.0000 FORMAT "%5.2" /end CHARACTERISTIC
/begin CHARACTERISTIC K_AUSS_OBD_SUM_KAT "Schwelle Katschaedigen. | EN: Schwelle Katschaedigen." VALUE 0x7079A TKW_VV_VV_UW 100.0 FORMULA_0572 0.0 257.0000 FORMAT "%5.2" /end CHARACTERISTIC
/begin CHARACTERISTIC K_AUSS_ASP_SA_CNT "Min Anzahl Arbeitspiele waehren SA vor Adaption. | EN: Min Anzahl Arbeitspiele waehren SA vor Adaption." VALUE 0x7079C TKW_VV_VV_UW 100.0 FORMULA_0010 0.0 65535.0000 /end CHARACTERISTIC
/begin CHARACTERISTIC K_AUSS_SPARK_SIZE "Breite erstes Ausschwingen Zuendspule." VALUE 0x7079E TKW_VV_VV_SW 100.0 FORMULA_0569 4.0000 508.0000 /end CHARACTERISTIC
/begin CHARACTERISTIC K_AUSS_SPARK_LEV "Schwelle Ausschwingen Zuendspule." VALUE 0x707A0 TKW_VV_VV_SW 100.0 FORMULA_0578 0.0 100.0000 FORMAT "%5.2" /end CHARACTERISTIC
/begin CHARACTERISTIC K_AUSS_INT_START_FAKTOR_KOR "Faktor-Korrekturwert waerend Startphase. | EN: Faktor-Korrekturwert waerend Startphase." VALUE 0x707A2 TKW_VV_VV_SW 100.0 FORMULA_0570 0.0 199.9938 FORMAT "%5.2" /end CHARACTERISTIC
/begin CHARACTERISTIC K_AUSS_OBD_ABG_WORST_CYL "Schwelle schlechtester Zylinder. | EN: Schwelle schlechtester Zylinder." VALUE 0x707A4 TKW_VV_VV_SW 100.0 FORMULA_0570 0.0 199.9938 FORMAT "%5.2" /end CHARACTERISTIC
/begin CHARACTERISTIC K_AUSS_TMOT_LU "Tmot Schwelle fuer LU Plausibilisierung." VALUE 0x707A6 TKW_VV_VV_SW 100.0 FORMULA_0023 -50.0000 170.0000 FORMAT "%4.1" /end CHARACTERISTIC
/begin CHARACTERISTIC K_AUSS_LP_MIN_SA_MAX_INI "Initialwert vom max Offset im Aussetzerfenster bei SA. | EN: Initialwert vom max Offset im Aussetzerfenster bei SA." VALUE 0x707A8 TKW_VV_VV_SW 100.0 FORMULA_0443 0.0 3.3000 FORMAT "%5.2" /end CHARACTERISTIC
/begin CHARACTERISTIC K_AUSS_FETRAWE_N "Drehzahlgrenze bei Abschaltung im FeTraWe-Mode. | EN: Drehzahlgrenze bei Abschaltung im FeTraWe-Mode." VALUE 0x707AA TKW_VV_VV_SW 100.0 FORMULA_0006 0.0 10000.0000 /end CHARACTERISTIC
/begin CHARACTERISTIC K_AUSS_FETRAWE_RF "Lastgrenze bei Abschaltung im FeTraWe-Mode. | EN: Lastgrenze bei Abschaltung im FeTraWe-Mode." VALUE 0x707AC TKW_VV_VV_SW 100.0 FORMULA_0007 0.0 2.0000 FORMAT "%6.3" /end CHARACTERISTIC
/begin CHARACTERISTIC K_AUSS_FETRAWE_TIME_ML "Zeitgrenze bei Abschaltung im FeTraWe-Mode. | EN: Zeitgrenze bei Abschaltung im FeTraWe-Mode." VALUE 0x707B0 TKW_VV_VV_UL 100.0 FORMULA_0152 0.0 42949672.9500 FORMAT "%5.2" /end CHARACTERISTIC
/begin CHARACTERISTIC K_AUSS_LP_COEF_1of40_ "Tief-Pass Filter zur Aussetzererkennung." VALUE 0x707B4 TKW_VV_VV_SF 100.0 FORMULA_0579 -340282346638528860000000000000000000000.0000 340282346638528860000000000000000000000.0000 FORMAT "%7.4" /end CHARACTERISTIC
/begin CHARACTERISTIC K_AUSS_LP_COEF_2of40_ "Tief-Pass Filter zur Aussetzererkennung." VALUE 0x707B8 TKW_VV_VV_SF 100.0 FORMULA_0579 -340282346638528860000000000000000000000.0000 340282346638528860000000000000000000000.0000 FORMAT "%7.4" /end CHARACTERISTIC
/begin CHARACTERISTIC K_AUSS_LP_COEF_3of40_ "Tief-Pass Filter zur Aussetzererkennung." VALUE 0x707BC TKW_VV_VV_SF 100.0 FORMULA_0579 -340282346638528860000000000000000000000.0000 340282346638528860000000000000000000000.0000 FORMAT "%7.4" /end CHARACTERISTIC
/begin CHARACTERISTIC K_AUSS_LP_COEF_4of40_ "Tief-Pass Filter zur Aussetzererkennung." VALUE 0x707C0 TKW_VV_VV_SF 100.0 FORMULA_0579 -340282346638528860000000000000000000000.0000 340282346638528860000000000000000000000.0000 FORMAT "%7.4" /end CHARACTERISTIC
/begin CHARACTERISTIC K_AUSS_LP_COEF_5of40_ "Tief-Pass Filter zur Aussetzererkennung." VALUE 0x707C4 TKW_VV_VV_SF 100.0 FORMULA_0579 -340282346638528860000000000000000000000.0000 340282346638528860000000000000000000000.0000 FORMAT "%7.4" /end CHARACTERISTIC
/begin CHARACTERISTIC K_AUSS_LP_COEF_6of40_ "Tief-Pass Filter zur Aussetzererkennung." VALUE 0x707C8 TKW_VV_VV_SF 100.0 FORMULA_0579 -340282346638528860000000000000000000000.0000 340282346638528860000000000000000000000.0000 FORMAT "%7.4" /end CHARACTERISTIC
/begin CHARACTERISTIC K_AUSS_LP_COEF_7of40_ "Tief-Pass Filter zur Aussetzererkennung." VALUE 0x707CC TKW_VV_VV_SF 100.0 FORMULA_0579 -340282346638528860000000000000000000000.0000 340282346638528860000000000000000000000.0000 FORMAT "%7.4" /end CHARACTERISTIC
/begin CHARACTERISTIC K_AUSS_LP_COEF_8of40_ "Tief-Pass Filter zur Aussetzererkennung." VALUE 0x707D0 TKW_VV_VV_SF 100.0 FORMULA_0579 -340282346638528860000000000000000000000.0000 340282346638528860000000000000000000000.0000 FORMAT "%7.4" /end CHARACTERISTIC
/begin CHARACTERISTIC K_AUSS_LP_COEF_9of40_ "Tief-Pass Filter zur Aussetzererkennung." VALUE 0x707D4 TKW_VV_VV_SF 100.0 FORMULA_0579 -340282346638528860000000000000000000000.0000 340282346638528860000000000000000000000.0000 FORMAT "%7.4" /end CHARACTERISTIC
/begin CHARACTERISTIC K_AUSS_LP_COEF_10of40_ "Tief-Pass Filter zur Aussetzererkennung." VALUE 0x707D8 TKW_VV_VV_SF 100.0 FORMULA_0579 -340282346638528860000000000000000000000.0000 340282346638528860000000000000000000000.0000 FORMAT "%7.4" /end CHARACTERISTIC
/begin CHARACTERISTIC K_AUSS_LP_COEF_11of40_ "Tief-Pass Filter zur Aussetzererkennung." VALUE 0x707DC TKW_VV_VV_SF 100.0 FORMULA_0579 -340282346638528860000000000000000000000.0000 340282346638528860000000000000000000000.0000 FORMAT "%7.4" /end CHARACTERISTIC
/begin CHARACTERISTIC K_AUSS_LP_COEF_12of40_ "Tief-Pass Filter zur Aussetzererkennung." VALUE 0x707E0 TKW_VV_VV_SF 100.0 FORMULA_0579 -340282346638528860000000000000000000000.0000 340282346638528860000000000000000000000.0000 FORMAT "%7.4" /end CHARACTERISTIC
/begin CHARACTERISTIC K_AUSS_LP_COEF_13of40_ "Tief-Pass Filter zur Aussetzererkennung." VALUE 0x707E4 TKW_VV_VV_SF 100.0 FORMULA_0579 -340282346638528860000000000000000000000.0000 340282346638528860000000000000000000000.0000 FORMAT "%7.4" /end CHARACTERISTIC
/begin CHARACTERISTIC K_AUSS_LP_COEF_14of40_ "Tief-Pass Filter zur Aussetzererkennung." VALUE 0x707E8 TKW_VV_VV_SF 100.0 FORMULA_0579 -340282346638528860000000000000000000000.0000 340282346638528860000000000000000000000.0000 FORMAT "%7.4" /end CHARACTERISTIC
/begin CHARACTERISTIC K_AUSS_LP_COEF_15of40_ "Tief-Pass Filter zur Aussetzererkennung." VALUE 0x707EC TKW_VV_VV_SF 100.0 FORMULA_0579 -340282346638528860000000000000000000000.0000 340282346638528860000000000000000000000.0000 FORMAT "%7.4" /end CHARACTERISTIC
/begin CHARACTERISTIC K_AUSS_LP_COEF_16of40_ "Tief-Pass Filter zur Aussetzererkennung." VALUE 0x707F0 TKW_VV_VV_SF 100.0 FORMULA_0579 -340282346638528860000000000000000000000.0000 340282346638528860000000000000000000000.0000 FORMAT "%7.4" /end CHARACTERISTIC
/begin CHARACTERISTIC K_AUSS_LP_COEF_17of40_ "Tief-Pass Filter zur Aussetzererkennung." VALUE 0x707F4 TKW_VV_VV_SF 100.0 FORMULA_0579 -340282346638528860000000000000000000000.0000 340282346638528860000000000000000000000.0000 FORMAT "%7.4" /end CHARACTERISTIC
/begin CHARACTERISTIC K_AUSS_LP_COEF_18of40_ "Tief-Pass Filter zur Aussetzererkennung." VALUE 0x707F8 TKW_VV_VV_SF 100.0 FORMULA_0579 -340282346638528860000000000000000000000.0000 340282346638528860000000000000000000000.0000 FORMAT "%7.4" /end CHARACTERISTIC
/begin CHARACTERISTIC K_AUSS_LP_COEF_19of40_ "Tief-Pass Filter zur Aussetzererkennung." VALUE 0x707FC TKW_VV_VV_SF 100.0 FORMULA_0579 -340282346638528860000000000000000000000.0000 340282346638528860000000000000000000000.0000 FORMAT "%7.4" /end CHARACTERISTIC
/begin CHARACTERISTIC K_AUSS_LP_COEF_20of40_ "Tief-Pass Filter zur Aussetzererkennung." VALUE 0x70800 TKW_VV_VV_SF 100.0 FORMULA_0579 -340282346638528860000000000000000000000.0000 340282346638528860000000000000000000000.0000 FORMAT "%7.4" /end CHARACTERISTIC
/begin CHARACTERISTIC K_AUSS_LP_COEF_21of40_ "Tief-Pass Filter zur Aussetzererkennung." VALUE 0x70804 TKW_VV_VV_SF 100.0 FORMULA_0579 -340282346638528860000000000000000000000.0000 340282346638528860000000000000000000000.0000 FORMAT "%7.4" /end CHARACTERISTIC
/begin CHARACTERISTIC K_AUSS_LP_COEF_22of40_ "Tief-Pass Filter zur Aussetzererkennung." VALUE 0x70808 TKW_VV_VV_SF 100.0 FORMULA_0579 -340282346638528860000000000000000000000.0000 340282346638528860000000000000000000000.0000 FORMAT "%7.4" /end CHARACTERISTIC
/begin CHARACTERISTIC K_AUSS_LP_COEF_23of40_ "Tief-Pass Filter zur Aussetzererkennung." VALUE 0x7080C TKW_VV_VV_SF 100.0 FORMULA_0579 -340282346638528860000000000000000000000.0000 340282346638528860000000000000000000000.0000 FORMAT "%7.4" /end CHARACTERISTIC
/begin CHARACTERISTIC K_AUSS_LP_COEF_24of40_ "Tief-Pass Filter zur Aussetzererkennung." VALUE 0x70810 TKW_VV_VV_SF 100.0 FORMULA_0579 -340282346638528860000000000000000000000.0000 340282346638528860000000000000000000000.0000 FORMAT "%7.4" /end CHARACTERISTIC
/begin CHARACTERISTIC K_AUSS_LP_COEF_25of40_ "Tief-Pass Filter zur Aussetzererkennung." VALUE 0x70814 TKW_VV_VV_SF 100.0 FORMULA_0579 -340282346638528860000000000000000000000.0000 340282346638528860000000000000000000000.0000 FORMAT "%7.4" /end CHARACTERISTIC
/begin CHARACTERISTIC K_AUSS_LP_COEF_26of40_ "Tief-Pass Filter zur Aussetzererkennung." VALUE 0x70818 TKW_VV_VV_SF 100.0 FORMULA_0579 -340282346638528860000000000000000000000.0000 340282346638528860000000000000000000000.0000 FORMAT "%7.4" /end CHARACTERISTIC
/begin CHARACTERISTIC K_AUSS_LP_COEF_27of40_ "Tief-Pass Filter zur Aussetzererkennung." VALUE 0x7081C TKW_VV_VV_SF 100.0 FORMULA_0579 -340282346638528860000000000000000000000.0000 340282346638528860000000000000000000000.0000 FORMAT "%7.4" /end CHARACTERISTIC
/begin CHARACTERISTIC K_AUSS_LP_COEF_28of40_ "Tief-Pass Filter zur Aussetzererkennung." VALUE 0x70820 TKW_VV_VV_SF 100.0 FORMULA_0579 -340282346638528860000000000000000000000.0000 340282346638528860000000000000000000000.0000 FORMAT "%7.4" /end CHARACTERISTIC
/begin CHARACTERISTIC K_AUSS_LP_COEF_29of40_ "Tief-Pass Filter zur Aussetzererkennung." VALUE 0x70824 TKW_VV_VV_SF 100.0 FORMULA_0579 -340282346638528860000000000000000000000.0000 340282346638528860000000000000000000000.0000 FORMAT "%7.4" /end CHARACTERISTIC
/begin CHARACTERISTIC K_AUSS_LP_COEF_30of40_ "Tief-Pass Filter zur Aussetzererkennung." VALUE 0x70828 TKW_VV_VV_SF 100.0 FORMULA_0579 -340282346638528860000000000000000000000.0000 340282346638528860000000000000000000000.0000 FORMAT "%7.4" /end CHARACTERISTIC
/begin CHARACTERISTIC K_AUSS_LP_COEF_31of40_ "Tief-Pass Filter zur Aussetzererkennung." VALUE 0x7082C TKW_VV_VV_SF 100.0 FORMULA_0579 -340282346638528860000000000000000000000.0000 340282346638528860000000000000000000000.0000 FORMAT "%7.4" /end CHARACTERISTIC
/begin CHARACTERISTIC K_AUSS_LP_COEF_32of40_ "Tief-Pass Filter zur Aussetzererkennung." VALUE 0x70830 TKW_VV_VV_SF 100.0 FORMULA_0579 -340282346638528860000000000000000000000.0000 340282346638528860000000000000000000000.0000 FORMAT "%7.4" /end CHARACTERISTIC
/begin CHARACTERISTIC K_AUSS_LP_COEF_33of40_ "Tief-Pass Filter zur Aussetzererkennung." VALUE 0x70834 TKW_VV_VV_SF 100.0 FORMULA_0579 -340282346638528860000000000000000000000.0000 340282346638528860000000000000000000000.0000 FORMAT "%7.4" /end CHARACTERISTIC
/begin CHARACTERISTIC K_AUSS_LP_COEF_34of40_ "Tief-Pass Filter zur Aussetzererkennung." VALUE 0x70838 TKW_VV_VV_SF 100.0 FORMULA_0579 -340282346638528860000000000000000000000.0000 340282346638528860000000000000000000000.0000 FORMAT "%7.4" /end CHARACTERISTIC
/begin CHARACTERISTIC K_AUSS_LP_COEF_35of40_ "Tief-Pass Filter zur Aussetzererkennung." VALUE 0x7083C TKW_VV_VV_SF 100.0 FORMULA_0579 -340282346638528860000000000000000000000.0000 340282346638528860000000000000000000000.0000 FORMAT "%7.4" /end CHARACTERISTIC
/begin CHARACTERISTIC K_AUSS_LP_COEF_36of40_ "Tief-Pass Filter zur Aussetzererkennung." VALUE 0x70840 TKW_VV_VV_SF 100.0 FORMULA_0579 -340282346638528860000000000000000000000.0000 340282346638528860000000000000000000000.0000 FORMAT "%7.4" /end CHARACTERISTIC
/begin CHARACTERISTIC K_AUSS_LP_COEF_37of40_ "Tief-Pass Filter zur Aussetzererkennung." VALUE 0x70844 TKW_VV_VV_SF 100.0 FORMULA_0579 -340282346638528860000000000000000000000.0000 340282346638528860000000000000000000000.0000 FORMAT "%7.4" /end CHARACTERISTIC
/begin CHARACTERISTIC K_AUSS_LP_COEF_38of40_ "Tief-Pass Filter zur Aussetzererkennung." VALUE 0x70848 TKW_VV_VV_SF 100.0 FORMULA_0579 -340282346638528860000000000000000000000.0000 340282346638528860000000000000000000000.0000 FORMAT "%7.4" /end CHARACTERISTIC
/begin CHARACTERISTIC K_AUSS_LP_COEF_39of40_ "Tief-Pass Filter zur Aussetzererkennung." VALUE 0x7084C TKW_VV_VV_SF 100.0 FORMULA_0579 -340282346638528860000000000000000000000.0000 340282346638528860000000000000000000000.0000 FORMAT "%7.4" /end CHARACTERISTIC
/begin CHARACTERISTIC K_AUSS_LP_COEF_40of40_ "Tief-Pass Filter zur Aussetzererkennung." VALUE 0x70850 TKW_VV_VV_SF 100.0 FORMULA_0579 -340282346638528860000000000000000000000.0000 340282346638528860000000000000000000000.0000 FORMAT "%7.4" /end CHARACTERISTIC
/begin CHARACTERISTIC KL_AUSS_OBD_TZ_GRAD "Deaktivierungsschwelle fuer tz_grad. | EN: Deactivation threshold for tz_grad (ignition gradient)" CURVE 0x70854 TKL_SW_VV_SW 100.0 FORMULA_0249 -100.0000 100.0000 /begin AXIS_DESCR STD_AXIS n FORMULA_0006 4 0.0 10000.0000 /end AXIS_DESCR FORMAT "%6.3" /end CHARACTERISTIC
/begin CHARACTERISTIC KL_AUSS_PUMG_FAKTOR "Korrektur ueber pumg." CURVE 0x70866 TKL_SW_VV_SW 100.0 FORMULA_0570 0.0 199.9938
 /begin AXIS_DESCR STD_AXIS pumg FORMULA_0077 4 400.0000 1200.0000 FORMAT "%4.1" /end AXIS_DESCR
 FORMAT "%5.2" /end CHARACTERISTIC
/begin CHARACTERISTIC KL_AUSS_START_FAKTOR "Korrekturfaktor waerend Startphase von auss_lp_int_min. | EN: Correction factor during start phase for auss_lp_int_min" CURVE 0x70878 TKL_SW_VV_SW 100.0 FORMULA_0570 0.0 199.9938
 /begin AXIS_DESCR STD_AXIS tmot FORMULA_0023 5 -50.0000 170.0000 FORMAT "%4.1" /end AXIS_DESCR
 FORMAT "%5.2" /end CHARACTERISTIC
/begin CHARACTERISTIC KL_AUSS_OBD_POS_MD_DYN "Maximal zul. pos. Dynamik." CURVE 0x7088E TKL_SW_VV_SW 100.0 FORMULA_0571 -5000.0000 5000.0000 /begin AXIS_DESCR STD_AXIS rf FORMULA_0007 6 0.0 2.0000 FORMAT "%6.3" /end AXIS_DESCR /end CHARACTERISTIC
/begin CHARACTERISTIC KL_AUSS_OBD_NEG_MD_DYN "Minimale zul. neg. Dynamik." CURVE 0x708A8 TKL_SW_VV_SW 100.0 FORMULA_0571 -5000.0000 5000.0000 /begin AXIS_DESCR STD_AXIS rf FORMULA_0007 6 0.0 2.0000 FORMAT "%6.3" /end AXIS_DESCR /end CHARACTERISTIC
/begin CHARACTERISTIC KL_AUSS_OBD_POS_MD_DYN_KH "Maximal zul. pos. Dynamik im Katheizen. | EN: Maximum permitted positive dynamics during catalyst heating" CURVE 0x708C2 TKL_SW_VV_SW 100.0 FORMULA_0571 -5000.0000 5000.0000 /begin AXIS_DESCR STD_AXIS rf FORMULA_0007 6 0.0 2.0000 FORMAT "%6.3" /end AXIS_DESCR /end CHARACTERISTIC
/begin CHARACTERISTIC KL_AUSS_OBD_NEG_MD_DYN_KH "Minimale zul. neg. Dynamik im Katheizen." CURVE 0x708DC TKL_SW_VV_SW 100.0 FORMULA_0571 -5000.0000 5000.0000 /begin AXIS_DESCR STD_AXIS rf FORMULA_0007 6 0.0 2.0000 FORMAT "%6.3" /end AXIS_DESCR /end CHARACTERISTIC
/begin CHARACTERISTIC KL_AUSS_INT_TMOT_FAKTOR "Korrekturfaktor ueber Tmot. | EN: Correction factor over engine temperature" CURVE 0x708F6 TKL_SW_VV_SW 100.0 FORMULA_0570 0.0 199.9938
 /begin AXIS_DESCR STD_AXIS tmot FORMULA_0023 8 -50.0000 170.0000 FORMAT "%4.1" /end AXIS_DESCR
 FORMAT "%5.2" /end CHARACTERISTIC
/begin CHARACTERISTIC KL_AUSS_INT_DTZ_FAKTOR "Korrekturfaktor ueber Rueckziehwinkel." CURVE 0x70918 TKL_SW_VV_SW 100.0 FORMULA_0570 0.0 199.9938 /begin AXIS_DESCR STD_AXIS tz FORMULA_0111 8 -50.0000 60.0000 FORMAT "%4.1" /end AXIS_DESCR FORMAT "%5.2" /end CHARACTERISTIC
/begin CHARACTERISTIC KL_AUSS_OBD_RF_MIN "Minimale RF-Aktivierungsschwelle." CURVE 0x7093A TKL_SW_VV_SW 100.0 FORMULA_0007 0.0 2.0000 /begin AXIS_DESCR STD_AXIS n FORMULA_0006 8 0.0 10000.0000 /end AXIS_DESCR FORMAT "%6.3" /end CHARACTERISTIC
/begin CHARACTERISTIC KL_AUSS_OBD_WICHT_KAT "Gewichtung Kattemperatur fuer Katschaedigung. | EN: Weighting of catalyst temperature for catalyst damage" CURVE 0x7095C TKL_SW_VV_UB 100.0 FORMULA_0502 0.0 1.0000
 /begin AXIS_DESCR STD_AXIS tabg_mkat FORMULA_0023 4 -50.0000 1250.0000 FORMAT "%4.1" /end AXIS_DESCR
/end CHARACTERISTIC
/begin CHARACTERISTIC KL_AUSS_MIN_AVG_SAMPLES "Anzahl Messpunkte Minimalintegral." CURVE 0x7096A TKL_SW_VV_UW 100.0 FORMULA_0569 4.0000 4092.0000 /begin AXIS_DESCR STD_AXIS n FORMULA_0006 6 0.0 10000.0000 /end AXIS_DESCR /end CHARACTERISTIC
/begin CHARACTERISTIC KF_AUSS_SPARK_TIME_MIN "Min zulaessige Funkenbrenndauer." MAP 0x70984 TKF_SW_SW_SW 100.0 FORMULA_0447 0.0 4.6810 /begin AXIS_DESCR STD_AXIS n FORMULA_0006 3 0.0 10000.0000 /end AXIS_DESCR /begin AXIS_DESCR STD_AXIS rf FORMULA_0007 3 0.0 2.0000 FORMAT "%6.3" /end AXIS_DESCR FORMAT "%5.2" /end CHARACTERISTIC
/begin CHARACTERISTIC KF_AUSS_SPARK_TIME_MAX "Max zulaessige Funkenbrenndauer. | EN: Maximum permitted spark burn duration" MAP 0x709A4 TKF_SW_SW_SW 100.0 FORMULA_0447 0.0 4.6810 /begin AXIS_DESCR STD_AXIS n FORMULA_0006 3 0.0 10000.0000 /end AXIS_DESCR /begin AXIS_DESCR STD_AXIS rf FORMULA_0007 3 0.0 2.0000 FORMAT "%6.3" /end AXIS_DESCR FORMAT "%5.2" /end CHARACTERISTIC
/begin CHARACTERISTIC KF_AUSS_LP_INT_MIN "Minimales Ionenleitwertintegral zur Aussetzererkennung. | EN: Minimum ion-current integral for misfire detection" MAP 0x709C4 TKF_SW_SW_SW 100.0 FORMULA_0245 0.0 4.0000 /begin AXIS_DESCR STD_AXIS n FORMULA_0006 16 0.0 10000.0000 /end AXIS_DESCR /begin AXIS_DESCR STD_AXIS rf FORMULA_0007 10 0.0 2.0000 FORMAT "%6.3" /end AXIS_DESCR FORMAT "%5.2" /end CHARACTERISTIC
/begin CHARACTERISTIC KF_AUSS_OBD_WICHT_KAT "Gewichtung Katschaedigen." MAP 0x70B3A TKF_SW_SW_UB 100.0 FORMULA_0502 0.0 1.0000 /begin AXIS_DESCR STD_AXIS n FORMULA_0006 8 0.0 10000.0000 /end AXIS_DESCR /begin AXIS_DESCR STD_AXIS rf FORMULA_0007 5 0.0 2.0000 FORMAT "%6.3" /end AXIS_DESCR /end CHARACTERISTIC
/begin CHARACTERISTIC KF_AUSS_OBD_DTZ_MAX "Maximal zul. delta Zuendwinkel." MAP 0x70B7E TKF_SW_SW_SW 100.0 FORMULA_0111 -50.0000 60.0000 /begin AXIS_DESCR STD_AXIS n FORMULA_0006 8 0.0 10000.0000 /end AXIS_DESCR /begin AXIS_DESCR STD_AXIS rf FORMULA_0007 5 0.0 2.0000 FORMAT "%6.3" /end AXIS_DESCR FORMAT "%4.1" /end CHARACTERISTIC
/begin CHARACTERISTIC KF_AUSS_TZ_OFFS "Ausetzerfensterstart (Offsetzeit nach Zuendzeitpunkt)." MAP 0x70BEA TKF_SW_SW_SW 100.0 FORMULA_0448 0.0040 8.1880 /begin AXIS_DESCR STD_AXIS n FORMULA_0006 6 0.0 10000.0000 /end AXIS_DESCR /begin AXIS_DESCR STD_AXIS rf FORMULA_0007 6 0.0 2.0000 FORMAT "%6.3" /end AXIS_DESCR FORMAT "%5.2" /end CHARACTERISTIC
/begin MEASUREMENT auss_obd_sa_cnt "Anzahl der SA-Bereiche fuer Wiedereinsetzen." UBYTE FORMULA_0003 0 0 0.0 255.0000 ECU_ADDRESS 0x3FB348 /end MEASUREMENT
/begin MEASUREMENT auss_obd_phase "OBD-Phase." UBYTE FORMULA_0500 0 0 0.0 255.0 ECU_ADDRESS 0x3FB349 /end MEASUREMENT
/begin MEASUREMENT auss_obd_scdn_st "Status Betriebsfensterbildung." UBYTE FORMULA_0003 0 0 0.0 255.0000 ECU_ADDRESS 0x3FB34A /end MEASUREMENT
/begin MEASUREMENT auss_obd_abg_ueberschr "Intervalle mit Abgasschwellen-Ueberschr in diesem DC." UBYTE FORMULA_0003 0 0 0.0 255.0000 ECU_ADDRESS 0x3FB34B /end MEASUREMENT
/begin MEASUREMENT auss_obd_sa_time "Timer fuer SA-Dauer Wiedereinsetzen." UBYTE FORMULA_0501 0 0 0.0 25.5000 ECU_ADDRESS 0x3FB34C /end MEASUREMENT
/begin MEASUREMENT auss_obd_wicht_kat_b1 "Gewichtungsfaktors fuer Katschaedigung." UBYTE FORMULA_0502 0 0 0.0 1.0000 ECU_ADDRESS 0x3FB34D /end MEASUREMENT
/begin MEASUREMENT auss_obd_wicht_kat_b2 "Gewichtungsfaktors fuer Katschaedigung." UBYTE FORMULA_0502 0 0 0.0 1.0000 ECU_ADDRESS 0x3FB34E /end MEASUREMENT
/begin MEASUREMENT auss_erk_tz "Status Ausschwingen Zuendspule." UWORD FORMULA_0503 0 0 0.0 4095.0 ECU_ADDRESS 0x3FB350 /end MEASUREMENT
/begin MEASUREMENT auss_erk_tz_zyl1 "Status Ausschwingen Zuendspule 1." UWORD FORMULA_0504 0 0 0.0 1.0 ECU_ADDRESS 0x3FB350 BIT_MASK 0x1 /end MEASUREMENT
/begin MEASUREMENT auss_erk_tz_zyl2 "Status Ausschwingen Zuendspule 2." UWORD FORMULA_0505 0 0 0.0 1.0 ECU_ADDRESS 0x3FB350 BIT_MASK 0x2 /end MEASUREMENT
/begin MEASUREMENT auss_erk_tz_zyl3 "Status Ausschwingen Zuendspule 3." UWORD FORMULA_0506 0 0 0.0 1.0 ECU_ADDRESS 0x3FB350 BIT_MASK 0x4 /end MEASUREMENT
/begin MEASUREMENT auss_erk_tz_zyl4 "Status Ausschwingen Zuendspule 4." UWORD FORMULA_0507 0 0 0.0 1.0 ECU_ADDRESS 0x3FB350 BIT_MASK 0x8 /end MEASUREMENT
/begin MEASUREMENT auss_erk_tz_zyl5 "Status Ausschwingen Zuendspule 5." UWORD FORMULA_0508 0 0 0.0 1.0 ECU_ADDRESS 0x3FB350 BIT_MASK 0x10 /end MEASUREMENT
/begin MEASUREMENT auss_erk_tz_zyl6 "Status Ausschwingen Zuendspule 6." UWORD FORMULA_0509 0 0 0.0 1.0 ECU_ADDRESS 0x3FB350 BIT_MASK 0x20 /end MEASUREMENT
/begin MEASUREMENT auss_erk_tz_zyl7 "Status Ausschwingen Zuendspule 7." UWORD FORMULA_0510 0 0 0.0 1.0 ECU_ADDRESS 0x3FB350 BIT_MASK 0x40 /end MEASUREMENT
/begin MEASUREMENT auss_erk_tz_zyl8 "Status Ausschwingen Zuendspule 8." UWORD FORMULA_0511 0 0 0.0 1.0 ECU_ADDRESS 0x3FB350 BIT_MASK 0x80 /end MEASUREMENT
/begin MEASUREMENT auss_erk_tz_zyl9 "Status Ausschwingen Zuendspule 9." UWORD FORMULA_0512 0 0 0.0 1.0 ECU_ADDRESS 0x3FB350 BIT_MASK 0x100 /end MEASUREMENT
/begin MEASUREMENT auss_erk_tz_zyl10 "Status Ausschwingen Zuendspule 10." UWORD FORMULA_0513 0 0 0.0 1.0 ECU_ADDRESS 0x3FB350 BIT_MASK 0x200 /end MEASUREMENT
/begin MEASUREMENT auss_erk_ti "Status Verbrennungsaussetzer." UWORD FORMULA_0514 0 0 0.0 4095.0 ECU_ADDRESS 0x3FB352 /end MEASUREMENT
/begin MEASUREMENT auss_erk_ti_zyl1 "Status Verbrennung Zylinder 1." UWORD FORMULA_0515 0 0 0.0 1.0 ECU_ADDRESS 0x3FB352 BIT_MASK 0x1 /end MEASUREMENT
/begin MEASUREMENT auss_erk_ti_zyl2 "Status Verbrennung Zylinder 2." UWORD FORMULA_0516 0 0 0.0 1.0 ECU_ADDRESS 0x3FB352 BIT_MASK 0x2 /end MEASUREMENT
/begin MEASUREMENT auss_erk_ti_zyl3 "Status Verbrennung Zylinder 3." UWORD FORMULA_0517 0 0 0.0 1.0 ECU_ADDRESS 0x3FB352 BIT_MASK 0x4 /end MEASUREMENT
/begin MEASUREMENT auss_erk_ti_zyl4 "Status Verbrennung Zylinder 4." UWORD FORMULA_0518 0 0 0.0 1.0 ECU_ADDRESS 0x3FB352 BIT_MASK 0x8 /end MEASUREMENT
/begin MEASUREMENT auss_erk_ti_zyl5 "Status Verbrennung Zylinder 5." UWORD FORMULA_0519 0 0 0.0 1.0 ECU_ADDRESS 0x3FB352 BIT_MASK 0x10 /end MEASUREMENT
/begin MEASUREMENT auss_erk_ti_zyl6 "Status Verbrennung Zylinder 6." UWORD FORMULA_0520 0 0 0.0 1.0 ECU_ADDRESS 0x3FB352 BIT_MASK 0x20 /end MEASUREMENT
/begin MEASUREMENT auss_erk_ti_zyl7 "Status Verbrennung Zylinder 7." UWORD FORMULA_0521 0 0 0.0 1.0 ECU_ADDRESS 0x3FB352 BIT_MASK 0x40 /end MEASUREMENT
/begin MEASUREMENT auss_erk_ti_zyl8 "Status Verbrennung Zylinder 8." UWORD FORMULA_0522 0 0 0.0 1.0 ECU_ADDRESS 0x3FB352 BIT_MASK 0x80 /end MEASUREMENT
/begin MEASUREMENT auss_erk_ti_zyl9 "Status Verbrennung Zylinder 9." UWORD FORMULA_0523 0 0 0.0 1.0 ECU_ADDRESS 0x3FB352 BIT_MASK 0x100 /end MEASUREMENT
/begin MEASUREMENT auss_erk_ti_zyl10 "Status Verbrennung Zylinder 10." UWORD FORMULA_0524 0 0 0.0 1.0 ECU_ADDRESS 0x3FB352 BIT_MASK 0x200 /end MEASUREMENT
/begin MEASUREMENT auss_erk_ns "Status Nebenschluss Zuendkerze." UWORD FORMULA_0525 0 0 0.0 4095.0 ECU_ADDRESS 0x3FB354 /end MEASUREMENT
/begin MEASUREMENT auss_erk_ns_zyl1 "Status Nebenschluss Zuendkerze 1." UWORD FORMULA_0526 0 0 0.0 1.0 ECU_ADDRESS 0x3FB354 BIT_MASK 0x1 /end MEASUREMENT
/begin MEASUREMENT auss_erk_ns_zyl2 "Status Nebenschluss Zuendkerze 2." UWORD FORMULA_0527 0 0 0.0 1.0 ECU_ADDRESS 0x3FB354 BIT_MASK 0x2 /end MEASUREMENT
/begin MEASUREMENT auss_erk_ns_zyl3 "Status Nebenschluss Zuendkerze 3." UWORD FORMULA_0528 0 0 0.0 1.0 ECU_ADDRESS 0x3FB354 BIT_MASK 0x4 /end MEASUREMENT
/begin MEASUREMENT auss_erk_ns_zyl4 "Status Nebenschluss Zuendkerze 4." UWORD FORMULA_0529 0 0 0.0 1.0 ECU_ADDRESS 0x3FB354 BIT_MASK 0x8 /end MEASUREMENT
/begin MEASUREMENT auss_erk_ns_zyl5 "Status Nebenschluss Zuendkerze 5." UWORD FORMULA_0530 0 0 0.0 1.0 ECU_ADDRESS 0x3FB354 BIT_MASK 0x10 /end MEASUREMENT
/begin MEASUREMENT auss_erk_ns_zyl6 "Status Nebenschluss Zuendkerze 6." UWORD FORMULA_0531 0 0 0.0 1.0 ECU_ADDRESS 0x3FB354 BIT_MASK 0x20 /end MEASUREMENT
/begin MEASUREMENT auss_erk_ns_zyl7 "Status Nebenschluss Zuendkerze 7." UWORD FORMULA_0532 0 0 0.0 1.0 ECU_ADDRESS 0x3FB354 BIT_MASK 0x40 /end MEASUREMENT
/begin MEASUREMENT auss_erk_ns_zyl8 "Status Nebenschluss Zuendkerze 8." UWORD FORMULA_0533 0 0 0.0 1.0 ECU_ADDRESS 0x3FB354 BIT_MASK 0x80 /end MEASUREMENT
/begin MEASUREMENT auss_erk_ns_zyl9 "Status Nebenschluss Zuendkerze 9." UWORD FORMULA_0534 0 0 0.0 1.0 ECU_ADDRESS 0x3FB354 BIT_MASK 0x100 /end MEASUREMENT
/begin MEASUREMENT auss_erk_ns_zyl10 "Status Nebenschluss Zuendkerze 10." UWORD FORMULA_0535 0 0 0.0 1.0 ECU_ADDRESS 0x3FB354 BIT_MASK 0x200 /end MEASUREMENT
/begin MEASUREMENT auss_obd_kat "Status Aussetzer Kat." UWORD FORMULA_0536 0 0 0.0 4095.0 ECU_ADDRESS 0x3FB356 /end MEASUREMENT
/begin MEASUREMENT auss_obd_kat_zyl1 "Aussetzererkennung Zylinder 1." UWORD FORMULA_0537 0 0 0.0 1.0 ECU_ADDRESS 0x3FB356 BIT_MASK 0x1 /end MEASUREMENT
/begin MEASUREMENT auss_obd_kat_zyl2 "Aussetzererkennung Zylinder 2." UWORD FORMULA_0538 0 0 0.0 1.0 ECU_ADDRESS 0x3FB356 BIT_MASK 0x2 /end MEASUREMENT
/begin MEASUREMENT auss_obd_kat_zyl3 "Aussetzererkennung Zylinder 3." UWORD FORMULA_0539 0 0 0.0 1.0 ECU_ADDRESS 0x3FB356 BIT_MASK 0x4 /end MEASUREMENT
/begin MEASUREMENT auss_obd_kat_zyl4 "Aussetzererkennung Zylinder 4." UWORD FORMULA_0540 0 0 0.0 1.0 ECU_ADDRESS 0x3FB356 BIT_MASK 0x8 /end MEASUREMENT
/begin MEASUREMENT auss_obd_kat_zyl5 "Aussetzererkennung Zylinder 5." UWORD FORMULA_0541 0 0 0.0 1.0 ECU_ADDRESS 0x3FB356 BIT_MASK 0x10 /end MEASUREMENT
/begin MEASUREMENT auss_obd_kat_zyl6 "Aussetzererkennung Zylinder 6." UWORD FORMULA_0542 0 0 0.0 1.0 ECU_ADDRESS 0x3FB356 BIT_MASK 0x20 /end MEASUREMENT
/begin MEASUREMENT auss_obd_kat_zyl7 "Aussetzererkennung Zylinder 7." UWORD FORMULA_0543 0 0 0.0 1.0 ECU_ADDRESS 0x3FB356 BIT_MASK 0x40 /end MEASUREMENT
/begin MEASUREMENT auss_obd_kat_zyl8 "Aussetzererkennung Zylinder 8." UWORD FORMULA_0544 0 0 0.0 1.0 ECU_ADDRESS 0x3FB356 BIT_MASK 0x80 /end MEASUREMENT
/begin MEASUREMENT auss_obd_kat_zyl9 "Aussetzererkennung Zylinder 9." UWORD FORMULA_0545 0 0 0.0 1.0 ECU_ADDRESS 0x3FB356 BIT_MASK 0x100 /end MEASUREMENT
/begin MEASUREMENT auss_obd_kat_zyl10 "Aussetzererkennung Zylinder 10." UWORD FORMULA_0546 0 0 0.0 1.0 ECU_ADDRESS 0x3FB356 BIT_MASK 0x200 /end MEASUREMENT
/begin MEASUREMENT auss_obd_abg "Status Aussetzer Abgas." UWORD FORMULA_0547 0 0 0.0 4095.0 ECU_ADDRESS 0x3FB358 /end MEASUREMENT
/begin MEASUREMENT auss_obd_abg_zyl1 "Aussetzererkennung Zylinder 1." UWORD FORMULA_0548 0 0 0.0 1.0 ECU_ADDRESS 0x3FB358 BIT_MASK 0x1 /end MEASUREMENT
/begin MEASUREMENT auss_obd_abg_zyl2 "Aussetzererkennung Zylinder 2." UWORD FORMULA_0549 0 0 0.0 1.0 ECU_ADDRESS 0x3FB358 BIT_MASK 0x2 /end MEASUREMENT
/begin MEASUREMENT auss_obd_abg_zyl3 "Aussetzererkennung Zylinder 3." UWORD FORMULA_0550 0 0 0.0 1.0 ECU_ADDRESS 0x3FB358 BIT_MASK 0x4 /end MEASUREMENT
/begin MEASUREMENT auss_obd_abg_zyl4 "Aussetzererkennung Zylinder 4." UWORD FORMULA_0551 0 0 0.0 1.0 ECU_ADDRESS 0x3FB358 BIT_MASK 0x8 /end MEASUREMENT
/begin MEASUREMENT auss_obd_abg_zyl5 "Aussetzererkennung Zylinder 5." UWORD FORMULA_0552 0 0 0.0 1.0 ECU_ADDRESS 0x3FB358 BIT_MASK 0x10 /end MEASUREMENT
/begin MEASUREMENT auss_obd_abg_zyl6 "Aussetzererkennung Zylinder 6." UWORD FORMULA_0553 0 0 0.0 1.0 ECU_ADDRESS 0x3FB358 BIT_MASK 0x20 /end MEASUREMENT
/begin MEASUREMENT auss_obd_abg_zyl7 "Aussetzererkennung Zylinder 7." UWORD FORMULA_0554 0 0 0.0 1.0 ECU_ADDRESS 0x3FB358 BIT_MASK 0x40 /end MEASUREMENT
/begin MEASUREMENT auss_obd_abg_zyl8 "Aussetzererkennung Zylinder 8." UWORD FORMULA_0555 0 0 0.0 1.0 ECU_ADDRESS 0x3FB358 BIT_MASK 0x80 /end MEASUREMENT
/begin MEASUREMENT auss_obd_abg_zyl9 "Aussetzererkennung Zylinder 9." UWORD FORMULA_0556 0 0 0.0 1.0 ECU_ADDRESS 0x3FB358 BIT_MASK 0x100 /end MEASUREMENT
/begin MEASUREMENT auss_obd_abg_zyl10 "Aussetzererkennung Zylinder 10." UWORD FORMULA_0557 0 0 0.0 1.0 ECU_ADDRESS 0x3FB358 BIT_MASK 0x200 /end MEASUREMENT
/begin MEASUREMENT auss_dtz_st "Status delta Rueckziehwinkel." UWORD FORMULA_0558 0 0 0.0 4095.0 ECU_ADDRESS 0x3FB35A /end MEASUREMENT
/begin MEASUREMENT auss_dtz_st_zyl1 "dtz Zylinder 1." UWORD FORMULA_0559 0 0 0.0 1.0 ECU_ADDRESS 0x3FB35A BIT_MASK 0x1 /end MEASUREMENT
/begin MEASUREMENT auss_dtz_st_zyl2 "dtz Zylinder 2." UWORD FORMULA_0560 0 0 0.0 1.0 ECU_ADDRESS 0x3FB35A BIT_MASK 0x2 /end MEASUREMENT
/begin MEASUREMENT auss_dtz_st_zyl3 "dtz Zylinder 3." UWORD FORMULA_0561 0 0 0.0 1.0 ECU_ADDRESS 0x3FB35A BIT_MASK 0x4 /end MEASUREMENT
/begin MEASUREMENT auss_dtz_st_zyl4 "dtz Zylinder 4." UWORD FORMULA_0562 0 0 0.0 1.0 ECU_ADDRESS 0x3FB35A BIT_MASK 0x8 /end MEASUREMENT
/begin MEASUREMENT auss_dtz_st_zyl5 "dtz Zylinder 5." UWORD FORMULA_0563 0 0 0.0 1.0 ECU_ADDRESS 0x3FB35A BIT_MASK 0x10 /end MEASUREMENT
/begin MEASUREMENT auss_dtz_st_zyl6 "dtz Zylinder 6." UWORD FORMULA_0564 0 0 0.0 1.0 ECU_ADDRESS 0x3FB35A BIT_MASK 0x20 /end MEASUREMENT
/begin MEASUREMENT auss_dtz_st_zyl7 "dtz Zylinder 7." UWORD FORMULA_0565 0 0 0.0 1.0 ECU_ADDRESS 0x3FB35A BIT_MASK 0x40 /end MEASUREMENT
/begin MEASUREMENT auss_dtz_st_zyl8 "dtz Zylinder 8." UWORD FORMULA_0566 0 0 0.0 1.0 ECU_ADDRESS 0x3FB35A BIT_MASK 0x80 /end MEASUREMENT
/begin MEASUREMENT auss_dtz_st_zyl9 "dtz Zylinder 9." UWORD FORMULA_0567 0 0 0.0 1.0 ECU_ADDRESS 0x3FB35A BIT_MASK 0x100 /end MEASUREMENT
/begin MEASUREMENT auss_dtz_st_zyl10 "dtz Zylinder 10." UWORD FORMULA_0568 0 0 0.0 1.0 ECU_ADDRESS 0x3FB35A BIT_MASK 0x200 /end MEASUREMENT
/begin MEASUREMENT auss_obd_tz_grad "Deaktivierungsschwelle fuer tz_grad." SWORD FORMULA_0249 0 0 -100.0000 100.0000 ECU_ADDRESS 0x3FB35C /end MEASUREMENT
/begin MEASUREMENT auss_min_avg_samples "Anzahl Messpunkte Minimalintegral." UWORD FORMULA_0569 0 0 4.0000 4092.0000 ECU_ADDRESS 0x3FB35E /end MEASUREMENT
/begin MEASUREMENT auss_asp_sa_cnt "Arbeitspielzaehler waehren SA." UWORD FORMULA_0010 0 0 0.0 65535.0000 ECU_ADDRESS 0x3FB360 /end MEASUREMENT
/begin MEASUREMENT auss_int_start_faktor "Aktueller Faktor-Korrekturwert waerend Startphase." SWORD FORMULA_0570 0 0 0.0 199.9938 ECU_ADDRESS 0x3FB362 /end MEASUREMENT
/begin MEASUREMENT auss_pumg_faktor "Korrektur ueber pumg." SWORD FORMULA_0570 0 0 0.0 199.9938 ECU_ADDRESS 0x3FB364 /end MEASUREMENT
/begin MEASUREMENT auss_int_tmot_faktor "Korrekturfaktor ueber Tmot." SWORD FORMULA_0570 0 0 0.0 199.9938 ECU_ADDRESS 0x3FB366 /end MEASUREMENT
/begin MEASUREMENT auss_obd_dtz_max "Maximal zul. delta Zuendwinkel." SWORD FORMULA_0111 0 0 -50.0000 60.0000 ECU_ADDRESS 0x3FB368 /end MEASUREMENT
/begin MEASUREMENT auss_n_ed "n fuer Fehlereintrag." SWORD FORMULA_0006 0 0 0.0 10000.0000 ECU_ADDRESS 0x3FB36A /end MEASUREMENT
/begin MEASUREMENT auss_n_ed_ti "n fuer Fehlereintrag Verbrennungsaussetzer." SWORD FORMULA_0006 0 0 0.0 10000.0000 ECU_ADDRESS 0x3FB36C /end MEASUREMENT
/begin MEASUREMENT auss_n_ed_ns "n fuer Fehlereintrag Nebenschluss." SWORD FORMULA_0006 0 0 0.0 10000.0000 ECU_ADDRESS 0x3FB36E /end MEASUREMENT
/begin MEASUREMENT auss_rf_ed_b1 "rf fuer Fehlereintrag." SWORD FORMULA_0007 0 0 0.0 2.0000 ECU_ADDRESS 0x3FB370 /end MEASUREMENT
/begin MEASUREMENT auss_rf_ed_b2 "rf fuer Fehlereintrag." SWORD FORMULA_0007 0 0 0.0 2.0000 ECU_ADDRESS 0x3FB372 /end MEASUREMENT
/begin MEASUREMENT auss_rf_ed_ti_b1 "rf fuer Fehlereintrag Verbrennungsaussetzer." SWORD FORMULA_0007 0 0 0.0 2.0000 ECU_ADDRESS 0x3FB374 /end MEASUREMENT
/begin MEASUREMENT auss_rf_ed_ti_b2 "rf fuer Fehlereintrag Verbrennungsaussetzer." SWORD FORMULA_0007 0 0 0.0 2.0000 ECU_ADDRESS 0x3FB376 /end MEASUREMENT
/begin MEASUREMENT auss_rf_ed_ns_b1 "rf fuer Fehlereintrag Nebenschluss." SWORD FORMULA_0007 0 0 0.0 2.0000 ECU_ADDRESS 0x3FB378 /end MEASUREMENT
/begin MEASUREMENT auss_rf_ed_ns_b2 "rf fuer Fehlereintrag Nebenschluss." SWORD FORMULA_0007 0 0 0.0 2.0000 ECU_ADDRESS 0x3FB37A /end MEASUREMENT
/begin MEASUREMENT auss_tz_offs_b1 "Offsets vom Aussetzerfenster." SWORD FORMULA_0448 0 0 0.0040 8.1880 ECU_ADDRESS 0x3FB37C /end MEASUREMENT
/begin MEASUREMENT auss_tz_offs_b2 "Offsets vom Aussetzerfenster." SWORD FORMULA_0448 0 0 0.0040 8.1880 ECU_ADDRESS 0x3FB37E /end MEASUREMENT
/begin MEASUREMENT auss_obd_rf_min_b1 "Minimale RF-Aktivierungsschwelle." SWORD FORMULA_0007 0 0 0.0 2.0000 ECU_ADDRESS 0x3FB380 /end MEASUREMENT
/begin MEASUREMENT auss_obd_rf_min_b2 "Minimale RF-Aktivierungsschwelle." SWORD FORMULA_0007 0 0 0.0 2.0000 ECU_ADDRESS 0x3FB382 /end MEASUREMENT
/begin MEASUREMENT auss_obd_pos_md_dyn_b1 "Maximal zul. pos. Dynamik." SWORD FORMULA_0571 0 0 -5000.0000 5000.0000 ECU_ADDRESS 0x3FB384 /end MEASUREMENT
/begin MEASUREMENT auss_obd_pos_md_dyn_b2 "Maximal zul. pos. Dynamik." SWORD FORMULA_0571 0 0 -5000.0000 5000.0000 ECU_ADDRESS 0x3FB386 /end MEASUREMENT
/begin MEASUREMENT auss_obd_neg_md_dyn_b1 "Maximal zul. neg. Dynamik." SWORD FORMULA_0571 0 0 -5000.0000 5000.0000 ECU_ADDRESS 0x3FB388 /end MEASUREMENT
/begin MEASUREMENT auss_obd_neg_md_dyn_b2 "Maximal zul. neg. Dynamik." SWORD FORMULA_0571 0 0 -5000.0000 5000.0000 ECU_ADDRESS 0x3FB38A /end MEASUREMENT
/begin MEASUREMENT auss_obd_t_idle_b1 "Zeit seit Deaktivierungsbedingung." UWORD FORMULA_0021 0 0 0.0 655.0000 ECU_ADDRESS 0x3FB38C /end MEASUREMENT
/begin MEASUREMENT auss_obd_t_idle_b2 "Zeit seit Deaktivierungsbedingung." UWORD FORMULA_0021 0 0 0.0 655.0000 ECU_ADDRESS 0x3FB38E /end MEASUREMENT
/begin MEASUREMENT auss_obd_t_min_lam_b1 "Abschaltzeit wegen Lamda-Unterschreitung." UWORD FORMULA_0021 0 0 0.0 655.0000 ECU_ADDRESS 0x3FB390 /end MEASUREMENT
/begin MEASUREMENT auss_obd_t_min_lam_b2 "Abschaltzeit wegen Lamda-Unterschreitung." UWORD FORMULA_0021 0 0 0.0 655.0000 ECU_ADDRESS 0x3FB392 /end MEASUREMENT
/begin MEASUREMENT auss_lp_int_min_zyl1 "Minimale TP-Leitwertintegralschwelle." SWORD FORMULA_0245 0 0 0.0 4.0000 ECU_ADDRESS 0x3FB394 /end MEASUREMENT
/begin MEASUREMENT auss_lp_int_min_zyl2 "Minimale TP-Leitwertintegralschwelle." SWORD FORMULA_0245 0 0 0.0 4.0000 ECU_ADDRESS 0x3FB396 /end MEASUREMENT
/begin MEASUREMENT auss_lp_int_min_zyl3 "Minimale TP-Leitwertintegralschwelle." SWORD FORMULA_0245 0 0 0.0 4.0000 ECU_ADDRESS 0x3FB398 /end MEASUREMENT
/begin MEASUREMENT auss_lp_int_min_zyl4 "Minimale TP-Leitwertintegralschwelle." SWORD FORMULA_0245 0 0 0.0 4.0000 ECU_ADDRESS 0x3FB39A /end MEASUREMENT
/begin MEASUREMENT auss_lp_int_min_zyl5 "Minimale TP-Leitwertintegralschwelle." SWORD FORMULA_0245 0 0 0.0 4.0000 ECU_ADDRESS 0x3FB39C /end MEASUREMENT
/begin MEASUREMENT auss_lp_int_min_zyl6 "Minimale TP-Leitwertintegralschwelle." SWORD FORMULA_0245 0 0 0.0 4.0000 ECU_ADDRESS 0x3FB39E /end MEASUREMENT
/begin MEASUREMENT auss_lp_int_min_zyl7 "Minimale TP-Leitwertintegralschwelle." SWORD FORMULA_0245 0 0 0.0 4.0000 ECU_ADDRESS 0x3FB3A0 /end MEASUREMENT
/begin MEASUREMENT auss_lp_int_min_zyl8 "Minimale TP-Leitwertintegralschwelle." SWORD FORMULA_0245 0 0 0.0 4.0000 ECU_ADDRESS 0x3FB3A2 /end MEASUREMENT
/begin MEASUREMENT auss_lp_int_min_zyl9 "Minimale TP-Leitwertintegralschwelle." SWORD FORMULA_0245 0 0 0.0 4.0000 ECU_ADDRESS 0x3FB3A4 /end MEASUREMENT
/begin MEASUREMENT auss_lp_int_min_zyl10 "Minimale TP-Leitwertintegralschwelle." SWORD FORMULA_0245 0 0 0.0 4.0000 ECU_ADDRESS 0x3FB3A6 /end MEASUREMENT
/begin MEASUREMENT auss_ns_time_zyl1 "Nebenschlusszeit im Aussetzerfenster." UWORD FORMULA_0448 0 0 0.0 24.5760 ECU_ADDRESS 0x3FB3A8 /end MEASUREMENT
/begin MEASUREMENT auss_ns_time_zyl2 "Nebenschlusszeit im Aussetzerfenster." UWORD FORMULA_0448 0 0 0.0 24.5760 ECU_ADDRESS 0x3FB3AA /end MEASUREMENT
/begin MEASUREMENT auss_ns_time_zyl3 "Nebenschlusszeit im Aussetzerfenster." UWORD FORMULA_0448 0 0 0.0 24.5760 ECU_ADDRESS 0x3FB3AC /end MEASUREMENT
/begin MEASUREMENT auss_ns_time_zyl4 "Nebenschlusszeit im Aussetzerfenster." UWORD FORMULA_0448 0 0 0.0 24.5760 ECU_ADDRESS 0x3FB3AE /end MEASUREMENT
/begin MEASUREMENT auss_ns_time_zyl5 "Nebenschlusszeit im Aussetzerfenster." UWORD FORMULA_0448 0 0 0.0 24.5760 ECU_ADDRESS 0x3FB3B0 /end MEASUREMENT
/begin MEASUREMENT auss_ns_time_zyl6 "Nebenschlusszeit im Aussetzerfenster." UWORD FORMULA_0448 0 0 0.0 24.5760 ECU_ADDRESS 0x3FB3B2 /end MEASUREMENT
/begin MEASUREMENT auss_ns_time_zyl7 "Nebenschlusszeit im Aussetzerfenster." UWORD FORMULA_0448 0 0 0.0 24.5760 ECU_ADDRESS 0x3FB3B4 /end MEASUREMENT
/begin MEASUREMENT auss_ns_time_zyl8 "Nebenschlusszeit im Aussetzerfenster." UWORD FORMULA_0448 0 0 0.0 24.5760 ECU_ADDRESS 0x3FB3B6 /end MEASUREMENT
/begin MEASUREMENT auss_ns_time_zyl9 "Nebenschlusszeit im Aussetzerfenster." UWORD FORMULA_0448 0 0 0.0 24.5760 ECU_ADDRESS 0x3FB3B8 /end MEASUREMENT
/begin MEASUREMENT auss_ns_time_zyl10 "Nebenschlusszeit im Aussetzerfenster." UWORD FORMULA_0448 0 0 0.0 24.5760 ECU_ADDRESS 0x3FB3BA /end MEASUREMENT
/begin MEASUREMENT auss_tz_ed_zyl1 "tz fuer Fehlereintrag." SWORD FORMULA_0111 0 0 -50.0000 60.0000 ECU_ADDRESS 0x3FB3BC /end MEASUREMENT
/begin MEASUREMENT auss_tz_ed_zyl2 "tz fuer Fehlereintrag." SWORD FORMULA_0111 0 0 -50.0000 60.0000 ECU_ADDRESS 0x3FB3BE /end MEASUREMENT
/begin MEASUREMENT auss_tz_ed_zyl3 "tz fuer Fehlereintrag." SWORD FORMULA_0111 0 0 -50.0000 60.0000 ECU_ADDRESS 0x3FB3C0 /end MEASUREMENT
/begin MEASUREMENT auss_tz_ed_zyl4 "tz fuer Fehlereintrag." SWORD FORMULA_0111 0 0 -50.0000 60.0000 ECU_ADDRESS 0x3FB3C2 /end MEASUREMENT
/begin MEASUREMENT auss_tz_ed_zyl5 "tz fuer Fehlereintrag." SWORD FORMULA_0111 0 0 -50.0000 60.0000 ECU_ADDRESS 0x3FB3C4 /end MEASUREMENT
/begin MEASUREMENT auss_tz_ed_zyl6 "tz fuer Fehlereintrag." SWORD FORMULA_0111 0 0 -50.0000 60.0000 ECU_ADDRESS 0x3FB3C6 /end MEASUREMENT
/begin MEASUREMENT auss_tz_ed_zyl7 "tz fuer Fehlereintrag." SWORD FORMULA_0111 0 0 -50.0000 60.0000 ECU_ADDRESS 0x3FB3C8 /end MEASUREMENT
/begin MEASUREMENT auss_tz_ed_zyl8 "tz fuer Fehlereintrag." SWORD FORMULA_0111 0 0 -50.0000 60.0000 ECU_ADDRESS 0x3FB3CA /end MEASUREMENT
/begin MEASUREMENT auss_tz_ed_zyl9 "tz fuer Fehlereintrag." SWORD FORMULA_0111 0 0 -50.0000 60.0000 ECU_ADDRESS 0x3FB3CC /end MEASUREMENT
/begin MEASUREMENT auss_tz_ed_zyl10 "tz fuer Fehlereintrag." SWORD FORMULA_0111 0 0 -50.0000 60.0000 ECU_ADDRESS 0x3FB3CE /end MEASUREMENT
/begin MEASUREMENT auss_tz_ed_ti_zyl1 "tz fuer Fehlereintrag Verbrennungsaussetzer." SWORD FORMULA_0111 0 0 -50.0000 60.0000 ECU_ADDRESS 0x3FB3D0 /end MEASUREMENT
/begin MEASUREMENT auss_tz_ed_ti_zyl2 "tz fuer Fehlereintrag Verbrennungsaussetzer." SWORD FORMULA_0111 0 0 -50.0000 60.0000 ECU_ADDRESS 0x3FB3D2 /end MEASUREMENT
/begin MEASUREMENT auss_tz_ed_ti_zyl3 "tz fuer Fehlereintrag Verbrennungsaussetzer." SWORD FORMULA_0111 0 0 -50.0000 60.0000 ECU_ADDRESS 0x3FB3D4 /end MEASUREMENT
/begin MEASUREMENT auss_tz_ed_ti_zyl4 "tz fuer Fehlereintrag Verbrennungsaussetzer." SWORD FORMULA_0111 0 0 -50.0000 60.0000 ECU_ADDRESS 0x3FB3D6 /end MEASUREMENT
/begin MEASUREMENT auss_tz_ed_ti_zyl5 "tz fuer Fehlereintrag Verbrennungsaussetzer." SWORD FORMULA_0111 0 0 -50.0000 60.0000 ECU_ADDRESS 0x3FB3D8 /end MEASUREMENT
/begin MEASUREMENT auss_tz_ed_ti_zyl6 "tz fuer Fehlereintrag Verbrennungsaussetzer." SWORD FORMULA_0111 0 0 -50.0000 60.0000 ECU_ADDRESS 0x3FB3DA /end MEASUREMENT
/begin MEASUREMENT auss_tz_ed_ti_zyl7 "tz fuer Fehlereintrag Verbrennungsaussetzer." SWORD FORMULA_0111 0 0 -50.0000 60.0000 ECU_ADDRESS 0x3FB3DC /end MEASUREMENT
/begin MEASUREMENT auss_tz_ed_ti_zyl8 "tz fuer Fehlereintrag Verbrennungsaussetzer." SWORD FORMULA_0111 0 0 -50.0000 60.0000 ECU_ADDRESS 0x3FB3DE /end MEASUREMENT
/begin MEASUREMENT auss_tz_ed_ti_zyl9 "tz fuer Fehlereintrag Verbrennungsaussetzer." SWORD FORMULA_0111 0 0 -50.0000 60.0000 ECU_ADDRESS 0x3FB3E0 /end MEASUREMENT
/begin MEASUREMENT auss_tz_ed_ti_zyl10 "tz fuer Fehlereintrag Verbrennungsaussetzer." SWORD FORMULA_0111 0 0 -50.0000 60.0000 ECU_ADDRESS 0x3FB3E2 /end MEASUREMENT
/begin MEASUREMENT auss_tz_ed_ns_zyl1 "tz fuer Fehlereintrag Nebenschluss." SWORD FORMULA_0111 0 0 -50.0000 60.0000 ECU_ADDRESS 0x3FB3E4 /end MEASUREMENT
/begin MEASUREMENT auss_tz_ed_ns_zyl2 "tz fuer Fehlereintrag Nebenschluss." SWORD FORMULA_0111 0 0 -50.0000 60.0000 ECU_ADDRESS 0x3FB3E6 /end MEASUREMENT
/begin MEASUREMENT auss_tz_ed_ns_zyl3 "tz fuer Fehlereintrag Nebenschluss." SWORD FORMULA_0111 0 0 -50.0000 60.0000 ECU_ADDRESS 0x3FB3E8 /end MEASUREMENT
/begin MEASUREMENT auss_tz_ed_ns_zyl4 "tz fuer Fehlereintrag Nebenschluss." SWORD FORMULA_0111 0 0 -50.0000 60.0000 ECU_ADDRESS 0x3FB3EA /end MEASUREMENT
/begin MEASUREMENT auss_tz_ed_ns_zyl5 "tz fuer Fehlereintrag Nebenschluss." SWORD FORMULA_0111 0 0 -50.0000 60.0000 ECU_ADDRESS 0x3FB3EC /end MEASUREMENT
/begin MEASUREMENT auss_tz_ed_ns_zyl6 "tz fuer Fehlereintrag Nebenschluss." SWORD FORMULA_0111 0 0 -50.0000 60.0000 ECU_ADDRESS 0x3FB3EE /end MEASUREMENT
/begin MEASUREMENT auss_tz_ed_ns_zyl7 "tz fuer Fehlereintrag Nebenschluss." SWORD FORMULA_0111 0 0 -50.0000 60.0000 ECU_ADDRESS 0x3FB3F0 /end MEASUREMENT
/begin MEASUREMENT auss_tz_ed_ns_zyl8 "tz fuer Fehlereintrag Nebenschluss." SWORD FORMULA_0111 0 0 -50.0000 60.0000 ECU_ADDRESS 0x3FB3F2 /end MEASUREMENT
/begin MEASUREMENT auss_tz_ed_ns_zyl9 "tz fuer Fehlereintrag Nebenschluss." SWORD FORMULA_0111 0 0 -50.0000 60.0000 ECU_ADDRESS 0x3FB3F4 /end MEASUREMENT
/begin MEASUREMENT auss_tz_ed_ns_zyl10 "tz fuer Fehlereintrag Nebenschluss." SWORD FORMULA_0111 0 0 -50.0000 60.0000 ECU_ADDRESS 0x3FB3F6 /end MEASUREMENT
/begin MEASUREMENT auss_lp_int_ed_zyl1 "Integral fuer Fehlereintrag." SWORD FORMULA_0245 0 0 0.0 4.0000 ECU_ADDRESS 0x3FB3F8 /end MEASUREMENT
/begin MEASUREMENT auss_lp_int_ed_zyl2 "Integral fuer Fehlereintrag." SWORD FORMULA_0245 0 0 0.0 4.0000 ECU_ADDRESS 0x3FB3FA /end MEASUREMENT
/begin MEASUREMENT auss_lp_int_ed_zyl3 "Integral fuer Fehlereintrag." SWORD FORMULA_0245 0 0 0.0 4.0000 ECU_ADDRESS 0x3FB3FC /end MEASUREMENT
/begin MEASUREMENT auss_lp_int_ed_zyl4 "Integral fuer Fehlereintrag." SWORD FORMULA_0245 0 0 0.0 4.0000 ECU_ADDRESS 0x3FB3FE /end MEASUREMENT
/begin MEASUREMENT auss_lp_int_ed_zyl5 "Integral fuer Fehlereintrag." SWORD FORMULA_0245 0 0 0.0 4.0000 ECU_ADDRESS 0x3FB400 /end MEASUREMENT
/begin MEASUREMENT auss_lp_int_ed_zyl6 "Integral fuer Fehlereintrag." SWORD FORMULA_0245 0 0 0.0 4.0000 ECU_ADDRESS 0x3FB402 /end MEASUREMENT
/begin MEASUREMENT auss_lp_int_ed_zyl7 "Integral fuer Fehlereintrag." SWORD FORMULA_0245 0 0 0.0 4.0000 ECU_ADDRESS 0x3FB404 /end MEASUREMENT
/begin MEASUREMENT auss_lp_int_ed_zyl8 "Integral fuer Fehlereintrag." SWORD FORMULA_0245 0 0 0.0 4.0000 ECU_ADDRESS 0x3FB406 /end MEASUREMENT
/begin MEASUREMENT auss_lp_int_ed_zyl9 "Integral fuer Fehlereintrag." SWORD FORMULA_0245 0 0 0.0 4.0000 ECU_ADDRESS 0x3FB408 /end MEASUREMENT
/begin MEASUREMENT auss_lp_int_ed_zyl10 "Integral fuer Fehlereintrag." SWORD FORMULA_0245 0 0 0.0 4.0000 ECU_ADDRESS 0x3FB40A /end MEASUREMENT
/begin MEASUREMENT auss_lp_int_ed_ti_zyl1 "Integral fuer Fehlereintrag Verbrennungsaussetzer." SWORD FORMULA_0245 0 0 0.0 4.0000 ECU_ADDRESS 0x3FB40C /end MEASUREMENT
/begin MEASUREMENT auss_lp_int_ed_ti_zyl2 "Integral fuer Fehlereintrag Verbrennungsaussetzer." SWORD FORMULA_0245 0 0 0.0 4.0000 ECU_ADDRESS 0x3FB40E /end MEASUREMENT
/begin MEASUREMENT auss_lp_int_ed_ti_zyl3 "Integral fuer Fehlereintrag Verbrennungsaussetzer." SWORD FORMULA_0245 0 0 0.0 4.0000 ECU_ADDRESS 0x3FB410 /end MEASUREMENT
/begin MEASUREMENT auss_lp_int_ed_ti_zyl4 "Integral fuer Fehlereintrag Verbrennungsaussetzer." SWORD FORMULA_0245 0 0 0.0 4.0000 ECU_ADDRESS 0x3FB412 /end MEASUREMENT
/begin MEASUREMENT auss_lp_int_ed_ti_zyl5 "Integral fuer Fehlereintrag Verbrennungsaussetzer." SWORD FORMULA_0245 0 0 0.0 4.0000 ECU_ADDRESS 0x3FB414 /end MEASUREMENT
/begin MEASUREMENT auss_lp_int_ed_ti_zyl6 "Integral fuer Fehlereintrag Verbrennungsaussetzer." SWORD FORMULA_0245 0 0 0.0 4.0000 ECU_ADDRESS 0x3FB416 /end MEASUREMENT
/begin MEASUREMENT auss_lp_int_ed_ti_zyl7 "Integral fuer Fehlereintrag Verbrennungsaussetzer." SWORD FORMULA_0245 0 0 0.0 4.0000 ECU_ADDRESS 0x3FB418 /end MEASUREMENT
/begin MEASUREMENT auss_lp_int_ed_ti_zyl8 "Integral fuer Fehlereintrag Verbrennungsaussetzer." SWORD FORMULA_0245 0 0 0.0 4.0000 ECU_ADDRESS 0x3FB41A /end MEASUREMENT
/begin MEASUREMENT auss_lp_int_ed_ti_zyl9 "Integral fuer Fehlereintrag Verbrennungsaussetzer." SWORD FORMULA_0245 0 0 0.0 4.0000 ECU_ADDRESS 0x3FB41C /end MEASUREMENT
/begin MEASUREMENT auss_lp_int_ed_ti_zyl10 "Integral fuer Fehlereintrag Verbrennungsaussetzer." SWORD FORMULA_0245 0 0 0.0 4.0000 ECU_ADDRESS 0x3FB41E /end MEASUREMENT
/begin MEASUREMENT auss_lp_int_ed_ns_zyl1 "Integral fuer Fehlereintrag Nebenschluss." SWORD FORMULA_0245 0 0 0.0 4.0000 ECU_ADDRESS 0x3FB420 /end MEASUREMENT
/begin MEASUREMENT auss_lp_int_ed_ns_zyl2 "Integral fuer Fehlereintrag Nebenschluss." SWORD FORMULA_0245 0 0 0.0 4.0000 ECU_ADDRESS 0x3FB422 /end MEASUREMENT
/begin MEASUREMENT auss_lp_int_ed_ns_zyl3 "Integral fuer Fehlereintrag Nebenschluss." SWORD FORMULA_0245 0 0 0.0 4.0000 ECU_ADDRESS 0x3FB424 /end MEASUREMENT
/begin MEASUREMENT auss_lp_int_ed_ns_zyl4 "Integral fuer Fehlereintrag Nebenschluss." SWORD FORMULA_0245 0 0 0.0 4.0000 ECU_ADDRESS 0x3FB426 /end MEASUREMENT
/begin MEASUREMENT auss_lp_int_ed_ns_zyl5 "Integral fuer Fehlereintrag Nebenschluss." SWORD FORMULA_0245 0 0 0.0 4.0000 ECU_ADDRESS 0x3FB428 /end MEASUREMENT
/begin MEASUREMENT auss_lp_int_ed_ns_zyl6 "Integral fuer Fehlereintrag Nebenschluss." SWORD FORMULA_0245 0 0 0.0 4.0000 ECU_ADDRESS 0x3FB42A /end MEASUREMENT
/begin MEASUREMENT auss_lp_int_ed_ns_zyl7 "Integral fuer Fehlereintrag Nebenschluss." SWORD FORMULA_0245 0 0 0.0 4.0000 ECU_ADDRESS 0x3FB42C /end MEASUREMENT
/begin MEASUREMENT auss_lp_int_ed_ns_zyl8 "Integral fuer Fehlereintrag Nebenschluss." SWORD FORMULA_0245 0 0 0.0 4.0000 ECU_ADDRESS 0x3FB42E /end MEASUREMENT
/begin MEASUREMENT auss_lp_int_ed_ns_zyl9 "Integral fuer Fehlereintrag Nebenschluss." SWORD FORMULA_0245 0 0 0.0 4.0000 ECU_ADDRESS 0x3FB430 /end MEASUREMENT
/begin MEASUREMENT auss_lp_int_ed_ns_zyl10 "Integral fuer Fehlereintrag Nebenschluss." SWORD FORMULA_0245 0 0 0.0 4.0000 ECU_ADDRESS 0x3FB432 /end MEASUREMENT
/begin MEASUREMENT auss_spark_time_zyl1 "Funkenbrenndauer." SWORD FORMULA_0447 0 0 0.0 4.6810 ECU_ADDRESS 0x3FB434 /end MEASUREMENT
/begin MEASUREMENT auss_spark_time_zyl2 "Funkenbrenndauer." SWORD FORMULA_0447 0 0 0.0 4.6810 ECU_ADDRESS 0x3FB436 /end MEASUREMENT
/begin MEASUREMENT auss_spark_time_zyl3 "Funkenbrenndauer." SWORD FORMULA_0447 0 0 0.0 4.6810 ECU_ADDRESS 0x3FB438 /end MEASUREMENT
/begin MEASUREMENT auss_spark_time_zyl4 "Funkenbrenndauer." SWORD FORMULA_0447 0 0 0.0 4.6810 ECU_ADDRESS 0x3FB43A /end MEASUREMENT
/begin MEASUREMENT auss_spark_time_zyl5 "Funkenbrenndauer." SWORD FORMULA_0447 0 0 0.0 4.6810 ECU_ADDRESS 0x3FB43C /end MEASUREMENT
/begin MEASUREMENT auss_spark_time_zyl6 "Funkenbrenndauer." SWORD FORMULA_0447 0 0 0.0 4.6810 ECU_ADDRESS 0x3FB43E /end MEASUREMENT
/begin MEASUREMENT auss_spark_time_zyl7 "Funkenbrenndauer." SWORD FORMULA_0447 0 0 0.0 4.6810 ECU_ADDRESS 0x3FB440 /end MEASUREMENT
/begin MEASUREMENT auss_spark_time_zyl8 "Funkenbrenndauer." SWORD FORMULA_0447 0 0 0.0 4.6810 ECU_ADDRESS 0x3FB442 /end MEASUREMENT
/begin MEASUREMENT auss_spark_time_zyl9 "Funkenbrenndauer." SWORD FORMULA_0447 0 0 0.0 4.6810 ECU_ADDRESS 0x3FB444 /end MEASUREMENT
/begin MEASUREMENT auss_spark_time_zyl10 "Funkenbrenndauer." SWORD FORMULA_0447 0 0 0.0 4.6810 ECU_ADDRESS 0x3FB446 /end MEASUREMENT
/begin MEASUREMENT auss_spark_time_fil_zyl1 "Funkenbrenndauer." SWORD FORMULA_0447 0 0 0.0 4.6810 ECU_ADDRESS 0x3FB448 /end MEASUREMENT
/begin MEASUREMENT auss_spark_time_fil_zyl2 "Funkenbrenndauer." SWORD FORMULA_0447 0 0 0.0 4.6810 ECU_ADDRESS 0x3FB44A /end MEASUREMENT
/begin MEASUREMENT auss_spark_time_fil_zyl3 "Funkenbrenndauer." SWORD FORMULA_0447 0 0 0.0 4.6810 ECU_ADDRESS 0x3FB44C /end MEASUREMENT
/begin MEASUREMENT auss_spark_time_fil_zyl4 "Funkenbrenndauer." SWORD FORMULA_0447 0 0 0.0 4.6810 ECU_ADDRESS 0x3FB44E /end MEASUREMENT
/begin MEASUREMENT auss_spark_time_fil_zyl5 "Funkenbrenndauer." SWORD FORMULA_0447 0 0 0.0 4.6810 ECU_ADDRESS 0x3FB450 /end MEASUREMENT
/begin MEASUREMENT auss_spark_time_fil_zyl6 "Funkenbrenndauer." SWORD FORMULA_0447 0 0 0.0 4.6810 ECU_ADDRESS 0x3FB452 /end MEASUREMENT
/begin MEASUREMENT auss_spark_time_fil_zyl7 "Funkenbrenndauer." SWORD FORMULA_0447 0 0 0.0 4.6810 ECU_ADDRESS 0x3FB454 /end MEASUREMENT
/begin MEASUREMENT auss_spark_time_fil_zyl8 "Funkenbrenndauer." SWORD FORMULA_0447 0 0 0.0 4.6810 ECU_ADDRESS 0x3FB456 /end MEASUREMENT
/begin MEASUREMENT auss_spark_time_fil_zyl9 "Funkenbrenndauer." SWORD FORMULA_0447 0 0 0.0 4.6810 ECU_ADDRESS 0x3FB458 /end MEASUREMENT
/begin MEASUREMENT auss_spark_time_fil_zyl10 "Funkenbrenndauer." SWORD FORMULA_0447 0 0 0.0 4.6810 ECU_ADDRESS 0x3FB45A /end MEASUREMENT
/begin MEASUREMENT auss_lp_min_zyl1 "Offset Leitwert im Aussetzerfenster." SWORD FORMULA_0443 0 0 0.0 0.6000 ECU_ADDRESS 0x3FB45C /end MEASUREMENT
/begin MEASUREMENT auss_lp_min_zyl2 "Offset Leitwert im Aussetzerfenster." SWORD FORMULA_0443 0 0 0.0 0.6000 ECU_ADDRESS 0x3FB45E /end MEASUREMENT
/begin MEASUREMENT auss_lp_min_zyl3 "Offset Leitwert im Aussetzerfenster." SWORD FORMULA_0443 0 0 0.0 0.6000 ECU_ADDRESS 0x3FB460 /end MEASUREMENT
/begin MEASUREMENT auss_lp_min_zyl4 "Offset Leitwert im Aussetzerfenster." SWORD FORMULA_0443 0 0 0.0 0.6000 ECU_ADDRESS 0x3FB462 /end MEASUREMENT
/begin MEASUREMENT auss_lp_min_zyl5 "Offset Leitwert im Aussetzerfenster." SWORD FORMULA_0443 0 0 0.0 0.6000 ECU_ADDRESS 0x3FB464 /end MEASUREMENT
/begin MEASUREMENT auss_lp_min_zyl6 "Offset Leitwert im Aussetzerfenster." SWORD FORMULA_0443 0 0 0.0 0.6000 ECU_ADDRESS 0x3FB466 /end MEASUREMENT
/begin MEASUREMENT auss_lp_min_zyl7 "Offset Leitwert im Aussetzerfenster." SWORD FORMULA_0443 0 0 0.0 0.6000 ECU_ADDRESS 0x3FB468 /end MEASUREMENT
/begin MEASUREMENT auss_lp_min_zyl8 "Offset Leitwert im Aussetzerfenster." SWORD FORMULA_0443 0 0 0.0 0.6000 ECU_ADDRESS 0x3FB46A /end MEASUREMENT
/begin MEASUREMENT auss_lp_min_zyl9 "Offset Leitwert im Aussetzerfenster." SWORD FORMULA_0443 0 0 0.0 0.6000 ECU_ADDRESS 0x3FB46C /end MEASUREMENT
/begin MEASUREMENT auss_lp_min_zyl10 "Offset Leitwert im Aussetzerfenster." SWORD FORMULA_0443 0 0 0.0 0.6000 ECU_ADDRESS 0x3FB46E /end MEASUREMENT
/begin MEASUREMENT auss_lp_int_zyl1 "TP-Integral-Leitwert im Aussetzerfenster." SWORD FORMULA_0245 0 0 0.0 4.0000 ECU_ADDRESS 0x3FB470 /end MEASUREMENT
/begin MEASUREMENT auss_lp_int_zyl2 "TP-Integral-Leitwert im Aussetzerfenster." SWORD FORMULA_0245 0 0 0.0 4.0000 ECU_ADDRESS 0x3FB472 /end MEASUREMENT
/begin MEASUREMENT auss_lp_int_zyl3 "TP-Integral-Leitwert im Aussetzerfenster." SWORD FORMULA_0245 0 0 0.0 4.0000 ECU_ADDRESS 0x3FB474 /end MEASUREMENT
/begin MEASUREMENT auss_lp_int_zyl4 "TP-Integral-Leitwert im Aussetzerfenster." SWORD FORMULA_0245 0 0 0.0 4.0000 ECU_ADDRESS 0x3FB476 /end MEASUREMENT
/begin MEASUREMENT auss_lp_int_zyl5 "TP-Integral-Leitwert im Aussetzerfenster." SWORD FORMULA_0245 0 0 0.0 4.0000 ECU_ADDRESS 0x3FB478 /end MEASUREMENT
/begin MEASUREMENT auss_lp_int_zyl6 "TP-Integral-Leitwert im Aussetzerfenster." SWORD FORMULA_0245 0 0 0.0 4.0000 ECU_ADDRESS 0x3FB47A /end MEASUREMENT
/begin MEASUREMENT auss_lp_int_zyl7 "TP-Integral-Leitwert im Aussetzerfenster." SWORD FORMULA_0245 0 0 0.0 4.0000 ECU_ADDRESS 0x3FB47C /end MEASUREMENT
/begin MEASUREMENT auss_lp_int_zyl8 "TP-Integral-Leitwert im Aussetzerfenster." SWORD FORMULA_0245 0 0 0.0 4.0000 ECU_ADDRESS 0x3FB47E /end MEASUREMENT
/begin MEASUREMENT auss_lp_int_zyl9 "TP-Integral-Leitwert im Aussetzerfenster." SWORD FORMULA_0245 0 0 0.0 4.0000 ECU_ADDRESS 0x3FB480 /end MEASUREMENT
/begin MEASUREMENT auss_lp_int_zyl10 "TP-Integral-Leitwert im Aussetzerfenster." SWORD FORMULA_0245 0 0 0.0 4.0000 ECU_ADDRESS 0x3FB482 /end MEASUREMENT
/begin MEASUREMENT auss_obd_sum_abg_spark_zyl1 "Summe Zuendauss. Abgas in 1000 Umdrehungen." UWORD FORMULA_0010 0 0 0.0 65535.0000 ECU_ADDRESS 0x3FB484 /end MEASUREMENT
/begin MEASUREMENT auss_obd_sum_abg_spark_zyl2 "Summe Zuendauss. Abgas in 1000 Umdrehungen." UWORD FORMULA_0010 0 0 0.0 65535.0000 ECU_ADDRESS 0x3FB486 /end MEASUREMENT
/begin MEASUREMENT auss_obd_sum_abg_spark_zyl3 "Summe Zuendauss. Abgas in 1000 Umdrehungen." UWORD FORMULA_0010 0 0 0.0 65535.0000 ECU_ADDRESS 0x3FB488 /end MEASUREMENT
/begin MEASUREMENT auss_obd_sum_abg_spark_zyl4 "Summe Zuendauss. Abgas in 1000 Umdrehungen." UWORD FORMULA_0010 0 0 0.0 65535.0000 ECU_ADDRESS 0x3FB48A /end MEASUREMENT
/begin MEASUREMENT auss_obd_sum_abg_spark_zyl5 "Summe Zuendauss. Abgas in 1000 Umdrehungen." UWORD FORMULA_0010 0 0 0.0 65535.0000 ECU_ADDRESS 0x3FB48C /end MEASUREMENT
/begin MEASUREMENT auss_obd_sum_abg_spark_zyl6 "Summe Zuendauss. Abgas in 1000 Umdrehungen." UWORD FORMULA_0010 0 0 0.0 65535.0000 ECU_ADDRESS 0x3FB48E /end MEASUREMENT
/begin MEASUREMENT auss_obd_sum_abg_spark_zyl7 "Summe Zuendauss. Abgas in 1000 Umdrehungen." UWORD FORMULA_0010 0 0 0.0 65535.0000 ECU_ADDRESS 0x3FB490 /end MEASUREMENT
/begin MEASUREMENT auss_obd_sum_abg_spark_zyl8 "Summe Zuendauss. Abgas in 1000 Umdrehungen." UWORD FORMULA_0010 0 0 0.0 65535.0000 ECU_ADDRESS 0x3FB492 /end MEASUREMENT
/begin MEASUREMENT auss_obd_sum_abg_spark_zyl9 "Summe Zuendauss. Abgas in 1000 Umdrehungen." UWORD FORMULA_0010 0 0 0.0 65535.0000 ECU_ADDRESS 0x3FB494 /end MEASUREMENT
/begin MEASUREMENT auss_obd_sum_abg_spark_zyl10 "Summe Zuendauss. Abgas in 1000 Umdrehungen." UWORD FORMULA_0010 0 0 0.0 65535.0000 ECU_ADDRESS 0x3FB496 /end MEASUREMENT
/begin MEASUREMENT auss_obd_sum_abg_ev_zyl1 "Summe Einspritzauss. Abgas in 1000 Umdrehungen." UWORD FORMULA_0010 0 0 0.0 65535.0000 ECU_ADDRESS 0x3FB498 /end MEASUREMENT
/begin MEASUREMENT auss_obd_sum_abg_ev_zyl2 "Summe Einspritzauss. Abgas in 1000 Umdrehungen." UWORD FORMULA_0010 0 0 0.0 65535.0000 ECU_ADDRESS 0x3FB49A /end MEASUREMENT
/begin MEASUREMENT auss_obd_sum_abg_ev_zyl3 "Summe Einspritzauss. Abgas in 1000 Umdrehungen." UWORD FORMULA_0010 0 0 0.0 65535.0000 ECU_ADDRESS 0x3FB49C /end MEASUREMENT
/begin MEASUREMENT auss_obd_sum_abg_ev_zyl4 "Summe Einspritzauss. Abgas in 1000 Umdrehungen." UWORD FORMULA_0010 0 0 0.0 65535.0000 ECU_ADDRESS 0x3FB49E /end MEASUREMENT
/begin MEASUREMENT auss_obd_sum_abg_ev_zyl5 "Summe Einspritzauss. Abgas in 1000 Umdrehungen." UWORD FORMULA_0010 0 0 0.0 65535.0000 ECU_ADDRESS 0x3FB4A0 /end MEASUREMENT
/begin MEASUREMENT auss_obd_sum_abg_ev_zyl6 "Summe Einspritzauss. Abgas in 1000 Umdrehungen." UWORD FORMULA_0010 0 0 0.0 65535.0000 ECU_ADDRESS 0x3FB4A2 /end MEASUREMENT
/begin MEASUREMENT auss_obd_sum_abg_ev_zyl7 "Summe Einspritzauss. Abgas in 1000 Umdrehungen." UWORD FORMULA_0010 0 0 0.0 65535.0000 ECU_ADDRESS 0x3FB4A4 /end MEASUREMENT
/begin MEASUREMENT auss_obd_sum_abg_ev_zyl8 "Summe Einspritzauss. Abgas in 1000 Umdrehungen." UWORD FORMULA_0010 0 0 0.0 65535.0000 ECU_ADDRESS 0x3FB4A6 /end MEASUREMENT
/begin MEASUREMENT auss_obd_sum_abg_ev_zyl9 "Summe Einspritzauss. Abgas in 1000 Umdrehungen." UWORD FORMULA_0010 0 0 0.0 65535.0000 ECU_ADDRESS 0x3FB4A8 /end MEASUREMENT
/begin MEASUREMENT auss_obd_sum_abg_ev_zyl10 "Summe Einspritzauss. Abgas in 1000 Umdrehungen." UWORD FORMULA_0010 0 0 0.0 65535.0000 ECU_ADDRESS 0x3FB4AA /end MEASUREMENT
/begin MEASUREMENT auss_obd_sum_kat_spark_zyl1 "Gew. Summe kat. Zuendauss. in 200 Umdrehungen." UWORD FORMULA_0572 0 0 0.0 257.0000 ECU_ADDRESS 0x3FB4AC /end MEASUREMENT
/begin MEASUREMENT auss_obd_sum_kat_spark_zyl2 "Gew. Summe kat. Zuendauss. in 200 Umdrehungen." UWORD FORMULA_0572 0 0 0.0 257.0000 ECU_ADDRESS 0x3FB4AE /end MEASUREMENT
/begin MEASUREMENT auss_obd_sum_kat_spark_zyl3 "Gew. Summe kat. Zuendauss. in 200 Umdrehungen." UWORD FORMULA_0572 0 0 0.0 257.0000 ECU_ADDRESS 0x3FB4B0 /end MEASUREMENT
/begin MEASUREMENT auss_obd_sum_kat_spark_zyl4 "Gew. Summe kat. Zuendauss. in 200 Umdrehungen." UWORD FORMULA_0572 0 0 0.0 257.0000 ECU_ADDRESS 0x3FB4B2 /end MEASUREMENT
/begin MEASUREMENT auss_obd_sum_kat_spark_zyl5 "Gew. Summe kat. Zuendauss. in 200 Umdrehungen." UWORD FORMULA_0572 0 0 0.0 257.0000 ECU_ADDRESS 0x3FB4B4 /end MEASUREMENT
/begin MEASUREMENT auss_obd_sum_kat_spark_zyl6 "Gew. Summe kat. Zuendauss. in 200 Umdrehungen." UWORD FORMULA_0572 0 0 0.0 257.0000 ECU_ADDRESS 0x3FB4B6 /end MEASUREMENT
/begin MEASUREMENT auss_obd_sum_kat_spark_zyl7 "Gew. Summe kat. Zuendauss. in 200 Umdrehungen." UWORD FORMULA_0572 0 0 0.0 257.0000 ECU_ADDRESS 0x3FB4B8 /end MEASUREMENT
/begin MEASUREMENT auss_obd_sum_kat_spark_zyl8 "Gew. Summe kat. Zuendauss. in 200 Umdrehungen." UWORD FORMULA_0572 0 0 0.0 257.0000 ECU_ADDRESS 0x3FB4BA /end MEASUREMENT
/begin MEASUREMENT auss_obd_sum_kat_spark_zyl9 "Gew. Summe kat. Zuendauss. in 200 Umdrehungen." UWORD FORMULA_0572 0 0 0.0 257.0000 ECU_ADDRESS 0x3FB4BC /end MEASUREMENT
/begin MEASUREMENT auss_obd_sum_kat_spark_zyl10 "Gew. Summe kat. Zuendauss. in 200 Umdrehungen." UWORD FORMULA_0572 0 0 0.0 257.0000 ECU_ADDRESS 0x3FB4BE /end MEASUREMENT
/begin MEASUREMENT auss_obd_sum_kat_ns_zyl1 "Gew. Summe kat. Nebenschlussauss. in 200 Umdrehungen." UWORD FORMULA_0572 0 0 0.0 257.0000 ECU_ADDRESS 0x3FB4C0 /end MEASUREMENT
/begin MEASUREMENT auss_obd_sum_kat_ns_zyl2 "Gew. Summe kat. Nebenschlussauss. in 200 Umdrehungen." UWORD FORMULA_0572 0 0 0.0 257.0000 ECU_ADDRESS 0x3FB4C2 /end MEASUREMENT
/begin MEASUREMENT auss_obd_sum_kat_ns_zyl3 "Gew. Summe kat. Nebenschlussauss. in 200 Umdrehungen." UWORD FORMULA_0572 0 0 0.0 257.0000 ECU_ADDRESS 0x3FB4C4 /end MEASUREMENT
/begin MEASUREMENT auss_obd_sum_kat_ns_zyl4 "Gew. Summe kat. Nebenschlussauss. in 200 Umdrehungen." UWORD FORMULA_0572 0 0 0.0 257.0000 ECU_ADDRESS 0x3FB4C6 /end MEASUREMENT
/begin MEASUREMENT auss_obd_sum_kat_ns_zyl5 "Gew. Summe kat. Nebenschlussauss. in 200 Umdrehungen." UWORD FORMULA_0572 0 0 0.0 257.0000 ECU_ADDRESS 0x3FB4C8 /end MEASUREMENT
/begin MEASUREMENT auss_obd_sum_kat_ns_zyl6 "Gew. Summe kat. Nebenschlussauss. in 200 Umdrehungen." UWORD FORMULA_0572 0 0 0.0 257.0000 ECU_ADDRESS 0x3FB4CA /end MEASUREMENT
/begin MEASUREMENT auss_obd_sum_kat_ns_zyl7 "Gew. Summe kat. Nebenschlussauss. in 200 Umdrehungen." UWORD FORMULA_0572 0 0 0.0 257.0000 ECU_ADDRESS 0x3FB4CC /end MEASUREMENT
/begin MEASUREMENT auss_obd_sum_kat_ns_zyl8 "Gew. Summe kat. Nebenschlussauss. in 200 Umdrehungen." UWORD FORMULA_0572 0 0 0.0 257.0000 ECU_ADDRESS 0x3FB4CE /end MEASUREMENT
/begin MEASUREMENT auss_obd_sum_kat_ns_zyl9 "Gew. Summe kat. Nebenschlussauss. in 200 Umdrehungen." UWORD FORMULA_0572 0 0 0.0 257.0000 ECU_ADDRESS 0x3FB4D0 /end MEASUREMENT
/begin MEASUREMENT auss_obd_sum_kat_ns_zyl10 "Gew. Summe kat. Nebenschlussauss. in 200 Umdrehungen." UWORD FORMULA_0572 0 0 0.0 257.0000 ECU_ADDRESS 0x3FB4D2 /end MEASUREMENT
/begin MEASUREMENT auss_obd_sum_kat_ev_zyl1 "Gew. Summe kat. Einspritzauss. in 200 Umdrehungen." UWORD FORMULA_0572 0 0 0.0 257.0000 ECU_ADDRESS 0x3FB4D4 /end MEASUREMENT
/begin MEASUREMENT auss_obd_sum_kat_ev_zyl2 "Gew. Summe kat. Einspritzauss. in 200 Umdrehungen." UWORD FORMULA_0572 0 0 0.0 257.0000 ECU_ADDRESS 0x3FB4D6 /end MEASUREMENT
/begin MEASUREMENT auss_obd_sum_kat_ev_zyl3 "Gew. Summe kat. Einspritzauss. in 200 Umdrehungen." UWORD FORMULA_0572 0 0 0.0 257.0000 ECU_ADDRESS 0x3FB4D8 /end MEASUREMENT
/begin MEASUREMENT auss_obd_sum_kat_ev_zyl4 "Gew. Summe kat. Einspritzauss. in 200 Umdrehungen." UWORD FORMULA_0572 0 0 0.0 257.0000 ECU_ADDRESS 0x3FB4DA /end MEASUREMENT
/begin MEASUREMENT auss_obd_sum_kat_ev_zyl5 "Gew. Summe kat. Einspritzauss. in 200 Umdrehungen." UWORD FORMULA_0572 0 0 0.0 257.0000 ECU_ADDRESS 0x3FB4DC /end MEASUREMENT
/begin MEASUREMENT auss_obd_sum_kat_ev_zyl6 "Gew. Summe kat. Einspritzauss. in 200 Umdrehungen." UWORD FORMULA_0572 0 0 0.0 257.0000 ECU_ADDRESS 0x3FB4DE /end MEASUREMENT
/begin MEASUREMENT auss_obd_sum_kat_ev_zyl7 "Gew. Summe kat. Einspritzauss. in 200 Umdrehungen." UWORD FORMULA_0572 0 0 0.0 257.0000 ECU_ADDRESS 0x3FB4E0 /end MEASUREMENT
/begin MEASUREMENT auss_obd_sum_kat_ev_zyl8 "Gew. Summe kat. Einspritzauss. in 200 Umdrehungen." UWORD FORMULA_0572 0 0 0.0 257.0000 ECU_ADDRESS 0x3FB4E2 /end MEASUREMENT
/begin MEASUREMENT auss_obd_sum_kat_ev_zyl9 "Gew. Summe kat. Einspritzauss. in 200 Umdrehungen." UWORD FORMULA_0572 0 0 0.0 257.0000 ECU_ADDRESS 0x3FB4E4 /end MEASUREMENT
/begin MEASUREMENT auss_obd_sum_kat_ev_zyl10 "Gew. Summe kat. Einspritzauss. in 200 Umdrehungen." UWORD FORMULA_0572 0 0 0.0 257.0000 ECU_ADDRESS 0x3FB4E6 /end MEASUREMENT
/begin MEASUREMENT auss_erk_kl15_zyl1 "Zaehler Aussetzer waerend KL15-Zyklus." UWORD FORMULA_0010 0 0 0.0 65535.0000 ECU_ADDRESS 0x3FB4E8 /end MEASUREMENT
/begin MEASUREMENT auss_erk_kl15_zyl2 "Zaehler Aussetzer waerend KL15-Zyklus." UWORD FORMULA_0010 0 0 0.0 65535.0000 ECU_ADDRESS 0x3FB4EA /end MEASUREMENT
/begin MEASUREMENT auss_erk_kl15_zyl3 "Zaehler Aussetzer waerend KL15-Zyklus." UWORD FORMULA_0010 0 0 0.0 65535.0000 ECU_ADDRESS 0x3FB4EC /end MEASUREMENT
/begin MEASUREMENT auss_erk_kl15_zyl4 "Zaehler Aussetzer waerend KL15-Zyklus." UWORD FORMULA_0010 0 0 0.0 65535.0000 ECU_ADDRESS 0x3FB4EE /end MEASUREMENT
/begin MEASUREMENT auss_erk_kl15_zyl5 "Zaehler Aussetzer waerend KL15-Zyklus." UWORD FORMULA_0010 0 0 0.0 65535.0000 ECU_ADDRESS 0x3FB4F0 /end MEASUREMENT
/begin MEASUREMENT auss_erk_kl15_zyl6 "Zaehler Aussetzer waerend KL15-Zyklus." UWORD FORMULA_0010 0 0 0.0 65535.0000 ECU_ADDRESS 0x3FB4F2 /end MEASUREMENT
/begin MEASUREMENT auss_erk_kl15_zyl7 "Zaehler Aussetzer waerend KL15-Zyklus." UWORD FORMULA_0010 0 0 0.0 65535.0000 ECU_ADDRESS 0x3FB4F4 /end MEASUREMENT
/begin MEASUREMENT auss_erk_kl15_zyl8 "Zaehler Aussetzer waerend KL15-Zyklus." UWORD FORMULA_0010 0 0 0.0 65535.0000 ECU_ADDRESS 0x3FB4F6 /end MEASUREMENT
/begin MEASUREMENT auss_erk_kl15_zyl9 "Zaehler Aussetzer waerend KL15-Zyklus." UWORD FORMULA_0010 0 0 0.0 65535.0000 ECU_ADDRESS 0x3FB4F8 /end MEASUREMENT
/begin MEASUREMENT auss_erk_kl15_zyl10 "Zaehler Aussetzer waerend KL15-Zyklus." UWORD FORMULA_0010 0 0 0.0 65535.0000 ECU_ADDRESS 0x3FB4FA /end MEASUREMENT
/begin MEASUREMENT auss_obd_kat_dreh_cnt "Arbeitsspielzaehler Katschutz." ULONG FORMULA_0000 0 0 0.0 4294967295.0000 ECU_ADDRESS 0x3FB4FC /end MEASUREMENT
/begin MEASUREMENT auss_obd_abg_dreh_cnt "Arbeitsspielzaehler Abgas." ULONG FORMULA_0000 0 0 0.0 4294967295.0000 ECU_ADDRESS 0x3FB500 /end MEASUREMENT
/begin MEASUREMENT auss_rf_fil_b1 "gefiltertes rf fuer Aussetzerekennung" SWORD FORMULA_0007 0 0 0.0 2.0000 ECU_ADDRESS 0x3FB504 /end MEASUREMENT
/begin MEASUREMENT auss_rf_fil_b2 "gefiltertes rf fuer Aussetzerekennung" SWORD FORMULA_0007 0 0 0.0 2.0000 ECU_ADDRESS 0x3FB506 /end MEASUREMENT
/begin MEASUREMENT auss_spark_time_min_b1 "Min zulaessige Funkenbrenndauer" SWORD FORMULA_0447 0 0 0.0 4.6810 ECU_ADDRESS 0x3FB508 /end MEASUREMENT
/begin MEASUREMENT auss_spark_time_min_b2 "Min zulaessige Funkenbrenndauer" SWORD FORMULA_0447 0 0 0.0 4.6810 ECU_ADDRESS 0x3FB50A /end MEASUREMENT
/begin MEASUREMENT auss_spark_time_max_b1 "Max zulaessige Funkenbrenndauer" SWORD FORMULA_0447 0 0 0.0 4.6810 ECU_ADDRESS 0x3FB50C /end MEASUREMENT
/begin MEASUREMENT auss_spark_time_max_b2 "Max zulaessige Funkenbrenndauer" SWORD FORMULA_0447 0 0 0.0 4.6810 ECU_ADDRESS 0x3FB50E /end MEASUREMENT
/* ------------------ Abschnitt erzeugt aus ub.dat ------------------ */
/begin CHARACTERISTIC K_UB_TAU "Filterkonstante Bordspannungserfassung | EN: Filter constant, battery-voltage sensing" VALUE 0x7A2F4 TKW_VV_VV_UB 100.0 FORMULA_0478 0.0051 1.2800 /end CHARACTERISTIC
/begin CHARACTERISTIC K_UB_TAU_START "Filterkonstante Bordspannungserfassung beim Start | EN: Filter constant, battery-voltage sensing during start" VALUE 0x7A2F5 TKW_VV_VV_UB 100.0 FORMULA_0478 0.0051 1.2800 /end CHARACTERISTIC
/begin CHARACTERISTIC K_UB_DIAG_MIN "Untere Grenze Bordspannung | EN: Lower limit, battery voltage" VALUE 0x7A2F6 TKW_VV_VV_SW 100.0 FORMULA_0277 0.0 28.0000 FORMAT "%6.3" /end CHARACTERISTIC
/begin CHARACTERISTIC K_UB_DIAG_MAX "Obere Grenze Bordspannung | EN: Upper limit, battery voltage" VALUE 0x7A2F8 TKW_VV_VV_SW 100.0 FORMULA_0277 0.0 28.0000 FORMAT "%6.3" /end CHARACTERISTIC
/begin CHARACTERISTIC K_UB_ML_MIN "Untere Grenze Bordspannung bei laufendem Motor | EN: Lower limit, battery voltage with engine running" VALUE 0x7A2FA TKW_VV_VV_SW 100.0 FORMULA_0277 0.0 28.0000 FORMAT "%6.3" /end CHARACTERISTIC
/begin CHARACTERISTIC K_UB_ERSATZ "Ersatzwert Bordspannung | EN: Substitute value, battery voltage" VALUE 0x7A2FC TKW_VV_VV_SW 100.0 FORMULA_0277 0.0 28.0000 FORMAT "%6.3" /end CHARACTERISTIC
/begin CHARACTERISTIC K_UB_GRAD_MAX "Endanschlag des Integrals | EN: End stop of the integral" VALUE 0x7A2FE TKW_VV_VV_SW 100.0 FORMULA_0277 0.0 50.0000 FORMAT "%6.3" /end CHARACTERISTIC
/begin CHARACTERISTIC K_UB_DIAG_GRAD_INT_MAX "Diagnoseschwelle Integreal | EN: Integral diagnosis threshold" VALUE 0x7A300 TKW_VV_VV_SW 100.0 FORMULA_0277 0.0 50.0000 FORMAT "%6.3" /end CHARACTERISTIC
/begin CHARACTERISTIC K_UB_GRAD_INT_REDUKTION "Integralreduktion pro Druchlauf | EN: Integral reduction per pass" VALUE 0x7A302 TKW_VV_VV_SW 100.0 FORMULA_1044 0.0 50.0000 FORMAT "%6.3" /end CHARACTERISTIC
/begin CHARACTERISTIC K_UB_START_TIME "Ansprechzeit der Plausibilitaet | EN: Plausibility response time" VALUE 0x7A304 TKW_VV_VV_UB 100.0 FORMULA_0232 0.0 255.0000 /end CHARACTERISTIC
/begin CHARACTERISTIC K_UB_DIAG_KL87_MAX_SPERRE "Max. Sperrzeit der Diagnose nach KL87 aus | EN: Maximum diagnosis lock time after terminal 87 off" VALUE 0x7A305 TKW_VV_VV_UB 100.0 FORMULA_0590 5.0000 1275.0000 /end CHARACTERISTIC
/begin MEASUREMENT ub_ad "AD-Wert der U_KL87-Erfassung" SWORD FORMULA_0123 0 0 0.0 1023.0000 ECU_ADDRESS 0x3FC5C0 /end MEASUREMENT
/begin MEASUREMENT ub_filter "Gefilterter Messwert der U_KL87-Erfassung" SWORD FORMULA_0277 0 0 0.0 28.0000 ECU_ADDRESS 0x3FC5C2 /end MEASUREMENT
/begin MEASUREMENT ub_old "UB bei der letzten Erfassung" SWORD FORMULA_0277 0 0 0.0 28.0000 ECU_ADDRESS 0x3FC5C4 /end MEASUREMENT
/begin MEASUREMENT ub_grad_int "Integral des Gradienten" SWORD FORMULA_0277 0 0 0.0 50.0000 ECU_ADDRESS 0x3FC5C6 /end MEASUREMENT
/begin MEASUREMENT ub_diag_kl87_sperre "Sperre der Diagnose nach KL87 aus" UBYTE FORMULA_0590 0 0 0.0 1275.0000 ECU_ADDRESS 0x3FC5C8 /end MEASUREMENT
/begin FUNCTION Anti-Trampeln ""
 /begin DEF_CHARACTERISTIC KF_AT_MD_BEGR_KR KF_AT_MD_BEGR_TN KF_AT_MD_BEGR_TV KL_AT_MD_BEGR_KR_FAK KL_AT_MD_BEGR_TN_FAK KL_AT_MD_BEGR_TV_FAK KL_AT_MD_KUPP_MIN KL_AT_N_FAK KL_AT_SCHLUPF_FAK KL_AT_TRAMPIN_SCHUB KL_AT_V_GRAD_FAK KL_AT_V_GRAD_INT_FAK KL_AT_V_TP_A2 KL_AT_V_TP_A3 KL_AT_V_TP_B1 KL_AT_V_TP_B2 KL_AT_V_TP_B3 K_AT_CFG K_AT_FG_TP_N K_AT_FG_TP_TRAMPIN K_AT_FG_TP_V K_AT_FG_TP_V_GRAD K_AT_MD_BEGR_A1 K_AT_MD_GRAD_TAU_NEG K_AT_MD_GRAD_TAU_POS K_AT_N_MAX K_AT_N_MIN K_AT_SK_MAX K_AT_TRAMPIN_SOLL_SCHUB K_AT_TRAMPIN_SOLL_START K_AT_TRAMPIN_SOLL_STOP K_AT_V_GRAD_DOWN_TAU K_AT_V_GRAD_INT_TAU K_AT_V_GRAD_INT_TGL K_AT_V_GRAD_UP_TAU /end DEF_CHARACTERISTIC
 /begin REF_CHARACTERISTIC /end REF_CHARACTERISTIC
 /begin IN_MEASUREMENT /end IN_MEASUREMENT
 /begin OUT_MEASUREMENT at_ff_dauer at_ff_gang at_ff_km_stand at_ff_md_kupp_wunsch_ges at_ff_st at_ff_st_alt at_ff_tgetr at_ff_trampin_dif at_ff_trmp_avg at_ff_trmp_max at_ff_trmp_sum at_ff_tumg at_ff_v_vorne at_koeff_tp_n_a2 at_koeff_tp_n_a3 at_koeff_tp_n_b1 at_koeff_tp_n_b2 at_koeff_tp_n_b3 at_koeff_tp_trampin_a2 at_koeff_tp_trampin_a3 at_koeff_tp_trampin_b1 at_koeff_tp_trampin_b2 at_koeff_tp_trampin_b3 at_koeff_tp_v_a2 at_koeff_tp_v_a3 at_koeff_tp_v_b1 at_koeff_tp_v_b2 at_koeff_tp_v_b3 at_koeff_tp_v_grad_a2 at_koeff_tp_v_grad_a3 at_koeff_tp_v_grad_b1 at_koeff_tp_v_grad_b2 at_koeff_tp_v_grad_b3 at_md_begr at_md_begr_b0 at_md_begr_b1 at_md_begr_b2 at_md_kupp_min at_md_kupp_ml at_md_kupp_tz at_md_kupp_wunsch at_n_fak at_n_hp at_n_hp_abs_fil at_sample_cnt at_schlupf_fak at_schlupf_li at_schlupf_min at_schlupf_re at_st at_st_eingriff at_st_eingriff_schub at_st_eingriff_zug at_st_enable at_tp_verz_n1 at_tp_verz_n2 at_tp_verz_trampin_ha1 at_tp_verz_trampin_ha2 at_tp_verz_trampin_n1 at_tp_verz_trampin_n2 at_tp_verz_trampin_vl1 at_tp_verz_trampin_vl2 at_tp_verz_trampin_vr1 at_tp_verz_trampin_vr2 at_tp_verz_v_grad_hl1 at_tp_verz_v_grad_hl2 at_tp_verz_v_grad_hr1 at_tp_verz_v_grad_hr2 at_tp_verz_v_grad_vl1 at_tp_verz_v_grad_vl2 at_tp_verz_v_grad_vr1 at_tp_verz_v_grad_vr2 at_tp_verz_v_hl1 at_tp_verz_v_hl2 at_tp_verz_v_hr1 at_tp_verz_v_hr2 at_tp_verz_v_vl1 at_tp_verz_v_vl2 at_tp_verz_v_vr1 at_tp_verz_v_vr2 at_trampin at_trampin_dif at_trampin_dif_verz1 at_trampin_dif_verz2 at_trampin_ha at_trampin_ha_roh at_trampin_ha_tp at_trampin_schub at_trampin_va at_trampin_vl at_trampin_vr at_v_grad_fak at_v_grad_int_100ms at_v_grad_int_100ms_fil at_v_grad_int_80ms at_v_grad_int_80ms_fil at_v_grad_int_fak at_v_grad_int_fil at_v_grad_li at_v_grad_max at_v_grad_re at_v_rad_hl_grad at_v_rad_hl_grad_fil at_v_rad_hl_hp at_v_rad_hl_tp at_v_rad_hl_tp_verz_1of4_ at_v_rad_hl_tp_verz_2of4_ at_v_rad_hl_tp_verz_3of4_ at_v_rad_hl_tp_verz_4of4_ at_v_rad_hl_verz_1of5_ at_v_rad_hl_verz_2of5_ at_v_rad_hl_verz_3of5_ at_v_rad_hl_verz_4of5_ at_v_rad_hl_verz_5of5_ at_v_rad_hr_grad at_v_rad_hr_grad_fil at_v_rad_hr_hp at_v_rad_hr_tp at_v_rad_hr_tp_verz_1of4_ at_v_rad_hr_tp_verz_2of4_ at_v_rad_hr_tp_verz_3of4_ at_v_rad_hr_tp_verz_4of4_ at_v_rad_hr_verz_1of5_ at_v_rad_hr_verz_2of5_ at_v_rad_hr_verz_3of5_ at_v_rad_hr_verz_4of5_ at_v_rad_hr_verz_5of5_ at_v_rad_vl_grad at_v_rad_vl_grad_fil at_v_rad_vl_hp at_v_rad_vl_tp at_v_rad_vl_tp_verz_1of4_ at_v_rad_vl_tp_verz_2of4_ at_v_rad_vl_tp_verz_3of4_ at_v_rad_vl_tp_verz_4of4_ at_v_rad_vr_grad at_v_rad_vr_grad_fil at_v_rad_vr_hp at_v_rad_vr_tp at_v_rad_vr_tp_verz_1of4_ at_v_rad_vr_tp_verz_2of4_ at_v_rad_vr_tp_verz_3of4_ at_v_rad_vr_tp_verz_4of4_ /end OUT_MEASUREMENT
/end FUNCTION
/begin FUNCTION Antiruckelregelung ""
 /begin DEF_CHARACTERISTIC KF_AR_MD_FAKTOR K_AR_CFG K_AR_FAK_KOMFORT K_AR_FAK_SPORT K_AR_KORR_P_1 K_AR_KORR_P_2 K_AR_KORR_P_3 K_AR_KORR_P_4 K_AR_KORR_P_5 K_AR_KORR_P_6 K_AR_KORR_P_7 K_AR_KORR_P_N K_AR_KORR_P_R K_AR_MD_MAX K_AR_MD_MIN K_AR_N_DIF_BESCHL_1 K_AR_N_DIF_BESCHL_2 K_AR_N_DIF_REF_MAX K_AR_N_DIF_REF_MIN K_AR_N_DIF_VERZ_1 K_AR_N_DIF_VERZ_2 K_AR_N_FIL_0 K_AR_N_FIL_1 K_AR_N_FIL_2 K_AR_N_FIL_3 K_AR_N_FIL_4 K_AR_N_MAX K_AR_N_MIN K_AR_T_MAX K_AR_T_PAS_DELAY /end DEF_CHARACTERISTIC
 /begin REF_CHARACTERISTIC /end REF_CHARACTERISTIC
 /begin IN_MEASUREMENT /end IN_MEASUREMENT
 /begin OUT_MEASUREMENT ar_dn ar_md ar_md_kupp_korr ar_n_dif ar_n_dif_last ar_n_dif_ref ar_n_dif_ref_filt ar_n_dif_ref_temp ar_n_ref ar_st ar_state ar_t_max ar_t_pas_delay /end OUT_MEASUREMENT
/end FUNCTION
/begin FUNCTION Aussetzererkennung ""
 /begin DEF_CHARACTERISTIC KF_AUSS_LP_INT_MIN KF_AUSS_OBD_DTZ_MAX KF_AUSS_OBD_WICHT_KAT KF_AUSS_SPARK_TIME_MAX KF_AUSS_SPARK_TIME_MIN KF_AUSS_TZ_OFFS KL_AUSS_INT_DTZ_FAKTOR KL_AUSS_INT_TMOT_FAKTOR KL_AUSS_MIN_AVG_SAMPLES KL_AUSS_OBD_NEG_MD_DYN KL_AUSS_OBD_NEG_MD_DYN_KH KL_AUSS_OBD_POS_MD_DYN KL_AUSS_OBD_POS_MD_DYN_KH KL_AUSS_OBD_RF_MIN KL_AUSS_OBD_TZ_GRAD KL_AUSS_OBD_WICHT_KAT KL_AUSS_PUMG_FAKTOR KL_AUSS_START_FAKTOR K_AG_TZ_ANZ K_AG_TZ_CFG K_AG_TZ_PAUSE K_AG_TZ_V_MIN K_AG_TZ_ZYL K_AUSS_ASP_SA_CNT K_AUSS_ED_LP_INT_MIN K_AUSS_ED_WICHT_SPARK K_AUSS_FETRAWE_N K_AUSS_FETRAWE_RF K_AUSS_FETRAWE_TIME_ML K_AUSS_INT_START_FAKTOR_KOR K_AUSS_LP_COEF_10of40_ K_AUSS_LP_COEF_11of40_ K_AUSS_LP_COEF_12of40_ K_AUSS_LP_COEF_13of40_ K_AUSS_LP_COEF_14of40_ K_AUSS_LP_COEF_15of40_ K_AUSS_LP_COEF_16of40_ K_AUSS_LP_COEF_17of40_ K_AUSS_LP_COEF_18of40_ K_AUSS_LP_COEF_19of40_ K_AUSS_LP_COEF_1of40_ K_AUSS_LP_COEF_20of40_ K_AUSS_LP_COEF_21of40_ K_AUSS_LP_COEF_22of40_ K_AUSS_LP_COEF_23of40_ K_AUSS_LP_COEF_24of40_ K_AUSS_LP_COEF_25of40_ K_AUSS_LP_COEF_26of40_ K_AUSS_LP_COEF_27of40_ K_AUSS_LP_COEF_28of40_ K_AUSS_LP_COEF_29of40_ K_AUSS_LP_COEF_2of40_ K_AUSS_LP_COEF_30of40_ K_AUSS_LP_COEF_31of40_ K_AUSS_LP_COEF_32of40_ K_AUSS_LP_COEF_33of40_ K_AUSS_LP_COEF_34of40_ K_AUSS_LP_COEF_35of40_ K_AUSS_LP_COEF_36of40_ K_AUSS_LP_COEF_37of40_ K_AUSS_LP_COEF_38of40_ K_AUSS_LP_COEF_39of40_ K_AUSS_LP_COEF_3of40_ K_AUSS_LP_COEF_40of40_ K_AUSS_LP_COEF_4of40_ K_AUSS_LP_COEF_5of40_ K_AUSS_LP_COEF_6of40_ K_AUSS_LP_COEF_7of40_ K_AUSS_LP_COEF_8of40_ K_AUSS_LP_COEF_9of40_ K_AUSS_LP_MAX_OFFSET K_AUSS_LP_MIN_BEGR K_AUSS_LP_MIN_NV_TREPP K_AUSS_LP_MIN_SA_MAX_INI K_AUSS_LP_NV_OFFSET K_AUSS_MAX_OFFSET_CFG K_AUSS_MIN_LAM K_AUSS_NS_MAX_ASP K_AUSS_NS_TIME_MAX_IC_0 K_AUSS_NS_TIME_MAX_IC_1 K_AUSS_NS_TIME_MAX_IC_2 K_AUSS_NS_TIME_MAX_IC_3 K_AUSS_NS_TIME_MAX_IC_4 K_AUSS_NS_TIME_MAX_IC_5 K_AUSS_NS_TIME_MAX_IC_6 K_AUSS_NS_TIME_MAX_IC_7 K_AUSS_NS_TIME_MAX_IC_8 K_AUSS_NS_TIME_MAX_IC_9 K_AUSS_NS_TIME_MAX_SAT_0 K_AUSS_NS_TIME_MAX_SAT_1 K_AUSS_NS_TIME_MAX_SAT_2 K_AUSS_NS_TIME_MAX_SAT_3 K_AUSS_OBD_ABG_1 K_AUSS_OBD_ABG_4 K_AUSS_OBD_ABG_WORST_CYL K_AUSS_OBD_CFG K_AUSS_OBD_N_MAX K_AUSS_OBD_N_MIN K_AUSS_OBD_RATE_ABG_ZYL K_AUSS_OBD_SA_CNT K_AUSS_OBD_SA_T_MIN K_AUSS_OBD_SUM_KAT K_AUSS_OBD_T_IDLE K_AUSS_OBD_T_MIN_LAM K_AUSS_OBD_WICHT_EV K_AUSS_OBD_WICHT_NS K_AUSS_OBD_WICHT_SPARK K_AUSS_RF_TAU K_AUSS_SPARK_LEV K_AUSS_SPARK_SIZE K_AUSS_SPARK_TIME_MIN K_AUSS_SPARK_TIME_TAU K_AUSS_TMOT_LU /end DEF_CHARACTERISTIC
 /begin REF_CHARACTERISTIC /end REF_CHARACTERISTIC
 /begin IN_MEASUREMENT /end IN_MEASUREMENT
 /begin OUT_MEASUREMENT ag_tz_anz ag_tz_anz_ctrl ag_tz_cfg_ctrl ag_tz_exd_state ag_tz_mask ag_tz_mask_zyl1 ag_tz_mask_zyl10 ag_tz_mask_zyl2 ag_tz_mask_zyl3 ag_tz_mask_zyl4 ag_tz_mask_zyl5 ag_tz_mask_zyl6 ag_tz_mask_zyl7 ag_tz_mask_zyl8 ag_tz_mask_zyl9 ag_tz_pause ag_tz_pause_ctrl ag_tz_zyl ag_tz_zyl_ctrl auss_asp_sa_cnt auss_dtz_st auss_dtz_st_zyl1 auss_dtz_st_zyl10 auss_dtz_st_zyl2 auss_dtz_st_zyl3 auss_dtz_st_zyl4 auss_dtz_st_zyl5 auss_dtz_st_zyl6 auss_dtz_st_zyl7 auss_dtz_st_zyl8 auss_dtz_st_zyl9 auss_erk_kl15_zyl1 auss_erk_kl15_zyl10 auss_erk_kl15_zyl2 auss_erk_kl15_zyl3 auss_erk_kl15_zyl4 auss_erk_kl15_zyl5 auss_erk_kl15_zyl6 auss_erk_kl15_zyl7 auss_erk_kl15_zyl8 auss_erk_kl15_zyl9 auss_erk_ns auss_erk_ns_zyl1 auss_erk_ns_zyl10 auss_erk_ns_zyl2 auss_erk_ns_zyl3 auss_erk_ns_zyl4 auss_erk_ns_zyl5 auss_erk_ns_zyl6 auss_erk_ns_zyl7 auss_erk_ns_zyl8 auss_erk_ns_zyl9 auss_erk_ti auss_erk_ti_zyl1 auss_erk_ti_zyl10 auss_erk_ti_zyl2 auss_erk_ti_zyl3 auss_erk_ti_zyl4 auss_erk_ti_zyl5 auss_erk_ti_zyl6 auss_erk_ti_zyl7 auss_erk_ti_zyl8 auss_erk_ti_zyl9 auss_erk_tz auss_erk_tz_zyl1 auss_erk_tz_zyl10 auss_erk_tz_zyl2 auss_erk_tz_zyl3 auss_erk_tz_zyl4 auss_erk_tz_zyl5 auss_erk_tz_zyl6 auss_erk_tz_zyl7 auss_erk_tz_zyl8 auss_erk_tz_zyl9 auss_int_start_faktor auss_int_tmot_faktor auss_lp_int_ed_ns_zyl1 auss_lp_int_ed_ns_zyl10 auss_lp_int_ed_ns_zyl2 auss_lp_int_ed_ns_zyl3 auss_lp_int_ed_ns_zyl4 auss_lp_int_ed_ns_zyl5 auss_lp_int_ed_ns_zyl6 auss_lp_int_ed_ns_zyl7 auss_lp_int_ed_ns_zyl8 auss_lp_int_ed_ns_zyl9 auss_lp_int_ed_ti_zyl1 auss_lp_int_ed_ti_zyl10 auss_lp_int_ed_ti_zyl2 auss_lp_int_ed_ti_zyl3 auss_lp_int_ed_ti_zyl4 auss_lp_int_ed_ti_zyl5 auss_lp_int_ed_ti_zyl6 auss_lp_int_ed_ti_zyl7 auss_lp_int_ed_ti_zyl8 auss_lp_int_ed_ti_zyl9 auss_lp_int_ed_zyl1 auss_lp_int_ed_zyl10 auss_lp_int_ed_zyl2 auss_lp_int_ed_zyl3 auss_lp_int_ed_zyl4 auss_lp_int_ed_zyl5 auss_lp_int_ed_zyl6 auss_lp_int_ed_zyl7 auss_lp_int_ed_zyl8 auss_lp_int_ed_zyl9 auss_lp_int_min_zyl1 auss_lp_int_min_zyl10 auss_lp_int_min_zyl2 auss_lp_int_min_zyl3 auss_lp_int_min_zyl4 auss_lp_int_min_zyl5 auss_lp_int_min_zyl6 auss_lp_int_min_zyl7 auss_lp_int_min_zyl8 auss_lp_int_min_zyl9 auss_lp_int_zyl1 auss_lp_int_zyl10 auss_lp_int_zyl2 auss_lp_int_zyl3 auss_lp_int_zyl4 auss_lp_int_zyl5 auss_lp_int_zyl6 auss_lp_int_zyl7 auss_lp_int_zyl8 auss_lp_int_zyl9 auss_lp_min_zyl1 auss_lp_min_zyl10 auss_lp_min_zyl2 auss_lp_min_zyl3 auss_lp_min_zyl4 auss_lp_min_zyl5 auss_lp_min_zyl6 auss_lp_min_zyl7 auss_lp_min_zyl8 auss_lp_min_zyl9 auss_min_avg_samples auss_n_ed auss_n_ed_ns auss_n_ed_ti auss_ns_time_zyl1 auss_ns_time_zyl10 auss_ns_time_zyl2 auss_ns_time_zyl3 auss_ns_time_zyl4 auss_ns_time_zyl5 auss_ns_time_zyl6 auss_ns_time_zyl7 auss_ns_time_zyl8 auss_ns_time_zyl9 auss_obd_abg auss_obd_abg_dreh_cnt auss_obd_abg_ueberschr auss_obd_abg_zyl1 auss_obd_abg_zyl10 auss_obd_abg_zyl2 auss_obd_abg_zyl3 auss_obd_abg_zyl4 auss_obd_abg_zyl5 auss_obd_abg_zyl6 auss_obd_abg_zyl7 auss_obd_abg_zyl8 auss_obd_abg_zyl9 auss_obd_dtz_max auss_obd_kat auss_obd_kat_dreh_cnt auss_obd_kat_zyl1 auss_obd_kat_zyl10 auss_obd_kat_zyl2 auss_obd_kat_zyl3 auss_obd_kat_zyl4 auss_obd_kat_zyl5 auss_obd_kat_zyl6 auss_obd_kat_zyl7 auss_obd_kat_zyl8 auss_obd_kat_zyl9 auss_obd_neg_md_dyn_b1 auss_obd_neg_md_dyn_b2 auss_obd_phase auss_obd_pos_md_dyn_b1 auss_obd_pos_md_dyn_b2 auss_obd_rf_min_b1 auss_obd_rf_min_b2 auss_obd_sa_cnt auss_obd_sa_time auss_obd_scdn_st auss_obd_sum_abg_ev_zyl1 auss_obd_sum_abg_ev_zyl10 auss_obd_sum_abg_ev_zyl2 auss_obd_sum_abg_ev_zyl3 auss_obd_sum_abg_ev_zyl4 auss_obd_sum_abg_ev_zyl5 auss_obd_sum_abg_ev_zyl6 auss_obd_sum_abg_ev_zyl7 auss_obd_sum_abg_ev_zyl8 auss_obd_sum_abg_ev_zyl9 auss_obd_sum_abg_spark_zyl1 auss_obd_sum_abg_spark_zyl10 auss_obd_sum_abg_spark_zyl2 auss_obd_sum_abg_spark_zyl3 auss_obd_sum_abg_spark_zyl4 auss_obd_sum_abg_spark_zyl5 auss_obd_sum_abg_spark_zyl6 auss_obd_sum_abg_spark_zyl7 auss_obd_sum_abg_spark_zyl8 auss_obd_sum_abg_spark_zyl9 auss_obd_sum_kat_ev_zyl1 auss_obd_sum_kat_ev_zyl10 auss_obd_sum_kat_ev_zyl2 auss_obd_sum_kat_ev_zyl3 auss_obd_sum_kat_ev_zyl4 auss_obd_sum_kat_ev_zyl5 auss_obd_sum_kat_ev_zyl6 auss_obd_sum_kat_ev_zyl7 auss_obd_sum_kat_ev_zyl8 auss_obd_sum_kat_ev_zyl9 auss_obd_sum_kat_ns_zyl1 auss_obd_sum_kat_ns_zyl10 auss_obd_sum_kat_ns_zyl2 auss_obd_sum_kat_ns_zyl3 auss_obd_sum_kat_ns_zyl4 auss_obd_sum_kat_ns_zyl5 auss_obd_sum_kat_ns_zyl6 auss_obd_sum_kat_ns_zyl7 auss_obd_sum_kat_ns_zyl8 auss_obd_sum_kat_ns_zyl9 auss_obd_sum_kat_spark_zyl1 auss_obd_sum_kat_spark_zyl10 auss_obd_sum_kat_spark_zyl2 auss_obd_sum_kat_spark_zyl3 auss_obd_sum_kat_spark_zyl4 auss_obd_sum_kat_spark_zyl5 auss_obd_sum_kat_spark_zyl6 auss_obd_sum_kat_spark_zyl7 auss_obd_sum_kat_spark_zyl8 auss_obd_sum_kat_spark_zyl9 auss_obd_t_idle_b1 auss_obd_t_idle_b2 auss_obd_t_min_lam_b1 auss_obd_t_min_lam_b2 auss_obd_tz_grad auss_obd_wicht_kat_b1 auss_obd_wicht_kat_b2 auss_pumg_faktor auss_rf_ed_b1 auss_rf_ed_b2 auss_rf_ed_ns_b1 auss_rf_ed_ns_b2 auss_rf_ed_ti_b1 auss_rf_ed_ti_b2 auss_rf_fil_b1 auss_rf_fil_b2 auss_spark_time_fil_zyl1 auss_spark_time_fil_zyl10 auss_spark_time_fil_zyl2 auss_spark_time_fil_zyl3 auss_spark_time_fil_zyl4 auss_spark_time_fil_zyl5 auss_spark_time_fil_zyl6 auss_spark_time_fil_zyl7 auss_spark_time_fil_zyl8 auss_spark_time_fil_zyl9 auss_spark_time_max_b1 auss_spark_time_max_b2 auss_spark_time_min_b1 auss_spark_time_min_b2 auss_spark_time_zyl1 auss_spark_time_zyl10 auss_spark_time_zyl2 auss_spark_time_zyl3 auss_spark_time_zyl4 auss_spark_time_zyl5 auss_spark_time_zyl6 auss_spark_time_zyl7 auss_spark_time_zyl8 auss_spark_time_zyl9 auss_tz_ed_ns_zyl1 auss_tz_ed_ns_zyl10 auss_tz_ed_ns_zyl2 auss_tz_ed_ns_zyl3 auss_tz_ed_ns_zyl4 auss_tz_ed_ns_zyl5 auss_tz_ed_ns_zyl6 auss_tz_ed_ns_zyl7 auss_tz_ed_ns_zyl8 auss_tz_ed_ns_zyl9 auss_tz_ed_ti_zyl1 auss_tz_ed_ti_zyl10 auss_tz_ed_ti_zyl2 auss_tz_ed_ti_zyl3 auss_tz_ed_ti_zyl4 auss_tz_ed_ti_zyl5 auss_tz_ed_ti_zyl6 auss_tz_ed_ti_zyl7 auss_tz_ed_ti_zyl8 auss_tz_ed_ti_zyl9 auss_tz_ed_zyl1 auss_tz_ed_zyl10 auss_tz_ed_zyl2 auss_tz_ed_zyl3 auss_tz_ed_zyl4 auss_tz_ed_zyl5 auss_tz_ed_zyl6 auss_tz_ed_zyl7 auss_tz_ed_zyl8 auss_tz_ed_zyl9 auss_tz_offs_b1 auss_tz_offs_b2 /end OUT_MEASUREMENT
/end FUNCTION
/begin FUNCTION Beschleunigung ""
 /begin DEF_CHARACTERISTIC K_AFZ_A0 K_AFZ_A0_CNT_MAX K_AFZ_A0_MAX K_AFZ_A0_MIN K_AFZ_BERG_TAU K_AFZ_CAN_BRP_MAX K_AFZ_DIAG_AX K_AFZ_DIAG_MAX K_AFZ_DIAG_MIN K_AFZ_DIAG_T K_AFZ_F_KONV_NENNER K_AFZ_F_KONV_ZAEHLER K_AFZ_MD_KUPP_WUNSCH_GES_MAX K_AFZ_NA0_CNT2_MAX K_AFZ_NA0_FAK K_AFZ_TAU K_AFZ_V_DIREKT_WEG /end DEF_CHARACTERISTIC
 /begin REF_CHARACTERISTIC /end REF_CHARACTERISTIC
 /begin IN_MEASUREMENT /end IN_MEASUREMENT
 /begin OUT_MEASUREMENT afz_a0_cnt afz_a0_sum afz_ad afz_berech afz_berg_pt1 afz_can_ax_fil afz_can_ax_fil_pt1 afz_diag_timer afz_fil afz_fil_pt1 afz_na0_avg1 afz_na0_avg2 afz_roh afz_v_direkt_weg_alt /end OUT_MEASUREMENT
/end FUNCTION
/begin FUNCTION Betriebssystem "" /begin DEF_CHARACTERISTIC /end DEF_CHARACTERISTIC /begin REF_CHARACTERISTIC /end REF_CHARACTERISTIC /begin IN_MEASUREMENT /end IN_MEASUREMENT
 /begin OUT_MEASUREMENT os_err.addr os_err.deadline.cnt os_err.deadline.task os_err.dflt.cnt os_err.dflt.task os_err.fifo.cnt os_err.fifo.task os_err.id.cnt os_err.id.task os_err.limit.cnt os_err.limit.task os_err.no_fnc.cnt os_err.no_fnc.task os_err.stack.cnt os_err.stack.task os_err.sum_cnt os_err.tt_act.cnt os_err.tt_act.task os_err.tt_miss.cnt os_err.tt_miss.task os_err.type os_err.value.cnt os_err.value.task /end OUT_MEASUREMENT
/end FUNCTION
/begin FUNCTION Bordspannung ""
 /begin DEF_CHARACTERISTIC K_UB_DIAG_GRAD_INT_MAX K_UB_DIAG_KL87_MAX_SPERRE K_UB_DIAG_MAX K_UB_DIAG_MIN K_UB_ERSATZ K_UB_GRAD_INT_REDUKTION K_UB_GRAD_MAX K_UB_ML_MIN K_UB_START_TIME K_UB_TAU K_UB_TAU_START /end DEF_CHARACTERISTIC
 /begin REF_CHARACTERISTIC /end REF_CHARACTERISTIC
 /begin IN_MEASUREMENT /end IN_MEASUREMENT
 /begin OUT_MEASUREMENT ub_ad ub_diag_kl87_sperre ub_filter ub_grad_int ub_old /end OUT_MEASUREMENT
/end FUNCTION
/begin FUNCTION Checksumme "" /begin DEF_CHARACTERISTIC /end DEF_CHARACTERISTIC /begin REF_CHARACTERISTIC /end REF_CHARACTERISTIC /begin IN_MEASUREMENT /end IN_MEASUREMENT
 /begin OUT_MEASUREMENT crc32_boot crc32_boot_st crc32_data crc32_data_st crc32_prog crc32_prog_st crc32_result /end OUT_MEASUREMENT
/end FUNCTION
/begin RECORD_LAYOUT TKW_VV_VV_UB FNC_VALUES 1 UBYTE COLUMN_DIR DIRECT /end RECORD_LAYOUT
/begin RECORD_LAYOUT TKW_VV_VV_UW FNC_VALUES 1 UWORD COLUMN_DIR DIRECT /end RECORD_LAYOUT
/begin RECORD_LAYOUT TKW_VV_VV_SW FNC_VALUES 1 SWORD COLUMN_DIR DIRECT /end RECORD_LAYOUT
/begin RECORD_LAYOUT TKW_VV_VV_UL FNC_VALUES 1 ULONG COLUMN_DIR DIRECT /end RECORD_LAYOUT
/begin RECORD_LAYOUT TKW_VV_VV_SF FNC_VALUES 1 FLOAT32_IEEE COLUMN_DIR DIRECT /end RECORD_LAYOUT
/begin RECORD_LAYOUT TKL_UB_VV_SW NO_AXIS_PTS_X 1 UBYTE RESERVED 2 BYTE AXIS_PTS_X 3 UBYTE INDEX_INCR DIRECT FNC_VALUES 4 SWORD COLUMN_DIR DIRECT /end RECORD_LAYOUT
/begin RECORD_LAYOUT TKL_SW_VV_UB NO_AXIS_PTS_X 1 UBYTE RESERVED 2 BYTE AXIS_PTS_X 3 SWORD INDEX_INCR DIRECT FNC_VALUES 4 UBYTE COLUMN_DIR DIRECT /end RECORD_LAYOUT
/begin RECORD_LAYOUT TKL_SW_VV_UW NO_AXIS_PTS_X 1 UBYTE RESERVED 2 BYTE AXIS_PTS_X 3 SWORD INDEX_INCR DIRECT FNC_VALUES 4 UWORD COLUMN_DIR DIRECT /end RECORD_LAYOUT
/begin RECORD_LAYOUT TKL_SW_VV_SW NO_AXIS_PTS_X 1 UBYTE RESERVED 2 BYTE AXIS_PTS_X 3 SWORD INDEX_INCR DIRECT FNC_VALUES 4 SWORD COLUMN_DIR DIRECT /end RECORD_LAYOUT
/begin RECORD_LAYOUT TKF_SW_SW_UB NO_AXIS_PTS_X 1 UBYTE NO_AXIS_PTS_Y 2 UBYTE AXIS_PTS_X 3 SWORD INDEX_INCR DIRECT AXIS_PTS_Y 4 SWORD INDEX_INCR DIRECT FNC_VALUES 5 UBYTE COLUMN_DIR DIRECT /end RECORD_LAYOUT
/begin RECORD_LAYOUT TKF_SW_SW_SW NO_AXIS_PTS_X 1 UBYTE NO_AXIS_PTS_Y 2 UBYTE AXIS_PTS_X 3 SWORD INDEX_INCR DIRECT AXIS_PTS_Y 4 SWORD INDEX_INCR DIRECT FNC_VALUES 5 SWORD COLUMN_DIR DIRECT /end RECORD_LAYOUT
/end MODULE
/end PROJECT
