/begin PROJECT MSS65-ign-V452 "MSS65 IGN - V452.01-B204.00, data set 0569Q60Z160E"
/begin HEADER "" VERSION "V452.01-B204.00" /end HEADER
/begin MODULE _MSS65-ign "MSS65 IGN - V452.01-B204.00, calibration xxxxxxxx"
/begin MOD_COMMON "" BYTE_ORDER MSB_FIRST /* Default byteorder (Motorola) */ /end MOD_COMMON
/* Formel fuer 1:1-Wiedergabe ohne Einheit */
/begin COMPU_METHOD FORMULA_USER1 "FORMULA_USER1" RAT_FUNC "%7.0" "-" COEFFS 0 1 0 0 0 1 /end COMPU_METHOD
/begin MEASUREMENT sys_sypcr "Watchdog-Register" ULONG FORMULA_USER1 0 0 0.0000 4294967295.0000 ECU_ADDRESS 0x2FC004 /begin FUNCTION_LIST Systemvariablen /end FUNCTION_LIST /end MEASUREMENT
/* ------------------ Abschnitt erzeugt aus adapt_common.dat ------------------ */
/begin COMPU_METHOD FORMULA_0000 "FORMULA_0000" RAT_FUNC "%7.0" "-" COEFFS 0 1 0 0 0 1 /end COMPU_METHOD
/begin COMPU_METHOD FORMULA_0001 "FORMULA_0001" RAT_FUNC "%6.1" "%" COEFFS 0 10 0 0 0 1 /end COMPU_METHOD
/begin COMPU_METHOD FORMULA_0003 "FORMULA_0003" RAT_FUNC "%3.0" "-" COEFFS 0 1 0 0 0 1 /end COMPU_METHOD
/begin COMPU_METHOD FORMULA_0006 "FORMULA_0006" RAT_FUNC "%5.0" "Upm" COEFFS 0 1 0 0 0 1 /end COMPU_METHOD
/begin COMPU_METHOD FORMULA_0007 "FORMULA_0007" RAT_FUNC "%8.3" "-" COEFFS 0 10000 0 0 0 1 /end COMPU_METHOD
/begin COMPU_METHOD FORMULA_0008 "FORMULA_0008" RAT_FUNC "%6.1" "V" COEFFS 0 10 0 0 0 1 /end COMPU_METHOD
/begin COMPU_METHOD FORMULA_0009 "FORMULA_0009" RAT_FUNC "%6.1" "Nm" COEFFS 0 10 0 0 0 1 /end COMPU_METHOD
/begin COMPU_METHOD FORMULA_0010 "FORMULA_0010" RAT_FUNC "%5.0" "-" COEFFS 0 1 0 0 0 1 /end COMPU_METHOD
/begin COMPU_METHOD FORMULA_0015 "FORMULA_0015" TAB_VERB "%5.0" "-" COMPU_TAB_REF FORMULA_0015_VTAB /end COMPU_METHOD
/begin COMPU_VTAB FORMULA_0015_VTAB "FORMULA_0015_VTAB" TAB_VERB 6 512 "MCI" 768 "DataAcc" 1024 "IntrAcc" 1536 "Align" 1792 "PrgExc" 8192 "NMI" /end COMPU_VTAB
/begin COMPU_METHOD FORMULA_0021 "FORMULA_0021" RAT_FUNC "%7.2" "s" COEFFS 0 100 0 0 0 1 /end COMPU_METHOD
/* ------------------ Abschnitt erzeugt aus adapt_glob.dat ------------------ */
/begin COMPU_METHOD FORMULA_0023 "FORMULA_0023" RAT_FUNC "%6.1" "�C" COEFFS 0 10 2732 0 0 1 /end COMPU_METHOD
/begin COMPU_METHOD FORMULA_0024 "FORMULA_0024" RAT_FUNC "%9.4" "-" COEFFS 0 32768 0 0 0 1 /end COMPU_METHOD
/begin COMPU_METHOD FORMULA_0027 "FORMULA_0027" RAT_FUNC "%7.0" "km" COEFFS 0 1 0 0 0 1 /end COMPU_METHOD
/begin COMPU_METHOD FORMULA_0033 "FORMULA_0033" RAT_FUNC "%5.2" "-" COEFFS 0 1 0 0 0 1 /end COMPU_METHOD
/begin COMPU_METHOD FORMULA_0073 "FORMULA_0073" RAT_FUNC "%6.1" "s" COEFFS 0 10 0 0 0 1 /end COMPU_METHOD
/begin COMPU_METHOD FORMULA_0075 "FORMULA_0075" RAT_FUNC "%8.3" "-" COEFFS 0 1024 0 0 0 1 /end COMPU_METHOD
/begin COMPU_METHOD FORMULA_0078 "FORMULA_0078" RAT_FUNC "%6.1" "km/h" COEFFS 0 16 0 0 0 1 /end COMPU_METHOD
/* ------------------ Abschnitt erzeugt aus glob.dat ------------------ */
/begin COMPU_METHOD FORMULA_0083 "FORMULA_0083" RAT_FUNC "%7.2" "-" COEFFS 0 1 0 0 0 1 /end COMPU_METHOD
/begin COMPU_METHOD FORMULA_0114 "FORMULA_0114" RAT_FUNC "%5.0" "Upm/s" COEFFS 0 1 0 0 0 1 /end COMPU_METHOD
/begin COMPU_METHOD FORMULA_0117 "FORMULA_0117" RAT_FUNC "%7.2" "s" COEFFS 0 200 0 0 0 1 /end COMPU_METHOD
/begin COMPU_METHOD FORMULA_0123 "FORMULA_0123" RAT_FUNC "%5.0" "digit" COEFFS 0 1 0 0 0 1 /end COMPU_METHOD
/begin COMPU_METHOD FORMULA_0125 "FORMULA_0125" TAB_VERB "%5.0" "-" COMPU_TAB_REF FORMULA_0125_VTAB /end COMPU_METHOD
/begin COMPU_VTAB FORMULA_0125_VTAB "FORMULA_0125_VTAB" TAB_VERB 8 0 "O.K." 1 "BusOff" 2 "DPR" 4 "Timeout" 5 "BusOff+Timeout" 8 "Overflow" 16 "Chksum" 32 "Alive" DEFAULT_VALUE "Mehrfachfehler" /end COMPU_VTAB
/begin COMPU_METHOD FORMULA_0132 "FORMULA_0132" RAT_FUNC "%7.2" "m/(s*s)" COEFFS 0 40 0 0 0 1 /end COMPU_METHOD
/begin COMPU_METHOD FORMULA_0279 "FORMULA_0279" RAT_FUNC "%3.0" ".Prog" COEFFS 0 1 0 0 0 1 /end COMPU_METHOD
/begin COMPU_METHOD FORMULA_0283 "FORMULA_0283" TAB_VERB "%5.2" "-" COMPU_TAB_REF FORMULA_0283_VTAB /end COMPU_METHOD
/begin COMPU_VTAB FORMULA_0283_VTAB "FORMULA_0283_VTAB" TAB_VERB 6 0 "Inaktiv" 1 "Aktiv" 3 "Aktiv+SA" 4 "TZ frei" 5 "Aktiv+TZ" 7 "Aktiv+TZ+SA" DEFAULT_VALUE "undef" /end COMPU_VTAB
/begin COMPU_METHOD FORMULA_0317 "FORMULA_0317" RAT_FUNC "%5.2" "s" COEFFS 0 100 0 0 0 1 /end COMPU_METHOD
/begin COMPU_METHOD FORMULA_0318 "FORMULA_0318" RAT_FUNC "%3.0" ".Gang" COEFFS 0 1 0 0 0 1 /end COMPU_METHOD
/* ------------------ Abschnitt erzeugt aus sys_zust.dat ------------------ */
/begin COMPU_METHOD FORMULA_0383 "FORMULA_0383" TAB_VERB "%7.2" "-" COMPU_TAB_REF FORMULA_0383_VTAB /end COMPU_METHOD
/begin COMPU_VTAB FORMULA_0383_VTAB "FORMULA_0383_VTAB" TAB_VERB 3 0 "Treiberdiagnose" 1 "Dauerbestromung TPU" 2 "Dauerbestromung Treiber" DEFAULT_VALUE "undef" /end COMPU_VTAB
/begin COMPU_METHOD FORMULA_0384 "FORMULA_0384" TAB_VERB "%7.2" "-" COMPU_TAB_REF FORMULA_0384_VTAB /end COMPU_METHOD
/begin COMPU_VTAB FORMULA_0384_VTAB "FORMULA_0384_VTAB" TAB_VERB 5 1 "Boot" 2 "FpFlash/iD" 4 "FpRAM/iD" 10 "FpFlash/eD" 12 "FpRAM/eD" DEFAULT_VALUE "undefiniert" /end COMPU_VTAB
/begin COMPU_METHOD FORMULA_0385 "FORMULA_0385" TAB_VERB "%3.0" "-" COMPU_TAB_REF FORMULA_0385_VTAB /end COMPU_METHOD
/begin COMPU_VTAB FORMULA_0385_VTAB "FORMULA_0385_VTAB" TAB_VERB 3 0 "Prozessor" 1 "Selbst" 2 "Kollege" DEFAULT_VALUE "undef" /end COMPU_VTAB
/begin COMPU_METHOD FORMULA_0386 "FORMULA_0386" TAB_VERB "%7.2" "-" COMPU_TAB_REF FORMULA_0386_VTAB /end COMPU_METHOD
/begin COMPU_VTAB FORMULA_0386_VTAB "FORMULA_0386_VTAB" TAB_VERB 1 0 "no" DEFAULT_VALUE "ja" /end COMPU_VTAB
/begin COMPU_METHOD FORMULA_0387 "FORMULA_0387" TAB_VERB "%7.2" "-" COMPU_TAB_REF FORMULA_0387_VTAB /end COMPU_METHOD
/begin COMPU_VTAB FORMULA_0387_VTAB "FORMULA_0387_VTAB" TAB_VERB 1 0 "no" DEFAULT_VALUE "ja" /end COMPU_VTAB
/begin COMPU_METHOD FORMULA_0388 "FORMULA_0388" TAB_VERB "%7.2" "-" COMPU_TAB_REF FORMULA_0388_VTAB /end COMPU_METHOD
/begin COMPU_VTAB FORMULA_0388_VTAB "FORMULA_0388_VTAB" TAB_VERB 1 0 "no" DEFAULT_VALUE "ja" /end COMPU_VTAB
/begin COMPU_METHOD FORMULA_0389 "FORMULA_0389" TAB_VERB "%7.2" "-" COMPU_TAB_REF FORMULA_0389_VTAB /end COMPU_METHOD
/begin COMPU_VTAB FORMULA_0389_VTAB "FORMULA_0389_VTAB" TAB_VERB 1 0 "no" DEFAULT_VALUE "ja" /end COMPU_VTAB
/begin COMPU_METHOD FORMULA_0390 "FORMULA_0390" TAB_VERB "%7.2" "-" COMPU_TAB_REF FORMULA_0390_VTAB /end COMPU_METHOD
/begin COMPU_VTAB FORMULA_0390_VTAB "FORMULA_0390_VTAB" TAB_VERB 1 0 "no" DEFAULT_VALUE "ja" /end COMPU_VTAB
/begin COMPU_METHOD FORMULA_0391 "FORMULA_0391" TAB_VERB "%7.2" "-" COMPU_TAB_REF FORMULA_0391_VTAB /end COMPU_METHOD
/begin COMPU_VTAB FORMULA_0391_VTAB "FORMULA_0391_VTAB" TAB_VERB 1 0 "no" DEFAULT_VALUE "ja" /end COMPU_VTAB
/begin COMPU_METHOD FORMULA_0392 "FORMULA_0392" TAB_VERB "%7.2" "-" COMPU_TAB_REF FORMULA_0392_VTAB /end COMPU_METHOD
/begin COMPU_VTAB FORMULA_0392_VTAB "FORMULA_0392_VTAB" TAB_VERB 1 0 "no" DEFAULT_VALUE "ja" /end COMPU_VTAB
/begin COMPU_METHOD FORMULA_0393 "FORMULA_0393" TAB_VERB "%7.2" "-" COMPU_TAB_REF FORMULA_0393_VTAB /end COMPU_METHOD
/begin COMPU_VTAB FORMULA_0393_VTAB "FORMULA_0393_VTAB" TAB_VERB 1 0 "no" DEFAULT_VALUE "ja" /end COMPU_VTAB
/begin COMPU_METHOD FORMULA_0394 "FORMULA_0394" TAB_VERB "%7.2" "-" COMPU_TAB_REF FORMULA_0394_VTAB /end COMPU_METHOD
/begin COMPU_VTAB FORMULA_0394_VTAB "FORMULA_0394_VTAB" TAB_VERB 1 0 "no" DEFAULT_VALUE "ja" /end COMPU_VTAB
/begin COMPU_METHOD FORMULA_0395 "FORMULA_0395" TAB_VERB "%7.2" "-" COMPU_TAB_REF FORMULA_0395_VTAB /end COMPU_METHOD
/begin COMPU_VTAB FORMULA_0395_VTAB "FORMULA_0395_VTAB" TAB_VERB 1 0 "no" DEFAULT_VALUE "ja" /end COMPU_VTAB
/begin COMPU_METHOD FORMULA_0396 "FORMULA_0396" TAB_VERB "%7.2" "-" COMPU_TAB_REF FORMULA_0396_VTAB /end COMPU_METHOD
/begin COMPU_VTAB FORMULA_0396_VTAB "FORMULA_0396_VTAB" TAB_VERB 1 0 "no" DEFAULT_VALUE "ja" /end COMPU_VTAB
/begin COMPU_METHOD FORMULA_0397 "FORMULA_0397" TAB_VERB "%7.2" "-" COMPU_TAB_REF FORMULA_0397_VTAB /end COMPU_METHOD
/begin COMPU_VTAB FORMULA_0397_VTAB "FORMULA_0397_VTAB" TAB_VERB 1 0 "no" DEFAULT_VALUE "ja" /end COMPU_VTAB
/begin COMPU_METHOD FORMULA_0398 "FORMULA_0398" TAB_VERB "%7.2" "-" COMPU_TAB_REF FORMULA_0398_VTAB /end COMPU_METHOD
/begin COMPU_VTAB FORMULA_0398_VTAB "FORMULA_0398_VTAB" TAB_VERB 1 0 "no" DEFAULT_VALUE "ja" /end COMPU_VTAB
/begin COMPU_METHOD FORMULA_0399 "FORMULA_0399" RAT_FUNC "%8.3" "ms" COEFFS 0 1000 0 0 0 1 /end COMPU_METHOD
/begin COMPU_METHOD FORMULA_0400 "FORMULA_0400" TAB_VERB "%3.0" "-" COMPU_TAB_REF FORMULA_0400_VTAB /end COMPU_METHOD
/begin COMPU_VTAB FORMULA_0400_VTAB "FORMULA_0400_VTAB" TAB_VERB 59 0 "kein Fehler" 1 "Adaptionsdaten CRC32" 2 "Programm CRC32" 3 "Daten CRC32" 4 "undef" 5 "undef" 6 "Watchdog-Reset" 7 "Reset" 8 "CRC Boot" 9 "Reset-MCI" 10 "Reset-Data" 11 "Reset-Instr" 13 "Reset-Align" 14 "Reset-Prog" 15 "Reset-NoFp" 19 "Reset-System" 20 "Reset-Trace" 21 "Reset-FpAss" 22 "Reset-Perform" 23 "Reset-SwEmu" 26 "Reset-InstrProt" 27 "Reset-DataProt" 35 "Reset-DataBrk" 36 "Reset-InstrBrk" 37 "Reset-MaskBrk" 38 "Reset-NMIBrk" 39 "Reset-NMI" 40 "Reset-Reserve" 41 "HW_INDEX zu klein" 42 "ADAPT Loeschen" 43 "ADAPT Schreiben" 44 "ADAPT Hochlauf" 50 "SK-Resetausloesung" 51 "ADC" 52 "TZ-TPU Pin" 53 "TZ-TREIBER Pin" 54 "DSP-Bus" 55 "DSP-Stack" 56 "DSP-Watchdog" 57 "DSP-Programm" 58 "DSP-Daten" 59 "DSP-CRC" 60 "ZUST_NL IGN Timeout" 61 "DSP-Zylinder" 62 "FPGA Init Pin NHigh1" 63 "FPGA Init Pin NHigh2" 64 "FPGA Done Pin NHigh" 65 "FPGA Kennung-CRC32" 66 "RAM" 67 "Register" 68 "TPU RAM" 69 "QADC0 CCW" 70 "QADC1 CCW" 71 "SPI-ATIC39 Chain" 72 "SPI-ATIC35 Chain" 73 "SPI-ATIC29 Chain" 74 "Interne Spannung" 75 "OS-Tasksystem" 76 "OS-Stack" DEFAULT_VALUE "undef" /end COMPU_VTAB
/begin COMPU_METHOD FORMULA_0401 "FORMULA_0401" RAT_FUNC "%6.1" "ms" COEFFS 0 1 0 0 0 0.255 /end COMPU_METHOD
/begin COMPU_METHOD FORMULA_0423 "FORMULA_0423" RAT_FUNC "%3.0" "Bit" COEFFS 0 1 0 0 0 4 /end COMPU_METHOD
/begin COMPU_METHOD FORMULA_0424 "FORMULA_0424" TAB_VERB "%5.2" "-" COMPU_TAB_REF FORMULA_0424_VTAB /end COMPU_METHOD
/begin COMPU_VTAB FORMULA_0424_VTAB "FORMULA_0424_VTAB" TAB_VERB 5 0 "offen" 1 "geschlossen" 2 "oeffnet" 3 "schliesst" 7 "Fehler" /end COMPU_VTAB
/begin COMPU_METHOD FORMULA_0425 "FORMULA_0425" TAB_VERB "%5.2" "-" COMPU_TAB_REF FORMULA_0425_VTAB /end COMPU_METHOD
/begin COMPU_VTAB FORMULA_0425_VTAB "FORMULA_0425_VTAB" TAB_VERB 11 0 "Geschaltet" 1 "Aktiv" 2 "ZWK aktiv" 3 "synchronisiert" 4 "SW Neutral" 5 "vorspannen" 6 "Init" 7 "Synchron fertig" 8 "vor Synchron" 9 "vor Synchron aktiv" 15 "Fehler" /end COMPU_VTAB
/begin COMPU_METHOD FORMULA_0435 "FORMULA_0435" RAT_FUNC "%6.1" "%" COEFFS 0 32768 0 0 0 100 /end COMPU_METHOD
/begin COMPU_METHOD FORMULA_0462 "FORMULA_0462" RAT_FUNC "%5.2" "s" COEFFS 0 0 2.56 0 1 0 /end COMPU_METHOD
/begin COMPU_METHOD FORMULA_0478 "FORMULA_0478" RAT_FUNC "%6.3" "s" COEFFS 0 0 1.28 0 1 0 /end COMPU_METHOD
/begin COMPU_METHOD FORMULA_0479 "FORMULA_0479" RAT_FUNC "%4.1" "%" COEFFS 0 10 0 0 0 1 /end COMPU_METHOD
/begin COMPU_METHOD FORMULA_0486 "FORMULA_0486" RAT_FUNC "%5.0" ".Gang" COEFFS 0 1 0 0 0 1 /end COMPU_METHOD
/begin COMPU_METHOD FORMULA_0501 "FORMULA_0501" RAT_FUNC "%4.1" "s" COEFFS 0 10 0 0 0 1 /end COMPU_METHOD
/begin COMPU_METHOD FORMULA_0571 "FORMULA_0571" RAT_FUNC "%5.0" "Nm/s" COEFFS 0 1 0 0 0 20 /end COMPU_METHOD
/begin COMPU_METHOD FORMULA_0679 "FORMULA_0679" RAT_FUNC "%5.2" "s" COEFFS 0 0 25.6 0 1 0 /end COMPU_METHOD
/begin COMPU_METHOD FORMULA_0704 "FORMULA_0704" RAT_FUNC "%5.2" "-" COEFFS 0 128 0 0 0 1 /end COMPU_METHOD
/begin COMPU_METHOD FORMULA_0746 "FORMULA_0746" RAT_FUNC "%3.0" "Upm" COEFFS 0 1 0 0 0 1 /end COMPU_METHOD
/begin COMPU_METHOD FORMULA_0749 "FORMULA_0749" RAT_FUNC "%4.1" "Nm" COEFFS 0 10 0 0 0 1 /end COMPU_METHOD
/begin COMPU_METHOD FORMULA_0799 "FORMULA_0799" RAT_FUNC "%3.0" "Nm/s" COEFFS 0 1 0 0 0 10 /end COMPU_METHOD
/begin COMPU_METHOD FORMULA_0827 "FORMULA_0827" RAT_FUNC "%3.0" "Nm/s" COEFFS 0 1 0 0 0 20 /end COMPU_METHOD
/* ------------------ Abschnitt erzeugt aus smg.dat ------------------ */
/begin COMPU_METHOD FORMULA_0909 "FORMULA_0909" RAT_FUNC "%6.1" "%" COEFFS 0 128 0 0 0 100 /end COMPU_METHOD
/begin COMPU_METHOD FORMULA_0910 "FORMULA_0910" TAB_VERB "%3.0" "-" COMPU_TAB_REF FORMULA_0910_VTAB /end COMPU_METHOD
/begin COMPU_VTAB FORMULA_0910_VTAB "FORMULA_0910_VTAB" TAB_VERB 1 0 "gesperrt" DEFAULT_VALUE "frei" /end COMPU_VTAB
/begin COMPU_METHOD FORMULA_0911 "FORMULA_0911" TAB_VERB "%3.0" "-" COMPU_TAB_REF FORMULA_0911_VTAB /end COMPU_METHOD
/begin COMPU_VTAB FORMULA_0911_VTAB "FORMULA_0911_VTAB" TAB_VERB 1 0 "PT1" DEFAULT_VALUE "Rampe" /end COMPU_VTAB
/begin COMPU_METHOD FORMULA_0912 "FORMULA_0912" TAB_VERB "%3.0" "-" COMPU_TAB_REF FORMULA_0912_VTAB /end COMPU_METHOD
/begin COMPU_VTAB FORMULA_0912_VTAB "FORMULA_0912_VTAB" TAB_VERB 1 0 "nein" DEFAULT_VALUE "erkannt" /end COMPU_VTAB
/begin COMPU_METHOD FORMULA_0913 "FORMULA_0913" TAB_VERB "%5.2" "-" COMPU_TAB_REF FORMULA_0913_VTAB /end COMPU_METHOD
/begin COMPU_VTAB FORMULA_0913_VTAB "FORMULA_0913_VTAB" TAB_VERB 11 0 "undef" 1 "Anfahren" 2 "Anfahren-KD" 3 "Wait-RS" 4 "Anfahren-RS" 5 "Schalten" 6 "Einkuppeln" 7 "Anhalten" 8 "Abwuergen" 9 "Radabriss" 15 "Fehler" /end COMPU_VTAB
/begin COMPU_METHOD FORMULA_0914 "FORMULA_0914" TAB_VERB "%5.2" "-" COMPU_TAB_REF FORMULA_0914_VTAB /end COMPU_METHOD
/begin COMPU_VTAB FORMULA_0914_VTAB "FORMULA_0914_VTAB" TAB_VERB 1 0 "EKR frei" DEFAULT_VALUE "EKR gesperrt" /end COMPU_VTAB
/begin COMPU_METHOD FORMULA_0915 "FORMULA_0915" TAB_VERB "%5.2" "-" COMPU_TAB_REF FORMULA_0915_VTAB /end COMPU_METHOD
/begin COMPU_VTAB FORMULA_0915_VTAB "FORMULA_0915_VTAB" TAB_VERB 1 0 "EKR frei" DEFAULT_VALUE "EKR gesperrt" /end COMPU_VTAB
/begin COMPU_METHOD FORMULA_0916 "FORMULA_0916" TAB_VERB "%5.2" "-" COMPU_TAB_REF FORMULA_0916_VTAB /end COMPU_METHOD
/begin COMPU_VTAB FORMULA_0916_VTAB "FORMULA_0916_VTAB" TAB_VERB 2 0 "Kupplungsschlupf" 1 "kein Schlupf" DEFAULT_VALUE "undefiniert" /end COMPU_VTAB
/begin COMPU_METHOD FORMULA_0917 "FORMULA_0917" RAT_FUNC "%7.2" "%" COEFFS 0 10.24 0 0 0 1 /end COMPU_METHOD
/begin COMPU_METHOD FORMULA_0918 "FORMULA_0918" TAB_VERB "%5.2" "-" COMPU_TAB_REF FORMULA_0918_VTAB /end COMPU_METHOD
/begin COMPU_VTAB FORMULA_0918_VTAB "FORMULA_0918_VTAB" TAB_VERB 11 0 "Inaktiv" 1 "Abregeln" 2 "Schalten" 3 "Aufregeln" 4 "AKS aktiv" 5 "Anfahren" 6 "Auf-LW" 67 "Auf+Ext" 129 "Ab+Korr" 131 "Auf+Korr" 195 "Auf+Korr+Ext" /end COMPU_VTAB
/begin COMPU_METHOD FORMULA_0919 "FORMULA_0919" TAB_VERB "%5.2" "-" COMPU_TAB_REF FORMULA_0919_VTAB /end COMPU_METHOD
/begin COMPU_VTAB FORMULA_0919_VTAB "FORMULA_0919_VTAB" TAB_VERB 1 0 "inaktiv" DEFAULT_VALUE "aktiv" /end COMPU_VTAB
/begin COMPU_METHOD FORMULA_0920 "FORMULA_0920" TAB_VERB "%5.2" "-" COMPU_TAB_REF FORMULA_0920_VTAB /end COMPU_METHOD
/begin COMPU_VTAB FORMULA_0920_VTAB "FORMULA_0920_VTAB" TAB_VERB 1 0 "inaktiv" DEFAULT_VALUE "aktiv" /end COMPU_VTAB
/begin COMPU_METHOD FORMULA_0921 "FORMULA_0921" TAB_VERB "%5.2" "-" COMPU_TAB_REF FORMULA_0921_VTAB /end COMPU_METHOD
/begin COMPU_VTAB FORMULA_0921_VTAB "FORMULA_0921_VTAB" TAB_VERB 1 0 "inaktiv" DEFAULT_VALUE "aktiv" /end COMPU_VTAB
/begin COMPU_METHOD FORMULA_0922 "FORMULA_0922" TAB_VERB "%5.2" "-" COMPU_TAB_REF FORMULA_0922_VTAB /end COMPU_METHOD
/begin COMPU_VTAB FORMULA_0922_VTAB "FORMULA_0922_VTAB" TAB_VERB 1 0 "Begr." DEFAULT_VALUE "Rohwert" /end COMPU_VTAB
/begin COMPU_METHOD FORMULA_0923 "FORMULA_0923" TAB_VERB "%5.2" "-" COMPU_TAB_REF FORMULA_0923_VTAB /end COMPU_METHOD
/begin COMPU_VTAB FORMULA_0923_VTAB "FORMULA_0923_VTAB" TAB_VERB 1 0 "nein" DEFAULT_VALUE "ja" /end COMPU_VTAB
/begin COMPU_METHOD FORMULA_0924 "FORMULA_0924" TAB_VERB "%5.2" "-" COMPU_TAB_REF FORMULA_0924_VTAB /end COMPU_METHOD
/begin COMPU_VTAB FORMULA_0924_VTAB "FORMULA_0924_VTAB" TAB_VERB 1 0 "inaktiv" DEFAULT_VALUE "aktiv" /end COMPU_VTAB
/begin COMPU_METHOD FORMULA_0925 "FORMULA_0925" TAB_VERB "%5.2" "-" COMPU_TAB_REF FORMULA_0925_VTAB /end COMPU_METHOD
/begin COMPU_VTAB FORMULA_0925_VTAB "FORMULA_0925_VTAB" TAB_VERB 1 0 "Inaktiv" DEFAULT_VALUE "Aktiv" /end COMPU_VTAB
/begin COMPU_METHOD FORMULA_0926 "FORMULA_0926" RAT_FUNC "%4.1" "%" COEFFS 0 128 0 0 0 100 /end COMPU_METHOD
/begin COMPU_METHOD FORMULA_0927 "FORMULA_0927" RAT_FUNC "%4.1" "%" COEFFS 0 256 0 0 0 100 /end COMPU_METHOD
/begin COMPU_METHOD FORMULA_0928 "FORMULA_0928" RAT_FUNC "%10.3" "Nm" COEFFS 0 10000 0 0 0 1 /end COMPU_METHOD
/begin COMPU_METHOD FORMULA_0929 "FORMULA_0929" RAT_FUNC "%10.3" "Nm" COEFFS 0 1000 0 0 0 1 /end COMPU_METHOD
/begin COMPU_METHOD FORMULA_0930 "FORMULA_0930" TAB_VERB "%5.2" "-" COMPU_TAB_REF FORMULA_0930_VTAB /end COMPU_METHOD
/begin COMPU_VTAB FORMULA_0930_VTAB "FORMULA_0930_VTAB" TAB_VERB 4 0 "Inaktiv" 1 "Rampe" 2 "Reduktion" 3 "Rampe+Red" DEFAULT_VALUE "undef" /end COMPU_VTAB
/begin COMPU_METHOD FORMULA_0931 "FORMULA_0931" TAB_VERB "%5.2" "-" COMPU_TAB_REF FORMULA_0931_VTAB /end COMPU_METHOD
/begin COMPU_VTAB FORMULA_0931_VTAB "FORMULA_0931_VTAB" TAB_VERB 11 0 "Inaktiv" 1 "Abregeln" 2 "n-Ziel" 3 "n-Regler" 4 "Aufregeln" 5 "Abwuergen" 6 "Radabriss" 7 "Ab-AKS" 9 "Anfahren" 10 "TZ-Nachlauf" 11 "ABS-Eingr" /end COMPU_VTAB
/begin COMPU_METHOD FORMULA_0932 "FORMULA_0932" TAB_VERB "%5.2" "-" COMPU_TAB_REF FORMULA_0932_VTAB /end COMPU_METHOD
/begin COMPU_VTAB FORMULA_0932_VTAB "FORMULA_0932_VTAB" TAB_VERB 1 0 "gleich" DEFAULT_VALUE "aktualisiert" /end COMPU_VTAB
/begin COMPU_METHOD FORMULA_0933 "FORMULA_0933" TAB_VERB "%5.2" "-" COMPU_TAB_REF FORMULA_0933_VTAB /end COMPU_METHOD
/begin COMPU_VTAB FORMULA_0933_VTAB "FORMULA_0933_VTAB" TAB_VERB 1 0 "ueber" DEFAULT_VALUE "unter" /end COMPU_VTAB
/begin COMPU_METHOD FORMULA_0934 "FORMULA_0934" RAT_FUNC "%8.1" "Nm" COEFFS 0 1000 0 0 0 1 /end COMPU_METHOD
/begin COMPU_METHOD FORMULA_0935 "FORMULA_0935" TAB_VERB "%5.2" "-" COMPU_TAB_REF FORMULA_0935_VTAB /end COMPU_METHOD
/begin COMPU_VTAB FORMULA_0935_VTAB "FORMULA_0935_VTAB" TAB_VERB 4 0 "DN/STG-" 1 "UP/STG-" 2 "DN/STG+" 3 "UP/STG+" /end COMPU_VTAB
/begin COMPU_METHOD FORMULA_0936 "FORMULA_0936" RAT_FUNC "%4.1" "%" COEFFS 0 128 0 0 0 100 /end COMPU_METHOD
/begin COMPU_METHOD FORMULA_0937 "FORMULA_0937" RAT_FUNC "%5.0" "ms" COEFFS 0 1.6 0 0 0 1 /end COMPU_METHOD
/begin COMPU_METHOD FORMULA_0938 "FORMULA_0938" TAB_VERB "%5.2" "-" COMPU_TAB_REF FORMULA_0938_VTAB /end COMPU_METHOD
/begin COMPU_VTAB FORMULA_0938_VTAB "FORMULA_0938_VTAB" TAB_VERB 4 0 "kein Abbruch" 1 "Ablauf-Timeout" 2 "CAN-Timeout" 16 "Doppelschaltung" DEFAULT_VALUE "undefiniert" /end COMPU_VTAB
/begin COMPU_METHOD FORMULA_0939 "FORMULA_0939" RAT_FUNC "%5.2" "Nms2" COEFFS 0 128 0 0 0 1 /end COMPU_METHOD
/begin COMPU_METHOD FORMULA_0940 "FORMULA_0940" RAT_FUNC "%5.0" "Nm" COEFFS 0 1 0 0 0 1 /end COMPU_METHOD
/begin COMPU_METHOD FORMULA_0941 "FORMULA_0941" TAB_VERB "%7.2" "-" COMPU_TAB_REF FORMULA_0941_VTAB /end COMPU_METHOD
/begin COMPU_VTAB FORMULA_0941_VTAB "FORMULA_0941_VTAB" TAB_VERB 9 0 "kein Fehler" 1 "DME-St" 2 "mKupp" 4 "nZiel" 8 "nGetr" 16 "nBerech" 32 "Gang" 64 "nZielMax" 128 "nGetrMax" DEFAULT_VALUE "Mehrfach" /end COMPU_VTAB
/begin COMPU_METHOD FORMULA_0942 "FORMULA_0942" RAT_FUNC "%5.0" "km" COEFFS 0 1 0 0 0 1 /end COMPU_METHOD
/begin COMPU_METHOD FORMULA_0943 "FORMULA_0943" RAT_FUNC "%4.1" "%" COEFFS 0 10.24 0 0 0 1 /end COMPU_METHOD
/begin COMPU_METHOD FORMULA_0944 "FORMULA_0944" TAB_VERB "%5.2" "-" COMPU_TAB_REF FORMULA_0944_VTAB /end COMPU_METHOD
/begin COMPU_VTAB FORMULA_0944_VTAB "FORMULA_0944_VTAB" TAB_VERB 2 0 "AKS bei Passiv" 1 "AKS bei Sport" /end COMPU_VTAB
/begin COMPU_METHOD FORMULA_0945 "FORMULA_0945" TAB_VERB "%5.2" "-" COMPU_TAB_REF FORMULA_0945_VTAB /end COMPU_METHOD
/begin COMPU_VTAB FORMULA_0945_VTAB "FORMULA_0945_VTAB" TAB_VERB 3 0 "aus" 1 "n-Regler" 2 "Automat-Prg" /end COMPU_VTAB
/begin COMPU_METHOD FORMULA_0946 "FORMULA_0946" RAT_FUNC "%6.3" "Nm/Upm" COEFFS 0 1000 0 0 0 1 /end COMPU_METHOD
/begin COMPU_METHOD FORMULA_0947 "FORMULA_0947" RAT_FUNC "%5.0" "Nm/s" COEFFS 0 10 0 0 0 1 /end COMPU_METHOD
/begin COMPU_METHOD FORMULA_0948 "FORMULA_0948" RAT_FUNC "%7.4" "Nms/Upm" COEFFS 0 10000 0 0 0 1 /end COMPU_METHOD
/begin COMPU_METHOD FORMULA_0949 "FORMULA_0949" RAT_FUNC "%5.0" "%" COEFFS 0 10.24 0 0 0 1 /end COMPU_METHOD
/begin COMPU_METHOD FORMULA_0950 "FORMULA_0950" TAB_VERB "%5.2" "-" COMPU_TAB_REF FORMULA_0950_VTAB /end COMPU_METHOD
/begin COMPU_VTAB FORMULA_0950_VTAB "FORMULA_0950_VTAB" TAB_VERB 1 0 "ohne Eingriff" DEFAULT_VALUE "mit Eingriff" /end COMPU_VTAB
/begin COMPU_METHOD FORMULA_0951 "FORMULA_0951" RAT_FUNC "%5.2" "cm" COEFFS 0 1 0 0 0 1 /end COMPU_METHOD
/begin COMPU_METHOD FORMULA_0952 "FORMULA_0952" TAB_VERB "%5.2" "-" COMPU_TAB_REF FORMULA_0952_VTAB /end COMPU_METHOD
/begin COMPU_VTAB FORMULA_0952_VTAB "FORMULA_0952_VTAB" TAB_VERB 2 0 "SK aus" 1 "SK ein" /end COMPU_VTAB
/begin COMPU_METHOD FORMULA_0953 "FORMULA_0953" RAT_FUNC "%4.1" "%FW" COEFFS 0 128 0 0 0 100 /end COMPU_METHOD
/begin COMPU_METHOD FORMULA_0954 "FORMULA_0954" RAT_FUNC "%4.1" "%t_END" COEFFS 0 128 0 0 0 100 /end COMPU_METHOD
/begin COMPU_METHOD FORMULA_0955 "FORMULA_0955" RAT_FUNC "%6.1" "2" COEFFS 0 128 0 0 0 1 /end COMPU_METHOD
/begin COMPU_METHOD FORMULA_0956 "FORMULA_0956" RAT_FUNC "%3.0" "%" COEFFS 0 128 0 0 0 100 /end COMPU_METHOD
/begin COMPU_METHOD FORMULA_0957 "FORMULA_0957" RAT_FUNC "%5.2" "Nm/Upm" COEFFS 0 100 0 0 0 1 /end COMPU_METHOD
/begin COMPU_METHOD FORMULA_0958 "FORMULA_0958" RAT_FUNC "%5.2" "Nm/Upm" COEFFS 0 10 0 0 0 1 /end COMPU_METHOD
/begin COMPU_METHOD FORMULA_0959 "FORMULA_0959" RAT_FUNC "%6.3" "Nms/Upm" COEFFS 0 1000 0 0 0 1 /end COMPU_METHOD
/begin COMPU_METHOD FORMULA_0960 "FORMULA_0960" RAT_FUNC "%3.0" "Prog" COEFFS 0 1 0 0 0 1 /end COMPU_METHOD
/begin COMPU_METHOD FORMULA_0961 "FORMULA_0961" RAT_FUNC "%5.2" "-" COEFFS 0 -128 128 0 0 -1 /end COMPU_METHOD
/begin COMPU_METHOD FORMULA_0962 "FORMULA_0962" RAT_FUNC "%5.0" "Nm/s" COEFFS 0 1 0 0 0 10 /end COMPU_METHOD
/* ------------------ Abschnitt erzeugt aus smg_can.dat ------------------ */
/begin COMPU_METHOD FORMULA_0963 "FORMULA_0963" TAB_VERB "%3.0" "-" COMPU_TAB_REF FORMULA_0963_VTAB /end COMPU_METHOD
/begin COMPU_VTAB FORMULA_0963_VTAB "FORMULA_0963_VTAB" TAB_VERB 8 0 "keine" 1 "SMG1" 2 "SMG2" 3 "SMG1+2" 4 "SMG3" 5 "SMG1+3" 6 "SMG2+3" 7 "SMG1+2+3" /end COMPU_VTAB
/begin COMPU_METHOD FORMULA_0964 "FORMULA_0964" TAB_VERB "%5.2" "-" COMPU_TAB_REF FORMULA_0964_VTAB /end COMPU_METHOD
/begin COMPU_VTAB FORMULA_0964_VTAB "FORMULA_0964_VTAB" TAB_VERB 1 0 "kein Schaltwunsch" DEFAULT_VALUE "Schaltwusch" /end COMPU_VTAB
/begin COMPU_METHOD FORMULA_0965 "FORMULA_0965" TAB_VERB "%5.2" "-" COMPU_TAB_REF FORMULA_0965_VTAB /end COMPU_METHOD
/begin COMPU_VTAB FORMULA_0965_VTAB "FORMULA_0965_VTAB" TAB_VERB 1 0 "offen" DEFAULT_VALUE "Kraftschluss" /end COMPU_VTAB
/begin COMPU_METHOD FORMULA_0966 "FORMULA_0966" TAB_VERB "%5.2" "-" COMPU_TAB_REF FORMULA_0966_VTAB /end COMPU_METHOD
/begin COMPU_VTAB FORMULA_0966_VTAB "FORMULA_0966_VTAB" TAB_VERB 1 0 "FGR ein" DEFAULT_VALUE "FGR aus" /end COMPU_VTAB
/begin COMPU_METHOD FORMULA_0967 "FORMULA_0967" TAB_VERB "%5.2" "-" COMPU_TAB_REF FORMULA_0967_VTAB /end COMPU_METHOD
/begin COMPU_VTAB FORMULA_0967_VTAB "FORMULA_0967_VTAB" TAB_VERB 1 0 "HE aus" DEFAULT_VALUE "HE ein" /end COMPU_VTAB
/begin COMPU_METHOD FORMULA_0968 "FORMULA_0968" RAT_FUNC "%4.1" "km/h" COEFFS 0 16 0 0 0 1 /end COMPU_METHOD
/begin COMPU_METHOD FORMULA_0969 "FORMULA_0969" TAB_VERB "%3.0" "-" COMPU_TAB_REF FORMULA_0969_VTAB /end COMPU_METHOD
/begin COMPU_VTAB FORMULA_0969_VTAB "FORMULA_0969_VTAB" TAB_VERB 8 0 "aus" 1 "Getr-Adapt" 2 "Getr-Ausl" 3 "Kupp-Adapt" 4 "GW-Adapt" 5 "a-Laengs" 6 "KKL-Default" 255 "Fehler" DEFAULT_VALUE "undef" /end COMPU_VTAB
/* ------------------ Abschnitt erzeugt aus smg_e2.dat ------------------ */
/begin COMPU_METHOD FORMULA_0970 "FORMULA_0970" TAB_VERB "%5.2" "-" COMPU_TAB_REF FORMULA_0970_VTAB /end COMPU_METHOD
/begin COMPU_VTAB FORMULA_0970_VTAB "FORMULA_0970_VTAB" TAB_VERB 5 0 "kein Fehler" 1 "DME-Status" 2 "Motor-Eingr" 4 "nGetr" 8 "Gang" DEFAULT_VALUE "Mehrfachfehler" /end COMPU_VTAB
/begin COMPU_METHOD FORMULA_0971 "FORMULA_0971" TAB_VERB "%5.2" "-" COMPU_TAB_REF FORMULA_0971_VTAB /end COMPU_METHOD
/begin COMPU_VTAB FORMULA_0971_VTAB "FORMULA_0971_VTAB" TAB_VERB 5 0 "Inaktiv" 1 "Abregeln" 2 "Schalten" 3 "Aufregeln" 4 "Ende" /end COMPU_VTAB
/begin COMPU_METHOD FORMULA_0972 "FORMULA_0972" TAB_VERB "%3.0" "-" COMPU_TAB_REF FORMULA_0972_VTAB /end COMPU_METHOD
/begin COMPU_VTAB FORMULA_0972_VTAB "FORMULA_0972_VTAB" TAB_VERB 1 0 "Schub" DEFAULT_VALUE "Zug" /end COMPU_VTAB
/begin COMPU_METHOD FORMULA_0973 "FORMULA_0973" TAB_VERB "%3.0" "-" COMPU_TAB_REF FORMULA_0973_VTAB /end COMPU_METHOD
/begin COMPU_VTAB FORMULA_0973_VTAB "FORMULA_0973_VTAB" TAB_VERB 1 0 "Frei" DEFAULT_VALUE "Sperre" /end COMPU_VTAB
/* ------------------ Abschnitt erzeugt aus start_rl.dat ------------------ */
/begin COMPU_METHOD FORMULA_0974 "FORMULA_0974" TAB_VERB "%3.0" "-" COMPU_TAB_REF FORMULA_0974_VTAB /end COMPU_METHOD
/begin COMPU_VTAB FORMULA_0974_VTAB "FORMULA_0974_VTAB" TAB_VERB 3 0 "aus" 1 "an" 2 "Sperre SH_TO_UB" /end COMPU_VTAB
/* ------------------ Abschnitt erzeugt aus tan.dat ------------------ */
/begin COMPU_METHOD FORMULA_0987 "FORMULA_0987" RAT_FUNC "%8.3" "�C" COEFFS 0 40 10926 0 0 1 /end COMPU_METHOD
/* ------------------ Abschnitt erzeugt aus tsgrw.dat ------------------ */
/begin COMPU_METHOD FORMULA_1028 "FORMULA_1028" RAT_FUNC "%6.1" "�C" COEFFS 0 40 10928 0 0 1 /end COMPU_METHOD
/begin COMPU_METHOD FORMULA_1029 "FORMULA_1029" TAB_VERB "%3.0" "-" COMPU_TAB_REF FORMULA_1029_VTAB /end COMPU_METHOD
/begin COMPU_VTAB FORMULA_1029_VTAB "FORMULA_1029_VTAB" TAB_VERB 2 0 "Konstante" 1 "Modell" /end COMPU_VTAB
/begin COMPU_METHOD FORMULA_1030 "FORMULA_1030" RAT_FUNC "%8.3" "Kelvin" COEFFS 0 40 0 0 0 1 /end COMPU_METHOD
/* ------------------ Abschnitt erzeugt aus sys_zust.dat ------------------ */
/begin MEASUREMENT sys_ed_st "ED Status" UWORD FORMULA_0383 0 0 0.0 65535.0 ECU_ADDRESS 0x3FC33C /end MEASUREMENT
/begin MEASUREMENT sys_zust "Betriebszustand des Systems" UWORD FORMULA_0384 0 0 0.0 65535.0 ECU_ADDRESS 0x3FC33E /end MEASUREMENT
/begin MEASUREMENT sys_last_reset_st "Letzter Resetstatus" UBYTE FORMULA_0385 0 0 0.0 255.0 ECU_ADDRESS 0x3FC344 /end MEASUREMENT
/begin MEASUREMENT sys_rsr "Reset Status Register" UWORD FORMULA_0010 0 0 0.0 65535.0000 ECU_ADDRESS 0x3FE768 /end MEASUREMENT
/begin MEASUREMENT sys_rsr_ehrs "External Hreset" UWORD FORMULA_0386 0 0 0.0 65535.0 ECU_ADDRESS 0x3FE768 BIT_MASK 0x8000 /end MEASUREMENT
/begin MEASUREMENT sys_rsr_ersr "External Soft reset" UWORD FORMULA_0387 0 0 0.0 65535.0 ECU_ADDRESS 0x3FE768 BIT_MASK 0x4000 /end MEASUREMENT
/begin MEASUREMENT sys_rsr_llrs "Los of lock reset" UWORD FORMULA_0388 0 0 0.0 65535.0 ECU_ADDRESS 0x3FE768 BIT_MASK 0x2000 /end MEASUREMENT
/begin MEASUREMENT sys_rsr_swrs "Software watchdog reset" UWORD FORMULA_0389 0 0 0.0 65535.0 ECU_ADDRESS 0x3FE768 BIT_MASK 0x1000 /end MEASUREMENT
/begin MEASUREMENT sys_rsr_csrs "Checkstop reset" UWORD FORMULA_0390 0 0 0.0 65535.0 ECU_ADDRESS 0x3FE768 BIT_MASK 0x800 /end MEASUREMENT
/begin MEASUREMENT sys_rsr_dbhrs "Debug port hard reset" UWORD FORMULA_0391 0 0 0.0 65535.0 ECU_ADDRESS 0x3FE768 BIT_MASK 0x400 /end MEASUREMENT
/begin MEASUREMENT sys_rsr_dbsrs "Debug port soft reset" UWORD FORMULA_0392 0 0 0.0 65535.0 ECU_ADDRESS 0x3FE768 BIT_MASK 0x200 /end MEASUREMENT
/begin MEASUREMENT sys_rsr_jtrs "Jtag reset" UWORD FORMULA_0393 0 0 0.0 65535.0 ECU_ADDRESS 0x3FE768 BIT_MASK 0x100 /end MEASUREMENT
/begin MEASUREMENT sys_rsr_occs "On chip clock reset" UWORD FORMULA_0394 0 0 0.0 65535.0 ECU_ADDRESS 0x3FE768 BIT_MASK 0x80 /end MEASUREMENT
/begin MEASUREMENT sys_rsr_ilbc "Illegal bit change reset" UWORD FORMULA_0395 0 0 0.0 65535.0 ECU_ADDRESS 0x3FE768 BIT_MASK 0x40 /end MEASUREMENT
/begin MEASUREMENT sys_rsr_gpor "Glitch detected on  powern on reset" UWORD FORMULA_0396 0 0 0.0 65535.0 ECU_ADDRESS 0x3FE768 BIT_MASK 0x20 /end MEASUREMENT
/begin MEASUREMENT sys_rsr_ghrst "Glitch detected on  HRESET PIN" UWORD FORMULA_0397 0 0 0.0 65535.0 ECU_ADDRESS 0x3FE768 BIT_MASK 0x10 /end MEASUREMENT
/begin MEASUREMENT sys_rsr_gsrst "Glitch detected on  SRESET PIN" UWORD FORMULA_0398 0 0 0.0 65535.0 ECU_ADDRESS 0x3FE768 BIT_MASK 0x8 /end MEASUREMENT
/begin MEASUREMENT sys_rsr_cnt_sum "Reset-Summenzaehler" UWORD FORMULA_0010 0 0 0.0 65535.0000 ECU_ADDRESS 0x3FE76A /end MEASUREMENT
/begin MEASUREMENT sys_zust_cpu_last "CPU Last" UWORD FORMULA_0001 0 0 0.0 100.0000 ECU_ADDRESS 0x3FE76C /end MEASUREMENT
/begin MEASUREMENT sys_zust_bgnd_cnt "Aufruf Bgnd Task pro 100ms" UWORD FORMULA_0010 0 0 0.0 1000.0000 ECU_ADDRESS 0x3FE76E /end MEASUREMENT
/begin MEASUREMENT sys_zust_bgnd_net_min "Background Netto time min" UWORD FORMULA_0399 0 0 0.0 2.0000 ECU_ADDRESS 0x3FE770 /end MEASUREMENT
/begin MEASUREMENT sys_exc_vec "Exception-Vector" UWORD FORMULA_0015 0 0 0.0 65535.0 ECU_ADDRESS 0x3FE772 /end MEASUREMENT
/begin MEASUREMENT sys_exc_addr "Exception-Adresse" ULONG FORMULA_0000 0 0 0.0 4294967295.0000 ECU_ADDRESS 0x3FE774 /end MEASUREMENT
/begin MEASUREMENT sys_sg_fehler "SG internere Fehlernummer" UBYTE FORMULA_0400 0 0 0.0 255.0 ECU_ADDRESS 0x3FE778 /end MEASUREMENT
/begin MEASUREMENT sys_reset_st "Resetursache" UBYTE FORMULA_0385 0 0 0.0 255.0 ECU_ADDRESS 0x3FE779 /end MEASUREMENT
/begin MEASUREMENT sys_exc_km_ni "Kilometerstand bei Exception" ULONG FORMULA_0027 0 0 0.0 16777214.0000 ECU_ADDRESS 0x3FE77C /end MEASUREMENT
/begin MEASUREMENT sys_exc_n_ni "Drehzahl bei Exception" SWORD FORMULA_0006 0 0 0.0 10000.0000 ECU_ADDRESS 0x3FE780 /end MEASUREMENT
/begin MEASUREMENT sys_sync_init_t_1of5_ "Hochlauf Zeitmarken" UWORD FORMULA_0401 0 0 0.0 16711.4250 ECU_ADDRESS 0x3FE782 /end MEASUREMENT
/begin MEASUREMENT sys_sync_init_t_2of5_ "Hochlauf Zeitmarken" UWORD FORMULA_0401 0 0 0.0 16711.4250 ECU_ADDRESS 0x3FE784 /end MEASUREMENT
/begin MEASUREMENT sys_sync_init_t_3of5_ "Hochlauf Zeitmarken" UWORD FORMULA_0401 0 0 0.0 16711.4250 ECU_ADDRESS 0x3FE786 /end MEASUREMENT
/begin MEASUREMENT sys_sync_init_t_4of5_ "Hochlauf Zeitmarken" UWORD FORMULA_0401 0 0 0.0 16711.4250 ECU_ADDRESS 0x3FE788 /end MEASUREMENT
/begin MEASUREMENT sys_sync_init_t_5of5_ "Hochlauf Zeitmarken" UWORD FORMULA_0401 0 0 0.0 16711.4250 ECU_ADDRESS 0x3FE78A /end MEASUREMENT
/* ------------------ Abschnitt erzeugt aus schalter_ign.dat ------------------ */
/begin CHARACTERISTIC K_SCHALTER_KS_M_AUF "Schwelle fuer kein Kraftschluss | EN: Schwelle fuer kein Kraftschluss" VALUE 0x78758 TKW_VV_VV_SW 100.0 FORMULA_0009 -100.0000 1000.0000 FORMAT "%4.1" /end CHARACTERISTIC
/begin CHARACTERISTIC K_SCHALTER_KS_M_ZU "Schwelle fuer Kraftschluss | EN: Schwelle fuer Kraftschluss" VALUE 0x7875A TKW_VV_VV_SW 100.0 FORMULA_0009 -100.0000 1000.0000 FORMAT "%4.1" /end CHARACTERISTIC
/begin CHARACTERISTIC K_SCHALTER_BLS_ENTPRELLUNG_E2 "Fehlerentprellschwelle fuer BLS E2 | EN: Fehlerentprellschwelle fuer BLS E2" VALUE 0x7A9A6 TKW_VV_VV_UB 100.0 FORMULA_0003 0.0 255.0000 /end CHARACTERISTIC
/begin MEASUREMENT schalter_st_ign_old_1of2_ "schalter_st_ign_old" UWORD FORMULA_0083 0 0 0.0 65535.0000 ECU_ADDRESS 0x3FC1E2 /end MEASUREMENT
/begin MEASUREMENT schalter_st_ign_old_2of2_ "schalter_st_ign_old" UWORD FORMULA_0083 0 0 0.0 65535.0000 ECU_ADDRESS 0x3FC1E4 /end MEASUREMENT
/begin MEASUREMENT schalter_wakeup_ad_ign "Eingelesener Spannungswert Wakeup" SWORD FORMULA_0123 0 0 0.0 1023.0000 ECU_ADDRESS 0x3FC1E6 /end MEASUREMENT
/begin MEASUREMENT schalter_bls_ad_ign "Eingelesener Spannungswert Bremslichtschalter" SWORD FORMULA_0123 0 0 0.0 1023.0000 ECU_ADDRESS 0x3FC1E8 /end MEASUREMENT
/begin MEASUREMENT schalter_kl87_ad "Eingelesener Spannungswert Klemme 87" SWORD FORMULA_0123 0 0 0.0 1023.0000 ECU_ADDRESS 0x3FC1EA /end MEASUREMENT
/begin MEASUREMENT schalter_bls_entprell_cnt_e2 "Entprell-Zaehler fuer BLS E2" UBYTE FORMULA_0003 0 0 0.0 255.0000 ECU_ADDRESS 0x3FC804 /end MEASUREMENT
/* ------------------ Abschnitt erzeugt aus smg.dat ------------------ */
/begin CHARACTERISTIC K_SMG_TAU_MD_FAHRER "Filter Fahrerwunsch | EN: Filter Fahrerwunsch" VALUE 0x78928 TKW_VV_VV_UB 100.0 FORMULA_0462 0.0101 2.5600 /end CHARACTERISTIC
/begin CHARACTERISTIC K_SMG_TAU_DN_FILTER "Filter Drehzahlgradient | EN: Filter Drehzahlgradient" VALUE 0x78929 TKW_VV_VV_UB 100.0 FORMULA_0462 0.0101 2.5600 /end CHARACTERISTIC
/begin CHARACTERISTIC K_SMG_TAU_DN_GETR "Filter Getriebedrehzahlgradient | EN: Filter Getriebedrehzahlgradient" VALUE 0x7892A TKW_VV_VV_UB 100.0 FORMULA_0462 0.0101 2.5600 /end CHARACTERISTIC
/begin CHARACTERISTIC K_SMG_TAU_KSCHLUPF "Filter Kupplungsschlupf | EN: Filter Kupplungsschlupf" VALUE 0x7892B TKW_VV_VV_UB 100.0 FORMULA_0462 0.0101 2.5600 /end CHARACTERISTIC
/begin CHARACTERISTIC K_SMG_TAU_AX_BERECH "Filter berech. ax | EN: Filter berech. ax" VALUE 0x7892C TKW_VV_VV_UB 100.0 FORMULA_0462 0.0101 2.5600 /end CHARACTERISTIC
/begin CHARACTERISTIC K_SMG_TAU_AX_MESS "Filter gem. ax | EN: Filter gem. ax" VALUE 0x7892D TKW_VV_VV_UB 100.0 FORMULA_0462 0.0101 2.5600 /end CHARACTERISTIC
/begin CHARACTERISTIC K_SMG_TAU_AX_BERG "Filter Steigung | EN: Filter Steigung" VALUE 0x7892E TKW_VV_VV_UB 100.0 FORMULA_0462 0.0101 2.5600 /end CHARACTERISTIC
/begin CHARACTERISTIC K_SMG_TAU_RSCHLUPF "Filter Radschlupf | EN: Filter Radschlupf" VALUE 0x7892F TKW_VV_VV_UB 100.0 FORMULA_0462 0.0101 2.5600 /end CHARACTERISTIC
/begin CHARACTERISTIC K_SMG_TAU_DSC_ABS "Filter DSC-Anforderung | EN: Filter DSC-Anforderung" VALUE 0x78930 TKW_VV_VV_UB 100.0 FORMULA_0462 0.0101 2.5600 /end CHARACTERISTIC
/begin CHARACTERISTIC K_SMG_MOT_J_MOTOR_ZR "Faktor fuer Vorst 2 bei ZR | EN: Faktor fuer Vorst 2 bei ZR" VALUE 0x78931 TKW_VV_VV_UB 100.0 FORMULA_0939 0.0 1.9921 /end CHARACTERISTIC
/begin CHARACTERISTIC K_SMG_PROG_V_SCHW "v-Schwelle fuer Schub-Programm | EN: v-Schwelle fuer Schub-Programm" VALUE 0x78932 TKW_VV_VV_SW 100.0 FORMULA_0078 -80.0000 360.0000 FORMAT "%4.1" /end CHARACTERISTIC
/begin CHARACTERISTIC K_SMG_PROG_MIN_ZR "min. Programm fuer ZR | EN: Minimum program for traction downshift" VALUE 0x78934 TKW_VV_VV_UB 100.0 FORMULA_0279 1.0000 8.0000 /end CHARACTERISTIC
/begin CHARACTERISTIC K_SMG_PROG_MIN_ANH "min. Programm mit Anhaenger | EN: Minimum program with trailer" VALUE 0x78935 TKW_VV_VV_UB 100.0 FORMULA_0279 1.0000 8.0000 /end CHARACTERISTIC
/begin CHARACTERISTIC K_SMG_PROG_MAX_ANH "max. Programm mit Anhaenger | EN: Maximum program with trailer" VALUE 0x78936 TKW_VV_VV_UB 100.0 FORMULA_0279 1.0000 8.0000 /end CHARACTERISTIC
/begin CHARACTERISTIC K_SMG_PROG_MAX_FETRAWE "max. Programm bei FeTraWe | EN: Maximum program in factory/transport/workshop mode" VALUE 0x78937 TKW_VV_VV_UB 100.0 FORMULA_0279 1.0000 8.0000 /end CHARACTERISTIC
/begin CHARACTERISTIC K_SMG_PROG_MAX_EINFAHR "max. Programm beim Einfahren | EN: Maximum program during running-in" VALUE 0x78938 TKW_VV_VV_UB 100.0 FORMULA_0279 1.0000 8.0000 /end CHARACTERISTIC
/begin CHARACTERISTIC K_SMG_PROG_FETRAWE_WEG "zul. Kilometerstand fuer SMG-Begrenzung im FeTra-Mode | EN: Permitted mileage for SMG limitation in factory/transport mode" VALUE 0x7893A TKW_VV_VV_UW 100.0 FORMULA_0942 0.0 65535.0000 /end CHARACTERISTIC
/begin CHARACTERISTIC K_SMG_PROG_EINFAHR_WEG "Kilometerstand Einfahr-Begrenzung | EN: Mileage for running-in limitation" VALUE 0x7893C TKW_VV_VV_UW 100.0 FORMULA_0942 0.0 65535.0000 /end CHARACTERISTIC
/begin CHARACTERISTIC K_SMG_N_ABRISS_HYS "Hysterese f�r Abrisserkennung | EN: Hysteresis for tear-off detection" VALUE 0x7893E TKW_VV_VV_SW 100.0 FORMULA_0006 0.0 10000.0000 /end CHARACTERISTIC
/begin CHARACTERISTIC K_SMG_N_ABRISS_ANF "Abrisserkennungschwelle beim Anfahren | EN: Tear-off detection threshold at pull-away" VALUE 0x78940 TKW_VV_VV_SW 100.0 FORMULA_0006 0.0 10000.0000 /end CHARACTERISTIC
/begin CHARACTERISTIC K_SMG_N_NULL "Drehzahl-Nullschwelle | EN: Zero-speed threshold" VALUE 0x78942 TKW_VV_VV_SW 100.0 FORMULA_0006 0.0 10000.0000 /end CHARACTERISTIC
/begin CHARACTERISTIC K_SMG_M_NULL "Moment-Nullschwelle | EN: Zero-torque threshold" VALUE 0x78944 TKW_VV_VV_SW 100.0 FORMULA_0009 -100.0000 1000.0000 FORMAT "%4.1" /end CHARACTERISTIC
/begin CHARACTERISTIC K_SMG_KSCHLUPF_N "n-Schwelle Kupplungsschlupf | EN: Speed threshold, clutch slip" VALUE 0x78946 TKW_VV_VV_SW 100.0 FORMULA_0006 0.0 10000.0000 /end CHARACTERISTIC
/begin CHARACTERISTIC K_SMG_KSCHLUPF_AUF "Kupplungsschlupfschwelle beim Aufregeln | EN: Clutch slip threshold during ramp-up" VALUE 0x78948 TKW_VV_VV_UB 100.0 FORMULA_0943 0.0 10.0000 /end CHARACTERISTIC
/begin CHARACTERISTIC K_SMG_KSCHLUPF_DSC "Kupplungsschlupf bei DSC-Eingr | EN: Clutch slip during DSC intervention" VALUE 0x78949 TKW_VV_VV_UB 100.0 FORMULA_0943 0.0 10.0000 /end CHARACTERISTIC
/begin CHARACTERISTIC K_SMG_KSCHLUPF_T_SCHW "Zeitschwelle fuer Kupplungsschlupf | EN: Time threshold for clutch slip" VALUE 0x7894A TKW_VV_VV_UB 100.0 FORMULA_0317 0.0 2.5500 /end CHARACTERISTIC
/begin CHARACTERISTIC K_SMG_KI_CFG "KI-Konfiguration | EN: Shift-index configuration" VALUE 0x7894B TKW_VV_VV_UB 100.0 FORMULA_0944 0.0 255.0 /end CHARACTERISTIC
/begin CHARACTERISTIC K_SMG_KI_SCHALT_DSC "max. Schalt-Index bei DSC aktiv | EN: Maximum shift index with DSC active" VALUE 0x7894C TKW_VV_VV_UB 100.0 FORMULA_0003 0.0 14.0000 /end CHARACTERISTIC
/begin CHARACTERISTIC K_SMG_KI_AUF_DSC "max. Aufregel-Index bei DSC passiv | EN: Maximum ramp-up index with DSC off" VALUE 0x7894D TKW_VV_VV_UB 100.0 FORMULA_0003 0.0 12.0000 /end CHARACTERISTIC
/begin CHARACTERISTIC K_SMG_KI_AUF_DSC2 "max. Aufregel-Index bei DSC-Sport | EN: Maximum ramp-up index in DSC Sport" VALUE 0x7894E TKW_VV_VV_UB 100.0 FORMULA_0003 0.0 12.0000 /end CHARACTERISTIC
/begin CHARACTERISTIC K_SMG_KI_AUF_EINGR "max. Aufregel-Index bei DSC-Eingriff | EN: Maximum ramp-up index during DSC intervention" VALUE 0x7894F TKW_VV_VV_UB 100.0 FORMULA_0003 0.0 12.0000 /end CHARACTERISTIC
/begin CHARACTERISTIC K_SMG_KI_AUF_ZR "max. Aufregel-Index bei Zugrueck | EN: Maximum ramp-up index on traction downshift" VALUE 0x78950 TKW_VV_VV_UB 100.0 FORMULA_0003 0.0 12.0000 /end CHARACTERISTIC
/begin CHARACTERISTIC K_SMG_KI_AUF_T_EINGR "max. Zeit mit DSC-Eingriff | EN: Maximum time with DSC intervention" VALUE 0x78952 TKW_VV_VV_UW 100.0 FORMULA_0021 0.0 655.0000 FORMAT "%5.2" /end CHARACTERISTIC
/begin CHARACTERISTIC K_SMG_KI_AKS_AY_MAX "AKS-Sperre bei hohen ay | EN: Auto-upshift lock at high lateral acceleration" VALUE 0x78954 TKW_VV_VV_SW 100.0 FORMULA_0132 -20.0000 20.0000 FORMAT "%5.2" /end CHARACTERISTIC
/begin CHARACTERISTIC K_SMG_KI_AKS_DAY_MAX "AKS-Sperre bei ay-Zunahme | EN: Auto-upshift lock on lateral-acceleration increase" VALUE 0x78956 TKW_VV_VV_SW 100.0 FORMULA_0132 -20.0000 20.0000 FORMAT "%5.2" /end CHARACTERISTIC
/begin CHARACTERISTIC K_SMG_KI_NEU_AY_MAX "kein Aktualisieren der KI bei hohen ay | EN: No shift-index update at high lateral acceleration" VALUE 0x78958 TKW_VV_VV_SW 100.0 FORMULA_0132 -20.0000 20.0000 FORMAT "%5.2" /end CHARACTERISTIC
/begin CHARACTERISTIC K_SMG_KI_DELTA_PWG "Neubestimmung der KIs | EN: Re-determination of shift indices" VALUE 0x7895A TKW_VV_VV_SW 100.0 FORMULA_0001 -10.0000 120.0000 FORMAT "%4.1" /end CHARACTERISTIC
/begin CHARACTERISTIC K_SMG_T_ABREGEL_AKS "Sprung auf Nullmoment | EN: Step to zero torque" VALUE 0x7895C TKW_VV_VV_UB 100.0 FORMULA_0317 0.0 2.5500 /end CHARACTERISTIC
/begin CHARACTERISTIC K_SMG_T_KORR_AB_MIN "t-Verkuerzung | EN: Time shortening" VALUE 0x7895D TKW_VV_VV_UB 100.0 FORMULA_0317 0.0 2.5500 /end CHARACTERISTIC
/begin CHARACTERISTIC K_SMG_T_KORR_AB_FW "Kuerzen wegen Fahreraktion | EN: Shorten due to driver action" VALUE 0x7895E TKW_VV_VV_UW 100.0 FORMULA_0009 0.0 6553.5000 FORMAT "%4.1" /end CHARACTERISTIC
/begin CHARACTERISTIC K_SMG_NO_LW_N_SCHW "Ende bei LW | EN: End at load change" VALUE 0x78960 TKW_VV_VV_UB 100.0 FORMULA_0746 0.0 255.0000 /end CHARACTERISTIC
/begin CHARACTERISTIC K_SMG_TESTMODE "Testfunktionen | EN: Test functions" VALUE 0x78961 TKW_VV_VV_UB 100.0 FORMULA_0945 0.0 255.0 /end CHARACTERISTIC
/begin CHARACTERISTIC K_SMG_MD_FW_MIN_AB "min. Abregelmoment | EN: Minimum ramp-down torque" VALUE 0x78962 TKW_VV_VV_SW 100.0 FORMULA_0009 -100.0000 1000.0000 FORMAT "%4.1" /end CHARACTERISTIC
/begin CHARACTERISTIC K_SMG_MD_FW_MIN_AUF "min. Aufregelmoment | EN: Minimum ramp-up torque" VALUE 0x78964 TKW_VV_VV_SW 100.0 FORMULA_0009 -100.0000 1000.0000 FORMAT "%4.1" /end CHARACTERISTIC
/begin CHARACTERISTIC K_SMG_MD_FW_HYS_ZUG "Hysterese Zugerkennung | EN: Hysteresis, traction detection" VALUE 0x78966 TKW_VV_VV_SW 100.0 FORMULA_0009 -100.0000 1000.0000 FORMAT "%4.1" /end CHARACTERISTIC
/begin CHARACTERISTIC K_SMG_MD_FW_HYS_SCH "Hysterese Schuberkennung | EN: Hysteresis, overrun detection" VALUE 0x78968 TKW_VV_VV_SW 100.0 FORMULA_0009 -100.0000 1000.0000 FORMAT "%4.1" /end CHARACTERISTIC
/begin CHARACTERISTIC K_SMG_PWG_FW_SCH "Pwg-Schuberkennung | EN: Pedal-based overrun detection" VALUE 0x7896A TKW_VV_VV_SW 100.0 FORMULA_0001 -10.0000 120.0000 FORMAT "%4.1" /end CHARACTERISTIC
/begin CHARACTERISTIC K_SMG_PWG_FW_SCH_N_OFF "LL-Offset fuer Pwg-Schuberkennung | EN: Idle offset for pedal-based overrun detection" VALUE 0x7896C TKW_VV_VV_SW 100.0 FORMULA_0006 0.0 10000.0000 /end CHARACTERISTIC
/begin CHARACTERISTIC K_SMG_KUPP_DM_MIN "min. Kupplungsgradient | EN: Minimum clutch gradient" VALUE 0x7896E TKW_VV_VV_SW 100.0 FORMULA_0571 -5000.0000 5000.0000 /end CHARACTERISTIC
/begin CHARACTERISTIC K_SMG_KUPP_DM_RAB "Kupplungsgradient bei RAB | EN: Clutch gradient during roll-back" VALUE 0x78970 TKW_VV_VV_UB 100.0 FORMULA_0827 0.0 5100.0000 /end CHARACTERISTIC
/begin CHARACTERISTIC K_SMG_KUPP_DM_ABS "Kupplungsgradient bei ABS-Eingr | EN: Clutch gradient during ABS intervention" VALUE 0x78971 TKW_VV_VV_UB 100.0 FORMULA_0827 0.0 5100.0000 /end CHARACTERISTIC
/begin CHARACTERISTIC K_SMG_KUPP_DM_SOLL_F "Faktor auf Kupplungsgradient | EN: Factor on clutch gradient" VALUE 0x78972 TKW_VV_VV_UB 100.0 FORMULA_0704 0.0 1.9921 /end CHARACTERISTIC
/begin CHARACTERISTIC K_SMG_KUPP_M_MAX_1 "Max. Schubmoment im 1.Gang | EN: Maximum overrun torque in 1st gear" VALUE 0x78974 TKW_VV_VV_SW 100.0 FORMULA_0009 -100.0000 1000.0000 FORMAT "%4.1" /end CHARACTERISTIC
/begin CHARACTERISTIC K_SMG_KUPP_M_MAX_2 "Max. Schubmoment im 2.Gang | EN: Maximum overrun torque in 2nd gear" VALUE 0x78976 TKW_VV_VV_SW 100.0 FORMULA_0009 -100.0000 1000.0000 FORMAT "%4.1" /end CHARACTERISTIC
/begin CHARACTERISTIC K_SMG_KUPP_REG_T "Einschaltschwelle Regler | EN: Controller switch-on threshold" VALUE 0x78978 TKW_VV_VV_UW 100.0 FORMULA_0021 0.0 655.0000 FORMAT "%5.2" /end CHARACTERISTIC
/begin CHARACTERISTIC K_SMG_KUPP_RAMPE_N_ABW "Ausloeseschwelle Rampe - Abwuergen | EN: Trigger threshold, ramp - stalling" VALUE 0x7897A TKW_VV_VV_SW 100.0 FORMULA_0006 0.0 10000.0000 /end CHARACTERISTIC
/begin CHARACTERISTIC K_SMG_KUPP_RAMPE_N "Ausloeseschwelle Rampe | EN: Trigger threshold, ramp" VALUE 0x7897C TKW_VV_VV_SW 100.0 FORMULA_0006 0.0 10000.0000 /end CHARACTERISTIC
/begin CHARACTERISTIC K_SMG_KUPP_RAMPE_DM "Steigung Kupplungsrampe | EN: Slope of clutch ramp" VALUE 0x7897E TKW_VV_VV_UB 100.0 FORMULA_0946 0.0 0.2550 /end CHARACTERISTIC
/begin CHARACTERISTIC K_SMG_KUPP_N_KSCHUTZ "Ausloeseschwelle fuer Kupplungsschutz | EN: Trigger threshold for clutch protection" VALUE 0x78980 TKW_VV_VV_SW 100.0 FORMULA_0006 0.0 10000.0000 /end CHARACTERISTIC
/begin CHARACTERISTIC K_SMG_KUPP_UL_FW_SCHW "min. Fahrerwunsch fuer Kupplungsschutz | EN: Minimum driver demand for clutch protection" VALUE 0x78982 TKW_VV_VV_SW 100.0 FORMULA_0009 -100.0000 1000.0000 FORMAT "%4.1" /end CHARACTERISTIC
/begin CHARACTERISTIC K_SMG_KUPP_UL_MD_SCHW "Offset auf Istmoment | EN: Offset on actual torque" VALUE 0x78984 TKW_VV_VV_SW 100.0 FORMULA_0009 -100.0000 1000.0000 FORMAT "%4.1" /end CHARACTERISTIC
/begin CHARACTERISTIC K_SMG_KUPP_UL_N_SCHW "Differenz Motor/Getriebe | EN: Difference engine/gearbox" VALUE 0x78986 TKW_VV_VV_SW 100.0 FORMULA_0006 0.0 10000.0000 /end CHARACTERISTIC
/begin CHARACTERISTIC K_SMG_KUPP_UL_FW_MAX "max. FW-Reduktion bei UL | EN: Maximum driver-demand reduction during overload" VALUE 0x78988 TKW_VV_VV_SW 100.0 FORMULA_0009 -100.0000 1000.0000 FORMAT "%4.1" /end CHARACTERISTIC
/begin CHARACTERISTIC K_SMG_KUPP_RAMPE_UL "Kupplungsrampe bei UL | EN: Clutch ramp during overload" VALUE 0x7898A TKW_VV_VV_UW 100.0 FORMULA_0947 0.0 6553.5000 /end CHARACTERISTIC
/begin CHARACTERISTIC K_SMG_KUPP_UL_FW_DM "Fahrerwunschrampe bei UL | EN: Driver-demand ramp during overload" VALUE 0x7898C TKW_VV_VV_UB 100.0 FORMULA_0799 0.0 2550.0000 /end CHARACTERISTIC
/begin CHARACTERISTIC K_SMG_KUPP_AUF_SCHW_N "n-Schwelle fuer Aufregelschwingen | EN: Speed threshold for ramp-up oscillation" VALUE 0x7898E TKW_VV_VV_SW 100.0 FORMULA_0006 0.0 10000.0000 /end CHARACTERISTIC
/begin CHARACTERISTIC K_SMG_TZ_EINGR_T_AB "Schwelle Abregeln mit TZ-Eingr | EN: Threshold for ramp-down with ignition intervention" VALUE 0x78990 TKW_VV_VV_UB 100.0 FORMULA_0317 0.0 2.5500 /end CHARACTERISTIC
/begin CHARACTERISTIC K_SMG_N_ZIEL_OFF_ZH "Offset zur EKR-Zieldrehzahl bei ZugHoch | EN: Offset to drag-control target speed on traction upshift" VALUE 0x78992 TKW_VV_VV_SW 100.0 FORMULA_0006 0.0 10000.0000 /end CHARACTERISTIC
/begin CHARACTERISTIC K_SMG_N_ZIEL_OFF_SCH "Offset zur EKR-Zieldrehzahl bei Schub | EN: Offset to drag-control target speed in overrun" VALUE 0x78994 TKW_VV_VV_SW 100.0 FORMULA_0006 0.0 10000.0000 /end CHARACTERISTIC
/begin CHARACTERISTIC K_SMG_N_ZIEL_HYS "max. Drehzahldifferenz | EN: Maximum speed difference" VALUE 0x78996 TKW_VV_VV_SW 100.0 FORMULA_0006 0.0 10000.0000 /end CHARACTERISTIC
/begin CHARACTERISTIC K_SMG_N_ZIEL_OFF_BEGR "Offset auf n-Begrenzer | EN: Offset on rev limiter" VALUE 0x78998 TKW_VV_VV_UB 100.0 FORMULA_0746 0.0 255.0000 /end CHARACTERISTIC
/begin CHARACTERISTIC K_SMG_N_EKR_OFF_BEGR "EKR-Offset auf n-Begrenzer | EN: Engine-drag-control offset on rev limiter" VALUE 0x78999 TKW_VV_VV_UB 100.0 FORMULA_0746 0.0 255.0000 /end CHARACTERISTIC
/begin CHARACTERISTIC K_SMG_N_ZIEL_ABWUERG "Abwuergsolldrehzahl | EN: Anti-stall target speed" VALUE 0x7899A TKW_VV_VV_SW 100.0 FORMULA_0006 0.0 10000.0000 /end CHARACTERISTIC
/begin CHARACTERISTIC K_SMG_N_ZIEL_ANF_V_MAX "v-Schwelle fuer Anfahrdrehzahl | EN: Speed threshold for pull-away engine speed" VALUE 0x7899C TKW_VV_VV_SW 100.0 FORMULA_0078 -80.0000 360.0000 FORMAT "%4.1" /end CHARACTERISTIC
/begin CHARACTERISTIC K_SMG_MOT_M_VOR_AUF "Vorausschau | EN: Look-ahead" VALUE 0x7899E TKW_VV_VV_UB 100.0 FORMULA_0317 0.0 2.5500 /end CHARACTERISTIC
/begin CHARACTERISTIC K_SMG_MOT_NL_MD_MAX "max. Abw. FW TZ-Nachlauf | EN: Maximum driver-demand deviation, ignition follow-up" VALUE 0x789A0 TKW_VV_VV_SW 100.0 FORMULA_0009 -100.0000 1000.0000 FORMAT "%4.1" /end CHARACTERISTIC
/begin CHARACTERISTIC K_SMG_MOT_NL_T_MAX "max. TZ-Nachlaufzeit | EN: Maximum ignition follow-up time" VALUE 0x789A2 TKW_VV_VV_UW 100.0 FORMULA_0117 0.0 325.0000 FORMAT "%5.2" /end CHARACTERISTIC
/begin CHARACTERISTIC K_SMG_MOT_NL_DELTA_FW "FW-Abbruchschwelle fuer Rampe | EN: Driver-demand abort threshold for ramp" VALUE 0x789A4 TKW_VV_VV_UB 100.0 FORMULA_0479 0.0 25.0000 /end CHARACTERISTIC
/begin CHARACTERISTIC K_SMG_MOT_NL_MD "Md-Abbruchschwelle fuer Rampe | EN: Torque abort threshold for ramp" VALUE 0x789A5 TKW_VV_VV_UB 100.0 FORMULA_0749 0.0 25.0000 /end CHARACTERISTIC
/begin CHARACTERISTIC K_SMG_MOT_NL_ETA "Eta-Abbruchschwelle fuer Rampe | EN: Efficiency abort threshold for ramp" VALUE 0x789A6 TKW_VV_VV_UW 100.0 FORMULA_0435 0.0 150.0000 FORMAT "%4.1" /end CHARACTERISTIC
/begin CHARACTERISTIC K_SMG_MOT_NL_TAU "Filter nach Rampenende | EN: Filter after end of ramp" VALUE 0x789A8 TKW_VV_VV_UB 100.0 FORMULA_0478 0.0051 1.2800 /end CHARACTERISTIC
/begin CHARACTERISTIC K_SMG_MOT_M_RES_EXT_MAX "Reserve inaktiv wg. ext. Reserve | EN: Reserve inactive due to external reserve" VALUE 0x789AA TKW_VV_VV_SW 100.0 FORMULA_0009 -100.0000 1000.0000 FORMAT "%4.1" /end CHARACTERISTIC
/begin CHARACTERISTIC K_SMG_MOT_M_RES_MAX "max. Momentenreserve | EN: Maximum torque reserve" VALUE 0x789AC TKW_VV_VV_SW 100.0 FORMULA_0009 0.0 1000.0000 FORMAT "%4.1" /end CHARACTERISTIC
/begin CHARACTERISTIC K_SMG_MOT_M_RES_SCHA "Momentenreserve Schalten | EN: Torque reserve, shifting" VALUE 0x789AE TKW_VV_VV_SW 100.0 FORMULA_0009 -1.0000 1000.0000 FORMAT "%4.1" /end CHARACTERISTIC
/begin CHARACTERISTIC K_SMG_MOT_M_RES_AUF "Momentenreserve Aufregeln | EN: Torque reserve during ramp-up" VALUE 0x789B0 TKW_VV_VV_SW 100.0 FORMULA_0009 -1.0000 1000.0000 FORMAT "%4.1" /end CHARACTERISTIC
/begin CHARACTERISTIC K_SMG_MOT_M_RES_RS "Momentenreserve RS | EN: Torque reserve, race start" VALUE 0x789B2 TKW_VV_VV_SW 100.0 FORMULA_0009 -1.0000 1000.0000 FORMAT "%4.1" /end CHARACTERISTIC
/begin CHARACTERISTIC K_SMG_MOT_M_RES_ABW "Momentenreserve Abwuergen | EN: Torque reserve against stalling" VALUE 0x789B4 TKW_VV_VV_SW 100.0 FORMULA_0009 -1.0000 1000.0000 FORMAT "%4.1" /end CHARACTERISTIC
/begin CHARACTERISTIC K_SMG_MOT_M_RES_RAMPE "Reserve-Rampe | EN: Reserve ramp" VALUE 0x789B6 TKW_VV_VV_SW 100.0 FORMULA_0571 -5000.0000 5000.0000 /end CHARACTERISTIC
/begin CHARACTERISTIC K_SMG_MOT_M_RES_RAMPE_KS "Reserve-Rampe bei Kupplungsschlupf | EN: Reserve ramp during clutch slip" VALUE 0x789B8 TKW_VV_VV_SW 100.0 FORMULA_0571 -5000.0000 5000.0000 /end CHARACTERISTIC
/begin CHARACTERISTIC K_SMG_MOT_M_RES_T_MAX "max. Zeit fuer Momentenreserve | EN: Maximum time for torque reserve" VALUE 0x789BA TKW_VV_VV_UW 100.0 FORMULA_0117 0.0 325.0000 FORMAT "%5.2" /end CHARACTERISTIC
/begin CHARACTERISTIC K_SMG_MOT_DN_SOLL_MIN "min. Drehzahlsollgradient | EN: Minimum target speed gradient" VALUE 0x789BC TKW_VV_VV_SW 100.0 FORMULA_0114 -10000.0000 10000.0000 /end CHARACTERISTIC
/begin CHARACTERISTIC K_SMG_MOT_DN_SOLL_VOR "Schwelle fuer DN-Umschaltung | EN: Threshold for speed-gradient switchover" VALUE 0x789BE TKW_VV_VV_SW 100.0 FORMULA_0006 0.0 10000.0000 /end CHARACTERISTIC
/begin CHARACTERISTIC K_SMG_MOT_DN_GANG_1of3_ "DN-Wichtung ueber Gang | EN: DN-Wichtung ueber Gang" VALUE 0x789C0 TKW_VV_VV_UB 100.0 FORMULA_0704 0.0 1.9921 /end CHARACTERISTIC
/begin CHARACTERISTIC K_SMG_MOT_DN_GANG_2of3_ "DN-Wichtung ueber Gang | EN: DN-Wichtung ueber Gang" VALUE 0x789C1 TKW_VV_VV_UB 100.0 FORMULA_0704 0.0 1.9921 /end CHARACTERISTIC
/begin CHARACTERISTIC K_SMG_MOT_DN_GANG_3of3_ "DN-Wichtung ueber Gang | EN: DN-Wichtung ueber Gang" VALUE 0x789C2 TKW_VV_VV_UB 100.0 FORMULA_0704 0.0 1.9921 /end CHARACTERISTIC
/begin CHARACTERISTIC K_SMG_MOT_DN_REG_I_P "I-Anteil Gradientenregler pos. | EN: Integral share, gradient controller, positive" VALUE 0x789C3 TKW_VV_VV_UB 100.0 FORMULA_0948 0.0 0.0255 /end CHARACTERISTIC
/begin CHARACTERISTIC K_SMG_MOT_DN_REG_I_N "I-Anteil Gradientenregler neg. | EN: Integral share, gradient controller, negative" VALUE 0x789C4 TKW_VV_VV_UB 100.0 FORMULA_0948 0.0 0.0255 /end CHARACTERISTIC
/begin CHARACTERISTIC K_SMG_MOT_DN_REG_I_S "I-Anteil Gradientenregler pos. Schub | EN: Integral share, gradient controller, positive, overrun" VALUE 0x789C5 TKW_VV_VV_UB 100.0 FORMULA_0948 0.0 0.0255 /end CHARACTERISTIC
/begin CHARACTERISTIC K_SMG_MOT_DN_REG_T "Einschaltschwelle dn-Regler | EN: Switch-on threshold, speed-gradient controller" VALUE 0x789C6 TKW_VV_VV_UW 100.0 FORMULA_0021 0.0100 655.0000 FORMAT "%5.2" /end CHARACTERISTIC
/begin CHARACTERISTIC K_SMG_MOT_RAB_M_MIN "min. Moment bei Radabriss | EN: Minimum torque on wheel tear-off" VALUE 0x789C8 TKW_VV_VV_SW 100.0 FORMULA_0009 -100.0000 1000.0000 FORMAT "%4.1" /end CHARACTERISTIC
/begin CHARACTERISTIC K_SMG_MOT_RAB_M_MAX "max. Moment bei Radabriss | EN: Maximum torque on wheel tear-off" VALUE 0x789CA TKW_VV_VV_SW 100.0 FORMULA_0009 -100.0000 1000.0000 FORMAT "%4.1" /end CHARACTERISTIC
/begin CHARACTERISTIC K_SMG_MOT_RAB_DM_MAX "Abbau max. Moment bei Radabriss | EN: Decay of maximum torque on wheel tear-off" VALUE 0x789CC TKW_VV_VV_SW 100.0 FORMULA_0571 -5000.0000 5000.0000 /end CHARACTERISTIC
/begin CHARACTERISTIC K_SMG_MOT_RAB_T_MAX "Maximalzeit fuer Radabriss | EN: Maximum time for wheel tear-off" VALUE 0x789CE TKW_VV_VV_UW 100.0 FORMULA_0021 0.0 655.0000 FORMAT "%5.2" /end CHARACTERISTIC
/begin CHARACTERISTIC K_SMG_MOT_ABS_N_OFF "Offset auf nGetr bei ABS-Eingriff | EN: Offset on gearbox speed during ABS intervention" VALUE 0x789D0 TKW_VV_VV_SW 100.0 FORMULA_0006 -1000.0000 10000.0000 /end CHARACTERISTIC
/begin CHARACTERISTIC K_SMG_MOT_ABS_M_MIN "min. Moment bei ABS-Eingriff | EN: Minimum torque during ABS intervention" VALUE 0x789D2 TKW_VV_VV_SW 100.0 FORMULA_0009 -100.0000 1000.0000 FORMAT "%4.1" /end CHARACTERISTIC
/begin CHARACTERISTIC K_SMG_MOT_ABS_M_MAX "max. Moment bei ABS-Eingriff | EN: Maximum torque during ABS intervention" VALUE 0x789D4 TKW_VV_VV_SW 100.0 FORMULA_0009 -100.0000 1000.0000 FORMAT "%4.1" /end CHARACTERISTIC
/begin CHARACTERISTIC K_SMG_MOT_ABS_DM_MAX "Abbau max. Moment bei ABS-Eingriff | EN: Decay of maximum torque during ABS intervention" VALUE 0x789D6 TKW_VV_VV_SW 100.0 FORMULA_0571 -5000.0000 5000.0000 /end CHARACTERISTIC
/begin CHARACTERISTIC K_SMG_MOT_ABS_T_MAX "Maximalzeit fuer ABS-Eingriff | EN: Maximum time for ABS intervention" VALUE 0x789D8 TKW_VV_VV_UW 100.0 FORMULA_0021 0.0 655.0000 FORMAT "%5.2" /end CHARACTERISTIC
/begin CHARACTERISTIC K_SMG_MOT_N_REG_I_UP "I-Anteil n-Regler Up | EN: Integral share, speed controller up" VALUE 0x789DA TKW_VV_VV_UB 100.0 FORMULA_0946 0.0 0.2550 /end CHARACTERISTIC
/begin CHARACTERISTIC K_SMG_MOT_N_REG_I_DN "I-Anteil n-Regler Down | EN: Integral share, speed controller down" VALUE 0x789DB TKW_VV_VV_UB 100.0 FORMULA_0946 0.0 0.2550 /end CHARACTERISTIC
/begin CHARACTERISTIC K_SMG_MOT_N_REG_I_SCHW "max. Regeldifferenz-Schwelle fuer I-Anteil (n-Regler) | EN: Maximum control-error threshold for integral share (speed controller)" VALUE 0x789DC TKW_VV_VV_SW 100.0 FORMULA_0006 0.0 10000.0000 /end CHARACTERISTIC
/begin CHARACTERISTIC K_SMG_MOT_N_REG_I_T "Einschaltschwelle I-Anteil | EN: Switch-on threshold, integral share" VALUE 0x789DE TKW_VV_VV_UW 100.0 FORMULA_0117 0.0 325.0000 FORMAT "%5.2" /end CHARACTERISTIC
/begin CHARACTERISTIC K_SMG_MOT_N_REG_I_T_RAB "Einschaltschwelle I-Anteil bei RAB | EN: Switch-on threshold, integral share during roll-back" VALUE 0x789E0 TKW_VV_VV_UW 100.0 FORMULA_0117 0.0 325.0000 FORMAT "%5.2" /end CHARACTERISTIC
/begin CHARACTERISTIC K_SMG_MOT_N_REG_M_STG "max. Moment fuer Stoerrgroessenaufschaltung | EN: Maximum torque for disturbance feed-forward" VALUE 0x789E2 TKW_VV_VV_SW 100.0 FORMULA_0009 -100.0000 1000.0000 FORMAT "%4.1" /end CHARACTERISTIC
/begin CHARACTERISTIC K_SMG_MOT_N_REG_D_MIN "min. Regeldifferenz fuer D-Anteil | EN: Minimum control error for derivative share" VALUE 0x789E4 TKW_VV_VV_SW 100.0 FORMULA_0006 0.0 10000.0000 /end CHARACTERISTIC
/begin CHARACTERISTIC K_SMG_MOT_N_REG_D_MAX "max. Regeldifferenz fuer D-Anteil | EN: Maximum control error for derivative share" VALUE 0x789E6 TKW_VV_VV_SW 100.0 FORMULA_0006 0.0 10000.0000 /end CHARACTERISTIC
/begin CHARACTERISTIC K_SMG_MOT_N_REG_M_MAX "max. Reglermoment im Aufregeln | EN: Maximum controller torque during ramp-up" VALUE 0x789E8 TKW_VV_VV_SW 100.0 FORMULA_0009 -100.0000 1000.0000 FORMAT "%4.1" /end CHARACTERISTIC
/begin CHARACTERISTIC K_SMG_MOT_N_REG_T_MAX "Abregelzeit max. Reglermoment | EN: Ramp-down time of maximum controller torque" VALUE 0x789EA TKW_VV_VV_UW 100.0 FORMULA_0117 0.0050 325.0000 FORMAT "%5.2" /end CHARACTERISTIC
/begin CHARACTERISTIC K_SMG_MOT_N_REG_M_BEGR "v-Schwelle fuer Begrenzung | EN: Speed threshold for limitation" VALUE 0x789EC TKW_VV_VV_SW 100.0 FORMULA_0078 -80.0000 360.0000 FORMAT "%4.1" /end CHARACTERISTIC
/begin CHARACTERISTIC K_SMG_MOT_ANF_N_OFF "Drehzahloffset auf Anfahrdrehzahl | EN: Speed offset on pull-away speed" VALUE 0x789EE TKW_VV_VV_SW 100.0 FORMULA_0006 0.0 10000.0000 /end CHARACTERISTIC
/begin CHARACTERISTIC K_SMG_MOT_ANF_FW_X "Abregelfaktor Anfahrdrehzahl | EN: Ramp-down factor, pull-away speed" VALUE 0x789F0 TKW_VV_VV_SW 100.0 FORMULA_0006 0.0 10000.0000 /end CHARACTERISTIC
/begin CHARACTERISTIC K_SMG_MOT_ANF_M_MIN "Erkennung Anfahren aus Schalten | EN: Detection of pull-away from a shift" VALUE 0x789F2 TKW_VV_VV_SW 100.0 FORMULA_0009 -100.0000 1000.0000 FORMAT "%4.1" /end CHARACTERISTIC
/begin CHARACTERISTIC K_SMG_MOT_ANF_DM_DSC "Rampe bei DSC-Anfahrt | EN: Ramp for DSC pull-away" VALUE 0x789F4 TKW_VV_VV_SW 100.0 FORMULA_0571 -5000.0000 5000.0000 /end CHARACTERISTIC
/begin CHARACTERISTIC K_SMG_MOT_RS_N_SCHW "n-Abbruchschwelle Rennstart | EN: Speed abort threshold, race start" VALUE 0x789F6 TKW_VV_VV_SW 100.0 FORMULA_0006 0.0 10000.0000 /end CHARACTERISTIC
/begin CHARACTERISTIC K_SMG_MOT_RS_S_SCHW "Schlupf-Abbruchsschwelle Rennstart | EN: Slip abort threshold, race start" VALUE 0x789F8 TKW_VV_VV_SW 100.0 FORMULA_0949 -100.0000 100.0000 /end CHARACTERISTIC
/begin CHARACTERISTIC K_SMG_MOT_RS_N_OFF "Offset auf RS-Anfahrdrehzahl | EN: Offset on race-start pull-away speed" VALUE 0x789FA TKW_VV_VV_SW 100.0 FORMULA_0006 0.0 10000.0000 /end CHARACTERISTIC
/begin CHARACTERISTIC K_SMG_MOT_RS_T_LO "Lowzeit | EN: Low time" VALUE 0x789FC TKW_VV_VV_UW 100.0 FORMULA_0117 0.0050 325.0000 FORMAT "%5.2" /end CHARACTERISTIC
/begin CHARACTERISTIC K_SMG_MOT_RS_T_HI "Highzeit | EN: High time" VALUE 0x789FE TKW_VV_VV_UW 100.0 FORMULA_0117 0.0050 325.0000 FORMAT "%5.2" /end CHARACTERISTIC
/begin CHARACTERISTIC K_SMG_MOT_RS_TI_TIME "Zeit fuer TI-Eingriff | EN: Time for injection intervention" VALUE 0x78A00 TKW_VV_VV_UW 100.0 FORMULA_0117 0.0 325.0000 FORMAT "%5.2" /end CHARACTERISTIC
/begin CHARACTERISTIC K_SMG_MOT_RS_TI_TABG "max. TABG fuer TI-Eingriff | EN: Maximum exhaust temperature for injection intervention" VALUE 0x78A02 TKW_VV_VV_SW 100.0 FORMULA_0023 -50.0000 1000.0000 FORMAT "%4.1" /end CHARACTERISTIC
/begin CHARACTERISTIC K_SMG_MOT_RSS_MD_EINGR "Config-Rennstartschaltung | EN: Race-start (launch) configuration" VALUE 0x78A04 TKW_VV_VV_UB 100.0 FORMULA_0950 0.0 255.0 /end CHARACTERISTIC
/begin CHARACTERISTIC K_SMG_MOT_AKS_N_SCHW "max. Differenz zu nBegr fuer AKS | EN: Maximum difference to rev limit for auto-upshift" VALUE 0x78A06 TKW_VV_VV_SW 100.0 FORMULA_0006 0.0 10000.0000 /end CHARACTERISTIC
/begin CHARACTERISTIC K_SMG_MOT_M_RES_POS_MAX "Start Moment pos. Reserve | EN: Start torque for positive reserve" VALUE 0x78A08 TKW_VV_VV_SW 100.0 FORMULA_0009 -100.0000 1000.0000 FORMAT "%4.1" /end CHARACTERISTIC
/begin CHARACTERISTIC K_SMG_MOT_M_RES_POS_N "Start Drehzahl pos. Reserve | EN: Start engine speed for positive reserve" VALUE 0x78A0A TKW_VV_VV_SW 100.0 FORMULA_0006 0.0 10000.0000 /end CHARACTERISTIC
/begin CHARACTERISTIC K_SMG_BERG_V_MIN_SCHW "min. v-Schwelle Bergerkennung | EN: Minimum speed threshold for hill detection" VALUE 0x78A0C TKW_VV_VV_SW 100.0 FORMULA_0078 -80.0000 360.0000 FORMAT "%4.1" /end CHARACTERISTIC
/begin CHARACTERISTIC K_SMG_BERG_V_MAX_SCHW "max. v-Schwelle Bergerkennung | EN: Maximum speed threshold for hill detection" VALUE 0x78A0E TKW_VV_VV_SW 100.0 FORMULA_0078 -80.0000 360.0000 FORMAT "%4.1" /end CHARACTERISTIC
/begin CHARACTERISTIC K_SMG_BERG_MD_KW_SCHW "Md-Schwelle Bergerkennung | EN: Torque threshold for hill detection" VALUE 0x78A10 TKW_VV_VV_SW 100.0 FORMULA_0009 -100.0000 1000.0000 FORMAT "%4.1" /end CHARACTERISTIC
/begin CHARACTERISTIC K_SMG_ADAPT_SP_TOEL "Toel-Sperre fuer Kupplungsadaption | EN: Oil-temperature lock for clutch adaptation" VALUE 0x78A12 TKW_VV_VV_SW 100.0 FORMULA_0023 -50.0000 170.0000 FORMAT "%4.1" /end CHARACTERISTIC
/begin CHARACTERISTIC K_SMG_ADAPT_SP_DMD_FW "Gradient-Sperre fuer Kupplungsadaption | EN: Gradient lock for clutch adaptation" VALUE 0x78A14 TKW_VV_VV_SW 100.0 FORMULA_0571 -5000.0000 5000.0000 /end CHARACTERISTIC
/begin CHARACTERISTIC K_SMG_ADAPT_SP_DM_MAX "zulaessige Abweichung fuer Kupplungsadaption | EN: Permitted deviation for clutch adaptation" VALUE 0x78A16 TKW_VV_VV_SW 100.0 FORMULA_0009 -100.0000 1000.0000 FORMAT "%4.1" /end CHARACTERISTIC
/begin CHARACTERISTIC K_SMG_ADAPT_SP_N_MIN "min. Drehzahl fuer Kupplungsadaption | EN: Minimum engine speed for clutch adaptation" VALUE 0x78A18 TKW_VV_VV_SW 100.0 FORMULA_0006 0.0 10000.0000 /end CHARACTERISTIC
/begin CHARACTERISTIC K_SMG_ADAPT_SP_N_MAX "max. Drehzahl fuer Kupplungsadaption | EN: Maximum engine speed for clutch adaptation" VALUE 0x78A1A TKW_VV_VV_SW 100.0 FORMULA_0006 0.0 10000.0000 /end CHARACTERISTIC
/begin CHARACTERISTIC K_SMG_OHNE_EINGR_OFF "Offset auf sa_n_we | EN: Offset on sa_n_we" VALUE 0x78A1C TKW_VV_VV_SW 100.0 FORMULA_0006 0.0 10000.0000 /end CHARACTERISTIC
/begin CHARACTERISTIC K_SMG_I_GANG_R "Gang�bersetzung | EN: Gear ratio" VALUE 0x78A1E TKW_VV_VV_UW 100.0 FORMULA_0075 0.0 4.0000 FORMAT "%6.3" /end CHARACTERISTIC
/begin CHARACTERISTIC K_SMG_I_GANG_N "Gang�bersetzung | EN: Gear ratio" VALUE 0x78A20 TKW_VV_VV_UW 100.0 FORMULA_0075 0.0 4.0000 FORMAT "%6.3" /end CHARACTERISTIC
/begin CHARACTERISTIC K_SMG_I_GANG_1 "Gang�bersetzung | EN: Gear ratio" VALUE 0x78A22 TKW_VV_VV_UW 100.0 FORMULA_0075 0.0 4.0000 FORMAT "%6.3" /end CHARACTERISTIC
/begin CHARACTERISTIC K_SMG_I_GANG_2 "Gang�bersetzung | EN: Gear ratio" VALUE 0x78A24 TKW_VV_VV_UW 100.0 FORMULA_0075 0.0 4.0000 FORMAT "%6.3" /end CHARACTERISTIC
/begin CHARACTERISTIC K_SMG_I_GANG_3 "Gang�bersetzung | EN: Gear ratio" VALUE 0x78A26 TKW_VV_VV_UW 100.0 FORMULA_0075 0.0 4.0000 FORMAT "%6.3" /end CHARACTERISTIC
/begin CHARACTERISTIC K_SMG_I_GANG_4 "Gang�bersetzung | EN: Gear ratio" VALUE 0x78A28 TKW_VV_VV_UW 100.0 FORMULA_0075 0.0 4.0000 FORMAT "%6.3" /end CHARACTERISTIC
/begin CHARACTERISTIC K_SMG_I_GANG_5 "Gang�bersetzung | EN: Gear ratio" VALUE 0x78A2A TKW_VV_VV_UW 100.0 FORMULA_0075 0.0 4.0000 FORMAT "%6.3" /end CHARACTERISTIC
/begin CHARACTERISTIC K_SMG_I_GANG_6 "Gang�bersetzung | EN: Gear ratio" VALUE 0x78A2C TKW_VV_VV_UW 100.0 FORMULA_0075 0.0 4.0000 FORMAT "%6.3" /end CHARACTERISTIC
/begin CHARACTERISTIC K_SMG_I_GANG_7 "Gang�bersetzung | EN: Gear ratio" VALUE 0x78A2E TKW_VV_VV_UW 100.0 FORMULA_0075 0.0 4.0000 FORMAT "%6.3" /end CHARACTERISTIC
/begin CHARACTERISTIC K_SMG_I_HA "Hinterachsuebersetzung | EN: Rear-axle ratio" VALUE 0x78A30 TKW_VV_VV_UW 100.0 FORMULA_0075 0.0 4.0000 FORMAT "%6.3" /end CHARACTERISTIC
/begin CHARACTERISTIC K_SMG_R_DYN "Reifenradius | EN: Tyre radius" VALUE 0x78A32 TKW_VV_VV_UB 100.0 FORMULA_0951 0.0 100.0000 /end CHARACTERISTIC
/begin CHARACTERISTIC K_SMG_SK_CONTROL "SK-Config | EN: Safety-concept configuration" VALUE 0x78A33 TKW_VV_VV_UB 100.0 FORMULA_0952 0.0 255.0 /end CHARACTERISTIC
/begin CHARACTERISTIC K_SMG_SK_T_PHASE_MAX_AB "max. Zeit | EN: Maximum time" VALUE 0x78A34 TKW_VV_VV_UW 100.0 FORMULA_0021 0.0 655.0000 FORMAT "%5.2" /end CHARACTERISTIC
/begin CHARACTERISTIC K_SMG_SK_T_PHASE_MAX_SCHA "max. Zeit | EN: Maximum time" VALUE 0x78A36 TKW_VV_VV_UW 100.0 FORMULA_0021 0.0 655.0000 FORMAT "%5.2" /end CHARACTERISTIC
/begin CHARACTERISTIC K_SMG_SK_T_PHASE_MAX_AUF "max. Zeit | EN: Maximum time" VALUE 0x78A38 TKW_VV_VV_UW 100.0 FORMULA_0021 0.0 655.0000 FORMAT "%5.2" /end CHARACTERISTIC
/begin CHARACTERISTIC K_SMG_SK_T_PHASE_N_MAX "max. Zeit Nmax-Ueberschreitung | EN: Maximum time for Nmax exceedance" VALUE 0x78A3A TKW_VV_VV_UW 100.0 FORMULA_0021 0.0 655.0000 FORMAT "%5.2" /end CHARACTERISTIC
/begin CHARACTERISTIC K_SMG_SK_T_MAX "Zeitschwelle CAN-Fehlerkennung | EN: Time threshold, CAN fault detection" VALUE 0x78A3C TKW_VV_VV_UB 100.0 FORMULA_0317 0.0 2.5500 /end CHARACTERISTIC
/begin CHARACTERISTIC K_SMG_SK_T_DME_ST_MAX "Zeitschwelle Statuscheck | EN: Time threshold, status check" VALUE 0x78A3D TKW_VV_VV_UB 100.0 FORMULA_0317 0.0 2.5500 /end CHARACTERISTIC
/begin CHARACTERISTIC K_SMG_SK_NBERCH_T "Zeitschwelle nBerech | EN: Time threshold nBerech" VALUE 0x78A3E TKW_VV_VV_UB 100.0 FORMULA_0317 0.0 2.5500 /end CHARACTERISTIC
/begin CHARACTERISTIC K_SMG_SK_NBERCH_MAX "Drehzahlschwelle nBerech | EN: Engine-speed threshold nBerech (calculated speed)" VALUE 0x78A40 TKW_VV_VV_SW 100.0 FORMULA_0006 0.0 10000.0000 /end CHARACTERISTIC
/begin CHARACTERISTIC K_SMG_SK_NZIEL_T "Zeitschwelle nZiel | EN: Time threshold, target speed" VALUE 0x78A42 TKW_VV_VV_UB 100.0 FORMULA_0317 0.0 2.5500 /end CHARACTERISTIC
/begin CHARACTERISTIC K_SMG_SK_NZIEL_MAX "Drehzahlschwelle nZiel | EN: Engine-speed threshold, target speed" VALUE 0x78A44 TKW_VV_VV_SW 100.0 FORMULA_0006 0.0 10000.0000 /end CHARACTERISTIC
/begin CHARACTERISTIC K_SMG_SK_NGETR_T "Zeitschwelle nGetr | EN: Time threshold, gearbox speed" VALUE 0x78A46 TKW_VV_VV_UB 100.0 FORMULA_0317 0.0 2.5500 /end CHARACTERISTIC
/begin CHARACTERISTIC K_SMG_SK_NGETR_MAX "Drehzahlschwelle nGetr | EN: Engine-speed threshold, gearbox speed" VALUE 0x78A48 TKW_VV_VV_SW 100.0 FORMULA_0006 0.0 10000.0000 /end CHARACTERISTIC
/begin CHARACTERISTIC K_SMG_SK_T_NGETR_MAX "Zeitschwelle max. nGetr | EN: Time threshold, maximum gearbox speed" VALUE 0x78A4A TKW_VV_VV_UB 100.0 FORMULA_0317 0.0 2.5500 /end CHARACTERISTIC
/begin CHARACTERISTIC K_SMG_SK_T_NZIEL_MAX "Zeitschwelle max. nZiel | EN: Time threshold, maximum target speed" VALUE 0x78A4B TKW_VV_VV_UB 100.0 FORMULA_0317 0.0 2.5500 /end CHARACTERISTIC
/begin CHARACTERISTIC K_SMG_SK_M_KUPP_MIN "max. Kupplungsmoment bei AK | EN: Maximum clutch torque at AK" VALUE 0x78A4C TKW_VV_VV_SW 100.0 FORMULA_0009 -100.0000 1000.0000 FORMAT "%4.1" /end CHARACTERISTIC
/begin CHARACTERISTIC K_SMG_SK_NMAX_FSP_INAKTIV "Nmax-Schwelle ausserhalb Schaltung | EN: Nmax threshold outside shift" VALUE 0x78A4E TKW_VV_VV_SW 100.0 FORMULA_0006 0.0 10000.0000 /end CHARACTERISTIC
/begin CHARACTERISTIC K_SMG_SK_NMAX_FSP "Nmax-Schwelle innerhalb Schaltung | EN: Nmax threshold during shift" VALUE 0x78A50 TKW_VV_VV_SW 100.0 FORMULA_0006 0.0 10000.0000 /end CHARACTERISTIC
/begin CHARACTERISTIC K_SMG_SK_V_SCHW "v-Diagnoseschwelle | EN: Vehicle-speed diagnosis threshold" VALUE 0x78A52 TKW_VV_VV_SW 100.0 FORMULA_0078 -80.0000 360.0000 FORMAT "%4.1" /end CHARACTERISTIC
/begin CHARACTERISTIC K_SMG_SK_MD_SCHW "Md-Diagnoseschwelle | EN: Torque diagnosis threshold" VALUE 0x78A54 TKW_VV_VV_SW 100.0 FORMULA_0009 -100.0000 1000.0000 FORMAT "%4.1" /end CHARACTERISTIC
/begin CHARACTERISTIC K_SMG_ADAPT_IHAR_CNT "Counter IHAR-Adaption | EN: Counter, rear-axle ratio adaptation" VALUE 0x78A56 TKW_VV_VV_UB 100.0 FORMULA_0033 0.0 255.0000 /end CHARACTERISTIC
/begin CHARACTERISTIC K_SMG_ADAPT_IHAR_MIN "min. IHAR-Uebersetzung | EN: Minimum rear-axle ratio" VALUE 0x78A58 TKW_VV_VV_UW 100.0 FORMULA_0075 0.0 4.0000 FORMAT "%6.3" /end CHARACTERISTIC
/begin CHARACTERISTIC K_SMG_ADAPT_IHAR_MAX "max. IHAR-Uebersetzung | EN: Maximum rear-axle ratio" VALUE 0x78A5A TKW_VV_VV_UW 100.0 FORMULA_0075 0.0 4.0000 FORMAT "%6.3" /end CHARACTERISTIC
/begin CHARACTERISTIC K_SMG_ADAPT_IHAR_DFLT "Default IHAR-Uebersetzung | EN: Default rear-axle ratio" VALUE 0x78A5C TKW_VV_VV_UW 100.0 FORMULA_0075 0.0 4.0000 FORMAT "%6.3" /end CHARACTERISTIC
/begin CHARACTERISTIC KL_SMG_PROG_MANUELL "Manuelle Programme | EN: Manual programs" CURVE 0x78A5E TKL_UB_VV_UB 100.0 FORMULA_0003 0.0 8.0000 /begin AXIS_DESCR STD_AXIS canP FORMULA_0003 6 0.0 6.0000 /end AXIS_DESCR /end CHARACTERISTIC
/begin CHARACTERISTIC KL_SMG_PROG_AUTOMAT "Automat-Programme | EN: Automatic programs" CURVE 0x78A6C TKL_UB_VV_UB 100.0 FORMULA_0003 0.0 8.0000 /begin AXIS_DESCR STD_AXIS canP FORMULA_0003 6 0.0 6.0000 /end AXIS_DESCR /end CHARACTERISTIC
/begin CHARACTERISTIC KL_SMG_SK_PROG_MAX "max. Programme bei SK-Begr | EN: Maximum programs with safety-concept limit" CURVE 0x78A7A TKL_UB_VV_UB 100.0 FORMULA_0003 0.0 8.0000 /begin AXIS_DESCR STD_AXIS sk_stufe FORMULA_0003 6 0.0 6.0000 /end AXIS_DESCR /end CHARACTERISTIC
/begin CHARACTERISTIC KL_SMG_T_KORR_AB "Faktor fuer Korrektur | EN: Correction factor" CURVE 0x78A88 TKL_UB_VV_UB 100.0 FORMULA_0926 0.0 199.2187 /begin AXIS_DESCR STD_AXIS rel_fw FORMULA_0926 6 0.0 199.2187 /end AXIS_DESCR /end CHARACTERISTIC
/begin CHARACTERISTIC KL_SMG_N_ABRISS_SCHW "Schwelle fuer Abriss | EN: Threshold for tear-off (wheel slip)" CURVE 0x78A96 TKL_SW_VV_SW 100.0 FORMULA_0006 0.0 10000.0000
 /begin AXIS_DESCR STD_AXIS md_kw FORMULA_0009 4 -100.0000 1000.0000 FORMAT "%4.1" /end AXIS_DESCR
/end CHARACTERISTIC
/begin CHARACTERISTIC KL_SMG_FW_REL_VIRT "virt. Fahrerwunsch | EN: Virtual driver demand" CURVE 0x78AA8 TKL_SW_VV_UB 100.0 FORMULA_0704 0.0 1.9921
 /begin AXIS_DESCR STD_AXIS rschlupf FORMULA_0917 4 -100.0000 100.0000 FORMAT "%5.2" /end AXIS_DESCR
/end CHARACTERISTIC
/begin CHARACTERISTIC KL_SMG_KI_DAY_MAX "max. Zunahme ay | EN: Maximum increase of lateral acceleration" CURVE 0x78AB6 TKL_SW_VV_UB 100.0 FORMULA_0003 0.0 15.0000 /begin AXIS_DESCR STD_AXIS day FORMULA_0132 3 -20.0000 20.0000 FORMAT "%5.2" /end AXIS_DESCR /end CHARACTERISTIC
/begin CHARACTERISTIC KL_SMG_KI_AKS_GANG "maximale KI ueber Ziel-Gang | EN: Maximum shift index over target gear" CURVE 0x78AC2 TKL_SB_VV_UB 100.0 FORMULA_0003 0.0 255.0000 /begin AXIS_DESCR STD_AXIS istgang FORMULA_0003 7 -128.0000 127.0000 /end AXIS_DESCR /end CHARACTERISTIC
/begin CHARACTERISTIC KL_SMG_KUPP_M_AB_ZH "Abregel-Kennlinie ZugHoch | EN: Ramp-down curve, traction upshift" CURVE 0x78AD2 TKL_UB_VV_UB 100.0 FORMULA_0953 0.0 199.2187 /begin AXIS_DESCR STD_AXIS t_norm FORMULA_0954 8 0.0 199.2187 /end AXIS_DESCR /end CHARACTERISTIC
/begin CHARACTERISTIC KL_SMG_KUPP_M_AB_ZR "Abregel-Kennlinie ZugRueck | EN: Ramp-down curve, traction downshift" CURVE 0x78AE4 TKL_UB_VV_UB 100.0 FORMULA_0953 0.0 199.2187 /begin AXIS_DESCR STD_AXIS t_norm FORMULA_0954 8 0.0 199.2187 /end AXIS_DESCR /end CHARACTERISTIC
/begin CHARACTERISTIC KL_SMG_KUPP_M_AB_SH "Abregel-Kennlinie SchubHoch | EN: Ramp-down curve, overrun upshift" CURVE 0x78AF6 TKL_UB_VV_UB 100.0 FORMULA_0953 0.0 199.2187 /begin AXIS_DESCR STD_AXIS t_norm FORMULA_0954 8 0.0 199.2187 /end AXIS_DESCR /end CHARACTERISTIC
/begin CHARACTERISTIC KL_SMG_KUPP_M_AB_SR "Abregel-Kennlinie SchubRueck | EN: Ramp-down curve, overrun downshift" CURVE 0x78B08 TKL_UB_VV_UB 100.0 FORMULA_0953 0.0 199.2187 /begin AXIS_DESCR STD_AXIS t_norm FORMULA_0954 8 0.0 199.2187 /end AXIS_DESCR /end CHARACTERISTIC
/begin CHARACTERISTIC KL_SMG_KUPP_M_AB_ANF "Abregel-Kennlinie nach Anfahren | EN: Ramp-down curve after pull-away" CURVE 0x78B1A TKL_UB_VV_UB 100.0 FORMULA_0953 0.0 199.2187 /begin AXIS_DESCR STD_AXIS t_norm FORMULA_0954 6 0.0 199.2187 /end AXIS_DESCR /end CHARACTERISTIC
/begin CHARACTERISTIC KL_SMG_KUPP_M_AUF_Z1 "Aufregel-Kennlinie Zug | EN: Ramp-up curve, traction" CURVE 0x78B28 TKL_UB_VV_UB 100.0 FORMULA_0953 0.0 100.0000 /begin AXIS_DESCR STD_AXIS t_norm FORMULA_0954 8 0.0 199.2187 /end AXIS_DESCR /end CHARACTERISTIC
/begin CHARACTERISTIC KL_SMG_KUPP_M_AUF_S1 "Aufregel-Kennlinie Schub | EN: Ramp-up curve, overrun" CURVE 0x78B3A TKL_UB_VV_UB 100.0 FORMULA_0953 0.0 100.0000 /begin AXIS_DESCR STD_AXIS t_norm FORMULA_0954 8 0.0 199.2187 /end AXIS_DESCR /end CHARACTERISTIC
/begin CHARACTERISTIC KL_SMG_KUPP_M_AUF_KI "Offset auf Aufregelrampe | EN: Offset on ramp-up ramp" CURVE 0x78B4C TKL_UB_VV_UB 100.0 FORMULA_0953 0.0 50.0000 /begin AXIS_DESCR STD_AXIS ki_auf FORMULA_0003 4 0.0 12.0000 /end AXIS_DESCR /end CHARACTERISTIC
/begin CHARACTERISTIC KL_SMG_KUPP_M_AUF_OFF "Kupplungsoffset beim Aufregeln | EN: Clutch offset during ramp-up" CURVE 0x78B56 TKL_UB_VV_UB 100.0 FORMULA_0749 0.0 25.5000 /begin AXIS_DESCR STD_AXIS t_norm FORMULA_0954 8 0.0 199.2187 /end AXIS_DESCR /end CHARACTERISTIC
/begin CHARACTERISTIC KL_SMG_KUPP_REG_I_F "Faktor fuer Rampe und Regler | EN: Factor for ramp and controller" CURVE 0x78B68 TKL_SW_VV_UW 100.0 FORMULA_0955 1.0000 10.0000
 /begin AXIS_DESCR STD_AXIS vor1 FORMULA_0009 3 -100.0000 1000.0000 FORMAT "%4.1" /end AXIS_DESCR
 FORMAT "%4.1" /end CHARACTERISTIC
/begin CHARACTERISTIC KL_SMG_KUPP_M_AB_OFF "Offset auf Fahrer beim Abregeln | EN: Offset on driver demand during ramp-down" CURVE 0x78B76 TKL_SW_VV_SW 100.0 FORMULA_0009 -100.0000 1000.0000
 /begin AXIS_DESCR STD_AXIS md_fw FORMULA_0009 3 -100.0000 1000.0000 FORMAT "%4.1" /end AXIS_DESCR
 FORMAT "%4.1" /end CHARACTERISTIC
/begin CHARACTERISTIC KL_SMG_KUPP_UL_DN_POS "Gradientenschwelle Ueberlastschutz | EN: Gradient threshold, overload protection" CURVE 0x78B84 TKL_SW_VV_SW 100.0 FORMULA_0114 0.0 10000.0000 /begin AXIS_DESCR STD_AXIS n_diff FORMULA_0006 3 0.0 10000.0000 /end AXIS_DESCR /end CHARACTERISTIC
/begin CHARACTERISTIC KL_SMG_MOT_M_AB_ZH "Abregel-Kennlinie ZugHoch | EN: Ramp-down curve, traction upshift" CURVE 0x78B92 TKL_UB_VV_UB 100.0 FORMULA_0953 0.0 199.2187 /begin AXIS_DESCR STD_AXIS t_norm FORMULA_0954 8 0.0 199.2187 /end AXIS_DESCR /end CHARACTERISTIC
/begin CHARACTERISTIC KL_SMG_MOT_M_AB_ZR "Abregel-Kennlinie ZugRueck | EN: Ramp-down curve, traction downshift" CURVE 0x78BA4 TKL_UB_VV_UB 100.0 FORMULA_0953 0.0 199.2187 /begin AXIS_DESCR STD_AXIS t_norm FORMULA_0954 8 0.0 199.2187 /end AXIS_DESCR /end CHARACTERISTIC
/begin CHARACTERISTIC KL_SMG_MOT_M_AB_SH "Abregel-Kennlinie SchubHoch | EN: Ramp-down curve, overrun upshift" CURVE 0x78BB6 TKL_UB_VV_UB 100.0 FORMULA_0953 0.0 199.2187 /begin AXIS_DESCR STD_AXIS t_norm FORMULA_0954 8 0.0 199.2187 /end AXIS_DESCR /end CHARACTERISTIC
/begin CHARACTERISTIC KL_SMG_MOT_M_AB_SR "Abregel-Kennlinie SchubRueck | EN: Ramp-down curve, overrun downshift" CURVE 0x78BC8 TKL_UB_VV_UB 100.0 FORMULA_0953 0.0 199.2187 /begin AXIS_DESCR STD_AXIS t_norm FORMULA_0954 8 0.0 199.2187 /end AXIS_DESCR /end CHARACTERISTIC
/begin CHARACTERISTIC KL_SMG_MOT_VOR_2_KI "Faktor fuer Vorsteuerung 2 | EN: Factor for pre-control 2" CURVE 0x78BDA TKL_UB_VV_UB 100.0 FORMULA_0704 0.0 1.9921 /begin AXIS_DESCR STD_AXIS smg_ki_auf FORMULA_0003 4 0.0 12.0000 /end AXIS_DESCR /end CHARACTERISTIC
/begin CHARACTERISTIC KL_SMG_N_ZIEL_OFF_MAX "maximaler Offsetfaktor | EN: Maximum offset factor" CURVE 0x78BE4 TKL_SW_VV_UB 100.0 FORMULA_0956 0.0 100.0000
 /begin AXIS_DESCR STD_AXIS toel FORMULA_0023 4 -50.0000 170.0000 FORMAT "%4.1" /end AXIS_DESCR
/end CHARACTERISTIC
/begin CHARACTERISTIC KL_SMG_N_ZIEL_OFF_ANF "Offset auf n-Anfahr | EN: Offset on pull-away speed" CURVE 0x78BF2 TKL_SW_VV_SW 100.0 FORMULA_0006 0.0 10000.0000
 /begin AXIS_DESCR STD_AXIS pwg_soll FORMULA_0001 3 -10.0000 120.0000 FORMAT "%4.1" /end AXIS_DESCR
/end CHARACTERISTIC
/begin CHARACTERISTIC KL_SMG_N_ZIEL_OFF_LL "Offset auf nLL | EN: Offset on idle speed" CURVE 0x78C00 TKL_SW_VV_SW 100.0 FORMULA_0006 0.0 10000.0000
 /begin AXIS_DESCR STD_AXIS pwg_soll FORMULA_0001 3 -10.0000 120.0000 FORMAT "%4.1" /end AXIS_DESCR
/end CHARACTERISTIC
/begin CHARACTERISTIC KL_SMG_MOT_N_REG_P_UP "P-Anteil UP | EN: P share UP" CURVE 0x78C0E TKL_SW_VV_UB 100.0 FORMULA_0957 0.0 2.5500 /begin AXIS_DESCR STD_AXIS n_soll FORMULA_0006 6 0.0 10000.0000 /end AXIS_DESCR /end CHARACTERISTIC
/begin CHARACTERISTIC KL_SMG_MOT_N_REG_P_DN "P-Anteil DOWN | EN: P share DOWN" CURVE 0x78C22 TKL_SW_VV_UB 100.0 FORMULA_0957 0.0 2.5500 /begin AXIS_DESCR STD_AXIS n_soll FORMULA_0006 6 0.0 10000.0000 /end AXIS_DESCR /end CHARACTERISTIC
/begin CHARACTERISTIC KL_SMG_MOT_N_REG_D_UP "D-Anteil UP | EN: Derivative share UP" CURVE 0x78C36 TKL_SW_VV_UB 100.0 FORMULA_0958 0.0 25.5000 /begin AXIS_DESCR STD_AXIS n_soll FORMULA_0006 6 0.0 10000.0000 /end AXIS_DESCR /end CHARACTERISTIC
/begin CHARACTERISTIC KL_SMG_MOT_N_REG_D_DN "D-Anteil DOWN | EN: Derivative share DOWN" CURVE 0x78C4A TKL_SW_VV_UB 100.0 FORMULA_0958 0.0 25.5000 /begin AXIS_DESCR STD_AXIS n_soll FORMULA_0006 6 0.0 10000.0000 /end AXIS_DESCR /end CHARACTERISTIC
/begin CHARACTERISTIC KL_SMG_MOT_DN_SOLL "Betrag Sollgradient | EN: Magnitude of target gradient" CURVE 0x78C5E TKL_SW_VV_SW 100.0 FORMULA_0114 -10000.0000 10000.0000 /begin AXIS_DESCR STD_AXIS n_diff FORMULA_0006 6 0.0 10000.0000 /end AXIS_DESCR /end CHARACTERISTIC
/begin CHARACTERISTIC KL_SMG_MOT_DN_REG_P "P-Anteil Gradientenreglers | EN: P share of gradient controller" CURVE 0x78C78 TKL_SW_VV_UB 100.0 FORMULA_0959 0.0 0.2550 /begin AXIS_DESCR STD_AXIS n_diff FORMULA_0006 4 0.0 10000.0000 /end AXIS_DESCR /end CHARACTERISTIC
/begin CHARACTERISTIC KL_SMG_MOT_J_MOTOR "Faktor fuer Vorst 2 | EN: Factor for pre-control 2" CURVE 0x78C86 TKL_SW_VV_UB 100.0 FORMULA_0939 0.0 1.9921 /begin AXIS_DESCR STD_AXIS n_ziel FORMULA_0006 3 0.0 10000.0000 /end AXIS_DESCR /end CHARACTERISTIC
/begin CHARACTERISTIC KL_SMG_MOT_M_VOR_AUF "Motor-Vorausschau | EN: Engine look-ahead" CURVE 0x78C92 TKL_SW_VV_UB 100.0 FORMULA_0317 0.0 2.5500 /begin AXIS_DESCR STD_AXIS n FORMULA_0006 4 0.0 10000.0000 /end AXIS_DESCR /end CHARACTERISTIC
/begin CHARACTERISTIC KL_SMG_N_ZIEL_OFF_ZR "Offset bei ZR | EN: Offset during traction downshift" CURVE 0x78CA0 TKL_UW_VV_SW 100.0 FORMULA_0006 0.0 10000.0000 /begin AXIS_DESCR STD_AXIS ki FORMULA_0010 3 0.0 65535.0000 /end AXIS_DESCR /end CHARACTERISTIC
/begin CHARACTERISTIC KL_SMG_N_ZIEL_OFF_RAB "Offsetdrehzahl bei Radabriss | EN: Speed offset on wheel tear-off" CURVE 0x78CAE TKL_SW_VV_SW 100.0 FORMULA_0006 0.0 10000.0000
 /begin AXIS_DESCR STD_AXIS m_k_1 FORMULA_0009 4 -100.0000 1000.0000 FORMAT "%4.1" /end AXIS_DESCR
/end CHARACTERISTIC
/begin CHARACTERISTIC KL_SMG_MOT_M_RES_AUF "Reserve beim Aufregeln | EN: Reserve during ramp-up" CURVE 0x78CC0 TKL_SW_VV_SW 100.0 FORMULA_0009 -100.0000 1000.0000
 /begin AXIS_DESCR STD_AXIS md_kupp_wunsch_ges FORMULA_0009 4 -100.0000 1000.0000 FORMAT "%4.1" /end AXIS_DESCR
 FORMAT "%4.1" /end CHARACTERISTIC
/begin CHARACTERISTIC KL_SMG_PROG_MAX_TOEL "maximales Programm ueber Toel | EN: Maximum program over oil temperature" CURVE 0x78CD2 TKL_SW_VV_UB 100.0 FORMULA_0960 1.0000 12.0000
 /begin AXIS_DESCR STD_AXIS toel FORMULA_0023 4 -50.0000 170.0000 FORMAT "%4.1" /end AXIS_DESCR
/end CHARACTERISTIC
/begin CHARACTERISTIC KL_SMG_PROG_MIN_BERG "minimales Programm bei Steigung | EN: Minimum program on incline" CURVE 0x78CE0 TKL_SW_VV_UB 100.0 FORMULA_0960 1.0000 12.0000
 /begin AXIS_DESCR STD_AXIS smg_ax_berg FORMULA_0132 4 -20.0000 20.0000 FORMAT "%5.2" /end AXIS_DESCR
/end CHARACTERISTIC
/begin CHARACTERISTIC KL_SMG_MOT_N_REG_M_LW "Max. Moment beim Lastwechsel | EN: Maximum torque during load change" CURVE 0x78CEE TKL_SW_VV_SW 100.0 FORMULA_0009 -100.0000 1000.0000
 /begin AXIS_DESCR STD_AXIS smg_can_m_kupp_ist_abs FORMULA_0009 4 -100.0000 1000.0000 FORMAT "%4.1" /end AXIS_DESCR
 FORMAT "%4.1" /end CHARACTERISTIC
/begin CHARACTERISTIC KL_SMG_MOT_N_REG_SA_DIFF "Drehzahldifferenz SA-Ausloesung | EN: Speed difference for cruise switch-off" CURVE 0x78D00 TKL_SW_VV_SW 100.0 FORMULA_0006 0.0 10000.0000 /begin AXIS_DESCR STD_AXIS gang FORMULA_0486 6 -1.0000 10.0000 /end AXIS_DESCR /end CHARACTERISTIC
/begin CHARACTERISTIC KF_SMG_KI_AB_K "Abregel-Index Komfort | EN: Ramp-down index, Comfort" MAP 0x78D1A TKF_SW_SW_UB 100.0 FORMULA_0003 0.0 12.0000
 /begin AXIS_DESCR STD_AXIS pwg_soll FORMULA_0001 8 -10.0000 120.0000 FORMAT "%4.1" /end AXIS_DESCR
 /begin AXIS_DESCR STD_AXIS n FORMULA_0006 6 0.0 10000.0000 /end AXIS_DESCR
/end CHARACTERISTIC
/begin CHARACTERISTIC KF_SMG_KI_AB_S "Abregel-Index Sport | EN: Ramp-down index, Sport" MAP 0x78D68 TKF_SW_SW_UB 100.0 FORMULA_0003 0.0 12.0000
 /begin AXIS_DESCR STD_AXIS pwg_soll FORMULA_0001 8 -10.0000 120.0000 FORMAT "%4.1" /end AXIS_DESCR
 /begin AXIS_DESCR STD_AXIS n FORMULA_0006 6 0.0 10000.0000 /end AXIS_DESCR
/end CHARACTERISTIC
/begin CHARACTERISTIC KF_SMG_KI_SCHA_K "Schalt-Index Komfort | EN: Shift index, Comfort" MAP 0x78DB6 TKF_SW_SW_UB 100.0 FORMULA_0003 0.0 14.0000
 /begin AXIS_DESCR STD_AXIS pwg_soll FORMULA_0001 8 -10.0000 120.0000 FORMAT "%4.1" /end AXIS_DESCR
 /begin AXIS_DESCR STD_AXIS n FORMULA_0006 6 0.0 10000.0000 /end AXIS_DESCR
/end CHARACTERISTIC
/begin CHARACTERISTIC KF_SMG_KI_SCHA_S "Schalt-Index Sport | EN: Shift index, Sport" MAP 0x78E04 TKF_SW_SW_UB 100.0 FORMULA_0003 0.0 14.0000
 /begin AXIS_DESCR STD_AXIS pwg_soll FORMULA_0001 8 -10.0000 120.0000 FORMAT "%4.1" /end AXIS_DESCR
 /begin AXIS_DESCR STD_AXIS n FORMULA_0006 6 0.0 10000.0000 /end AXIS_DESCR
/end CHARACTERISTIC
/begin CHARACTERISTIC KF_SMG_KI_AUF_K "Aufregel-Index Komfort | EN: Ramp-up index, Comfort" MAP 0x78E52 TKF_SW_SW_UB 100.0 FORMULA_0003 0.0 12.0000
 /begin AXIS_DESCR STD_AXIS pwg_soll FORMULA_0001 8 -10.0000 120.0000 FORMAT "%4.1" /end AXIS_DESCR
 /begin AXIS_DESCR STD_AXIS n FORMULA_0006 6 0.0 10000.0000 /end AXIS_DESCR
/end CHARACTERISTIC
/begin CHARACTERISTIC KF_SMG_KI_AUF_S "Aufregel-Index Sport | EN: Ramp-up index, Sport" MAP 0x78EA0 TKF_SW_SW_UB 100.0 FORMULA_0003 0.0 12.0000
 /begin AXIS_DESCR STD_AXIS pwg_soll FORMULA_0001 8 -10.0000 120.0000 FORMAT "%4.1" /end AXIS_DESCR
 /begin AXIS_DESCR STD_AXIS n FORMULA_0006 6 0.0 10000.0000 /end AXIS_DESCR
/end CHARACTERISTIC
/begin CHARACTERISTIC KF_SMG_KI_AB_SCH_K "Abregel-Index Schub Komfort | EN: Ramp-down index, overrun, Comfort" MAP 0x78EEE TKF_SW_SW_UB 100.0 FORMULA_0003 0.0 12.0000
 /begin AXIS_DESCR STD_AXIS can_ax FORMULA_0132 5 -20.0000 20.0000 FORMAT "%5.2" /end AXIS_DESCR
 /begin AXIS_DESCR STD_AXIS n FORMULA_0006 6 0.0 10000.0000 /end AXIS_DESCR
/end CHARACTERISTIC
/begin CHARACTERISTIC KF_SMG_KI_AB_SCH_S "Abregel-Index Schub Sport | EN: Ramp-down index, overrun, Sport" MAP 0x78F24 TKF_SW_SW_UB 100.0 FORMULA_0003 0.0 12.0000
 /begin AXIS_DESCR STD_AXIS can_ax FORMULA_0132 5 -20.0000 20.0000 FORMAT "%5.2" /end AXIS_DESCR
 /begin AXIS_DESCR STD_AXIS n FORMULA_0006 6 0.0 10000.0000 /end AXIS_DESCR
/end CHARACTERISTIC
/begin CHARACTERISTIC KF_SMG_KI_SCHA_SCH_K "Schalt-Index Schub Komfort | EN: Shift index, overrun, Comfort" MAP 0x78F5A TKF_SW_SW_UB 100.0 FORMULA_0003 0.0 12.0000
 /begin AXIS_DESCR STD_AXIS can_ax FORMULA_0132 5 -20.0000 20.0000 FORMAT "%5.2" /end AXIS_DESCR
 /begin AXIS_DESCR STD_AXIS n FORMULA_0006 6 0.0 10000.0000 /end AXIS_DESCR
/end CHARACTERISTIC
/begin CHARACTERISTIC KF_SMG_KI_SCHA_SCH_S "Schalt-Index Schub Sport | EN: Shift index, overrun, Sport" MAP 0x78F90 TKF_SW_SW_UB 100.0 FORMULA_0003 0.0 12.0000
 /begin AXIS_DESCR STD_AXIS can_ax FORMULA_0132 5 -20.0000 20.0000 FORMAT "%5.2" /end AXIS_DESCR
 /begin AXIS_DESCR STD_AXIS n FORMULA_0006 6 0.0 10000.0000 /end AXIS_DESCR
/end CHARACTERISTIC
/begin CHARACTERISTIC KF_SMG_KI_AUF_SCH_K "Aufregel-Index Schub Komfort | EN: Ramp-up index, overrun, Comfort" MAP 0x78FC6 TKF_SW_SW_UB 100.0 FORMULA_0003 0.0 12.0000
 /begin AXIS_DESCR STD_AXIS can_ax FORMULA_0132 5 -20.0000 20.0000 FORMAT "%5.2" /end AXIS_DESCR
 /begin AXIS_DESCR STD_AXIS n FORMULA_0006 6 0.0 10000.0000 /end AXIS_DESCR
/end CHARACTERISTIC
/begin CHARACTERISTIC KF_SMG_KI_AUF_SCH_S "Aufregel-Index Schub Sport | EN: Ramp-up index, overrun, Sport" MAP 0x78FFC TKF_SW_SW_UB 100.0 FORMULA_0003 0.0 12.0000
 /begin AXIS_DESCR STD_AXIS can_ax FORMULA_0132 5 -20.0000 20.0000 FORMAT "%5.2" /end AXIS_DESCR
 /begin AXIS_DESCR STD_AXIS n FORMULA_0006 6 0.0 10000.0000 /end AXIS_DESCR
/end CHARACTERISTIC
/begin CHARACTERISTIC KF_SMG_T_ABREGEL "Abregelzeit | EN: Ramp-down time" MAP 0x79032 TKF_UB_UB_UB 100.0 FORMULA_0317 0.0100 2.4500 /begin AXIS_DESCR STD_AXIS Kennung FORMULA_0003 12 0.0 255.0000 /end AXIS_DESCR /begin AXIS_DESCR STD_AXIS Istgang FORMULA_0003 7 0.0 255.0000 /end AXIS_DESCR /end CHARACTERISTIC
/begin CHARACTERISTIC KF_SMG_T_AUFREGEL "Aufregelzeit | EN: Ramp-up time" MAP 0x7909B TKF_UB_UB_UB 100.0 FORMULA_0317 0.0100 2.4500 /begin AXIS_DESCR STD_AXIS Kennung FORMULA_0003 12 0.0 255.0000 /end AXIS_DESCR /begin AXIS_DESCR STD_AXIS Istgang FORMULA_0003 7 0.0 255.0000 /end AXIS_DESCR /end CHARACTERISTIC
/begin CHARACTERISTIC KF_SMG_BW_NULL "Bewertung Nulldurchgang | EN: Zero-crossing evaluation" MAP 0x79104 TKF_UB_UB_UB 100.0 FORMULA_0003 0.0 15.0000 /begin AXIS_DESCR STD_AXIS KI_AB FORMULA_0003 6 1.0000 12.0000 /end AXIS_DESCR /begin AXIS_DESCR STD_AXIS KI_SCHA FORMULA_0003 6 1.0000 12.0000 /end AXIS_DESCR /end CHARACTERISTIC
/begin CHARACTERISTIC KF_SMG_N_ZIEL_OFF_K "Offsetfaktor auf Zieldrehzahl Komfort | EN: Offset factor on target speed, Comfort" MAP 0x79136 TKF_SW_SW_UB 100.0 FORMULA_0956 0.0 100.0000 /begin AXIS_DESCR STD_AXIS ax FORMULA_0132 4 -20.0000 20.0000 FORMAT "%5.2" /end AXIS_DESCR /begin AXIS_DESCR STD_AXIS n FORMULA_0006 6 0.0 10000.0000 /end AXIS_DESCR /end CHARACTERISTIC
/begin CHARACTERISTIC KF_SMG_N_ZIEL_OFF_S "Offsetfaktor auf Zieldrehzahl Sport | EN: Offset factor on target speed, Sport" MAP 0x79164 TKF_SW_SW_UB 100.0 FORMULA_0956 0.0 100.0000 /begin AXIS_DESCR STD_AXIS ax FORMULA_0132 4 -20.0000 20.0000 FORMAT "%5.2" /end AXIS_DESCR /begin AXIS_DESCR STD_AXIS n FORMULA_0006 6 0.0 10000.0000 /end AXIS_DESCR /end CHARACTERISTIC
/begin CHARACTERISTIC KF_SMG_MOT_N_REG_M_MAX "Max-Begrenzung n-Regler | EN: Maximum limit of speed controller" MAP 0x79192 TKF_SW_SW_SW 100.0 FORMULA_0009 -100.0000 1000.0000
 /begin AXIS_DESCR STD_AXIS pwg_soll FORMULA_0001 5 -10.0000 120.0000 FORMAT "%4.1" /end AXIS_DESCR
 /begin AXIS_DESCR STD_AXIS canP FORMULA_0010 5 0.0 8.0000 /end AXIS_DESCR
 FORMAT "%4.1" /end CHARACTERISTIC
/begin CHARACTERISTIC KF_SMG_MOT_ANF_M_RAMPE_1R "Rampe beim Anfahren in 1 und R | EN: Ramp for pull-away in 1st and reverse" MAP 0x791DA TKF_SW_SW_SW 100.0 FORMULA_0571 0.0 5000.0000
 /begin AXIS_DESCR STD_AXIS pwg_soll FORMULA_0001 4 -10.0000 120.0000 FORMAT "%4.1" /end AXIS_DESCR
 /begin AXIS_DESCR STD_AXIS smg_ax_berg FORMULA_0132 4 0.0 20.0000 FORMAT "%5.2" /end AXIS_DESCR
/end CHARACTERISTIC
/begin CHARACTERISTIC KF_SMG_MOT_ANF_M_RAMPE_2 "Rampe beim Anfahren in 2 | EN: Ramp for pull-away in 2nd" MAP 0x7920C TKF_SW_SW_SW 100.0 FORMULA_0571 0.0 5000.0000
 /begin AXIS_DESCR STD_AXIS pwg_soll FORMULA_0001 4 -10.0000 120.0000 FORMAT "%4.1" /end AXIS_DESCR
 /begin AXIS_DESCR STD_AXIS smg_ax_berg FORMULA_0132 4 0.0 20.0000 FORMAT "%5.2" /end AXIS_DESCR
/end CHARACTERISTIC
/begin CHARACTERISTIC KF_SMG_MOT_N_REG_P_KO "Korrektur P-Faktor | EN: P-factor correction" MAP 0x7923E TKF_SW_SW_UB 100.0 FORMULA_0961 1.0000 2.9921 /begin AXIS_DESCR STD_AXIS n_diff FORMULA_0006 6 0.0 10000.0000 /end AXIS_DESCR /begin AXIS_DESCR STD_AXIS n_grad_asp FORMULA_0114 6 -10000.0000 10000.0000 /end AXIS_DESCR /end CHARACTERISTIC
/begin CHARACTERISTIC KF_SMG_KUPP_REG_I_ZUG "Kupplungsregler fuer Zug | EN: Clutch controller for traction (drive)" MAP 0x7927C TKF_SW_SW_UB 100.0 FORMULA_0948 0.0 0.0255 /begin AXIS_DESCR STD_AXIS n_diff FORMULA_0006 4 0.0 10000.0000 /end AXIS_DESCR /begin AXIS_DESCR STD_AXIS n_grad_diff FORMULA_0114 3 -10000.0000 10000.0000 /end AXIS_DESCR /end CHARACTERISTIC
/begin CHARACTERISTIC KF_SMG_KUPP_REG_I_SCH "Kupplungsregler fuer Schub | EN: Clutch controller for overrun" MAP 0x79298 TKF_SW_SW_UB 100.0 FORMULA_0948 0.0 0.0255 /begin AXIS_DESCR STD_AXIS n_diff FORMULA_0006 4 0.0 10000.0000 /end AXIS_DESCR /begin AXIS_DESCR STD_AXIS n_grad_diff FORMULA_0114 3 -10000.0000 10000.0000 /end AXIS_DESCR /end CHARACTERISTIC
/begin CHARACTERISTIC KF_SMG_KUPP_LW_RAMPE "Rampe beim Lastwechsel | EN: Ramp on load change" MAP 0x792B4 TKF_SW_SW_SW 100.0 FORMULA_0962 -5000.0000 5000.0000
 /begin AXIS_DESCR STD_AXIS pwg_soll FORMULA_0001 4 -10.0000 120.0000 FORMAT "%4.1" /end AXIS_DESCR
 /begin AXIS_DESCR STD_AXIS smg_kupp_m_lw_start FORMULA_0009 4 0.0 1000.0000 FORMAT "%4.1" /end AXIS_DESCR
/end CHARACTERISTIC
/begin MEASUREMENT smg_old.t_korr "Verkuerzung der Abregelzeit" UWORD FORMULA_0909 0 0 0.0 100.0000 ECU_ADDRESS 0x3FC226 /end MEASUREMENT
/begin MEASUREMENT smg_old.flags "diverse Bits" UBYTE FORMULA_0003 0 0 0.0 255.0000 ECU_ADDRESS 0x3FC23A /end MEASUREMENT
/begin MEASUREMENT smg_old.flags_sa "Ausblendfreigabe" UBYTE FORMULA_0910 0 0 0.0 255.0 ECU_ADDRESS 0x3FC23A BIT_MASK 0x1 /end MEASUREMENT
/begin MEASUREMENT smg_old.flags_nl "NL ueber Rampe" UBYTE FORMULA_0911 0 0 0.0 255.0 ECU_ADDRESS 0x3FC23A BIT_MASK 0x8 /end MEASUREMENT
/begin MEASUREMENT smg_old.flags_anf "Anfahren aus Schalten" UBYTE FORMULA_0912 0 0 0.0 255.0 ECU_ADDRESS 0x3FC23A BIT_MASK 0x40 /end MEASUREMENT
/begin MEASUREMENT smg_old.schaltart "Schaltart - gesichert" UWORD FORMULA_0010 0 0 0.0 65535.0000 ECU_ADDRESS 0x3FC232 /end MEASUREMENT
/begin MEASUREMENT smg_old.modul "Modulstatus - gesichert" UBYTE FORMULA_0913 0 0 0.0 255.0 ECU_ADDRESS 0x3FC238 /end MEASUREMENT
/begin MEASUREMENT smg_fw_rel_virt "Virtueller Fahrerwunsch" UBYTE FORMULA_0704 0 0 0.0 1.9921 ECU_ADDRESS 0x3FC23C /end MEASUREMENT
/begin MEASUREMENT smg_md_fahrer_ab "Wunschmoment fuers Abregeln" SWORD FORMULA_0009 0 0 -100.0000 1000.0000 ECU_ADDRESS 0x3FC23E /end MEASUREMENT
/begin MEASUREMENT smg_md_fahrer_auf "Wunschmoment fuers Aufregeln" SWORD FORMULA_0009 0 0 -100.0000 1000.0000 ECU_ADDRESS 0x3FC240 /end MEASUREMENT
/begin MEASUREMENT smg_md_dsc_abs "Betrag der DSC-Anforderung" SWORD FORMULA_0009 0 0 -100.0000 1000.0000 ECU_ADDRESS 0x3FC242 /end MEASUREMENT
/begin MEASUREMENT smg_n_diff_getr "Differenz Getriebe - Motor" SWORD FORMULA_0006 0 0 0.0 10000.0000 ECU_ADDRESS 0x3FC244 /end MEASUREMENT
/begin MEASUREMENT smg_n_diff_ziel "Differenz Getriebeziel - Motor" SWORD FORMULA_0006 0 0 0.0 10000.0000 ECU_ADDRESS 0x3FC248 /end MEASUREMENT
/begin MEASUREMENT smg_dn_filter "gefilt. Drehzahlgradient" SWORD FORMULA_0114 0 0 -5000.0000 5000.0000 ECU_ADDRESS 0x3FC24C /end MEASUREMENT
/begin MEASUREMENT smg_schaltart_lw_cnt "Lastwechsel-Z�hler" UBYTE FORMULA_0003 0 0 0.0 255.0000 ECU_ADDRESS 0x3FC24E /end MEASUREMENT
/begin MEASUREMENT smg_ki_ab "Abregel-Kennung" UBYTE FORMULA_0003 0 0 0.0 255.0000 ECU_ADDRESS 0x3FC24F /end MEASUREMENT
/begin MEASUREMENT smg_ki_scha "Schalt-Kennung" UBYTE FORMULA_0003 0 0 0.0 255.0000 ECU_ADDRESS 0x3FC250 /end MEASUREMENT
/begin MEASUREMENT smg_ki_auf "Aufregel-Kennung" UBYTE FORMULA_0003 0 0 0.0 255.0000 ECU_ADDRESS 0x3FC251 /end MEASUREMENT
/begin MEASUREMENT smg_st_ekr "Status Einkuppelfreigabe" UBYTE FORMULA_0003 0 0 0.0 255.0000 ECU_ADDRESS 0x3FC252 /end MEASUREMENT
/begin MEASUREMENT smg_st_ekr_n "EKR-Sperre wg. n-Bezug" UBYTE FORMULA_0914 0 0 0.0 255.0 ECU_ADDRESS 0x3FC252 BIT_MASK 0x1 /end MEASUREMENT
/begin MEASUREMENT smg_st_ekr_n_max "EKR-Sperre wg. Nmax" UBYTE FORMULA_0915 0 0 0.0 255.0 ECU_ADDRESS 0x3FC252 BIT_MASK 0x2 /end MEASUREMENT
/begin MEASUREMENT smg_kschlupf_st "Kupplungsschlupf-Status" UBYTE FORMULA_0916 0 0 0.0 255.0 ECU_ADDRESS 0x3FC253 /end MEASUREMENT
/begin MEASUREMENT smg_kschlupf "Kupplungsschlupf" SWORD FORMULA_0917 0 0 -100.0000 100.0000 ECU_ADDRESS 0x3FC254 /end MEASUREMENT
/begin MEASUREMENT smg_radschlupf "Radschlupf" SWORD FORMULA_0917 0 0 -100.0000 100.0000 ECU_ADDRESS 0x3FC256 /end MEASUREMENT
/begin MEASUREMENT smg_prog_max_toel "Toel-Programmbegrenzung" UBYTE FORMULA_0279 0 0 1.0000 255.0000 ECU_ADDRESS 0x3FC258 /end MEASUREMENT
/begin MEASUREMENT smg_prog_max_sk "SK-Programmbegrenzung" UBYTE FORMULA_0279 0 0 1.0000 255.0000 ECU_ADDRESS 0x3FC259 /end MEASUREMENT
/begin MEASUREMENT smg_prog_min_berg "Programmanhebung am Berg" UBYTE FORMULA_0279 0 0 1.0000 255.0000 ECU_ADDRESS 0x3FC25A /end MEASUREMENT
/begin MEASUREMENT smg_prog_info_intern "internes Programm" UBYTE FORMULA_0279 0 0 1.0000 255.0000 ECU_ADDRESS 0x3FC25B /end MEASUREMENT
/begin MEASUREMENT smg_n_getr_ein "gerechnete Drehzahl am Getriebeeingang" SWORD FORMULA_0006 0 0 0.0 10000.0000 ECU_ADDRESS 0x3FC25C /end MEASUREMENT
/begin MEASUREMENT smg_n_getr_ziel "gerechnete Ziel-Drehzahl am Getriebeeingang" SWORD FORMULA_0006 0 0 0.0 10000.0000 ECU_ADDRESS 0x3FC25E /end MEASUREMENT
/begin MEASUREMENT smg_dn_getr_ein_fil "gefilt. Drehzahl am Getriebeeingang" SWORD FORMULA_0114 0 0 -10000.0000 10000.0000 ECU_ADDRESS 0x3FC260 /end MEASUREMENT
/begin MEASUREMENT smg_dn_mot_getr "Gradient Motor/Getriebe" SWORD FORMULA_0114 0 0 -10000.0000 10000.0000 ECU_ADDRESS 0x3FC262 /end MEASUREMENT
/begin MEASUREMENT smg_ay_zunahme "Zunahme ay" SWORD FORMULA_0132 0 0 -20.0000 20.0000 ECU_ADDRESS 0x3FC264 /end MEASUREMENT
/begin MEASUREMENT smg_kupp_modul "Kupplungs-Modul" UBYTE FORMULA_0918 0 0 0.0 255.0 ECU_ADDRESS 0x3FC266 /end MEASUREMENT
/begin MEASUREMENT smg_kupp_flags "Kupplung-Flags" UBYTE FORMULA_0003 0 0 0.0 255.0000 ECU_ADDRESS 0x3FC267 /end MEASUREMENT
/begin MEASUREMENT smg_kupp_flags_adapt "Adaptionssperre" UBYTE FORMULA_0919 0 0 0.0 255.0 ECU_ADDRESS 0x3FC267 BIT_MASK 0x2 /end MEASUREMENT
/begin MEASUREMENT smg_kupp_flags_abs "RAB mit ABS-Eingriff" UBYTE FORMULA_0920 0 0 0.0 255.0 ECU_ADDRESS 0x3FC267 BIT_MASK 0x4 /end MEASUREMENT
/begin MEASUREMENT smg_kupp_flags_ks "Kupplungsschutz" UBYTE FORMULA_0921 0 0 0.0 255.0 ECU_ADDRESS 0x3FC267 BIT_MASK 0x8 /end MEASUREMENT
/begin MEASUREMENT smg_kupp_flags_dn "Status dn-Soll" UBYTE FORMULA_0922 0 0 0.0 255.0 ECU_ADDRESS 0x3FC267 BIT_MASK 0x10 /end MEASUREMENT
/begin MEASUREMENT smg_kupp_flags_schw "Drehzahlschwinger beim Aufregeln" UBYTE FORMULA_0923 0 0 0.0 255.0 ECU_ADDRESS 0x3FC267 BIT_MASK 0x20 /end MEASUREMENT
/begin MEASUREMENT smg_kupp_flags_ekr "Begrenzung Ekr-Schwelle" UBYTE FORMULA_0924 0 0 0.0 255.0 ECU_ADDRESS 0x3FC267 BIT_MASK 0x40 /end MEASUREMENT
/begin MEASUREMENT smg_kupp_flags_anf "Schaltung nach Anfahren" UBYTE FORMULA_0925 0 0 0.0 255.0 ECU_ADDRESS 0x3FC267 BIT_MASK 0x80 /end MEASUREMENT
/begin MEASUREMENT smg_kupp_m_rel_fw "Kupplungssollmoment bzgl. Fahrerwunsch" UBYTE FORMULA_0926 0 0 0.0 199.2187 ECU_ADDRESS 0x3FC268 /end MEASUREMENT
/begin MEASUREMENT smg_kupp_m_voraus "Vorausschau Kupplungssollmoment" UBYTE FORMULA_0926 0 0 0.0 199.2187 ECU_ADDRESS 0x3FC269 /end MEASUREMENT
/begin MEASUREMENT smg_kupp_t_rest "Restzeit bis Kupplungsendmoment" UBYTE FORMULA_0317 0 0 0.0 2.5500 ECU_ADDRESS 0x3FC26A /end MEASUREMENT
/begin MEASUREMENT smg_kupp_m_soll_abs "absolutes Kupplungssollmoment" SWORD FORMULA_0009 0 0 -100.0000 1000.0000 ECU_ADDRESS 0x3FC26C /end MEASUREMENT
/begin MEASUREMENT smg_kupp_m_soll "relatives Kupplungssollmoment" UBYTE FORMULA_0927 0 0 0.0 99.6093 ECU_ADDRESS 0x3FC26E /end MEASUREMENT
/begin MEASUREMENT smg_kupp_m_ist_0 "Kupplungsmoment bei Abregelstart" UBYTE FORMULA_0927 0 0 0.0 99.6093 ECU_ADDRESS 0x3FC26F /end MEASUREMENT
/begin MEASUREMENT smg_kupp_m_20 "Kupplungssollmomente" UBYTE FORMULA_0927 0 0 0.0 99.6093 ECU_ADDRESS 0x3FC270 /end MEASUREMENT
/begin MEASUREMENT smg_kupp_m_40 "Kupplungssollmomente" UBYTE FORMULA_0927 0 0 0.0 99.6093 ECU_ADDRESS 0x3FC271 /end MEASUREMENT
/begin MEASUREMENT smg_kupp_m_60 "Kupplungssollmomente" UBYTE FORMULA_0927 0 0 0.0 99.6093 ECU_ADDRESS 0x3FC272 /end MEASUREMENT
/begin MEASUREMENT smg_kupp_m_80 "Kupplungssollmomente" UBYTE FORMULA_0927 0 0 0.0 99.6093 ECU_ADDRESS 0x3FC273 /end MEASUREMENT
/begin MEASUREMENT smg_kupp_m_end "Kupplungsendmoment" UBYTE FORMULA_0927 0 0 0.0 99.6093 ECU_ADDRESS 0x3FC274 /end MEASUREMENT
/begin MEASUREMENT smg_kupp_array "Arraykennung" UBYTE FORMULA_0003 0 0 0.0 255.0000 ECU_ADDRESS 0x3FC275 /end MEASUREMENT
/begin MEASUREMENT smg_kupp_dm_soll "Kupplungsgradient" SWORD FORMULA_0571 0 0 -5000.0000 5000.0000 ECU_ADDRESS 0x3FC276 /end MEASUREMENT
/begin MEASUREMENT smg_kupp_m_soll_regler "Kupplungsregler" SLONG FORMULA_0928 0 0 -200.0000 600.0000 ECU_ADDRESS 0x3FC278 /end MEASUREMENT
/begin MEASUREMENT smg_kupp_m_soll_rampe "Kupplungsrampe" ULONG FORMULA_0929 0 0 0.0 100.0000 ECU_ADDRESS 0x3FC27C /end MEASUREMENT
/begin MEASUREMENT smg_kupp_t_dn_null "Zeit mit konst. Drehzahl" UBYTE FORMULA_0317 0 0 0.0 2.5500 ECU_ADDRESS 0x3FC280 /end MEASUREMENT
/begin MEASUREMENT smg_kupp_m_off_ab "Offset auf Fahrerwunsch beim Abregeln" SWORD FORMULA_0009 0 0 -100.0000 1000.0000 ECU_ADDRESS 0x3FC282 /end MEASUREMENT
/begin MEASUREMENT smg_kupp_dn_soll_roh "Soll-Drehzahlgradient (Roh)" SWORD FORMULA_0114 0 0 -5000.0000 5000.0000 ECU_ADDRESS 0x3FC286 /end MEASUREMENT
/begin MEASUREMENT smg_kupp_dn_soll "Soll-Drehzahlgradient" SWORD FORMULA_0114 0 0 -5000.0000 5000.0000 ECU_ADDRESS 0x3FC288 /end MEASUREMENT
/begin MEASUREMENT smg_kupp_m_rab_start "Moment bei Ausloesung Radabriss" SWORD FORMULA_0009 0 0 -100.0000 1000.0000 ECU_ADDRESS 0x3FC28A /end MEASUREMENT
/begin MEASUREMENT smg_kupp_m_lw_start "Moment beim Lastwechsel" SWORD FORMULA_0009 0 0 -100.0000 1000.0000 ECU_ADDRESS 0x3FC28C /end MEASUREMENT
/begin MEASUREMENT smg_kupp_ul_fw_red "Reduktionsrampe bei Ueberlast" SWORD FORMULA_0009 0 0 -100.0000 1000.0000 ECU_ADDRESS 0x3FC28E /end MEASUREMENT
/begin MEASUREMENT smg_kupp_ul_st "Ueberlaststatus" UBYTE FORMULA_0930 0 0 0.0 255.0 ECU_ADDRESS 0x3FC290 /end MEASUREMENT
/begin MEASUREMENT smg_mot_modul "Motor-Modul" UBYTE FORMULA_0931 0 0 0.0 255.0 ECU_ADDRESS 0x3FC291 /end MEASUREMENT
/begin MEASUREMENT smg_mot_flags "Motor-Flags" UBYTE FORMULA_0003 0 0 0.0 255.0000 ECU_ADDRESS 0x3FC292 /end MEASUREMENT
/begin MEASUREMENT smg_mot_flags_nziel "Motor-Flags" UBYTE FORMULA_0932 0 0 0.0 255.0 ECU_ADDRESS 0x3FC292 BIT_MASK 0x1 /end MEASUREMENT
/begin MEASUREMENT smg_mot_flags_nll "Drehzahlniveau bzgl. nLL" UBYTE FORMULA_0933 0 0 0.0 255.0 ECU_ADDRESS 0x3FC292 BIT_MASK 0x2 /end MEASUREMENT
/begin MEASUREMENT smg_mot_flags_begr "Begrenzung auf FW" UBYTE FORMULA_0920 0 0 0.0 255.0 ECU_ADDRESS 0x3FC292 BIT_MASK 0x4 /end MEASUREMENT
/begin MEASUREMENT smg_mot_m_soll_rel "relatives Motorsollmoment" SWORD FORMULA_0909 0 0 -25600.0000 25599.2187 ECU_ADDRESS 0x3FC294 /end MEASUREMENT
/begin MEASUREMENT smg_mot_m_soll "Motorsollmoment" SWORD FORMULA_0009 0 0 -100.0000 1000.0000 ECU_ADDRESS 0x3FC296 /end MEASUREMENT
/begin MEASUREMENT smg_mot_m_soll_voraus "Motorsollmoment DK-Rohwert" SWORD FORMULA_0009 0 0 -100.0000 1000.0000 ECU_ADDRESS 0x3FC298 /end MEASUREMENT
/begin MEASUREMENT smg_mot_m_soll_tz "TZ-Motorsollmoment" SWORD FORMULA_0009 0 0 -100.0000 1000.0000 ECU_ADDRESS 0x3FC29A /end MEASUREMENT
/begin MEASUREMENT smg_mot_m_soll_dk "DK-Motorsollmoment" SWORD FORMULA_0009 0 0 -100.0000 1000.0000 ECU_ADDRESS 0x3FC29C /end MEASUREMENT
/begin MEASUREMENT smg_mot_m_res "Momentenreserve" SWORD FORMULA_0009 0 0 -100.0000 1000.0000 ECU_ADDRESS 0x3FC29E /end MEASUREMENT
/begin MEASUREMENT smg_mot_m_res_time "Timer Momentenreserve" UWORD FORMULA_0117 0 0 0.0 325.0000 ECU_ADDRESS 0x3FC2A0 /end MEASUREMENT
/begin MEASUREMENT smg_mot_m_soll_pA "P-Anteil Drehzahlregler" SLONG FORMULA_0934 0 0 -200.0000 600.0000 ECU_ADDRESS 0x3FC2A4 /end MEASUREMENT
/begin MEASUREMENT smg_mot_m_soll_iA "I-Anteil Drehzahlregler" SLONG FORMULA_0929 0 0 -200.0000 600.0000 ECU_ADDRESS 0x3FC2A8 /end MEASUREMENT
/begin MEASUREMENT smg_mot_m_soll_iA_2 "I-Anteil Gradientenregler" SLONG FORMULA_0928 0 0 -200.0000 600.0000 ECU_ADDRESS 0x3FC2AC /end MEASUREMENT
/begin MEASUREMENT smg_mot_m_soll_dA "D-Anteil Drehzahlregler" SLONG FORMULA_0934 0 0 -200.0000 600.0000 ECU_ADDRESS 0x3FC2B0 /end MEASUREMENT
/begin MEASUREMENT smg_mot_n_soll "Solldrehzahl" SWORD FORMULA_0006 0 0 0.0 10000.0000 ECU_ADDRESS 0x3FC2B4 /end MEASUREMENT
/begin MEASUREMENT smg_mot_n_ekr_schw "EKR-Schwelle" SWORD FORMULA_0006 0 0 0.0 10000.0000 ECU_ADDRESS 0x3FC2B6 /end MEASUREMENT
/begin MEASUREMENT smg_mot_n_offset "Offset auf Zieldrehzahl" SWORD FORMULA_0006 0 0 -3000.0000 3000.0000 ECU_ADDRESS 0x3FC2B8 /end MEASUREMENT
/begin MEASUREMENT smg_mot_n_reg_st "Status Drehzahlreglers" UBYTE FORMULA_0935 0 0 0.0 255.0 ECU_ADDRESS 0x3FC2BA /end MEASUREMENT
/begin MEASUREMENT smg_mot_n_ziel_off "Faktor fuer Schubzieldrehzahl" UBYTE FORMULA_0936 0 0 0.0 199.2187 ECU_ADDRESS 0x3FC2BB /end MEASUREMENT
/begin MEASUREMENT smg_mot_m_soll_vor_1 "Rampe auf Fahrerwunsch" SWORD FORMULA_0009 0 0 -100.0000 1000.0000 ECU_ADDRESS 0x3FC2BC /end MEASUREMENT
/begin MEASUREMENT smg_mot_m_soll_vor_2 "Anteil aus Gradient und Traegheit" SWORD FORMULA_0009 0 0 -100.0000 1000.0000 ECU_ADDRESS 0x3FC2BE /end MEASUREMENT
/begin MEASUREMENT smg_mot_m_soll_regler "Regleranteil" SWORD FORMULA_0009 0 0 -100.0000 1000.0000 ECU_ADDRESS 0x3FC2C0 /end MEASUREMENT
/begin MEASUREMENT smg_mot_tz_nachlauf "TZ-Nachlaufzeit" UWORD FORMULA_0117 0 0 0.0 325.0000 ECU_ADDRESS 0x3FC2C2 /end MEASUREMENT
/begin MEASUREMENT smg_mot_dm_soll "Soll-Gradient fuer TZ-Nachlauf" SWORD FORMULA_0571 0 0 -5000.0000 5000.0000 ECU_ADDRESS 0x3FC2C4 /end MEASUREMENT
/begin MEASUREMENT smg_mot_m_begr_min "min. Motorsollmoment" SWORD FORMULA_0009 0 0 -100.0000 1000.0000 ECU_ADDRESS 0x3FC2C6 /end MEASUREMENT
/begin MEASUREMENT smg_mot_m_begr_max "max. Motorsollmoment" SWORD FORMULA_0009 0 0 -100.0000 1000.0000 ECU_ADDRESS 0x3FC2C8 /end MEASUREMENT
/begin MEASUREMENT smg_mot_m_soll_stg "Stoergroessenaufschaltung" SWORD FORMULA_0009 0 0 -100.0000 1000.0000 ECU_ADDRESS 0x3FC2CA /end MEASUREMENT
/begin MEASUREMENT smg_mot_t_regler "Regler-Zeit" UWORD FORMULA_0117 0 0 0.0 325.0000 ECU_ADDRESS 0x3FC2CC /end MEASUREMENT
/begin MEASUREMENT smg_mot_m_res_pos "min. pos. Momentenreserve" SWORD FORMULA_0009 0 0 -100.0000 1000.0000 ECU_ADDRESS 0x3FC2CE /end MEASUREMENT
/begin MEASUREMENT smg_t_aktuell "aktuelle Zeit der jeweiligen Schaltphase" UWORD FORMULA_0021 0 0 0.0 655.0000 ECU_ADDRESS 0x3FC2D0 /end MEASUREMENT
/begin MEASUREMENT smg_t_aktuell_korr "korr. Zeit" UWORD FORMULA_0937 0 0 0.0 10000.0000 ECU_ADDRESS 0x3FC2D2 /end MEASUREMENT
/begin MEASUREMENT smg_bw_null "Bewertung Nulldurchgang" UBYTE FORMULA_0003 0 0 0.0 255.0000 ECU_ADDRESS 0x3FC2D4 /end MEASUREMENT
/begin MEASUREMENT smg_abbruch_grund "Grund fuer Schaltabbruch" UBYTE FORMULA_0938 0 0 0.0 255.0 ECU_ADDRESS 0x3FC2D5 /end MEASUREMENT
/begin MEASUREMENT smg_abbruch_ges "Grund fuer Schaltabbruch - Summe" UBYTE FORMULA_0938 0 0 0.0 255.0 ECU_ADDRESS 0x3FC2D6 /end MEASUREMENT
/begin MEASUREMENT smg_mot_j_motor "Faktor fuer Vorst 2" UBYTE FORMULA_0939 0 0 0.0 1.9921 ECU_ADDRESS 0x3FC2D7 /end MEASUREMENT
/begin MEASUREMENT smg_md_kw_ga "Motor-Moment am Getriebeausgang" SWORD FORMULA_0940 0 0 -1000.0000 4000.0000 ECU_ADDRESS 0x3FC2D8 /end MEASUREMENT
/begin MEASUREMENT smg_m_kupp_ist_ga "Kupplungs-Moment am Getriebeausgang" SWORD FORMULA_0940 0 0 -1000.0000 4000.0000 ECU_ADDRESS 0x3FC2DA /end MEASUREMENT
/begin MEASUREMENT smg_ax_filter "ax gefilter mit Vorzeichen" SWORD FORMULA_0132 0 0 -20.0000 20.0000 ECU_ADDRESS 0x3FC2DC /end MEASUREMENT
/begin MEASUREMENT smg_n_abriss "Abrissdrehzahl" SWORD FORMULA_0006 0 0 0.0 10000.0000 ECU_ADDRESS 0x3FC2DE /end MEASUREMENT
/begin MEASUREMENT smg_n_abriss_schw "Abriss-Schwelle" SWORD FORMULA_0006 0 0 0.0 10000.0000 ECU_ADDRESS 0x3FC2E0 /end MEASUREMENT
/begin MEASUREMENT smg_ki_auf_t_eingr "Zeitzaehler fuer DSC beim Aufregeln" UWORD FORMULA_0021 0 0 0.0 655.0000 ECU_ADDRESS 0x3FC2E2 /end MEASUREMENT
/begin MEASUREMENT smg_sk_t_phase "abs. Dauer einer Schaltphase" UWORD FORMULA_0021 0 0 0.0 655.0000 ECU_ADDRESS 0x3FC2E4 /end MEASUREMENT
/begin MEASUREMENT smg_sk_flags "SK-Fehler" UWORD FORMULA_0941 0 0 0.0 65535.0 ECU_ADDRESS 0x3FC2E6 /end MEASUREMENT
/begin MEASUREMENT smg_sk_t_dme_st "Ueberwachung DME-Status" UBYTE FORMULA_0317 0 0 0.0 2.5500 ECU_ADDRESS 0x3FC2E8 /end MEASUREMENT
/begin MEASUREMENT smg_sk_t_kupp "Ueberwachung Kupplung" UBYTE FORMULA_0317 0 0 0.0 2.5500 ECU_ADDRESS 0x3FC2E9 /end MEASUREMENT
/begin MEASUREMENT smg_sk_t_ngetr "Ueberwachung nGetr" UBYTE FORMULA_0317 0 0 0.0 2.5500 ECU_ADDRESS 0x3FC2EA /end MEASUREMENT
/begin MEASUREMENT smg_sk_t_nziel "Ueberwachung nZiel" UBYTE FORMULA_0317 0 0 0.0 2.5500 ECU_ADDRESS 0x3FC2EB /end MEASUREMENT
/begin MEASUREMENT smg_sk_t_nberech "Ueberwachung nBerech" UBYTE FORMULA_0317 0 0 0.0 2.5500 ECU_ADDRESS 0x3FC2EC /end MEASUREMENT
/begin MEASUREMENT smg_sk_t_ngetr_max "Ueberwachung max. nGetr" UBYTE FORMULA_0317 0 0 0.0 2.5500 ECU_ADDRESS 0x3FC2ED /end MEASUREMENT
/begin MEASUREMENT smg_sk_t_nziel_max "Ueberwachung max. nZiel" UBYTE FORMULA_0317 0 0 0.0 2.5500 ECU_ADDRESS 0x3FC2EE /end MEASUREMENT
/begin MEASUREMENT smg_sk_t_ngetr_plau "Ueberwachung nGetr" UBYTE FORMULA_0317 0 0 0.0 2.5500 ECU_ADDRESS 0x3FC2EF /end MEASUREMENT
/begin MEASUREMENT smg_sk_t_nziel_plau "Ueberwachung nZiel" UBYTE FORMULA_0317 0 0 0.0 2.5500 ECU_ADDRESS 0x3FC2F0 /end MEASUREMENT
/begin MEASUREMENT smg_adapt_ihar_sum "Summenzaehler" ULONG FORMULA_0000 0 0 0.0 4294967295.0000 ECU_ADDRESS 0x3FC2F4 /end MEASUREMENT
/begin MEASUREMENT smg_adapt_ihar_cnt "Counter" UBYTE FORMULA_0003 0 0 0.0 255.0000 ECU_ADDRESS 0x3FC2F8 /end MEASUREMENT
/* ------------------ Abschnitt erzeugt aus smg_can.dat ------------------ */
/begin CHARACTERISTIC K_SMG_CAN_ED_TSPERR "max. Zeit f�r CAN-Chksum | EN: Maximum time for CAN checksum" VALUE 0x792E6 TKW_VV_VV_UW 100.0 FORMULA_0117 0.0 325.0000 FORMAT "%5.2" /end CHARACTERISTIC
/begin CHARACTERISTIC K_SMG_CAN_ED_UB_MIN "min. Ub fuer CAN-Diagnose | EN: Minimum battery voltage for CAN diagnosis" VALUE 0x792E8 TKW_VV_VV_SW 100.0 FORMULA_0008 0.0 28.0000 FORMAT "%4.1" /end CHARACTERISTIC
/begin CHARACTERISTIC K_SMG_ALIVE_ERR_MAX "max. Zeit f�r CAN-Alive | EN: Maximum time for CAN alive signal" VALUE 0x792EA TKW_VV_VV_UB 100.0 FORMULA_0003 0.0 255.0000 /end CHARACTERISTIC
/begin CHARACTERISTIC K_SMG_CHKSUM_ERR_MAX "max. Zeit f�r CAN-Chksum | EN: Maximum time for CAN checksum" VALUE 0x792EB TKW_VV_VV_UB 100.0 FORMULA_0003 0.0 255.0000 /end CHARACTERISTIC
/begin CHARACTERISTIC K_SMG_V_KRAFTS_ERSATZ "v-Schwelle fuer Kraftschlussersatzwert | EN: Speed threshold for drivetrain-engagement substitute value" VALUE 0x792EC TKW_VV_VV_UB 100.0 FORMULA_0968 0.0 15.9375 /end CHARACTERISTIC
/begin CHARACTERISTIC K_SMG_CAN_TESTMODE "Vorgabe Testmode | EN: Test mode setting" VALUE 0x792ED TKW_VV_VV_UB 100.0 FORMULA_0969 0.0 255.0 /end CHARACTERISTIC
/begin CHARACTERISTIC K_SMG_CAN_KL87_TMAX "KL87-Timeout | EN: Terminal 87 timeout" VALUE 0x792EE TKW_VV_VV_UW 100.0 FORMULA_0073 0.0 6553.5000 FORMAT "%4.1" /end CHARACTERISTIC
/begin CHARACTERISTIC K_SMG_TAU_NGETR_ZIEL "Filter Getriebezieldrehzahl | EN: Filter, gearbox target speed" VALUE 0x792F0 TKW_VV_VV_UB 100.0 FORMULA_0478 0.0051 1.2800 /end CHARACTERISTIC
/begin MEASUREMENT smg_can_alive_smg1 "Alive SMG1" UBYTE FORMULA_0003 0 0 0.0 255.0000 ECU_ADDRESS 0x3FC2FF /end MEASUREMENT
/begin MEASUREMENT smg_can_alive_smg2 "Alive SMG2" UBYTE FORMULA_0003 0 0 0.0 255.0000 ECU_ADDRESS 0x3FC300 /end MEASUREMENT
/begin MEASUREMENT smg_can_alive_smg3 "Alive SMG3" UBYTE FORMULA_0003 0 0 0.0 255.0000 ECU_ADDRESS 0x3FC301 /end MEASUREMENT
/begin MEASUREMENT smg_can_ed_tsperr "Diagnosesperrzeit" UWORD FORMULA_0117 0 0 0.0 325.0000 ECU_ADDRESS 0x3FC302 /end MEASUREMENT
/begin MEASUREMENT smg_can_empf_st "Empfangsstatus" UBYTE FORMULA_0963 0 0 0.0 255.0 ECU_ADDRESS 0x3FC304 /end MEASUREMENT
/begin MEASUREMENT smg_can_empf_st_hys "Empfangsstatus im SG-Zyklus" UBYTE FORMULA_0963 0 0 0.0 255.0 ECU_ADDRESS 0x3FC305 /end MEASUREMENT
/begin MEASUREMENT smg_can_st_smg "Empfangsstatus SMG" UWORD FORMULA_0125 0 0 0.0 65535.0 ECU_ADDRESS 0x3FC306 /end MEASUREMENT
/begin MEASUREMENT smg_can_st_smg1 "Empfangsstatus SMG1" UWORD FORMULA_0125 0 0 0.0 65535.0 ECU_ADDRESS 0x3FC308 /end MEASUREMENT
/begin MEASUREMENT smg_can_st_smg2 "Empfangsstatus SMG2" UWORD FORMULA_0125 0 0 0.0 65535.0 ECU_ADDRESS 0x3FC30A /end MEASUREMENT
/begin MEASUREMENT smg_can_st_smg3 "Empfangsstatus SMG3" UWORD FORMULA_0125 0 0 0.0 65535.0 ECU_ADDRESS 0x3FC30C /end MEASUREMENT
/begin MEASUREMENT smg_can_alive_smg1_cnt "Fehler Alivecounter" UBYTE FORMULA_0003 0 0 0.0 255.0000 ECU_ADDRESS 0x3FC30E /end MEASUREMENT
/begin MEASUREMENT smg_can_chksum_smg1_cnt "Fehler Chksum" UBYTE FORMULA_0003 0 0 0.0 255.0000 ECU_ADDRESS 0x3FC30F /end MEASUREMENT
/begin MEASUREMENT smg_can_alive_smg2_cnt "Fehler Alivecounter" UBYTE FORMULA_0003 0 0 0.0 255.0000 ECU_ADDRESS 0x3FC310 /end MEASUREMENT
/begin MEASUREMENT smg_can_chksum_smg2_cnt "Fehler Chksum" UBYTE FORMULA_0003 0 0 0.0 255.0000 ECU_ADDRESS 0x3FC311 /end MEASUREMENT
/begin MEASUREMENT smg_can_alive_smg3_cnt "Fehler Alivecounter" UBYTE FORMULA_0003 0 0 0.0 255.0000 ECU_ADDRESS 0x3FC312 /end MEASUREMENT
/begin MEASUREMENT smg_can_chksum_smg3_cnt "Fehler Chksum" UBYTE FORMULA_0003 0 0 0.0 255.0000 ECU_ADDRESS 0x3FC313 /end MEASUREMENT
/begin MEASUREMENT smg_can_schalter "CAN-Schalter" UBYTE FORMULA_0003 0 0 0.0 255.0000 ECU_ADDRESS 0x3FC314 /end MEASUREMENT
/begin MEASUREMENT smg_can_s_schalt "Schaltwunsch" UBYTE FORMULA_0964 0 0 0.0 255.0 ECU_ADDRESS 0x3FC314 BIT_MASK 0x1 /end MEASUREMENT
/begin MEASUREMENT smg_can_s_krafts "Kraftschlusstatus" UBYTE FORMULA_0965 0 0 0.0 255.0 ECU_ADDRESS 0x3FC314 BIT_MASK 0x2 /end MEASUREMENT
/begin MEASUREMENT smg_can_s_fgr "FGR-Schalter" UBYTE FORMULA_0966 0 0 0.0 255.0 ECU_ADDRESS 0x3FC314 BIT_MASK 0x4 /end MEASUREMENT
/begin MEASUREMENT smg_can_s_he "HE-Schalter" UBYTE FORMULA_0967 0 0 0.0 255.0 ECU_ADDRESS 0x3FC314 BIT_MASK 0x8 /end MEASUREMENT
/begin MEASUREMENT smg_can_n_getr_ziel_roh "Zieldrehzahl ungefiltert" SWORD FORMULA_0006 0 0 0.0 10000.0000 ECU_ADDRESS 0x3FC316 /end MEASUREMENT
/begin MEASUREMENT smg_can_n_anfahr "Anfahrdrehzahl" SWORD FORMULA_0006 0 0 0.0 10000.0000 ECU_ADDRESS 0x3FC318 /end MEASUREMENT
/begin MEASUREMENT smg_can_t_rest_se "Restzeit bis Synchro-Ende" UBYTE FORMULA_0317 0 0 0.0 2.5500 ECU_ADDRESS 0x3FC31A /end MEASUREMENT
/begin MEASUREMENT smg_can_t_rest_ekr "Restzeit bis Start Einkuppelrampe" UBYTE FORMULA_0317 0 0 0.0 2.5500 ECU_ADDRESS 0x3FC31B /end MEASUREMENT
/begin MEASUREMENT smg_can_istgang "Istgang" SBYTE FORMULA_0318 0 0 -1.0000 10.0000 ECU_ADDRESS 0x3FC31C /end MEASUREMENT
/begin MEASUREMENT smg_can_zielgang "Zielgang" SBYTE FORMULA_0318 0 0 -1.0000 10.0000 ECU_ADDRESS 0x3FC31D /end MEASUREMENT
/begin MEASUREMENT smg_can_kupp_st "Kupplungsstatus" UBYTE FORMULA_0424 0 0 0.0 255.0 ECU_ADDRESS 0x3FC31E /end MEASUREMENT
/begin MEASUREMENT smg_can_getr_st "Getriebestatus" UBYTE FORMULA_0425 0 0 0.0 255.0 ECU_ADDRESS 0x3FC31F /end MEASUREMENT
/begin MEASUREMENT smg_can_m_kupp_max "Kupplungsmaximalmoment" SWORD FORMULA_0009 0 0 -100.0000 1000.0000 ECU_ADDRESS 0x3FC320 /end MEASUREMENT
/begin MEASUREMENT smg_can_m_kupp_ist "Kupplungsistmoment" UBYTE FORMULA_0927 0 0 0.0 99.6093 ECU_ADDRESS 0x3FC322 /end MEASUREMENT
/begin MEASUREMENT smg_can_m_kupp_ist_abs "absolutes Kupplungsmoment" SWORD FORMULA_0009 0 0 -100.0000 1000.0000 ECU_ADDRESS 0x3FC324 /end MEASUREMENT
/begin MEASUREMENT smg_can_ax_mess "AX gemessen" SWORD FORMULA_0132 0 0 -20.0000 20.0000 ECU_ADDRESS 0x3FC326 /end MEASUREMENT
/begin MEASUREMENT smg_can_v_diff "Achsdifferenz" SBYTE FORMULA_0968 0 0 -7.9000 7.9000 ECU_ADDRESS 0x3FC328 /end MEASUREMENT
/begin MEASUREMENT smg_can_pos_kupp_ist "Kupplungsposition" UBYTE FORMULA_0423 0 0 0.0 1020.0000 ECU_ADDRESS 0x3FC329 /end MEASUREMENT
/begin MEASUREMENT smg_can_testmode "Vorgabe Testmode" UBYTE FORMULA_0969 0 0 0.0 255.0 ECU_ADDRESS 0x3FC32A /end MEASUREMENT
/begin MEASUREMENT smg_can_r_testmode "Rueckgabe Testmode" UBYTE FORMULA_0969 0 0 0.0 255.0 ECU_ADDRESS 0x3FC32B /end MEASUREMENT
/* ------------------ Abschnitt erzeugt aus smg_e2.dat ------------------ */
/begin CHARACTERISTIC K_SMG_E2_ST_ERR_MAX "max. Fehler fuer Statusvergleich | EN: max. Fehler fuer Statusvergleich" VALUE 0x7A9A8 TKW_VV_VV_UB 100.0 FORMULA_0003 0.0 12.0000 /end CHARACTERISTIC
/begin CHARACTERISTIC K_SMG_MOT_NL_T_MAX_E2 "max. TZ-Nachlaufzeit Ebene 2 | EN: max. TZ-Nachlaufzeit Ebene 2" VALUE 0x7A9AA TKW_VV_VV_UW 100.0 FORMULA_0117 0.0 325.0000 FORMAT "%5.2" /end CHARACTERISTIC
/begin CHARACTERISTIC K_SMG_NGETR_MAX_E2 "max. Getriebedrehzahl Ebene 2 | EN: max. Getriebedrehzahl Ebene 2" VALUE 0x7A9AC TKW_VV_VV_SW 100.0 FORMULA_0006 0.0 20000.0000 /end CHARACTERISTIC
/begin CHARACTERISTIC K_SMG_NGETR_DIFF_E2 "max. Differenz MotGetr Ebene 2 | EN: Unidentified constant read directly by IGN 0x11b18c (chapter unknown)" VALUE 0x7A9AE TKW_VV_VV_SW 100.0 FORMULA_0006 0.0 10000.0000 /end CHARACTERISTIC
/begin MEASUREMENT smg_e2_fehler "Fehlerstatus Ebene 2" UBYTE FORMULA_0970 0 0 0.0 255.0 ECU_ADDRESS 0x3FC826 /end MEASUREMENT
/begin MEASUREMENT smg_st_dme_e2 "DME-Status Ebene 2" UBYTE FORMULA_0971 0 0 0.0 255.0 ECU_ADDRESS 0x3FC827 /end MEASUREMENT
/begin MEASUREMENT smg_st_mot_e2 "SMG-Motoreingriff Ebene 2" UBYTE FORMULA_0283 0 0 0.0 255.0 ECU_ADDRESS 0x3FC828 BIT_MASK 0xF /end MEASUREMENT
/begin MEASUREMENT smg_st_dme_e2_err "Anzahl der Vergleichs-Fehler" UBYTE FORMULA_0003 0 0 0.0 255.0000 ECU_ADDRESS 0x3FC829 /end MEASUREMENT
/begin MEASUREMENT smg_st_mot_e2_err "Anzahl der Vergleichs-Fehler" UBYTE FORMULA_0003 0 0 0.0 255.0000 ECU_ADDRESS 0x3FC82A /end MEASUREMENT
/begin MEASUREMENT smg_ngetr_e2_err "Anzahl der Vergleichs-Fehler" UBYTE FORMULA_0003 0 0 0.0 255.0000 ECU_ADDRESS 0x3FC82B /end MEASUREMENT
/begin MEASUREMENT smg_gang_e2_err "Anzahl der Vergleichs-Fehler" UBYTE FORMULA_0003 0 0 0.0 255.0000 ECU_ADDRESS 0x3FC82C /end MEASUREMENT
/begin MEASUREMENT smg_flags_e2 "diverse Flags Ebene 2" UBYTE FORMULA_0003 0 0 0.0 255.0000 ECU_ADDRESS 0x3FC82D /end MEASUREMENT
/begin MEASUREMENT smg_flags_e2.zs "ZugSchubschaltung" UBYTE FORMULA_0972 0 0 0.0 255.0 ECU_ADDRESS 0x3FC82D BIT_MASK 0x1 /end MEASUREMENT
/begin MEASUREMENT smg_flags_e2.ekr "EKR-Freigabe" UBYTE FORMULA_0973 0 0 0.0 255.0 ECU_ADDRESS 0x3FC82D BIT_MASK 0x2 /end MEASUREMENT
/begin MEASUREMENT smg_mot_tz_nachl_e2 "Zeit TZ-Nachlauf Ebene 2" UWORD FORMULA_0117 0 0 0.0 325.0000 ECU_ADDRESS 0x3FC82E /end MEASUREMENT
/* ------------------ Abschnitt erzeugt aus start_rl.dat ------------------ */
/begin CHARACTERISTIC K_START_RL_BEGINN "Maximale Motordrehzahl beim Anlassbeginn | EN: Maximale Motordrehzahl beim Anlassbeginn" VALUE 0x792F2 TKW_VV_VV_SW 100.0 FORMULA_0006 0.0 10000.0000 /end CHARACTERISTIC
/begin MEASUREMENT start_rl_st "Status der Startrelaisansteuerung" UBYTE FORMULA_0974 0 0 0.0 255.0 ECU_ADDRESS 0x3FC332 BIT_MASK 0x3 /end MEASUREMENT
/begin MEASUREMENT start_rl_exd_timeout "KWP-Ansteuerzeit" UBYTE FORMULA_0501 0 0 0.0 25.5000 ECU_ADDRESS 0x3FC333 /end MEASUREMENT
/begin MEASUREMENT start_rl_exd_beginn "Beginn der externen Ansteuerung" UWORD FORMULA_0010 0 0 0.0 65535.0000 ECU_ADDRESS 0x3FC334 /end MEASUREMENT
/* ------------------ Abschnitt erzeugt aus tdme.dat ------------------ */
/begin CHARACTERISTIC K_TDME_DIAG_MIN "Unter Grenze Steuergeraetetemperatur | EN: Lower limit, ECU temperature" VALUE 0x7961A TKW_VV_VV_SW 100.0 FORMULA_0987 -50.0000 170.0000 FORMAT "%6.3" /end CHARACTERISTIC
/begin CHARACTERISTIC K_TDME_DIAG_MAX "Obere Grenze Steuergeraetetemperatur | EN: Upper limit, ECU temperature" VALUE 0x7961C TKW_VV_VV_SW 100.0 FORMULA_0987 -50.0000 170.0000 FORMAT "%6.3" /end CHARACTERISTIC
/begin CHARACTERISTIC K_TDME_SCHWELLE_ZAEHLER "Schwelle fuer Langzeitueberwachung | EN: Threshold for long-term monitoring" VALUE 0x7961E TKW_VV_VV_SW 100.0 FORMULA_0023 -50.0000 170.0000 FORMAT "%4.1" /end CHARACTERISTIC
/begin CHARACTERISTIC K_TDME_TAU "Filterkonstante fuer die Steuergeraetetemperatur | EN: Filter constant for ECU temperature" VALUE 0x79620 TKW_VV_VV_UB 100.0 FORMULA_0679 0.1004 25.6000 /end CHARACTERISTIC
/begin CHARACTERISTIC KL_TDME_NTC "Kennlinie Steuergeraetetemperatur | EN: ECU temperature curve" CURVE 0x79622 TKL_SW_VV_SW 100.0 FORMULA_0987 -50.0000 170.0000 /begin AXIS_DESCR STD_AXIS tdme_ad FORMULA_0123 8 0.0 1023.0000 /end AXIS_DESCR FORMAT "%6.3" /end CHARACTERISTIC
/begin MEASUREMENT tdme_ad "Eingelesener Spannungswert fuer Steuergeraetetemperatur" SWORD FORMULA_0123 0 0 0.0 1023.0000 ECU_ADDRESS 0x3FC3EC /end MEASUREMENT
/begin MEASUREMENT tdme_roh "Ungefilterter Messwert der Steuergeraetetemperatur" SWORD FORMULA_0987 0 0 -50.0000 170.0000 ECU_ADDRESS 0x3FC3EE /end MEASUREMENT
/begin MEASUREMENT tdme_filter "Gefilterter Messwert der Steuergeraetetemperatur" SWORD FORMULA_0987 0 0 -50.0000 170.0000 ECU_ADDRESS 0x3FC3F0 /end MEASUREMENT
/* ------------------ Abschnitt erzeugt aus tsgrw.dat ------------------ */
/begin CHARACTERISTIC K_TSGRW_TU "Tuning Saugrohrwandtemperatur | EN: Tuning of intake-manifold wall temperature" VALUE 0x79B44 TKW_VV_VV_SW 100.0 FORMULA_1028 -50.0000 170.0000 FORMAT "%4.1" /end CHARACTERISTIC
/begin CHARACTERISTIC K_TSGRW_CFG "Schalter welches TSGRW | EN: Switch selecting intake-manifold wall temperature source" VALUE 0x79B46 TKW_VV_VV_UB 100.0 FORMULA_1029 0.0 255.0 BIT_MASK 0x1 /end CHARACTERISTIC
/begin CHARACTERISTIC K_TSGRW_TAU "Filterkonstante fuer die Saugrohrwandtemperatur | EN: Filter constant for intake-manifold wall temperature" VALUE 0x79B47 TKW_VV_VV_UB 100.0 FORMULA_0679 0.1004 25.6000 /end CHARACTERISTIC
/begin CHARACTERISTIC K_TSGRW_TAU_MS "Filterkonstante fuer die Saugrohrwandtemperatur bei stehendem Motor | EN: Filter constant for intake-manifold wall temperature with engine stopped" VALUE 0x79B48 TKW_VV_VV_UB 100.0 FORMULA_0679 0.1004 25.6000 /end CHARACTERISTIC
/begin CHARACTERISTIC KL_TSGRW_OFFS "Kennlinie Offset | EN: Offset curve" CURVE 0x79B4A TKL_SW_VV_SW 100.0 FORMULA_1030 -800.0000 800.0000 /begin AXIS_DESCR STD_AXIS rf FORMULA_0007 5 0.0 2.0000 FORMAT "%6.3" /end AXIS_DESCR FORMAT "%6.3" /end CHARACTERISTIC
/begin CHARACTERISTIC KL_TSGRW_F "Verhaeltnisfaktor | EN: Ratio factor" CURVE 0x79B60 TKL_SW_VV_UW 100.0 FORMULA_0024 0.0 1.9999
 /begin AXIS_DESCR STD_AXIS tmot FORMULA_0023 4 -50.0000 170.0000 FORMAT "%4.1" /end AXIS_DESCR
 FORMAT "%7.4" /end CHARACTERISTIC
/begin MEASUREMENT tsgrw_roh_b1 "Ungefilterte Saugrohrwandtemperatur" SWORD FORMULA_0987 0 0 -50.0000 170.0000 ECU_ADDRESS 0x3FC4BA /end MEASUREMENT
/begin MEASUREMENT tsgrw_roh_b2 "Ungefilterte Saugrohrwandtemperatur" SWORD FORMULA_0987 0 0 -50.0000 170.0000 ECU_ADDRESS 0x3FC4BC /end MEASUREMENT
/begin MEASUREMENT tsgrw_filter_b1 "Gefilterte Saugrohrwandtemperatur" SWORD FORMULA_0987 0 0 -50.0000 170.0000 ECU_ADDRESS 0x3FC4BE /end MEASUREMENT
/begin MEASUREMENT tsgrw_filter_b2 "Gefilterte Saugrohrwandtemperatur" SWORD FORMULA_0987 0 0 -50.0000 170.0000 ECU_ADDRESS 0x3FC4C0 /end MEASUREMENT
/begin FUNCTION SMG ""
 /begin DEF_CHARACTERISTIC KF_SMG_BW_NULL KF_SMG_KI_AB_K KF_SMG_KI_AB_S KF_SMG_KI_AB_SCH_K KF_SMG_KI_AB_SCH_S KF_SMG_KI_AUF_K KF_SMG_KI_AUF_S KF_SMG_KI_AUF_SCH_K KF_SMG_KI_AUF_SCH_S KF_SMG_KI_SCHA_K KF_SMG_KI_SCHA_S KF_SMG_KI_SCHA_SCH_K KF_SMG_KI_SCHA_SCH_S KF_SMG_KUPP_LW_RAMPE KF_SMG_KUPP_REG_I_SCH KF_SMG_KUPP_REG_I_ZUG KF_SMG_MOT_ANF_M_RAMPE_1R KF_SMG_MOT_ANF_M_RAMPE_2 KF_SMG_MOT_N_REG_M_MAX KF_SMG_MOT_N_REG_P_KO KF_SMG_N_ZIEL_OFF_K KF_SMG_N_ZIEL_OFF_S KF_SMG_T_ABREGEL KF_SMG_T_AUFREGEL KL_SMG_FW_REL_VIRT KL_SMG_KI_AKS_GANG KL_SMG_KI_DAY_MAX KL_SMG_KUPP_M_AB_ANF KL_SMG_KUPP_M_AB_OFF KL_SMG_KUPP_M_AB_SH KL_SMG_KUPP_M_AB_SR KL_SMG_KUPP_M_AB_ZH KL_SMG_KUPP_M_AB_ZR KL_SMG_KUPP_M_AUF_KI KL_SMG_KUPP_M_AUF_OFF KL_SMG_KUPP_M_AUF_S1 KL_SMG_KUPP_M_AUF_Z1 KL_SMG_KUPP_REG_I_F KL_SMG_KUPP_UL_DN_POS KL_SMG_MOT_DN_REG_P KL_SMG_MOT_DN_SOLL KL_SMG_MOT_J_MOTOR KL_SMG_MOT_M_AB_SH KL_SMG_MOT_M_AB_SR KL_SMG_MOT_M_AB_ZH KL_SMG_MOT_M_AB_ZR KL_SMG_MOT_M_RES_AUF KL_SMG_MOT_M_VOR_AUF KL_SMG_MOT_N_REG_D_DN KL_SMG_MOT_N_REG_D_UP KL_SMG_MOT_N_REG_M_LW KL_SMG_MOT_N_REG_P_DN KL_SMG_MOT_N_REG_P_UP KL_SMG_MOT_N_REG_SA_DIFF KL_SMG_MOT_VOR_2_KI KL_SMG_N_ABRISS_SCHW KL_SMG_N_ZIEL_OFF_ANF KL_SMG_N_ZIEL_OFF_LL KL_SMG_N_ZIEL_OFF_MAX KL_SMG_N_ZIEL_OFF_RAB KL_SMG_N_ZIEL_OFF_ZR KL_SMG_PROG_AUTOMAT KL_SMG_PROG_MANUELL KL_SMG_PROG_MAX_TOEL KL_SMG_PROG_MIN_BERG KL_SMG_SK_PROG_MAX KL_SMG_T_KORR_AB K_SMG_ADAPT_IHAR_CNT K_SMG_ADAPT_IHAR_DFLT K_SMG_ADAPT_IHAR_MAX K_SMG_ADAPT_IHAR_MIN K_SMG_ADAPT_SP_DMD_FW K_SMG_ADAPT_SP_DM_MAX K_SMG_ADAPT_SP_N_MAX K_SMG_ADAPT_SP_N_MIN K_SMG_ADAPT_SP_TOEL K_SMG_ALIVE_ERR_MAX K_SMG_BERG_MD_KW_SCHW K_SMG_BERG_V_MAX_SCHW K_SMG_BERG_V_MIN_SCHW K_SMG_CAN_ED_TSPERR K_SMG_CAN_ED_UB_MIN K_SMG_CAN_KL87_TMAX K_SMG_CAN_TESTMODE K_SMG_CHKSUM_ERR_MAX K_SMG_I_GANG_1 K_SMG_I_GANG_2 K_SMG_I_GANG_3 K_SMG_I_GANG_4 K_SMG_I_GANG_5 K_SMG_I_GANG_6 K_SMG_I_GANG_7 K_SMG_I_GANG_N K_SMG_I_GANG_R K_SMG_I_HA K_SMG_KI_AKS_AY_MAX K_SMG_KI_AKS_DAY_MAX K_SMG_KI_AUF_DSC K_SMG_KI_AUF_DSC2 K_SMG_KI_AUF_EINGR K_SMG_KI_AUF_T_EINGR K_SMG_KI_AUF_ZR K_SMG_KI_CFG K_SMG_KI_DELTA_PWG K_SMG_KI_NEU_AY_MAX K_SMG_KI_SCHALT_DSC K_SMG_KSCHLUPF_AUF K_SMG_KSCHLUPF_DSC K_SMG_KSCHLUPF_N K_SMG_KSCHLUPF_T_SCHW K_SMG_KUPP_AUF_SCHW_N K_SMG_KUPP_DM_ABS K_SMG_KUPP_DM_MIN K_SMG_KUPP_DM_RAB K_SMG_KUPP_DM_SOLL_F K_SMG_KUPP_M_MAX_1 K_SMG_KUPP_M_MAX_2 K_SMG_KUPP_N_KSCHUTZ K_SMG_KUPP_RAMPE_DM K_SMG_KUPP_RAMPE_N K_SMG_KUPP_RAMPE_N_ABW K_SMG_KUPP_RAMPE_UL K_SMG_KUPP_REG_T K_SMG_KUPP_UL_FW_DM K_SMG_KUPP_UL_FW_MAX K_SMG_KUPP_UL_FW_SCHW K_SMG_KUPP_UL_MD_SCHW K_SMG_KUPP_UL_N_SCHW K_SMG_MD_FW_HYS_SCH K_SMG_MD_FW_HYS_ZUG K_SMG_MD_FW_MIN_AB K_SMG_MD_FW_MIN_AUF K_SMG_MOT_ABS_DM_MAX K_SMG_MOT_ABS_M_MAX K_SMG_MOT_ABS_M_MIN K_SMG_MOT_ABS_N_OFF K_SMG_MOT_ABS_T_MAX K_SMG_MOT_AKS_N_SCHW K_SMG_MOT_ANF_DM_DSC K_SMG_MOT_ANF_FW_X K_SMG_MOT_ANF_M_MIN K_SMG_MOT_ANF_N_OFF K_SMG_MOT_DN_GANG_1of3_ K_SMG_MOT_DN_GANG_2of3_ K_SMG_MOT_DN_GANG_3of3_ K_SMG_MOT_DN_REG_I_N K_SMG_MOT_DN_REG_I_P K_SMG_MOT_DN_REG_I_S K_SMG_MOT_DN_REG_T K_SMG_MOT_DN_SOLL_MIN K_SMG_MOT_DN_SOLL_VOR K_SMG_MOT_J_MOTOR_ZR K_SMG_MOT_M_RES_ABW K_SMG_MOT_M_RES_AUF K_SMG_MOT_M_RES_EXT_MAX K_SMG_MOT_M_RES_MAX K_SMG_MOT_M_RES_POS_MAX K_SMG_MOT_M_RES_POS_N K_SMG_MOT_M_RES_RAMPE K_SMG_MOT_M_RES_RAMPE_KS K_SMG_MOT_M_RES_RS K_SMG_MOT_M_RES_SCHA K_SMG_MOT_M_RES_T_MAX K_SMG_MOT_M_VOR_AUF K_SMG_MOT_NL_DELTA_FW K_SMG_MOT_NL_ETA K_SMG_MOT_NL_MD K_SMG_MOT_NL_MD_MAX K_SMG_MOT_NL_TAU K_SMG_MOT_NL_T_MAX K_SMG_MOT_N_REG_D_MAX K_SMG_MOT_N_REG_D_MIN K_SMG_MOT_N_REG_I_DN K_SMG_MOT_N_REG_I_SCHW K_SMG_MOT_N_REG_I_T K_SMG_MOT_N_REG_I_T_RAB K_SMG_MOT_N_REG_I_UP K_SMG_MOT_N_REG_M_BEGR K_SMG_MOT_N_REG_M_MAX K_SMG_MOT_N_REG_M_STG K_SMG_MOT_N_REG_T_MAX K_SMG_MOT_RAB_DM_MAX K_SMG_MOT_RAB_M_MAX K_SMG_MOT_RAB_M_MIN K_SMG_MOT_RAB_T_MAX K_SMG_MOT_RSS_MD_EINGR K_SMG_MOT_RS_N_OFF K_SMG_MOT_RS_N_SCHW K_SMG_MOT_RS_S_SCHW K_SMG_MOT_RS_TI_TABG K_SMG_MOT_RS_TI_TIME K_SMG_MOT_RS_T_HI K_SMG_MOT_RS_T_LO K_SMG_M_NULL K_SMG_NO_LW_N_SCHW K_SMG_N_ABRISS_ANF K_SMG_N_ABRISS_HYS K_SMG_N_EKR_OFF_BEGR K_SMG_N_NULL K_SMG_N_ZIEL_ABWUERG K_SMG_N_ZIEL_ANF_V_MAX K_SMG_N_ZIEL_HYS K_SMG_N_ZIEL_OFF_BEGR K_SMG_N_ZIEL_OFF_SCH K_SMG_N_ZIEL_OFF_ZH K_SMG_OHNE_EINGR_OFF K_SMG_PROG_EINFAHR_WEG K_SMG_PROG_FETRAWE_WEG K_SMG_PROG_MAX_ANH K_SMG_PROG_MAX_EINFAHR K_SMG_PROG_MAX_FETRAWE K_SMG_PROG_MIN_ANH K_SMG_PROG_MIN_ZR K_SMG_PROG_V_SCHW K_SMG_PWG_FW_SCH K_SMG_PWG_FW_SCH_N_OFF K_SMG_R_DYN K_SMG_SK_CONTROL K_SMG_SK_MD_SCHW K_SMG_SK_M_KUPP_MIN K_SMG_SK_NBERCH_MAX K_SMG_SK_NBERCH_T K_SMG_SK_NGETR_MAX K_SMG_SK_NGETR_T K_SMG_SK_NMAX_FSP K_SMG_SK_NMAX_FSP_INAKTIV K_SMG_SK_NZIEL_MAX K_SMG_SK_NZIEL_T K_SMG_SK_T_DME_ST_MAX K_SMG_SK_T_MAX K_SMG_SK_T_NGETR_MAX K_SMG_SK_T_NZIEL_MAX K_SMG_SK_T_PHASE_MAX_AB K_SMG_SK_T_PHASE_MAX_AUF K_SMG_SK_T_PHASE_MAX_SCHA K_SMG_SK_T_PHASE_N_MAX K_SMG_SK_V_SCHW K_SMG_TAU_AX_BERECH K_SMG_TAU_AX_BERG K_SMG_TAU_AX_MESS K_SMG_TAU_DN_FILTER K_SMG_TAU_DN_GETR K_SMG_TAU_DSC_ABS K_SMG_TAU_KSCHLUPF K_SMG_TAU_MD_FAHRER K_SMG_TAU_NGETR_ZIEL K_SMG_TAU_RSCHLUPF K_SMG_TESTMODE K_SMG_TZ_EINGR_T_AB K_SMG_T_ABREGEL_AKS K_SMG_T_KORR_AB_FW K_SMG_T_KORR_AB_MIN K_SMG_V_KRAFTS_ERSATZ /end DEF_CHARACTERISTIC
 /begin REF_CHARACTERISTIC /end REF_CHARACTERISTIC
 /begin IN_MEASUREMENT /end IN_MEASUREMENT
 /begin OUT_MEASUREMENT smg_abbruch_ges smg_abbruch_grund smg_adapt_ihar_cnt smg_adapt_ihar_sum smg_ax_filter smg_ay_zunahme smg_bw_null smg_can_alive_smg1 smg_can_alive_smg1_cnt smg_can_alive_smg2 smg_can_alive_smg2_cnt smg_can_alive_smg3 smg_can_alive_smg3_cnt smg_can_ax_mess smg_can_chksum_smg1_cnt smg_can_chksum_smg2_cnt smg_can_chksum_smg3_cnt smg_can_ed_tsperr smg_can_empf_st smg_can_empf_st_hys smg_can_getr_st smg_can_istgang smg_can_kupp_st smg_can_m_kupp_ist smg_can_m_kupp_ist_abs smg_can_m_kupp_max smg_can_n_anfahr smg_can_n_getr_ziel_roh smg_can_pos_kupp_ist smg_can_r_testmode smg_can_s_fgr smg_can_s_he smg_can_s_krafts smg_can_s_schalt smg_can_schalter smg_can_st_smg smg_can_st_smg1 smg_can_st_smg2 smg_can_st_smg3 smg_can_t_rest_ekr smg_can_t_rest_se smg_can_testmode smg_can_v_diff smg_can_zielgang smg_dn_filter smg_dn_getr_ein_fil smg_dn_mot_getr smg_fw_rel_virt smg_ki_ab smg_ki_auf smg_ki_auf_t_eingr smg_ki_scha smg_kschlupf smg_kschlupf_st smg_kupp_array smg_kupp_dm_soll smg_kupp_dn_soll smg_kupp_dn_soll_roh smg_kupp_flags smg_kupp_flags_abs smg_kupp_flags_adapt smg_kupp_flags_anf smg_kupp_flags_dn smg_kupp_flags_ekr smg_kupp_flags_ks smg_kupp_flags_schw smg_kupp_m_20 smg_kupp_m_40 smg_kupp_m_60 smg_kupp_m_80 smg_kupp_m_end smg_kupp_m_ist_0 smg_kupp_m_lw_start smg_kupp_m_off_ab smg_kupp_m_rab_start smg_kupp_m_rel_fw smg_kupp_m_soll smg_kupp_m_soll_abs smg_kupp_m_soll_rampe smg_kupp_m_soll_regler smg_kupp_m_voraus smg_kupp_modul smg_kupp_t_dn_null smg_kupp_t_rest smg_kupp_ul_fw_red smg_kupp_ul_st smg_m_kupp_ist_ga smg_md_dsc_abs smg_md_fahrer_ab smg_md_fahrer_auf smg_md_kw_ga smg_mot_dm_soll smg_mot_flags smg_mot_flags_begr smg_mot_flags_nll smg_mot_flags_nziel smg_mot_j_motor smg_mot_m_begr_max smg_mot_m_begr_min smg_mot_m_res smg_mot_m_res_pos smg_mot_m_res_time smg_mot_m_soll smg_mot_m_soll_dA smg_mot_m_soll_dk smg_mot_m_soll_iA smg_mot_m_soll_iA_2 smg_mot_m_soll_pA smg_mot_m_soll_regler smg_mot_m_soll_rel smg_mot_m_soll_stg smg_mot_m_soll_tz smg_mot_m_soll_vor_1 smg_mot_m_soll_vor_2 smg_mot_m_soll_voraus smg_mot_modul smg_mot_n_ekr_schw smg_mot_n_offset smg_mot_n_reg_st smg_mot_n_soll smg_mot_n_ziel_off smg_mot_t_regler smg_mot_tz_nachlauf smg_n_abriss smg_n_abriss_schw smg_n_diff_getr smg_n_diff_ziel smg_n_getr_ein smg_n_getr_ziel smg_old.flags smg_old.flags_anf smg_old.flags_nl smg_old.flags_sa smg_old.modul smg_old.schaltart smg_old.t_korr smg_prog_info_intern smg_prog_max_sk smg_prog_max_toel smg_prog_min_berg smg_radschlupf smg_schaltart_lw_cnt smg_sk_flags smg_sk_t_dme_st smg_sk_t_kupp smg_sk_t_nberech smg_sk_t_ngetr smg_sk_t_ngetr_max smg_sk_t_ngetr_plau smg_sk_t_nziel smg_sk_t_nziel_max smg_sk_t_nziel_plau smg_sk_t_phase smg_st_ekr smg_st_ekr_n smg_st_ekr_n_max smg_t_aktuell smg_t_aktuell_korr /end OUT_MEASUREMENT
/end FUNCTION
/begin FUNCTION SMG-Ebene_2 ""
 /begin DEF_CHARACTERISTIC K_SMG_E2_ST_ERR_MAX K_SMG_MOT_NL_T_MAX_E2 K_SMG_NGETR_DIFF_E2 K_SMG_NGETR_MAX_E2 /end DEF_CHARACTERISTIC
 /begin REF_CHARACTERISTIC /end REF_CHARACTERISTIC
 /begin IN_MEASUREMENT /end IN_MEASUREMENT
 /begin OUT_MEASUREMENT smg_e2_fehler smg_flags_e2 smg_flags_e2.ekr smg_flags_e2.zs smg_gang_e2_err smg_mot_tz_nachl_e2 smg_ngetr_e2_err smg_st_dme_e2 smg_st_dme_e2_err smg_st_mot_e2 smg_st_mot_e2_err /end OUT_MEASUREMENT
/end FUNCTION
/begin FUNCTION SPI_INJ "" /begin DEF_CHARACTERISTIC /end DEF_CHARACTERISTIC /begin REF_CHARACTERISTIC /end REF_CHARACTERISTIC /begin IN_MEASUREMENT /end IN_MEASUREMENT /begin OUT_MEASUREMENT /end OUT_MEASUREMENT /end FUNCTION
/begin FUNCTION Saugrohtwandtemperatur ""
 /begin DEF_CHARACTERISTIC KL_TSGRW_F KL_TSGRW_OFFS K_TSGRW_CFG K_TSGRW_TAU K_TSGRW_TAU_MS K_TSGRW_TU /end DEF_CHARACTERISTIC
 /begin REF_CHARACTERISTIC /end REF_CHARACTERISTIC
 /begin IN_MEASUREMENT /end IN_MEASUREMENT
 /begin OUT_MEASUREMENT tsgrw_filter_b1 tsgrw_filter_b2 tsgrw_roh_b1 tsgrw_roh_b2 /end OUT_MEASUREMENT
/end FUNCTION
/begin FUNCTION Schalter ""
 /begin DEF_CHARACTERISTIC K_SCHALTER_BLS_ENTPRELLUNG_E2 K_SCHALTER_KS_M_AUF K_SCHALTER_KS_M_ZU /end DEF_CHARACTERISTIC
 /begin REF_CHARACTERISTIC /end REF_CHARACTERISTIC
 /begin IN_MEASUREMENT /end IN_MEASUREMENT
 /begin OUT_MEASUREMENT schalter_bls_ad_ign schalter_bls_entprell_cnt_e2 schalter_kl87_ad schalter_st_ign_old_1of2_ schalter_st_ign_old_2of2_ schalter_wakeup_ad_ign /end OUT_MEASUREMENT
/end FUNCTION
/begin FUNCTION Startrelais "" /begin DEF_CHARACTERISTIC K_START_RL_BEGINN /end DEF_CHARACTERISTIC /begin REF_CHARACTERISTIC /end REF_CHARACTERISTIC /begin IN_MEASUREMENT /end IN_MEASUREMENT /begin OUT_MEASUREMENT start_rl_exd_beginn start_rl_exd_timeout start_rl_st /end OUT_MEASUREMENT /end FUNCTION
/begin FUNCTION Steuergeraetetemperatur ""
 /begin DEF_CHARACTERISTIC KL_TDME_NTC K_TDME_DIAG_MAX K_TDME_DIAG_MIN K_TDME_SCHWELLE_ZAEHLER K_TDME_TAU /end DEF_CHARACTERISTIC
 /begin REF_CHARACTERISTIC /end REF_CHARACTERISTIC
 /begin IN_MEASUREMENT /end IN_MEASUREMENT
 /begin OUT_MEASUREMENT tdme_ad tdme_filter tdme_roh /end OUT_MEASUREMENT
/end FUNCTION
/begin FUNCTION Systemvariablen "" /begin DEF_CHARACTERISTIC /end DEF_CHARACTERISTIC /begin REF_CHARACTERISTIC /end REF_CHARACTERISTIC /begin IN_MEASUREMENT /end IN_MEASUREMENT
 /begin OUT_MEASUREMENT sys_ed_st sys_exc_addr sys_exc_km_ni sys_exc_n_ni sys_exc_vec sys_last_reset_st sys_reset_st sys_rsr sys_rsr_cnt_sum sys_rsr_csrs sys_rsr_dbhrs sys_rsr_dbsrs sys_rsr_ehrs sys_rsr_ersr sys_rsr_ghrst sys_rsr_gpor sys_rsr_gsrst sys_rsr_ilbc sys_rsr_jtrs sys_rsr_llrs sys_rsr_occs sys_rsr_swrs sys_sg_fehler sys_sync_init_t_1of5_ sys_sync_init_t_2of5_ sys_sync_init_t_3of5_ sys_sync_init_t_4of5_ sys_sync_init_t_5of5_ sys_zust sys_zust_bgnd_cnt sys_zust_bgnd_net_min sys_zust_cpu_last /end OUT_MEASUREMENT
/end FUNCTION
/begin FUNCTION TD "" /begin DEF_CHARACTERISTIC /end DEF_CHARACTERISTIC /begin REF_CHARACTERISTIC /end REF_CHARACTERISTIC /begin IN_MEASUREMENT /end IN_MEASUREMENT /begin OUT_MEASUREMENT /end OUT_MEASUREMENT /end FUNCTION
/begin RECORD_LAYOUT TKW_VV_VV_UB FNC_VALUES 1 UBYTE COLUMN_DIR DIRECT /end RECORD_LAYOUT
/begin RECORD_LAYOUT TKW_VV_VV_UW FNC_VALUES 1 UWORD COLUMN_DIR DIRECT /end RECORD_LAYOUT
/begin RECORD_LAYOUT TKW_VV_VV_SW FNC_VALUES 1 SWORD COLUMN_DIR DIRECT /end RECORD_LAYOUT
/begin RECORD_LAYOUT TKL_UB_VV_UB NO_AXIS_PTS_X 1 UBYTE RESERVED 2 BYTE AXIS_PTS_X 3 UBYTE INDEX_INCR DIRECT FNC_VALUES 4 UBYTE COLUMN_DIR DIRECT /end RECORD_LAYOUT
/begin RECORD_LAYOUT TKL_SB_VV_UB NO_AXIS_PTS_X 1 UBYTE RESERVED 2 BYTE AXIS_PTS_X 3 SBYTE INDEX_INCR DIRECT FNC_VALUES 4 UBYTE COLUMN_DIR DIRECT /end RECORD_LAYOUT
/begin RECORD_LAYOUT TKL_UW_VV_SW NO_AXIS_PTS_X 1 UBYTE RESERVED 2 BYTE AXIS_PTS_X 3 UWORD INDEX_INCR DIRECT FNC_VALUES 4 SWORD COLUMN_DIR DIRECT /end RECORD_LAYOUT
/begin RECORD_LAYOUT TKL_SW_VV_UB NO_AXIS_PTS_X 1 UBYTE RESERVED 2 BYTE AXIS_PTS_X 3 SWORD INDEX_INCR DIRECT FNC_VALUES 4 UBYTE COLUMN_DIR DIRECT /end RECORD_LAYOUT
/begin RECORD_LAYOUT TKL_SW_VV_UW NO_AXIS_PTS_X 1 UBYTE RESERVED 2 BYTE AXIS_PTS_X 3 SWORD INDEX_INCR DIRECT FNC_VALUES 4 UWORD COLUMN_DIR DIRECT /end RECORD_LAYOUT
/begin RECORD_LAYOUT TKL_SW_VV_SW NO_AXIS_PTS_X 1 UBYTE RESERVED 2 BYTE AXIS_PTS_X 3 SWORD INDEX_INCR DIRECT FNC_VALUES 4 SWORD COLUMN_DIR DIRECT /end RECORD_LAYOUT
/begin RECORD_LAYOUT TKF_UB_UB_UB NO_AXIS_PTS_X 1 UBYTE NO_AXIS_PTS_Y 2 UBYTE AXIS_PTS_X 3 UBYTE INDEX_INCR DIRECT AXIS_PTS_Y 4 UBYTE INDEX_INCR DIRECT FNC_VALUES 5 UBYTE COLUMN_DIR DIRECT /end RECORD_LAYOUT
/begin RECORD_LAYOUT TKF_SW_SW_UB NO_AXIS_PTS_X 1 UBYTE NO_AXIS_PTS_Y 2 UBYTE AXIS_PTS_X 3 SWORD INDEX_INCR DIRECT AXIS_PTS_Y 4 SWORD INDEX_INCR DIRECT FNC_VALUES 5 UBYTE COLUMN_DIR DIRECT /end RECORD_LAYOUT
/begin RECORD_LAYOUT TKF_SW_SW_SW NO_AXIS_PTS_X 1 UBYTE NO_AXIS_PTS_Y 2 UBYTE AXIS_PTS_X 3 SWORD INDEX_INCR DIRECT AXIS_PTS_Y 4 SWORD INDEX_INCR DIRECT FNC_VALUES 5 SWORD COLUMN_DIR DIRECT /end RECORD_LAYOUT
/end MODULE
/end PROJECT
