/* ------------------------------------------------------------------
MSS65 IGN A2L - Calibration B584696 (V452.01-B204.00, data set 0569Q60Z160E)
Created by ZiMMie for the M5Board and Nam3Forum communities.
This project exists to make this information freely available to
everyone: to share the work, encourage collaboration, and let others
learn from it, use it and add their own knowledge.
The reference material is based on publicly available program data.
The V452 program was disassembled and analysed to place and verify the
definitions for this calibration.
This is a community effort, and every contribution matters.
Corrections, additional findings, technical knowledge and general
feedback are all very welcome. The more knowledge is shared and the
more people work together, the more can be achieved.
Completely free to use and share.
------------------------------------------------------------------ */
/* Technical notes - V452 definitions.
Calibration addresses remapped by structural + code alignment against the V452 full read (04.11.2026).
Calibration layout: 0x786A8-0x786AB hold the V452-specific constants K_N_GETR_HS_DIAG_ABTR_MIN / _N_MAX.
English text (EN:) taken from the MSS60 V762 definition where the name matches.
RAM measurements: 98.7% of code-accessed addresses confirmed in V452; blocks marked "V452 CHECK" are not valid. */
/begin PROJECT MSS65-ign-V452 "MSS65 IGN - V452.01-B204.00, data set 0569Q60Z160E"
/begin HEADER "" VERSION "V452.01-B204.00" /end HEADER
/begin MODULE _MSS65-ign "MSS65 IGN - V452.01-B204.00, calibration xxxxxxxx"
/begin MOD_COMMON "" BYTE_ORDER MSB_FIRST /* Default byteorder (Motorola) */ /end MOD_COMMON
/begin MOD_PAR "" VERSION "ccp 2.1" ADDR_EPK 0x00070289 EPK "V452" SUPPLIER "" CUSTOMER "" CUSTOMER_NO "" USER "" ECU "MSS65-IGN" /* Description of memory-segments. There has to be a CODE and DATA-Segment to */ /* support the generation of valid flashable HEX-Files */
 /begin MEMORY_SEGMENT CODESEG1 "Program" CODE FLASH INTERN 0x10000 0x60000 -1 -1 -1 -1 -1 /end MEMORY_SEGMENT
 /begin MEMORY_SEGMENT CODESEG2 "Program" CODE FLASH EXTERN 0x450000 0x1B0000 -1 -1 -1 -1 -1 /end MEMORY_SEGMENT
 /begin MEMORY_SEGMENT DATASEG1 "Appl.-DATA" DATA FLASH /* Memorytype; RAM wird nicht unterst�tzt */ INTERN 0x70000 0x10000 -1 -1 -1 -1 -1 /end MEMORY_SEGMENT
 /begin MEMORY_SEGMENT /* The new keyword MEMORY_SEGMENT */ VARSEG "Variablen" VARIABLES RAM INTERN 0x3F8000 0x8000 -1 -1 -1 -1 -1 /end MEMORY_SEGMENT
 /begin CALIBRATION_METHOD "DSERAP" /* Name of Method */ 1 /* Version No. */
  /begin CALIBRATION_HANDLE 0x70000 /* Begin of Calibration-Data */ 0xFFFC /* Length of Calibration-Data */ /end CALIBRATION_HANDLE
 /end CALIBRATION_METHOD
/end MOD_PAR
/begin IF_DATA ASAP1B_CCP /* spezific definition for CCP */ /* schnelle zeitsynchrone DAQ-Liste */
 /begin SOURCE "5 ms" 3 /* Basic Scale Unit: 3 -> 1ms */ 5 /* Rate: 5 * 1ms = 5ms */
  /begin QP_BLOB /* The QP-BLOB specifies the behavior of*/ 0 LENGTH 20 CAN_ID_FIXED 0x410 RASTER 0 FIRST_PID 0 /end QP_BLOB
 /end SOURCE
 /* langsame zeitsynchrone DAQ-Liste */
 /begin SOURCE "100 ms" 5 /* Basic Scale Unit: 5 -> 100ms */ 1 /* Rate: 1 * 100ms = 100ms */
  /begin QP_BLOB /* The QP-BLOB specifies the behavior of*/ 1 LENGTH 10 CAN_ID_FIXED 0x411 RASTER 1 FIRST_PID 20 /end QP_BLOB
 /end SOURCE
 /* winkelsynchrone DAQ-Liste */
 /begin SOURCE "segment-synchron" 103 /* Basic Scale Unit: 103 -> Segment */ 1 /* Rate: 1 * Seg = Seg */
  /begin QP_BLOB /* The QP-BLOB specify the behavior of */ 2 LENGTH 10 CAN_ID_FIXED 0x412 RASTER 2 /* noch pruefen!!!! p_wax */ FIRST_PID 30 /end QP_BLOB
 /end SOURCE
 /begin RASTER "5ms-Task" "5ms" 0 3 /* Scaling Unit: 3 = 1 msec */ 5 /* Rate in Scaling Unit: 5 */ /end RASTER
 /begin RASTER "100ms-Task" "100ms" 1 5 /* Scaling Unit: 5 = 100 msec */ 1 /* Rate in Scaling Unit: 1 */ /end RASTER
 /begin RASTER "sync-Task" "sync" 2 103 /* Scaling Unit: 103 = cylinder segment */ 1 /* Rate in Scaling Unit: 1 */ /end RASTER
 /begin TP_BLOB /* This BLOB describes all parameters */ /* that are necessary for CAN-timing and*/ /* ECU-calibration-technics */ 0x0201 /* CCP-Version V2.1 => 0x0201 */ 0x0202 /* BLOB-Version V2.2 => 0x0202 */ 0x400 /* CAN-ID CCP -> ECU */ 0x401 /* CAN-ID ECU -> CCP */ 0x1234 /* ECU CCP-Address */ 1 /* Byte-order: 1 - High-Byte-First (MOT)*/ /* 2 - Low-Byte-First(INTEL)*/
  /begin CAN_PARAM /* Interface CAN-Conrtoller settings */ 0x01f4 /* CAN-Baudrate in kBd: 0x01F4 = 500 kBd*/ 0x41 /* Bittimingregister BTR0: 0x41 */ 0x25 /* Bittimingregister BTR1: 0x25 */ /end CAN_PARAM
  BAUDRATE 500000 /* Baud rate */ SAMPLE_POINT 66 /* Sampling Point of time in percent */ SAMPLE_RATE 1 /* number of samples per bit */ STORE_SUPPORTED /* ECU supports the Store function */ RESUME_SUPPORTED /* ECU supports the Resume function */
  /begin CHECKSUM_PARAM 0x8009 /* Auswahl Checksum-Funktionen */ 0xFFFC /* Max. Blocklaenge */ CHECKSUM_CALCULATION ACTIVE_PAGE /* akt. Seite berechnen */ /end CHECKSUM_PARAM
  /begin DEFINED_PAGES /* Description of the memory-page */ 1 /* Logical-page-number */ "Workingpage" /* Name of page */ 0x0000 /* Address-Extension */ /* (only low-byte sgnificant) */ 0xc70000 /* Address of Memorypage */ 0x10000 /* Memorysize */ RAM FLASH_BACK /* feature available to flash back the RAM memory page */ DEFAULT /* Page is standard (fallback mode) */ RAM_INIT_BY_ECU /* Initialisationmethode: die ECU initialisiert die WP eigenstaendig */ /* INCA vermeidet mit dieser Einstellung das Senden des MOVE-Commands */ /* beim CCP-Session-Login. */ /end DEFINED_PAGES
  /begin DEFINED_PAGES /* Description of the memory-page */ 2 /* Logical-page-number */ "Referenzpage" /* Name of page */ 0x0000 /* Address-Extension */ /* (only low-byte sgnificant) */ 0x70000 /* Address of Memorypage */ 0x10000 /* Memorysize */ FLASH RAM_INIT_BY_ECU /* Initialisationmethode: die ECU initialisiert die WP eigenstaendig */ /* INCA vermeidet mit dieser Einstellung das Senden des MOVE-Commands */ /* beim CCP-Session-Login. */ /end DEFINED_PAGES
  OPTIONAL_CMD 0x0C /* GetSessionStatus */ OPTIONAL_CMD 0x0D /* SetSessionStatus */ OPTIONAL_CMD 0x0E /* BuildChecksum */ OPTIONAL_CMD 0x09 /* GetCalPage */ OPTIONAL_CMD 0x10 /* Clear Memory */ OPTIONAL_CMD 0x11 /* SelectCalPage */ OPTIONAL_CMD 0x12 /* GetSeed */ OPTIONAL_CMD 0x13 /* Unlock */ OPTIONAL_CMD 0x18 /* Programm */ OPTIONAL_CMD 0x19 /* Move */ OPTIONAL_CMD 0x22 /* Programm6 */ OPTIONAL_CMD 0x23 /* Download6 */ /end TP_BLOB
/end IF_DATA
/begin IF_DATA ASAP1B_KWP2000
 /begin SOURCE "timeslot" 0 0 QP_BLOB 0 BLOCKMODE 0xf0 0 20 /end SOURCE
 /begin TP_BLOB 0x0100 /* blob Version */ 0x11 /* ECU address on k line */ 0xF1 /* required tester address */ WuP /* stimulation mode of ECU: WuP */ MSB_FIRST /* byte order in measurements and characteristics */ 1 /* 1: 1st startDiagnosticSession without baudrate switch */ 0x00000 /* Project base address (PBA) */ /*SERAM SERAM_A SERAM_U SERAM_O SERAM_E Flash addr RAM addr Data rd code ver Code read Load mode*/ SERAM 0x60100 0x60100 0x6FAFF 0x6FAFF 0 0 1 0 0 1
  /begin CHECKSUM 0x010201 /* check sum type qualifier (see table) */ 1 /* 1: check sum calculation only on active page */ 1 /* No of local routine for check sum */ RequestRoutineResults /* result of checksum routine delivered by */ RNC_RESULT 0x23 /* only at 'RequestRoutineResults': */ /* result codes, that sign 'calculation in progress' */ /end CHECKSUM
  /begin FLASH_COPY TOOLFLASHBACK /* ECU mode for copying RAM into Flash */ 3 /* No of local routine for copy Flash to RAM */ RequestRoutineResults /* result of copy routine delivered by */ RAM_InitByECU /* ECU mode for copying Flash into RAM */ 0x86 /* diagnostic mode for copy RAM to Flash */ COPY_FRAME 1 /* list of page frames to be copied */ RNC_RESULT 0x23 0xfb 0xfc /* only at 'RequestRoutineResults': */ /* result codes, that sign 'copy in progress' */ /* COPY_PARA */ /* list of add. parameters for local routine */ /end FLASH_COPY
  /*Baudrate switch: BaudRate DiagMode i,k for ECU baudrate*/ /* BAUD_DEF 250000 0x86 0xA7 */ /* BAUD_DEF 125000 0x86 0x87 */ /* BAUD_DEF 111111 0x86 0x84 */ /* BAUD_DEF 55555 0x86 0x64 */ /* BAUD_DEF 10400 0x86 0x14 */ /*Timing parameter: p1Max p2Min p2Max p3Min p3Max p4Min */ /*Timing parameter: p1Max p2Min p2Max p3Min p3Max p4Min */ /* TIME_DEF 1 0 50 0 500 0 */ /* TIME_DEF 2 0 50 0 500 0 */ /* TIME_DEF 5 1 100 1 500 0 */ /* TIME_DEF 10 1 500 2 1000 1 */ TIME_DEF 20 2 25 28 250 0 /end TP_BLOB
/end IF_DATA
/begin IF_DATA EDIC_ISO_DS2 "V1.0" 0x12 25 1 SUPP_SERVICE READMEM SUPP_SERVICE WRITEMEM SUPP_SERVICE ACK TELDATA 0x9E /end IF_DATA
/* ------------------ Abschnitt erzeugt aus adapt_common.dat ------------------ */
/begin COMPU_METHOD FORMULA_0000 "FORMULA_0000" RAT_FUNC "%7.0" "-" COEFFS 0 1 0 0 0 1 /end COMPU_METHOD
/begin COMPU_METHOD FORMULA_0001 "FORMULA_0001" RAT_FUNC "%6.1" "%" COEFFS 0 10 0 0 0 1 /end COMPU_METHOD
/begin COMPU_METHOD FORMULA_0002 "FORMULA_0002" TAB_VERB "%3.0" "-" COMPU_TAB_REF FORMULA_0002_VTAB /end COMPU_METHOD
/begin COMPU_VTAB FORMULA_0002_VTAB "FORMULA_0002_VTAB" TAB_VERB 4 0 "in Ordnung" 128 "queue full" 64 "queue fehler" 32 "IRQ illegal" DEFAULT_VALUE "undefiniert" /end COMPU_VTAB
/begin COMPU_METHOD FORMULA_0003 "FORMULA_0003" RAT_FUNC "%3.0" "-" COEFFS 0 1 0 0 0 1 /end COMPU_METHOD
/begin COMPU_METHOD FORMULA_0004 "FORMULA_0004" TAB_VERB "%5.2" "-" COMPU_TAB_REF FORMULA_0004_VTAB /end COMPU_METHOD
/begin COMPU_VTAB FORMULA_0004_VTAB "FORMULA_0004_VTAB" TAB_VERB 9 0 "OK" 1 "NR CS0" 2 "NR CS1" 4 "NR CS2" 8 "NR CS3" 16 "CNT CS0" 17 "CNT CS1" 18 "CNT CS2" 20 "CNT CS3" /end COMPU_VTAB
/begin COMPU_METHOD FORMULA_0005 "FORMULA_0005" TAB_VERB "%5.2" "-" COMPU_TAB_REF FORMULA_0005_VTAB /end COMPU_METHOD
/begin COMPU_VTAB FORMULA_0005_VTAB "FORMULA_0005_VTAB" TAB_VERB 7 0 "OK" 1 "Seg-Kanal" 2 "5ms-Kanal" 4 "10ms-Kanal" 8 "100ms-Kanal" 16 "bgnd-Kanal" 32 "kwp-Kanal" DEFAULT_VALUE "ungueltig" /end COMPU_VTAB
/begin COMPU_METHOD FORMULA_0006 "FORMULA_0006" RAT_FUNC "%5.0" "Upm" COEFFS 0 1 0 0 0 1 /end COMPU_METHOD
/begin COMPU_METHOD FORMULA_0007 "FORMULA_0007" RAT_FUNC "%8.3" "-" COEFFS 0 10000 0 0 0 1 /end COMPU_METHOD
/begin COMPU_METHOD FORMULA_0008 "FORMULA_0008" RAT_FUNC "%6.1" "V" COEFFS 0 10 0 0 0 1 /end COMPU_METHOD
/begin COMPU_METHOD FORMULA_0009 "FORMULA_0009" RAT_FUNC "%6.1" "Nm" COEFFS 0 10 0 0 0 1 /end COMPU_METHOD
/begin COMPU_METHOD FORMULA_0010 "FORMULA_0010" RAT_FUNC "%5.0" "-" COEFFS 0 1 0 0 0 1 /end COMPU_METHOD
/begin COMPU_METHOD FORMULA_0011 "FORMULA_0011" TAB_VERB "%5.0" "-" COMPU_TAB_REF FORMULA_0011_VTAB /end COMPU_METHOD
/begin COMPU_VTAB FORMULA_0011_VTAB "FORMULA_0011_VTAB" TAB_VERB 15 0 "kein Fehler" 1 "Egasueberwachung" 2 "Momentenueberwachung" 4 "Einspritzueberwachung" 8 "SMG-Ueberwachung" 16 "Systemfehler" 32 "Stackueberwachung" 64 "Resetanzahl" 128 "Gemischfehler" 256 "Klopfregelung" 512 "CRC-Check" 1024 "Taskueberwachung" 2048 "Prozessueberwachung" 4096 "Pedalwertgeber" 8192 "Mastervac" DEFAULT_VALUE "undef" /end COMPU_VTAB
/begin COMPU_METHOD FORMULA_0012 "FORMULA_0012" TAB_VERB "%3.0" "-" COMPU_TAB_REF FORMULA_0012_VTAB /end COMPU_METHOD
/begin COMPU_VTAB FORMULA_0012_VTAB "FORMULA_0012_VTAB" TAB_VERB 1 0 "iO" DEFAULT_VALUE "Fehler" /end COMPU_VTAB
/begin COMPU_METHOD FORMULA_0013 "FORMULA_0013" TAB_VERB "%3.0" "-" COMPU_TAB_REF FORMULA_0013_VTAB /end COMPU_METHOD
/begin COMPU_VTAB FORMULA_0013_VTAB "FORMULA_0013_VTAB" TAB_VERB 5 0 "CRC iO" 1 "D-Fehler" 2 "P-Fehler" 3 "PD-Fehler" 4 "B-Fehler" DEFAULT_VALUE "Mehrfachfehler" /end COMPU_VTAB
/begin COMPU_METHOD FORMULA_0014 "FORMULA_0014" TAB_VERB "%3.0" "-" COMPU_TAB_REF FORMULA_0014_VTAB /end COMPU_METHOD
/begin COMPU_VTAB FORMULA_0014_VTAB "FORMULA_0014_VTAB" TAB_VERB 5 0 "OK" 3 "ID" 4 "Limit" 11 "Overrun" 14 "Stack" /end COMPU_VTAB
/begin COMPU_METHOD FORMULA_0015 "FORMULA_0015" TAB_VERB "%5.0" "-" COMPU_TAB_REF FORMULA_0015_VTAB /end COMPU_METHOD
/begin COMPU_VTAB FORMULA_0015_VTAB "FORMULA_0015_VTAB" TAB_VERB 6 512 "MCI" 768 "DataAcc" 1024 "IntrAcc" 1536 "Align" 1792 "PrgExc" 8192 "NMI" /end COMPU_VTAB
/begin COMPU_METHOD FORMULA_0016 "FORMULA_0016" TAB_VERB "%3.0" "-" COMPU_TAB_REF FORMULA_0016_VTAB /end COMPU_METHOD
/begin COMPU_VTAB FORMULA_0016_VTAB "FORMULA_0016_VTAB" TAB_VERB 13 0 "ini" 1 "1st edge" 2 "second edge" 3 "wait teeth" 4 "search gap" 5 "1st missing required" 6 "last tooth until gap" 7 "1st missing tooth" 8 "2nd missing tooth" 9 "1st tooth after gap" 10 "2nd tooth after gap" 11 "tooth 2..56, 62..116" 12 "gap required" DEFAULT_VALUE "undefined" /end COMPU_VTAB
/begin COMPU_METHOD FORMULA_0017 "FORMULA_0017" RAT_FUNC "%9.2" "ms" COEFFS 0 7000 0 0 0 1 /end COMPU_METHOD
/begin COMPU_METHOD FORMULA_0018 "FORMULA_0018" RAT_FUNC "%5.0" "us" COEFFS 0 1 0 0 0 1 /end COMPU_METHOD
/begin COMPU_METHOD FORMULA_0019 "FORMULA_0019" TAB_VERB "%7.2" "-" COMPU_TAB_REF FORMULA_0019_VTAB /end COMPU_METHOD
/begin COMPU_VTAB FORMULA_0019_VTAB "FORMULA_0019_VTAB" TAB_VERB 13 1 "Motor steht" 2 "Motor presync" 4 "Start" 8 "LLOKS" 16 "LLMKS" 32 "TL" 64 "VL" 128 "SA" 256 "NL" 512 "Abgew." 1024 "Kl15 aus" 2048 "Wakeup" 4096 "Schub" DEFAULT_VALUE "undefiniert" /end COMPU_VTAB
/begin COMPU_METHOD FORMULA_0020 "FORMULA_0020" RAT_FUNC "%5.0" "qmm/s" COEFFS 0 1 0 0 0 20 /end COMPU_METHOD
/begin COMPU_METHOD FORMULA_0021 "FORMULA_0021" RAT_FUNC "%7.2" "s" COEFFS 0 100 0 0 0 1 /end COMPU_METHOD
/begin COMPU_METHOD FORMULA_0022 "FORMULA_0022" RAT_FUNC "%7.2" "%" COEFFS 0 100 0 0 0 1 /end COMPU_METHOD
/* ------------------ Abschnitt erzeugt aus adapt_glob.dat ------------------ */
/begin COMPU_METHOD FORMULA_0023 "FORMULA_0023" RAT_FUNC "%6.1" "�C" COEFFS 0 10 2732 0 0 1 /end COMPU_METHOD
/begin COMPU_METHOD FORMULA_0024 "FORMULA_0024" RAT_FUNC "%9.4" "-" COEFFS 0 32768 0 0 0 1 /end COMPU_METHOD
/begin COMPU_METHOD FORMULA_0025 "FORMULA_0025" RAT_FUNC "%8.3" "-" COEFFS 0 16384 0 0 0 1 /end COMPU_METHOD
/begin COMPU_METHOD FORMULA_0026 "FORMULA_0026" TAB_VERB "%3.0" "-" COMPU_TAB_REF FORMULA_0026_VTAB /end COMPU_METHOD
/begin COMPU_VTAB FORMULA_0026_VTAB "FORMULA_0026_VTAB" TAB_VERB 4 0 "off" 1 "Fertigungsmode" 2 "Transportmode" 4 "Werkstattmode" DEFAULT_VALUE "off" /end COMPU_VTAB
/begin COMPU_METHOD FORMULA_0027 "FORMULA_0027" RAT_FUNC "%7.0" "km" COEFFS 0 1 0 0 0 1 /end COMPU_METHOD
/begin COMPU_METHOD FORMULA_0028 "FORMULA_0028" TAB_VERB "%3.0" "-" COMPU_TAB_REF FORMULA_0028_VTAB /end COMPU_METHOD
/begin COMPU_VTAB FORMULA_0028_VTAB "FORMULA_0028_VTAB" TAB_VERB 7 0 "kein Land" 1 "ECE" 2 "US" 3 "D" 4 "GB" 5 "J" 255 "ungueltig" /end COMPU_VTAB
/begin COMPU_METHOD FORMULA_0029 "FORMULA_0029" TAB_VERB "%3.0" "-" COMPU_TAB_REF FORMULA_0029_VTAB /end COMPU_METHOD
/begin COMPU_VTAB FORMULA_0029_VTAB "FORMULA_0029_VTAB" TAB_VERB 9 0 "keine Angabe" 4 "E60" 5 "E61" 6 "E63" 7 "E64" 8 "E90" 13 "E91" 14 "E92" 15 "E93" DEFAULT_VALUE "ungueltig" /end COMPU_VTAB
/begin COMPU_METHOD FORMULA_0030 "FORMULA_0030" TAB_VERB "%3.0" "-" COMPU_TAB_REF FORMULA_0030_VTAB /end COMPU_METHOD
/begin COMPU_VTAB FORMULA_0030_VTAB "FORMULA_0030_VTAB" TAB_VERB 3 0 "v_max 250" 1 "reserviert" 2 "v_max angehoben" DEFAULT_VALUE "undef" /end COMPU_VTAB
/begin COMPU_METHOD FORMULA_0031 "FORMULA_0031" TAB_VERB "%3.0" "-" COMPU_TAB_REF FORMULA_0031_VTAB /end COMPU_METHOD
/begin COMPU_VTAB FORMULA_0031_VTAB "FORMULA_0031_VTAB" TAB_VERB 5 0 "HS" 1 "Automat" 2 "Steptronic" 3 "SMG" 15 "ungueltig" /end COMPU_VTAB
/begin COMPU_METHOD FORMULA_0032 "FORMULA_0032" RAT_FUNC "%3.0" "%" COEFFS 0 1 0 0 0 1 /end COMPU_METHOD
/begin COMPU_METHOD FORMULA_0033 "FORMULA_0033" RAT_FUNC "%5.2" "-" COEFFS 0 1 0 0 0 1 /end COMPU_METHOD
/begin COMPU_METHOD FORMULA_0034 "FORMULA_0034" TAB_VERB "%5.2" "-" COMPU_TAB_REF FORMULA_0034_VTAB /end COMPU_METHOD
/begin COMPU_VTAB FORMULA_0034_VTAB "FORMULA_0034_VTAB" TAB_VERB 1 0 "erfuellt" DEFAULT_VALUE "offen" /end COMPU_VTAB
/begin COMPU_METHOD FORMULA_0035 "FORMULA_0035" TAB_VERB "%5.2" "-" COMPU_TAB_REF FORMULA_0035_VTAB /end COMPU_METHOD
/begin COMPU_VTAB FORMULA_0035_VTAB "FORMULA_0035_VTAB" TAB_VERB 1 0 "erfuellt" DEFAULT_VALUE "offen" /end COMPU_VTAB
/begin COMPU_METHOD FORMULA_0036 "FORMULA_0036" TAB_VERB "%5.2" "-" COMPU_TAB_REF FORMULA_0036_VTAB /end COMPU_METHOD
/begin COMPU_VTAB FORMULA_0036_VTAB "FORMULA_0036_VTAB" TAB_VERB 1 0 "erfuellt" DEFAULT_VALUE "offen" /end COMPU_VTAB
/begin COMPU_METHOD FORMULA_0037 "FORMULA_0037" TAB_VERB "%5.2" "-" COMPU_TAB_REF FORMULA_0037_VTAB /end COMPU_METHOD
/begin COMPU_VTAB FORMULA_0037_VTAB "FORMULA_0037_VTAB" TAB_VERB 1 0 "erfuellt" DEFAULT_VALUE "offen" /end COMPU_VTAB
/begin COMPU_METHOD FORMULA_0038 "FORMULA_0038" TAB_VERB "%5.2" "-" COMPU_TAB_REF FORMULA_0038_VTAB /end COMPU_METHOD
/begin COMPU_VTAB FORMULA_0038_VTAB "FORMULA_0038_VTAB" TAB_VERB 1 0 "erfuellt" DEFAULT_VALUE "offen" /end COMPU_VTAB
/begin COMPU_METHOD FORMULA_0073 "FORMULA_0073" RAT_FUNC "%6.1" "s" COEFFS 0 10 0 0 0 1 /end COMPU_METHOD
/begin COMPU_METHOD FORMULA_0075 "FORMULA_0075" RAT_FUNC "%8.3" "-" COEFFS 0 1024 0 0 0 1 /end COMPU_METHOD
/begin COMPU_METHOD FORMULA_0076 "FORMULA_0076" RAT_FUNC "%6.1" "Kelvin" COEFFS 0 10 0 0 0 1 /end COMPU_METHOD
/begin COMPU_METHOD FORMULA_0077 "FORMULA_0077" RAT_FUNC "%6.1" "mbar" COEFFS 0 16 0 0 0 1 /end COMPU_METHOD
/begin COMPU_METHOD FORMULA_0078 "FORMULA_0078" RAT_FUNC "%6.1" "km/h" COEFFS 0 16 0 0 0 1 /end COMPU_METHOD
/begin COMPU_METHOD FORMULA_0093 "FORMULA_0093" RAT_FUNC "%7.2" "mg" COEFFS 0 10 0 0 0 1 /end COMPU_METHOD
/begin COMPU_METHOD FORMULA_0109 "FORMULA_0109" RAT_FUNC "%7.2" "-" COEFFS 0 10000 0 0 0 1 /end COMPU_METHOD
/begin COMPU_METHOD FORMULA_0111 "FORMULA_0111" RAT_FUNC "%6.1" "�KW" COEFFS 0 10 0 0 0 1 /end COMPU_METHOD
/begin COMPU_METHOD FORMULA_0112 "FORMULA_0112" RAT_FUNC "%6.1" "kg/h" COEFFS 0 10 0 0 0 1 /end COMPU_METHOD
/begin COMPU_METHOD FORMULA_0114 "FORMULA_0114" RAT_FUNC "%5.0" "Upm/s" COEFFS 0 1 0 0 0 1 /end COMPU_METHOD
/begin COMPU_METHOD FORMULA_0117 "FORMULA_0117" RAT_FUNC "%7.2" "s" COEFFS 0 200 0 0 0 1 /end COMPU_METHOD
/begin COMPU_METHOD FORMULA_0118 "FORMULA_0118" RAT_FUNC "%8.3" "bar" COEFFS 0 1000 0 0 0 1 /end COMPU_METHOD
/begin COMPU_METHOD FORMULA_0123 "FORMULA_0123" RAT_FUNC "%5.0" "digit" COEFFS 0 1 0 0 0 1 /end COMPU_METHOD
/begin COMPU_METHOD FORMULA_0126 "FORMULA_0126" TAB_VERB "%3.0" "-" COMPU_TAB_REF FORMULA_0126_VTAB /end COMPU_METHOD
/begin COMPU_VTAB FORMULA_0126_VTAB "FORMULA_0126_VTAB" TAB_VERB 8 0 "O.K." 1 "BusOff" 2 "DPR" 4 "Timeout" 5 "BusOff+Timeout" 8 "Overflow" 16 "Chksum" 32 "Alive" DEFAULT_VALUE "Mehrfachfehler" /end COMPU_VTAB
/begin COMPU_METHOD FORMULA_0132 "FORMULA_0132" RAT_FUNC "%7.2" "m/(s*s)" COEFFS 0 40 0 0 0 1 /end COMPU_METHOD
/begin COMPU_METHOD FORMULA_0138 "FORMULA_0138" RAT_FUNC "%3.0" "bar" COEFFS 0 1 0 0 0 1 /end COMPU_METHOD
/begin COMPU_METHOD FORMULA_0141 "FORMULA_0141" RAT_FUNC "%7.2" "Grad" COEFFS 0 1 0 0 0 0.04395 /end COMPU_METHOD
/begin COMPU_METHOD FORMULA_0147 "FORMULA_0147" RAT_FUNC "%6.1" "qmm" COEFFS 0 10 0 0 0 1 /end COMPU_METHOD
/begin COMPU_METHOD FORMULA_0149 "FORMULA_0149" RAT_FUNC "%9.2" "min" COEFFS 0 60 0 0 0 1 /end COMPU_METHOD
/begin COMPU_METHOD FORMULA_0152 "FORMULA_0152" RAT_FUNC "%9.2" "s" COEFFS 0 100 0 0 0 1 /end COMPU_METHOD
/begin COMPU_METHOD FORMULA_0172 "FORMULA_0172" TAB_VERB "%3.0" "-" COMPU_TAB_REF FORMULA_0172_VTAB /end COMPU_METHOD
/begin COMPU_VTAB FORMULA_0172_VTAB "FORMULA_0172_VTAB" TAB_VERB 1 0 "kein Fehler" /end COMPU_VTAB
/begin COMPU_METHOD FORMULA_0243 "FORMULA_0243" RAT_FUNC "%10.3" "�KW" COEFFS 0 81920 0 0 0 1 /end COMPU_METHOD
/begin COMPU_METHOD FORMULA_0245 "FORMULA_0245" RAT_FUNC "%7.2" "nSs" COEFFS 0 1 0 0 0 0.01952206 /end COMPU_METHOD
/begin COMPU_METHOD FORMULA_0295 "FORMULA_0295" RAT_FUNC "%9.4" "-" COEFFS 0 16384 0 0 0 1 /end COMPU_METHOD
/begin COMPU_METHOD FORMULA_0309 "FORMULA_0309" TAB_VERB "%5.2" "-" COMPU_TAB_REF FORMULA_0309_VTAB /end COMPU_METHOD
/begin COMPU_VTAB FORMULA_0309_VTAB "FORMULA_0309_VTAB" TAB_VERB 6 0 "Inaktiv" 1 "Abregeln" 2 "Schalten" 3 "Aufregeln" 4 "Ende" 15 "Error" /end COMPU_VTAB
/begin COMPU_METHOD FORMULA_0318 "FORMULA_0318" RAT_FUNC "%3.0" ".Gang" COEFFS 0 1 0 0 0 1 /end COMPU_METHOD
/begin COMPU_METHOD FORMULA_0333 "FORMULA_0333" RAT_FUNC "%7.2" "�C" COEFFS 0 20 5463 0 0 1 /end COMPU_METHOD
/* ------------------ Abschnitt erzeugt aus sc_glob.dat ------------------ */
/begin COMPU_METHOD FORMULA_0358 "FORMULA_0358" RAT_FUNC "%9.2" "ms" COEFFS 0 1000 0 0 0 1 /end COMPU_METHOD
/* ------------------ Abschnitt erzeugt aus version.dat ------------------ */
/begin COMPU_METHOD FORMULA_0414 "FORMULA_0414" TAB_VERB "%3.0" "-" COMPU_TAB_REF FORMULA_0414_VTAB /end COMPU_METHOD
/begin COMPU_VTAB FORMULA_0414_VTAB "FORMULA_0414_VTAB" TAB_VERB 63 45 "-" 48 "0" 49 "1" 50 "2" 51 "3" 52 "4" 53 "5" 54 "6" 55 "7" 56 "8" 57 "9" 65 "A" 66 "B" 67 "C" 68 "D" 69 "E" 70 "F" 71 "G" 72 "H" 73 "I" 74 "J" 75 "K" 76 "L" 77 "M" 78 "N" 79 "O" 80 "P" 81 "Q" 82 "R" 83 "S" 84 "T" 85 "U" 86 "V" 87 "W" 88 "X" 89 "Y" 90 "Z" 97 "a" 98 "b" 99 "c" 100 "d" 101 "e" 102 "f" 103 "g" 104 "h" 105 "i" 106 "j" 107 "k" 108 "l" 109 "m" 110 "n" 111 "o" 112 "p" 113 "q" 114 "r" 115 "s" 116 "t" 117 "u" 118 "v" 119 "w" 120 "x" 121 "y" 122 "z" DEFAULT_VALUE "DEZ" /end COMPU_VTAB
/* ------------------ Abschnitt erzeugt aus adapt.dat ------------------ */
/begin COMPU_METHOD FORMULA_0418 "FORMULA_0418" RAT_FUNC "%8.3" "V" COEFFS 0 1024 0 0 0 5 /end COMPU_METHOD
/begin COMPU_METHOD FORMULA_0419 "FORMULA_0419" RAT_FUNC "%8.3" "V" COEFFS 0 2048 0 0 0 5 /end COMPU_METHOD
/begin COMPU_METHOD FORMULA_0420 "FORMULA_0420" RAT_FUNC "%3.0" "mal" COEFFS 0 1 0 0 0 1 /end COMPU_METHOD
/begin COMPU_METHOD FORMULA_0421 "FORMULA_0421" TAB_VERB "%3.0" "-" COMPU_TAB_REF FORMULA_0421_VTAB /end COMPU_METHOD
/begin COMPU_VTAB FORMULA_0421_VTAB "FORMULA_0421_VTAB" TAB_VERB 1 0 "Kein Testwert 1" DEFAULT_VALUE "Testwert ermittelt" /end COMPU_VTAB
/begin COMPU_METHOD FORMULA_0422 "FORMULA_0422" RAT_FUNC "%7.2" "qmm" COEFFS 0 100 0 0 0 1 /end COMPU_METHOD
/begin COMPU_METHOD FORMULA_0423 "FORMULA_0423" RAT_FUNC "%3.0" "Bit" COEFFS 0 1 0 0 0 4 /end COMPU_METHOD
/begin COMPU_METHOD FORMULA_0424 "FORMULA_0424" TAB_VERB "%5.2" "-" COMPU_TAB_REF FORMULA_0424_VTAB /end COMPU_METHOD
/begin COMPU_VTAB FORMULA_0424_VTAB "FORMULA_0424_VTAB" TAB_VERB 5 0 "offen" 1 "geschlossen" 2 "oeffnet" 3 "schliesst" 7 "Fehler" /end COMPU_VTAB
/begin COMPU_METHOD FORMULA_0425 "FORMULA_0425" TAB_VERB "%5.2" "-" COMPU_TAB_REF FORMULA_0425_VTAB /end COMPU_METHOD
/begin COMPU_VTAB FORMULA_0425_VTAB "FORMULA_0425_VTAB" TAB_VERB 11 0 "Geschaltet" 1 "Aktiv" 2 "ZWK aktiv" 3 "synchronisiert" 4 "SW Neutral" 5 "vorspannen" 6 "Init" 7 "Synchron fertig" 8 "vor Synchron" 9 "vor Synchron aktiv" 15 "Fehler" /end COMPU_VTAB
/begin COMPU_METHOD FORMULA_0426 "FORMULA_0426" TAB_VERB "%3.0" "-" COMPU_TAB_REF FORMULA_0426_VTAB /end COMPU_METHOD
/begin COMPU_VTAB FORMULA_0426_VTAB "FORMULA_0426_VTAB" TAB_VERB 11 0 "undef" 1 "Anfahren" 2 "Anfahren-KD" 3 "Wait-RS" 4 "Anfahren-RS" 5 "Schalten" 6 "Einkuppeln" 7 "Anhalten" 8 "Abwuergen" 9 "Radabriss" 15 "Fehler" /end COMPU_VTAB
/begin COMPU_METHOD FORMULA_0427 "FORMULA_0427" TAB_VERB "%5.2" "-" COMPU_TAB_REF FORMULA_0427_VTAB /end COMPU_METHOD
/begin COMPU_VTAB FORMULA_0427_VTAB "FORMULA_0427_VTAB" TAB_VERB 2 0 "offen" 1 "geschlossen" DEFAULT_VALUE "undef" /end COMPU_VTAB
/begin COMPU_METHOD FORMULA_0428 "FORMULA_0428" TAB_VERB "%5.2" "-" COMPU_TAB_REF FORMULA_0428_VTAB /end COMPU_METHOD
/begin COMPU_VTAB FORMULA_0428_VTAB "FORMULA_0428_VTAB" TAB_VERB 4 0 "kein Abbruch" 1 "Ablauf-Timeout" 2 "CAN-Timeout" 16 "Doppelschaltung" DEFAULT_VALUE "undef" /end COMPU_VTAB
/begin COMPU_METHOD FORMULA_0429 "FORMULA_0429" TAB_VERB "%5.0" "-" COMPU_TAB_REF FORMULA_0429_VTAB /end COMPU_METHOD
/begin COMPU_VTAB FORMULA_0429_VTAB "FORMULA_0429_VTAB" TAB_VERB 8 0 "kein Fehler" 1 "R-Mode" 2 "Diagnose" 8 "CAN-Fehler" 16 "NP-Err" 32 "SK-Fehler" 12 "Alive" 64 "Startup" DEFAULT_VALUE "Mehrfachfehler" /end COMPU_VTAB
/begin COMPU_METHOD FORMULA_0430 "FORMULA_0430" TAB_VERB "%7.2" "-" COMPU_TAB_REF FORMULA_0430_VTAB /end COMPU_METHOD
/begin COMPU_VTAB FORMULA_0430_VTAB "FORMULA_0430_VTAB" TAB_VERB 9 0 "kein Fehler" 1 "Soll-Vgl" 2 "Soll-Ist-Vgl" 4 "Mode-Vgl" 8 "CAN-Wert" 16 "Spalt offen" 32 "Klemmen offen" 64 "CAN-Istwert" 128 "WDK-CAN-Vgl" DEFAULT_VALUE "Mehrfachfehler" /end COMPU_VTAB
/begin COMPU_METHOD FORMULA_0431 "FORMULA_0431" TAB_VERB "%5.0" "-" COMPU_TAB_REF FORMULA_0431_VTAB /end COMPU_METHOD
/begin COMPU_VTAB FORMULA_0431_VTAB "FORMULA_0431_VTAB" TAB_VERB 17 0 "kein Fehler" 1 "RAM-Fehler" 2 "ROM-Fehler" 4 "A/D Wandler-Fehler" 8 "Software Reset" 16 "CAN-Bus Fehler" 32 "CAN-Timeout" 64 "CAN-Fehler Chksum" 128 "CAN-Fehler Alive" 256 "Zylinderbankzuordnung" 512 "Bereichsueberwachung" 1024 "Gradientenueberwachung" 2048 "Lagereglerueberwachung" 4096 "therm. Ueberlast" 8192 "Motorschutz" 16384 "NP-Fehler" 32768 "NP-Abbruch" DEFAULT_VALUE "Mehrfachfehler" /end COMPU_VTAB
/begin COMPU_METHOD FORMULA_0432 "FORMULA_0432" TAB_VERB "%3.0" "-" COMPU_TAB_REF FORMULA_0432_VTAB /end COMPU_METHOD
/begin COMPU_VTAB FORMULA_0432_VTAB "FORMULA_0432_VTAB" TAB_VERB 6 1 "oA aus" 2 "oA aktiv" 4 "oA erfolgreich" 9 "oA abgelehnt" 10 "oA abgebrochen" 12 "oA fehlerhaft" DEFAULT_VALUE "undef" /end COMPU_VTAB
/begin COMPU_METHOD FORMULA_0433 "FORMULA_0433" TAB_VERB "%3.0" "-" COMPU_TAB_REF FORMULA_0433_VTAB /end COMPU_METHOD
/begin COMPU_VTAB FORMULA_0433_VTAB "FORMULA_0433_VTAB" TAB_VERB 7 0 "Init" 1 "Inaktiv" 2 "NP-Adapt" 4 "Aktiv" 8 "Zust bb" 10 "Federtest" 15 "Failsafe" /end COMPU_VTAB
/begin COMPU_METHOD FORMULA_0434 "FORMULA_0434" TAB_VERB "%5.2" "-" COMPU_TAB_REF FORMULA_0434_VTAB /end COMPU_METHOD
/begin COMPU_VTAB FORMULA_0434_VTAB "FORMULA_0434_VTAB" TAB_VERB 5 0 "Wait" 1 "Inaktiv" 2 "Aktiv" 3 "Aktiv/Adapt" 255 "Failsafe" /end COMPU_VTAB
/begin COMPU_METHOD FORMULA_0435 "FORMULA_0435" RAT_FUNC "%6.1" "%" COEFFS 0 32768 0 0 0 100 /end COMPU_METHOD
/begin COMPU_METHOD FORMULA_0436 "FORMULA_0436" TAB_VERB "%3.0" "-" COMPU_TAB_REF FORMULA_0436_VTAB /end COMPU_METHOD
/begin COMPU_VTAB FORMULA_0436_VTAB "FORMULA_0436_VTAB" TAB_VERB 7 0 "kein Fehler" 1 "Md-Chk0" 2 "Md-Chk" 4 "MDmin-Chk" 8 "Rf-Chk" 16 "Eta-Chk" 32 "LLR-Chk" DEFAULT_VALUE "Mehrfach" /end COMPU_VTAB
/begin COMPU_METHOD FORMULA_0437 "FORMULA_0437" TAB_VERB "%3.0" "-" COMPU_TAB_REF FORMULA_0437_VTAB /end COMPU_METHOD
/begin COMPU_VTAB FORMULA_0437_VTAB "FORMULA_0437_VTAB" TAB_VERB 1 0 "nein" DEFAULT_VALUE "ja" /end COMPU_VTAB
/begin COMPU_METHOD FORMULA_0438 "FORMULA_0438" TAB_VERB "%3.0" "-" COMPU_TAB_REF FORMULA_0438_VTAB /end COMPU_METHOD
/begin COMPU_VTAB FORMULA_0438_VTAB "FORMULA_0438_VTAB" TAB_VERB 22 0 "Fahrer" 1 "Getr" 2 "ASC" 3 "MSR" 4 "Schub" 5 "MCS" 16 "Fahrer+LLR" 17 "Getr+LLR" 18 "ASC+LLR" 19 "MSR+LLR" 32 "Fahrer+AR" 33 "Getr+AR" 34 "ASC+AR" 35 "MSR+AR" 64 "Fahrer+Begr" 65 "Getr+Begr" 66 "ASC+Begr" 67 "MSR+Begr" 128 "Fahrer+SK" 129 "Getr+SK" 130 "ASC+SK" 131 "MSR+SK" DEFAULT_VALUE "Mehrfach" /end COMPU_VTAB
/begin COMPU_METHOD FORMULA_0439 "FORMULA_0439" RAT_FUNC "%8.3" "0/oo" COEFFS 0 4194.304 0 0 0 1 /end COMPU_METHOD
/begin COMPU_METHOD FORMULA_0440 "FORMULA_0440" RAT_FUNC "%7.0" "U*2" COEFFS 0 1 0 0 0 1 /end COMPU_METHOD
/begin COMPU_METHOD FORMULA_0441 "FORMULA_0441" TAB_VERB "%3.0" "-" COMPU_TAB_REF FORMULA_0441_VTAB /end COMPU_METHOD
/begin COMPU_VTAB FORMULA_0441_VTAB "FORMULA_0441_VTAB" TAB_VERB 4 0 "aus" 2 "FF" 4 "MIL" 6 "FF+MIL" /end COMPU_VTAB
/begin COMPU_METHOD FORMULA_0442 "FORMULA_0442" RAT_FUNC "%11.4" "m/(s*s)" COEFFS 0 2867200000 0 0 0 19613 /end COMPU_METHOD
/begin COMPU_METHOD FORMULA_0443 "FORMULA_0443" RAT_FUNC "%7.2" "V" COEFFS 0 1 0 0 0 0.00080566 /end COMPU_METHOD
/begin COMPU_METHOD FORMULA_0444 "FORMULA_0444" RAT_FUNC "%7.2" "mg" COEFFS 0 64 0 0 0 1 /end COMPU_METHOD
/begin COMPU_METHOD FORMULA_0445 "FORMULA_0445" RAT_FUNC "%3.0" "-" COEFFS 0 1 0 0 0 4 /end COMPU_METHOD
/begin COMPU_METHOD FORMULA_0446 "FORMULA_0446" TAB_VERB "%5.0" "-" COMPU_TAB_REF FORMULA_0446_VTAB /end COMPU_METHOD
/begin COMPU_VTAB FORMULA_0446_VTAB "FORMULA_0446_VTAB" TAB_VERB 2 0 "leer" 1 "gespeichert" DEFAULT_VALUE "eingefroren" /end COMPU_VTAB
/begin COMPU_METHOD FORMULA_0447 "FORMULA_0447" RAT_FUNC "%7.2" "ms" COEFFS 0 7000 0 0 0 1 /end COMPU_METHOD
/begin COMPU_METHOD FORMULA_0448 "FORMULA_0448" RAT_FUNC "%7.2" "ms" COEFFS 0 250 0 0 0 1 /end COMPU_METHOD
/begin COMPU_METHOD FORMULA_0449 "FORMULA_0449" RAT_FUNC "%7.2" "*" COEFFS 0 1024 0 0 0 1 /end COMPU_METHOD
/begin COMPU_METHOD FORMULA_0450 "FORMULA_0450" RAT_FUNC "%8.3" "%" COEFFS 0 640 0 0 0 1 /end COMPU_METHOD
/begin COMPU_METHOD FORMULA_0451 "FORMULA_0451" RAT_FUNC "%9.2" "s" COEFFS 0 200 0 0 0 1 /end COMPU_METHOD
/begin COMPU_METHOD FORMULA_0452 "FORMULA_0452" RAT_FUNC "%6.1" "trmp" COEFFS 0 16 0 0 0 1 /end COMPU_METHOD
/* ------------------ Abschnitt erzeugt aus adapt_wichtig.dat ------------------ */
/begin COMPU_METHOD FORMULA_0453 "FORMULA_0453" RAT_FUNC "%7.0" "mal" COEFFS 0 1 0 0 0 1 /end COMPU_METHOD
/begin COMPU_METHOD FORMULA_0454 "FORMULA_0454" RAT_FUNC "%5.0" "bytes" COEFFS 0 1 0 0 0 4 /end COMPU_METHOD
/begin COMPU_METHOD FORMULA_0455 "FORMULA_0455" RAT_FUNC "%5.0" "VERS" COEFFS 0 1 0 0 0 1 /end COMPU_METHOD
/begin COMPU_METHOD FORMULA_0456 "FORMULA_0456" RAT_FUNC "%8.1" "s" COEFFS 0 10 0 0 0 1 /end COMPU_METHOD
/begin COMPU_METHOD FORMULA_0457 "FORMULA_0457" RAT_FUNC "%5.0" "zyklen" COEFFS 0 1 0 0 0 1 /end COMPU_METHOD
/begin COMPU_METHOD FORMULA_0458 "FORMULA_0458" RAT_FUNC "%7.2" "m/(s*s)" COEFFS 0 286720 0 0 0 19613 /end COMPU_METHOD
/begin COMPU_METHOD FORMULA_0679 "FORMULA_0679" RAT_FUNC "%5.2" "s" COEFFS 0 0 25.6 0 1 0 /end COMPU_METHOD
/* ------------------ Abschnitt erzeugt aus tabg.dat ------------------ */
/begin COMPU_METHOD FORMULA_0975 "FORMULA_0975" RAT_FUNC "%7.2" "Kelvin" COEFFS 0 100 0 0 0 1 /end COMPU_METHOD
/begin COMPU_METHOD FORMULA_0976 "FORMULA_0976" TAB_VERB "%3.0" "-" COMPU_TAB_REF FORMULA_0976_VTAB /end COMPU_METHOD
/begin COMPU_VTAB FORMULA_0976_VTAB "FORMULA_0976_VTAB" TAB_VERB 3 0 "Messwert" 1 "Modell" 2 "kein Sensor" /end COMPU_VTAB
/begin COMPU_METHOD FORMULA_0977 "FORMULA_0977" TAB_VERB "%3.0" "-" COMPU_TAB_REF FORMULA_0977_VTAB /end COMPU_METHOD
/begin COMPU_VTAB FORMULA_0977_VTAB "FORMULA_0977_VTAB" TAB_VERB 2 0 "Messwert" 1 "Modell" /end COMPU_VTAB
/begin COMPU_METHOD FORMULA_0978 "FORMULA_0978" RAT_FUNC "%9.4" "W/Km�" COEFFS 0 1000 0 0 0 1 /end COMPU_METHOD
/begin COMPU_METHOD FORMULA_0979 "FORMULA_0979" RAT_FUNC "%9.4" "Wh/Km�km" COEFFS 0 10000 0 0 0 1 /end COMPU_METHOD
/begin COMPU_METHOD FORMULA_0980 "FORMULA_0980" RAT_FUNC "%7.2" "Kelvin" COEFFS 0 20 0 0 0 1 /end COMPU_METHOD
/begin COMPU_METHOD FORMULA_0981 "FORMULA_0981" RAT_FUNC "%7.2" "K/100ms" COEFFS 0 20 0 0 0 1 /end COMPU_METHOD
/begin COMPU_METHOD FORMULA_0982 "FORMULA_0982" RAT_FUNC "%5.0" "J/(kg*K)" COEFFS 0 1 0 0 0 1 /end COMPU_METHOD
/begin COMPU_METHOD FORMULA_0983 "FORMULA_0983" RAT_FUNC "%5.0" "J/Kelvin" COEFFS 0 1 0 0 0 1 /end COMPU_METHOD
/begin COMPU_METHOD FORMULA_0984 "FORMULA_0984" RAT_FUNC "%9.4" "m�" COEFFS 0 10000 0 0 0 1 /end COMPU_METHOD
/begin COMPU_METHOD FORMULA_0985 "FORMULA_0985" RAT_FUNC "%6.1" "Kelvin/s" COEFFS 0 10 0 0 0 1 /end COMPU_METHOD
/begin COMPU_METHOD FORMULA_0986 "FORMULA_0986" RAT_FUNC "%7.2" "min" COEFFS 0 60 0 0 0 1 /end COMPU_METHOD
/* ------------------ Abschnitt erzeugt aus tan.dat ------------------ */
/begin COMPU_METHOD FORMULA_0987 "FORMULA_0987" RAT_FUNC "%8.3" "�C" COEFFS 0 40 10926 0 0 1 /end COMPU_METHOD
/begin COMPU_METHOD FORMULA_0988 "FORMULA_0988" RAT_FUNC "%7.2" "s" COEFFS 0 0 6553.5 0 1 0 /end COMPU_METHOD
/begin COMPU_METHOD FORMULA_0989 "FORMULA_0989" TAB_VERB "%3.0" "-" COMPU_TAB_REF FORMULA_0989_VTAB /end COMPU_METHOD
/begin COMPU_VTAB FORMULA_0989_VTAB "FORMULA_0989_VTAB" TAB_VERB 5 0 "O.K." 1 "Fehler HFM" 2 "Fehler TMOT" 4 "Fehler TUMG" 8 "Fehler time_ms" DEFAULT_VALUE "undef" /end COMPU_VTAB
/begin COMPU_METHOD FORMULA_0990 "FORMULA_0990" TAB_VERB "%3.0" "-" COMPU_TAB_REF FORMULA_0990_VTAB /end COMPU_METHOD
/begin COMPU_VTAB FORMULA_0990_VTAB "FORMULA_0990_VTAB" TAB_VERB 3 0 "kein Ersatzwert" 1 "HFM1 ist Ersatzwert" 2 "HFM2 ist Ersatzwert" DEFAULT_VALUE "undef" /end COMPU_VTAB
/begin COMPU_METHOD FORMULA_0991 "FORMULA_0991" TAB_VERB "%3.0" "-" COMPU_TAB_REF FORMULA_0991_VTAB /end COMPU_METHOD
/begin COMPU_VTAB FORMULA_0991_VTAB "FORMULA_0991_VTAB" TAB_VERB 3 0 "Bedingungen" 1 "O.K." 16 "Fehler" DEFAULT_VALUE "undef" /end COMPU_VTAB
/begin COMPU_METHOD FORMULA_0992 "FORMULA_0992" TAB_VERB "%3.0" "-" COMPU_TAB_REF FORMULA_0992_VTAB /end COMPU_METHOD
/begin COMPU_VTAB FORMULA_0992_VTAB "FORMULA_0992_VTAB" TAB_VERB 3 0 "Fehlt" 1 "O.K." 16 "Fehler" DEFAULT_VALUE "undef" /end COMPU_VTAB
/begin COMPU_METHOD FORMULA_0993 "FORMULA_0993" RAT_FUNC "%7.2" "s" COEFFS 0 10 0 0 0 1 /end COMPU_METHOD
/begin COMPU_METHOD FORMULA_0994 "FORMULA_0994" TAB_VERB "%5.2" "-" COMPU_TAB_REF FORMULA_0994_VTAB /end COMPU_METHOD
/begin COMPU_VTAB FORMULA_0994_VTAB "FORMULA_0994_VTAB" TAB_VERB 2 0 "Disabled" 1 "Enabled" /end COMPU_VTAB
/begin COMPU_METHOD FORMULA_0995 "FORMULA_0995" TAB_VERB "%5.2" "-" COMPU_TAB_REF FORMULA_0995_VTAB /end COMPU_METHOD
/begin COMPU_VTAB FORMULA_0995_VTAB "FORMULA_0995_VTAB" TAB_VERB 2 0 "Not Allowed" 1 "Allowed" /end COMPU_VTAB
/begin COMPU_METHOD FORMULA_0996 "FORMULA_0996" TAB_VERB "%5.2" "-" COMPU_TAB_REF FORMULA_0996_VTAB /end COMPU_METHOD
/begin COMPU_VTAB FORMULA_0996_VTAB "FORMULA_0996_VTAB" TAB_VERB 2 0 "All Conditions" 1 "No Conditions" /end COMPU_VTAB
/begin COMPU_METHOD FORMULA_0997 "FORMULA_0997" RAT_FUNC "%5.0" "Kelvin/s" COEFFS 0 1 0 0 0 1 /end COMPU_METHOD
/* ------------------ Abschnitt erzeugt aus adapt_common.dat ------------------ */
/begin MEASUREMENT crc32_prog_carb_nv "Programm-CRC fuer Mode 9" ULONG FORMULA_0000 0 0 0.0 4294967295.0000 ECU_ADDRESS 0x3F9190 /end MEASUREMENT
/begin MEASUREMENT crc32_data_carb_nv "Daten-CRC fuer Mode 9" ULONG FORMULA_0000 0 0 0.0 4294967295.0000 ECU_ADDRESS 0x3F9194 /end MEASUREMENT
/begin MEASUREMENT ram_chk_err_adr_nv "Fehleradresse vom RamCheck" ULONG FORMULA_0000 0 0 0.0 4294967295.0000 ECU_ADDRESS 0x3F9198 /end MEASUREMENT
/begin MEASUREMENT sys_zust_cpu_last_max_nv "Maximale CPU Last" UWORD FORMULA_0001 0 0 0.0 100.0000 ECU_ADDRESS 0x3F919C /end MEASUREMENT
/begin MEASUREMENT spim_errorcode_reinit_nv "Errorcode weswegen ein SPI-Reinit ausgefuehrt wurde" UBYTE FORMULA_0002 0 0 0.0 255.0 ECU_ADDRESS 0x3F919E /end MEASUREMENT
/begin MEASUREMENT spim_error_reinit_ctr_nv "SPI-reinits durch Fehlverhalten" UBYTE FORMULA_0003 0 0 0.0 255.0000 ECU_ADDRESS 0x3F919F /end MEASUREMENT
/begin MEASUREMENT spim_chain_error_nv "SPI Chains Fehler" UBYTE FORMULA_0004 0 0 0.0 255.0 ECU_ADDRESS 0x3F91A0 /end MEASUREMENT
/begin MEASUREMENT ipk_sync_errorcount_nv "Fehlerzaehler fuer Sync-Timeout" UBYTE FORMULA_0003 0 0 0.0 255.0000 ECU_ADDRESS 0x3F91A1 /end MEASUREMENT
/begin MEASUREMENT ipk_sync_error_st_nv "IPK Sync Error im Hochlauf" UBYTE FORMULA_0005 0 0 0.0 255.0 ECU_ADDRESS 0x3F91A2 /end MEASUREMENT
/begin MEASUREMENT sk_ff.n "Drehzahl" SWORD FORMULA_0006 0 0 0.0 10000.0000 ECU_ADDRESS 0x3F91A4 /end MEASUREMENT
/begin MEASUREMENT sk_ff.rf_m "Fuellung" SWORD FORMULA_0007 0 0 0.0 2.0000 ECU_ADDRESS 0x3F91A6 /end MEASUREMENT
/begin MEASUREMENT sk_ff.ub "Spannung" SWORD FORMULA_0008 0 0 0.0 28.0000 ECU_ADDRESS 0x3F91A8 /end MEASUREMENT
/begin MEASUREMENT sk_ff.kupp_wunsch_ges "Wunschmoment" SWORD FORMULA_0009 0 0 -100.0000 1000.0000 ECU_ADDRESS 0x3F91AA /end MEASUREMENT
/begin MEASUREMENT sk_ff.kupp_ist "Istmoment" SWORD FORMULA_0009 0 0 -100.0000 1000.0000 ECU_ADDRESS 0x3F91AC /end MEASUREMENT
/begin MEASUREMENT sk_ff.pwg_soll "Pedalwert" SWORD FORMULA_0001 0 0 -10.0000 120.0000 ECU_ADDRESS 0x3F91AE /end MEASUREMENT
/begin MEASUREMENT sk_ff.fail_st_zyl "Ausblender" UWORD FORMULA_0010 0 0 0.0 65535.0000 ECU_ADDRESS 0x3F91B0 /end MEASUREMENT
/begin MEASUREMENT sk_ff.ursache "Ursache fuer SK-Eingriff" UWORD FORMULA_0011 0 0 0.0 65535.0 ECU_ADDRESS 0x3F91B2 /end MEASUREMENT
/begin MEASUREMENT sk_ff.egas_sk_mode "SK-Mode Egas" UBYTE FORMULA_0012 0 0 0.0 255.0 ECU_ADDRESS 0x3F91B4 /end MEASUREMENT
/begin MEASUREMENT sk_ff.md_sk_mode "SK-Mode Momentenmanager" UBYTE FORMULA_0012 0 0 0.0 255.0 ECU_ADDRESS 0x3F91B5 /end MEASUREMENT
/begin MEASUREMENT sk_ff.smg_sk_mode "SK-Mode SMG" UBYTE FORMULA_0012 0 0 0.0 255.0 ECU_ADDRESS 0x3F91B6 /end MEASUREMENT
/begin MEASUREMENT sk_ff.crc32_result "CRC-Fehler" UBYTE FORMULA_0013 0 0 0.0 255.0 ECU_ADDRESS 0x3F91B7 /end MEASUREMENT
/begin MEASUREMENT sk_ff.os_err_cnt "OS-Err: Summe" UBYTE FORMULA_0003 0 0 0.0 255.0000 ECU_ADDRESS 0x3F91B8 /end MEASUREMENT
/begin MEASUREMENT sk_ff.os_err_type "Fehlertyp" UBYTE FORMULA_0014 0 0 0.0 255.0 ECU_ADDRESS 0x3F91B9 /end MEASUREMENT
/begin MEASUREMENT sk_ff.reset_cnt "Resetzaehler" UBYTE FORMULA_0003 0 0 0.0 255.0000 ECU_ADDRESS 0x3F91BA /end MEASUREMENT
/begin MEASUREMENT sk_ff.stufe "SK-Stufe" UBYTE FORMULA_0003 0 0 0.0 255.0000 ECU_ADDRESS 0x3F91BB /end MEASUREMENT
/begin MEASUREMENT sk_ff.os_err_addr "OS-Err: Adresse" ULONG FORMULA_0000 0 0 0.0 4294967295.0000 ECU_ADDRESS 0x3F91BC /end MEASUREMENT
/begin MEASUREMENT sk_ff.proz_err "Prozess-Fehler" UWORD FORMULA_0010 0 0 0.0 65535.0000 ECU_ADDRESS 0x3F91C0 /end MEASUREMENT
/begin MEASUREMENT sk_ff.task_err "Task-Fehler" UWORD FORMULA_0010 0 0 0.0 65535.0000 ECU_ADDRESS 0x3F91C2 /end MEASUREMENT
/begin MEASUREMENT tpu_kw_irq_info_cnt_nv_a "Anzahl Infointerrupts (+/- ein Zahn)." UBYTE FORMULA_0003 0 0 0.0 255.0000 ECU_ADDRESS 0x3F91C4 /end MEASUREMENT
/begin MEASUREMENT tpu_kw_irq_info_cnt_nv_b "Anzahl Infointerrupts (+/- ein Zahn)." UBYTE FORMULA_0003 0 0 0.0 255.0000 ECU_ADDRESS 0x3F91C5 /end MEASUREMENT
/begin MEASUREMENT pctrl_task_err_nv "Fehler Taskueberwachung" UBYTE FORMULA_0003 0 0 0.0 255.0000 ECU_ADDRESS 0x3F91C6 /end MEASUREMENT
/begin MEASUREMENT pctrl_proz_err_nv "Fehler Prozessueberwachung" UWORD FORMULA_0010 0 0 0.0 65535.0000 ECU_ADDRESS 0x3F91C8 /end MEASUREMENT
/begin MEASUREMENT sys_exc_vec_nv "Exception-Vector" UWORD FORMULA_0015 0 0 0.0 65535.0 ECU_ADDRESS 0x3F91CA /end MEASUREMENT
/begin MEASUREMENT sys_exc_lr_nv "Exception-Linkregister" ULONG FORMULA_0000 0 0 0.0 4294967295.0000 ECU_ADDRESS 0x3F91CC /end MEASUREMENT
/begin MEASUREMENT sys_exc_addr_nv "Exception-Adresse" ULONG FORMULA_0000 0 0 0.0 4294967295.0000 ECU_ADDRESS 0x3F91D0 /end MEASUREMENT
/begin MEASUREMENT sys_rsr_cnt_nv.ehrs "ExtHardReset" UBYTE FORMULA_0003 0 0 0.0 255.0000 ECU_ADDRESS 0x3F91D4 /end MEASUREMENT
/begin MEASUREMENT sys_rsr_cnt_nv.esrs "ExtSoftReset" UBYTE FORMULA_0003 0 0 0.0 255.0000 ECU_ADDRESS 0x3F91D5 /end MEASUREMENT
/begin MEASUREMENT sys_rsr_cnt_nv.llrs "LossOfClockReset" UBYTE FORMULA_0003 0 0 0.0 255.0000 ECU_ADDRESS 0x3F91D6 /end MEASUREMENT
/begin MEASUREMENT sys_rsr_cnt_nv.swrs "WatchdogReset" UBYTE FORMULA_0003 0 0 0.0 255.0000 ECU_ADDRESS 0x3F91D7 /end MEASUREMENT
/begin MEASUREMENT sys_rsr_cnt_nv.csrs "ChkstopReset" UBYTE FORMULA_0003 0 0 0.0 255.0000 ECU_ADDRESS 0x3F91D8 /end MEASUREMENT
/begin MEASUREMENT sys_rsr_cnt_nv.dbhrs "DebugHardReset" UBYTE FORMULA_0003 0 0 0.0 255.0000 ECU_ADDRESS 0x3F91D9 /end MEASUREMENT
/begin MEASUREMENT sys_rsr_cnt_nv.dbsrs "DebugSoftReset" UBYTE FORMULA_0003 0 0 0.0 255.0000 ECU_ADDRESS 0x3F91DA /end MEASUREMENT
/begin MEASUREMENT sys_rsr_cnt_nv.jtrs "JTAGReset" UBYTE FORMULA_0003 0 0 0.0 255.0000 ECU_ADDRESS 0x3F91DB /end MEASUREMENT
/begin MEASUREMENT sys_rsr_cnt_nv.ocrs "OnChipReset" UBYTE FORMULA_0003 0 0 0.0 255.0000 ECU_ADDRESS 0x3F91DC /end MEASUREMENT
/begin MEASUREMENT sys_rsr_cnt_nv.ilbc "IllegalBitChangeReset" UBYTE FORMULA_0003 0 0 0.0 255.0000 ECU_ADDRESS 0x3F91DD /end MEASUREMENT
/begin MEASUREMENT sys_rsr_cnt_nv.gpor "GlitchPowerOnReset" UBYTE FORMULA_0003 0 0 0.0 255.0000 ECU_ADDRESS 0x3F91DE /end MEASUREMENT
/begin MEASUREMENT sys_rsr_cnt_nv.ghrst "GlitchHPinReset" UBYTE FORMULA_0003 0 0 0.0 255.0000 ECU_ADDRESS 0x3F91DF /end MEASUREMENT
/begin MEASUREMENT sys_rsr_cnt_nv.gsrst "GlitchSPinReset" UBYTE FORMULA_0003 0 0 0.0 255.0000 ECU_ADDRESS 0x3F91E0 /end MEASUREMENT
/begin MEASUREMENT ccp_retry_cnt_nv "Download Retryzaehler" UWORD FORMULA_0010 0 0 0.0 65535.0000 ECU_ADDRESS 0x3F91E2 /end MEASUREMENT
/begin MEASUREMENT tpu_kw_err_ff_a.state "Zustand der TPU" UBYTE FORMULA_0016 0 0 0.0 255.0 ECU_ADDRESS 0x3F91E4 /end MEASUREMENT
/begin MEASUREMENT tpu_kw_err_ff_b.state "Zustand der TPU" UBYTE FORMULA_0016 0 0 0.0 255.0 ECU_ADDRESS 0x3F91FC /end MEASUREMENT
/begin MEASUREMENT tpu_kw_err_ff_a.tooth "Abrisszahn" UBYTE FORMULA_0003 0 0 0.0 255.0000 ECU_ADDRESS 0x3F91E5 /end MEASUREMENT
/begin MEASUREMENT tpu_kw_err_ff_b.tooth "Abrisszahn" UBYTE FORMULA_0003 0 0 0.0 255.0000 ECU_ADDRESS 0x3F91FD /end MEASUREMENT
/begin MEASUREMENT tpu_kw_err_ff_a.irq "Interruptarten" UBYTE FORMULA_0003 0 0 0.0 255.0000 ECU_ADDRESS 0x3F91E6 /end MEASUREMENT
/begin MEASUREMENT tpu_kw_err_ff_b.irq "Interruptarten" UBYTE FORMULA_0003 0 0 0.0 255.0000 ECU_ADDRESS 0x3F91FE /end MEASUREMENT
/begin MEASUREMENT tpu_kw_err_ff_a.cnt "Abrisszaehler" UBYTE FORMULA_0003 0 0 0.0 255.0000 ECU_ADDRESS 0x3F91E7 /end MEASUREMENT
/begin MEASUREMENT tpu_kw_err_ff_b.cnt "Abrisszaehler" UBYTE FORMULA_0003 0 0 0.0 255.0000 ECU_ADDRESS 0x3F91FF /end MEASUREMENT
/begin MEASUREMENT tpu_kw_err_ff_a.n "Abrissdrehzahl" SWORD FORMULA_0006 0 0 0.0 10000.0000 ECU_ADDRESS 0x3F91E8 /end MEASUREMENT
/begin MEASUREMENT tpu_kw_err_ff_b.n "Abrissdrehzahl" SWORD FORMULA_0006 0 0 0.0 10000.0000 ECU_ADDRESS 0x3F9200 /end MEASUREMENT
/begin MEASUREMENT tpu_kw_err_ff_a.n_zahn "Abrisszahndrehzahl" SWORD FORMULA_0006 0 0 0.0 10000.0000 ECU_ADDRESS 0x3F91EA /end MEASUREMENT
/begin MEASUREMENT tpu_kw_err_ff_b.n_zahn "Abrisszahndrehzahl" SWORD FORMULA_0006 0 0 0.0 10000.0000 ECU_ADDRESS 0x3F9202 /end MEASUREMENT
/begin MEASUREMENT tpu_kw_err_ff_a.prev_period "vorletzte Zahnperiode" ULONG FORMULA_0017 0 0 0.0 2396.7450 ECU_ADDRESS 0x3F91EC /end MEASUREMENT
/begin MEASUREMENT tpu_kw_err_ff_b.prev_period "vorletzte Zahnperiode" ULONG FORMULA_0017 0 0 0.0 2396.7450 ECU_ADDRESS 0x3F9204 /end MEASUREMENT
/begin MEASUREMENT tpu_kw_err_ff_a.last_period "letzte Zahnperiode" ULONG FORMULA_0017 0 0 0.0 2396.7450 ECU_ADDRESS 0x3F91F0 /end MEASUREMENT
/begin MEASUREMENT tpu_kw_err_ff_b.last_period "letzte Zahnperiode" ULONG FORMULA_0017 0 0 0.0 2396.7450 ECU_ADDRESS 0x3F9208 /end MEASUREMENT
/begin MEASUREMENT tpu_kw_err_ff_a.event_time "letzte Ereigniszeit" ULONG FORMULA_0017 0 0 0.0 2396.7450 ECU_ADDRESS 0x3F91F4 /end MEASUREMENT
/begin MEASUREMENT tpu_kw_err_ff_b.event_time "letzte Ereigniszeit" ULONG FORMULA_0017 0 0 0.0 2396.7450 ECU_ADDRESS 0x3F920C /end MEASUREMENT
/begin MEASUREMENT tpu_kw_err_ff_a.tooth_time "letzte Zahnzeit" ULONG FORMULA_0017 0 0 0.0 2396.7450 ECU_ADDRESS 0x3F91F8 /end MEASUREMENT
/begin MEASUREMENT tpu_kw_err_ff_b.tooth_time "letzte Zahnzeit" ULONG FORMULA_0017 0 0 0.0 2396.7450 ECU_ADDRESS 0x3F9210 /end MEASUREMENT
/begin MEASUREMENT os_err_ff.ptr "Zeiger auf Ringspeicher" ULONG FORMULA_0000 0 0 0.0 4294967295.0000 ECU_ADDRESS 0x3F9214 /end MEASUREMENT
/begin MEASUREMENT os_err_ff.addr_0 "Adresse wo letzte Exception her kam" ULONG FORMULA_0000 0 0 0.0 4294967295.0000 ECU_ADDRESS 0x3F9218 /end MEASUREMENT
/begin MEASUREMENT os_err_ff.addr_1 "Adresse wo letzte Exception her kam" ULONG FORMULA_0000 0 0 0.0 4294967295.0000 ECU_ADDRESS 0x3F921C /end MEASUREMENT
/begin MEASUREMENT os_err_ff.addr_2 "Adresse wo letzte Exception her kam" ULONG FORMULA_0000 0 0 0.0 4294967295.0000 ECU_ADDRESS 0x3F9220 /end MEASUREMENT
/begin MEASUREMENT os_err_ff.addr_3 "Adresse wo letzte Exception her kam" ULONG FORMULA_0000 0 0 0.0 4294967295.0000 ECU_ADDRESS 0x3F9224 /end MEASUREMENT
/begin MEASUREMENT os_err_ff.addr_4 "Adresse wo letzte Exception her kam" ULONG FORMULA_0000 0 0 0.0 4294967295.0000 ECU_ADDRESS 0x3F9228 /end MEASUREMENT
/begin MEASUREMENT os_err_ff.addr_5 "Adresse wo letzte Exception her kam" ULONG FORMULA_0000 0 0 0.0 4294967295.0000 ECU_ADDRESS 0x3F922C /end MEASUREMENT
/begin MEASUREMENT os_err_ff.addr_6 "Adresse wo letzte Exception her kam" ULONG FORMULA_0000 0 0 0.0 4294967295.0000 ECU_ADDRESS 0x3F9230 /end MEASUREMENT
/begin MEASUREMENT os_err_ff.addr_7 "Adresse wo letzte Exception her kam" ULONG FORMULA_0000 0 0 0.0 4294967295.0000 ECU_ADDRESS 0x3F9234 /end MEASUREMENT
/begin MEASUREMENT os_proz_ff.mtime "Maximale Prozess Zeit" UWORD FORMULA_0018 0 0 0.0 65535.0000 ECU_ADDRESS 0x3F9238 /end MEASUREMENT
/begin MEASUREMENT os_proz_ff.mtime_pid "PID des Prozesses mit max Zeit" UWORD FORMULA_0010 0 0 0.0 65535.0000 ECU_ADDRESS 0x3F923A /end MEASUREMENT
/begin MEASUREMENT os_proz_ff.n "Motordrehzahl" SWORD FORMULA_0006 0 0 0.0 10000.0000 ECU_ADDRESS 0x3F923C /end MEASUREMENT
/begin MEASUREMENT os_proz_ff.rf "relative Fuellung Mittel zwischen Bank 1 und 2" SWORD FORMULA_0007 0 0 0.0 2.0000 ECU_ADDRESS 0x3F923E /end MEASUREMENT
/begin MEASUREMENT os_proz_ff.zustand_motor "Betriebszustand der Motorsteuerung" UWORD FORMULA_0019 0 0 0.0 65535.0 ECU_ADDRESS 0x3F9240 /end MEASUREMENT
/begin MEASUREMENT os_proz_ff.aq_soll_grad "Gradient AQ-Soll von Bank1" SWORD FORMULA_0020 0 0 -30000.0000 30000.0000 ECU_ADDRESS 0x3F9242 /end MEASUREMENT
/begin MEASUREMENT os_proz_ff.time_ml "Motor laeuft Zeit" UWORD FORMULA_0021 0 0 0.0 655.0000 ECU_ADDRESS 0x3F9244 /end MEASUREMENT
/begin MEASUREMENT os_proz_irq_ff.mtime "Maximale Prozess Zeit" UWORD FORMULA_0018 0 0 0.0 65535.0000 ECU_ADDRESS 0x3F9246 /end MEASUREMENT
/begin MEASUREMENT os_proz_irq_ff.mtime_pid "PID des Prozesses mit max Zeit" UWORD FORMULA_0010 0 0 0.0 65535.0000 ECU_ADDRESS 0x3F9248 /end MEASUREMENT
/begin MEASUREMENT os_proz_irq_ff.n "Motordrehzahl" SWORD FORMULA_0006 0 0 0.0 10000.0000 ECU_ADDRESS 0x3F924A /end MEASUREMENT
/begin MEASUREMENT os_proz_irq_ff.rf "relative Fuellung Mittel zwischen Bank 1 und 2" SWORD FORMULA_0007 0 0 0.0 2.0000 ECU_ADDRESS 0x3F924C /end MEASUREMENT
/begin MEASUREMENT os_proz_irq_ff.zustand_motor "Betriebszustand der Motorsteuerung" UWORD FORMULA_0019 0 0 0.0 65535.0 ECU_ADDRESS 0x3F924E /end MEASUREMENT
/begin MEASUREMENT os_proz_irq_ff.aq_soll_grad "Gradient AQ-Soll von Bank1" SWORD FORMULA_0020 0 0 -30000.0000 30000.0000 ECU_ADDRESS 0x3F9250 /end MEASUREMENT
/begin MEASUREMENT os_proz_irq_ff.time_ml "Motor laeuft Zeit" UWORD FORMULA_0021 0 0 0.0 655.0000 ECU_ADDRESS 0x3F9252 /end MEASUREMENT
/begin MEASUREMENT os_proz_irq_last_nv_1of10_ "CPU Last fuer diesen IRQ" UWORD FORMULA_0022 0 0 0.0 655.3500 ECU_ADDRESS 0x3F9254 /end MEASUREMENT
/begin MEASUREMENT os_proz_irq_last_nv_2of10_ "CPU Last fuer diesen IRQ" UWORD FORMULA_0022 0 0 0.0 655.3500 ECU_ADDRESS 0x3F9256 /end MEASUREMENT
/begin MEASUREMENT os_proz_irq_last_nv_3of10_ "CPU Last fuer diesen IRQ" UWORD FORMULA_0022 0 0 0.0 655.3500 ECU_ADDRESS 0x3F9258 /end MEASUREMENT
/begin MEASUREMENT os_proz_irq_last_nv_4of10_ "CPU Last fuer diesen IRQ" UWORD FORMULA_0022 0 0 0.0 655.3500 ECU_ADDRESS 0x3F925A /end MEASUREMENT
/begin MEASUREMENT os_proz_irq_last_nv_5of10_ "CPU Last fuer diesen IRQ" UWORD FORMULA_0022 0 0 0.0 655.3500 ECU_ADDRESS 0x3F925C /end MEASUREMENT
/begin MEASUREMENT os_proz_irq_last_nv_6of10_ "CPU Last fuer diesen IRQ" UWORD FORMULA_0022 0 0 0.0 655.3500 ECU_ADDRESS 0x3F925E /end MEASUREMENT
/begin MEASUREMENT os_proz_irq_last_nv_7of10_ "CPU Last fuer diesen IRQ" UWORD FORMULA_0022 0 0 0.0 655.3500 ECU_ADDRESS 0x3F9260 /end MEASUREMENT
/begin MEASUREMENT os_proz_irq_last_nv_8of10_ "CPU Last fuer diesen IRQ" UWORD FORMULA_0022 0 0 0.0 655.3500 ECU_ADDRESS 0x3F9262 /end MEASUREMENT
/begin MEASUREMENT os_proz_irq_last_nv_9of10_ "CPU Last fuer diesen IRQ" UWORD FORMULA_0022 0 0 0.0 655.3500 ECU_ADDRESS 0x3F9264 /end MEASUREMENT
/begin MEASUREMENT os_proz_irq_last_nv_10of10_ "CPU Last fuer diesen IRQ" UWORD FORMULA_0022 0 0 0.0 655.3500 ECU_ADDRESS 0x3F9266 /end MEASUREMENT
/* ------------------ Abschnitt erzeugt aus adapt_glob.dat ------------------ */
/begin MEASUREMENT toel_wanne "Oeltemperatur am QLT (Oelwanne)" SWORD FORMULA_0023 0 0 -50.0000 170.0000 ECU_ADDRESS 0x3F8618 /end MEASUREMENT
/begin MEASUREMENT laa_f_ber_nv_b1 "Faktor-Lambdaadaption ohne TE" UWORD FORMULA_0024 0 0 0.0 1.9990 ECU_ADDRESS 0x3F861A /end MEASUREMENT
/begin MEASUREMENT laa_f_ber_nv_b2 "Faktor-Lambdaadaption ohne TE" UWORD FORMULA_0024 0 0 0.0 1.9990 ECU_ADDRESS 0x3F861C /end MEASUREMENT
/begin MEASUREMENT kat_obd_wert_nv_b1 "gem., gewichtete Abweichung z. MW" UWORD FORMULA_0025 0 0 0.0 3.9990 ECU_ADDRESS 0x3F861E /end MEASUREMENT
/begin MEASUREMENT kat_obd_wert_nv_b2 "gem., gewichtete Abweichung z. MW" UWORD FORMULA_0025 0 0 0.0 3.9990 ECU_ADDRESS 0x3F8620 /end MEASUREMENT
/begin MEASUREMENT kat_obd_wert_gesamt_nv "Gesamtsystemdiagnosewert" UWORD FORMULA_0025 0 0 0.0 3.9990 ECU_ADDRESS 0x3F8622 /end MEASUREMENT
/begin MEASUREMENT kwp_fetrawe_st "" UBYTE FORMULA_0026 0 0 0.0 255.0 ECU_ADDRESS 0x3F8624 /end MEASUREMENT
/begin MEASUREMENT ed_fsp_inj_fehlerzaehler_nv "Zaehler zum Fehlersortieren" UWORD FORMULA_0010 0 0 0.0 65535.0000 ECU_ADDRESS 0x3F8626 /end MEASUREMENT
/begin MEASUREMENT can_km_stand_nv "Kilometerstand" ULONG FORMULA_0027 0 0 0.0 16777214.0000 ECU_ADDRESS 0x3F8628 /end MEASUREMENT
/begin MEASUREMENT can_fzgtyp_land_nv "Laendervariante" UBYTE FORMULA_0028 0 0 0.0 255.0 ECU_ADDRESS 0x3F862C /end MEASUREMENT
/begin MEASUREMENT can_fzgtyp_veh_nv "Fahrzeugvariante" UBYTE FORMULA_0029 0 0 0.0 255.0 ECU_ADDRESS 0x3F862D /end MEASUREMENT
/begin MEASUREMENT can_fzgtyp_clas_pwr_nv "Variante v_max-Anhebung" UBYTE FORMULA_0030 0 0 0.0 255.0 ECU_ADDRESS 0x3F862E /end MEASUREMENT
/begin MEASUREMENT can_fzgtyp_grb_nv "Getriebevariante" UBYTE FORMULA_0031 0 0 0.0 255.0 ECU_ADDRESS 0x3F862F /end MEASUREMENT
/begin MEASUREMENT elu_nl_nv "PWM-Signal der letzten ELU-Nachlaufanforderung" UBYTE FORMULA_0032 0 0 0.0 255.0000 ECU_ADDRESS 0x3F8630 /end MEASUREMENT
/begin MEASUREMENT tmot_abstell_nv "Abstelltemperatur des Motors" SWORD FORMULA_0023 0 0 -50.0000 170.0000 ECU_ADDRESS 0x3F8334 /end MEASUREMENT
/begin MEASUREMENT ed_css_st_ign_nv "CSS-Status der Funktionen" UBYTE FORMULA_0033 0 0 0.0 255.0000 ECU_ADDRESS 0x3F8336 /end MEASUREMENT
/begin MEASUREMENT ed_css_st_ign_nv_auss "Aussetzer" UBYTE FORMULA_0034 0 0 0.0 255.0 ECU_ADDRESS 0x3F8336 BIT_MASK 0x1 /end MEASUREMENT
/begin MEASUREMENT ed_css_st_ign_nv_pwg "Pedalwertgeber" UBYTE FORMULA_0035 0 0 0.0 255.0 ECU_ADDRESS 0x3F8336 BIT_MASK 0x2 /end MEASUREMENT
/begin MEASUREMENT ed_css_st_ign_nv_tmot "Motortemperatur" UBYTE FORMULA_0036 0 0 0.0 255.0 ECU_ADDRESS 0x3F8336 BIT_MASK 0x4 /end MEASUREMENT
/begin MEASUREMENT ed_css_st_ign_nv_lls "Leerlaufsteller" UBYTE FORMULA_0037 0 0 0.0 255.0 ECU_ADDRESS 0x3F8336 BIT_MASK 0x8 /end MEASUREMENT
/begin MEASUREMENT ed_css_st_ign_nv_dk "Drosselklappe" UBYTE FORMULA_0038 0 0 0.0 255.0 ECU_ADDRESS 0x3F8336 BIT_MASK 0x10 /end MEASUREMENT
/* ------------------ Abschnitt erzeugt aus adapt.dat ------------------ */
/begin MEASUREMENT toel_abstell_nv "Oel-Abstelltemperatur" SWORD FORMULA_0023 0 0 -50.0000 170.0000 ECU_ADDRESS 0x3F9DE0 /end MEASUREMENT
/begin MEASUREMENT toel_modell_abstell_nv "Oelabstell-Modelltemperatur am Oelfilterkopf" SWORD FORMULA_0023 0 0 -50.0000 170.0000 ECU_ADDRESS 0x3F9DE2 /end MEASUREMENT
/begin MEASUREMENT pwg_max_diff_adapt_nv "Maximal aufgetretene Differenz der Pedalwertgeber" SWORD FORMULA_0001 0 0 0.0 120.0000 ECU_ADDRESS 0x3F9DE4 /end MEASUREMENT
/begin MEASUREMENT pwg1_a0_nv "Absolute Potentiometerspannung 1 fuer LL" SWORD FORMULA_0418 0 0 0.0 5.0000 ECU_ADDRESS 0x3F9DE6 /end MEASUREMENT
/begin MEASUREMENT pwg2_a0_nv "Absolute Potentiometerspannung 2 fuer LL" SWORD FORMULA_0419 0 0 0.0 5.0000 ECU_ADDRESS 0x3F9DE8 /end MEASUREMENT
/begin MEASUREMENT egas_wdk_a0_b1 "WDK-Nullpunkt" SWORD FORMULA_0418 0 0 0.0 5.0000 ECU_ADDRESS 0x3F9DEA /end MEASUREMENT
/begin MEASUREMENT egas_wdk_a0_b2 "WDK-Nullpunkt" SWORD FORMULA_0418 0 0 0.0 5.0000 ECU_ADDRESS 0x3F9DEC /end MEASUREMENT
/begin MEASUREMENT tabg_lw_stand_nv_b1 "Offset zu TUMG beim Abstellen" SWORD FORMULA_0076 0 0 -1000.0000 1250.0000 ECU_ADDRESS 0x3F9DEE /end MEASUREMENT
/begin MEASUREMENT tabg_lw_stand_nv_b2 "Offset zu TUMG beim Abstellen" SWORD FORMULA_0076 0 0 -1000.0000 1250.0000 ECU_ADDRESS 0x3F9DF0 /end MEASUREMENT
/begin MEASUREMENT tabg_vkat_stand_nv_b1 "Offset zu TUMG beim Abstellen" SWORD FORMULA_0076 0 0 -1000.0000 1250.0000 ECU_ADDRESS 0x3F9DF2 /end MEASUREMENT
/begin MEASUREMENT tabg_vkat_stand_nv_b2 "Offset zu TUMG beim Abstellen" SWORD FORMULA_0076 0 0 -1000.0000 1250.0000 ECU_ADDRESS 0x3F9DF4 /end MEASUREMENT
/begin MEASUREMENT tabg_nkat_stand_nv_b1 "Offset zu TUMG beim Abstellen" SWORD FORMULA_0076 0 0 -1000.0000 1250.0000 ECU_ADDRESS 0x3F9DF6 /end MEASUREMENT
/begin MEASUREMENT tabg_nkat_stand_nv_b2 "Offset zu TUMG beim Abstellen" SWORD FORMULA_0076 0 0 -1000.0000 1250.0000 ECU_ADDRESS 0x3F9DF8 /end MEASUREMENT
/begin MEASUREMENT tabg_nkat_max_nv_b1 "Maximale Nachkattemperatur" SWORD FORMULA_0023 0 0 -50.0000 1250.0000 ECU_ADDRESS 0x3F9DFA /end MEASUREMENT
/begin MEASUREMENT tabg_nkat_max_nv_b2 "Maximale Nachkattemperatur" SWORD FORMULA_0023 0 0 -50.0000 1250.0000 ECU_ADDRESS 0x3F9DFC /end MEASUREMENT
/begin MEASUREMENT fpga_lade_errors_nv "Anzahl fehlgeschlagener FPGA loads" UBYTE FORMULA_0420 0 0 0.0 255.0000 ECU_ADDRESS 0x3F9DFE /end MEASUREMENT
/begin MEASUREMENT auss_mode6_st_nv "Status Aktivierung Mode 6 Aussetzererkennung." UBYTE FORMULA_0421 0 0 0.0 255.0 ECU_ADDRESS 0x3F9DFF /end MEASUREMENT
/begin MEASUREMENT fra_aq_adapt_roh_b1 "Adaptionswert" SWORD FORMULA_0422 0 0 -50.0000 50.0000 ECU_ADDRESS 0x3F9E00 /end MEASUREMENT
/begin MEASUREMENT fra_aq_adapt_roh_b2 "Adaptionswert" SWORD FORMULA_0422 0 0 -50.0000 50.0000 ECU_ADDRESS 0x3F9E02 /end MEASUREMENT
/begin MEASUREMENT tan_modell_off_b1 "Temperaturdifferenz TAN Modell zu ungefiltert" SWORD FORMULA_0076 0 0 -1000.0000 1000.0000 ECU_ADDRESS 0x3F9E04 /end MEASUREMENT
/begin MEASUREMENT tan_modell_off_b2 "Temperaturdifferenz TAN Modell zu ungefiltert" SWORD FORMULA_0076 0 0 -1000.0000 1000.0000 ECU_ADDRESS 0x3F9E06 /end MEASUREMENT
/begin MEASUREMENT tan_modell_mr_off "Temperaturdifferenz Motorraum zu TMOT" SWORD FORMULA_0076 0 0 -1000.0000 1000.0000 ECU_ADDRESS 0x3F9E08 /end MEASUREMENT
/begin MEASUREMENT auss_erk_nv_zyl1 "Zaehler Zuendaussetzer." UWORD FORMULA_0010 0 0 0.0 65535.0000 ECU_ADDRESS 0x3F9E0A /end MEASUREMENT
/begin MEASUREMENT auss_erk_nv_zyl2 "Zaehler Zuendaussetzer." UWORD FORMULA_0010 0 0 0.0 65535.0000 ECU_ADDRESS 0x3F9E0C /end MEASUREMENT
/begin MEASUREMENT auss_erk_nv_zyl3 "Zaehler Zuendaussetzer." UWORD FORMULA_0010 0 0 0.0 65535.0000 ECU_ADDRESS 0x3F9E0E /end MEASUREMENT
/begin MEASUREMENT auss_erk_nv_zyl4 "Zaehler Zuendaussetzer." UWORD FORMULA_0010 0 0 0.0 65535.0000 ECU_ADDRESS 0x3F9E10 /end MEASUREMENT
/begin MEASUREMENT auss_erk_nv_zyl5 "Zaehler Zuendaussetzer." UWORD FORMULA_0010 0 0 0.0 65535.0000 ECU_ADDRESS 0x3F9E12 /end MEASUREMENT
/begin MEASUREMENT auss_erk_nv_zyl6 "Zaehler Zuendaussetzer." UWORD FORMULA_0010 0 0 0.0 65535.0000 ECU_ADDRESS 0x3F9E14 /end MEASUREMENT
/begin MEASUREMENT auss_erk_nv_zyl7 "Zaehler Zuendaussetzer." UWORD FORMULA_0010 0 0 0.0 65535.0000 ECU_ADDRESS 0x3F9E16 /end MEASUREMENT
/begin MEASUREMENT auss_erk_nv_zyl8 "Zaehler Zuendaussetzer." UWORD FORMULA_0010 0 0 0.0 65535.0000 ECU_ADDRESS 0x3F9E18 /end MEASUREMENT
/begin MEASUREMENT auss_erk_nv_zyl9 "Zaehler Zuendaussetzer." UWORD FORMULA_0010 0 0 0.0 65535.0000 ECU_ADDRESS 0x3F9E1A /end MEASUREMENT
/begin MEASUREMENT auss_erk_nv_zyl10 "Zaehler Zuendaussetzer." UWORD FORMULA_0010 0 0 0.0 65535.0000 ECU_ADDRESS 0x3F9E1C /end MEASUREMENT
/begin MEASUREMENT auss_erk_ti_nv_zyl1 "Zaehler Verbrennungsaussetzererkennung." UWORD FORMULA_0010 0 0 0.0 65535.0000 ECU_ADDRESS 0x3F9E1E /end MEASUREMENT
/begin MEASUREMENT auss_erk_ti_nv_zyl2 "Zaehler Verbrennungsaussetzererkennung." UWORD FORMULA_0010 0 0 0.0 65535.0000 ECU_ADDRESS 0x3F9E20 /end MEASUREMENT
/begin MEASUREMENT auss_erk_ti_nv_zyl3 "Zaehler Verbrennungsaussetzererkennung." UWORD FORMULA_0010 0 0 0.0 65535.0000 ECU_ADDRESS 0x3F9E22 /end MEASUREMENT
/begin MEASUREMENT auss_erk_ti_nv_zyl4 "Zaehler Verbrennungsaussetzererkennung." UWORD FORMULA_0010 0 0 0.0 65535.0000 ECU_ADDRESS 0x3F9E24 /end MEASUREMENT
/begin MEASUREMENT auss_erk_ti_nv_zyl5 "Zaehler Verbrennungsaussetzererkennung." UWORD FORMULA_0010 0 0 0.0 65535.0000 ECU_ADDRESS 0x3F9E26 /end MEASUREMENT
/begin MEASUREMENT auss_erk_ti_nv_zyl6 "Zaehler Verbrennungsaussetzererkennung." UWORD FORMULA_0010 0 0 0.0 65535.0000 ECU_ADDRESS 0x3F9E28 /end MEASUREMENT
/begin MEASUREMENT auss_erk_ti_nv_zyl7 "Zaehler Verbrennungsaussetzererkennung." UWORD FORMULA_0010 0 0 0.0 65535.0000 ECU_ADDRESS 0x3F9E2A /end MEASUREMENT
/begin MEASUREMENT auss_erk_ti_nv_zyl8 "Zaehler Verbrennungsaussetzererkennung." UWORD FORMULA_0010 0 0 0.0 65535.0000 ECU_ADDRESS 0x3F9E2C /end MEASUREMENT
/begin MEASUREMENT auss_erk_ti_nv_zyl9 "Zaehler Verbrennungsaussetzererkennung." UWORD FORMULA_0010 0 0 0.0 65535.0000 ECU_ADDRESS 0x3F9E2E /end MEASUREMENT
/begin MEASUREMENT auss_erk_ti_nv_zyl10 "Zaehler Verbrennungsaussetzererkennung." UWORD FORMULA_0010 0 0 0.0 65535.0000 ECU_ADDRESS 0x3F9E30 /end MEASUREMENT
/begin MEASUREMENT auss_erk_ns_nv_zyl1 "Zaehler Nebenschlusserkennung." UWORD FORMULA_0010 0 0 0.0 65535.0000 ECU_ADDRESS 0x3F9E32 /end MEASUREMENT
/begin MEASUREMENT auss_erk_ns_nv_zyl2 "Zaehler Nebenschlusserkennung." UWORD FORMULA_0010 0 0 0.0 65535.0000 ECU_ADDRESS 0x3F9E34 /end MEASUREMENT
/begin MEASUREMENT auss_erk_ns_nv_zyl3 "Zaehler Nebenschlusserkennung." UWORD FORMULA_0010 0 0 0.0 65535.0000 ECU_ADDRESS 0x3F9E36 /end MEASUREMENT
/begin MEASUREMENT auss_erk_ns_nv_zyl4 "Zaehler Nebenschlusserkennung." UWORD FORMULA_0010 0 0 0.0 65535.0000 ECU_ADDRESS 0x3F9E38 /end MEASUREMENT
/begin MEASUREMENT auss_erk_ns_nv_zyl5 "Zaehler Nebenschlusserkennung." UWORD FORMULA_0010 0 0 0.0 65535.0000 ECU_ADDRESS 0x3F9E3A /end MEASUREMENT
/begin MEASUREMENT auss_erk_ns_nv_zyl6 "Zaehler Nebenschlusserkennung." UWORD FORMULA_0010 0 0 0.0 65535.0000 ECU_ADDRESS 0x3F9E3C /end MEASUREMENT
/begin MEASUREMENT auss_erk_ns_nv_zyl7 "Zaehler Nebenschlusserkennung." UWORD FORMULA_0010 0 0 0.0 65535.0000 ECU_ADDRESS 0x3F9E3E /end MEASUREMENT
/begin MEASUREMENT auss_erk_ns_nv_zyl8 "Zaehler Nebenschlusserkennung." UWORD FORMULA_0010 0 0 0.0 65535.0000 ECU_ADDRESS 0x3F9E40 /end MEASUREMENT
/begin MEASUREMENT auss_erk_ns_nv_zyl9 "Zaehler Nebenschlusserkennung." UWORD FORMULA_0010 0 0 0.0 65535.0000 ECU_ADDRESS 0x3F9E42 /end MEASUREMENT
/begin MEASUREMENT auss_erk_ns_nv_zyl10 "Zaehler Nebenschlusserkennung." UWORD FORMULA_0010 0 0 0.0 65535.0000 ECU_ADDRESS 0x3F9E44 /end MEASUREMENT
/begin MEASUREMENT auss_erk_1dc_nv_zyl1 "Zaehler Aussetzer ueber letzten DC." UWORD FORMULA_0010 0 0 0.0 65535.0000 ECU_ADDRESS 0x3F9E46 /end MEASUREMENT
/begin MEASUREMENT auss_erk_1dc_nv_zyl2 "Zaehler Aussetzer ueber letzten DC." UWORD FORMULA_0010 0 0 0.0 65535.0000 ECU_ADDRESS 0x3F9E48 /end MEASUREMENT
/begin MEASUREMENT auss_erk_1dc_nv_zyl3 "Zaehler Aussetzer ueber letzten DC." UWORD FORMULA_0010 0 0 0.0 65535.0000 ECU_ADDRESS 0x3F9E4A /end MEASUREMENT
/begin MEASUREMENT auss_erk_1dc_nv_zyl4 "Zaehler Aussetzer ueber letzten DC." UWORD FORMULA_0010 0 0 0.0 65535.0000 ECU_ADDRESS 0x3F9E4C /end MEASUREMENT
/begin MEASUREMENT auss_erk_1dc_nv_zyl5 "Zaehler Aussetzer ueber letzten DC." UWORD FORMULA_0010 0 0 0.0 65535.0000 ECU_ADDRESS 0x3F9E4E /end MEASUREMENT
/begin MEASUREMENT auss_erk_1dc_nv_zyl6 "Zaehler Aussetzer ueber letzten DC." UWORD FORMULA_0010 0 0 0.0 65535.0000 ECU_ADDRESS 0x3F9E50 /end MEASUREMENT
/begin MEASUREMENT auss_erk_1dc_nv_zyl7 "Zaehler Aussetzer ueber letzten DC." UWORD FORMULA_0010 0 0 0.0 65535.0000 ECU_ADDRESS 0x3F9E52 /end MEASUREMENT
/begin MEASUREMENT auss_erk_1dc_nv_zyl8 "Zaehler Aussetzer ueber letzten DC." UWORD FORMULA_0010 0 0 0.0 65535.0000 ECU_ADDRESS 0x3F9E54 /end MEASUREMENT
/begin MEASUREMENT auss_erk_1dc_nv_zyl9 "Zaehler Aussetzer ueber letzten DC." UWORD FORMULA_0010 0 0 0.0 65535.0000 ECU_ADDRESS 0x3F9E56 /end MEASUREMENT
/begin MEASUREMENT auss_erk_1dc_nv_zyl10 "Zaehler Aussetzer ueber letzten DC." UWORD FORMULA_0010 0 0 0.0 65535.0000 ECU_ADDRESS 0x3F9E58 /end MEASUREMENT
/begin MEASUREMENT auss_erk_10dc_nv_zyl1 "Zaehler Aussetzer ueber 10 DC." UWORD FORMULA_0010 0 0 0.0 65535.0000 ECU_ADDRESS 0x3F9E5A /end MEASUREMENT
/begin MEASUREMENT auss_erk_10dc_nv_zyl2 "Zaehler Aussetzer ueber 10 DC." UWORD FORMULA_0010 0 0 0.0 65535.0000 ECU_ADDRESS 0x3F9E5C /end MEASUREMENT
/begin MEASUREMENT auss_erk_10dc_nv_zyl3 "Zaehler Aussetzer ueber 10 DC." UWORD FORMULA_0010 0 0 0.0 65535.0000 ECU_ADDRESS 0x3F9E5E /end MEASUREMENT
/begin MEASUREMENT auss_erk_10dc_nv_zyl4 "Zaehler Aussetzer ueber 10 DC." UWORD FORMULA_0010 0 0 0.0 65535.0000 ECU_ADDRESS 0x3F9E60 /end MEASUREMENT
/begin MEASUREMENT auss_erk_10dc_nv_zyl5 "Zaehler Aussetzer ueber 10 DC." UWORD FORMULA_0010 0 0 0.0 65535.0000 ECU_ADDRESS 0x3F9E62 /end MEASUREMENT
/begin MEASUREMENT auss_erk_10dc_nv_zyl6 "Zaehler Aussetzer ueber 10 DC." UWORD FORMULA_0010 0 0 0.0 65535.0000 ECU_ADDRESS 0x3F9E64 /end MEASUREMENT
/begin MEASUREMENT auss_erk_10dc_nv_zyl7 "Zaehler Aussetzer ueber 10 DC." UWORD FORMULA_0010 0 0 0.0 65535.0000 ECU_ADDRESS 0x3F9E66 /end MEASUREMENT
/begin MEASUREMENT auss_erk_10dc_nv_zyl8 "Zaehler Aussetzer ueber 10 DC." UWORD FORMULA_0010 0 0 0.0 65535.0000 ECU_ADDRESS 0x3F9E68 /end MEASUREMENT
/begin MEASUREMENT auss_erk_10dc_nv_zyl9 "Zaehler Aussetzer ueber 10 DC." UWORD FORMULA_0010 0 0 0.0 65535.0000 ECU_ADDRESS 0x3F9E6A /end MEASUREMENT
/begin MEASUREMENT auss_erk_10dc_nv_zyl10 "Zaehler Aussetzer ueber 10 DC." UWORD FORMULA_0010 0 0 0.0 65535.0000 ECU_ADDRESS 0x3F9E6C /end MEASUREMENT
/begin MEASUREMENT kr_dtz_diag_cnt_nv_b1 "Zaehler Bereichsueberwachung von kr_dtz pro Bank." UBYTE FORMULA_0003 0 0 0.0 255.0000 ECU_ADDRESS 0x3F9E6E /end MEASUREMENT
/begin MEASUREMENT kr_dtz_diag_cnt_nv_b2 "Zaehler Bereichsueberwachung von kr_dtz pro Bank." UBYTE FORMULA_0003 0 0 0.0 255.0000 ECU_ADDRESS 0x3F9E6F /end MEASUREMENT
/begin MEASUREMENT ka_tz_diag_cnt_nv_b1 "Zaehler Bereichsueberwachung von ka_tz_nv pro Bank." UBYTE FORMULA_0003 0 0 0.0 255.0000 ECU_ADDRESS 0x3F9E70 /end MEASUREMENT
/begin MEASUREMENT ka_tz_diag_cnt_nv_b2 "Zaehler Bereichsueberwachung von ka_tz_nv pro Bank." UBYTE FORMULA_0003 0 0 0.0 255.0000 ECU_ADDRESS 0x3F9E71 /end MEASUREMENT
/begin MEASUREMENT ka_dtz_diag_cnt_nv_b1 "Zaehler Bereichsueberwachung von ka_dtz pro Bank." UBYTE FORMULA_0003 0 0 0.0 255.0000 ECU_ADDRESS 0x3F9E72 /end MEASUREMENT
/begin MEASUREMENT ka_dtz_diag_cnt_nv_b2 "Zaehler Bereichsueberwachung von ka_dtz pro Bank." UBYTE FORMULA_0003 0 0 0.0 255.0000 ECU_ADDRESS 0x3F9E73 /end MEASUREMENT
/begin MEASUREMENT ka_tz_nv_zyl1 "Klopfadaptionrueckziehwinkel." SLONG FORMULA_0243 0 0 -50.0000 60.0000 ECU_ADDRESS 0x3F9E74 /end MEASUREMENT
/begin MEASUREMENT ka_tz_nv_zyl2 "Klopfadaptionrueckziehwinkel." SLONG FORMULA_0243 0 0 -50.0000 60.0000 ECU_ADDRESS 0x3F9E78 /end MEASUREMENT
/begin MEASUREMENT ka_tz_nv_zyl3 "Klopfadaptionrueckziehwinkel." SLONG FORMULA_0243 0 0 -50.0000 60.0000 ECU_ADDRESS 0x3F9E7C /end MEASUREMENT
/begin MEASUREMENT ka_tz_nv_zyl4 "Klopfadaptionrueckziehwinkel." SLONG FORMULA_0243 0 0 -50.0000 60.0000 ECU_ADDRESS 0x3F9E80 /end MEASUREMENT
/begin MEASUREMENT ka_tz_nv_zyl5 "Klopfadaptionrueckziehwinkel." SLONG FORMULA_0243 0 0 -50.0000 60.0000 ECU_ADDRESS 0x3F9E84 /end MEASUREMENT
/begin MEASUREMENT ka_tz_nv_zyl6 "Klopfadaptionrueckziehwinkel." SLONG FORMULA_0243 0 0 -50.0000 60.0000 ECU_ADDRESS 0x3F9E88 /end MEASUREMENT
/begin MEASUREMENT ka_tz_nv_zyl7 "Klopfadaptionrueckziehwinkel." SLONG FORMULA_0243 0 0 -50.0000 60.0000 ECU_ADDRESS 0x3F9E8C /end MEASUREMENT
/begin MEASUREMENT ka_tz_nv_zyl8 "Klopfadaptionrueckziehwinkel." SLONG FORMULA_0243 0 0 -50.0000 60.0000 ECU_ADDRESS 0x3F9E90 /end MEASUREMENT
/begin MEASUREMENT ka_tz_nv_zyl9 "Klopfadaptionrueckziehwinkel." SLONG FORMULA_0243 0 0 -50.0000 60.0000 ECU_ADDRESS 0x3F9E94 /end MEASUREMENT
/begin MEASUREMENT ka_tz_nv_zyl10 "Klopfadaptionrueckziehwinkel." SLONG FORMULA_0243 0 0 -50.0000 60.0000 ECU_ADDRESS 0x3F9E98 /end MEASUREMENT
/begin MEASUREMENT llr_ad_md_norm "Adaptionswert" SWORD FORMULA_0009 0 0 -50.0000 50.0000 ECU_ADDRESS 0x3F9E9C /end MEASUREMENT
/begin MEASUREMENT llr_ad_md_ac "Adaptionswert mit Klima" SWORD FORMULA_0009 0 0 -50.0000 50.0000 ECU_ADDRESS 0x3F9E9E /end MEASUREMENT
/begin MEASUREMENT zoelp_ans_cnt_nv "Anzahl der Ansteuerungen" UWORD FORMULA_0010 0 0 0.0 65535.0000 ECU_ADDRESS 0x3F9EA0 /end MEASUREMENT
/begin MEASUREMENT fr_adapt_1of8_1of2_ "Bereichsadaption" UWORD FORMULA_0075 0 0 0.0 4.0000 ECU_ADDRESS 0x3F9EA2 /end MEASUREMENT
/begin MEASUREMENT fr_adapt_1of8_2of2_ "Bereichsadaption" UWORD FORMULA_0075 0 0 0.0 4.0000 ECU_ADDRESS 0x3F9EA4 /end MEASUREMENT
/begin MEASUREMENT fr_adapt_2of8_1of2_ "Bereichsadaption" UWORD FORMULA_0075 0 0 0.0 4.0000 ECU_ADDRESS 0x3F9EA6 /end MEASUREMENT
/begin MEASUREMENT fr_adapt_2of8_2of2_ "Bereichsadaption" UWORD FORMULA_0075 0 0 0.0 4.0000 ECU_ADDRESS 0x3F9EA8 /end MEASUREMENT
/begin MEASUREMENT fr_adapt_3of8_1of2_ "Bereichsadaption" UWORD FORMULA_0075 0 0 0.0 4.0000 ECU_ADDRESS 0x3F9EAA /end MEASUREMENT
/begin MEASUREMENT fr_adapt_3of8_2of2_ "Bereichsadaption" UWORD FORMULA_0075 0 0 0.0 4.0000 ECU_ADDRESS 0x3F9EAC /end MEASUREMENT
/begin MEASUREMENT fr_adapt_4of8_1of2_ "Bereichsadaption" UWORD FORMULA_0075 0 0 0.0 4.0000 ECU_ADDRESS 0x3F9EAE /end MEASUREMENT
/begin MEASUREMENT fr_adapt_4of8_2of2_ "Bereichsadaption" UWORD FORMULA_0075 0 0 0.0 4.0000 ECU_ADDRESS 0x3F9EB0 /end MEASUREMENT
/begin MEASUREMENT fr_adapt_5of8_1of2_ "Bereichsadaption" UWORD FORMULA_0075 0 0 0.0 4.0000 ECU_ADDRESS 0x3F9EB2 /end MEASUREMENT
/begin MEASUREMENT fr_adapt_5of8_2of2_ "Bereichsadaption" UWORD FORMULA_0075 0 0 0.0 4.0000 ECU_ADDRESS 0x3F9EB4 /end MEASUREMENT
/begin MEASUREMENT fr_adapt_6of8_1of2_ "Bereichsadaption" UWORD FORMULA_0075 0 0 0.0 4.0000 ECU_ADDRESS 0x3F9EB6 /end MEASUREMENT
/begin MEASUREMENT fr_adapt_6of8_2of2_ "Bereichsadaption" UWORD FORMULA_0075 0 0 0.0 4.0000 ECU_ADDRESS 0x3F9EB8 /end MEASUREMENT
/begin MEASUREMENT fr_adapt_7of8_1of2_ "Bereichsadaption" UWORD FORMULA_0075 0 0 0.0 4.0000 ECU_ADDRESS 0x3F9EBA /end MEASUREMENT
/begin MEASUREMENT fr_adapt_7of8_2of2_ "Bereichsadaption" UWORD FORMULA_0075 0 0 0.0 4.0000 ECU_ADDRESS 0x3F9EBC /end MEASUREMENT
/begin MEASUREMENT fr_adapt_8of8_1of2_ "Bereichsadaption" UWORD FORMULA_0075 0 0 0.0 4.0000 ECU_ADDRESS 0x3F9EBE /end MEASUREMENT
/begin MEASUREMENT fr_adapt_8of8_2of2_ "Bereichsadaption" UWORD FORMULA_0075 0 0 0.0 4.0000 ECU_ADDRESS 0x3F9EC0 /end MEASUREMENT
/begin MEASUREMENT smg_ff.km_stand "Kilometerstand" ULONG FORMULA_0027 0 0 0.0 16777214.0000 ECU_ADDRESS 0x3F9EC4 /end MEASUREMENT
/begin MEASUREMENT smg_ff.counter "Anzahl der Aufrufe" UBYTE FORMULA_0003 0 0 0.0 255.0000 ECU_ADDRESS 0x3F9EC8 /end MEASUREMENT
/begin MEASUREMENT smg_ff.sk_mode "SK-Mode" UBYTE FORMULA_0003 0 0 0.0 255.0000 ECU_ADDRESS 0x3F9EC9 /end MEASUREMENT
/begin MEASUREMENT smg_ff.sk_flags "SK-Flags" UWORD FORMULA_0010 0 0 0.0 65535.0000 ECU_ADDRESS 0x3F9ECA /end MEASUREMENT
/begin MEASUREMENT smg_ff.sk_flags_nv "SK-Flags Historie" UWORD FORMULA_0010 0 0 0.0 65535.0000 ECU_ADDRESS 0x3F9ECC /end MEASUREMENT
/begin MEASUREMENT smg_ff.toel "Toel" SWORD FORMULA_0023 0 0 -50.0000 170.0000 ECU_ADDRESS 0x3F9ECE /end MEASUREMENT
/begin MEASUREMENT smg_ff.n "Motordrehzahl" SWORD FORMULA_0006 0 0 0.0 10000.0000 ECU_ADDRESS 0x3F9ED0 /end MEASUREMENT
/begin MEASUREMENT smg_ff.n_getr_ein "Getriebeeingangsdrehzahl" SWORD FORMULA_0006 0 0 0.0 10000.0000 ECU_ADDRESS 0x3F9ED2 /end MEASUREMENT
/begin MEASUREMENT smg_ff.n_getr_ziel "Getriebezieldrehzahl" SWORD FORMULA_0006 0 0 0.0 10000.0000 ECU_ADDRESS 0x3F9ED4 /end MEASUREMENT
/begin MEASUREMENT smg_ff.v_vorne "vVorne" SWORD FORMULA_0078 0 0 -80.0000 360.0000 ECU_ADDRESS 0x3F9ED6 /end MEASUREMENT
/begin MEASUREMENT smg_ff.v_hinten "vHinten" SWORD FORMULA_0078 0 0 -80.0000 360.0000 ECU_ADDRESS 0x3F9ED8 /end MEASUREMENT
/begin MEASUREMENT smg_ff.pwg_soll "Fahrerwunsch" SWORD FORMULA_0001 0 0 -10.0000 120.0000 ECU_ADDRESS 0x3F9EDA /end MEASUREMENT
/begin MEASUREMENT smg_ff.md_fahrer "Fahrerwunschmoment" SWORD FORMULA_0009 0 0 -100.0000 1000.0000 ECU_ADDRESS 0x3F9EDC /end MEASUREMENT
/begin MEASUREMENT smg_ff.md_soll "TZ-Sollmoment" SWORD FORMULA_0009 0 0 -100.0000 1000.0000 ECU_ADDRESS 0x3F9EDE /end MEASUREMENT
/begin MEASUREMENT smg_ff.md_ist "Moment an der Kupplung" SWORD FORMULA_0009 0 0 -100.0000 1000.0000 ECU_ADDRESS 0x3F9EE0 /end MEASUREMENT
/begin MEASUREMENT smg_ff.mk_soll "absolutes Kupplungssollmoment" SWORD FORMULA_0009 0 0 -100.0000 1000.0000 ECU_ADDRESS 0x3F9EE2 /end MEASUREMENT
/begin MEASUREMENT smg_ff.mk_ist "absolutes Kupplungsmoment" SWORD FORMULA_0009 0 0 -100.0000 1000.0000 ECU_ADDRESS 0x3F9EE4 /end MEASUREMENT
/begin MEASUREMENT smg_ff.pos_kupp_ist "Kupplungsposition" UBYTE FORMULA_0423 0 0 0.0 1020.0000 ECU_ADDRESS 0x3F9EE6 /end MEASUREMENT
/begin MEASUREMENT smg_ff.istgang "Istgang" SBYTE FORMULA_0318 0 0 -1.0000 10.0000 ECU_ADDRESS 0x3F9EE8 /end MEASUREMENT
/begin MEASUREMENT smg_ff.zielgang "Zielgang" SBYTE FORMULA_0318 0 0 -1.0000 10.0000 ECU_ADDRESS 0x3F9EE7 /end MEASUREMENT
/begin MEASUREMENT smg_ff.dme_st "DME-Status" UBYTE FORMULA_0309 0 0 0.0 255.0 ECU_ADDRESS 0x3F9EE9 /end MEASUREMENT
/begin MEASUREMENT smg_ff.kupp_st "Kupplungsstatus" UBYTE FORMULA_0424 0 0 0.0 255.0 ECU_ADDRESS 0x3F9EEA /end MEASUREMENT
/begin MEASUREMENT smg_ff.getr_st "Getriebestatus" UBYTE FORMULA_0425 0 0 0.0 255.0 ECU_ADDRESS 0x3F9EEB /end MEASUREMENT
/begin MEASUREMENT smg_ff.modul "Modulstatus" UBYTE FORMULA_0426 0 0 0.0 255.0 ECU_ADDRESS 0x3F9EEC /end MEASUREMENT
/begin MEASUREMENT smg_ff.s_krafts "Kraftschluss" UBYTE FORMULA_0427 0 0 0.0 255.0 ECU_ADDRESS 0x3F9EED /end MEASUREMENT
/begin MEASUREMENT smg_ff.abbruch_ges "Grund fuer Schaltabbruch - Summe" UBYTE FORMULA_0428 0 0 0.0 255.0 ECU_ADDRESS 0x3F9EEE /end MEASUREMENT
/begin MEASUREMENT smg_ff.n_berech "berechnete Drehzahl" SWORD FORMULA_0006 0 0 0.0 10000.0000 ECU_ADDRESS 0x3F9EF0 /end MEASUREMENT
/begin MEASUREMENT egas_lls_ff_b1.n "Drehzahl" SWORD FORMULA_0006 0 0 0.0 10000.0000 ECU_ADDRESS 0x3F9EF4 /end MEASUREMENT
/begin MEASUREMENT egas_lls_ff_b2.n "Drehzahl" SWORD FORMULA_0006 0 0 0.0 10000.0000 ECU_ADDRESS 0x3F9F0C /end MEASUREMENT
/begin MEASUREMENT egas_lls_ff_b1.rf "Fuellung" SWORD FORMULA_0007 0 0 0.0 2.0000 ECU_ADDRESS 0x3F9EF6 /end MEASUREMENT
/begin MEASUREMENT egas_lls_ff_b2.rf "Fuellung" SWORD FORMULA_0007 0 0 0.0 2.0000 ECU_ADDRESS 0x3F9F0E /end MEASUREMENT
/begin MEASUREMENT egas_lls_ff_b1.ub "Spannung" SWORD FORMULA_0008 0 0 0.0 28.0000 ECU_ADDRESS 0x3F9EF8 /end MEASUREMENT
/begin MEASUREMENT egas_lls_ff_b2.ub "Spannung" SWORD FORMULA_0008 0 0 0.0 28.0000 ECU_ADDRESS 0x3F9F10 /end MEASUREMENT
/begin MEASUREMENT egas_lls_ff_b1.soll "Sollwert" SWORD FORMULA_0001 0 0 -10.0000 120.0000 ECU_ADDRESS 0x3F9EFA /end MEASUREMENT
/begin MEASUREMENT egas_lls_ff_b2.soll "Sollwert" SWORD FORMULA_0001 0 0 -10.0000 120.0000 ECU_ADDRESS 0x3F9F12 /end MEASUREMENT
/begin MEASUREMENT egas_lls_ff_b1.ist "Istwert" SWORD FORMULA_0001 0 0 -10.0000 120.0000 ECU_ADDRESS 0x3F9EFC /end MEASUREMENT
/begin MEASUREMENT egas_lls_ff_b2.ist "Istwert" SWORD FORMULA_0001 0 0 -10.0000 120.0000 ECU_ADDRESS 0x3F9F14 /end MEASUREMENT
/begin MEASUREMENT egas_lls_ff_b1.fail_st "Failsafe-Status" UWORD FORMULA_0429 0 0 0.0 65535.0 ECU_ADDRESS 0x3F9EFE /end MEASUREMENT
/begin MEASUREMENT egas_lls_ff_b2.fail_st "Failsafe-Status" UWORD FORMULA_0429 0 0 0.0 65535.0 ECU_ADDRESS 0x3F9F16 /end MEASUREMENT
/begin MEASUREMENT egas_lls_ff_b1.zust_sk "SK-Zustand der DK" UWORD FORMULA_0430 0 0 0.0 65535.0 ECU_ADDRESS 0x3F9F00 /end MEASUREMENT
/begin MEASUREMENT egas_lls_ff_b2.zust_sk "SK-Zustand der DK" UWORD FORMULA_0430 0 0 0.0 65535.0 ECU_ADDRESS 0x3F9F18 /end MEASUREMENT
/begin MEASUREMENT egas_lls_ff_b1.r_sollw "R-Sollwert" SWORD FORMULA_0001 0 0 -10.0000 120.0000 ECU_ADDRESS 0x3F9F02 /end MEASUREMENT
/begin MEASUREMENT egas_lls_ff_b2.r_sollw "R-Sollwert" SWORD FORMULA_0001 0 0 -10.0000 120.0000 ECU_ADDRESS 0x3F9F1A /end MEASUREMENT
/begin MEASUREMENT egas_lls_ff_b1.r_diag_st "Diagnosestatus" UWORD FORMULA_0431 0 0 0.0 65535.0 ECU_ADDRESS 0x3F9F04 /end MEASUREMENT
/begin MEASUREMENT egas_lls_ff_b2.r_diag_st "Diagnosestatus" UWORD FORMULA_0431 0 0 0.0 65535.0 ECU_ADDRESS 0x3F9F1C /end MEASUREMENT
/begin MEASUREMENT egas_lls_ff_b1.r_adapt_st "Adaptionsstatus" UBYTE FORMULA_0432 0 0 0.0 255.0 ECU_ADDRESS 0x3F9F06 /end MEASUREMENT
/begin MEASUREMENT egas_lls_ff_b2.r_adapt_st "Adaptionsstatus" UBYTE FORMULA_0432 0 0 0.0 255.0 ECU_ADDRESS 0x3F9F1E /end MEASUREMENT
/begin MEASUREMENT egas_lls_ff_b1.r_mode "Mode" UBYTE FORMULA_0433 0 0 0.0 255.0 ECU_ADDRESS 0x3F9F07 /end MEASUREMENT
/begin MEASUREMENT egas_lls_ff_b2.r_mode "Mode" UBYTE FORMULA_0433 0 0 0.0 255.0 ECU_ADDRESS 0x3F9F1F /end MEASUREMENT
/begin MEASUREMENT egas_lls_ff_b1.mode "Mode" UBYTE FORMULA_0433 0 0 0.0 255.0 ECU_ADDRESS 0x3F9F08 /end MEASUREMENT
/begin MEASUREMENT egas_lls_ff_b2.mode "Mode" UBYTE FORMULA_0433 0 0 0.0 255.0 ECU_ADDRESS 0x3F9F20 /end MEASUREMENT
/begin MEASUREMENT egas_lls_ff_b1.state "State" UBYTE FORMULA_0434 0 0 0.0 255.0 ECU_ADDRESS 0x3F9F09 /end MEASUREMENT
/begin MEASUREMENT egas_lls_ff_b2.state "State" UBYTE FORMULA_0434 0 0 0.0 255.0 ECU_ADDRESS 0x3F9F21 /end MEASUREMENT
/begin MEASUREMENT egas_lls_ff_b1.can_st "CAN-Status" UBYTE FORMULA_0126 0 0 0.0 255.0 ECU_ADDRESS 0x3F9F0A /end MEASUREMENT
/begin MEASUREMENT egas_lls_ff_b2.can_st "CAN-Status" UBYTE FORMULA_0126 0 0 0.0 255.0 ECU_ADDRESS 0x3F9F22 /end MEASUREMENT
/begin MEASUREMENT egas_dk_ff_b1.n "Drehzahl" SWORD FORMULA_0006 0 0 0.0 10000.0000 ECU_ADDRESS 0x3F9F24 /end MEASUREMENT
/begin MEASUREMENT egas_dk_ff_b2.n "Drehzahl" SWORD FORMULA_0006 0 0 0.0 10000.0000 ECU_ADDRESS 0x3F9F42 /end MEASUREMENT
/begin MEASUREMENT egas_dk_ff_b1.rf_aq "Fuellung vom AQ" SWORD FORMULA_0007 0 0 0.0 2.0000 ECU_ADDRESS 0x3F9F26 /end MEASUREMENT
/begin MEASUREMENT egas_dk_ff_b2.rf_aq "Fuellung vom AQ" SWORD FORMULA_0007 0 0 0.0 2.0000 ECU_ADDRESS 0x3F9F44 /end MEASUREMENT
/begin MEASUREMENT egas_dk_ff_b1.rf_hfm "Fuellung vom HFM" SWORD FORMULA_0007 0 0 0.0 2.0000 ECU_ADDRESS 0x3F9F28 /end MEASUREMENT
/begin MEASUREMENT egas_dk_ff_b2.rf_hfm "Fuellung vom HFM" SWORD FORMULA_0007 0 0 0.0 2.0000 ECU_ADDRESS 0x3F9F46 /end MEASUREMENT
/begin MEASUREMENT egas_dk_ff_b1.ub "Spannung" SWORD FORMULA_0008 0 0 0.0 28.0000 ECU_ADDRESS 0x3F9F2A /end MEASUREMENT
/begin MEASUREMENT egas_dk_ff_b2.ub "Spannung" SWORD FORMULA_0008 0 0 0.0 28.0000 ECU_ADDRESS 0x3F9F48 /end MEASUREMENT
/begin MEASUREMENT egas_dk_ff_b1.soll "Sollwert" SWORD FORMULA_0001 0 0 -10.0000 120.0000 ECU_ADDRESS 0x3F9F2C /end MEASUREMENT
/begin MEASUREMENT egas_dk_ff_b2.soll "Sollwert" SWORD FORMULA_0001 0 0 -10.0000 120.0000 ECU_ADDRESS 0x3F9F4A /end MEASUREMENT
/begin MEASUREMENT egas_dk_ff_b1.ist "Istwert" SWORD FORMULA_0001 0 0 -10.0000 120.0000 ECU_ADDRESS 0x3F9F2E /end MEASUREMENT
/begin MEASUREMENT egas_dk_ff_b2.ist "Istwert" SWORD FORMULA_0001 0 0 -10.0000 120.0000 ECU_ADDRESS 0x3F9F4C /end MEASUREMENT
/begin MEASUREMENT egas_dk_ff_b1.wdk "Istwert" SWORD FORMULA_0001 0 0 -10.0000 120.0000 ECU_ADDRESS 0x3F9F30 /end MEASUREMENT
/begin MEASUREMENT egas_dk_ff_b2.wdk "Istwert" SWORD FORMULA_0001 0 0 -10.0000 120.0000 ECU_ADDRESS 0x3F9F4E /end MEASUREMENT
/begin MEASUREMENT egas_dk_ff_b1.abs "korr. U_WDK" SWORD FORMULA_0418 0 0 0.0 5.0000 ECU_ADDRESS 0x3F9F32 /end MEASUREMENT
/begin MEASUREMENT egas_dk_ff_b2.abs "korr. U_WDK" SWORD FORMULA_0418 0 0 0.0 5.0000 ECU_ADDRESS 0x3F9F50 /end MEASUREMENT
/begin MEASUREMENT egas_dk_ff_b1.fail_st "Failsafe-Status" UWORD FORMULA_0429 0 0 0.0 65535.0 ECU_ADDRESS 0x3F9F34 /end MEASUREMENT
/begin MEASUREMENT egas_dk_ff_b2.fail_st "Failsafe-Status" UWORD FORMULA_0429 0 0 0.0 65535.0 ECU_ADDRESS 0x3F9F52 /end MEASUREMENT
/begin MEASUREMENT egas_dk_ff_b1.zust_sk "SK-Zustand der DK" UWORD FORMULA_0430 0 0 0.0 65535.0 ECU_ADDRESS 0x3F9F36 /end MEASUREMENT
/begin MEASUREMENT egas_dk_ff_b2.zust_sk "SK-Zustand der DK" UWORD FORMULA_0430 0 0 0.0 65535.0 ECU_ADDRESS 0x3F9F54 /end MEASUREMENT
/begin MEASUREMENT egas_dk_ff_b1.r_sollw "R-Sollwert" SWORD FORMULA_0001 0 0 -10.0000 120.0000 ECU_ADDRESS 0x3F9F38 /end MEASUREMENT
/begin MEASUREMENT egas_dk_ff_b2.r_sollw "R-Sollwert" SWORD FORMULA_0001 0 0 -10.0000 120.0000 ECU_ADDRESS 0x3F9F56 /end MEASUREMENT
/begin MEASUREMENT egas_dk_ff_b1.r_diag_st "Diagnosestatus" UWORD FORMULA_0431 0 0 0.0 65535.0 ECU_ADDRESS 0x3F9F3A /end MEASUREMENT
/begin MEASUREMENT egas_dk_ff_b2.r_diag_st "Diagnosestatus" UWORD FORMULA_0431 0 0 0.0 65535.0 ECU_ADDRESS 0x3F9F58 /end MEASUREMENT
/begin MEASUREMENT egas_dk_ff_b1.r_adapt_st "Adaptionsstatus" UBYTE FORMULA_0432 0 0 0.0 255.0 ECU_ADDRESS 0x3F9F3C /end MEASUREMENT
/begin MEASUREMENT egas_dk_ff_b2.r_adapt_st "Adaptionsstatus" UBYTE FORMULA_0432 0 0 0.0 255.0 ECU_ADDRESS 0x3F9F5A /end MEASUREMENT
/begin MEASUREMENT egas_dk_ff_b1.r_mode "Mode" UBYTE FORMULA_0433 0 0 0.0 255.0 ECU_ADDRESS 0x3F9F3D /end MEASUREMENT
/begin MEASUREMENT egas_dk_ff_b2.r_mode "Mode" UBYTE FORMULA_0433 0 0 0.0 255.0 ECU_ADDRESS 0x3F9F5B /end MEASUREMENT
/begin MEASUREMENT egas_dk_ff_b1.mode "Mode" UBYTE FORMULA_0433 0 0 0.0 255.0 ECU_ADDRESS 0x3F9F3E /end MEASUREMENT
/begin MEASUREMENT egas_dk_ff_b2.mode "Mode" UBYTE FORMULA_0433 0 0 0.0 255.0 ECU_ADDRESS 0x3F9F5C /end MEASUREMENT
/begin MEASUREMENT egas_dk_ff_b1.state "State" UBYTE FORMULA_0434 0 0 0.0 255.0 ECU_ADDRESS 0x3F9F3F /end MEASUREMENT
/begin MEASUREMENT egas_dk_ff_b2.state "State" UBYTE FORMULA_0434 0 0 0.0 255.0 ECU_ADDRESS 0x3F9F5D /end MEASUREMENT
/begin MEASUREMENT egas_dk_ff_b1.can_st "CAN-Status" UBYTE FORMULA_0126 0 0 0.0 255.0 ECU_ADDRESS 0x3F9F40 /end MEASUREMENT
/begin MEASUREMENT egas_dk_ff_b2.can_st "CAN-Status" UBYTE FORMULA_0126 0 0 0.0 255.0 ECU_ADDRESS 0x3F9F5E /end MEASUREMENT
/begin MEASUREMENT md_ff.n "Drehzzahl" SWORD FORMULA_0006 0 0 0.0 10000.0000 ECU_ADDRESS 0x3F9F60 /end MEASUREMENT
/begin MEASUREMENT md_ff.kupp_wunsch_ges "Wunschmoment" SWORD FORMULA_0009 0 0 -100.0000 1000.0000 ECU_ADDRESS 0x3F9F62 /end MEASUREMENT
/begin MEASUREMENT md_ff.kupp_wunsch_tz "TZ-Wunschmoment" SWORD FORMULA_0009 0 0 -100.0000 1000.0000 ECU_ADDRESS 0x3F9F64 /end MEASUREMENT
/begin MEASUREMENT md_ff.kupp_wunsch_ml "ML-Wunschmoment" SWORD FORMULA_0009 0 0 -100.0000 1000.0000 ECU_ADDRESS 0x3F9F66 /end MEASUREMENT
/begin MEASUREMENT md_ff.ind_wunsch_tz "TZ-Wunschmoment" SWORD FORMULA_0009 0 0 -100.0000 1000.0000 ECU_ADDRESS 0x3F9F68 /end MEASUREMENT
/begin MEASUREMENT md_ff.ind_wunsch_ml "ML-Wunschmoment" SWORD FORMULA_0009 0 0 -100.0000 1000.0000 ECU_ADDRESS 0x3F9F6A /end MEASUREMENT
/begin MEASUREMENT md_ff.rf_soll "Sollfuellung" SWORD FORMULA_0007 0 0 0.0 2.0000 ECU_ADDRESS 0x3F9F76 /end MEASUREMENT
/begin MEASUREMENT md_ff.kupp_ist "Istmoment" SWORD FORMULA_0009 0 0 -100.0000 1000.0000 ECU_ADDRESS 0x3F9F6C /end MEASUREMENT
/begin MEASUREMENT md_ff.kupp_min_filter "min. Moment" SWORD FORMULA_0009 0 0 -100.0000 1000.0000 ECU_ADDRESS 0x3F9F70 /end MEASUREMENT
/begin MEASUREMENT md_ff.pwg_soll "min. Moment" SWORD FORMULA_0001 0 0 -10.0000 120.0000 ECU_ADDRESS 0x3F9F6E /end MEASUREMENT
/begin MEASUREMENT md_ff.eta_min "min. Eta" UWORD FORMULA_0435 0 0 0.0 150.0000 ECU_ADDRESS 0x3F9F72 /end MEASUREMENT
/begin MEASUREMENT md_ff.eta_ne "Eta-Ne" UWORD FORMULA_0435 0 0 0.0 150.0000 ECU_ADDRESS 0x3F9F74 /end MEASUREMENT
/begin MEASUREMENT md_ff.rf_m "Sollfuellung" SWORD FORMULA_0007 0 0 0.0 2.0000 ECU_ADDRESS 0x3F9F78 /end MEASUREMENT
/begin MEASUREMENT md_ff.aq_abs_m "Oeffnung" UWORD FORMULA_0147 0 0 0.0 6500.0000 ECU_ADDRESS 0x3F9F7A /end MEASUREMENT
/begin MEASUREMENT md_ff.sk_fehler "SK-Fehlerinfo" UBYTE FORMULA_0436 0 0 0.0 255.0 ECU_ADDRESS 0x3F9F7C /end MEASUREMENT
/begin MEASUREMENT md_ff.s_bls "Bremse" UBYTE FORMULA_0437 0 0 0.0 255.0 ECU_ADDRESS 0x3F9F7D /end MEASUREMENT
/begin MEASUREMENT md_ff.tz_st "Status Sollmoment-TZ" UBYTE FORMULA_0438 0 0 0.0 255.0 ECU_ADDRESS 0x3F9F7E /end MEASUREMENT
/begin MEASUREMENT md_ff.ml_st "Status Sollmoment-ML" UBYTE FORMULA_0438 0 0 0.0 255.0 ECU_ADDRESS 0x3F9F7F /end MEASUREMENT
/begin MEASUREMENT md_ff.ti_tpu_st "Einspritzung" UWORD FORMULA_0010 0 0 0.0 65535.0000 ECU_ADDRESS 0x3F9F80 /end MEASUREMENT
/begin MEASUREMENT smg_adapt_ihar_nv "Hinterachs- und Raduebersetzung" UWORD FORMULA_0075 0 0 0.0 63.9990 ECU_ADDRESS 0x3F9F82 /end MEASUREMENT
/begin MEASUREMENT schalter_bls_counter_nv "Haeufigkeitszaehler Bremse" ULONG FORMULA_0000 0 0 0.0 4294967295.0000 ECU_ADDRESS 0x3F9F84 /end MEASUREMENT
/begin MEASUREMENT lu_adap_segm1 "Geberrad-Adaption" SWORD FORMULA_0439 0 0 -7.8000 7.8000 ECU_ADDRESS 0x3F9F88 /end MEASUREMENT
/begin MEASUREMENT lu_adap_segm2 "Geberrad-Adaption" SWORD FORMULA_0439 0 0 -7.8000 7.8000 ECU_ADDRESS 0x3F9F8A /end MEASUREMENT
/begin MEASUREMENT lu_adap_segm3 "Geberrad-Adaption" SWORD FORMULA_0439 0 0 -7.8000 7.8000 ECU_ADDRESS 0x3F9F8C /end MEASUREMENT
/begin MEASUREMENT lu_adap_segm4 "Geberrad-Adaption" SWORD FORMULA_0439 0 0 -7.8000 7.8000 ECU_ADDRESS 0x3F9F8E /end MEASUREMENT
/begin MEASUREMENT lu_adap_segm5 "Geberrad-Adaption" SWORD FORMULA_0439 0 0 -7.8000 7.8000 ECU_ADDRESS 0x3F9F90 /end MEASUREMENT
/begin MEASUREMENT lu_adap_segm6 "Geberrad-Adaption" SWORD FORMULA_0439 0 0 -7.8000 7.8000 ECU_ADDRESS 0x3F9F92 /end MEASUREMENT
/begin MEASUREMENT lu_adap_segm7 "Geberrad-Adaption" SWORD FORMULA_0439 0 0 -7.8000 7.8000 ECU_ADDRESS 0x3F9F94 /end MEASUREMENT
/begin MEASUREMENT lu_adap_segm8 "Geberrad-Adaption" SWORD FORMULA_0439 0 0 -7.8000 7.8000 ECU_ADDRESS 0x3F9F96 /end MEASUREMENT
/begin MEASUREMENT lu_adap_segm9 "Geberrad-Adaption" SWORD FORMULA_0439 0 0 -7.8000 7.8000 ECU_ADDRESS 0x3F9F98 /end MEASUREMENT
/begin MEASUREMENT lu_adap_segm10 "Geberrad-Adaption" SWORD FORMULA_0439 0 0 -7.8000 7.8000 ECU_ADDRESS 0x3F9F9A /end MEASUREMENT
/begin MEASUREMENT lu_adap_cnt "LU-Adaptions-Fortschrittszaehler" UWORD FORMULA_0010 0 0 0.0 65535.0000 ECU_ADDRESS 0x3F9F9C /end MEASUREMENT
/begin MEASUREMENT lu_no_cnt "Arbeitsspiele insgesamt" ULONG FORMULA_0440 0 0 0.0 4294967295.0000 ECU_ADDRESS 0x3F9FA0 /end MEASUREMENT
/begin MEASUREMENT lu_no_active_cnt "Arbeitsspiele mit aktiver LU" ULONG FORMULA_0440 0 0 0.0 4294967295.0000 ECU_ADDRESS 0x3F9FA4 /end MEASUREMENT
/begin MEASUREMENT smg_can_obd_st_nv "OBD-Status SMG" UBYTE FORMULA_0441 0 0 0.0 255.0 ECU_ADDRESS 0x3F9FA8 /end MEASUREMENT
/begin MEASUREMENT afz_na0_cnt1_nv "Anzahl der Messwerte" UWORD FORMULA_0010 0 0 0.0 65535.0000 ECU_ADDRESS 0x3F9FAA /end MEASUREMENT
/begin MEASUREMENT afz_na0_sum1_nv "Summe der Messwerte" SLONG FORMULA_0000 0 0 -2147483648.0000 2147483647.0000 ECU_ADDRESS 0x3F9FAC /end MEASUREMENT
/begin MEASUREMENT afz_na0_cnt2_nv "Anzahl der Durchschnittswerte" UWORD FORMULA_0010 0 0 0.0 65535.0000 ECU_ADDRESS 0x3F9FB0 /end MEASUREMENT
/begin MEASUREMENT afz_na0_sum2_nv "Summe der Durchschnittswerte" SLONG FORMULA_0000 0 0 -2147483648.0000 2147483647.0000 ECU_ADDRESS 0x3F9FB4 /end MEASUREMENT
/begin MEASUREMENT afz_na0_delta_nv "Nachadaptionsdelta" SLONG FORMULA_0442 0 0 -50.0000 50.0000 ECU_ADDRESS 0x3F9FB8 /end MEASUREMENT
/begin MEASUREMENT gang_i_ha_nv "Getriebeuebersetzungsverhaeltnis Hinterachse" SWORD FORMULA_0075 0 0 -10.0000 10.0000 ECU_ADDRESS 0x3F9FBC /end MEASUREMENT
/begin MEASUREMENT auss_lp_min_sa_max_nv_zyl1 "Maximaler Offset im Aussetzerfenster bei SA." SWORD FORMULA_0443 0 0 0.0 0.6000 ECU_ADDRESS 0x3F9FBE /end MEASUREMENT
/begin MEASUREMENT auss_lp_min_sa_max_nv_zyl2 "Maximaler Offset im Aussetzerfenster bei SA." SWORD FORMULA_0443 0 0 0.0 0.6000 ECU_ADDRESS 0x3F9FC0 /end MEASUREMENT
/begin MEASUREMENT auss_lp_min_sa_max_nv_zyl3 "Maximaler Offset im Aussetzerfenster bei SA." SWORD FORMULA_0443 0 0 0.0 0.6000 ECU_ADDRESS 0x3F9FC2 /end MEASUREMENT
/begin MEASUREMENT auss_lp_min_sa_max_nv_zyl4 "Maximaler Offset im Aussetzerfenster bei SA." SWORD FORMULA_0443 0 0 0.0 0.6000 ECU_ADDRESS 0x3F9FC4 /end MEASUREMENT
/begin MEASUREMENT auss_lp_min_sa_max_nv_zyl5 "Maximaler Offset im Aussetzerfenster bei SA." SWORD FORMULA_0443 0 0 0.0 0.6000 ECU_ADDRESS 0x3F9FC6 /end MEASUREMENT
/begin MEASUREMENT auss_lp_min_sa_max_nv_zyl6 "Maximaler Offset im Aussetzerfenster bei SA." SWORD FORMULA_0443 0 0 0.0 0.6000 ECU_ADDRESS 0x3F9FC8 /end MEASUREMENT
/begin MEASUREMENT auss_lp_min_sa_max_nv_zyl7 "Maximaler Offset im Aussetzerfenster bei SA." SWORD FORMULA_0443 0 0 0.0 0.6000 ECU_ADDRESS 0x3F9FCA /end MEASUREMENT
/begin MEASUREMENT auss_lp_min_sa_max_nv_zyl8 "Maximaler Offset im Aussetzerfenster bei SA." SWORD FORMULA_0443 0 0 0.0 0.6000 ECU_ADDRESS 0x3F9FCC /end MEASUREMENT
/begin MEASUREMENT auss_lp_min_sa_max_nv_zyl9 "Maximaler Offset im Aussetzerfenster bei SA." SWORD FORMULA_0443 0 0 0.0 0.6000 ECU_ADDRESS 0x3F9FCE /end MEASUREMENT
/begin MEASUREMENT auss_lp_min_sa_max_nv_zyl10 "Maximaler Offset im Aussetzerfenster bei SA." SWORD FORMULA_0443 0 0 0.0 0.6000 ECU_ADDRESS 0x3F9FD0 /end MEASUREMENT
/begin MEASUREMENT md_off_1of3_.n "Drehzzahl" SWORD FORMULA_0006 0 0 0.0 10000.0000 ECU_ADDRESS 0x3F9FD4 /end MEASUREMENT
/begin MEASUREMENT md_off_2of3_.n "Drehzzahl" SWORD FORMULA_0006 0 0 0.0 10000.0000 ECU_ADDRESS 0x3FA00C /end MEASUREMENT
/begin MEASUREMENT md_off_3of3_.n "Drehzzahl" SWORD FORMULA_0006 0 0 0.0 10000.0000 ECU_ADDRESS 0x3FA044 /end MEASUREMENT
/begin MEASUREMENT md_off_1of3_.kupp_wunsch "Wunschmoment" SWORD FORMULA_0009 0 0 -100.0000 1000.0000 ECU_ADDRESS 0x3F9FD6 /end MEASUREMENT
/begin MEASUREMENT md_off_2of3_.kupp_wunsch "Wunschmoment" SWORD FORMULA_0009 0 0 -100.0000 1000.0000 ECU_ADDRESS 0x3FA00E /end MEASUREMENT
/begin MEASUREMENT md_off_3of3_.kupp_wunsch "Wunschmoment" SWORD FORMULA_0009 0 0 -100.0000 1000.0000 ECU_ADDRESS 0x3FA046 /end MEASUREMENT
/begin MEASUREMENT md_off_1of3_.kupp_wunsch_ges "Wunschmoment" SWORD FORMULA_0009 0 0 -100.0000 1000.0000 ECU_ADDRESS 0x3F9FD8 /end MEASUREMENT
/begin MEASUREMENT md_off_2of3_.kupp_wunsch_ges "Wunschmoment" SWORD FORMULA_0009 0 0 -100.0000 1000.0000 ECU_ADDRESS 0x3FA010 /end MEASUREMENT
/begin MEASUREMENT md_off_3of3_.kupp_wunsch_ges "Wunschmoment" SWORD FORMULA_0009 0 0 -100.0000 1000.0000 ECU_ADDRESS 0x3FA048 /end MEASUREMENT
/begin MEASUREMENT md_off_1of3_.kupp_wunsch_tz "TZ-Wunschmoment" SWORD FORMULA_0009 0 0 -100.0000 1000.0000 ECU_ADDRESS 0x3F9FDA /end MEASUREMENT
/begin MEASUREMENT md_off_2of3_.kupp_wunsch_tz "TZ-Wunschmoment" SWORD FORMULA_0009 0 0 -100.0000 1000.0000 ECU_ADDRESS 0x3FA012 /end MEASUREMENT
/begin MEASUREMENT md_off_3of3_.kupp_wunsch_tz "TZ-Wunschmoment" SWORD FORMULA_0009 0 0 -100.0000 1000.0000 ECU_ADDRESS 0x3FA04A /end MEASUREMENT
/begin MEASUREMENT md_off_1of3_.kupp_wunsch_ml "ML-Wunschmoment" SWORD FORMULA_0009 0 0 -100.0000 1000.0000 ECU_ADDRESS 0x3F9FDC /end MEASUREMENT
/begin MEASUREMENT md_off_2of3_.kupp_wunsch_ml "ML-Wunschmoment" SWORD FORMULA_0009 0 0 -100.0000 1000.0000 ECU_ADDRESS 0x3FA014 /end MEASUREMENT
/begin MEASUREMENT md_off_3of3_.kupp_wunsch_ml "ML-Wunschmoment" SWORD FORMULA_0009 0 0 -100.0000 1000.0000 ECU_ADDRESS 0x3FA04C /end MEASUREMENT
/begin MEASUREMENT md_off_1of3_.ind_schlepp "Schleppmoment" SWORD FORMULA_0009 0 0 -100.0000 1000.0000 ECU_ADDRESS 0x3F9FDE /end MEASUREMENT
/begin MEASUREMENT md_off_2of3_.ind_schlepp "Schleppmoment" SWORD FORMULA_0009 0 0 -100.0000 1000.0000 ECU_ADDRESS 0x3FA016 /end MEASUREMENT
/begin MEASUREMENT md_off_3of3_.ind_schlepp "Schleppmoment" SWORD FORMULA_0009 0 0 -100.0000 1000.0000 ECU_ADDRESS 0x3FA04E /end MEASUREMENT
/begin MEASUREMENT md_off_1of3_.ind_wunsch_ml_komp "ML-Wunschmoment" SWORD FORMULA_0009 0 0 -100.0000 1000.0000 ECU_ADDRESS 0x3F9FE0 /end MEASUREMENT
/begin MEASUREMENT md_off_2of3_.ind_wunsch_ml_komp "ML-Wunschmoment" SWORD FORMULA_0009 0 0 -100.0000 1000.0000 ECU_ADDRESS 0x3FA018 /end MEASUREMENT
/begin MEASUREMENT md_off_3of3_.ind_wunsch_ml_komp "ML-Wunschmoment" SWORD FORMULA_0009 0 0 -100.0000 1000.0000 ECU_ADDRESS 0x3FA050 /end MEASUREMENT
/begin MEASUREMENT md_off_1of3_.rf_soll "Sollfuellung" SWORD FORMULA_0006 0 0 0.0 10000.0000 ECU_ADDRESS 0x3F9FE8 /end MEASUREMENT
/begin MEASUREMENT md_off_2of3_.rf_soll "Sollfuellung" SWORD FORMULA_0006 0 0 0.0 10000.0000 ECU_ADDRESS 0x3FA020 /end MEASUREMENT
/begin MEASUREMENT md_off_3of3_.rf_soll "Sollfuellung" SWORD FORMULA_0006 0 0 0.0 10000.0000 ECU_ADDRESS 0x3FA058 /end MEASUREMENT
/begin MEASUREMENT md_off_1of3_.kupp_ist "Istmoment" SWORD FORMULA_0009 0 0 -100.0000 1000.0000 ECU_ADDRESS 0x3F9FE2 /end MEASUREMENT
/begin MEASUREMENT md_off_2of3_.kupp_ist "Istmoment" SWORD FORMULA_0009 0 0 -100.0000 1000.0000 ECU_ADDRESS 0x3FA01A /end MEASUREMENT
/begin MEASUREMENT md_off_3of3_.kupp_ist "Istmoment" SWORD FORMULA_0009 0 0 -100.0000 1000.0000 ECU_ADDRESS 0x3FA052 /end MEASUREMENT
/begin MEASUREMENT md_off_1of3_.kupp_min_filter "min. Moment" SWORD FORMULA_0009 0 0 -100.0000 1000.0000 ECU_ADDRESS 0x3F9FE6 /end MEASUREMENT
/begin MEASUREMENT md_off_2of3_.kupp_min_filter "min. Moment" SWORD FORMULA_0009 0 0 -100.0000 1000.0000 ECU_ADDRESS 0x3FA01E /end MEASUREMENT
/begin MEASUREMENT md_off_3of3_.kupp_min_filter "min. Moment" SWORD FORMULA_0009 0 0 -100.0000 1000.0000 ECU_ADDRESS 0x3FA056 /end MEASUREMENT
/begin MEASUREMENT md_off_1of3_.pwg_soll "min. Moment" SWORD FORMULA_0001 0 0 -10.0000 120.0000 ECU_ADDRESS 0x3F9FE4 /end MEASUREMENT
/begin MEASUREMENT md_off_2of3_.pwg_soll "min. Moment" SWORD FORMULA_0001 0 0 -10.0000 120.0000 ECU_ADDRESS 0x3FA01C /end MEASUREMENT
/begin MEASUREMENT md_off_3of3_.pwg_soll "min. Moment" SWORD FORMULA_0001 0 0 -10.0000 120.0000 ECU_ADDRESS 0x3FA054 /end MEASUREMENT
/begin MEASUREMENT md_off_1of3_.rf_m "Sollfuellung" SWORD FORMULA_0007 0 0 0.0 2.0000 ECU_ADDRESS 0x3F9FEA /end MEASUREMENT
/begin MEASUREMENT md_off_2of3_.rf_m "Sollfuellung" SWORD FORMULA_0007 0 0 0.0 2.0000 ECU_ADDRESS 0x3FA022 /end MEASUREMENT
/begin MEASUREMENT md_off_3of3_.rf_m "Sollfuellung" SWORD FORMULA_0007 0 0 0.0 2.0000 ECU_ADDRESS 0x3FA05A /end MEASUREMENT
/begin MEASUREMENT md_off_1of3_.pks_rel "rel. Kraftstoffdruck" SWORD FORMULA_0118 0 0 0.0 10.0000 ECU_ADDRESS 0x3F9FEC /end MEASUREMENT
/begin MEASUREMENT md_off_2of3_.pks_rel "rel. Kraftstoffdruck" SWORD FORMULA_0118 0 0 0.0 10.0000 ECU_ADDRESS 0x3FA024 /end MEASUREMENT
/begin MEASUREMENT md_off_3of3_.pks_rel "rel. Kraftstoffdruck" SWORD FORMULA_0118 0 0 0.0 10.0000 ECU_ADDRESS 0x3FA05C /end MEASUREMENT
/begin MEASUREMENT md_off_1of3_.ti_tpu_st "Einspritzung" UWORD FORMULA_0010 0 0 0.0 65535.0000 ECU_ADDRESS 0x3F9FEE /end MEASUREMENT
/begin MEASUREMENT md_off_2of3_.ti_tpu_st "Einspritzung" UWORD FORMULA_0010 0 0 0.0 65535.0000 ECU_ADDRESS 0x3FA026 /end MEASUREMENT
/begin MEASUREMENT md_off_3of3_.ti_tpu_st "Einspritzung" UWORD FORMULA_0010 0 0 0.0 65535.0000 ECU_ADDRESS 0x3FA05E /end MEASUREMENT
/begin MEASUREMENT md_off_1of3_.time_ml "Time" UWORD FORMULA_0021 0 0 0.0 655.0000 ECU_ADDRESS 0x3F9FF0 /end MEASUREMENT
/begin MEASUREMENT md_off_2of3_.time_ml "Time" UWORD FORMULA_0021 0 0 0.0 655.0000 ECU_ADDRESS 0x3FA028 /end MEASUREMENT
/begin MEASUREMENT md_off_3of3_.time_ml "Time" UWORD FORMULA_0021 0 0 0.0 655.0000 ECU_ADDRESS 0x3FA060 /end MEASUREMENT
/begin MEASUREMENT md_off_1of3_.zust_motor "Betriebszustand der Motorsteuerung" UWORD FORMULA_0019 0 0 0.0 65535.0 ECU_ADDRESS 0x3F9FF2 /end MEASUREMENT
/begin MEASUREMENT md_off_2of3_.zust_motor "Betriebszustand der Motorsteuerung" UWORD FORMULA_0019 0 0 0.0 65535.0 ECU_ADDRESS 0x3FA02A /end MEASUREMENT
/begin MEASUREMENT md_off_3of3_.zust_motor "Betriebszustand der Motorsteuerung" UWORD FORMULA_0019 0 0 0.0 65535.0 ECU_ADDRESS 0x3FA062 /end MEASUREMENT
/begin MEASUREMENT md_off_1of3_.ti_mks_soll1 "Time" UWORD FORMULA_0444 0 0 0.0 1023.9843 ECU_ADDRESS 0x3F9FF4 /end MEASUREMENT
/begin MEASUREMENT md_off_2of3_.ti_mks_soll1 "Time" UWORD FORMULA_0444 0 0 0.0 1023.9843 ECU_ADDRESS 0x3FA02C /end MEASUREMENT
/begin MEASUREMENT md_off_3of3_.ti_mks_soll1 "Time" UWORD FORMULA_0444 0 0 0.0 1023.9843 ECU_ADDRESS 0x3FA064 /end MEASUREMENT
/begin MEASUREMENT md_off_1of3_.tz1 "Time" SWORD FORMULA_0111 0 0 -50.0000 60.0000 ECU_ADDRESS 0x3F9FF6 /end MEASUREMENT
/begin MEASUREMENT md_off_2of3_.tz1 "Time" SWORD FORMULA_0111 0 0 -50.0000 60.0000 ECU_ADDRESS 0x3FA02E /end MEASUREMENT
/begin MEASUREMENT md_off_3of3_.tz1 "Time" SWORD FORMULA_0111 0 0 -50.0000 60.0000 ECU_ADDRESS 0x3FA066 /end MEASUREMENT
/begin MEASUREMENT md_off_1of3_.ti_out1 "Ausgegebene Einspritzzeit im letzten Arbeitsspiel." ULONG FORMULA_0358 0 0 4194.3030 0.0 ECU_ADDRESS 0x3F9FF8 /end MEASUREMENT
/begin MEASUREMENT md_off_2of3_.ti_out1 "Ausgegebene Einspritzzeit im letzten Arbeitsspiel." ULONG FORMULA_0358 0 0 4194.3030 0.0 ECU_ADDRESS 0x3FA030 /end MEASUREMENT
/begin MEASUREMENT md_off_3of3_.ti_out1 "Ausgegebene Einspritzzeit im letzten Arbeitsspiel." ULONG FORMULA_0358 0 0 4194.3030 0.0 ECU_ADDRESS 0x3FA068 /end MEASUREMENT
/begin MEASUREMENT md_off_1of3_.te_tv "auszugebendes TE-Tastverhaeltnis" UWORD FORMULA_0001 0 0 0.0 100.0000 ECU_ADDRESS 0x3F9FFC /end MEASUREMENT
/begin MEASUREMENT md_off_2of3_.te_tv "auszugebendes TE-Tastverhaeltnis" UWORD FORMULA_0001 0 0 0.0 100.0000 ECU_ADDRESS 0x3FA034 /end MEASUREMENT
/begin MEASUREMENT md_off_3of3_.te_tv "auszugebendes TE-Tastverhaeltnis" UWORD FORMULA_0001 0 0 0.0 100.0000 ECU_ADDRESS 0x3FA06C /end MEASUREMENT
/begin MEASUREMENT md_off_1of3_.aq_abs_b1 "Oeffnung B1" UWORD FORMULA_0147 0 0 0.0 6500.0000 ECU_ADDRESS 0x3F9FFE /end MEASUREMENT
/begin MEASUREMENT md_off_2of3_.aq_abs_b1 "Oeffnung B1" UWORD FORMULA_0147 0 0 0.0 6500.0000 ECU_ADDRESS 0x3FA036 /end MEASUREMENT
/begin MEASUREMENT md_off_3of3_.aq_abs_b1 "Oeffnung B1" UWORD FORMULA_0147 0 0 0.0 6500.0000 ECU_ADDRESS 0x3FA06E /end MEASUREMENT
/begin MEASUREMENT md_off_1of3_.aq_abs_b2 "Oeffnung B2" UWORD FORMULA_0147 0 0 0.0 6500.0000 ECU_ADDRESS 0x3FA000 /end MEASUREMENT
/begin MEASUREMENT md_off_2of3_.aq_abs_b2 "Oeffnung B2" UWORD FORMULA_0147 0 0 0.0 6500.0000 ECU_ADDRESS 0x3FA038 /end MEASUREMENT
/begin MEASUREMENT md_off_3of3_.aq_abs_b2 "Oeffnung B2" UWORD FORMULA_0147 0 0 0.0 6500.0000 ECU_ADDRESS 0x3FA070 /end MEASUREMENT
/begin MEASUREMENT md_off_1of3_.lam_ist_b1 "Lambdaist B1" UWORD FORMULA_0025 0 0 0.0 3.9990 ECU_ADDRESS 0x3FA002 /end MEASUREMENT
/begin MEASUREMENT md_off_2of3_.lam_ist_b1 "Lambdaist B1" UWORD FORMULA_0025 0 0 0.0 3.9990 ECU_ADDRESS 0x3FA03A /end MEASUREMENT
/begin MEASUREMENT md_off_3of3_.lam_ist_b1 "Lambdaist B1" UWORD FORMULA_0025 0 0 0.0 3.9990 ECU_ADDRESS 0x3FA072 /end MEASUREMENT
/begin MEASUREMENT md_off_1of3_.lam_ist_b2 "Lambdaist B2" UWORD FORMULA_0025 0 0 0.0 3.9990 ECU_ADDRESS 0x3FA004 /end MEASUREMENT
/begin MEASUREMENT md_off_2of3_.lam_ist_b2 "Lambdaist B2" UWORD FORMULA_0025 0 0 0.0 3.9990 ECU_ADDRESS 0x3FA03C /end MEASUREMENT
/begin MEASUREMENT md_off_3of3_.lam_ist_b2 "Lambdaist B2" UWORD FORMULA_0025 0 0 0.0 3.9990 ECU_ADDRESS 0x3FA074 /end MEASUREMENT
/begin MEASUREMENT md_off_1of3_.pos_kupp_ist "Debug" UBYTE FORMULA_0445 0 0 0.0 1020.0000 ECU_ADDRESS 0x3FA006 /end MEASUREMENT
/begin MEASUREMENT md_off_2of3_.pos_kupp_ist "Debug" UBYTE FORMULA_0445 0 0 0.0 1020.0000 ECU_ADDRESS 0x3FA03E /end MEASUREMENT
/begin MEASUREMENT md_off_3of3_.pos_kupp_ist "Debug" UBYTE FORMULA_0445 0 0 0.0 1020.0000 ECU_ADDRESS 0x3FA076 /end MEASUREMENT
/begin MEASUREMENT md_off_1of3_.smg_st "Debug" UBYTE FORMULA_0003 0 0 0.0 255.0000 ECU_ADDRESS 0x3FA007 /end MEASUREMENT
/begin MEASUREMENT md_off_2of3_.smg_st "Debug" UBYTE FORMULA_0003 0 0 0.0 255.0000 ECU_ADDRESS 0x3FA03F /end MEASUREMENT
/begin MEASUREMENT md_off_3of3_.smg_st "Debug" UBYTE FORMULA_0003 0 0 0.0 255.0000 ECU_ADDRESS 0x3FA077 /end MEASUREMENT
/begin MEASUREMENT md_off_1of3_.s_bls "Bremse/HBR/Kraftschluss" UBYTE FORMULA_0437 0 0 0.0 255.0 ECU_ADDRESS 0x3FA008 /end MEASUREMENT
/begin MEASUREMENT md_off_2of3_.s_bls "Bremse/HBR/Kraftschluss" UBYTE FORMULA_0437 0 0 0.0 255.0 ECU_ADDRESS 0x3FA040 /end MEASUREMENT
/begin MEASUREMENT md_off_3of3_.s_bls "Bremse/HBR/Kraftschluss" UBYTE FORMULA_0437 0 0 0.0 255.0 ECU_ADDRESS 0x3FA078 /end MEASUREMENT
/begin MEASUREMENT md_off_1of3_.tz_st "Status Sollmoment-TZ" UBYTE FORMULA_0438 0 0 0.0 255.0 ECU_ADDRESS 0x3FA009 /end MEASUREMENT
/begin MEASUREMENT md_off_2of3_.tz_st "Status Sollmoment-TZ" UBYTE FORMULA_0438 0 0 0.0 255.0 ECU_ADDRESS 0x3FA041 /end MEASUREMENT
/begin MEASUREMENT md_off_3of3_.tz_st "Status Sollmoment-TZ" UBYTE FORMULA_0438 0 0 0.0 255.0 ECU_ADDRESS 0x3FA079 /end MEASUREMENT
/begin MEASUREMENT md_off_1of3_.ml_st "Status Sollmoment-ML" UBYTE FORMULA_0438 0 0 0.0 255.0 ECU_ADDRESS 0x3FA00A /end MEASUREMENT
/begin MEASUREMENT md_off_2of3_.ml_st "Status Sollmoment-ML" UBYTE FORMULA_0438 0 0 0.0 255.0 ECU_ADDRESS 0x3FA042 /end MEASUREMENT
/begin MEASUREMENT md_off_3of3_.ml_st "Status Sollmoment-ML" UBYTE FORMULA_0438 0 0 0.0 255.0 ECU_ADDRESS 0x3FA07A /end MEASUREMENT
/begin MEASUREMENT md_off_1of3_.gang "Gang" SBYTE FORMULA_0318 0 0 -1.0000 10.0000 ECU_ADDRESS 0x3FA00B /end MEASUREMENT
/begin MEASUREMENT md_off_2of3_.gang "Gang" SBYTE FORMULA_0318 0 0 -1.0000 10.0000 ECU_ADDRESS 0x3FA043 /end MEASUREMENT
/begin MEASUREMENT md_off_3of3_.gang "Gang" SBYTE FORMULA_0318 0 0 -1.0000 10.0000 ECU_ADDRESS 0x3FA07B /end MEASUREMENT
/begin MEASUREMENT md_off_st "Debug" UBYTE FORMULA_0003 0 0 0.0 255.0000 ECU_ADDRESS 0x3FA07C /end MEASUREMENT
/begin MEASUREMENT md_sk_timer_0_nv "SK-Timer bei pwg=0 - NV" UWORD FORMULA_0021 0 0 0.0 655.0000 ECU_ADDRESS 0x3FA07E /end MEASUREMENT
/begin MEASUREMENT md_sk_timer_1_nv "SK-Timer bei pwg>0 - NV" UWORD FORMULA_0021 0 0 0.0 655.0000 ECU_ADDRESS 0x3FA080 /end MEASUREMENT
/begin MEASUREMENT md_sk_vergl_diff_nv "Soll-/Istabweichung - NV" SWORD FORMULA_0009 0 0 -100.0000 1000.0000 ECU_ADDRESS 0x3FA082 /end MEASUREMENT
/begin MEASUREMENT md_ff_e2.n "Drehzzahl" SWORD FORMULA_0006 0 0 0.0 10000.0000 ECU_ADDRESS 0x3FA084 /end MEASUREMENT
/begin MEASUREMENT md_ff_e2.rf_m "Fuellung" SWORD FORMULA_0007 0 0 0.0 2.0000 ECU_ADDRESS 0x3FA086 /end MEASUREMENT
/begin MEASUREMENT md_ff_e2.rf_pt_korr "Fuellungskorrektur" UWORD FORMULA_0075 0 0 0.0 4.0000 ECU_ADDRESS 0x3FA088 /end MEASUREMENT
/begin MEASUREMENT md_ff_e2.toel "Oeltemperatur" SWORD FORMULA_0023 0 0 -50.0000 170.0000 ECU_ADDRESS 0x3FA08A /end MEASUREMENT
/begin MEASUREMENT md_ff_e2.fw_rel "Rel. Fahrerwunsch" SWORD FORMULA_0001 0 0 -10.0000 120.0000 ECU_ADDRESS 0x3FA08C /end MEASUREMENT
/begin MEASUREMENT md_ff_e2.fw_rel_diff "Rel. Fahrerwunsch - Differenz" SWORD FORMULA_0001 0 0 -10.0000 120.0000 ECU_ADDRESS 0x3FA08E /end MEASUREMENT
/begin MEASUREMENT md_ff_e2.kupp_max "Maximalmoment" SWORD FORMULA_0009 0 0 -100.0000 1000.0000 ECU_ADDRESS 0x3FA090 /end MEASUREMENT
/begin MEASUREMENT md_ff_e2.kupp_max_diff "Maximalmoment - Differenz" SWORD FORMULA_0009 0 0 -100.0000 1000.0000 ECU_ADDRESS 0x3FA092 /end MEASUREMENT
/begin MEASUREMENT md_ff_e2.kupp_min "Minimalmoment" SWORD FORMULA_0009 0 0 -100.0000 1000.0000 ECU_ADDRESS 0x3FA094 /end MEASUREMENT
/begin MEASUREMENT md_ff_e2.kupp_min_diff "Minimalmoment - Differenz" SWORD FORMULA_0009 0 0 -100.0000 1000.0000 ECU_ADDRESS 0x3FA096 /end MEASUREMENT
/begin MEASUREMENT md_ff_e2.schlepp "Schleppmoment" SWORD FORMULA_0009 0 0 -100.0000 1000.0000 ECU_ADDRESS 0x3FA098 /end MEASUREMENT
/begin MEASUREMENT md_ff_e2.schlepp_diff "Schleppmoment - Differenz" SWORD FORMULA_0009 0 0 -100.0000 1000.0000 ECU_ADDRESS 0x3FA09A /end MEASUREMENT
/begin MEASUREMENT md_ff_e2.kupp_wunsch "Wunschmoment (Fahrer, FGR)" SWORD FORMULA_0009 0 0 -100.0000 1000.0000 ECU_ADDRESS 0x3FA09C /end MEASUREMENT
/begin MEASUREMENT md_ff_e2.kupp_soll "Sollmoment" SWORD FORMULA_0009 0 0 -100.0000 1000.0000 ECU_ADDRESS 0x3FA09E /end MEASUREMENT
/begin MEASUREMENT md_ff_e2.kupp_ist "Istmoment" SWORD FORMULA_0009 0 0 -100.0000 1000.0000 ECU_ADDRESS 0x3FA0A0 /end MEASUREMENT
/begin MEASUREMENT md_ff_e2.ind_opt "ind. Optimal" SWORD FORMULA_0009 0 0 -100.0000 1000.0000 ECU_ADDRESS 0x3FA0A2 /end MEASUREMENT
/begin MEASUREMENT md_ff_e2.ind_opt_diff "ind. Optimal - Differenz" SWORD FORMULA_0009 0 0 -100.0000 1000.0000 ECU_ADDRESS 0x3FA0A4 /end MEASUREMENT
/begin MEASUREMENT md_ff_e2.eta_zw_ne_e2 "Eta aus Ebene 2" UWORD FORMULA_0435 0 0 0.0 150.0000 ECU_ADDRESS 0x3FA0A6 /end MEASUREMENT
/begin MEASUREMENT md_ff_e2.eta_zw_ne "Eta aus Ebene 1" UWORD FORMULA_0435 0 0 0.0 150.0000 ECU_ADDRESS 0x3FA0A8 /end MEASUREMENT
/begin MEASUREMENT md_ff_e2.ti_tpu_st "Ausblendstatus" UWORD FORMULA_0010 0 0 0.0 65535.0000 ECU_ADDRESS 0x3FA0AA /end MEASUREMENT
/begin MEASUREMENT time_rel_diag_nl_nv "Relativzeit aus letztem Nachlauf" ULONG FORMULA_0149 0 0 0.0 71582788.2500 ECU_ADDRESS 0x3FA0AC /end MEASUREMENT
/begin MEASUREMENT time_rel_diag_nl_2_nv "Relativzeit aus vorletztem Nachlauf" ULONG FORMULA_0149 0 0 0.0 71582788.2500 ECU_ADDRESS 0x3FA0B0 /end MEASUREMENT
/begin MEASUREMENT time_rel_zero_cnt_nv "time_rel-Reset-Zaehler" UBYTE FORMULA_0003 0 0 0.0 255.0000 ECU_ADDRESS 0x3FA0B4 /end MEASUREMENT
/begin MEASUREMENT auss_ff.st "FF-Zustand" UWORD FORMULA_0446 0 0 0.0 65535.0 ECU_ADDRESS 0x3FA0B8 /end MEASUREMENT
/begin MEASUREMENT auss_ff.n "Drehzahl" SWORD FORMULA_0006 0 0 0.0 10000.0000 ECU_ADDRESS 0x3FA0BA /end MEASUREMENT
/begin MEASUREMENT auss_ff.ub "Spannung" SWORD FORMULA_0008 0 0 0.0 28.0000 ECU_ADDRESS 0x3FA0BC /end MEASUREMENT
/begin MEASUREMENT auss_ff.pks_rel "rel. Kraftstoffdruck" SWORD FORMULA_0118 0 0 0.0 10.0000 ECU_ADDRESS 0x3FA0BE /end MEASUREMENT
/begin MEASUREMENT auss_ff.ti_tpu_st "Freigabe Einspritzung" UWORD FORMULA_0010 0 0 0.0 65535.0000 ECU_ADDRESS 0x3FA0C0 /end MEASUREMENT
/begin MEASUREMENT auss_ff.zustand_motor "Betriebszustand" UWORD FORMULA_0019 0 0 0.0 65535.0 ECU_ADDRESS 0x3FA0C2 /end MEASUREMENT
/begin MEASUREMENT auss_ff.time_ml "Zeit seit Motor laeuft" ULONG FORMULA_0152 0 0 0.0 42949672.9500 ECU_ADDRESS 0x3FA0C4 /end MEASUREMENT
/begin MEASUREMENT auss_ff.rf "Fuellung" SWORD FORMULA_0007 0 0 0.0 2.0000 ECU_ADDRESS 0x3FA0C8 /end MEASUREMENT
/begin MEASUREMENT auss_ff.rf_hfm "Fuellung vom HFM" SWORD FORMULA_0007 0 0 0.0 2.0000 ECU_ADDRESS 0x3FA0CA /end MEASUREMENT
/begin MEASUREMENT auss_ff.rf_aq "Fuellung vom AQ" SWORD FORMULA_0007 0 0 0.0 2.0000 ECU_ADDRESS 0x3FA0CC /end MEASUREMENT
/begin MEASUREMENT auss_ff.lam_ist_mw "Mittelwert IST-Lambda" UWORD FORMULA_0025 0 0 0.0 3.9990 ECU_ADDRESS 0x3FA0CE /end MEASUREMENT
/begin MEASUREMENT auss_ff.laa_f_ber_nv "Faktor-Lambdaadaption ohne TE" UWORD FORMULA_0024 0 0 0.0 1.9990 ECU_ADDRESS 0x3FA0D0 /end MEASUREMENT
/begin MEASUREMENT auss_ff.van_ist_e "Einlassvanos Istposition" SWORD FORMULA_0111 0 0 50.0000 160.0000 ECU_ADDRESS 0x3FA0D2 /end MEASUREMENT
/begin MEASUREMENT auss_ff.van_soll_e "Einlassvanos Sollwert" SWORD FORMULA_0111 0 0 50.0000 160.0000 ECU_ADDRESS 0x3FA0D4 /end MEASUREMENT
/begin MEASUREMENT auss_ff.van_ist_a "Auslassvanos Istposition" SWORD FORMULA_0111 0 0 50.0000 160.0000 ECU_ADDRESS 0x3FA0D6 /end MEASUREMENT
/begin MEASUREMENT auss_ff.van_soll_a "Auslassvanos Sollwert" SWORD FORMULA_0111 0 0 50.0000 160.0000 ECU_ADDRESS 0x3FA0D8 /end MEASUREMENT
/begin MEASUREMENT auss_ff.egas_wdk_abs "korr. U_WDK" SWORD FORMULA_0418 0 0 0.0 5.0000 ECU_ADDRESS 0x3FA0DA /end MEASUREMENT
/begin MEASUREMENT auss_ff.egas_ist_lls "Istwert LLS (CAN)" SWORD FORMULA_0001 0 0 -10.0000 120.0000 ECU_ADDRESS 0x3FA0DC /end MEASUREMENT
/begin MEASUREMENT auss_ff.tz "Zuendwinkel" SWORD FORMULA_0111 0 0 -50.0000 60.0000 ECU_ADDRESS 0x3FA0DE /end MEASUREMENT
/begin MEASUREMENT auss_ff.auss_lp_int "TP-Integral-Leitwert im Aussetzerfenster" SWORD FORMULA_0245 0 0 0.0 4.0000 ECU_ADDRESS 0x3FA0E0 /end MEASUREMENT
/begin MEASUREMENT auss_ff.auss_spark_time "Funkenbrenndauer." SWORD FORMULA_0447 0 0 0.0 4.6810 ECU_ADDRESS 0x3FA0E2 /end MEASUREMENT
/begin MEASUREMENT auss_ff.auss_ns_time "Nebenschlusszeit im Aussetzerfenster." UWORD FORMULA_0448 0 0 0.0 24.5760 ECU_ADDRESS 0x3FA0E4 /end MEASUREMENT
/begin MEASUREMENT auss_ff.auss_lp_min "Offset Leitwert im Aussetzerfenster." SWORD FORMULA_0443 0 0 0.0 0.6000 ECU_ADDRESS 0x3FA0E6 /end MEASUREMENT
/begin MEASUREMENT auss_ff.vr_mess_ist "Istverstaerkung." SWORD FORMULA_0449 0 0 0.0 16.0000 ECU_ADDRESS 0x3FA0E8 /end MEASUREMENT
/begin MEASUREMENT auss_ff.tmot "Motortemperatur." SWORD FORMULA_0023 0 0 -50.0000 170.0000 ECU_ADDRESS 0x3FA0EA /end MEASUREMENT
/begin MEASUREMENT pwg_bls_ff.can_km_stand_nv "Kilometerstand" ULONG FORMULA_0027 0 0 0.0 16777214.0000 ECU_ADDRESS 0x3FA0EC /end MEASUREMENT
/begin MEASUREMENT pwg_bls_ff.anzahl_nv "Anzahl der Gas-Bremse-Betaetigungen" UWORD FORMULA_0010 0 0 0.0 65535.0000 ECU_ADDRESS 0x3FA0F0 /end MEASUREMENT
/begin MEASUREMENT pwg_bls_ff.sk_md_begr_nv "SK-Begrenzungsstufe" UBYTE FORMULA_0172 0 0 0.0 255.0 ECU_ADDRESS 0x3FA0F2 /end MEASUREMENT
/begin MEASUREMENT pwg_bls_ff.can_brp_nv "Bremsdruck" UBYTE FORMULA_0138 0 0 0.0 200.0000 ECU_ADDRESS 0x3FA0F3 /end MEASUREMENT
/begin MEASUREMENT pwg_bls_ff.mvac_p_nv "gemessener Differenzdruck(Senor) Mastervac/Umgebung" SWORD FORMULA_0077 0 0 -1100.0000 200.0000 ECU_ADDRESS 0x3FA0F4 /end MEASUREMENT
/begin MEASUREMENT pwg_bls_ff.pwg_filter_nv "Gefilterter Messwert der Pedalwerterfassung" UWORD FORMULA_0450 0 0 0.0 102.3984 ECU_ADDRESS 0x3FA0F6 /end MEASUREMENT
/begin MEASUREMENT pwg_bls_ff.rf_m_nv "relative Fuellung Mittel zwischen Bank 1 und 2" SWORD FORMULA_0007 0 0 0.0 2.0000 ECU_ADDRESS 0x3FA0F8 /end MEASUREMENT
/begin MEASUREMENT pwg_bls_ff.n_nv "Drehzahl" SWORD FORMULA_0006 0 0 0.0 10000.0000 ECU_ADDRESS 0x3FA0FA /end MEASUREMENT
/begin MEASUREMENT pwg_bls_ff.v_vorne_nv "v-Vorderachse" SWORD FORMULA_0078 0 0 -80.0000 360.0000 ECU_ADDRESS 0x3FA0FC /end MEASUREMENT
/begin MEASUREMENT pwg_bls_ff.can_ax "Laengsbeschleunigung (roh)" SWORD FORMULA_0132 0 0 -20.0000 20.0000 ECU_ADDRESS 0x3FA0FE /end MEASUREMENT
/begin MEASUREMENT pwg_bls_ff.can_ay "Querbeschleunigung (roh)" SWORD FORMULA_0132 0 0 -20.0000 20.0000 ECU_ADDRESS 0x3FA100 /end MEASUREMENT
/begin MEASUREMENT pwg_bls_ff.can_lrw "Lenkradwinkel" SWORD FORMULA_0141 0 0 -1440.1536 1440.1096 ECU_ADDRESS 0x3FA102 /end MEASUREMENT
/begin MEASUREMENT pwg_bls_ff.md_fw_fgr "rel. Wunschmoment vom FGR" SWORD FORMULA_0001 0 0 0.0 100.0000 ECU_ADDRESS 0x3FA104 /end MEASUREMENT
/begin MEASUREMENT at_ff.ges_dauer "Gesamtdauer des Trampelns" ULONG FORMULA_0451 0 0 0.0 21474836.0000 ECU_ADDRESS 0x3FA108 /end MEASUREMENT
/begin MEASUREMENT at_ff.ges_aktiv_cnt "Anzahl der Anti-Trampel Aktivierungen" UWORD FORMULA_0010 0 0 0.0 65535.0000 ECU_ADDRESS 0x3FA10C /end MEASUREMENT
/begin MEASUREMENT at_ff.ges_trmp_avg "mittlere Trampelintensitaet des Trampelns" SWORD FORMULA_0452 0 0 -80.0000 360.0000 ECU_ADDRESS 0x3FA10E /end MEASUREMENT
/begin MEASUREMENT at_ff.letzter_km_stand "Kilometerstand des letzten Trampelns" ULONG FORMULA_0027 0 0 0.0 16777214.0000 ECU_ADDRESS 0x3FA110 /end MEASUREMENT
/begin MEASUREMENT at_ff.letzter_dauer "Dauer des letzten Trampelns" UWORD FORMULA_0117 0 0 0.0 325.0000 ECU_ADDRESS 0x3FA114 /end MEASUREMENT
/begin MEASUREMENT at_ff.letzter_trmp_avg "mittlere Trampelintensitaet des letzten Trampelns" SWORD FORMULA_0452 0 0 -80.0000 360.0000 ECU_ADDRESS 0x3FA116 /end MEASUREMENT
/begin MEASUREMENT at_ff.letzter_trmp_max "max. Trampelintensitaet des letzten Trampelns" SWORD FORMULA_0452 0 0 -80.0000 360.0000 ECU_ADDRESS 0x3FA118 /end MEASUREMENT
/begin MEASUREMENT at_ff.letzter_tumg "Umgebungstemperatur waehrend des letzten Trampelns" SWORD FORMULA_0023 0 0 -50.0000 170.0000 ECU_ADDRESS 0x3FA11A /end MEASUREMENT
/begin MEASUREMENT at_ff.letzter_tgetr "Getriebetemperatur waehrend des letzten Trampelns" SWORD FORMULA_0023 0 0 -50.0000 190.0000 ECU_ADDRESS 0x3FA11C /end MEASUREMENT
/begin MEASUREMENT at_ff.letzter_v_vorne "v-Vorderachse beim letzten Trampeln" SWORD FORMULA_0078 0 0 -80.0000 360.0000 ECU_ADDRESS 0x3FA11E /end MEASUREMENT
/begin MEASUREMENT at_ff.letzter_md_kupp_wunsch_ges "Wunschmoment beim letzten Trampeln" SWORD FORMULA_0009 0 0 -100.0000 1000.0000 ECU_ADDRESS 0x3FA120 /end MEASUREMENT
/begin MEASUREMENT at_ff.letzter_gang "Gang beim letzten Trampeln" SBYTE FORMULA_0318 0 0 -1.0000 10.0000 ECU_ADDRESS 0x3FA122 /end MEASUREMENT
/begin MEASUREMENT at_ff.max_gang "Gang beim staerksten Trampeln" SBYTE FORMULA_0318 0 0 -1.0000 10.0000 ECU_ADDRESS 0x3FA123 /end MEASUREMENT
/begin MEASUREMENT at_ff.max_km_stand "Kilometerstand des staerksten Trampelns" ULONG FORMULA_0027 0 0 0.0 16777214.0000 ECU_ADDRESS 0x3FA124 /end MEASUREMENT
/begin MEASUREMENT at_ff.max_dauer "Dauer des staerksten Trampelns" UWORD FORMULA_0117 0 0 0.0 325.0000 ECU_ADDRESS 0x3FA128 /end MEASUREMENT
/begin MEASUREMENT at_ff.max_trmp_avg "mittlere Trampelintensitaet des staerksten Trampelns" SWORD FORMULA_0452 0 0 -80.0000 360.0000 ECU_ADDRESS 0x3FA12A /end MEASUREMENT
/begin MEASUREMENT at_ff.max_trmp_max "max. Trampelintensitaet des staerksten Trampelns" SWORD FORMULA_0452 0 0 -80.0000 360.0000 ECU_ADDRESS 0x3FA12C /end MEASUREMENT
/begin MEASUREMENT at_ff.max_tumg "Umgebungstemperatur waehrend des staerksten Trampelns" SWORD FORMULA_0023 0 0 -50.0000 170.0000 ECU_ADDRESS 0x3FA12E /end MEASUREMENT
/begin MEASUREMENT at_ff.max_tgetr "Getriebetemperatur waehrend des staerksten Trampelns" SWORD FORMULA_0023 0 0 -50.0000 190.0000 ECU_ADDRESS 0x3FA130 /end MEASUREMENT
/begin MEASUREMENT at_ff.max_v_vorne "v-Vorderachse beim staerksten Trampeln" SWORD FORMULA_0078 0 0 -80.0000 360.0000 ECU_ADDRESS 0x3FA132 /end MEASUREMENT
/begin MEASUREMENT at_ff.max_md_kupp_wunsch_ges "Wunschmoment beim staerksten Trampeln" SWORD FORMULA_0009 0 0 -100.0000 1000.0000 ECU_ADDRESS 0x3FA134 /end MEASUREMENT
/* ------------------ Abschnitt erzeugt aus adapt_wichtig.dat ------------------ */
/begin MEASUREMENT eeprom_crc_wichtig_nv "Lebensdauer Adaptionsdaten" ULONG FORMULA_0000 0 0 0.0 4294967295.0000 ECU_ADDRESS 0x3F9064 /end MEASUREMENT
/begin MEASUREMENT eeprom_anzahl_schreiben_nv "Anzahl der Schreibvorgaenge ins Flash" ULONG FORMULA_0453 0 0 0.0 4294967295.0000 ECU_ADDRESS 0x3F9068 /end MEASUREMENT
/begin MEASUREMENT eeprom_datenlaenge_wichtig_nv "Anzahl der Datenbytes" UWORD FORMULA_0454 0 0 0.0 262140.0000 ECU_ADDRESS 0x3F906C /end MEASUREMENT
/begin MEASUREMENT eeprom_version_prog_nv "Programmversion beim Abspeichern" UWORD FORMULA_0455 0 0 0.0 65535.0000 ECU_ADDRESS 0x3F906E /end MEASUREMENT
/begin MEASUREMENT eeprom_crc_nv "Standstabile Adaptionsdaten" ULONG FORMULA_0000 0 0 0.0 4294967295.0000 ECU_ADDRESS 0x3F9070 /end MEASUREMENT
/begin MEASUREMENT eeprom_datenlaenge_nv "Anzahl der Datenbytes" UWORD FORMULA_0454 0 0 0.0 262140.0000 ECU_ADDRESS 0x3F9074 /end MEASUREMENT
/begin MEASUREMENT eeprom_date_1of9_ "Erstelldatum beim Abspeichern" UBYTE FORMULA_0414 0 0 0.0 255.0 ECU_ADDRESS 0x3F9076 /end MEASUREMENT
/begin MEASUREMENT eeprom_date_2of9_ "Erstelldatum beim Abspeichern" UBYTE FORMULA_0414 0 0 0.0 255.0 ECU_ADDRESS 0x3F9077 /end MEASUREMENT
/begin MEASUREMENT eeprom_date_3of9_ "Erstelldatum beim Abspeichern" UBYTE FORMULA_0414 0 0 0.0 255.0 ECU_ADDRESS 0x3F9078 /end MEASUREMENT
/begin MEASUREMENT eeprom_date_4of9_ "Erstelldatum beim Abspeichern" UBYTE FORMULA_0414 0 0 0.0 255.0 ECU_ADDRESS 0x3F9079 /end MEASUREMENT
/begin MEASUREMENT eeprom_date_5of9_ "Erstelldatum beim Abspeichern" UBYTE FORMULA_0414 0 0 0.0 255.0 ECU_ADDRESS 0x3F907A /end MEASUREMENT
/begin MEASUREMENT eeprom_date_6of9_ "Erstelldatum beim Abspeichern" UBYTE FORMULA_0414 0 0 0.0 255.0 ECU_ADDRESS 0x3F907B /end MEASUREMENT
/begin MEASUREMENT eeprom_date_7of9_ "Erstelldatum beim Abspeichern" UBYTE FORMULA_0414 0 0 0.0 255.0 ECU_ADDRESS 0x3F907C /end MEASUREMENT
/begin MEASUREMENT eeprom_date_8of9_ "Erstelldatum beim Abspeichern" UBYTE FORMULA_0414 0 0 0.0 255.0 ECU_ADDRESS 0x3F907D /end MEASUREMENT
/begin MEASUREMENT eeprom_date_9of9_ "Erstelldatum beim Abspeichern" UBYTE FORMULA_0414 0 0 0.0 255.0 ECU_ADDRESS 0x3F907E /end MEASUREMENT
/begin MEASUREMENT eeprom_time_1of6_ "Erstellzeit beim Abspeichern" UBYTE FORMULA_0414 0 0 0.0 255.0 ECU_ADDRESS 0x3F907F /end MEASUREMENT
/begin MEASUREMENT eeprom_time_2of6_ "Erstellzeit beim Abspeichern" UBYTE FORMULA_0414 0 0 0.0 255.0 ECU_ADDRESS 0x3F9080 /end MEASUREMENT
/begin MEASUREMENT eeprom_time_3of6_ "Erstellzeit beim Abspeichern" UBYTE FORMULA_0414 0 0 0.0 255.0 ECU_ADDRESS 0x3F9081 /end MEASUREMENT
/begin MEASUREMENT eeprom_time_4of6_ "Erstellzeit beim Abspeichern" UBYTE FORMULA_0414 0 0 0.0 255.0 ECU_ADDRESS 0x3F9082 /end MEASUREMENT
/begin MEASUREMENT eeprom_time_5of6_ "Erstellzeit beim Abspeichern" UBYTE FORMULA_0414 0 0 0.0 255.0 ECU_ADDRESS 0x3F9083 /end MEASUREMENT
/begin MEASUREMENT eeprom_time_6of6_ "Erstellzeit beim Abspeichern" UBYTE FORMULA_0414 0 0 0.0 255.0 ECU_ADDRESS 0x3F9084 /end MEASUREMENT
/begin MEASUREMENT hdw_1_nv "HDW" ULONG FORMULA_0000 0 0 0.0 4294967295.0000 ECU_ADDRESS 0x3F9088 /end MEASUREMENT
/begin MEASUREMENT hdw_2_nv "HDW" ULONG FORMULA_0000 0 0 0.0 4294967295.0000 ECU_ADDRESS 0x3F908C /end MEASUREMENT
/begin MEASUREMENT hdw_3_nv "HDW" ULONG FORMULA_0000 0 0 0.0 4294967295.0000 ECU_ADDRESS 0x3F9090 /end MEASUREMENT
/begin MEASUREMENT tdme_max_nv "Maximale DME-Temperatur ueber alle Zyklen" SWORD FORMULA_0023 0 0 -50.0000 170.0000 ECU_ADDRESS 0x3F9094 /end MEASUREMENT
/begin MEASUREMENT tdme_min_nv "Minimale DME-Temperatur ueber alle Zyklen" SWORD FORMULA_0023 0 0 -50.0000 170.0000 ECU_ADDRESS 0x3F9096 /end MEASUREMENT
/begin MEASUREMENT tdme_time_zaehler_nv "Zeit fuer Temperatur oberhalb Schwelle" ULONG FORMULA_0456 0 0 0.0 429496729.5000 ECU_ADDRESS 0x3F9098 /end MEASUREMENT
/begin MEASUREMENT tdme_zyklen_nv "Fahrzyklen oberhalb der Temperatur Schwelle" UWORD FORMULA_0457 0 0 0.0 65535.0000 ECU_ADDRESS 0x3F909C /end MEASUREMENT
/begin MEASUREMENT afz_a0_nv "Nullpunktadaption f�r Laengsbeschleunigung Fahrzeug" SWORD FORMULA_0458 0 0 -50.0000 50.0000 ECU_ADDRESS 0x3F909E /end MEASUREMENT
/* ------------------ Abschnitt erzeugt aus tabg.dat ------------------ */
/begin CHARACTERISTIC K_TABG_NKAT_CFG "Schalter welche Nachkattemperatur | EN: Schalter welche Nachkattemperatur" VALUE 0x79304 TKW_VV_VV_UB 100.0 FORMULA_0976 0.0 255.0 /end CHARACTERISTIC
/begin CHARACTERISTIC K_TABG_NKAT_MAX_CFG "Schalter welche Nachkattemperatur abgespeichert wird" VALUE 0x79305 TKW_VV_VV_UB 100.0 FORMULA_0977 0.0 255.0 /end CHARACTERISTIC
/begin CHARACTERISTIC K_TABG_PST_V "Ersatzgeschwindigkeit am Pruefstand | EN: Ersatzgeschwindigkeit am Pruefstand" VALUE 0x79306 TKW_VV_VV_SW 100.0 FORMULA_0078 -80.0000 360.0000 FORMAT "%4.1" /end CHARACTERISTIC
/begin CHARACTERISTIC K_TABG_NKAT_K_TUMG "Waermeuebergangskoeffizient | EN: Waermeuebergangskoeffizient" VALUE 0x79308 TKW_VV_VV_UW 100.0 FORMULA_0978 0.0 65.5350 FORMAT "%7.4" /end CHARACTERISTIC
/begin CHARACTERISTIC K_TABG_VKAT_K_V "Geschwindikeitsabhaengiger Waermeuebergangskoeffizient | EN: Geschwindikeitsabhaengiger Waermeuebergangskoeffizient" VALUE 0x7930A TKW_VV_VV_UW 100.0 FORMULA_0979 0.0 6.5535 FORMAT "%7.4" /end CHARACTERISTIC
/begin CHARACTERISTIC K_TABG_NKAT_K_V "Geschwindikeitsabhaengiger Waermeuebergangskoeffizient | EN: Geschwindikeitsabhaengiger Waermeuebergangskoeffizient" VALUE 0x7930C TKW_VV_VV_UW 100.0 FORMULA_0979 0.0 6.5535 FORMAT "%7.4" /end CHARACTERISTIC
/begin CHARACTERISTIC K_TABG_DIAG_MIN "Unter Grenze Abgastemperatur" VALUE 0x7930E TKW_VV_VV_SW 100.0 FORMULA_0333 -50.0000 1250.0000 FORMAT "%5.2" /end CHARACTERISTIC
/begin CHARACTERISTIC K_TABG_DIAG_MAX "Obere Grenze Abgastemperatur" VALUE 0x79310 TKW_VV_VV_SW 100.0 FORMULA_0333 -50.0000 1250.0000 FORMAT "%5.2" /end CHARACTERISTIC
/begin CHARACTERISTIC K_TABG_DIAG_PLAUSI_DELTA_NEG "Maximale negative Abweichung" VALUE 0x79312 TKW_VV_VV_SW 100.0 FORMULA_0980 -1000.0000 0.0 FORMAT "%5.2" /end CHARACTERISTIC
/begin CHARACTERISTIC K_TABG_DIAG_PLAUSI_DELTA_POS "Maximale positive Abweichung" VALUE 0x79314 TKW_VV_VV_SW 100.0 FORMULA_0980 0.0 1000.0000 FORMAT "%5.2" /end CHARACTERISTIC
/begin CHARACTERISTIC K_TABG_DIAG_PLAUSI_AKTIV_T_ML "Plausi-Diag-Sperrzeit nach Motorstart" VALUE 0x79316 TKW_VV_VV_UW 100.0 FORMULA_0021 0.0 655.0000 FORMAT "%5.2" /end CHARACTERISTIC
/begin CHARACTERISTIC K_TABG_DIAG_TIME "Sperrzeit fuer Plausifehler" VALUE 0x79318 TKW_VV_VV_UW 100.0 FORMULA_0073 0.0 6553.5000 FORMAT "%4.1" /end CHARACTERISTIC
/begin CHARACTERISTIC K_TABG_STAND_MAX "Maximale Abstellabgastemperatur | EN: Maximale Abstellabgastempe-ratur" VALUE 0x7931A TKW_VV_VV_SW 100.0 FORMULA_0076 -1000.0000 1250.0000 FORMAT "%4.1" /end CHARACTERISTIC
/begin CHARACTERISTIC K_TABG_TAU "Filterkonstante fuer die Abgastemperaturerfassung | EN: Filterkonstante fuer die A b-gastemperaturerfassung" VALUE 0x7931C TKW_VV_VV_UB 100.0 FORMULA_0679 0.1004 25.6000 /end CHARACTERISTIC
/begin CHARACTERISTIC K_TABG_KAT_OBD_GRAD_TAU "Filterkonstante fuer die Kattemperatur | EN: Filterkonstante fuer die Ka t-temperatur" VALUE 0x7931D TKW_VV_VV_UB 100.0 FORMULA_0679 0.1004 25.6000 /end CHARACTERISTIC
/begin CHARACTERISTIC K_TABG_KAT_OBD_GRAD_MAX "Max. Gradient ueber 100ms | EN: Max. Gradient ueber 100ms" VALUE 0x7931E TKW_VV_VV_SW 100.0 FORMULA_0981 0.0 1638.3500 FORMAT "%5.2" /end CHARACTERISTIC
/begin CHARACTERISTIC K_TABG_C "Mittlere spezifische Waermekapazitaet | EN: Mittlere spezifische Waerm e-kapazitaet" VALUE 0x79320 TKW_VV_VV_UW 100.0 FORMULA_0982 1.0000 65535.0000 /end CHARACTERISTIC
/begin CHARACTERISTIC K_TABG_VKAT_MC "Waermekapazitaet vor Kat | EN: Waermekapazitaet vor Kat" VALUE 0x79322 TKW_VV_VV_UW 100.0 FORMULA_0983 1.0000 65535.0000 /end CHARACTERISTIC
/begin CHARACTERISTIC K_TABG_VKAT_REAK_SCHWELLE "Aktivierungsschwelle Kruemmerreaktion | EN: Aktivierungsschwelle Kruemmerreaktion" VALUE 0x79324 TKW_VV_VV_SW 100.0 FORMULA_0023 -50.0000 1250.0000 FORMAT "%4.1" /end CHARACTERISTIC
/begin CHARACTERISTIC K_TABG_KAT_MC "Waermekapazitaet des Katalysatoranfangs | EN: Waermekapazitaet des Kat a-lysatoranfangs" VALUE 0x79326 TKW_VV_VV_UW 100.0 FORMULA_0983 1.0000 65535.0000 /end CHARACTERISTIC
/begin CHARACTERISTIC K_TABG_NKAT_MC "Waermekapazitaet des Katalysatorendes | EN: Waermekapazitaet des Kat a-lysatorendes" VALUE 0x79328 TKW_VV_VV_UW 100.0 FORMULA_0983 1.0000 65535.0000 /end CHARACTERISTIC
/begin CHARACTERISTIC K_TABG_LW_AUSBLEND_OFFS "Temperaturoffset ausgeblendeter Zylinder | EN: Temperaturoffset ausgeble n-deter Zylinder" VALUE 0x7932A TKW_VV_VV_SW 100.0 FORMULA_0076 -1000.0000 1000.0000 FORMAT "%4.1" /end CHARACTERISTIC
/begin CHARACTERISTIC K_TABG_VKAT_A "Kruemmerflaeche | EN: Krümmerflaeche" VALUE 0x7932C TKW_VV_VV_UW 100.0 FORMULA_0984 0.0 6.5535 FORMAT "%7.4" /end CHARACTERISTIC
/begin CHARACTERISTIC K_TABG_NKAT_A "Katflaeche | EN: Katflaeche" VALUE 0x7932E TKW_VV_VV_UW 100.0 FORMULA_0984 0.0 6.5535 FORMAT "%7.4" /end CHARACTERISTIC
/begin CHARACTERISTIC K_TABG_KAT_T_OFFS_AUF "Aufregelrampe Enthalpie | EN: Ramp-up for enthalpy" VALUE 0x79330 TKW_VV_VV_SW 100.0 FORMULA_0985 0.0 3276.7000 FORMAT "%4.1" /end CHARACTERISTIC
/begin CHARACTERISTIC K_TABG_KAT_T_OFFS_AB "Abregelrampe Enthalpie | EN: Ramp-down for enthalpy" VALUE 0x79332 TKW_VV_VV_SW 100.0 FORMULA_0985 0.0 3276.7000 FORMAT "%4.1" /end CHARACTERISTIC
/begin CHARACTERISTIC K_TABG_KAT_EXO_HYS "Hysterese fuer Enthalpie | EN: Hysteresis for enthalpy" VALUE 0x79334 TKW_VV_VV_SW 100.0 FORMULA_0076 -1000.0000 1000.0000 FORMAT "%4.1" /end CHARACTERISTIC
/begin CHARACTERISTIC K_TABG_KAT_EXO_ON "Startwert fuer Enthalpie | EN: Start value for enthalpy [°C]" VALUE 0x79336 TKW_VV_VV_SW 100.0 FORMULA_0023 -50.0000 1250.0000 FORMAT "%4.1" /end CHARACTERISTIC
/begin CHARACTERISTIC K_TABG_KAT_EXO_MS_SCHWELLE "Gespeicherte Sauerstoffmasse im KAT | EN: Stored oxygen mass in the catalyst [mg]" VALUE 0x79338 TKW_VV_VV_SW 100.0 FORMULA_0093 -3276.8000 3276.7000 FORMAT "%5.2" /end CHARACTERISTIC
/begin CHARACTERISTIC KL_TABG_PT200 "Kennlinie Abgastemperatur | EN: Exhaust temperature curve" CURVE 0x7933A TKL_SW_VV_SW 100.0 FORMULA_0333 -50.0000 1250.0000 /begin AXIS_DESCR STD_AXIS tabg_ad FORMULA_0123 18 0.0 1023.0000 /end AXIS_DESCR FORMAT "%5.2" /end CHARACTERISTIC
/begin CHARACTERISTIC KL_TABG_LW_F_RG "Gewichtungsfaktor Restgas" CURVE 0x79384 TKL_SW_VV_UW 100.0 FORMULA_0075 0.0 4.0000
 /begin AXIS_DESCR STD_AXIS rg_x_delta FORMULA_0109 7 -0.5000 0.5000 FORMAT "%5.2" /end AXIS_DESCR
 FORMAT "%6.3" /end CHARACTERISTIC
/begin CHARACTERISTIC KL_TABG_LW_F_ETA_ZW "Gewichtungsfaktor Zuendwinkel | EN: Weighting factor, ignition angle" CURVE 0x793A2 TKL_UW_VV_UW 100.0 FORMULA_0075 0.0 4.0000
 /begin AXIS_DESCR STD_AXIS md_eta_zw_ne FORMULA_0435 6 0.0 150.0000 FORMAT "%4.1" /end AXIS_DESCR
 FORMAT "%6.3" /end CHARACTERISTIC
/begin CHARACTERISTIC KL_TABG_LW_F_LAM "Gewichtungsfaktor Lambda | EN: Weighting factor, lambda" CURVE 0x793BC TKL_UW_VV_UW 100.0 FORMULA_0075 0.0 4.0000
 /begin AXIS_DESCR STD_AXIS lam_ist_mw FORMULA_0025 4 0.0 3.9990 FORMAT "%6.3" /end AXIS_DESCR
 FORMAT "%6.3" /end CHARACTERISTIC
/begin CHARACTERISTIC KL_TABG_LW_VERH_WURZEL "Verhaeltnis der Ladungswechseltemperaturen | EN: Ratio of gas-exchange temperatures" CURVE 0x793CE TKL_UW_VV_UW 100.0 FORMULA_0075 0.0 4.0000
 /begin AXIS_DESCR STD_AXIS tabg_lw_verh FORMULA_0075 7 0.0 4.0000 FORMAT "%6.3" /end AXIS_DESCR
 FORMAT "%6.3" /end CHARACTERISTIC
/begin CHARACTERISTIC KL_TABG_VKAT_STAND_F "Faktor Standzeit | EN: Faktor Standzeit" CURVE 0x793EC TKL_UW_VV_UW 100.0 FORMULA_0075 0.0 4.0000
 /begin AXIS_DESCR STD_AXIS time_ms FORMULA_0986 8 0.0 1092.2500 FORMAT "%5.2" /end AXIS_DESCR
 FORMAT "%6.3" /end CHARACTERISTIC
/begin CHARACTERISTIC KL_TABG_KAT_STAND_F "Faktor Standzeit | EN: Faktor Standzeit" CURVE 0x7940E TKL_UW_VV_UW 100.0 FORMULA_0075 0.0 4.0000
 /begin AXIS_DESCR STD_AXIS time_ms FORMULA_0986 8 0.0 1092.2500 FORMAT "%5.2" /end AXIS_DESCR
 FORMAT "%6.3" /end CHARACTERISTIC
/begin CHARACTERISTIC KL_TABG_LW_STAND_F "Faktor Standzeit | EN: Faktor Standzeit" CURVE 0x79430 TKL_UW_VV_UW 100.0 FORMULA_0075 0.0 4.0000
 /begin AXIS_DESCR STD_AXIS time_ms FORMULA_0986 4 0.0 1092.2500 FORMAT "%5.2" /end AXIS_DESCR
 FORMAT "%6.3" /end CHARACTERISTIC
/begin CHARACTERISTIC KL_TABG_LW_TAU "Filterzeitkonstante | EN: Filter time constant" CURVE 0x79442 TKL_SW_VV_UB 100.0 FORMULA_0679 0.1004 25.6000
 /begin AXIS_DESCR STD_AXIS tabg_lw_ml_ges FORMULA_0112 4 -100.0000 1400.0000 FORMAT "%4.1" /end AXIS_DESCR
/end CHARACTERISTIC
/begin CHARACTERISTIC KL_TABG_VKAT_K_TMOT "Waermeuebergangskoeffizient | EN: Waermeuebergangskoeffizient" CURVE 0x79450 TKL_SW_VV_UW 100.0 FORMULA_0978 0.0 65.5350
 /begin AXIS_DESCR STD_AXIS tabg_lw_ml_ges FORMULA_0112 4 -100.0000 1400.0000 FORMAT "%4.1" /end AXIS_DESCR
 FORMAT "%7.4" /end CHARACTERISTIC
/begin CHARACTERISTIC KL_TABG_VKAT_MC_F_TMOT "Waermekapazitaet vor Kat beim Start | EN: Waermekapazitaet vor Kat beim Start" CURVE 0x79462 TKL_SW_VV_UW 100.0 FORMULA_0075 0.0 63.9990
 /begin AXIS_DESCR STD_AXIS tmot FORMULA_0023 4 -50.0000 170.0000 FORMAT "%4.1" /end AXIS_DESCR
 FORMAT "%6.3" /end CHARACTERISTIC
/begin CHARACTERISTIC KL_TABG_VKAT_F_REAK "Reaktion im Kruemmer | EN: Reaction in the exhaust manifold" CURVE 0x79474 TKL_UW_VV_UW 100.0 FORMULA_0075 0.0 4.0000
 /begin AXIS_DESCR STD_AXIS lam_ist_mw FORMULA_0025 4 0.0 3.9990 FORMAT "%6.3" /end AXIS_DESCR
 FORMAT "%6.3" /end CHARACTERISTIC
/begin CHARACTERISTIC KL_TABG_KAT_EXO_MAX "Maximale Enthalpie | EN: Maximale Enthalpie" CURVE 0x79486 TKL_UW_VV_SW 100.0 FORMULA_0975 0.0 327.6700
 /begin AXIS_DESCR STD_AXIS lam_ist_mw FORMULA_0025 4 0.0 3.9990 FORMAT "%6.3" /end AXIS_DESCR
 FORMAT "%5.2" /end CHARACTERISTIC
/begin CHARACTERISTIC KL_TABG_DIAG_PLAUSI_ML_FAK "Gewichtungsfaktor bei der Diagnose | EN: Weighting factor during diagnosis" CURVE 0x79498 TKL_SW_VV_UW 100.0 FORMULA_0075 0.0 4.0000
 /begin AXIS_DESCR STD_AXIS tabg_ml_ges FORMULA_0112 4 -100.0000 1400.0000 FORMAT "%4.1" /end AXIS_DESCR
 FORMAT "%6.3" /end CHARACTERISTIC
/begin CHARACTERISTIC KF_TABG_LW_STAT "Stationaere Abgastemperatur nach Ladungswechsel | EN: Steady-state exhaust temperature after gas exchange" MAP 0x794AA TKF_SW_SW_SW 100.0 FORMULA_0023 -50.0000 1250.0000 /begin AXIS_DESCR STD_AXIS n FORMULA_0006 8 0.0 10000.0000 /end AXIS_DESCR /begin AXIS_DESCR STD_AXIS rf FORMULA_0007 8 0.0 2.0000 FORMAT "%6.3" /end AXIS_DESCR FORMAT "%4.1" /end CHARACTERISTIC
/begin MEASUREMENT tabg_ad_b1 "Eingelesener Spannungswert fuer Abgastemperatur" SWORD FORMULA_0123 0 0 0.0 1023.0000 ECU_ADDRESS 0x3FC360 /end MEASUREMENT
/begin MEASUREMENT tabg_ad_b2 "Eingelesener Spannungswert fuer Abgastemperatur" SWORD FORMULA_0123 0 0 0.0 1023.0000 ECU_ADDRESS 0x3FC362 /end MEASUREMENT
/begin MEASUREMENT tabg_roh_b1 "Ungefilterter Messwert der Abgastemperatur" SWORD FORMULA_0333 0 0 -50.0000 1250.0000 ECU_ADDRESS 0x3FC364 /end MEASUREMENT
/begin MEASUREMENT tabg_roh_b2 "Ungefilterter Messwert der Abgastemperatur" SWORD FORMULA_0333 0 0 -50.0000 1250.0000 ECU_ADDRESS 0x3FC366 /end MEASUREMENT
/begin MEASUREMENT tabg_kat_obd_grad_filter_b1 "Gefilterte Kattemperatur" SWORD FORMULA_0333 0 0 -50.0000 1250.0000 ECU_ADDRESS 0x3FC368 /end MEASUREMENT
/begin MEASUREMENT tabg_kat_obd_grad_filter_b2 "Gefilterte Kattemperatur" SWORD FORMULA_0333 0 0 -50.0000 1250.0000 ECU_ADDRESS 0x3FC36A /end MEASUREMENT
/begin MEASUREMENT tabg_lw_stat_b1 "Temperatur in Celsius" SWORD FORMULA_0023 0 0 -50.0000 1250.0000 ECU_ADDRESS 0x3FC36C /end MEASUREMENT
/begin MEASUREMENT tabg_lw_stat_b2 "Temperatur in Celsius" SWORD FORMULA_0023 0 0 -50.0000 1250.0000 ECU_ADDRESS 0x3FC36E /end MEASUREMENT
/begin MEASUREMENT tabg_lw_roh_b1 "Ungefilterte Ladungswechseltemperatur" SWORD FORMULA_0333 0 0 -50.0000 1250.0000 ECU_ADDRESS 0x3FC370 /end MEASUREMENT
/begin MEASUREMENT tabg_lw_roh_b2 "Ungefilterte Ladungswechseltemperatur" SWORD FORMULA_0333 0 0 -50.0000 1250.0000 ECU_ADDRESS 0x3FC372 /end MEASUREMENT
/begin MEASUREMENT tabg_lw_filter_b1 "Gefilterte Ladungswechseltemperatur" SWORD FORMULA_0333 0 0 -50.0000 1250.0000 ECU_ADDRESS 0x3FC374 /end MEASUREMENT
/begin MEASUREMENT tabg_lw_filter_b2 "Gefilterte Ladungswechseltemperatur" SWORD FORMULA_0333 0 0 -50.0000 1250.0000 ECU_ADDRESS 0x3FC376 /end MEASUREMENT
/begin MEASUREMENT tabg_lw_f_rg_b1 "Resteinflussgasfaktor" UWORD FORMULA_0075 0 0 0.0 4.0000 ECU_ADDRESS 0x3FC378 /end MEASUREMENT
/begin MEASUREMENT tabg_lw_f_rg_b2 "Resteinflussgasfaktor" UWORD FORMULA_0075 0 0 0.0 4.0000 ECU_ADDRESS 0x3FC37A /end MEASUREMENT
/begin MEASUREMENT tabg_lw_f_eta_zw_ne_b1 "Zuendwinkeleinflussfaktor" UWORD FORMULA_0075 0 0 0.0 4.0000 ECU_ADDRESS 0x3FC37C /end MEASUREMENT
/begin MEASUREMENT tabg_lw_f_eta_zw_ne_b2 "Zuendwinkeleinflussfaktor" UWORD FORMULA_0075 0 0 0.0 4.0000 ECU_ADDRESS 0x3FC37E /end MEASUREMENT
/begin MEASUREMENT tabg_lw_f_lam_b1 "Lambdaeinflussfaktor" UWORD FORMULA_0075 0 0 0.0 4.0000 ECU_ADDRESS 0x3FC380 /end MEASUREMENT
/begin MEASUREMENT tabg_lw_f_lam_b2 "Lambdaeinflussfaktor" UWORD FORMULA_0075 0 0 0.0 4.0000 ECU_ADDRESS 0x3FC382 /end MEASUREMENT
/begin MEASUREMENT tabg_vkat_f_reak_b1 "Faktor der Reaktion im Kruemmer" UWORD FORMULA_0075 0 0 0.0 4.0000 ECU_ADDRESS 0x3FC384 /end MEASUREMENT
/begin MEASUREMENT tabg_vkat_f_reak_b2 "Faktor der Reaktion im Kruemmer" UWORD FORMULA_0075 0 0 0.0 4.0000 ECU_ADDRESS 0x3FC386 /end MEASUREMENT
/begin MEASUREMENT tabg_ml_ges_b1 "Gesamte Luftmasse im Abgasstrang" SWORD FORMULA_0112 0 0 -100.0000 1400.0000 ECU_ADDRESS 0x3FC388 /end MEASUREMENT
/begin MEASUREMENT tabg_ml_ges_b2 "Gesamte Luftmasse im Abgasstrang" SWORD FORMULA_0112 0 0 -100.0000 1400.0000 ECU_ADDRESS 0x3FC38A /end MEASUREMENT
/begin MEASUREMENT tabg_lw_tau_b1 "Filterzeitkonstante fuer Ladungswechsel" UBYTE FORMULA_0679 0 0 0.1004 25.6000 ECU_ADDRESS 0x3FC38C /end MEASUREMENT
/begin MEASUREMENT tabg_lw_tau_b2 "Filterzeitkonstante fuer Ladungswechsel" UBYTE FORMULA_0679 0 0 0.1004 25.6000 ECU_ADDRESS 0x3FC38D /end MEASUREMENT
/begin MEASUREMENT tabg_kat_t_offs_b1 "Enthalpietemperatur" SWORD FORMULA_0975 0 0 0.0 327.6700 ECU_ADDRESS 0x3FC38E /end MEASUREMENT
/begin MEASUREMENT tabg_kat_t_offs_b2 "Enthalpietemperatur" SWORD FORMULA_0975 0 0 0.0 327.6700 ECU_ADDRESS 0x3FC390 /end MEASUREMENT
/begin MEASUREMENT tabg_kat_exo_max_b1 "Maximale Enthalpie" SWORD FORMULA_0975 0 0 0.0 327.6700 ECU_ADDRESS 0x3FC392 /end MEASUREMENT
/begin MEASUREMENT tabg_kat_exo_max_b2 "Maximale Enthalpie" SWORD FORMULA_0975 0 0 0.0 327.6700 ECU_ADDRESS 0x3FC394 /end MEASUREMENT
/begin MEASUREMENT tabg_kat_exo_on_b1 "Einschaltschwelle fuer Enthalpie" SWORD FORMULA_0023 0 0 -50.0000 1250.0000 ECU_ADDRESS 0x3FC396 /end MEASUREMENT
/begin MEASUREMENT tabg_kat_exo_on_b2 "Einschaltschwelle fuer Enthalpie" SWORD FORMULA_0023 0 0 -50.0000 1250.0000 ECU_ADDRESS 0x3FC398 /end MEASUREMENT
/begin MEASUREMENT tabg_diag_time_b1 "Sperrzeit fuer Plausifehler" UWORD FORMULA_0073 0 0 0.0 6553.5000 ECU_ADDRESS 0x3FC39A /end MEASUREMENT
/begin MEASUREMENT tabg_diag_time_b2 "Sperrzeit fuer Plausifehler" UWORD FORMULA_0073 0 0 0.0 6553.5000 ECU_ADDRESS 0x3FC39C /end MEASUREMENT
/* ------------------ Abschnitt erzeugt aus tan.dat ------------------ */
/begin CHARACTERISTIC K_TAN_DIAG_MIN "Unter Grenze Ansauglufttemperatur | EN: Unter Grenze Ansauglufttemperatur" VALUE 0x7954C TKW_VV_VV_SW 100.0 FORMULA_0987 -50.0000 170.0000 FORMAT "%6.3" /end CHARACTERISTIC
/begin CHARACTERISTIC K_TAN_DIAG_MAX "Obere Grenze Ansauglufttemperatur | EN: Obere Grenze Ansauglufttemperatur" VALUE 0x7954E TKW_VV_VV_SW 100.0 FORMULA_0987 -50.0000 170.0000 FORMAT "%6.3" /end CHARACTERISTIC
/begin CHARACTERISTIC K_TAN_ERSATZ "Ersatzwert fuer die Ansauglufttemperatur | EN: Ersatzwert fuer die Ansauglufttemperatur" VALUE 0x79550 TKW_VV_VV_SW 100.0 FORMULA_0987 -50.0000 170.0000 FORMAT "%6.3" /end CHARACTERISTIC
/begin CHARACTERISTIC K_TAN_MW_ABGR_NEG "neg. Aenderungsbegr. Ansauglufttemperatur pro 100ms | EN: neg. Aenderungsbegr. Ansauglufttemperatur pro 100ms" VALUE 0x79552 TKW_VV_VV_UW 100.0 FORMULA_0023 0.0 100.0000 FORMAT "%4.1" /end CHARACTERISTIC
/begin CHARACTERISTIC K_TAN_MW_ABGR_POS "pos. Aenderungsbegr. Ansauglufttemperatur pro 100ms | EN: pos. Aenderungsbegr. Ansauglufttemperatur pro 100ms" VALUE 0x79554 TKW_VV_VV_UW 100.0 FORMULA_0023 0.0 100.0000 FORMAT "%4.1" /end CHARACTERISTIC
/begin CHARACTERISTIC K_TAN_TAU "Filterkonstante fuer die Ansauglufttemperaturerfassung | EN: Filterkonstante fuer die Ansauglufttemperaturerfassung" VALUE 0x79556 TKW_VV_VV_UB 100.0 FORMULA_0679 0.1004 25.6000 /end CHARACTERISTIC
/begin CHARACTERISTIC K_TAN_OBD_N_DYN_TAU "Filterkonstante f�r Drehzahldynamik | EN: Filterkonstante fï¿½r Drehzahldynamik" VALUE 0x79557 TKW_VV_VV_UB 100.0 FORMULA_0679 0.1004 25.6000 /end CHARACTERISTIC
/begin CHARACTERISTIC K_TAN_MODELL_MR_TAU "Filterkonstante fuer Motorraumtemperatur | EN: Filterkonstante fuer Motorraumtemperatur" VALUE 0x79558 TKW_VV_VV_UW 100.0 FORMULA_0988 0.1000 6553.5000 FORMAT "%5.2" /end CHARACTERISTIC
/begin CHARACTERISTIC K_TAN_OBD_CFG "Plausibilisierung Ansauglufttemperatur | EN: Plausibilisierung Ansauglufttemperatur" VALUE 0x7955A TKW_VV_VV_UB 100.0 FORMULA_0994 0.0 255.0 /end CHARACTERISTIC
/begin CHARACTERISTIC K_TAN_MODELL_ALLOW_NO_TUMG "Fehler Umgebungstemperatur zulassen | EN: Fehler Umgebungstemperatur zulassen" VALUE 0x7955B TKW_VV_VV_UB 100.0 FORMULA_0995 0.0 255.0 /end CHARACTERISTIC
/begin CHARACTERISTIC K_TAN_OBD_ALWAYS "Bedingungen ignorieren" VALUE 0x7955C TKW_VV_VV_UB 100.0 FORMULA_0996 0.0 255.0 /end CHARACTERISTIC
/begin CHARACTERISTIC K_TAN_OBD_DELTA_MAX "Maximale Temperaturdifferenz der beiden HFM | EN: Maximale Temperaturdifferenz der beiden HFM" VALUE 0x7955E TKW_VV_VV_SW 100.0 FORMULA_0076 -1000.0000 1000.0000 FORMAT "%4.1" /end CHARACTERISTIC
/begin CHARACTERISTIC K_TAN_OBD_T_DELTA "Zeitfenster f�r Temperaturabweichung | EN: Zeitfenster fï¿½r Temperaturabweichung" VALUE 0x79560 TKW_VV_VV_UW 100.0 FORMULA_0993 0.0 6553.5000 FORMAT "%5.2" /end CHARACTERISTIC
/begin CHARACTERISTIC K_TAN_OBD_V_T_MIN "Zeitfenster f�r Mindestgeschwindigkeit | EN: Zeitfenster fï¿½r Mindestgeschwindigkeit" VALUE 0x79562 TKW_VV_VV_UW 100.0 FORMULA_0993 0.0 6553.5000 FORMAT "%5.2" /end CHARACTERISTIC
/begin CHARACTERISTIC K_TAN_OBD_DYN_DELAY "Zeitfenster f�r Delay nach Dynamik" VALUE 0x79564 TKW_VV_VV_UW 100.0 FORMULA_0993 0.0 6553.5000 FORMAT "%5.2" /end CHARACTERISTIC
/begin CHARACTERISTIC K_TAN_OBD_V_MIN "Mindestgeschwindigkeit" VALUE 0x79566 TKW_VV_VV_SW 100.0 FORMULA_0078 -80.0000 360.0000 FORMAT "%4.1" /end CHARACTERISTIC
/begin CHARACTERISTIC K_TAN_OBD_N_MIN "Mindestdrehzahl | EN: Minimum engine speed [Upm]" VALUE 0x79568 TKW_VV_VV_SW 100.0 FORMULA_0006 0.0 10000.0000 /end CHARACTERISTIC
/begin CHARACTERISTIC K_TAN_OBD_N_MAX "Mindestdrehzahl | EN: Minimum engine speed [Upm]" VALUE 0x7956A TKW_VV_VV_SW 100.0 FORMULA_0006 0.0 10000.0000 /end CHARACTERISTIC
/begin CHARACTERISTIC K_TAN_OBD_N_DYN_MAX "Maximale Drehzahldynamik | EN: Maximum engine-speed dynamics [Upm/s]" VALUE 0x7956C TKW_VV_VV_SW 100.0 FORMULA_0114 -10000.0000 10000.0000 /end CHARACTERISTIC
/begin CHARACTERISTIC K_TAN_OBD_TMOT_MIN "Untergrenze Motortemperatur | EN: Lower limit, engine temperature [°C]" VALUE 0x7956E TKW_VV_VV_SW 100.0 FORMULA_0023 -50.0000 170.0000 FORMAT "%4.1" /end CHARACTERISTIC
/begin CHARACTERISTIC K_TAN_OBD_RF_MIN "Untergrenze relative F�llung | EN: Lower limit, relative charge" VALUE 0x79570 TKW_VV_VV_SW 100.0 FORMULA_0007 0.0 2.0000 FORMAT "%6.3" /end CHARACTERISTIC
/begin CHARACTERISTIC K_TAN_OBD_RF_MAX "Obergrenze relative F�llung | EN: Upper limit, relative charge" VALUE 0x79572 TKW_VV_VV_SW 100.0 FORMULA_0007 0.0 2.0000 FORMAT "%6.3" /end CHARACTERISTIC
/begin CHARACTERISTIC K_TAN_OBD_RF_DYN_MAX "Maximale Dynamik relative F�llung | EN: Maximum dynamics of relative charge" VALUE 0x79574 TKW_VV_VV_SW 100.0 FORMULA_0007 0.0 2.0000 FORMAT "%6.3" /end CHARACTERISTIC
/begin CHARACTERISTIC KL_TAN_NTC "Kennlinie Ansauglufttemperatur | EN: Intake air temperature curve" CURVE 0x79576 TKL_SW_VV_SW 100.0 FORMULA_0987 -50.0000 170.0000 /begin AXIS_DESCR STD_AXIS tan_ad FORMULA_0123 8 0.0 1023.0000 /end AXIS_DESCR FORMAT "%6.3" /end CHARACTERISTIC
/begin CHARACTERISTIC KL_TAN_MODELL_ML_TAU "Kennlinie Ansaugluftmasse zu tau" CURVE 0x79598 TKL_SW_VV_UW 100.0 FORMULA_0988 0.1000 6553.5000
 /begin AXIS_DESCR STD_AXIS ml_b1 FORMULA_0112 6 -100.0000 1400.0000 FORMAT "%4.1" /end AXIS_DESCR
 FORMAT "%5.2" /end CHARACTERISTIC
/begin CHARACTERISTIC KL_TAN_MODELL_ML_RATIO "Kennlinie Ansaugluftmasse zu tau | EN: Curve: intake air mass to time constant" CURVE 0x795B2 TKL_SW_VV_UW 100.0 FORMULA_0295 0.0 2.0000
 /begin AXIS_DESCR STD_AXIS ml_b1 FORMULA_0112 6 -100.0000 1400.0000 FORMAT "%4.1" /end AXIS_DESCR
 FORMAT "%7.4" /end CHARACTERISTIC
/begin CHARACTERISTIC KL_TAN_MODELL_ABREG "Kennlinie Temperaturabregung/Zeit | EN: Curve: temperature ramp-down over time" CURVE 0x795CC TKL_UW_VV_UW 100.0 FORMULA_0295 0.0 2.0000
 /begin AXIS_DESCR STD_AXIS time_ms FORMULA_0986 6 0.0 1092.2500 FORMAT "%5.2" /end AXIS_DESCR
 FORMAT "%7.4" /end CHARACTERISTIC
/begin CHARACTERISTIC KL_TAN_MODELL_MR_ABREG "Kennlinie Temperaturabregung/Zeit | EN: Curve: temperature ramp-down over time" CURVE 0x795E6 TKL_UW_VV_UW 100.0 FORMULA_0295 0.0 2.0000
 /begin AXIS_DESCR STD_AXIS time_ms FORMULA_0986 6 0.0 1092.2500 FORMAT "%5.2" /end AXIS_DESCR
 FORMAT "%7.4" /end CHARACTERISTIC
/begin CHARACTERISTIC KL_TAN_MODELL_MR_TUMG_KAL "Kalibrierung Motorraumtemp mit TUMG | EN: Engine-bay temperature calibration against ambient temperature" CURVE 0x79600 TKL_SW_VV_SW 100.0 FORMULA_0076 -1000.0000 1000.0000
 /begin AXIS_DESCR STD_AXIS tumg FORMULA_0023 6 -50.0000 170.0000 FORMAT "%4.1" /end AXIS_DESCR
 FORMAT "%4.1" /end CHARACTERISTIC
/begin CHARACTERISTIC K_TAN_MIN_E2 "min. Ansauglufttemperatur" VALUE 0x7A9B0 TKW_VV_VV_SW 100.0 FORMULA_0023 -50.0000 170.0000 FORMAT "%4.1" /end CHARACTERISTIC
/begin CHARACTERISTIC K_TAN_MAX_E2 "max. Ansauglufttemperatur" VALUE 0x7A9B2 TKW_VV_VV_SW 100.0 FORMULA_0023 -50.0000 170.0000 FORMAT "%4.1" /end CHARACTERISTIC
/begin CHARACTERISTIC K_TAN_MAX_NEG_GRAD_E2 "Gradientenschwelle Ebene 2" VALUE 0x7A9B4 TKW_VV_VV_SW 100.0 FORMULA_0997 -32768.0000 0.0 /end CHARACTERISTIC
/begin CHARACTERISTIC K_TAN_MAX_POS_GRAD_E2 "Gradientenschwelle Ebene 2" VALUE 0x7A9B6 TKW_VV_VV_SW 100.0 FORMULA_0997 0.0 32767.0000 /end CHARACTERISTIC
/begin MEASUREMENT tan_ad_b1 "Eingelesener Spannungswert fuer Ansauglufttemperatur" SWORD FORMULA_0123 0 0 0.0 1023.0000 ECU_ADDRESS 0x3FC3AE /end MEASUREMENT
/begin MEASUREMENT tan_ad_b2 "Eingelesener Spannungswert fuer Ansauglufttemperatur" SWORD FORMULA_0123 0 0 0.0 1023.0000 ECU_ADDRESS 0x3FC3B0 /end MEASUREMENT
/begin MEASUREMENT tan_roh_b1 "Ungefilterter Messwert der Ansauglufttemperatur" SWORD FORMULA_0987 0 0 -50.0000 170.0000 ECU_ADDRESS 0x3FC3B2 /end MEASUREMENT
/begin MEASUREMENT tan_roh_b2 "Ungefilterter Messwert der Ansauglufttemperatur" SWORD FORMULA_0987 0 0 -50.0000 170.0000 ECU_ADDRESS 0x3FC3B4 /end MEASUREMENT
/begin MEASUREMENT tan_filter_b1 "Gefilterter Messwert der Ansauglufttemperatur" SWORD FORMULA_0987 0 0 -50.0000 170.0000 ECU_ADDRESS 0x3FC3B6 /end MEASUREMENT
/begin MEASUREMENT tan_filter_b2 "Gefilterter Messwert der Ansauglufttemperatur" SWORD FORMULA_0987 0 0 -50.0000 170.0000 ECU_ADDRESS 0x3FC3B8 /end MEASUREMENT
/begin MEASUREMENT tan_modell_mr "Temperatur Motorraum TAN-Modell" SWORD FORMULA_0023 0 0 -50.0000 170.0000 ECU_ADDRESS 0x3FC3BA /end MEASUREMENT
/begin MEASUREMENT tan_tmot_tumg_delta "Temperaturdifferenz Motorraum zu Umgebung" SWORD FORMULA_0076 0 0 -1000.0000 1000.0000 ECU_ADDRESS 0x3FC3BC /end MEASUREMENT
/begin MEASUREMENT tan_modell_raw_b1 "Temperatur Ansaugluft Modell ungefiltert" SWORD FORMULA_0023 0 0 -50.0000 170.0000 ECU_ADDRESS 0x3FC3BE /end MEASUREMENT
/begin MEASUREMENT tan_modell_raw_b2 "Temperatur Ansaugluft Modell ungefiltert" SWORD FORMULA_0023 0 0 -50.0000 170.0000 ECU_ADDRESS 0x3FC3C0 /end MEASUREMENT
/begin MEASUREMENT tan_modell_b1 "Ansauglufttemperatur Modell gefiltert" SWORD FORMULA_0023 0 0 -50.0000 170.0000 ECU_ADDRESS 0x3FC3C2 /end MEASUREMENT
/begin MEASUREMENT tan_modell_b2 "Ansauglufttemperatur Modell gefiltert" SWORD FORMULA_0023 0 0 -50.0000 170.0000 ECU_ADDRESS 0x3FC3C4 /end MEASUREMENT
/begin MEASUREMENT tan_modell_ml_tau_b1 "Temperatur tau TAN-Modell" UWORD FORMULA_0988 0 0 0.1000 6553.5000 ECU_ADDRESS 0x3FC3C6 /end MEASUREMENT
/begin MEASUREMENT tan_modell_ml_tau_b2 "Temperatur tau TAN-Modell" UWORD FORMULA_0988 0 0 0.1000 6553.5000 ECU_ADDRESS 0x3FC3C8 /end MEASUREMENT
/begin MEASUREMENT tan_modell_ml_ratio_b1 "Faktor Luftmasse f�r TAN-Modell" UWORD FORMULA_0295 0 0 0.0 2.0000 ECU_ADDRESS 0x3FC3CA /end MEASUREMENT
/begin MEASUREMENT tan_modell_ml_ratio_b2 "Faktor Luftmasse f�r TAN-Modell" UWORD FORMULA_0295 0 0 0.0 2.0000 ECU_ADDRESS 0x3FC3CC /end MEASUREMENT
/begin MEASUREMENT tan_modell_st "Status Modell Ansauglufttemperatur" UBYTE FORMULA_0989 0 0 0.0 2.0 ECU_ADDRESS 0x3FC3CE /end MEASUREMENT
/begin MEASUREMENT tan_obd_ersatz "Zuteilung Ersatzwert Ansauglufttemperatur" UBYTE FORMULA_0990 0 0 0.0 2.0 ECU_ADDRESS 0x3FC3CF /end MEASUREMENT
/begin MEASUREMENT tan_obd_st "Status Plausibilisierung Ansauglufttemperatur" UBYTE FORMULA_0003 0 0 0.0 2.0000 ECU_ADDRESS 0x3FC3D0 /end MEASUREMENT
/begin MEASUREMENT tan_obd_st_now "Status aktuelle Diagnose" UBYTE FORMULA_0991 0 0 0.0 255.0 ECU_ADDRESS 0x3FC3D0 BIT_MASK 0x11 /end MEASUREMENT
/begin MEASUREMENT tan_obd_st_last "Status letzte Diagnose" UBYTE FORMULA_0992 0 0 0.0 255.0 ECU_ADDRESS 0x3FC3D0 BIT_MASK 0x22 /end MEASUREMENT
/begin MEASUREMENT tan_obd_t_delta_yes "Zeit seit Abweichung" UWORD FORMULA_0993 0 0 0.0 6553.5000 ECU_ADDRESS 0x3FC3D2 /end MEASUREMENT
/begin MEASUREMENT tan_obd_t_delta_no "Zeit seit keine Abweichung" UWORD FORMULA_0993 0 0 0.0 6553.5000 ECU_ADDRESS 0x3FC3D4 /end MEASUREMENT
/begin MEASUREMENT tan_obd_dyn_delay "Zeit seit Dynamik�berschreitung" UWORD FORMULA_0993 0 0 0.0 6553.5000 ECU_ADDRESS 0x3FC3D6 /end MEASUREMENT
/begin MEASUREMENT tan_obd_delta "Temperaturdifferenz der beiden HFM" SWORD FORMULA_0076 0 0 -1000.0000 1000.0000 ECU_ADDRESS 0x3FC3D8 /end MEASUREMENT
/begin MEASUREMENT tan_obd_delta_modell_b1 "Temperaturdifferenz HFM zu Modell" SWORD FORMULA_0076 0 0 -1000.0000 1000.0000 ECU_ADDRESS 0x3FC3DA /end MEASUREMENT
/begin MEASUREMENT tan_obd_delta_modell_b2 "Temperaturdifferenz HFM zu Modell" SWORD FORMULA_0076 0 0 -1000.0000 1000.0000 ECU_ADDRESS 0x3FC3DC /end MEASUREMENT
/begin MEASUREMENT tan_obd_v_t_min "Zeit �ber Minimalgeschwindigkeit" UWORD FORMULA_0993 0 0 0.0 6553.5000 ECU_ADDRESS 0x3FC3DE /end MEASUREMENT
/begin MEASUREMENT tan_n_dyn "Drehzahl gefiltert im tan-Modul" SWORD FORMULA_0114 0 0 -10000.0000 10000.0000 ECU_ADDRESS 0x3FC3E0 /end MEASUREMENT
/begin MEASUREMENT tan_n_dyn_delta "Drehzahl zwischen gefiltert und ungefiltert" SWORD FORMULA_0114 0 0 -10000.0000 10000.0000 ECU_ADDRESS 0x3FC3E2 /end MEASUREMENT
/begin MEASUREMENT tan_modell_mr_kal "Motorraumtempabweichung durch TUMG" SWORD FORMULA_0076 0 0 -1000.0000 1000.0000 ECU_ADDRESS 0x3FC3E4 /end MEASUREMENT
/begin MEASUREMENT tan_modell_tmot "Motorraumtemperatur Zielwert" SWORD FORMULA_0023 0 0 -50.0000 170.0000 ECU_ADDRESS 0x3FC3E6 /end MEASUREMENT
/begin MEASUREMENT tan_start "Mittelwert der Ansauglufttemperatur beim Start" SWORD FORMULA_0023 0 0 -50.0000 170.0000 ECU_ADDRESS 0x3FC3E8 /end MEASUREMENT
/begin FUNCTION Abgastemperatur ""
 /begin DEF_CHARACTERISTIC KF_TABG_LW_STAT KL_TABG_DIAG_PLAUSI_ML_FAK KL_TABG_KAT_EXO_MAX KL_TABG_KAT_STAND_F KL_TABG_LW_F_ETA_ZW KL_TABG_LW_F_LAM KL_TABG_LW_F_RG KL_TABG_LW_STAND_F KL_TABG_LW_TAU KL_TABG_LW_VERH_WURZEL KL_TABG_PT200 KL_TABG_VKAT_F_REAK KL_TABG_VKAT_K_TMOT KL_TABG_VKAT_MC_F_TMOT KL_TABG_VKAT_STAND_F K_TABG_C K_TABG_DIAG_MAX K_TABG_DIAG_MIN K_TABG_DIAG_PLAUSI_AKTIV_T_ML K_TABG_DIAG_PLAUSI_DELTA_NEG K_TABG_DIAG_PLAUSI_DELTA_POS K_TABG_DIAG_TIME K_TABG_KAT_EXO_HYS K_TABG_KAT_EXO_MS_SCHWELLE K_TABG_KAT_EXO_ON K_TABG_KAT_MC K_TABG_KAT_OBD_GRAD_MAX K_TABG_KAT_OBD_GRAD_TAU K_TABG_KAT_T_OFFS_AB K_TABG_KAT_T_OFFS_AUF K_TABG_LW_AUSBLEND_OFFS K_TABG_NKAT_A K_TABG_NKAT_CFG K_TABG_NKAT_K_TUMG K_TABG_NKAT_K_V K_TABG_NKAT_MAX_CFG K_TABG_NKAT_MC K_TABG_PST_V K_TABG_STAND_MAX K_TABG_TAU K_TABG_VKAT_A K_TABG_VKAT_K_V K_TABG_VKAT_MC K_TABG_VKAT_REAK_SCHWELLE /end DEF_CHARACTERISTIC
 /begin REF_CHARACTERISTIC /end REF_CHARACTERISTIC
 /begin IN_MEASUREMENT /end IN_MEASUREMENT
 /begin OUT_MEASUREMENT tabg_ad_b1 tabg_ad_b2 tabg_diag_time_b1 tabg_diag_time_b2 tabg_kat_exo_max_b1 tabg_kat_exo_max_b2 tabg_kat_exo_on_b1 tabg_kat_exo_on_b2 tabg_kat_obd_grad_filter_b1 tabg_kat_obd_grad_filter_b2 tabg_kat_t_offs_b1 tabg_kat_t_offs_b2 tabg_lw_f_eta_zw_ne_b1 tabg_lw_f_eta_zw_ne_b2 tabg_lw_f_lam_b1 tabg_lw_f_lam_b2 tabg_lw_f_rg_b1 tabg_lw_f_rg_b2 tabg_lw_filter_b1 tabg_lw_filter_b2 tabg_lw_roh_b1 tabg_lw_roh_b2 tabg_lw_stat_b1 tabg_lw_stat_b2 tabg_lw_tau_b1 tabg_lw_tau_b2 tabg_ml_ges_b1 tabg_ml_ges_b2 tabg_roh_b1 tabg_roh_b2 tabg_vkat_f_reak_b1 tabg_vkat_f_reak_b2 /end OUT_MEASUREMENT
/end FUNCTION
/begin FUNCTION AdaptCommon "" /begin DEF_CHARACTERISTIC /end DEF_CHARACTERISTIC /begin REF_CHARACTERISTIC /end REF_CHARACTERISTIC /begin IN_MEASUREMENT /end IN_MEASUREMENT
 /begin OUT_MEASUREMENT ccp_retry_cnt_nv crc32_data_carb_nv crc32_prog_carb_nv ipk_sync_error_st_nv ipk_sync_errorcount_nv os_err_ff.addr_0 os_err_ff.addr_1 os_err_ff.addr_2 os_err_ff.addr_3 os_err_ff.addr_4 os_err_ff.addr_5 os_err_ff.addr_6 os_err_ff.addr_7 os_err_ff.ptr os_proz_ff.aq_soll_grad os_proz_ff.mtime os_proz_ff.mtime_pid os_proz_ff.n os_proz_ff.rf os_proz_ff.time_ml os_proz_ff.zustand_motor os_proz_irq_ff.aq_soll_grad os_proz_irq_ff.mtime os_proz_irq_ff.mtime_pid os_proz_irq_ff.n os_proz_irq_ff.rf os_proz_irq_ff.time_ml os_proz_irq_ff.zustand_motor os_proz_irq_last_nv_10of10_ os_proz_irq_last_nv_1of10_ os_proz_irq_last_nv_2of10_ os_proz_irq_last_nv_3of10_ os_proz_irq_last_nv_4of10_ os_proz_irq_last_nv_5of10_ os_proz_irq_last_nv_6of10_ os_proz_irq_last_nv_7of10_ os_proz_irq_last_nv_8of10_ os_proz_irq_last_nv_9of10_ pctrl_proz_err_nv pctrl_task_err_nv ram_chk_err_adr_nv sk_ff.crc32_result sk_ff.egas_sk_mode sk_ff.fail_st_zyl sk_ff.kupp_ist sk_ff.kupp_wunsch_ges sk_ff.md_sk_mode sk_ff.n sk_ff.os_err_addr sk_ff.os_err_cnt sk_ff.os_err_type sk_ff.proz_err sk_ff.pwg_soll sk_ff.reset_cnt sk_ff.rf_m sk_ff.smg_sk_mode sk_ff.stufe sk_ff.task_err sk_ff.ub sk_ff.ursache spim_chain_error_nv spim_error_reinit_ctr_nv spim_errorcode_reinit_nv sys_exc_addr_nv sys_exc_lr_nv sys_exc_vec_nv sys_rsr_cnt_nv.csrs sys_rsr_cnt_nv.dbhrs sys_rsr_cnt_nv.dbsrs sys_rsr_cnt_nv.ehrs sys_rsr_cnt_nv.esrs sys_rsr_cnt_nv.ghrst sys_rsr_cnt_nv.gpor sys_rsr_cnt_nv.gsrst sys_rsr_cnt_nv.ilbc sys_rsr_cnt_nv.jtrs sys_rsr_cnt_nv.llrs sys_rsr_cnt_nv.ocrs sys_rsr_cnt_nv.swrs sys_zust_cpu_last_max_nv tpu_kw_err_ff_a.cnt tpu_kw_err_ff_a.event_time tpu_kw_err_ff_a.irq tpu_kw_err_ff_a.last_period tpu_kw_err_ff_a.n tpu_kw_err_ff_a.n_zahn tpu_kw_err_ff_a.prev_period tpu_kw_err_ff_a.state tpu_kw_err_ff_a.tooth tpu_kw_err_ff_a.tooth_time tpu_kw_err_ff_b.cnt tpu_kw_err_ff_b.event_time tpu_kw_err_ff_b.irq tpu_kw_err_ff_b.last_period tpu_kw_err_ff_b.n tpu_kw_err_ff_b.n_zahn tpu_kw_err_ff_b.prev_period tpu_kw_err_ff_b.state tpu_kw_err_ff_b.tooth tpu_kw_err_ff_b.tooth_time tpu_kw_irq_info_cnt_nv_a tpu_kw_irq_info_cnt_nv_b /end OUT_MEASUREMENT
/end FUNCTION
/begin FUNCTION Adaptiondaten_glob "" /begin DEF_CHARACTERISTIC /end DEF_CHARACTERISTIC /begin REF_CHARACTERISTIC /end REF_CHARACTERISTIC /begin IN_MEASUREMENT /end IN_MEASUREMENT
 /begin OUT_MEASUREMENT can_fzgtyp_clas_pwr_nv can_fzgtyp_grb_nv can_fzgtyp_land_nv can_fzgtyp_veh_nv can_km_stand_nv ed_css_st_ign_nv ed_css_st_ign_nv_auss ed_css_st_ign_nv_dk ed_css_st_ign_nv_lls ed_css_st_ign_nv_pwg ed_css_st_ign_nv_tmot ed_fsp_inj_fehlerzaehler_nv elu_nl_nv kat_obd_wert_gesamt_nv kat_obd_wert_nv_b1 kat_obd_wert_nv_b2 kwp_fetrawe_st laa_f_ber_nv_b1 laa_f_ber_nv_b2 tmot_abstell_nv toel_wanne /end OUT_MEASUREMENT
/end FUNCTION
/begin FUNCTION Adaptionswerte "" /begin DEF_CHARACTERISTIC /end DEF_CHARACTERISTIC /begin REF_CHARACTERISTIC /end REF_CHARACTERISTIC /begin IN_MEASUREMENT /end IN_MEASUREMENT
 /begin OUT_MEASUREMENT afz_a0_nv afz_na0_cnt1_nv afz_na0_cnt2_nv afz_na0_delta_nv afz_na0_sum1_nv afz_na0_sum2_nv at_ff.ges_aktiv_cnt at_ff.ges_dauer at_ff.ges_trmp_avg at_ff.letzter_dauer at_ff.letzter_gang at_ff.letzter_km_stand at_ff.letzter_md_kupp_wunsch_ges at_ff.letzter_tgetr at_ff.letzter_trmp_avg at_ff.letzter_trmp_max at_ff.letzter_tumg at_ff.letzter_v_vorne at_ff.max_dauer at_ff.max_gang at_ff.max_km_stand at_ff.max_md_kupp_wunsch_ges at_ff.max_tgetr at_ff.max_trmp_avg at_ff.max_trmp_max at_ff.max_tumg at_ff.max_v_vorne auss_erk_10dc_nv_zyl1 auss_erk_10dc_nv_zyl10 auss_erk_10dc_nv_zyl2 auss_erk_10dc_nv_zyl3 auss_erk_10dc_nv_zyl4 auss_erk_10dc_nv_zyl5 auss_erk_10dc_nv_zyl6 auss_erk_10dc_nv_zyl7 auss_erk_10dc_nv_zyl8 auss_erk_10dc_nv_zyl9 auss_erk_1dc_nv_zyl1 auss_erk_1dc_nv_zyl10 auss_erk_1dc_nv_zyl2 auss_erk_1dc_nv_zyl3 auss_erk_1dc_nv_zyl4 auss_erk_1dc_nv_zyl5 auss_erk_1dc_nv_zyl6 auss_erk_1dc_nv_zyl7 auss_erk_1dc_nv_zyl8 auss_erk_1dc_nv_zyl9 auss_erk_ns_nv_zyl1 auss_erk_ns_nv_zyl10 auss_erk_ns_nv_zyl2 auss_erk_ns_nv_zyl3 auss_erk_ns_nv_zyl4 auss_erk_ns_nv_zyl5 auss_erk_ns_nv_zyl6 auss_erk_ns_nv_zyl7 auss_erk_ns_nv_zyl8 auss_erk_ns_nv_zyl9 auss_erk_nv_zyl1 auss_erk_nv_zyl10 auss_erk_nv_zyl2 auss_erk_nv_zyl3 auss_erk_nv_zyl4 auss_erk_nv_zyl5 auss_erk_nv_zyl6 auss_erk_nv_zyl7 auss_erk_nv_zyl8 auss_erk_nv_zyl9 auss_erk_ti_nv_zyl1 auss_erk_ti_nv_zyl10 auss_erk_ti_nv_zyl2 auss_erk_ti_nv_zyl3 auss_erk_ti_nv_zyl4 auss_erk_ti_nv_zyl5 auss_erk_ti_nv_zyl6 auss_erk_ti_nv_zyl7 auss_erk_ti_nv_zyl8 auss_erk_ti_nv_zyl9 auss_ff.auss_lp_int auss_ff.auss_lp_min auss_ff.auss_ns_time auss_ff.auss_spark_time auss_ff.egas_ist_lls auss_ff.egas_wdk_abs auss_ff.laa_f_ber_nv auss_ff.lam_ist_mw auss_ff.n auss_ff.pks_rel auss_ff.rf auss_ff.rf_aq auss_ff.rf_hfm auss_ff.st auss_ff.ti_tpu_st auss_ff.time_ml auss_ff.tmot auss_ff.tz auss_ff.ub auss_ff.van_ist_a auss_ff.van_ist_e auss_ff.van_soll_a auss_ff.van_soll_e auss_ff.vr_mess_ist auss_ff.zustand_motor auss_lp_min_sa_max_nv_zyl1 auss_lp_min_sa_max_nv_zyl10 auss_lp_min_sa_max_nv_zyl2 auss_lp_min_sa_max_nv_zyl3 auss_lp_min_sa_max_nv_zyl4 auss_lp_min_sa_max_nv_zyl5 auss_lp_min_sa_max_nv_zyl6 auss_lp_min_sa_max_nv_zyl7 auss_lp_min_sa_max_nv_zyl8 auss_lp_min_sa_max_nv_zyl9 auss_mode6_st_nv eeprom_anzahl_schreiben_nv eeprom_crc_nv eeprom_crc_wichtig_nv eeprom_date_1of9_ eeprom_date_2of9_ eeprom_date_3of9_ eeprom_date_4of9_ eeprom_date_5of9_ eeprom_date_6of9_ eeprom_date_7of9_ eeprom_date_8of9_ eeprom_date_9of9_ eeprom_datenlaenge_nv eeprom_datenlaenge_wichtig_nv eeprom_time_1of6_ eeprom_time_2of6_ eeprom_time_3of6_ eeprom_time_4of6_ eeprom_time_5of6_ eeprom_time_6of6_ eeprom_version_prog_nv egas_dk_ff_b1.abs egas_dk_ff_b1.can_st egas_dk_ff_b1.fail_st egas_dk_ff_b1.ist egas_dk_ff_b1.mode egas_dk_ff_b1.n egas_dk_ff_b1.r_adapt_st egas_dk_ff_b1.r_diag_st egas_dk_ff_b1.r_mode egas_dk_ff_b1.r_sollw egas_dk_ff_b1.rf_aq egas_dk_ff_b1.rf_hfm egas_dk_ff_b1.soll egas_dk_ff_b1.state egas_dk_ff_b1.ub egas_dk_ff_b1.wdk egas_dk_ff_b1.zust_sk egas_dk_ff_b2.abs egas_dk_ff_b2.can_st egas_dk_ff_b2.fail_st egas_dk_ff_b2.ist egas_dk_ff_b2.mode egas_dk_ff_b2.n egas_dk_ff_b2.r_adapt_st egas_dk_ff_b2.r_diag_st egas_dk_ff_b2.r_mode egas_dk_ff_b2.r_sollw egas_dk_ff_b2.rf_aq egas_dk_ff_b2.rf_hfm egas_dk_ff_b2.soll egas_dk_ff_b2.state egas_dk_ff_b2.ub egas_dk_ff_b2.wdk egas_dk_ff_b2.zust_sk egas_lls_ff_b1.can_st egas_lls_ff_b1.fail_st egas_lls_ff_b1.ist egas_lls_ff_b1.mode egas_lls_ff_b1.n egas_lls_ff_b1.r_adapt_st egas_lls_ff_b1.r_diag_st egas_lls_ff_b1.r_mode egas_lls_ff_b1.r_sollw egas_lls_ff_b1.rf egas_lls_ff_b1.soll egas_lls_ff_b1.state egas_lls_ff_b1.ub egas_lls_ff_b1.zust_sk egas_lls_ff_b2.can_st egas_lls_ff_b2.fail_st egas_lls_ff_b2.ist egas_lls_ff_b2.mode egas_lls_ff_b2.n egas_lls_ff_b2.r_adapt_st egas_lls_ff_b2.r_diag_st egas_lls_ff_b2.r_mode egas_lls_ff_b2.r_sollw egas_lls_ff_b2.rf egas_lls_ff_b2.soll egas_lls_ff_b2.state egas_lls_ff_b2.ub egas_lls_ff_b2.zust_sk egas_wdk_a0_b1 egas_wdk_a0_b2 fpga_lade_errors_nv fr_adapt_1of8_1of2_ fr_adapt_1of8_2of2_ fr_adapt_2of8_1of2_ fr_adapt_2of8_2of2_ fr_adapt_3of8_1of2_ fr_adapt_3of8_2of2_ fr_adapt_4of8_1of2_ fr_adapt_4of8_2of2_ fr_adapt_5of8_1of2_ fr_adapt_5of8_2of2_ fr_adapt_6of8_1of2_ fr_adapt_6of8_2of2_ fr_adapt_7of8_1of2_ fr_adapt_7of8_2of2_ fr_adapt_8of8_1of2_ fr_adapt_8of8_2of2_ fra_aq_adapt_roh_b1 fra_aq_adapt_roh_b2 gang_i_ha_nv hdw_1_nv hdw_2_nv hdw_3_nv ka_dtz_diag_cnt_nv_b1 ka_dtz_diag_cnt_nv_b2 ka_tz_diag_cnt_nv_b1 ka_tz_diag_cnt_nv_b2 ka_tz_nv_zyl1 ka_tz_nv_zyl10 ka_tz_nv_zyl2 ka_tz_nv_zyl3 ka_tz_nv_zyl4 ka_tz_nv_zyl5 ka_tz_nv_zyl6 ka_tz_nv_zyl7 ka_tz_nv_zyl8 ka_tz_nv_zyl9 kr_dtz_diag_cnt_nv_b1 kr_dtz_diag_cnt_nv_b2 llr_ad_md_ac llr_ad_md_norm lu_adap_cnt lu_adap_segm1 lu_adap_segm10 lu_adap_segm2 lu_adap_segm3 lu_adap_segm4 lu_adap_segm5 lu_adap_segm6 lu_adap_segm7 lu_adap_segm8 lu_adap_segm9 lu_no_active_cnt lu_no_cnt md_ff.aq_abs_m md_ff.eta_min md_ff.eta_ne md_ff.ind_wunsch_ml md_ff.ind_wunsch_tz md_ff.kupp_ist md_ff.kupp_min_filter md_ff.kupp_wunsch_ges md_ff.kupp_wunsch_ml md_ff.kupp_wunsch_tz md_ff.ml_st md_ff.n md_ff.pwg_soll md_ff.rf_m md_ff.rf_soll md_ff.s_bls md_ff.sk_fehler md_ff.ti_tpu_st md_ff.tz_st md_ff_e2.eta_zw_ne md_ff_e2.eta_zw_ne_e2 md_ff_e2.fw_rel md_ff_e2.fw_rel_diff md_ff_e2.ind_opt md_ff_e2.ind_opt_diff md_ff_e2.kupp_ist md_ff_e2.kupp_max md_ff_e2.kupp_max_diff md_ff_e2.kupp_min md_ff_e2.kupp_min_diff md_ff_e2.kupp_soll md_ff_e2.kupp_wunsch md_ff_e2.n md_ff_e2.rf_m md_ff_e2.rf_pt_korr md_ff_e2.schlepp md_ff_e2.schlepp_diff md_ff_e2.ti_tpu_st md_ff_e2.toel md_off_1of3_.aq_abs_b1 md_off_1of3_.aq_abs_b2 md_off_1of3_.gang md_off_1of3_.ind_schlepp md_off_1of3_.ind_wunsch_ml_komp md_off_1of3_.kupp_ist md_off_1of3_.kupp_min_filter md_off_1of3_.kupp_wunsch md_off_1of3_.kupp_wunsch_ges md_off_1of3_.kupp_wunsch_ml md_off_1of3_.kupp_wunsch_tz md_off_1of3_.lam_ist_b1 md_off_1of3_.lam_ist_b2 md_off_1of3_.ml_st md_off_1of3_.n md_off_1of3_.pks_rel md_off_1of3_.pos_kupp_ist md_off_1of3_.pwg_soll md_off_1of3_.rf_m md_off_1of3_.rf_soll md_off_1of3_.s_bls md_off_1of3_.smg_st md_off_1of3_.te_tv md_off_1of3_.ti_mks_soll1 md_off_1of3_.ti_out1 md_off_1of3_.ti_tpu_st md_off_1of3_.time_ml md_off_1of3_.tz1 md_off_1of3_.tz_st md_off_1of3_.zust_motor md_off_2of3_.aq_abs_b1 md_off_2of3_.aq_abs_b2 md_off_2of3_.gang md_off_2of3_.ind_schlepp md_off_2of3_.ind_wunsch_ml_komp md_off_2of3_.kupp_ist md_off_2of3_.kupp_min_filter md_off_2of3_.kupp_wunsch md_off_2of3_.kupp_wunsch_ges md_off_2of3_.kupp_wunsch_ml md_off_2of3_.kupp_wunsch_tz md_off_2of3_.lam_ist_b1 md_off_2of3_.lam_ist_b2 md_off_2of3_.ml_st md_off_2of3_.n md_off_2of3_.pks_rel md_off_2of3_.pos_kupp_ist md_off_2of3_.pwg_soll md_off_2of3_.rf_m md_off_2of3_.rf_soll md_off_2of3_.s_bls md_off_2of3_.smg_st md_off_2of3_.te_tv md_off_2of3_.ti_mks_soll1 md_off_2of3_.ti_out1 md_off_2of3_.ti_tpu_st md_off_2of3_.time_ml md_off_2of3_.tz1 md_off_2of3_.tz_st md_off_2of3_.zust_motor md_off_3of3_.aq_abs_b1 md_off_3of3_.aq_abs_b2 md_off_3of3_.gang md_off_3of3_.ind_schlepp md_off_3of3_.ind_wunsch_ml_komp md_off_3of3_.kupp_ist md_off_3of3_.kupp_min_filter md_off_3of3_.kupp_wunsch md_off_3of3_.kupp_wunsch_ges md_off_3of3_.kupp_wunsch_ml md_off_3of3_.kupp_wunsch_tz md_off_3of3_.lam_ist_b1 md_off_3of3_.lam_ist_b2 md_off_3of3_.ml_st md_off_3of3_.n md_off_3of3_.pks_rel md_off_3of3_.pos_kupp_ist md_off_3of3_.pwg_soll md_off_3of3_.rf_m md_off_3of3_.rf_soll md_off_3of3_.s_bls md_off_3of3_.smg_st md_off_3of3_.te_tv md_off_3of3_.ti_mks_soll1 md_off_3of3_.ti_out1 md_off_3of3_.ti_tpu_st md_off_3of3_.time_ml md_off_3of3_.tz1 md_off_3of3_.tz_st md_off_3of3_.zust_motor md_off_st md_sk_timer_0_nv md_sk_timer_1_nv md_sk_vergl_diff_nv pwg1_a0_nv pwg2_a0_nv pwg_bls_ff.anzahl_nv pwg_bls_ff.can_ax pwg_bls_ff.can_ay pwg_bls_ff.can_brp_nv pwg_bls_ff.can_km_stand_nv pwg_bls_ff.can_lrw pwg_bls_ff.md_fw_fgr pwg_bls_ff.mvac_p_nv pwg_bls_ff.n_nv pwg_bls_ff.pwg_filter_nv pwg_bls_ff.rf_m_nv pwg_bls_ff.sk_md_begr_nv pwg_bls_ff.v_vorne_nv pwg_max_diff_adapt_nv schalter_bls_counter_nv smg_adapt_ihar_nv smg_can_obd_st_nv smg_ff.abbruch_ges smg_ff.counter smg_ff.dme_st smg_ff.getr_st smg_ff.istgang smg_ff.km_stand smg_ff.kupp_st smg_ff.md_fahrer smg_ff.md_ist smg_ff.md_soll smg_ff.mk_ist smg_ff.mk_soll smg_ff.modul smg_ff.n smg_ff.n_berech smg_ff.n_getr_ein smg_ff.n_getr_ziel smg_ff.pos_kupp_ist smg_ff.pwg_soll smg_ff.s_krafts smg_ff.sk_flags smg_ff.sk_flags_nv smg_ff.sk_mode smg_ff.toel smg_ff.v_hinten smg_ff.v_vorne smg_ff.zielgang tabg_lw_stand_nv_b1 tabg_lw_stand_nv_b2 tabg_nkat_max_nv_b1 tabg_nkat_max_nv_b2 tabg_nkat_stand_nv_b1 tabg_nkat_stand_nv_b2 tabg_vkat_stand_nv_b1 tabg_vkat_stand_nv_b2 tan_modell_mr_off tan_modell_off_b1 tan_modell_off_b2 tdme_max_nv tdme_min_nv tdme_time_zaehler_nv tdme_zyklen_nv time_rel_diag_nl_2_nv time_rel_diag_nl_nv time_rel_zero_cnt_nv toel_abstell_nv toel_modell_abstell_nv zoelp_ans_cnt_nv /end OUT_MEASUREMENT
/end FUNCTION
/begin FUNCTION Ansauglufttemperatur ""
 /begin DEF_CHARACTERISTIC KL_TAN_MODELL_ABREG KL_TAN_MODELL_ML_RATIO KL_TAN_MODELL_ML_TAU KL_TAN_MODELL_MR_ABREG KL_TAN_MODELL_MR_TUMG_KAL KL_TAN_NTC K_TAN_DIAG_MAX K_TAN_DIAG_MIN K_TAN_ERSATZ K_TAN_MAX_E2 K_TAN_MAX_NEG_GRAD_E2 K_TAN_MAX_POS_GRAD_E2 K_TAN_MIN_E2 K_TAN_MODELL_ALLOW_NO_TUMG K_TAN_MODELL_MR_TAU K_TAN_MW_ABGR_NEG K_TAN_MW_ABGR_POS K_TAN_OBD_ALWAYS K_TAN_OBD_CFG K_TAN_OBD_DELTA_MAX K_TAN_OBD_DYN_DELAY K_TAN_OBD_N_DYN_MAX K_TAN_OBD_N_DYN_TAU K_TAN_OBD_N_MAX K_TAN_OBD_N_MIN K_TAN_OBD_RF_DYN_MAX K_TAN_OBD_RF_MAX K_TAN_OBD_RF_MIN K_TAN_OBD_TMOT_MIN K_TAN_OBD_T_DELTA K_TAN_OBD_V_MIN K_TAN_OBD_V_T_MIN K_TAN_TAU /end DEF_CHARACTERISTIC
 /begin REF_CHARACTERISTIC /end REF_CHARACTERISTIC
 /begin IN_MEASUREMENT /end IN_MEASUREMENT
 /begin OUT_MEASUREMENT tan_ad_b1 tan_ad_b2 tan_filter_b1 tan_filter_b2 tan_modell_b1 tan_modell_b2 tan_modell_ml_ratio_b1 tan_modell_ml_ratio_b2 tan_modell_ml_tau_b1 tan_modell_ml_tau_b2 tan_modell_mr tan_modell_mr_kal tan_modell_raw_b1 tan_modell_raw_b2 tan_modell_st tan_modell_tmot tan_n_dyn tan_n_dyn_delta tan_obd_delta tan_obd_delta_modell_b1 tan_obd_delta_modell_b2 tan_obd_dyn_delay tan_obd_ersatz tan_obd_st tan_obd_st_last tan_obd_st_now tan_obd_t_delta_no tan_obd_t_delta_yes tan_obd_v_t_min tan_roh_b1 tan_roh_b2 tan_start tan_tmot_tumg_delta /end OUT_MEASUREMENT
/end FUNCTION
/begin RECORD_LAYOUT TKW_VV_VV_UB FNC_VALUES 1 UBYTE COLUMN_DIR DIRECT /end RECORD_LAYOUT
/begin RECORD_LAYOUT TKW_VV_VV_UW FNC_VALUES 1 UWORD COLUMN_DIR DIRECT /end RECORD_LAYOUT
/begin RECORD_LAYOUT TKW_VV_VV_SW FNC_VALUES 1 SWORD COLUMN_DIR DIRECT /end RECORD_LAYOUT
/begin RECORD_LAYOUT TKL_UW_VV_UW NO_AXIS_PTS_X 1 UBYTE RESERVED 2 BYTE AXIS_PTS_X 3 UWORD INDEX_INCR DIRECT FNC_VALUES 4 UWORD COLUMN_DIR DIRECT /end RECORD_LAYOUT
/begin RECORD_LAYOUT TKL_UW_VV_SW NO_AXIS_PTS_X 1 UBYTE RESERVED 2 BYTE AXIS_PTS_X 3 UWORD INDEX_INCR DIRECT FNC_VALUES 4 SWORD COLUMN_DIR DIRECT /end RECORD_LAYOUT
/begin RECORD_LAYOUT TKL_SW_VV_UB NO_AXIS_PTS_X 1 UBYTE RESERVED 2 BYTE AXIS_PTS_X 3 SWORD INDEX_INCR DIRECT FNC_VALUES 4 UBYTE COLUMN_DIR DIRECT /end RECORD_LAYOUT
/begin RECORD_LAYOUT TKL_SW_VV_UW NO_AXIS_PTS_X 1 UBYTE RESERVED 2 BYTE AXIS_PTS_X 3 SWORD INDEX_INCR DIRECT FNC_VALUES 4 UWORD COLUMN_DIR DIRECT /end RECORD_LAYOUT
/begin RECORD_LAYOUT TKL_SW_VV_SW NO_AXIS_PTS_X 1 UBYTE RESERVED 2 BYTE AXIS_PTS_X 3 SWORD INDEX_INCR DIRECT FNC_VALUES 4 SWORD COLUMN_DIR DIRECT /end RECORD_LAYOUT
/begin RECORD_LAYOUT TKF_SW_SW_SW NO_AXIS_PTS_X 1 UBYTE NO_AXIS_PTS_Y 2 UBYTE AXIS_PTS_X 3 SWORD INDEX_INCR DIRECT AXIS_PTS_Y 4 SWORD INDEX_INCR DIRECT FNC_VALUES 5 SWORD COLUMN_DIR DIRECT /end RECORD_LAYOUT
/end MODULE
/end PROJECT
