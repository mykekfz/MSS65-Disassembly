/begin PROJECT MSS65-ign-V452 "MSS65 IGN - V452.01-B204.00, data set 0569Q60Z160E"
/begin HEADER "" VERSION "V452.01-B204.00" /end HEADER
/begin MODULE _MSS65-ign "MSS65 IGN - V452.01-B204.00, calibration xxxxxxxx"
/begin MOD_COMMON "" BYTE_ORDER MSB_FIRST /* Default byteorder (Motorola) */ /end MOD_COMMON
/* ------------------ Abschnitt erzeugt aus adapt_common.dat ------------------ */
/begin COMPU_METHOD FORMULA_0000 "FORMULA_0000" RAT_FUNC "%7.0" "-" COEFFS 0 1 0 0 0 1 /end COMPU_METHOD
/begin COMPU_METHOD FORMULA_0001 "FORMULA_0001" RAT_FUNC "%6.1" "%" COEFFS 0 10 0 0 0 1 /end COMPU_METHOD
/begin COMPU_METHOD FORMULA_0003 "FORMULA_0003" RAT_FUNC "%3.0" "-" COEFFS 0 1 0 0 0 1 /end COMPU_METHOD
/begin COMPU_METHOD FORMULA_0006 "FORMULA_0006" RAT_FUNC "%5.0" "Upm" COEFFS 0 1 0 0 0 1 /end COMPU_METHOD
/begin COMPU_METHOD FORMULA_0007 "FORMULA_0007" RAT_FUNC "%8.3" "-" COEFFS 0 10000 0 0 0 1 /end COMPU_METHOD
/begin COMPU_METHOD FORMULA_0008 "FORMULA_0008" RAT_FUNC "%6.1" "V" COEFFS 0 10 0 0 0 1 /end COMPU_METHOD
/begin COMPU_METHOD FORMULA_0009 "FORMULA_0009" RAT_FUNC "%6.1" "Nm" COEFFS 0 10 0 0 0 1 /end COMPU_METHOD
/begin COMPU_METHOD FORMULA_0010 "FORMULA_0010" RAT_FUNC "%5.0" "-" COEFFS 0 1 0 0 0 1 /end COMPU_METHOD
/begin COMPU_METHOD FORMULA_0021 "FORMULA_0021" RAT_FUNC "%7.2" "s" COEFFS 0 100 0 0 0 1 /end COMPU_METHOD
/begin COMPU_METHOD FORMULA_0022 "FORMULA_0022" RAT_FUNC "%7.2" "%" COEFFS 0 100 0 0 0 1 /end COMPU_METHOD
/* ------------------ Abschnitt erzeugt aus adapt_glob.dat ------------------ */
/begin COMPU_METHOD FORMULA_0023 "FORMULA_0023" RAT_FUNC "%6.1" "�C" COEFFS 0 10 2732 0 0 1 /end COMPU_METHOD
/begin COMPU_METHOD FORMULA_0024 "FORMULA_0024" RAT_FUNC "%9.4" "-" COEFFS 0 32768 0 0 0 1 /end COMPU_METHOD
/begin COMPU_METHOD FORMULA_0033 "FORMULA_0033" RAT_FUNC "%5.2" "-" COEFFS 0 1 0 0 0 1 /end COMPU_METHOD
/begin COMPU_METHOD FORMULA_0075 "FORMULA_0075" RAT_FUNC "%8.3" "-" COEFFS 0 1024 0 0 0 1 /end COMPU_METHOD
/begin COMPU_METHOD FORMULA_0076 "FORMULA_0076" RAT_FUNC "%6.1" "Kelvin" COEFFS 0 10 0 0 0 1 /end COMPU_METHOD
/begin COMPU_METHOD FORMULA_0078 "FORMULA_0078" RAT_FUNC "%6.1" "km/h" COEFFS 0 16 0 0 0 1 /end COMPU_METHOD
/begin COMPU_METHOD FORMULA_0112 "FORMULA_0112" RAT_FUNC "%6.1" "kg/h" COEFFS 0 10 0 0 0 1 /end COMPU_METHOD
/begin COMPU_METHOD FORMULA_0114 "FORMULA_0114" RAT_FUNC "%5.0" "Upm/s" COEFFS 0 1 0 0 0 1 /end COMPU_METHOD
/begin COMPU_METHOD FORMULA_0115 "FORMULA_0115" RAT_FUNC "%7.2" "%" COEFFS 0 16384 0 0 0 100 /end COMPU_METHOD
/begin COMPU_METHOD FORMULA_0117 "FORMULA_0117" RAT_FUNC "%7.2" "s" COEFFS 0 200 0 0 0 1 /end COMPU_METHOD
/begin COMPU_METHOD FORMULA_0132 "FORMULA_0132" RAT_FUNC "%7.2" "m/(s*s)" COEFFS 0 40 0 0 0 1 /end COMPU_METHOD
/begin COMPU_METHOD FORMULA_0147 "FORMULA_0147" RAT_FUNC "%6.1" "qmm" COEFFS 0 10 0 0 0 1 /end COMPU_METHOD
/begin COMPU_METHOD FORMULA_0232 "FORMULA_0232" RAT_FUNC "%3.0" "s" COEFFS 0 1 0 0 0 1 /end COMPU_METHOD
/begin COMPU_METHOD FORMULA_0295 "FORMULA_0295" RAT_FUNC "%9.4" "-" COEFFS 0 16384 0 0 0 1 /end COMPU_METHOD
/begin COMPU_METHOD FORMULA_0317 "FORMULA_0317" RAT_FUNC "%5.2" "s" COEFFS 0 100 0 0 0 1 /end COMPU_METHOD
/begin COMPU_METHOD FORMULA_0318 "FORMULA_0318" RAT_FUNC "%3.0" ".Gang" COEFFS 0 1 0 0 0 1 /end COMPU_METHOD
/begin COMPU_METHOD FORMULA_0326 "FORMULA_0326" TAB_VERB "%3.0" "-" COMPU_TAB_REF FORMULA_0326_VTAB /end COMPU_METHOD
/begin COMPU_VTAB FORMULA_0326_VTAB "FORMULA_0326_VTAB" TAB_VERB 3 0 "aus" 1 "inaktiv" 2 "aktiv" /end COMPU_VTAB
/begin COMPU_METHOD FORMULA_0327 "FORMULA_0327" TAB_VERB "%3.0" "-" COMPU_TAB_REF FORMULA_0327_VTAB /end COMPU_METHOD
/begin COMPU_VTAB FORMULA_0327_VTAB "FORMULA_0327_VTAB" TAB_VERB 2 0 "aus" 1 "ein" /end COMPU_VTAB
/begin COMPU_METHOD FORMULA_0329 "FORMULA_0329" RAT_FUNC "%6.1" "km/h" COEFFS 0 10 0 0 0 1 /end COMPU_METHOD
/* ------------------ Abschnitt erzeugt aus sc_glob.dat ------------------ */
/begin COMPU_METHOD FORMULA_0358 "FORMULA_0358" RAT_FUNC "%9.2" "ms" COEFFS 0 1000 0 0 0 1 /end COMPU_METHOD
/begin COMPU_METHOD FORMULA_0359 "FORMULA_0359" TAB_VERB "%5.2" "-" COMPU_TAB_REF FORMULA_0359_VTAB /end COMPU_METHOD
/begin COMPU_VTAB FORMULA_0359_VTAB "FORMULA_0359_VTAB" TAB_VERB 2 0 "WorkPage" 16 "RefPage" DEFAULT_VALUE "Err/RefP" /end COMPU_VTAB
/begin COMPU_METHOD FORMULA_0360 "FORMULA_0360" TAB_VERB "%5.2" "-" COMPU_TAB_REF FORMULA_0360_VTAB /end COMPU_METHOD
/begin COMPU_VTAB FORMULA_0360_VTAB "FORMULA_0360_VTAB" TAB_VERB 4 0 "idle" 1 "to WorkPage" 2 "to RefPage" 4 "ready" /end COMPU_VTAB
/begin COMPU_METHOD FORMULA_0361 "FORMULA_0361" TAB_VERB "%5.2" "-" COMPU_TAB_REF FORMULA_0361_VTAB /end COMPU_METHOD
/begin COMPU_VTAB FORMULA_0361_VTAB "FORMULA_0361_VTAB" TAB_VERB 3 0 "idle" 1 "loop" 2 "ready" /end COMPU_VTAB
/begin COMPU_METHOD FORMULA_0422 "FORMULA_0422" RAT_FUNC "%7.2" "qmm" COEFFS 0 100 0 0 0 1 /end COMPU_METHOD
/begin COMPU_METHOD FORMULA_0450 "FORMULA_0450" RAT_FUNC "%8.3" "%" COEFFS 0 640 0 0 0 1 /end COMPU_METHOD
/begin COMPU_METHOD FORMULA_0460 "FORMULA_0460" RAT_FUNC "%8.1" "m" COEFFS 0 1600 0 0 0 1 /end COMPU_METHOD
/begin COMPU_METHOD FORMULA_0462 "FORMULA_0462" RAT_FUNC "%5.2" "s" COEFFS 0 0 2.56 0 1 0 /end COMPU_METHOD
/begin COMPU_METHOD FORMULA_0463 "FORMULA_0463" RAT_FUNC "%6.1" "%" COEFFS 0 100 0 0 0 1 /end COMPU_METHOD
/begin COMPU_METHOD FORMULA_0486 "FORMULA_0486" RAT_FUNC "%5.0" ".Gang" COEFFS 0 1 0 0 0 1 /end COMPU_METHOD
/begin COMPU_METHOD FORMULA_0497 "FORMULA_0497" RAT_FUNC "%7.2" "-" COEFFS 0 100 0 0 0 1 /end COMPU_METHOD
/begin COMPU_METHOD FORMULA_0501 "FORMULA_0501" RAT_FUNC "%4.1" "s" COEFFS 0 10 0 0 0 1 /end COMPU_METHOD
/begin COMPU_METHOD FORMULA_0502 "FORMULA_0502" RAT_FUNC "%5.2" "-" COEFFS 0 255 0 0 0 1 /end COMPU_METHOD
/* ------------------ Abschnitt erzeugt aus fgr.dat ------------------ */
/begin COMPU_METHOD FORMULA_0635 "FORMULA_0635" TAB_VERB "%4.1" "-" COMPU_TAB_REF FORMULA_0635_VTAB /end COMPU_METHOD
/begin COMPU_VTAB FORMULA_0635_VTAB "FORMULA_0635_VTAB" TAB_VERB 2 0 "nein" 1 "ja" /end COMPU_VTAB
/begin COMPU_METHOD FORMULA_0636 "FORMULA_0636" RAT_FUNC "%6.1" "%" COEFFS 0 640 0 0 0 1 /end COMPU_METHOD
/begin COMPU_METHOD FORMULA_0637 "FORMULA_0637" TAB_VERB "%4.1" "-" COMPU_TAB_REF FORMULA_0637_VTAB /end COMPU_METHOD
/begin COMPU_VTAB FORMULA_0637_VTAB "FORMULA_0637_VTAB" TAB_VERB 19 0 "Kein Abwurf" 1 "Reglerabweichung zu gross" 2 "Ueberholen zu lang" 3 "Geschw. zu gross" 4 "DSC-Eingriff" 5 "Geschw. zu gering" 6 "Hochlaufsperre" 7 "Nmax Begrenzer" 8 "Vmax Begrenzer" 9 "Beschl. zu gross" 10 "SMG Abwurf" 11 "VAHA Plausi" 12 "Rennstart" 13 "SK Manager" 14 "FGR Fehler E2" 15 "BLS PWG Fehler" 16 "Kupplungs Fehler" 17 "CAN Fehler" 18 "Tuner Plausi" DEFAULT_VALUE "undefiniert" /end COMPU_VTAB
/begin COMPU_METHOD FORMULA_0638 "FORMULA_0638" TAB_VERB "%4.1" "-" COMPU_TAB_REF FORMULA_0638_VTAB /end COMPU_METHOD
/begin COMPU_VTAB FORMULA_0638_VTAB "FORMULA_0638_VTAB" TAB_VERB 2 0 "DSC inaktiv" 1 "DSC regelt" /end COMPU_VTAB
/begin COMPU_METHOD FORMULA_0639 "FORMULA_0639" TAB_VERB "%4.1" "-" COMPU_TAB_REF FORMULA_0639_VTAB /end COMPU_METHOD
/begin COMPU_VTAB FORMULA_0639_VTAB "FORMULA_0639_VTAB" TAB_VERB 2 0 "DSC inaktiv" 1 "DSC Eingriff" /end COMPU_VTAB
/begin COMPU_METHOD FORMULA_0640 "FORMULA_0640" TAB_VERB "%4.1" "-" COMPU_TAB_REF FORMULA_0640_VTAB /end COMPU_METHOD
/begin COMPU_VTAB FORMULA_0640_VTAB "FORMULA_0640_VTAB" TAB_VERB 2 0 "DSC inaktiv" 1 "DSC Reg./Eingriff" /end COMPU_VTAB
/begin COMPU_METHOD FORMULA_0641 "FORMULA_0641" TAB_VERB "%4.1" "-" COMPU_TAB_REF FORMULA_0641_VTAB /end COMPU_METHOD
/begin COMPU_VTAB FORMULA_0641_VTAB "FORMULA_0641_VTAB" TAB_VERB 2 0 "DSC inaktiv" 1 "DSC ABS/ASC/MSR" /end COMPU_VTAB
/begin COMPU_METHOD FORMULA_0642 "FORMULA_0642" TAB_VERB "%3.0" "-" COMPU_TAB_REF FORMULA_0642_VTAB /end COMPU_METHOD
/begin COMPU_VTAB FORMULA_0642_VTAB "FORMULA_0642_VTAB" TAB_VERB 8 0 "Keine Aktion" 1 "Tippen vorn" 2 "Ueberdruecken vorn" 4 "Tippen hinten" 8 "Ueberdruecken hinten" 16 "Tippen oben/unten" 64 "Tippen axial" 127 "ungueltig" DEFAULT_VALUE "undef" /end COMPU_VTAB
/begin COMPU_METHOD FORMULA_0643 "FORMULA_0643" TAB_VERB "%3.0" "-" COMPU_TAB_REF FORMULA_0643_VTAB /end COMPU_METHOD
/begin COMPU_VTAB FORMULA_0643_VTAB "FORMULA_0643_VTAB" TAB_VERB 10 0 "hart aus" 1 "weich aus" 2 "tip plus" 3 "tip minus" 4 "set beschl" 5 "wieder aufnehmen" 6 "set verzoegern" 7 "keine Aktion" 8 "Marke hoch" 9 "Marke runter" DEFAULT_VALUE "undef" /end COMPU_VTAB
/begin COMPU_METHOD FORMULA_0644 "FORMULA_0644" TAB_VERB "%3.0" "-" COMPU_TAB_REF FORMULA_0644_VTAB /end COMPU_METHOD
/begin COMPU_VTAB FORMULA_0644_VTAB "FORMULA_0644_VTAB" TAB_VERB 4 0 "keine Abschaltung" 1 "weiche Abschaltung rev." 2 "harte Abschaltung rev." 3 "harte Abschaltung irrev." DEFAULT_VALUE "undef" /end COMPU_VTAB
/begin COMPU_METHOD FORMULA_0645 "FORMULA_0645" TAB_VERB "%3.0" "-" COMPU_TAB_REF FORMULA_0645_VTAB /end COMPU_METHOD
/begin COMPU_VTAB FORMULA_0645_VTAB "FORMULA_0645_VTAB" TAB_VERB 6 0 "keine Abschaltung" 1 "Fahrereingabe" 2 "Regelabweichung zu gross" 3 "Ueberholfunktion" 4 "Geschwindigkeit zu gross" 5 "DSC-Eingriff" DEFAULT_VALUE "undef" /end COMPU_VTAB
/begin COMPU_METHOD FORMULA_0646 "FORMULA_0646" TAB_VERB "%3.0" "-" COMPU_TAB_REF FORMULA_0646_VTAB /end COMPU_METHOD
/begin COMPU_VTAB FORMULA_0646_VTAB "FORMULA_0646_VTAB" TAB_VERB 14 0 "keine Abschaltung" 1 "Fahrereingabe" 2 "Bremse" 3 "Kupplung HS" 4 "Neutralgang SMG" 5 "Geschw. zu gering" 6 "Motorzustand" 7 "Hochlaufsperre HS" 8 "Drehzahlbegrenzer" 9 "Geschw. Begrenzer" 10 "Beschl. zu gross" 11 "Abschaltung SMG" 12 "VAHA-Plausi" 13 "Rennstart" /end COMPU_VTAB
/begin COMPU_METHOD FORMULA_0647 "FORMULA_0647" TAB_VERB "%3.0" "-" COMPU_TAB_REF FORMULA_0647_VTAB /end COMPU_METHOD
/begin COMPU_VTAB FORMULA_0647_VTAB "FORMULA_0647_VTAB" TAB_VERB 8 0 "keine Abschaltung" 1 "SK Manager" 2 "FGR Fehler Ebene 2" 3 "BLS PWG Plausi" 4 "Fehler Kupplung" 5 "CAN-Fehler" 6 "Tuner Plausi" 7 "KL15 aus" /end COMPU_VTAB
/begin COMPU_METHOD FORMULA_0648 "FORMULA_0648" TAB_VERB "%3.0" "-" COMPU_TAB_REF FORMULA_0648_VTAB /end COMPU_METHOD
/begin COMPU_VTAB FORMULA_0648_VTAB "FORMULA_0648_VTAB" TAB_VERB 3 0 "keine Aktion" 1 "Stufe hoch" 2 "Stufe runter" /end COMPU_VTAB
/begin COMPU_METHOD FORMULA_0649 "FORMULA_0649" TAB_VERB "%3.0" "-" COMPU_TAB_REF FORMULA_0649_VTAB /end COMPU_METHOD
/begin COMPU_VTAB FORMULA_0649_VTAB "FORMULA_0649_VTAB" TAB_VERB 2 0 "beibehalten" 1 "ausschalten" /end COMPU_VTAB
/begin COMPU_METHOD FORMULA_0650 "FORMULA_0650" TAB_VERB "%3.0" "-" COMPU_TAB_REF FORMULA_0650_VTAB /end COMPU_METHOD
/begin COMPU_VTAB FORMULA_0650_VTAB "FORMULA_0650_VTAB" TAB_VERB 3 0 "aus" 1 "ein" 2 "verweigert" /end COMPU_VTAB
/begin COMPU_METHOD FORMULA_0651 "FORMULA_0651" TAB_VERB "%3.0" "-" COMPU_TAB_REF FORMULA_0651_VTAB /end COMPU_METHOD
/begin COMPU_VTAB FORMULA_0651_VTAB "FORMULA_0651_VTAB" TAB_VERB 2 0 "kein" 1 "erkannt" /end COMPU_VTAB
/begin COMPU_METHOD FORMULA_0652 "FORMULA_0652" RAT_FUNC "%9.2" "km/h" COEFFS 0 16384 0 0 0 1 /end COMPU_METHOD
/begin COMPU_METHOD FORMULA_0653 "FORMULA_0653" RAT_FUNC "%9.4" "kmh/10mS" COEFFS 0 16384 0 0 0 1 /end COMPU_METHOD
/begin COMPU_METHOD FORMULA_0654 "FORMULA_0654" RAT_FUNC "%6.3" "-" COEFFS 0 255 0 0 0 1 /end COMPU_METHOD
/begin COMPU_METHOD FORMULA_0655 "FORMULA_0655" RAT_FUNC "%6.3" "-" COEFFS 0 128 0 0 0 1 /end COMPU_METHOD
/begin COMPU_METHOD FORMULA_0656 "FORMULA_0656" RAT_FUNC "%8.3" "-" COEFFS 0 100 0 0 0 1 /end COMPU_METHOD
/begin COMPU_METHOD FORMULA_0657 "FORMULA_0657" RAT_FUNC "%6.1" "n" COEFFS 0 1 0 0 0 1 /end COMPU_METHOD
/begin COMPU_METHOD FORMULA_0658 "FORMULA_0658" RAT_FUNC "%9.4" "-" COEFFS 0 262144 0 0 0 1 /end COMPU_METHOD
/begin COMPU_METHOD FORMULA_0659 "FORMULA_0659" RAT_FUNC "%9.2" "sec" COEFFS 0 100 0 0 0 1 /end COMPU_METHOD
/begin COMPU_METHOD FORMULA_0660 "FORMULA_0660" TAB_VERB "%3.0" "-" COMPU_TAB_REF FORMULA_0660_VTAB /end COMPU_METHOD
/begin COMPU_VTAB FORMULA_0660_VTAB "FORMULA_0660_VTAB" TAB_VERB 2 0 "nicht sperren" 1 "sperren" /end COMPU_VTAB
/begin COMPU_METHOD FORMULA_0661 "FORMULA_0661" TAB_VERB "%3.0" "-" COMPU_TAB_REF FORMULA_0661_VTAB /end COMPU_METHOD
/begin COMPU_VTAB FORMULA_0661_VTAB "FORMULA_0661_VTAB" TAB_VERB 2 0 "Marke = Sollgeschw." 1 "Marke = Istgeschw." /end COMPU_VTAB
/begin COMPU_METHOD FORMULA_0662 "FORMULA_0662" TAB_VERB "%3.0" "-" COMPU_TAB_REF FORMULA_0662_VTAB /end COMPU_METHOD
/begin COMPU_VTAB FORMULA_0662_VTAB "FORMULA_0662_VTAB" TAB_VERB 2 0 "FGR bis 250Km/h" 1 "FGR bis Vmax" /end COMPU_VTAB
/begin COMPU_METHOD FORMULA_0663 "FORMULA_0663" RAT_FUNC "%5.2" "km/h" COEFFS 0 16 0 0 0 1 /end COMPU_METHOD
/begin COMPU_METHOD FORMULA_0664 "FORMULA_0664" RAT_FUNC "%6.1" "mph" COEFFS 0 16 0 0 0 1 /end COMPU_METHOD
/begin COMPU_METHOD FORMULA_0665 "FORMULA_0665" RAT_FUNC "%5.2" "-" COEFFS 0 100 0 0 0 1 /end COMPU_METHOD
/begin COMPU_METHOD FORMULA_0666 "FORMULA_0666" TAB_VERB "%3.0" "-" COMPU_TAB_REF FORMULA_0666_VTAB /end COMPU_METHOD
/begin COMPU_VTAB FORMULA_0666_VTAB "FORMULA_0666_VTAB" TAB_VERB 2 0 "Fahrzeuggeschw." 1 "Anzeigegeschw." /end COMPU_VTAB
/begin COMPU_METHOD FORMULA_0667 "FORMULA_0667" RAT_FUNC "%9.4" "%/sek" COEFFS 0 10 0 0 0 1 /end COMPU_METHOD
/begin COMPU_METHOD FORMULA_0668 "FORMULA_0668" RAT_FUNC "%5.2" "-" COEFFS 0 10 0 0 0 1 /end COMPU_METHOD
/begin COMPU_METHOD FORMULA_0669 "FORMULA_0669" RAT_FUNC "%7.2" "sek" COEFFS 0 100 0 0 0 1 /end COMPU_METHOD
/begin COMPU_METHOD FORMULA_0670 "FORMULA_0670" RAT_FUNC "%6.3" "sek" COEFFS 0 128 0 0 0 1 /end COMPU_METHOD
/begin COMPU_METHOD FORMULA_0671 "FORMULA_0671" RAT_FUNC "%6.3" "-" COEFFS 0 10 0 0 0 1 /end COMPU_METHOD
/begin COMPU_METHOD FORMULA_0672 "FORMULA_0672" RAT_FUNC "%6.3" "%" COEFFS 0 10 0 0 0 1 /end COMPU_METHOD
/begin COMPU_METHOD FORMULA_0673 "FORMULA_0673" RAT_FUNC "%8.3" "%/km/h" COEFFS 0 640 0 0 0 1 /end COMPU_METHOD
/begin COMPU_METHOD FORMULA_0674 "FORMULA_0674" RAT_FUNC "%8.3" "sek" COEFFS 0 640 0 0 0 1 /end COMPU_METHOD
/* ------------------ Abschnitt erzeugt aus fr.dat ------------------ */
/begin COMPU_METHOD FORMULA_0675 "FORMULA_0675" TAB_VERB "%3.0" "-" COMPU_TAB_REF FORMULA_0675_VTAB /end COMPU_METHOD
/begin COMPU_VTAB FORMULA_0675_VTAB "FORMULA_0675_VTAB" TAB_VERB 3 0 "Inaktiv" 1 "Aktiv" 2 "Gesperrt" /end COMPU_VTAB
/begin COMPU_METHOD FORMULA_0676 "FORMULA_0676" RAT_FUNC "%9.4" "-" COEFFS 0 10000 0 0 0 1 /end COMPU_METHOD
/begin COMPU_METHOD FORMULA_0677 "FORMULA_0677" RAT_FUNC "%9.4" "1/s" COEFFS 0 32768 0 0 0 100 /end COMPU_METHOD
/begin COMPU_METHOD FORMULA_0678 "FORMULA_0678" TAB_VERB "%5.2" "-" COMPU_TAB_REF FORMULA_0678_VTAB /end COMPU_METHOD
/begin COMPU_VTAB FORMULA_0678_VTAB "FORMULA_0678_VTAB" TAB_VERB 4 0 "HFM+Aus" 1 "PSAU+Aus" 2 "HFM+Eingr" 3 "PSAU+Eingr" /end COMPU_VTAB
/begin COMPU_METHOD FORMULA_0679 "FORMULA_0679" RAT_FUNC "%5.2" "s" COEFFS 0 0 25.6 0 1 0 /end COMPU_METHOD
/* ------------------ Abschnitt erzeugt aus fra.dat ------------------ */
/begin COMPU_METHOD FORMULA_0680 "FORMULA_0680" TAB_VERB "%3.0" "-" COMPU_TAB_REF FORMULA_0680_VTAB /end COMPU_METHOD
/begin COMPU_VTAB FORMULA_0680_VTAB "FORMULA_0680_VTAB" TAB_VERB 7 0 "Freigabe" 1 "FRA aus" 2 "KH" 4 "Tmot" 8 "Egas/SK" 16 "Rf" 32 "TE" /end COMPU_VTAB
/begin COMPU_METHOD FORMULA_0681 "FORMULA_0681" TAB_VERB "%3.0" "-" COMPU_TAB_REF FORMULA_0681_VTAB /end COMPU_METHOD
/begin COMPU_VTAB FORMULA_0681_VTAB "FORMULA_0681_VTAB" TAB_VERB 5 0 "Inaktiv" 1 "Warten" 3 "Adaption" 7 "Adapt+nBegr" 11 "Adapt+pBegr" /end COMPU_VTAB
/begin COMPU_METHOD FORMULA_0682 "FORMULA_0682" TAB_VERB "%5.2" "-" COMPU_TAB_REF FORMULA_0682_VTAB /end COMPU_METHOD
/begin COMPU_VTAB FORMULA_0682_VTAB "FORMULA_0682_VTAB" TAB_VERB 2 0 "FRA aus" 1 "FRA aktiv" DEFAULT_VALUE "undef" /end COMPU_VTAB
/* ------------------ Abschnitt erzeugt aus gang.dat ------------------ */
/begin COMPU_METHOD FORMULA_0683 "FORMULA_0683" TAB_VERB "%5.2" "-" COMPU_TAB_REF FORMULA_0683_VTAB /end COMPU_METHOD
/begin COMPU_VTAB FORMULA_0683_VTAB "FORMULA_0683_VTAB" TAB_VERB 3 0 "unbekannt" 1 "vorwaerts" 2 "rueckwaerts" /end COMPU_VTAB
/begin COMPU_METHOD FORMULA_0684 "FORMULA_0684" RAT_FUNC "%5.0" "ms" COEFFS 0 1 0 0 0 10 /end COMPU_METHOD
/begin COMPU_METHOD FORMULA_0685 "FORMULA_0685" TAB_VERB "%5.2" "-" COMPU_TAB_REF FORMULA_0685_VTAB /end COMPU_METHOD
/begin COMPU_VTAB FORMULA_0685_VTAB "FORMULA_0685_VTAB" TAB_VERB 2 0 "Sperre aus" 1 "Sperre ein" /end COMPU_VTAB
/begin COMPU_METHOD FORMULA_0686 "FORMULA_0686" TAB_VERB "%5.2" "-" COMPU_TAB_REF FORMULA_0686_VTAB /end COMPU_METHOD
/begin COMPU_VTAB FORMULA_0686_VTAB "FORMULA_0686_VTAB" TAB_VERB 2 0 "iHA gesperrt" 1 "iHA freigegeben" /end COMPU_VTAB
/begin COMPU_METHOD FORMULA_0687 "FORMULA_0687" TAB_VERB "%5.2" "-" COMPU_TAB_REF FORMULA_0687_VTAB /end COMPU_METHOD
/begin COMPU_VTAB FORMULA_0687_VTAB "FORMULA_0687_VTAB" TAB_VERB 2 0 "iHA ungueltig" 1 "iHA gueltig" /end COMPU_VTAB
/begin COMPU_METHOD FORMULA_0688 "FORMULA_0688" TAB_VERB "%5.2" "-" COMPU_TAB_REF FORMULA_0688_VTAB /end COMPU_METHOD
/begin COMPU_VTAB FORMULA_0688_VTAB "FORMULA_0688_VTAB" TAB_VERB 2 0 "iHA nicht verfuegbar" 1 "iHA verfuegbar" /end COMPU_VTAB
/begin COMPU_METHOD FORMULA_0689 "FORMULA_0689" RAT_FUNC "%10.3" "-" COEFFS 0 1024 0 0 0 1 /end COMPU_METHOD
/begin COMPU_METHOD FORMULA_0690 "FORMULA_0690" RAT_FUNC "%8.3" "m" COEFFS 0 1024 0 0 0 1 /end COMPU_METHOD
/begin COMPU_METHOD FORMULA_0691 "FORMULA_0691" RAT_FUNC "%5.0" "-" COEFFS 0 1024 0 0 0 1 /end COMPU_METHOD
/* ------------------ Abschnitt erzeugt aus n_getr.dat ------------------ */
/begin COMPU_METHOD FORMULA_0839 "FORMULA_0839" RAT_FUNC "%5.0" "us" COEFFS 0 1 0 0 0 6 /end COMPU_METHOD
/begin COMPU_METHOD FORMULA_0840 "FORMULA_0840" TAB_VERB "%4.1" "-" COMPU_TAB_REF FORMULA_0840_VTAB /end COMPU_METHOD
/begin COMPU_VTAB FORMULA_0840_VTAB "FORMULA_0840_VTAB" TAB_VERB 2 0 "Messwert" 1 "Ersatzwert" /end COMPU_VTAB
/* ------------------ Abschnitt erzeugt aus v_direkt.dat ------------------ */
/begin COMPU_METHOD FORMULA_1061 "FORMULA_1061" RAT_FUNC "%6.1" "km/h*10ms" COEFFS 0 16 0 0 0 1 /end COMPU_METHOD
/begin CHARACTERISTIC K_ED_WUC_TMOT_MIN "Min. Temperatur fuer Warmupcycle | EN: Minimum temperature for an OBD warm-up cycle" VALUE 0x71962 TKW_VV_VV_SW 100.0 FORMULA_0023 -50.0000 170.0000 FORMAT "%4.1" /end CHARACTERISTIC
/begin CHARACTERISTIC K_ED_WUC_DELTA_TMOT "Min. Temperaturerhoehung fuer Warmupcycle | EN: Minimum temperature rise for an OBD warm-up cycle" VALUE 0x71964 TKW_VV_VV_SW 100.0 FORMULA_0076 -1000.0000 1000.0000 FORMAT "%4.1" /end CHARACTERISTIC
/begin CHARACTERISTIC K_ED_UBMIN "untere UB-Schwelle fuer elektr. Diagnosen | EN: Lower battery-voltage threshold for electrical diagnoses" VALUE 0x7197A TKW_VV_VV_SW 100.0 FORMULA_0008 0.0 28.0000 FORMAT "%4.1" /end CHARACTERISTIC
/* ------------------ Abschnitt erzeugt aus sc_glob.dat ------------------ */
/begin CHARACTERISTIC K_DIAGNOSE_INDEX_LO "Diagnoseindex | EN: Diagnoseindex" VALUE 0x7024C TKW_VV_VV_UB 100.0 FORMULA_0003 0.0 255.0000 /end CHARACTERISTIC
/begin CHARACTERISTIC K_DIAGNOSE_INDEX_HI "Diagnoseindex | EN: Diagnoseindex" VALUE 0x7024B TKW_VV_VV_UB 100.0 FORMULA_0003 0.0 255.0000 /end CHARACTERISTIC
/begin MEASUREMENT tm_Sync1.netTime "Netozeit" ULONG FORMULA_0358 0 0 0.0 1000.0000 ECU_ADDRESS 0x3F8B08 /end MEASUREMENT
/begin MEASUREMENT tm_Sync1.maxTime "Maxzeit" ULONG FORMULA_0358 0 0 0.0 1000.0000 ECU_ADDRESS 0x3F8B10 /end MEASUREMENT
/begin MEASUREMENT tm_Sync1.dT "Maxzeit" ULONG FORMULA_0358 0 0 0.0 1000.0000 ECU_ADDRESS 0x3F8B14 /end MEASUREMENT
/begin MEASUREMENT tm_Sync1.lastTask "vorherige Task" ULONG FORMULA_0000 0 0 0.0 1000.0000 ECU_ADDRESS 0x3F8B18 /end MEASUREMENT
/begin MEASUREMENT tm_Sync2.netTime "Netozeit" ULONG FORMULA_0358 0 0 0.0 1000.0000 ECU_ADDRESS 0x3F8B30 /end MEASUREMENT
/begin MEASUREMENT tm_Sync2.maxTime "Maxzeit" ULONG FORMULA_0358 0 0 0.0 1000.0000 ECU_ADDRESS 0x3F8B38 /end MEASUREMENT
/begin MEASUREMENT tm_Sync2.dT "Maxzeit" ULONG FORMULA_0358 0 0 0.0 1000.0000 ECU_ADDRESS 0x3F8B3C /end MEASUREMENT
/begin MEASUREMENT tm_Sync2.lastTask "vorherige Task" ULONG FORMULA_0000 0 0 0.0 1000.0000 ECU_ADDRESS 0x3F8B40 /end MEASUREMENT
/begin MEASUREMENT tm_5ms.netTime "Netozeit" ULONG FORMULA_0358 0 0 0.0 1000.0000 ECU_ADDRESS 0x3F8BA8 /end MEASUREMENT
/begin MEASUREMENT tm_5ms.maxTime "Maxzeit" ULONG FORMULA_0358 0 0 0.0 1000.0000 ECU_ADDRESS 0x3F8BB0 /end MEASUREMENT
/begin MEASUREMENT tm_5ms.dT "Maxzeit" ULONG FORMULA_0358 0 0 0.0 1000.0000 ECU_ADDRESS 0x3F8BB4 /end MEASUREMENT
/begin MEASUREMENT tm_5ms.lastTask "vorherige Task" ULONG FORMULA_0000 0 0 0.0 1000.0000 ECU_ADDRESS 0x3F8BB8 /end MEASUREMENT
/begin MEASUREMENT tm_10ms.netTime "Netozeit" ULONG FORMULA_0358 0 0 0.0 1000.0000 ECU_ADDRESS 0x3F8BD0 /end MEASUREMENT
/begin MEASUREMENT tm_10ms.maxTime "Maxzeit" ULONG FORMULA_0358 0 0 0.0 1000.0000 ECU_ADDRESS 0x3F8BD8 /end MEASUREMENT
/begin MEASUREMENT tm_10ms.dT "Maxzeit" ULONG FORMULA_0358 0 0 0.0 1000.0000 ECU_ADDRESS 0x3F8BDC /end MEASUREMENT
/begin MEASUREMENT tm_10ms.lastTask "vorherige Task" ULONG FORMULA_0000 0 0 0.0 1000.0000 ECU_ADDRESS 0x3F8BE0 /end MEASUREMENT
/begin MEASUREMENT tm_100ms.netTime "Netozeit" ULONG FORMULA_0358 0 0 0.0 1000.0000 ECU_ADDRESS 0x3F8BF8 /end MEASUREMENT
/begin MEASUREMENT tm_100ms.maxTime "Maxzeit" ULONG FORMULA_0358 0 0 0.0 1000.0000 ECU_ADDRESS 0x3F8C00 /end MEASUREMENT
/begin MEASUREMENT tm_100ms.dT "Maxzeit" ULONG FORMULA_0358 0 0 0.0 1000.0000 ECU_ADDRESS 0x3F8C04 /end MEASUREMENT
/begin MEASUREMENT tm_100ms.lastTask "vorherige Task" ULONG FORMULA_0000 0 0 0.0 1000.0000 ECU_ADDRESS 0x3F8C08 /end MEASUREMENT
/begin MEASUREMENT tm_bgnd.grossRunTime "grossRunTime" ULONG FORMULA_0358 0 0 0.0 1000.0000 ECU_ADDRESS 0x3F8C44 /end MEASUREMENT
/begin MEASUREMENT tm_bgnd.netTime "Netozeit" ULONG FORMULA_0358 0 0 0.0 1000.0000 ECU_ADDRESS 0x3F8C48 /end MEASUREMENT
/begin MEASUREMENT tm_bgnd.maxTime "Maxzeit" ULONG FORMULA_0358 0 0 0.0 1000.0000 ECU_ADDRESS 0x3F8C50 /end MEASUREMENT
/begin MEASUREMENT tm_bgnd.dT "Maxzeit" ULONG FORMULA_0358 0 0 0.0 1000.0000 ECU_ADDRESS 0x3F8C54 /end MEASUREMENT
/begin MEASUREMENT tm_bgnd.lastTask "vorherige Task" ULONG FORMULA_0000 0 0 0.0 1000.0000 ECU_ADDRESS 0x3F8C58 /end MEASUREMENT
/begin MEASUREMENT stack_status "Stackstatus" ULONG FORMULA_0000 0 0 0.0 1000.0000 ECU_ADDRESS 0x3F8D74 /end MEASUREMENT
/begin MEASUREMENT stack_usedUser "Userstack" ULONG FORMULA_0000 0 0 0.0 1000.0000 ECU_ADDRESS 0x3F8D78 /end MEASUREMENT
/begin MEASUREMENT stack_usedErcosek "Ercosekstack" ULONG FORMULA_0000 0 0 0.0 1000.0000 ECU_ADDRESS 0x3F8D7C /end MEASUREMENT
/begin MEASUREMENT ccp_aramStatus "CCP RAM-Status" UBYTE FORMULA_0359 0 0 0.0 255.0 ECU_ADDRESS 0x3FA734 /end MEASUREMENT
/begin MEASUREMENT ccp_reqSwitch "CCP Umschalt-Status" UBYTE FORMULA_0360 0 0 0.0 255.0 ECU_ADDRESS 0x3FA735 /end MEASUREMENT
/begin MEASUREMENT ccp_moveStatus "CCP Move-Status" UBYTE FORMULA_0361 0 0 0.0 255.0 ECU_ADDRESS 0x3FA758 /end MEASUREMENT
/begin MEASUREMENT ccp_stateChecksum "CCP ChkSum-Status" UBYTE FORMULA_0361 0 0 0.0 255.0 ECU_ADDRESS 0x3FA748 /end MEASUREMENT
/begin MEASUREMENT ccp_checksum "CCP ChkSum" UWORD FORMULA_0010 0 0 0.0 65535.0000 ECU_ADDRESS 0x3FA74C /end MEASUREMENT
/begin CHARACTERISTIC K_ED_TMOT.P_CODE_SH_TO_UB "P-Code fuer die Art SH_TO_UB | EN: Fault code TMOT - OBD P-code reported for short to battery voltage" VALUE 0x70C7A TKW_VV_VV_UW 100.0 FORMULA_0010 0.0 65535.0000 /end CHARACTERISTIC
/begin CHARACTERISTIC K_ED_TMOT_OBD.P_CODE_SH_TO_UB "P-Code fuer die Art SH_TO_UB | EN: Fault code TMOT_OBD - OBD P-code reported for short to battery voltage" VALUE 0x70C94 TKW_VV_VV_UW 100.0 FORMULA_0010 0.0 65535.0000 /end CHARACTERISTIC
/begin CHARACTERISTIC K_ED_TAN1.P_CODE_SH_TO_UB "P-Code fuer die Art SH_TO_UB | EN: Fault code TAN1 - OBD P-code reported for short to battery voltage" VALUE 0x70CAE TKW_VV_VV_UW 100.0 FORMULA_0010 0.0 65535.0000 /end CHARACTERISTIC
/begin CHARACTERISTIC K_ED_TAN2.P_CODE_SH_TO_UB "P-Code fuer die Art SH_TO_UB | EN: Fault code TAN2 - OBD P-code reported for short to battery voltage" VALUE 0x70CC8 TKW_VV_VV_UW 100.0 FORMULA_0010 0.0 65535.0000 /end CHARACTERISTIC
/begin CHARACTERISTIC K_ED_TIME_REL_OBD.P_CODE_SH_TO_UB "P-Code fuer die Art SH_TO_UB | EN: Fault code TIME_REL_OBD - OBD P-code reported for short to battery voltage" VALUE 0x70CE2 TKW_VV_VV_UW 100.0 FORMULA_0010 0.0 65535.0000 /end CHARACTERISTIC
/begin CHARACTERISTIC K_ED_UB.P_CODE_SH_TO_UB "P-Code fuer die Art SH_TO_UB | EN: Fault code UB - OBD P-code reported for short to battery voltage" VALUE 0x70CFC TKW_VV_VV_UW 100.0 FORMULA_0010 0.0 65535.0000 /end CHARACTERISTIC
/begin CHARACTERISTIC K_ED_TKA.P_CODE_SH_TO_UB "P-Code fuer die Art SH_TO_UB | EN: Fault code TKA - OBD P-code reported for short to battery voltage" VALUE 0x70D16 TKW_VV_VV_UW 100.0 FORMULA_0010 0.0 65535.0000 /end CHARACTERISTIC
/begin CHARACTERISTIC K_ED_TDME.P_CODE_SH_TO_UB "P-Code fuer die Art SH_TO_UB | EN: Fault code TDME - OBD P-code reported for short to battery voltage" VALUE 0x70D30 TKW_VV_VV_UW 100.0 FORMULA_0010 0.0 65535.0000 /end CHARACTERISTIC
/begin CHARACTERISTIC K_ED_UEXT_111219514.P_CODE_SH_TO_UB "P-Code fuer die Art SH_TO_UB | EN: Fault code UEXT_111219514 - OBD P-code reported for short to battery voltage" VALUE 0x70D4A TKW_VV_VV_UW 100.0 FORMULA_0010 0.0 65535.0000 /end CHARACTERISTIC
/begin CHARACTERISTIC K_ED_UEXT_124_512.P_CODE_SH_TO_UB "P-Code fuer die Art SH_TO_UB | EN: Fault code UEXT_124_512 - OBD P-code reported for short to battery voltage" VALUE 0x70D64 TKW_VV_VV_UW 100.0 FORMULA_0010 0.0 65535.0000 /end CHARACTERISTIC
/begin CHARACTERISTIC K_ED_TKA_OBD.P_CODE_SH_TO_UB "P-Code fuer die Art SH_TO_UB | EN: Fault code TKA_OBD - OBD P-code reported for short to battery voltage" VALUE 0x70D98 TKW_VV_VV_UW 100.0 FORMULA_0010 0.0 65535.0000 /end CHARACTERISTIC
/begin CHARACTERISTIC K_ED_SMG_SK.P_CODE_SH_TO_UB "P-Code fuer die Art SH_TO_UB | EN: Fault code SMG_SK - OBD P-code reported for short to battery voltage" VALUE 0x70ED0 TKW_VV_VV_UW 100.0 FORMULA_0010 0.0 65535.0000 /end CHARACTERISTIC
/begin CHARACTERISTIC K_ED_SMG_SK_N.P_CODE_SH_TO_UB "P-Code fuer die Art SH_TO_UB | EN: Fault code SMG_SK_N - OBD P-code reported for short to battery voltage" VALUE 0x70EEA TKW_VV_VV_UW 100.0 FORMULA_0010 0.0 65535.0000 /end CHARACTERISTIC
/begin CHARACTERISTIC K_ED_TUMG_OBD.P_CODE_SH_TO_UB "P-Code fuer die Art SH_TO_UB | EN: Fault code TUMG_OBD - OBD P-code reported for short to battery voltage" VALUE 0x70F04 TKW_VV_VV_UW 100.0 FORMULA_0010 0.0 65535.0000 /end CHARACTERISTIC
/begin CHARACTERISTIC K_ED_V_DIREKT.P_CODE_SH_TO_UB "P-Code fuer die Art SH_TO_UB | EN: Fault code V_DIREKT - OBD P-code reported for short to battery voltage" VALUE 0x70F1E TKW_VV_VV_UW 100.0 FORMULA_0010 0.0 65535.0000 /end CHARACTERISTIC
/begin CHARACTERISTIC K_ED_TABG1.P_CODE_SH_TO_UB "P-Code fuer die Art SH_TO_UB | EN: Fault code TABG1 - OBD P-code reported for short to battery voltage" VALUE 0x71022 TKW_VV_VV_UW 100.0 FORMULA_0010 0.0 65535.0000 /end CHARACTERISTIC
/begin CHARACTERISTIC K_ED_TABG2.P_CODE_SH_TO_UB "P-Code fuer die Art SH_TO_UB | EN: Fault code TABG2 - OBD P-code reported for short to battery voltage" VALUE 0x7103C TKW_VV_VV_UW 100.0 FORMULA_0010 0.0 65535.0000 /end CHARACTERISTIC
/begin CHARACTERISTIC K_ED_TAN_OBD_B1.P_CODE_SH_TO_UB "P-Code fuer die Art SH_TO_UB | EN: Fault code TAN_OBD_B1 - OBD P-code reported for short to battery voltage" VALUE 0x71536 TKW_VV_VV_UW 100.0 FORMULA_0010 0.0 65535.0000 /end CHARACTERISTIC
/begin CHARACTERISTIC K_ED_ZOELP1.P_CODE_SH_TO_UB "P-Code fuer die Art SH_TO_UB | EN: Fault code ZOELP1 - OBD P-code reported for short to battery voltage" VALUE 0x71584 TKW_VV_VV_UW 100.0 FORMULA_0010 0.0 65535.0000 /end CHARACTERISTIC
/begin CHARACTERISTIC K_ED_ZOELP2.P_CODE_SH_TO_UB "P-Code fuer die Art SH_TO_UB | EN: Fault code ZOELP2 - OBD P-code reported for short to battery voltage" VALUE 0x7159E TKW_VV_VV_UW 100.0 FORMULA_0010 0.0 65535.0000 /end CHARACTERISTIC
/begin CHARACTERISTIC K_ED_THERMOSTAT.P_CODE_SH_TO_UB "P-Code fuer die Art SH_TO_UB | EN: Fault code THERMOSTAT - OBD P-code reported for short to battery voltage" VALUE 0x7163A TKW_VV_VV_UW 100.0 FORMULA_0010 0.0 65535.0000 /end CHARACTERISTIC
/begin CHARACTERISTIC K_ED_TAN_OBD_B2.P_CODE_SH_TO_UB "P-Code fuer die Art SH_TO_UB | EN: Fault code TAN_OBD_B2 - OBD P-code reported for short to battery voltage" VALUE 0x71654 TKW_VV_VV_UW 100.0 FORMULA_0010 0.0 65535.0000 /end CHARACTERISTIC
/begin CHARACTERISTIC K_ED_START_RL.P_CODE_SH_TO_UB "P-Code fuer die Art SH_TO_UB | EN: Fault code START_RL - OBD P-code reported for short to battery voltage" VALUE 0x716D6 TKW_VV_VV_UW 100.0 FORMULA_0010 0.0 65535.0000 /end CHARACTERISTIC
/begin CHARACTERISTIC K_ED_TUMG.P_CODE_SH_TO_UB "P-Code fuer die Art SH_TO_UB | EN: Fault code TUMG - OBD P-code reported for short to battery voltage" VALUE 0x71724 TKW_VV_VV_UW 100.0 FORMULA_0010 0.0 65535.0000 /end CHARACTERISTIC
/begin CHARACTERISTIC K_ED_TMOT_OBD_HIGH.P_CODE_SH_TO_UB "P-Code fuer die Art SH_TO_UB | EN: Fault code TMOT_OBD_HIGH - OBD P-code reported for short to battery voltage" VALUE 0x71758 TKW_VV_VV_UW 100.0 FORMULA_0010 0.0 65535.0000 /end CHARACTERISTIC
/begin CHARACTERISTIC K_ED_TMOT.P_CODE_SH_TO_GND "P-Code fuer die Art SH_TO_GND | EN: Fault code TMOT - OBD P-code reported for short to ground" VALUE 0x70C7C TKW_VV_VV_UW 100.0 FORMULA_0010 0.0 65535.0000 /end CHARACTERISTIC
/begin CHARACTERISTIC K_ED_TMOT_OBD.P_CODE_SH_TO_GND "P-Code fuer die Art SH_TO_GND | EN: Fault code TMOT_OBD - OBD P-code reported for short to ground" VALUE 0x70C96 TKW_VV_VV_UW 100.0 FORMULA_0010 0.0 65535.0000 /end CHARACTERISTIC
/begin CHARACTERISTIC K_ED_TAN1.P_CODE_SH_TO_GND "P-Code fuer die Art SH_TO_GND | EN: Fault code TAN1 - OBD P-code reported for short to ground" VALUE 0x70CB0 TKW_VV_VV_UW 100.0 FORMULA_0010 0.0 65535.0000 /end CHARACTERISTIC
/begin CHARACTERISTIC K_ED_TAN2.P_CODE_SH_TO_GND "P-Code fuer die Art SH_TO_GND | EN: Fault code TAN2 - OBD P-code reported for short to ground" VALUE 0x70CCA TKW_VV_VV_UW 100.0 FORMULA_0010 0.0 65535.0000 /end CHARACTERISTIC
/begin CHARACTERISTIC K_ED_TIME_REL_OBD.P_CODE_SH_TO_GND "P-Code fuer die Art SH_TO_GND | EN: Fault code TIME_REL_OBD - OBD P-code reported for short to ground" VALUE 0x70CE4 TKW_VV_VV_UW 100.0 FORMULA_0010 0.0 65535.0000 /end CHARACTERISTIC
/begin CHARACTERISTIC K_ED_UB.P_CODE_SH_TO_GND "P-Code fuer die Art SH_TO_GND | EN: Fault code UB - OBD P-code reported for short to ground" VALUE 0x70CFE TKW_VV_VV_UW 100.0 FORMULA_0010 0.0 65535.0000 /end CHARACTERISTIC
/begin CHARACTERISTIC K_ED_TKA.P_CODE_SH_TO_GND "P-Code fuer die Art SH_TO_GND | EN: Fault code TKA - OBD P-code reported for short to ground" VALUE 0x70D18 TKW_VV_VV_UW 100.0 FORMULA_0010 0.0 65535.0000 /end CHARACTERISTIC
/begin CHARACTERISTIC K_ED_TDME.P_CODE_SH_TO_GND "P-Code fuer die Art SH_TO_GND | EN: Fault code TDME - OBD P-code reported for short to ground" VALUE 0x70D32 TKW_VV_VV_UW 100.0 FORMULA_0010 0.0 65535.0000 /end CHARACTERISTIC
/begin CHARACTERISTIC K_ED_UEXT_111219514.P_CODE_SH_TO_GND "P-Code fuer die Art SH_TO_GND | EN: Fault code UEXT_111219514 - OBD P-code reported for short to ground" VALUE 0x70D4C TKW_VV_VV_UW 100.0 FORMULA_0010 0.0 65535.0000 /end CHARACTERISTIC
/begin CHARACTERISTIC K_ED_UEXT_124_512.P_CODE_SH_TO_GND "P-Code fuer die Art SH_TO_GND | EN: Fault code UEXT_124_512 - OBD P-code reported for short to ground" VALUE 0x70D66 TKW_VV_VV_UW 100.0 FORMULA_0010 0.0 65535.0000 /end CHARACTERISTIC
/begin CHARACTERISTIC K_ED_TKA_OBD.P_CODE_SH_TO_GND "P-Code fuer die Art SH_TO_GND | EN: Fault code TKA_OBD - OBD P-code reported for short to ground" VALUE 0x70D9A TKW_VV_VV_UW 100.0 FORMULA_0010 0.0 65535.0000 /end CHARACTERISTIC
/begin CHARACTERISTIC K_ED_SMG_SK.P_CODE_SH_TO_GND "P-Code fuer die Art SH_TO_GND | EN: Fault code SMG_SK - OBD P-code reported for short to ground" VALUE 0x70ED2 TKW_VV_VV_UW 100.0 FORMULA_0010 0.0 65535.0000 /end CHARACTERISTIC
/begin CHARACTERISTIC K_ED_SMG_SK_N.P_CODE_SH_TO_GND "P-Code fuer die Art SH_TO_GND | EN: Fault code SMG_SK_N - OBD P-code reported for short to ground" VALUE 0x70EEC TKW_VV_VV_UW 100.0 FORMULA_0010 0.0 65535.0000 /end CHARACTERISTIC
/begin CHARACTERISTIC K_ED_TUMG_OBD.P_CODE_SH_TO_GND "P-Code fuer die Art SH_TO_GND | EN: Fault code TUMG_OBD - OBD P-code reported for short to ground" VALUE 0x70F06 TKW_VV_VV_UW 100.0 FORMULA_0010 0.0 65535.0000 /end CHARACTERISTIC
/begin CHARACTERISTIC K_ED_V_DIREKT.P_CODE_SH_TO_GND "P-Code fuer die Art SH_TO_GND | EN: Fault code V_DIREKT - OBD P-code reported for short to ground" VALUE 0x70F20 TKW_VV_VV_UW 100.0 FORMULA_0010 0.0 65535.0000 /end CHARACTERISTIC
/begin CHARACTERISTIC K_ED_TABG1.P_CODE_SH_TO_GND "P-Code fuer die Art SH_TO_GND | EN: Fault code TABG1 - OBD P-code reported for short to ground" VALUE 0x71024 TKW_VV_VV_UW 100.0 FORMULA_0010 0.0 65535.0000 /end CHARACTERISTIC
/begin CHARACTERISTIC K_ED_TABG2.P_CODE_SH_TO_GND "P-Code fuer die Art SH_TO_GND | EN: Fault code TABG2 - OBD P-code reported for short to ground" VALUE 0x7103E TKW_VV_VV_UW 100.0 FORMULA_0010 0.0 65535.0000 /end CHARACTERISTIC
/begin CHARACTERISTIC K_ED_TAN_OBD_B1.P_CODE_SH_TO_GND "P-Code fuer die Art SH_TO_GND | EN: Fault code TAN_OBD_B1 - OBD P-code reported for short to ground" VALUE 0x71538 TKW_VV_VV_UW 100.0 FORMULA_0010 0.0 65535.0000 /end CHARACTERISTIC
/begin CHARACTERISTIC K_ED_ZOELP1.P_CODE_SH_TO_GND "P-Code fuer die Art SH_TO_GND | EN: Fault code ZOELP1 - OBD P-code reported for short to ground" VALUE 0x71586 TKW_VV_VV_UW 100.0 FORMULA_0010 0.0 65535.0000 /end CHARACTERISTIC
/begin CHARACTERISTIC K_ED_ZOELP2.P_CODE_SH_TO_GND "P-Code fuer die Art SH_TO_GND | EN: Fault code ZOELP2 - OBD P-code reported for short to ground" VALUE 0x715A0 TKW_VV_VV_UW 100.0 FORMULA_0010 0.0 65535.0000 /end CHARACTERISTIC
/begin CHARACTERISTIC K_ED_THERMOSTAT.P_CODE_SH_TO_GND "P-Code fuer die Art SH_TO_GND | EN: Fault code THERMOSTAT - OBD P-code reported for short to ground" VALUE 0x7163C TKW_VV_VV_UW 100.0 FORMULA_0010 0.0 65535.0000 /end CHARACTERISTIC
/begin CHARACTERISTIC K_ED_TAN_OBD_B2.P_CODE_SH_TO_GND "P-Code fuer die Art SH_TO_GND | EN: Fault code TAN_OBD_B2 - OBD P-code reported for short to ground" VALUE 0x71656 TKW_VV_VV_UW 100.0 FORMULA_0010 0.0 65535.0000 /end CHARACTERISTIC
/begin CHARACTERISTIC K_ED_START_RL.P_CODE_SH_TO_GND "P-Code fuer die Art SH_TO_GND | EN: Fault code START_RL - OBD P-code reported for short to ground" VALUE 0x716D8 TKW_VV_VV_UW 100.0 FORMULA_0010 0.0 65535.0000 /end CHARACTERISTIC
/begin CHARACTERISTIC K_ED_TUMG.P_CODE_SH_TO_GND "P-Code fuer die Art SH_TO_GND | EN: Fault code TUMG - OBD P-code reported for short to ground" VALUE 0x71726 TKW_VV_VV_UW 100.0 FORMULA_0010 0.0 65535.0000 /end CHARACTERISTIC
/begin CHARACTERISTIC K_ED_TMOT_OBD_HIGH.P_CODE_SH_TO_GND "P-Code fuer die Art SH_TO_GND | EN: Fault code TMOT_OBD_HIGH - OBD P-code reported for short to ground" VALUE 0x7175A TKW_VV_VV_UW 100.0 FORMULA_0010 0.0 65535.0000 /end CHARACTERISTIC
/begin CHARACTERISTIC K_ED_TMOT.P_CODE_OPENLOAD "P-Code fuer die Art OPENLOAD | EN: Fault code TMOT - OBD P-code reported for open circuit" VALUE 0x70C7E TKW_VV_VV_UW 100.0 FORMULA_0010 0.0 65535.0000 /end CHARACTERISTIC
/begin CHARACTERISTIC K_ED_TMOT_OBD.P_CODE_OPENLOAD "P-Code fuer die Art OPENLOAD | EN: Fault code TMOT_OBD - OBD P-code reported for open circuit" VALUE 0x70C98 TKW_VV_VV_UW 100.0 FORMULA_0010 0.0 65535.0000 /end CHARACTERISTIC
/begin CHARACTERISTIC K_ED_TAN1.P_CODE_OPENLOAD "P-Code fuer die Art OPENLOAD | EN: Fault code TAN1 - OBD P-code reported for open circuit" VALUE 0x70CB2 TKW_VV_VV_UW 100.0 FORMULA_0010 0.0 65535.0000 /end CHARACTERISTIC
/begin CHARACTERISTIC K_ED_TAN2.P_CODE_OPENLOAD "P-Code fuer die Art OPENLOAD | EN: Fault code TAN2 - OBD P-code reported for open circuit" VALUE 0x70CCC TKW_VV_VV_UW 100.0 FORMULA_0010 0.0 65535.0000 /end CHARACTERISTIC
/begin CHARACTERISTIC K_ED_TIME_REL_OBD.P_CODE_OPENLOAD "P-Code fuer die Art OPENLOAD | EN: Fault code TIME_REL_OBD - OBD P-code reported for open circuit" VALUE 0x70CE6 TKW_VV_VV_UW 100.0 FORMULA_0010 0.0 65535.0000 /end CHARACTERISTIC
/begin CHARACTERISTIC K_ED_UB.P_CODE_OPENLOAD "P-Code fuer die Art OPENLOAD | EN: Fault code UB - OBD P-code reported for open circuit" VALUE 0x70D00 TKW_VV_VV_UW 100.0 FORMULA_0010 0.0 65535.0000 /end CHARACTERISTIC
/begin CHARACTERISTIC K_ED_TKA.P_CODE_OPENLOAD "P-Code fuer die Art OPENLOAD | EN: Fault code TKA - OBD P-code reported for open circuit" VALUE 0x70D1A TKW_VV_VV_UW 100.0 FORMULA_0010 0.0 65535.0000 /end CHARACTERISTIC
/begin CHARACTERISTIC K_ED_TDME.P_CODE_OPENLOAD "P-Code fuer die Art OPENLOAD | EN: Fault code TDME - OBD P-code reported for open circuit" VALUE 0x70D34 TKW_VV_VV_UW 100.0 FORMULA_0010 0.0 65535.0000 /end CHARACTERISTIC
/begin CHARACTERISTIC K_ED_UEXT_111219514.P_CODE_OPENLOAD "P-Code fuer die Art OPENLOAD | EN: Fault code UEXT_111219514 - OBD P-code reported for open circuit" VALUE 0x70D4E TKW_VV_VV_UW 100.0 FORMULA_0010 0.0 65535.0000 /end CHARACTERISTIC
/begin CHARACTERISTIC K_ED_UEXT_124_512.P_CODE_OPENLOAD "P-Code fuer die Art OPENLOAD | EN: Fault code UEXT_124_512 - OBD P-code reported for open circuit" VALUE 0x70D68 TKW_VV_VV_UW 100.0 FORMULA_0010 0.0 65535.0000 /end CHARACTERISTIC
/begin CHARACTERISTIC K_ED_TKA_OBD.P_CODE_OPENLOAD "P-Code fuer die Art OPENLOAD | EN: Fault code TKA_OBD - OBD P-code reported for open circuit" VALUE 0x70D9C TKW_VV_VV_UW 100.0 FORMULA_0010 0.0 65535.0000 /end CHARACTERISTIC
/begin CHARACTERISTIC K_ED_SMG_SK.P_CODE_OPENLOAD "P-Code fuer die Art OPENLOAD | EN: Fault code SMG_SK - OBD P-code reported for open circuit" VALUE 0x70ED4 TKW_VV_VV_UW 100.0 FORMULA_0010 0.0 65535.0000 /end CHARACTERISTIC
/begin CHARACTERISTIC K_ED_SMG_SK_N.P_CODE_OPENLOAD "P-Code fuer die Art OPENLOAD | EN: Fault code SMG_SK_N - OBD P-code reported for open circuit" VALUE 0x70EEE TKW_VV_VV_UW 100.0 FORMULA_0010 0.0 65535.0000 /end CHARACTERISTIC
/begin CHARACTERISTIC K_ED_TUMG_OBD.P_CODE_OPENLOAD "P-Code fuer die Art OPENLOAD | EN: Fault code TUMG_OBD - OBD P-code reported for open circuit" VALUE 0x70F08 TKW_VV_VV_UW 100.0 FORMULA_0010 0.0 65535.0000 /end CHARACTERISTIC
/begin CHARACTERISTIC K_ED_V_DIREKT.P_CODE_OPENLOAD "P-Code fuer die Art OPENLOAD | EN: Fault code V_DIREKT - OBD P-code reported for open circuit" VALUE 0x70F22 TKW_VV_VV_UW 100.0 FORMULA_0010 0.0 65535.0000 /end CHARACTERISTIC
/begin CHARACTERISTIC K_ED_TABG1.P_CODE_OPENLOAD "P-Code fuer die Art OPENLOAD | EN: Fault code TABG1 - OBD P-code reported for open circuit" VALUE 0x71026 TKW_VV_VV_UW 100.0 FORMULA_0010 0.0 65535.0000 /end CHARACTERISTIC
/begin CHARACTERISTIC K_ED_TABG2.P_CODE_OPENLOAD "P-Code fuer die Art OPENLOAD | EN: Fault code TABG2 - OBD P-code reported for open circuit" VALUE 0x71040 TKW_VV_VV_UW 100.0 FORMULA_0010 0.0 65535.0000 /end CHARACTERISTIC
/begin CHARACTERISTIC K_ED_TAN_OBD_B1.P_CODE_OPENLOAD "P-Code fuer die Art OPENLOAD | EN: Fault code TAN_OBD_B1 - OBD P-code reported for open circuit" VALUE 0x7153A TKW_VV_VV_UW 100.0 FORMULA_0010 0.0 65535.0000 /end CHARACTERISTIC
/begin CHARACTERISTIC K_ED_ZOELP1.P_CODE_OPENLOAD "P-Code fuer die Art OPENLOAD | EN: Fault code ZOELP1 - OBD P-code reported for open circuit" VALUE 0x71588 TKW_VV_VV_UW 100.0 FORMULA_0010 0.0 65535.0000 /end CHARACTERISTIC
/begin CHARACTERISTIC K_ED_ZOELP2.P_CODE_OPENLOAD "P-Code fuer die Art OPENLOAD | EN: Fault code ZOELP2 - OBD P-code reported for open circuit" VALUE 0x715A2 TKW_VV_VV_UW 100.0 FORMULA_0010 0.0 65535.0000 /end CHARACTERISTIC
/begin CHARACTERISTIC K_ED_THERMOSTAT.P_CODE_OPENLOAD "P-Code fuer die Art OPENLOAD | EN: Fault code THERMOSTAT - OBD P-code reported for open circuit" VALUE 0x7163E TKW_VV_VV_UW 100.0 FORMULA_0010 0.0 65535.0000 /end CHARACTERISTIC
/begin CHARACTERISTIC K_ED_TAN_OBD_B2.P_CODE_OPENLOAD "P-Code fuer die Art OPENLOAD | EN: Fault code TAN_OBD_B2 - OBD P-code reported for open circuit" VALUE 0x71658 TKW_VV_VV_UW 100.0 FORMULA_0010 0.0 65535.0000 /end CHARACTERISTIC
/begin CHARACTERISTIC K_ED_START_RL.P_CODE_OPENLOAD "P-Code fuer die Art OPENLOAD | EN: Fault code START_RL - OBD P-code reported for open circuit" VALUE 0x716DA TKW_VV_VV_UW 100.0 FORMULA_0010 0.0 65535.0000 /end CHARACTERISTIC
/begin CHARACTERISTIC K_ED_TUMG.P_CODE_OPENLOAD "P-Code fuer die Art OPENLOAD | EN: Fault code TUMG - OBD P-code reported for open circuit" VALUE 0x71728 TKW_VV_VV_UW 100.0 FORMULA_0010 0.0 65535.0000 /end CHARACTERISTIC
/begin CHARACTERISTIC K_ED_TMOT_OBD_HIGH.P_CODE_OPENLOAD "P-Code fuer die Art OPENLOAD | EN: Fault code TMOT_OBD_HIGH - OBD P-code reported for open circuit" VALUE 0x7175C TKW_VV_VV_UW 100.0 FORMULA_0010 0.0 65535.0000 /end CHARACTERISTIC
/begin CHARACTERISTIC K_ED_TMOT.P_CODE_UNPLAUSIBEL "P-Code fuer die Art UNPLAUSIBEL | EN: Fault code TMOT - OBD P-code reported for implausible signal" VALUE 0x70C80 TKW_VV_VV_UW 100.0 FORMULA_0010 0.0 65535.0000 /end CHARACTERISTIC
/begin CHARACTERISTIC K_ED_TMOT_OBD.P_CODE_UNPLAUSIBEL "P-Code fuer die Art UNPLAUSIBEL | EN: Fault code TMOT_OBD - OBD P-code reported for implausible signal" VALUE 0x70C9A TKW_VV_VV_UW 100.0 FORMULA_0010 0.0 65535.0000 /end CHARACTERISTIC
/begin CHARACTERISTIC K_ED_TAN1.P_CODE_UNPLAUSIBEL "P-Code fuer die Art UNPLAUSIBEL | EN: Fault code TAN1 - OBD P-code reported for implausible signal" VALUE 0x70CB4 TKW_VV_VV_UW 100.0 FORMULA_0010 0.0 65535.0000 /end CHARACTERISTIC
/begin CHARACTERISTIC K_ED_TAN2.P_CODE_UNPLAUSIBEL "P-Code fuer die Art UNPLAUSIBEL | EN: Fault code TAN2 - OBD P-code reported for implausible signal" VALUE 0x70CCE TKW_VV_VV_UW 100.0 FORMULA_0010 0.0 65535.0000 /end CHARACTERISTIC
/begin CHARACTERISTIC K_ED_TIME_REL_OBD.P_CODE_UNPLAUSIBEL "P-Code fuer die Art UNPLAUSIBEL | EN: Fault code TIME_REL_OBD - OBD P-code reported for implausible signal" VALUE 0x70CE8 TKW_VV_VV_UW 100.0 FORMULA_0010 0.0 65535.0000 /end CHARACTERISTIC
/begin CHARACTERISTIC K_ED_UB.P_CODE_UNPLAUSIBEL "P-Code fuer die Art UNPLAUSIBEL | EN: Fault code UB - OBD P-code reported for implausible signal" VALUE 0x70D02 TKW_VV_VV_UW 100.0 FORMULA_0010 0.0 65535.0000 /end CHARACTERISTIC
/begin CHARACTERISTIC K_ED_TKA.P_CODE_UNPLAUSIBEL "P-Code fuer die Art UNPLAUSIBEL | EN: Fault code TKA - OBD P-code reported for implausible signal" VALUE 0x70D1C TKW_VV_VV_UW 100.0 FORMULA_0010 0.0 65535.0000 /end CHARACTERISTIC
/begin CHARACTERISTIC K_ED_TDME.P_CODE_UNPLAUSIBEL "P-Code fuer die Art UNPLAUSIBEL | EN: Fault code TDME - OBD P-code reported for implausible signal" VALUE 0x70D36 TKW_VV_VV_UW 100.0 FORMULA_0010 0.0 65535.0000 /end CHARACTERISTIC
/begin CHARACTERISTIC K_ED_UEXT_111219514.P_CODE_UNPLAUSIBEL "P-Code fuer die Art UNPLAUSIBEL | EN: Fault code UEXT_111219514 - OBD P-code reported for implausible signal" VALUE 0x70D50 TKW_VV_VV_UW 100.0 FORMULA_0010 0.0 65535.0000 /end CHARACTERISTIC
/begin CHARACTERISTIC K_ED_UEXT_124_512.P_CODE_UNPLAUSIBEL "P-Code fuer die Art UNPLAUSIBEL | EN: Fault code UEXT_124_512 - OBD P-code reported for implausible signal" VALUE 0x70D6A TKW_VV_VV_UW 100.0 FORMULA_0010 0.0 65535.0000 /end CHARACTERISTIC
/begin CHARACTERISTIC K_ED_TKA_OBD.P_CODE_UNPLAUSIBEL "P-Code fuer die Art UNPLAUSIBEL | EN: Fault code TKA_OBD - OBD P-code reported for implausible signal" VALUE 0x70D9E TKW_VV_VV_UW 100.0 FORMULA_0010 0.0 65535.0000 /end CHARACTERISTIC
/begin CHARACTERISTIC K_ED_SMG_SK.P_CODE_UNPLAUSIBEL "P-Code fuer die Art UNPLAUSIBEL | EN: Fault code SMG_SK - OBD P-code reported for implausible signal" VALUE 0x70ED6 TKW_VV_VV_UW 100.0 FORMULA_0010 0.0 65535.0000 /end CHARACTERISTIC
/begin CHARACTERISTIC K_ED_SMG_SK_N.P_CODE_UNPLAUSIBEL "P-Code fuer die Art UNPLAUSIBEL | EN: Fault code SMG_SK_N - OBD P-code reported for implausible signal" VALUE 0x70EF0 TKW_VV_VV_UW 100.0 FORMULA_0010 0.0 65535.0000 /end CHARACTERISTIC
/begin CHARACTERISTIC K_ED_TUMG_OBD.P_CODE_UNPLAUSIBEL "P-Code fuer die Art UNPLAUSIBEL | EN: Fault code TUMG_OBD - OBD P-code reported for implausible signal" VALUE 0x70F0A TKW_VV_VV_UW 100.0 FORMULA_0010 0.0 65535.0000 /end CHARACTERISTIC
/begin CHARACTERISTIC K_ED_V_DIREKT.P_CODE_UNPLAUSIBEL "P-Code fuer die Art UNPLAUSIBEL | EN: Fault code V_DIREKT - OBD P-code reported for implausible signal" VALUE 0x70F24 TKW_VV_VV_UW 100.0 FORMULA_0010 0.0 65535.0000 /end CHARACTERISTIC
/begin CHARACTERISTIC K_ED_TABG1.P_CODE_UNPLAUSIBEL "P-Code fuer die Art UNPLAUSIBEL | EN: Fault code TABG1 - OBD P-code reported for implausible signal" VALUE 0x71028 TKW_VV_VV_UW 100.0 FORMULA_0010 0.0 65535.0000 /end CHARACTERISTIC
/begin CHARACTERISTIC K_ED_TABG2.P_CODE_UNPLAUSIBEL "P-Code fuer die Art UNPLAUSIBEL | EN: Fault code TABG2 - OBD P-code reported for implausible signal" VALUE 0x71042 TKW_VV_VV_UW 100.0 FORMULA_0010 0.0 65535.0000 /end CHARACTERISTIC
/begin CHARACTERISTIC K_ED_TAN_OBD_B1.P_CODE_UNPLAUSIBEL "P-Code fuer die Art UNPLAUSIBEL | EN: Fault code TAN_OBD_B1 - OBD P-code reported for implausible signal" VALUE 0x7153C TKW_VV_VV_UW 100.0 FORMULA_0010 0.0 65535.0000 /end CHARACTERISTIC
/begin CHARACTERISTIC K_ED_ZOELP1.P_CODE_UNPLAUSIBEL "P-Code fuer die Art UNPLAUSIBEL | EN: Fault code ZOELP1 - OBD P-code reported for implausible signal" VALUE 0x7158A TKW_VV_VV_UW 100.0 FORMULA_0010 0.0 65535.0000 /end CHARACTERISTIC
/begin CHARACTERISTIC K_ED_ZOELP2.P_CODE_UNPLAUSIBEL "P-Code fuer die Art UNPLAUSIBEL | EN: Fault code ZOELP2 - OBD P-code reported for implausible signal" VALUE 0x715A4 TKW_VV_VV_UW 100.0 FORMULA_0010 0.0 65535.0000 /end CHARACTERISTIC
/begin CHARACTERISTIC K_ED_THERMOSTAT.P_CODE_UNPLAUSIBEL "P-Code fuer die Art UNPLAUSIBEL | EN: Fault code THERMOSTAT - OBD P-code reported for implausible signal" VALUE 0x71640 TKW_VV_VV_UW 100.0 FORMULA_0010 0.0 65535.0000 /end CHARACTERISTIC
/begin CHARACTERISTIC K_ED_TAN_OBD_B2.P_CODE_UNPLAUSIBEL "P-Code fuer die Art UNPLAUSIBEL | EN: Fault code TAN_OBD_B2 - OBD P-code reported for implausible signal" VALUE 0x7165A TKW_VV_VV_UW 100.0 FORMULA_0010 0.0 65535.0000 /end CHARACTERISTIC
/begin CHARACTERISTIC K_ED_START_RL.P_CODE_UNPLAUSIBEL "P-Code fuer die Art UNPLAUSIBEL | EN: Fault code START_RL - OBD P-code reported for implausible signal" VALUE 0x716DC TKW_VV_VV_UW 100.0 FORMULA_0010 0.0 65535.0000 /end CHARACTERISTIC
/begin CHARACTERISTIC K_ED_TUMG.P_CODE_UNPLAUSIBEL "P-Code fuer die Art UNPLAUSIBEL | EN: Fault code TUMG - OBD P-code reported for implausible signal" VALUE 0x7172A TKW_VV_VV_UW 100.0 FORMULA_0010 0.0 65535.0000 /end CHARACTERISTIC
/begin CHARACTERISTIC K_ED_TMOT_OBD_HIGH.P_CODE_UNPLAUSIBEL "P-Code fuer die Art UNPLAUSIBEL | EN: Fault code TMOT_OBD_HIGH - OBD P-code reported for implausible signal" VALUE 0x7175E TKW_VV_VV_UW 100.0 FORMULA_0010 0.0 65535.0000 /end CHARACTERISTIC
/begin CHARACTERISTIC K_ED_TMOT.FEHLERSCHWELLE "Filterschwelle fuer Fehlereintrag | EN: Fault code TMOT - debounce filter threshold for setting the fault" VALUE 0x70C82 TKW_VV_VV_UB 100.0 FORMULA_0003 0.0 255.0000 /end CHARACTERISTIC
/begin CHARACTERISTIC K_ED_TMOT_OBD.FEHLERSCHWELLE "Filterschwelle fuer Fehlereintrag | EN: Fault code TMOT_OBD - debounce filter threshold for setting the fault" VALUE 0x70C9C TKW_VV_VV_UB 100.0 FORMULA_0003 0.0 255.0000 /end CHARACTERISTIC
/begin CHARACTERISTIC K_ED_TAN1.FEHLERSCHWELLE "Filterschwelle fuer Fehlereintrag | EN: Fault code TAN1 - debounce filter threshold for setting the fault" VALUE 0x70CB6 TKW_VV_VV_UB 100.0 FORMULA_0003 0.0 255.0000 /end CHARACTERISTIC
/begin CHARACTERISTIC K_ED_TAN2.FEHLERSCHWELLE "Filterschwelle fuer Fehlereintrag | EN: Fault code TAN2 - debounce filter threshold for setting the fault" VALUE 0x70CD0 TKW_VV_VV_UB 100.0 FORMULA_0003 0.0 255.0000 /end CHARACTERISTIC
/begin CHARACTERISTIC K_ED_TIME_REL_OBD.FEHLERSCHWELLE "Filterschwelle fuer Fehlereintrag | EN: Fault code TIME_REL_OBD - debounce filter threshold for setting the fault" VALUE 0x70CEA TKW_VV_VV_UB 100.0 FORMULA_0003 0.0 255.0000 /end CHARACTERISTIC
/begin CHARACTERISTIC K_ED_UB.FEHLERSCHWELLE "Filterschwelle fuer Fehlereintrag | EN: Fault code UB - debounce filter threshold for setting the fault" VALUE 0x70D04 TKW_VV_VV_UB 100.0 FORMULA_0003 0.0 255.0000 /end CHARACTERISTIC
/begin CHARACTERISTIC K_ED_TKA.FEHLERSCHWELLE "Filterschwelle fuer Fehlereintrag | EN: Fault code TKA - debounce filter threshold for setting the fault" VALUE 0x70D1E TKW_VV_VV_UB 100.0 FORMULA_0003 0.0 255.0000 /end CHARACTERISTIC
/begin CHARACTERISTIC K_ED_TDME.FEHLERSCHWELLE "Filterschwelle fuer Fehlereintrag | EN: Fault code TDME - debounce filter threshold for setting the fault" VALUE 0x70D38 TKW_VV_VV_UB 100.0 FORMULA_0003 0.0 255.0000 /end CHARACTERISTIC
/begin CHARACTERISTIC K_ED_UEXT_111219514.FEHLERSCHWELLE "Filterschwelle fuer Fehlereintrag | EN: Fault code UEXT_111219514 - debounce filter threshold for setting the fault" VALUE 0x70D52 TKW_VV_VV_UB 100.0 FORMULA_0003 0.0 255.0000 /end CHARACTERISTIC
/begin CHARACTERISTIC K_ED_UEXT_124_512.FEHLERSCHWELLE "Filterschwelle fuer Fehlereintrag | EN: Fault code UEXT_124_512 - debounce filter threshold for setting the fault" VALUE 0x70D6C TKW_VV_VV_UB 100.0 FORMULA_0003 0.0 255.0000 /end CHARACTERISTIC
/begin CHARACTERISTIC K_ED_TKA_OBD.FEHLERSCHWELLE "Filterschwelle fuer Fehlereintrag | EN: Fault code TKA_OBD - debounce filter threshold for setting the fault" VALUE 0x70DA0 TKW_VV_VV_UB 100.0 FORMULA_0003 0.0 255.0000 /end CHARACTERISTIC
/begin CHARACTERISTIC K_ED_SMG_SK.FEHLERSCHWELLE "Filterschwelle fuer Fehlereintrag | EN: Fault code SMG_SK - debounce filter threshold for setting the fault" VALUE 0x70ED8 TKW_VV_VV_UB 100.0 FORMULA_0003 0.0 255.0000 /end CHARACTERISTIC
/begin CHARACTERISTIC K_ED_SMG_SK_N.FEHLERSCHWELLE "Filterschwelle fuer Fehlereintrag | EN: Fault code SMG_SK_N - debounce filter threshold for setting the fault" VALUE 0x70EF2 TKW_VV_VV_UB 100.0 FORMULA_0003 0.0 255.0000 /end CHARACTERISTIC
/begin CHARACTERISTIC K_ED_TUMG_OBD.FEHLERSCHWELLE "Filterschwelle fuer Fehlereintrag | EN: Fault code TUMG_OBD - debounce filter threshold for setting the fault" VALUE 0x70F0C TKW_VV_VV_UB 100.0 FORMULA_0003 0.0 255.0000 /end CHARACTERISTIC
/begin CHARACTERISTIC K_ED_V_DIREKT.FEHLERSCHWELLE "Filterschwelle fuer Fehlereintrag | EN: Fault code V_DIREKT - debounce filter threshold for setting the fault" VALUE 0x70F26 TKW_VV_VV_UB 100.0 FORMULA_0003 0.0 255.0000 /end CHARACTERISTIC
/begin CHARACTERISTIC K_ED_TABG1.FEHLERSCHWELLE "Filterschwelle fuer Fehlereintrag | EN: Fault code TABG1 - debounce filter threshold for setting the fault" VALUE 0x7102A TKW_VV_VV_UB 100.0 FORMULA_0003 0.0 255.0000 /end CHARACTERISTIC
/begin CHARACTERISTIC K_ED_TABG2.FEHLERSCHWELLE "Filterschwelle fuer Fehlereintrag | EN: Fault code TABG2 - debounce filter threshold for setting the fault" VALUE 0x71044 TKW_VV_VV_UB 100.0 FORMULA_0003 0.0 255.0000 /end CHARACTERISTIC
/begin CHARACTERISTIC K_ED_TAN_OBD_B1.FEHLERSCHWELLE "Filterschwelle fuer Fehlereintrag | EN: Fault code TAN_OBD_B1 - debounce filter threshold for setting the fault" VALUE 0x7153E TKW_VV_VV_UB 100.0 FORMULA_0003 0.0 255.0000 /end CHARACTERISTIC
/begin CHARACTERISTIC K_ED_ZOELP1.FEHLERSCHWELLE "Filterschwelle fuer Fehlereintrag | EN: Fault code ZOELP1 - debounce filter threshold for setting the fault" VALUE 0x7158C TKW_VV_VV_UB 100.0 FORMULA_0003 0.0 255.0000 /end CHARACTERISTIC
/begin CHARACTERISTIC K_ED_ZOELP2.FEHLERSCHWELLE "Filterschwelle fuer Fehlereintrag | EN: Fault code ZOELP2 - debounce filter threshold for setting the fault" VALUE 0x715A6 TKW_VV_VV_UB 100.0 FORMULA_0003 0.0 255.0000 /end CHARACTERISTIC
/begin CHARACTERISTIC K_ED_THERMOSTAT.FEHLERSCHWELLE "Filterschwelle fuer Fehlereintrag | EN: Fault code THERMOSTAT - debounce filter threshold for setting the fault" VALUE 0x71642 TKW_VV_VV_UB 100.0 FORMULA_0003 0.0 255.0000 /end CHARACTERISTIC
/begin CHARACTERISTIC K_ED_TAN_OBD_B2.FEHLERSCHWELLE "Filterschwelle fuer Fehlereintrag | EN: Fault code TAN_OBD_B2 - debounce filter threshold for setting the fault" VALUE 0x7165C TKW_VV_VV_UB 100.0 FORMULA_0003 0.0 255.0000 /end CHARACTERISTIC
/begin CHARACTERISTIC K_ED_START_RL.FEHLERSCHWELLE "Filterschwelle fuer Fehlereintrag | EN: Fault code START_RL - debounce filter threshold for setting the fault" VALUE 0x716DE TKW_VV_VV_UB 100.0 FORMULA_0003 0.0 255.0000 /end CHARACTERISTIC
/begin CHARACTERISTIC K_ED_TUMG.FEHLERSCHWELLE "Filterschwelle fuer Fehlereintrag | EN: Fault code TUMG - debounce filter threshold for setting the fault" VALUE 0x7172C TKW_VV_VV_UB 100.0 FORMULA_0003 0.0 255.0000 /end CHARACTERISTIC
/begin CHARACTERISTIC K_ED_TMOT_OBD_HIGH.FEHLERSCHWELLE "Filterschwelle fuer Fehlereintrag | EN: Fault code TMOT_OBD_HIGH - debounce filter threshold for setting the fault" VALUE 0x71760 TKW_VV_VV_UB 100.0 FORMULA_0003 0.0 255.0000 /end CHARACTERISTIC
/begin CHARACTERISTIC K_ED_TMOT.OK_SCHWELLE "Filterschwelle fuer Fehleraustrag | EN: Fault code TMOT - debounce filter threshold for clearing (healing) the fault" VALUE 0x70C83 TKW_VV_VV_UB 100.0 FORMULA_0003 0.0 255.0000 /end CHARACTERISTIC
/begin CHARACTERISTIC K_ED_TMOT_OBD.OK_SCHWELLE "Filterschwelle fuer Fehleraustrag | EN: Fault code TMOT_OBD - debounce filter threshold for clearing (healing) the fault" VALUE 0x70C9D TKW_VV_VV_UB 100.0 FORMULA_0003 0.0 255.0000 /end CHARACTERISTIC
/begin CHARACTERISTIC K_ED_TAN1.OK_SCHWELLE "Filterschwelle fuer Fehleraustrag | EN: Fault code TAN1 - debounce filter threshold for clearing (healing) the fault" VALUE 0x70CB7 TKW_VV_VV_UB 100.0 FORMULA_0003 0.0 255.0000 /end CHARACTERISTIC
/begin CHARACTERISTIC K_ED_TAN2.OK_SCHWELLE "Filterschwelle fuer Fehleraustrag | EN: Fault code TAN2 - debounce filter threshold for clearing (healing) the fault" VALUE 0x70CD1 TKW_VV_VV_UB 100.0 FORMULA_0003 0.0 255.0000 /end CHARACTERISTIC
/begin CHARACTERISTIC K_ED_TIME_REL_OBD.OK_SCHWELLE "Filterschwelle fuer Fehleraustrag | EN: Fault code TIME_REL_OBD - debounce filter threshold for clearing (healing) the fault" VALUE 0x70CEB TKW_VV_VV_UB 100.0 FORMULA_0003 0.0 255.0000 /end CHARACTERISTIC
/begin CHARACTERISTIC K_ED_UB.OK_SCHWELLE "Filterschwelle fuer Fehleraustrag | EN: Fault code UB - debounce filter threshold for clearing (healing) the fault" VALUE 0x70D05 TKW_VV_VV_UB 100.0 FORMULA_0003 0.0 255.0000 /end CHARACTERISTIC
/begin CHARACTERISTIC K_ED_TKA.OK_SCHWELLE "Filterschwelle fuer Fehleraustrag | EN: Fault code TKA - debounce filter threshold for clearing (healing) the fault" VALUE 0x70D1F TKW_VV_VV_UB 100.0 FORMULA_0003 0.0 255.0000 /end CHARACTERISTIC
/begin CHARACTERISTIC K_ED_TDME.OK_SCHWELLE "Filterschwelle fuer Fehleraustrag | EN: Fault code TDME - debounce filter threshold for clearing (healing) the fault" VALUE 0x70D39 TKW_VV_VV_UB 100.0 FORMULA_0003 0.0 255.0000 /end CHARACTERISTIC
/begin CHARACTERISTIC K_ED_UEXT_111219514.OK_SCHWELLE "Filterschwelle fuer Fehleraustrag | EN: Fault code UEXT_111219514 - debounce filter threshold for clearing (healing) the fault" VALUE 0x70D53 TKW_VV_VV_UB 100.0 FORMULA_0003 0.0 255.0000 /end CHARACTERISTIC
/begin CHARACTERISTIC K_ED_UEXT_124_512.OK_SCHWELLE "Filterschwelle fuer Fehleraustrag | EN: Fault code UEXT_124_512 - debounce filter threshold for clearing (healing) the fault" VALUE 0x70D6D TKW_VV_VV_UB 100.0 FORMULA_0003 0.0 255.0000 /end CHARACTERISTIC
/begin CHARACTERISTIC K_ED_TKA_OBD.OK_SCHWELLE "Filterschwelle fuer Fehleraustrag | EN: Fault code TKA_OBD - debounce filter threshold for clearing (healing) the fault" VALUE 0x70DA1 TKW_VV_VV_UB 100.0 FORMULA_0003 0.0 255.0000 /end CHARACTERISTIC
/begin CHARACTERISTIC K_ED_SMG_SK.OK_SCHWELLE "Filterschwelle fuer Fehleraustrag | EN: Fault code SMG_SK - debounce filter threshold for clearing (healing) the fault" VALUE 0x70ED9 TKW_VV_VV_UB 100.0 FORMULA_0003 0.0 255.0000 /end CHARACTERISTIC
/begin CHARACTERISTIC K_ED_SMG_SK_N.OK_SCHWELLE "Filterschwelle fuer Fehleraustrag | EN: Fault code SMG_SK_N - debounce filter threshold for clearing (healing) the fault" VALUE 0x70EF3 TKW_VV_VV_UB 100.0 FORMULA_0003 0.0 255.0000 /end CHARACTERISTIC
/begin CHARACTERISTIC K_ED_TUMG_OBD.OK_SCHWELLE "Filterschwelle fuer Fehleraustrag | EN: Fault code TUMG_OBD - debounce filter threshold for clearing (healing) the fault" VALUE 0x70F0D TKW_VV_VV_UB 100.0 FORMULA_0003 0.0 255.0000 /end CHARACTERISTIC
/begin CHARACTERISTIC K_ED_V_DIREKT.OK_SCHWELLE "Filterschwelle fuer Fehleraustrag | EN: Fault code V_DIREKT - debounce filter threshold for clearing (healing) the fault" VALUE 0x70F27 TKW_VV_VV_UB 100.0 FORMULA_0003 0.0 255.0000 /end CHARACTERISTIC
/begin CHARACTERISTIC K_ED_TABG1.OK_SCHWELLE "Filterschwelle fuer Fehleraustrag | EN: Fault code TABG1 - debounce filter threshold for clearing (healing) the fault" VALUE 0x7102B TKW_VV_VV_UB 100.0 FORMULA_0003 0.0 255.0000 /end CHARACTERISTIC
/begin CHARACTERISTIC K_ED_TABG2.OK_SCHWELLE "Filterschwelle fuer Fehleraustrag | EN: Fault code TABG2 - debounce filter threshold for clearing (healing) the fault" VALUE 0x71045 TKW_VV_VV_UB 100.0 FORMULA_0003 0.0 255.0000 /end CHARACTERISTIC
/begin CHARACTERISTIC K_ED_TAN_OBD_B1.OK_SCHWELLE "Filterschwelle fuer Fehleraustrag | EN: Fault code TAN_OBD_B1 - debounce filter threshold for clearing (healing) the fault" VALUE 0x7153F TKW_VV_VV_UB 100.0 FORMULA_0003 0.0 255.0000 /end CHARACTERISTIC
/begin CHARACTERISTIC K_ED_ZOELP1.OK_SCHWELLE "Filterschwelle fuer Fehleraustrag | EN: Fault code ZOELP1 - debounce filter threshold for clearing (healing) the fault" VALUE 0x7158D TKW_VV_VV_UB 100.0 FORMULA_0003 0.0 255.0000 /end CHARACTERISTIC
/begin CHARACTERISTIC K_ED_ZOELP2.OK_SCHWELLE "Filterschwelle fuer Fehleraustrag | EN: Fault code ZOELP2 - debounce filter threshold for clearing (healing) the fault" VALUE 0x715A7 TKW_VV_VV_UB 100.0 FORMULA_0003 0.0 255.0000 /end CHARACTERISTIC
/begin CHARACTERISTIC K_ED_THERMOSTAT.OK_SCHWELLE "Filterschwelle fuer Fehleraustrag | EN: Fault code THERMOSTAT - debounce filter threshold for clearing (healing) the fault" VALUE 0x71643 TKW_VV_VV_UB 100.0 FORMULA_0003 0.0 255.0000 /end CHARACTERISTIC
/begin CHARACTERISTIC K_ED_TAN_OBD_B2.OK_SCHWELLE "Filterschwelle fuer Fehleraustrag | EN: Fault code TAN_OBD_B2 - debounce filter threshold for clearing (healing) the fault" VALUE 0x7165D TKW_VV_VV_UB 100.0 FORMULA_0003 0.0 255.0000 /end CHARACTERISTIC
/begin CHARACTERISTIC K_ED_START_RL.OK_SCHWELLE "Filterschwelle fuer Fehleraustrag | EN: Fault code START_RL - debounce filter threshold for clearing (healing) the fault" VALUE 0x716DF TKW_VV_VV_UB 100.0 FORMULA_0003 0.0 255.0000 /end CHARACTERISTIC
/begin CHARACTERISTIC K_ED_TUMG.OK_SCHWELLE "Filterschwelle fuer Fehleraustrag | EN: Fault code TUMG - debounce filter threshold for clearing (healing) the fault" VALUE 0x7172D TKW_VV_VV_UB 100.0 FORMULA_0003 0.0 255.0000 /end CHARACTERISTIC
/begin CHARACTERISTIC K_ED_TMOT_OBD_HIGH.OK_SCHWELLE "Filterschwelle fuer Fehleraustrag | EN: Fault code TMOT_OBD_HIGH - debounce filter threshold for clearing (healing) the fault" VALUE 0x71761 TKW_VV_VV_UB 100.0 FORMULA_0003 0.0 255.0000 /end CHARACTERISTIC
/begin CHARACTERISTIC K_ED_TMOT.INC_VOR_EINTRAG "Filtererhoehung vorm Fehlerspeichereintrag | EN: Fault code TMOT - debounce filter increment before fault-memory entry" VALUE 0x70C84 TKW_VV_VV_UB 100.0 FORMULA_0003 0.0 255.0000 /end CHARACTERISTIC
/begin CHARACTERISTIC K_ED_TMOT_OBD.INC_VOR_EINTRAG "Filtererhoehung vorm Fehlerspeichereintrag | EN: Fault code TMOT_OBD - debounce filter increment before fault-memory entry" VALUE 0x70C9E TKW_VV_VV_UB 100.0 FORMULA_0003 0.0 255.0000 /end CHARACTERISTIC
/begin CHARACTERISTIC K_ED_TAN1.INC_VOR_EINTRAG "Filtererhoehung vorm Fehlerspeichereintrag | EN: Fault code TAN1 - debounce filter increment before fault-memory entry" VALUE 0x70CB8 TKW_VV_VV_UB 100.0 FORMULA_0003 0.0 255.0000 /end CHARACTERISTIC
/begin CHARACTERISTIC K_ED_TAN2.INC_VOR_EINTRAG "Filtererhoehung vorm Fehlerspeichereintrag | EN: Fault code TAN2 - debounce filter increment before fault-memory entry" VALUE 0x70CD2 TKW_VV_VV_UB 100.0 FORMULA_0003 0.0 255.0000 /end CHARACTERISTIC
/begin CHARACTERISTIC K_ED_TIME_REL_OBD.INC_VOR_EINTRAG "Filtererhoehung vorm Fehlerspeichereintrag | EN: Fault code TIME_REL_OBD - debounce filter increment before fault-memory entry" VALUE 0x70CEC TKW_VV_VV_UB 100.0 FORMULA_0003 0.0 255.0000 /end CHARACTERISTIC
/begin CHARACTERISTIC K_ED_UB.INC_VOR_EINTRAG "Filtererhoehung vorm Fehlerspeichereintrag | EN: Fault code UB - debounce filter increment before fault-memory entry" VALUE 0x70D06 TKW_VV_VV_UB 100.0 FORMULA_0003 0.0 255.0000 /end CHARACTERISTIC
/begin CHARACTERISTIC K_ED_TKA.INC_VOR_EINTRAG "Filtererhoehung vorm Fehlerspeichereintrag | EN: Fault code TKA - debounce filter increment before fault-memory entry" VALUE 0x70D20 TKW_VV_VV_UB 100.0 FORMULA_0003 0.0 255.0000 /end CHARACTERISTIC
/begin CHARACTERISTIC K_ED_TDME.INC_VOR_EINTRAG "Filtererhoehung vorm Fehlerspeichereintrag | EN: Fault code TDME - debounce filter increment before fault-memory entry" VALUE 0x70D3A TKW_VV_VV_UB 100.0 FORMULA_0003 0.0 255.0000 /end CHARACTERISTIC
/begin CHARACTERISTIC K_ED_UEXT_111219514.INC_VOR_EINTRAG "Filtererhoehung vorm Fehlerspeichereintrag | EN: Fault code UEXT_111219514 - debounce filter increment before fault-memory entry" VALUE 0x70D54 TKW_VV_VV_UB 100.0 FORMULA_0003 0.0 255.0000 /end CHARACTERISTIC
/begin CHARACTERISTIC K_ED_UEXT_124_512.INC_VOR_EINTRAG "Filtererhoehung vorm Fehlerspeichereintrag | EN: Fault code UEXT_124_512 - debounce filter increment before fault-memory entry" VALUE 0x70D6E TKW_VV_VV_UB 100.0 FORMULA_0003 0.0 255.0000 /end CHARACTERISTIC
/begin CHARACTERISTIC K_ED_TKA_OBD.INC_VOR_EINTRAG "Filtererhoehung vorm Fehlerspeichereintrag | EN: Fault code TKA_OBD - debounce filter increment before fault-memory entry" VALUE 0x70DA2 TKW_VV_VV_UB 100.0 FORMULA_0003 0.0 255.0000 /end CHARACTERISTIC
/begin CHARACTERISTIC K_ED_SMG_SK.INC_VOR_EINTRAG "Filtererhoehung vorm Fehlerspeichereintrag | EN: Fault code SMG_SK - debounce filter increment before fault-memory entry" VALUE 0x70EDA TKW_VV_VV_UB 100.0 FORMULA_0003 0.0 255.0000 /end CHARACTERISTIC
/begin CHARACTERISTIC K_ED_SMG_SK_N.INC_VOR_EINTRAG "Filtererhoehung vorm Fehlerspeichereintrag | EN: Fault code SMG_SK_N - debounce filter increment before fault-memory entry" VALUE 0x70EF4 TKW_VV_VV_UB 100.0 FORMULA_0003 0.0 255.0000 /end CHARACTERISTIC
/begin CHARACTERISTIC K_ED_TUMG_OBD.INC_VOR_EINTRAG "Filtererhoehung vorm Fehlerspeichereintrag | EN: Fault code TUMG_OBD - debounce filter increment before fault-memory entry" VALUE 0x70F0E TKW_VV_VV_UB 100.0 FORMULA_0003 0.0 255.0000 /end CHARACTERISTIC
/begin CHARACTERISTIC K_ED_V_DIREKT.INC_VOR_EINTRAG "Filtererhoehung vorm Fehlerspeichereintrag | EN: Fault code V_DIREKT - debounce filter increment before fault-memory entry" VALUE 0x70F28 TKW_VV_VV_UB 100.0 FORMULA_0003 0.0 255.0000 /end CHARACTERISTIC
/begin CHARACTERISTIC K_ED_TABG1.INC_VOR_EINTRAG "Filtererhoehung vorm Fehlerspeichereintrag | EN: Fault code TABG1 - debounce filter increment before fault-memory entry" VALUE 0x7102C TKW_VV_VV_UB 100.0 FORMULA_0003 0.0 255.0000 /end CHARACTERISTIC
/begin CHARACTERISTIC K_ED_TABG2.INC_VOR_EINTRAG "Filtererhoehung vorm Fehlerspeichereintrag | EN: Fault code TABG2 - debounce filter increment before fault-memory entry" VALUE 0x71046 TKW_VV_VV_UB 100.0 FORMULA_0003 0.0 255.0000 /end CHARACTERISTIC
/begin CHARACTERISTIC K_ED_TAN_OBD_B1.INC_VOR_EINTRAG "Filtererhoehung vorm Fehlerspeichereintrag | EN: Fault code TAN_OBD_B1 - debounce filter increment before fault-memory entry" VALUE 0x71540 TKW_VV_VV_UB 100.0 FORMULA_0003 0.0 255.0000 /end CHARACTERISTIC
/begin CHARACTERISTIC K_ED_ZOELP1.INC_VOR_EINTRAG "Filtererhoehung vorm Fehlerspeichereintrag | EN: Fault code ZOELP1 - debounce filter increment before fault-memory entry" VALUE 0x7158E TKW_VV_VV_UB 100.0 FORMULA_0003 0.0 255.0000 /end CHARACTERISTIC
/begin CHARACTERISTIC K_ED_ZOELP2.INC_VOR_EINTRAG "Filtererhoehung vorm Fehlerspeichereintrag | EN: Fault code ZOELP2 - debounce filter increment before fault-memory entry" VALUE 0x715A8 TKW_VV_VV_UB 100.0 FORMULA_0003 0.0 255.0000 /end CHARACTERISTIC
/begin CHARACTERISTIC K_ED_THERMOSTAT.INC_VOR_EINTRAG "Filtererhoehung vorm Fehlerspeichereintrag | EN: Fault code THERMOSTAT - debounce filter increment before fault-memory entry" VALUE 0x71644 TKW_VV_VV_UB 100.0 FORMULA_0003 0.0 255.0000 /end CHARACTERISTIC
/begin CHARACTERISTIC K_ED_TAN_OBD_B2.INC_VOR_EINTRAG "Filtererhoehung vorm Fehlerspeichereintrag | EN: Fault code TAN_OBD_B2 - debounce filter increment before fault-memory entry" VALUE 0x7165E TKW_VV_VV_UB 100.0 FORMULA_0003 0.0 255.0000 /end CHARACTERISTIC
/begin CHARACTERISTIC K_ED_START_RL.INC_VOR_EINTRAG "Filtererhoehung vorm Fehlerspeichereintrag | EN: Fault code START_RL - debounce filter increment before fault-memory entry" VALUE 0x716E0 TKW_VV_VV_UB 100.0 FORMULA_0003 0.0 255.0000 /end CHARACTERISTIC
/begin CHARACTERISTIC K_ED_TUMG.INC_VOR_EINTRAG "Filtererhoehung vorm Fehlerspeichereintrag | EN: Fault code TUMG - debounce filter increment before fault-memory entry" VALUE 0x7172E TKW_VV_VV_UB 100.0 FORMULA_0003 0.0 255.0000 /end CHARACTERISTIC
/begin CHARACTERISTIC K_ED_TMOT_OBD_HIGH.INC_VOR_EINTRAG "Filtererhoehung vorm Fehlerspeichereintrag | EN: Fault code TMOT_OBD_HIGH - debounce filter increment before fault-memory entry" VALUE 0x71762 TKW_VV_VV_UB 100.0 FORMULA_0003 0.0 255.0000 /end CHARACTERISTIC
/begin CHARACTERISTIC K_ED_TMOT.DEC_VOR_EINTRAG "Filterverringerung vorm Fehlerspeichereintrag | EN: Fault code TMOT - debounce filter decrement before fault-memory entry" VALUE 0x70C85 TKW_VV_VV_UB 100.0 FORMULA_0003 0.0 255.0000 /end CHARACTERISTIC
/begin CHARACTERISTIC K_ED_TMOT_OBD.DEC_VOR_EINTRAG "Filterverringerung vorm Fehlerspeichereintrag | EN: Fault code TMOT_OBD - debounce filter decrement before fault-memory entry" VALUE 0x70C9F TKW_VV_VV_UB 100.0 FORMULA_0003 0.0 255.0000 /end CHARACTERISTIC
/begin CHARACTERISTIC K_ED_TAN1.DEC_VOR_EINTRAG "Filterverringerung vorm Fehlerspeichereintrag | EN: Fault code TAN1 - debounce filter decrement before fault-memory entry" VALUE 0x70CB9 TKW_VV_VV_UB 100.0 FORMULA_0003 0.0 255.0000 /end CHARACTERISTIC
/begin CHARACTERISTIC K_ED_TAN2.DEC_VOR_EINTRAG "Filterverringerung vorm Fehlerspeichereintrag | EN: Fault code TAN2 - debounce filter decrement before fault-memory entry" VALUE 0x70CD3 TKW_VV_VV_UB 100.0 FORMULA_0003 0.0 255.0000 /end CHARACTERISTIC
/begin CHARACTERISTIC K_ED_TIME_REL_OBD.DEC_VOR_EINTRAG "Filterverringerung vorm Fehlerspeichereintrag | EN: Fault code TIME_REL_OBD - debounce filter decrement before fault-memory entry" VALUE 0x70CED TKW_VV_VV_UB 100.0 FORMULA_0003 0.0 255.0000 /end CHARACTERISTIC
/begin CHARACTERISTIC K_ED_UB.DEC_VOR_EINTRAG "Filterverringerung vorm Fehlerspeichereintrag | EN: Fault code UB - debounce filter decrement before fault-memory entry" VALUE 0x70D07 TKW_VV_VV_UB 100.0 FORMULA_0003 0.0 255.0000 /end CHARACTERISTIC
/begin CHARACTERISTIC K_ED_TKA.DEC_VOR_EINTRAG "Filterverringerung vorm Fehlerspeichereintrag | EN: Fault code TKA - debounce filter decrement before fault-memory entry" VALUE 0x70D21 TKW_VV_VV_UB 100.0 FORMULA_0003 0.0 255.0000 /end CHARACTERISTIC
/begin CHARACTERISTIC K_ED_TDME.DEC_VOR_EINTRAG "Filterverringerung vorm Fehlerspeichereintrag | EN: Fault code TDME - debounce filter decrement before fault-memory entry" VALUE 0x70D3B TKW_VV_VV_UB 100.0 FORMULA_0003 0.0 255.0000 /end CHARACTERISTIC
/begin CHARACTERISTIC K_ED_UEXT_111219514.DEC_VOR_EINTRAG "Filterverringerung vorm Fehlerspeichereintrag | EN: Fault code UEXT_111219514 - debounce filter decrement before fault-memory entry" VALUE 0x70D55 TKW_VV_VV_UB 100.0 FORMULA_0003 0.0 255.0000 /end CHARACTERISTIC
/begin CHARACTERISTIC K_ED_UEXT_124_512.DEC_VOR_EINTRAG "Filterverringerung vorm Fehlerspeichereintrag | EN: Fault code UEXT_124_512 - debounce filter decrement before fault-memory entry" VALUE 0x70D6F TKW_VV_VV_UB 100.0 FORMULA_0003 0.0 255.0000 /end CHARACTERISTIC
/begin CHARACTERISTIC K_ED_TKA_OBD.DEC_VOR_EINTRAG "Filterverringerung vorm Fehlerspeichereintrag | EN: Fault code TKA_OBD - debounce filter decrement before fault-memory entry" VALUE 0x70DA3 TKW_VV_VV_UB 100.0 FORMULA_0003 0.0 255.0000 /end CHARACTERISTIC
/begin CHARACTERISTIC K_ED_SMG_SK_N.DEC_VOR_EINTRAG "Filterverringerung vorm Fehlerspeichereintrag | EN: Fault code SMG_SK_N - debounce filter decrement before fault-memory entry" VALUE 0x70EF5 TKW_VV_VV_UB 100.0 FORMULA_0003 0.0 255.0000 /end CHARACTERISTIC
/begin CHARACTERISTIC K_ED_TUMG_OBD.DEC_VOR_EINTRAG "Filterverringerung vorm Fehlerspeichereintrag | EN: Fault code TUMG_OBD - debounce filter decrement before fault-memory entry" VALUE 0x70F0F TKW_VV_VV_UB 100.0 FORMULA_0003 0.0 255.0000 /end CHARACTERISTIC
/begin CHARACTERISTIC K_ED_V_DIREKT.DEC_VOR_EINTRAG "Filterverringerung vorm Fehlerspeichereintrag | EN: Fault code V_DIREKT - debounce filter decrement before fault-memory entry" VALUE 0x70F29 TKW_VV_VV_UB 100.0 FORMULA_0003 0.0 255.0000 /end CHARACTERISTIC
/begin CHARACTERISTIC K_ED_TABG1.DEC_VOR_EINTRAG "Filterverringerung vorm Fehlerspeichereintrag | EN: Fault code TABG1 - debounce filter decrement before fault-memory entry" VALUE 0x7102D TKW_VV_VV_UB 100.0 FORMULA_0003 0.0 255.0000 /end CHARACTERISTIC
/begin CHARACTERISTIC K_ED_TABG2.DEC_VOR_EINTRAG "Filterverringerung vorm Fehlerspeichereintrag | EN: Fault code TABG2 - debounce filter decrement before fault-memory entry" VALUE 0x71047 TKW_VV_VV_UB 100.0 FORMULA_0003 0.0 255.0000 /end CHARACTERISTIC
/begin CHARACTERISTIC K_ED_TAN_OBD_B1.DEC_VOR_EINTRAG "Filterverringerung vorm Fehlerspeichereintrag | EN: Fault code TAN_OBD_B1 - debounce filter decrement before fault-memory entry" VALUE 0x71541 TKW_VV_VV_UB 100.0 FORMULA_0003 0.0 255.0000 /end CHARACTERISTIC
/begin CHARACTERISTIC K_ED_ZOELP1.DEC_VOR_EINTRAG "Filterverringerung vorm Fehlerspeichereintrag | EN: Fault code ZOELP1 - debounce filter decrement before fault-memory entry" VALUE 0x7158F TKW_VV_VV_UB 100.0 FORMULA_0003 0.0 255.0000 /end CHARACTERISTIC
/begin CHARACTERISTIC K_ED_ZOELP2.DEC_VOR_EINTRAG "Filterverringerung vorm Fehlerspeichereintrag | EN: Fault code ZOELP2 - debounce filter decrement before fault-memory entry" VALUE 0x715A9 TKW_VV_VV_UB 100.0 FORMULA_0003 0.0 255.0000 /end CHARACTERISTIC
/begin CHARACTERISTIC K_ED_THERMOSTAT.DEC_VOR_EINTRAG "Filterverringerung vorm Fehlerspeichereintrag | EN: Fault code THERMOSTAT - debounce filter decrement before fault-memory entry" VALUE 0x71645 TKW_VV_VV_UB 100.0 FORMULA_0003 0.0 255.0000 /end CHARACTERISTIC
/begin CHARACTERISTIC K_ED_TAN_OBD_B2.DEC_VOR_EINTRAG "Filterverringerung vorm Fehlerspeichereintrag | EN: Fault code TAN_OBD_B2 - debounce filter decrement before fault-memory entry" VALUE 0x7165F TKW_VV_VV_UB 100.0 FORMULA_0003 0.0 255.0000 /end CHARACTERISTIC
/begin CHARACTERISTIC K_ED_START_RL.DEC_VOR_EINTRAG "Filterverringerung vorm Fehlerspeichereintrag | EN: Fault code START_RL - debounce filter decrement before fault-memory entry" VALUE 0x716E1 TKW_VV_VV_UB 100.0 FORMULA_0003 0.0 255.0000 /end CHARACTERISTIC
/begin CHARACTERISTIC K_ED_TUMG.DEC_VOR_EINTRAG "Filterverringerung vorm Fehlerspeichereintrag | EN: Fault code TUMG - debounce filter decrement before fault-memory entry" VALUE 0x7172F TKW_VV_VV_UB 100.0 FORMULA_0003 0.0 255.0000 /end CHARACTERISTIC
/begin CHARACTERISTIC K_ED_TMOT_OBD_HIGH.DEC_VOR_EINTRAG "Filterverringerung vorm Fehlerspeichereintrag | EN: Fault code TMOT_OBD_HIGH - debounce filter decrement before fault-memory entry" VALUE 0x71763 TKW_VV_VV_UB 100.0 FORMULA_0003 0.0 255.0000 /end CHARACTERISTIC
/begin CHARACTERISTIC K_ED_TMOT.INC_NACH_EINTRAG "Filtererhoehung nach Fehlerspeichereintrag | EN: Fault code TMOT - debounce filter increment after fault-memory entry" VALUE 0x70C86 TKW_VV_VV_UB 100.0 FORMULA_0003 0.0 255.0000 /end CHARACTERISTIC
/begin CHARACTERISTIC K_ED_TMOT_OBD.INC_NACH_EINTRAG "Filtererhoehung nach Fehlerspeichereintrag | EN: Fault code TMOT_OBD - debounce filter increment after fault-memory entry" VALUE 0x70CA0 TKW_VV_VV_UB 100.0 FORMULA_0003 0.0 255.0000 /end CHARACTERISTIC
/begin CHARACTERISTIC K_ED_TAN1.INC_NACH_EINTRAG "Filtererhoehung nach Fehlerspeichereintrag | EN: Fault code TAN1 - debounce filter increment after fault-memory entry" VALUE 0x70CBA TKW_VV_VV_UB 100.0 FORMULA_0003 0.0 255.0000 /end CHARACTERISTIC
/begin CHARACTERISTIC K_ED_TAN2.INC_NACH_EINTRAG "Filtererhoehung nach Fehlerspeichereintrag | EN: Fault code TAN2 - debounce filter increment after fault-memory entry" VALUE 0x70CD4 TKW_VV_VV_UB 100.0 FORMULA_0003 0.0 255.0000 /end CHARACTERISTIC
/begin CHARACTERISTIC K_ED_TIME_REL_OBD.INC_NACH_EINTRAG "Filtererhoehung nach Fehlerspeichereintrag | EN: Fault code TIME_REL_OBD - debounce filter increment after fault-memory entry" VALUE 0x70CEE TKW_VV_VV_UB 100.0 FORMULA_0003 0.0 255.0000 /end CHARACTERISTIC
/begin CHARACTERISTIC K_ED_UB.INC_NACH_EINTRAG "Filtererhoehung nach Fehlerspeichereintrag | EN: Fault code UB - debounce filter increment after fault-memory entry" VALUE 0x70D08 TKW_VV_VV_UB 100.0 FORMULA_0003 0.0 255.0000 /end CHARACTERISTIC
/begin CHARACTERISTIC K_ED_TKA.INC_NACH_EINTRAG "Filtererhoehung nach Fehlerspeichereintrag | EN: Fault code TKA - debounce filter increment after fault-memory entry" VALUE 0x70D22 TKW_VV_VV_UB 100.0 FORMULA_0003 0.0 255.0000 /end CHARACTERISTIC
/begin CHARACTERISTIC K_ED_TDME.INC_NACH_EINTRAG "Filtererhoehung nach Fehlerspeichereintrag | EN: Fault code TDME - debounce filter increment after fault-memory entry" VALUE 0x70D3C TKW_VV_VV_UB 100.0 FORMULA_0003 0.0 255.0000 /end CHARACTERISTIC
/begin CHARACTERISTIC K_ED_UEXT_111219514.INC_NACH_EINTRAG "Filtererhoehung nach Fehlerspeichereintrag | EN: Fault code UEXT_111219514 - debounce filter increment after fault-memory entry" VALUE 0x70D56 TKW_VV_VV_UB 100.0 FORMULA_0003 0.0 255.0000 /end CHARACTERISTIC
/begin CHARACTERISTIC K_ED_UEXT_124_512.INC_NACH_EINTRAG "Filtererhoehung nach Fehlerspeichereintrag | EN: Fault code UEXT_124_512 - debounce filter increment after fault-memory entry" VALUE 0x70D70 TKW_VV_VV_UB 100.0 FORMULA_0003 0.0 255.0000 /end CHARACTERISTIC
/begin CHARACTERISTIC K_ED_TKA_OBD.INC_NACH_EINTRAG "Filtererhoehung nach Fehlerspeichereintrag | EN: Fault code TKA_OBD - debounce filter increment after fault-memory entry" VALUE 0x70DA4 TKW_VV_VV_UB 100.0 FORMULA_0003 0.0 255.0000 /end CHARACTERISTIC
/begin CHARACTERISTIC K_ED_SMG_SK.INC_NACH_EINTRAG "Filtererhoehung nach Fehlerspeichereintrag | EN: Fault code SMG_SK - debounce filter increment after fault-memory entry" VALUE 0x70EDC TKW_VV_VV_UB 100.0 FORMULA_0003 0.0 255.0000 /end CHARACTERISTIC
/begin CHARACTERISTIC K_ED_SMG_SK_N.INC_NACH_EINTRAG "Filtererhoehung nach Fehlerspeichereintrag | EN: Fault code SMG_SK_N - debounce filter increment after fault-memory entry" VALUE 0x70EF6 TKW_VV_VV_UB 100.0 FORMULA_0003 0.0 255.0000 /end CHARACTERISTIC
/begin CHARACTERISTIC K_ED_TUMG_OBD.INC_NACH_EINTRAG "Filtererhoehung nach Fehlerspeichereintrag | EN: Fault code TUMG_OBD - debounce filter increment after fault-memory entry" VALUE 0x70F10 TKW_VV_VV_UB 100.0 FORMULA_0003 0.0 255.0000 /end CHARACTERISTIC
/begin CHARACTERISTIC K_ED_V_DIREKT.INC_NACH_EINTRAG "Filtererhoehung nach Fehlerspeichereintrag | EN: Fault code V_DIREKT - debounce filter increment after fault-memory entry" VALUE 0x70F2A TKW_VV_VV_UB 100.0 FORMULA_0003 0.0 255.0000 /end CHARACTERISTIC
/begin CHARACTERISTIC K_ED_TABG1.INC_NACH_EINTRAG "Filtererhoehung nach Fehlerspeichereintrag | EN: Fault code TABG1 - debounce filter increment after fault-memory entry" VALUE 0x7102E TKW_VV_VV_UB 100.0 FORMULA_0003 0.0 255.0000 /end CHARACTERISTIC
/begin CHARACTERISTIC K_ED_TABG2.INC_NACH_EINTRAG "Filtererhoehung nach Fehlerspeichereintrag | EN: Fault code TABG2 - debounce filter increment after fault-memory entry" VALUE 0x71048 TKW_VV_VV_UB 100.0 FORMULA_0003 0.0 255.0000 /end CHARACTERISTIC
/begin CHARACTERISTIC K_ED_TAN_OBD_B1.INC_NACH_EINTRAG "Filtererhoehung nach Fehlerspeichereintrag | EN: Fault code TAN_OBD_B1 - debounce filter increment after fault-memory entry" VALUE 0x71542 TKW_VV_VV_UB 100.0 FORMULA_0003 0.0 255.0000 /end CHARACTERISTIC
/begin CHARACTERISTIC K_ED_ZOELP1.INC_NACH_EINTRAG "Filtererhoehung nach Fehlerspeichereintrag | EN: Fault code ZOELP1 - debounce filter increment after fault-memory entry" VALUE 0x71590 TKW_VV_VV_UB 100.0 FORMULA_0003 0.0 255.0000 /end CHARACTERISTIC
/begin CHARACTERISTIC K_ED_ZOELP2.INC_NACH_EINTRAG "Filtererhoehung nach Fehlerspeichereintrag | EN: Fault code ZOELP2 - debounce filter increment after fault-memory entry" VALUE 0x715AA TKW_VV_VV_UB 100.0 FORMULA_0003 0.0 255.0000 /end CHARACTERISTIC
/begin CHARACTERISTIC K_ED_THERMOSTAT.INC_NACH_EINTRAG "Filtererhoehung nach Fehlerspeichereintrag | EN: Fault code THERMOSTAT - debounce filter increment after fault-memory entry" VALUE 0x71646 TKW_VV_VV_UB 100.0 FORMULA_0003 0.0 255.0000 /end CHARACTERISTIC
/begin CHARACTERISTIC K_ED_TAN_OBD_B2.INC_NACH_EINTRAG "Filtererhoehung nach Fehlerspeichereintrag | EN: Fault code TAN_OBD_B2 - debounce filter increment after fault-memory entry" VALUE 0x71660 TKW_VV_VV_UB 100.0 FORMULA_0003 0.0 255.0000 /end CHARACTERISTIC
/begin CHARACTERISTIC K_ED_START_RL.INC_NACH_EINTRAG "Filtererhoehung nach Fehlerspeichereintrag | EN: Fault code START_RL - debounce filter increment after fault-memory entry" VALUE 0x716E2 TKW_VV_VV_UB 100.0 FORMULA_0003 0.0 255.0000 /end CHARACTERISTIC
/begin CHARACTERISTIC K_ED_TUMG.INC_NACH_EINTRAG "Filtererhoehung nach Fehlerspeichereintrag | EN: Fault code TUMG - debounce filter increment after fault-memory entry" VALUE 0x71730 TKW_VV_VV_UB 100.0 FORMULA_0003 0.0 255.0000 /end CHARACTERISTIC
/begin CHARACTERISTIC K_ED_TMOT_OBD_HIGH.INC_NACH_EINTRAG "Filtererhoehung nach Fehlerspeichereintrag | EN: Fault code TMOT_OBD_HIGH - debounce filter increment after fault-memory entry" VALUE 0x71764 TKW_VV_VV_UB 100.0 FORMULA_0003 0.0 255.0000 /end CHARACTERISTIC
/begin CHARACTERISTIC K_ED_TMOT.DEC_NACH_EINTRAG "Filterverringerung nach Fehlerspeichereintrag | EN: Fault code TMOT - debounce filter decrement after fault-memory entry" VALUE 0x70C87 TKW_VV_VV_UB 100.0 FORMULA_0003 0.0 255.0000 /end CHARACTERISTIC
/begin CHARACTERISTIC K_ED_TMOT_OBD.DEC_NACH_EINTRAG "Filterverringerung nach Fehlerspeichereintrag | EN: Fault code TMOT_OBD - debounce filter decrement after fault-memory entry" VALUE 0x70CA1 TKW_VV_VV_UB 100.0 FORMULA_0003 0.0 255.0000 /end CHARACTERISTIC
/begin CHARACTERISTIC K_ED_TAN1.DEC_NACH_EINTRAG "Filterverringerung nach Fehlerspeichereintrag | EN: Fault code TAN1 - debounce filter decrement after fault-memory entry" VALUE 0x70CBB TKW_VV_VV_UB 100.0 FORMULA_0003 0.0 255.0000 /end CHARACTERISTIC
/begin CHARACTERISTIC K_ED_TAN2.DEC_NACH_EINTRAG "Filterverringerung nach Fehlerspeichereintrag | EN: Fault code TAN2 - debounce filter decrement after fault-memory entry" VALUE 0x70CD5 TKW_VV_VV_UB 100.0 FORMULA_0003 0.0 255.0000 /end CHARACTERISTIC
/begin CHARACTERISTIC K_ED_TIME_REL_OBD.DEC_NACH_EINTRAG "Filterverringerung nach Fehlerspeichereintrag | EN: Fault code TIME_REL_OBD - debounce filter decrement after fault-memory entry" VALUE 0x70CEF TKW_VV_VV_UB 100.0 FORMULA_0003 0.0 255.0000 /end CHARACTERISTIC
/begin CHARACTERISTIC K_ED_UB.DEC_NACH_EINTRAG "Filterverringerung nach Fehlerspeichereintrag | EN: Fault code UB - debounce filter decrement after fault-memory entry" VALUE 0x70D09 TKW_VV_VV_UB 100.0 FORMULA_0003 0.0 255.0000 /end CHARACTERISTIC
/begin CHARACTERISTIC K_ED_TKA.DEC_NACH_EINTRAG "Filterverringerung nach Fehlerspeichereintrag | EN: Fault code TKA - debounce filter decrement after fault-memory entry" VALUE 0x70D23 TKW_VV_VV_UB 100.0 FORMULA_0003 0.0 255.0000 /end CHARACTERISTIC
/begin CHARACTERISTIC K_ED_TDME.DEC_NACH_EINTRAG "Filterverringerung nach Fehlerspeichereintrag | EN: Fault code TDME - debounce filter decrement after fault-memory entry" VALUE 0x70D3D TKW_VV_VV_UB 100.0 FORMULA_0003 0.0 255.0000 /end CHARACTERISTIC
/begin CHARACTERISTIC K_ED_UEXT_111219514.DEC_NACH_EINTRAG "Filterverringerung nach Fehlerspeichereintrag | EN: Fault code UEXT_111219514 - debounce filter decrement after fault-memory entry" VALUE 0x70D57 TKW_VV_VV_UB 100.0 FORMULA_0003 0.0 255.0000 /end CHARACTERISTIC
/begin CHARACTERISTIC K_ED_UEXT_124_512.DEC_NACH_EINTRAG "Filterverringerung nach Fehlerspeichereintrag | EN: Fault code UEXT_124_512 - debounce filter decrement after fault-memory entry" VALUE 0x70D71 TKW_VV_VV_UB 100.0 FORMULA_0003 0.0 255.0000 /end CHARACTERISTIC
/begin CHARACTERISTIC K_ED_TKA_OBD.DEC_NACH_EINTRAG "Filterverringerung nach Fehlerspeichereintrag | EN: Fault code TKA_OBD - debounce filter decrement after fault-memory entry" VALUE 0x70DA5 TKW_VV_VV_UB 100.0 FORMULA_0003 0.0 255.0000 /end CHARACTERISTIC
/begin CHARACTERISTIC K_ED_SMG_SK_N.DEC_NACH_EINTRAG "Filterverringerung nach Fehlerspeichereintrag | EN: Fault code SMG_SK_N - debounce filter decrement after fault-memory entry" VALUE 0x70EF7 TKW_VV_VV_UB 100.0 FORMULA_0003 0.0 255.0000 /end CHARACTERISTIC
/begin CHARACTERISTIC K_ED_TUMG_OBD.DEC_NACH_EINTRAG "Filterverringerung nach Fehlerspeichereintrag | EN: Fault code TUMG_OBD - debounce filter decrement after fault-memory entry" VALUE 0x70F11 TKW_VV_VV_UB 100.0 FORMULA_0003 0.0 255.0000 /end CHARACTERISTIC
/begin CHARACTERISTIC K_ED_V_DIREKT.DEC_NACH_EINTRAG "Filterverringerung nach Fehlerspeichereintrag | EN: Fault code V_DIREKT - debounce filter decrement after fault-memory entry" VALUE 0x70F2B TKW_VV_VV_UB 100.0 FORMULA_0003 0.0 255.0000 /end CHARACTERISTIC
/begin CHARACTERISTIC K_ED_TABG1.DEC_NACH_EINTRAG "Filterverringerung nach Fehlerspeichereintrag | EN: Fault code TABG1 - debounce filter decrement after fault-memory entry" VALUE 0x7102F TKW_VV_VV_UB 100.0 FORMULA_0003 0.0 255.0000 /end CHARACTERISTIC
/begin CHARACTERISTIC K_ED_TABG2.DEC_NACH_EINTRAG "Filterverringerung nach Fehlerspeichereintrag | EN: Fault code TABG2 - debounce filter decrement after fault-memory entry" VALUE 0x71049 TKW_VV_VV_UB 100.0 FORMULA_0003 0.0 255.0000 /end CHARACTERISTIC
/begin CHARACTERISTIC K_ED_TAN_OBD_B1.DEC_NACH_EINTRAG "Filterverringerung nach Fehlerspeichereintrag | EN: Fault code TAN_OBD_B1 - debounce filter decrement after fault-memory entry" VALUE 0x71543 TKW_VV_VV_UB 100.0 FORMULA_0003 0.0 255.0000 /end CHARACTERISTIC
/begin CHARACTERISTIC K_ED_ZOELP1.DEC_NACH_EINTRAG "Filterverringerung nach Fehlerspeichereintrag | EN: Fault code ZOELP1 - debounce filter decrement after fault-memory entry" VALUE 0x71591 TKW_VV_VV_UB 100.0 FORMULA_0003 0.0 255.0000 /end CHARACTERISTIC
/begin CHARACTERISTIC K_ED_ZOELP2.DEC_NACH_EINTRAG "Filterverringerung nach Fehlerspeichereintrag | EN: Fault code ZOELP2 - debounce filter decrement after fault-memory entry" VALUE 0x715AB TKW_VV_VV_UB 100.0 FORMULA_0003 0.0 255.0000 /end CHARACTERISTIC
/begin CHARACTERISTIC K_ED_THERMOSTAT.DEC_NACH_EINTRAG "Filterverringerung nach Fehlerspeichereintrag | EN: Fault code THERMOSTAT - debounce filter decrement after fault-memory entry" VALUE 0x71647 TKW_VV_VV_UB 100.0 FORMULA_0003 0.0 255.0000 /end CHARACTERISTIC
/begin CHARACTERISTIC K_ED_TAN_OBD_B2.DEC_NACH_EINTRAG "Filterverringerung nach Fehlerspeichereintrag | EN: Fault code TAN_OBD_B2 - debounce filter decrement after fault-memory entry" VALUE 0x71661 TKW_VV_VV_UB 100.0 FORMULA_0003 0.0 255.0000 /end CHARACTERISTIC
/begin CHARACTERISTIC K_ED_START_RL.DEC_NACH_EINTRAG "Filterverringerung nach Fehlerspeichereintrag | EN: Fault code START_RL - debounce filter decrement after fault-memory entry" VALUE 0x716E3 TKW_VV_VV_UB 100.0 FORMULA_0003 0.0 255.0000 /end CHARACTERISTIC
/begin CHARACTERISTIC K_ED_TUMG.DEC_NACH_EINTRAG "Filterverringerung nach Fehlerspeichereintrag | EN: Fault code TUMG - debounce filter decrement after fault-memory entry" VALUE 0x71731 TKW_VV_VV_UB 100.0 FORMULA_0003 0.0 255.0000 /end CHARACTERISTIC
/begin CHARACTERISTIC K_ED_TMOT_OBD_HIGH.DEC_NACH_EINTRAG "Filterverringerung nach Fehlerspeichereintrag | EN: Fault code TMOT_OBD_HIGH - debounce filter decrement after fault-memory entry" VALUE 0x71765 TKW_VV_VV_UB 100.0 FORMULA_0003 0.0 255.0000 /end CHARACTERISTIC
/begin CHARACTERISTIC K_ED_TMOT.KLASSENINDEX "Auswahl der Fehlerklasse | EN: Fault code TMOT - fault class selection (lamp / warning behaviour)" VALUE 0x70C88 TKW_VV_VV_UB 100.0 FORMULA_0003 0.0 8.0000 /end CHARACTERISTIC
/begin CHARACTERISTIC K_ED_TMOT_OBD.KLASSENINDEX "Auswahl der Fehlerklasse | EN: Fault code TMOT_OBD - fault class selection (lamp / warning behaviour)" VALUE 0x70CA2 TKW_VV_VV_UB 100.0 FORMULA_0003 0.0 8.0000 /end CHARACTERISTIC
/begin CHARACTERISTIC K_ED_TAN1.KLASSENINDEX "Auswahl der Fehlerklasse | EN: Fault code TAN1 - fault class selection (lamp / warning behaviour)" VALUE 0x70CBC TKW_VV_VV_UB 100.0 FORMULA_0003 0.0 8.0000 /end CHARACTERISTIC
/begin CHARACTERISTIC K_ED_TAN2.KLASSENINDEX "Auswahl der Fehlerklasse | EN: Fault code TAN2 - fault class selection (lamp / warning behaviour)" VALUE 0x70CD6 TKW_VV_VV_UB 100.0 FORMULA_0003 0.0 8.0000 /end CHARACTERISTIC
/begin CHARACTERISTIC K_ED_TIME_REL_OBD.KLASSENINDEX "Auswahl der Fehlerklasse | EN: Fault code TIME_REL_OBD - fault class selection (lamp / warning behaviour)" VALUE 0x70CF0 TKW_VV_VV_UB 100.0 FORMULA_0003 0.0 8.0000 /end CHARACTERISTIC
/begin CHARACTERISTIC K_ED_UB.KLASSENINDEX "Auswahl der Fehlerklasse | EN: Fault code UB - fault class selection (lamp / warning behaviour)" VALUE 0x70D0A TKW_VV_VV_UB 100.0 FORMULA_0003 0.0 8.0000 /end CHARACTERISTIC
/begin CHARACTERISTIC K_ED_TKA.KLASSENINDEX "Auswahl der Fehlerklasse | EN: Fault code TKA - fault class selection (lamp / warning behaviour)" VALUE 0x70D24 TKW_VV_VV_UB 100.0 FORMULA_0003 0.0 8.0000 /end CHARACTERISTIC
/begin CHARACTERISTIC K_ED_TDME.KLASSENINDEX "Auswahl der Fehlerklasse | EN: Fault code TDME - fault class selection (lamp / warning behaviour)" VALUE 0x70D3E TKW_VV_VV_UB 100.0 FORMULA_0003 0.0 8.0000 /end CHARACTERISTIC
/begin CHARACTERISTIC K_ED_UEXT_111219514.KLASSENINDEX "Auswahl der Fehlerklasse | EN: Fault code UEXT_111219514 - fault class selection (lamp / warning behaviour)" VALUE 0x70D58 TKW_VV_VV_UB 100.0 FORMULA_0003 0.0 8.0000 /end CHARACTERISTIC
/begin CHARACTERISTIC K_ED_UEXT_124_512.KLASSENINDEX "Auswahl der Fehlerklasse | EN: Fault code UEXT_124_512 - fault class selection (lamp / warning behaviour)" VALUE 0x70D72 TKW_VV_VV_UB 100.0 FORMULA_0003 0.0 8.0000 /end CHARACTERISTIC
/begin CHARACTERISTIC K_ED_TKA_OBD.KLASSENINDEX "Auswahl der Fehlerklasse | EN: Fault code TKA_OBD - fault class selection (lamp / warning behaviour)" VALUE 0x70DA6 TKW_VV_VV_UB 100.0 FORMULA_0003 0.0 8.0000 /end CHARACTERISTIC
/begin CHARACTERISTIC K_ED_SMG_SK.KLASSENINDEX "Auswahl der Fehlerklasse | EN: Fault code SMG_SK - fault class selection (lamp / warning behaviour)" VALUE 0x70EDE TKW_VV_VV_UB 100.0 FORMULA_0003 0.0 8.0000 /end CHARACTERISTIC
/begin CHARACTERISTIC K_ED_SMG_SK_N.KLASSENINDEX "Auswahl der Fehlerklasse | EN: Fault code SMG_SK_N - fault class selection (lamp / warning behaviour)" VALUE 0x70EF8 TKW_VV_VV_UB 100.0 FORMULA_0003 0.0 8.0000 /end CHARACTERISTIC
/begin CHARACTERISTIC K_ED_TUMG_OBD.KLASSENINDEX "Auswahl der Fehlerklasse | EN: Fault code TUMG_OBD - fault class selection (lamp / warning behaviour)" VALUE 0x70F12 TKW_VV_VV_UB 100.0 FORMULA_0003 0.0 8.0000 /end CHARACTERISTIC
/begin CHARACTERISTIC K_ED_V_DIREKT.KLASSENINDEX "Auswahl der Fehlerklasse | EN: Fault code V_DIREKT - fault class selection (lamp / warning behaviour)" VALUE 0x70F2C TKW_VV_VV_UB 100.0 FORMULA_0003 0.0 8.0000 /end CHARACTERISTIC
/begin CHARACTERISTIC K_ED_TABG1.KLASSENINDEX "Auswahl der Fehlerklasse | EN: Fault code TABG1 - fault class selection (lamp / warning behaviour)" VALUE 0x71030 TKW_VV_VV_UB 100.0 FORMULA_0003 0.0 8.0000 /end CHARACTERISTIC
/begin CHARACTERISTIC K_ED_TABG2.KLASSENINDEX "Auswahl der Fehlerklasse | EN: Fault code TABG2 - fault class selection (lamp / warning behaviour)" VALUE 0x7104A TKW_VV_VV_UB 100.0 FORMULA_0003 0.0 8.0000 /end CHARACTERISTIC
/begin CHARACTERISTIC K_ED_TAN_OBD_B1.KLASSENINDEX "Auswahl der Fehlerklasse | EN: Fault code TAN_OBD_B1 - fault class selection (lamp / warning behaviour)" VALUE 0x71544 TKW_VV_VV_UB 100.0 FORMULA_0003 0.0 8.0000 /end CHARACTERISTIC
/begin CHARACTERISTIC K_ED_ZOELP1.KLASSENINDEX "Auswahl der Fehlerklasse | EN: Fault code ZOELP1 - fault class selection (lamp / warning behaviour)" VALUE 0x71592 TKW_VV_VV_UB 100.0 FORMULA_0003 0.0 8.0000 /end CHARACTERISTIC
/begin CHARACTERISTIC K_ED_ZOELP2.KLASSENINDEX "Auswahl der Fehlerklasse | EN: Fault code ZOELP2 - fault class selection (lamp / warning behaviour)" VALUE 0x715AC TKW_VV_VV_UB 100.0 FORMULA_0003 0.0 8.0000 /end CHARACTERISTIC
/begin CHARACTERISTIC K_ED_THERMOSTAT.KLASSENINDEX "Auswahl der Fehlerklasse | EN: Fault code THERMOSTAT - fault class selection (lamp / warning behaviour)" VALUE 0x71648 TKW_VV_VV_UB 100.0 FORMULA_0003 0.0 8.0000 /end CHARACTERISTIC
/begin CHARACTERISTIC K_ED_TAN_OBD_B2.KLASSENINDEX "Auswahl der Fehlerklasse | EN: Fault code TAN_OBD_B2 - fault class selection (lamp / warning behaviour)" VALUE 0x71662 TKW_VV_VV_UB 100.0 FORMULA_0003 0.0 8.0000 /end CHARACTERISTIC
/begin CHARACTERISTIC K_ED_START_RL.KLASSENINDEX "Auswahl der Fehlerklasse | EN: Fault code START_RL - fault class selection (lamp / warning behaviour)" VALUE 0x716E4 TKW_VV_VV_UB 100.0 FORMULA_0003 0.0 8.0000 /end CHARACTERISTIC
/begin CHARACTERISTIC K_ED_TUMG.KLASSENINDEX "Auswahl der Fehlerklasse | EN: Fault code TUMG - fault class selection (lamp / warning behaviour)" VALUE 0x71732 TKW_VV_VV_UB 100.0 FORMULA_0003 0.0 8.0000 /end CHARACTERISTIC
/begin CHARACTERISTIC K_ED_TMOT_OBD_HIGH.KLASSENINDEX "Auswahl der Fehlerklasse | EN: Fault code TMOT_OBD_HIGH - fault class selection (lamp / warning behaviour)" VALUE 0x71766 TKW_VV_VV_UB 100.0 FORMULA_0003 0.0 8.0000 /end CHARACTERISTIC
/* ------------------ Abschnitt erzeugt aus fgr.dat ------------------ */
/begin CHARACTERISTIC K_FGR_EIN "FGR Einschalten 1: Ein, 0: Aus " VALUE 0x72964 TKW_VV_VV_UB 100.0 FORMULA_0327 0.0 1.0 /end CHARACTERISTIC
/begin CHARACTERISTIC K_FGR_FSP_EIN "FGR Fehlerspeicher Einschalten 1: Ein, 0: Aus  | EN: 0x0 Aus 0x1 Ein FGR Fehlerspeicher Einschalten 1: Ein, 0: Aus" VALUE 0x72965 TKW_VV_VV_UB 100.0 FORMULA_0327 0.0 1.0 /end CHARACTERISTIC
/begin CHARACTERISTIC K_FGR_STATE_AG "FGR STATE AG 1: Ein, 0: Aus  | EN: FGR STATE AG 1: Ein, 0: Aus 0x0 Aus 0x1 Ein" VALUE 0x72966 TKW_VV_VV_UB 100.0 FORMULA_0327 0.0 1.0 /end CHARACTERISTIC
/begin CHARACTERISTIC K_FGR_CFG_VORST "FGR Vorsteuerung 1: Ein, 0: Aus  | EN: 0x0 Aus 0x1 Ein FGR Vorsteuerung 1: Ein, 0: Aus" VALUE 0x72967 TKW_VV_VV_UB 100.0 FORMULA_0327 0.0 1.0 /end CHARACTERISTIC
/begin CHARACTERISTIC K_FGR_SMG_MCS "FGR Abschaltung durch SMG sperren | EN: 0x0 nicht sperren 0x1 sperren FGR Abschaltung durch SMG sperren" VALUE 0x72968 TKW_VV_VV_UB 100.0 FORMULA_0660 0.0 1.0 /end CHARACTERISTIC
/begin CHARACTERISTIC K_FGR_MARKE_CFG "Konfig Markenanzeige w�hrend Beschleunigung" VALUE 0x72969 TKW_VV_VV_UB 100.0 FORMULA_0661 0.0 1.0 /end CHARACTERISTIC
/begin CHARACTERISTIC K_FGR_CFG_V_MAX "Konfig FGR bis Vmax" VALUE 0x7296A TKW_VV_VV_UB 100.0 FORMULA_0662 0.0 1.0 /end CHARACTERISTIC
/begin CHARACTERISTIC K_FGR_MSW_T_MIN "Wartezeit f�r langes Dr�cken | EN: Wartezeit für langes Drücken" VALUE 0x7296B TKW_VV_VV_UB 100.0 FORMULA_0317 0.0 2.5500 /end CHARACTERISTIC
/begin CHARACTERISTIC K_FGR_TIP_T_MIN "Wartezeit f�r Entprellung Tipp | EN: Wartezeit für Entprellung Tipp" VALUE 0x7296C TKW_VV_VV_UB 100.0 FORMULA_0317 0.0 2.5500 /end CHARACTERISTIC
/begin CHARACTERISTIC K_FGR_STEP_T_MIN "Wartezeit f�r wiederholte Markenspr�nge | EN: Wartezeit für wiederholte Markensprünge" VALUE 0x7296D TKW_VV_VV_UB 100.0 FORMULA_0317 0.0 2.5500 /end CHARACTERISTIC
/begin CHARACTERISTIC K_FGR_T_AUS "Wartezeit bis Erkennung HUD aus | EN: Wait time until HUD-off is detected [s]" VALUE 0x7296E TKW_VV_VV_UB 100.0 FORMULA_0317 0.0 2.5500 /end CHARACTERISTIC
/begin CHARACTERISTIC K_FGR_V_DIF_MAX "Max Schwelle der Soll/Ist Regelabweichung | EN: Maximum threshold of setpoint/actual control error [km/h]" VALUE 0x72970 TKW_VV_VV_SW 100.0 FORMULA_0078 -360.0000 360.0000 FORMAT "%4.1" /end CHARACTERISTIC
/begin CHARACTERISTIC K_FGR_V_DIF_MIN "Min Schwelle der Soll/Ist Regelabweichung | EN: Minimum threshold of setpoint/actual control error [km/h]" VALUE 0x72972 TKW_VV_VV_SW 100.0 FORMULA_0078 -360.0000 360.0000 FORMAT "%4.1" /end CHARACTERISTIC
/begin CHARACTERISTIC K_FGR_T_UEBERHOL_MAX "Max Zeit bei �bertreten des FGR Eingriffs | EN: Maximum time when driver overrides cruise control [s]" VALUE 0x72974 TKW_VV_VV_UW 100.0 FORMULA_0021 0.0 655.0000 FORMAT "%5.2" /end CHARACTERISTIC
/begin CHARACTERISTIC K_FGR_T_STRICH "Zeit f�r HUD Anzeige Strich | EN: Time for HUD dash display [s]" VALUE 0x72976 TKW_VV_VV_UW 100.0 FORMULA_0021 0.0 655.0000 FORMAT "%5.2" /end CHARACTERISTIC
/begin CHARACTERISTIC K_FGR_T_CONSTF_RAMPE "Max Zeit bei �bertreten des FGR Eingriffs | EN: Maximum time when driver overrides cruise control [s]" VALUE 0x72978 TKW_VV_VV_UW 100.0 FORMULA_0021 0.0 655.0000 FORMAT "%5.2" /end CHARACTERISTIC
/begin CHARACTERISTIC K_FGR_V_SOLL_DIF_MAX "Max. Abweichung von Zielgeschw. bei �bertreten | EN: Maximum deviation from target speed when overridden [km/h]" VALUE 0x7297A TKW_VV_VV_SW 100.0 FORMULA_0078 -360.0000 360.0000 FORMAT "%4.1" /end CHARACTERISTIC
/begin CHARACTERISTIC K_FGR_V_SOLL_DIF_MIN "Min. Abweichung von Zielgeschw. bei �bertreten | EN: Minimum deviation from target speed when overridden [km/h]" VALUE 0x7297C TKW_VV_VV_SW 100.0 FORMULA_0078 -360.0000 360.0000 FORMAT "%4.1" /end CHARACTERISTIC
/begin CHARACTERISTIC K_FGR_V_SOLL_DIF_KONST "Konstante Abweichung von Zielgeschw. bei �bertreten | EN: Constant deviation from target speed when overridden [km/h]" VALUE 0x7297E TKW_VV_VV_SW 100.0 FORMULA_0078 -360.0000 360.0000 FORMAT "%4.1" /end CHARACTERISTIC
/begin CHARACTERISTIC K_FGR_V_SOLL_OFFSET "Konstante Abweichung vom Kombi | EN: Constant deviation from instrument cluster [km/h]" VALUE 0x72980 TKW_VV_VV_SB 100.0 FORMULA_0663 -5.0000 5.0000 /end CHARACTERISTIC
/begin CHARACTERISTIC K_FGR_V_SOLL_MAX_T "Max. Zeitdauer �ber max. Sollgeschwindigkeit | EN: Maximum time above maximum set speed [s]" VALUE 0x72982 TKW_VV_VV_UW 100.0 FORMULA_0021 0.0 655.0000 FORMAT "%5.2" /end CHARACTERISTIC
/begin CHARACTERISTIC K_FGR_DSC_MD_T "Max Zeitdauer eines DSC Momenteneingriff | EN: Maximum duration of a DSC torque intervention [s]" VALUE 0x72984 TKW_VV_VV_UW 100.0 FORMULA_0021 0.0 655.0000 FORMAT "%5.2" /end CHARACTERISTIC
/begin CHARACTERISTIC K_FGR_DSC_MD_BLS_T "Max Zeitdauer eines DSC Bremseneingriff | EN: Maximum duration of a DSC brake intervention [s]" VALUE 0x72986 TKW_VV_VV_UW 100.0 FORMULA_0021 0.0 655.0000 FORMAT "%5.2" /end CHARACTERISTIC
/begin CHARACTERISTIC K_FGR_DSC_BLS_T "Max Zeitdauer eines kombinierten DSC-Eingriffs | EN: Maximum duration of a combined DSC intervention [s]" VALUE 0x72988 TKW_VV_VV_UW 100.0 FORMULA_0021 0.0 655.0000 FORMAT "%5.2" /end CHARACTERISTIC
/begin CHARACTERISTIC K_FGR_V_IST_MIN "Min. Fahrzeuggeschwindigkeit | EN: Minimum vehicle speed [km/h]" VALUE 0x7298A TKW_VV_VV_SW 100.0 FORMULA_0078 -360.0000 360.0000 FORMAT "%4.1" /end CHARACTERISTIC
/begin CHARACTERISTIC K_FGR_V_TIP_INC_DEC "Tipp Fahrzeuggeschwindigkeit inc/dec | EN: Tip vehicle speed inc/dec [km/h]" VALUE 0x7298C TKW_VV_VV_SW 100.0 FORMULA_0078 -80.0000 360.0000 FORMAT "%4.1" /end CHARACTERISTIC
/begin CHARACTERISTIC K_FGR_V_SOLL_MAX_KMH "Max. Ziel-/Sollgeschwindigkeit in km/h | EN: Maximum target/set speed in km/h [km/h]" VALUE 0x7298E TKW_VV_VV_SW 100.0 FORMULA_0078 -360.0000 360.0000 FORMAT "%4.1" /end CHARACTERISTIC
/begin CHARACTERISTIC K_FGR_V_SOLL_MIN_KMH "Min. Ziel-/Sollgeschwindigkeit in km/h | EN: Minimum target/set speed in km/h [km/h]" VALUE 0x72990 TKW_VV_VV_SW 100.0 FORMULA_0078 -360.0000 360.0000 FORMAT "%4.1" /end CHARACTERISTIC
/begin CHARACTERISTIC K_FGR_V_SOLL_MAX_MPH "Max. Ziel-/Sollgeschwindigkeit in mph | EN: Maximum target/set speed in mph [mph]" VALUE 0x72992 TKW_VV_VV_SW 100.0 FORMULA_0664 -360.0000 360.0000 FORMAT "%4.1" /end CHARACTERISTIC
/begin CHARACTERISTIC K_FGR_V_SOLL_MIN_MPH "Min. Ziel-/Sollgeschwindigkeit in mph | EN: Minimum target/set speed in mph [mph]" VALUE 0x72994 TKW_VV_VV_SW 100.0 FORMULA_0664 -360.0000 360.0000 FORMAT "%4.1" /end CHARACTERISTIC
/begin CHARACTERISTIC K_FGR_V_DIF_MAX_AUFST "Max. Regelabweichung bevor Rampe wartet | EN: Max. Regelabweichung bevor Rampe wartet" VALUE 0x72996 TKW_VV_VV_SW 100.0 FORMULA_0078 -80.0000 360.0000 FORMAT "%4.1" /end CHARACTERISTIC
/begin CHARACTERISTIC K_FGR_V_DIF_MIN_AUFST "Min. Regelabweichung bevor Rampe wartet | EN: Min. Regelabweichung bevor Rampe wartet" VALUE 0x72998 TKW_VV_VV_SW 100.0 FORMULA_0078 -360.0000 360.0000 FORMAT "%4.1" /end CHARACTERISTIC
/begin CHARACTERISTIC K_FGR_FAK_V_MAX "Schwelle oberer Bereich | EN: Threshold, upper range [km/h]" VALUE 0x7299A TKW_VV_VV_SW 100.0 FORMULA_0078 -80.0000 360.0000 FORMAT "%4.1" /end CHARACTERISTIC
/begin CHARACTERISTIC K_FGR_FAK_V_MIN "Schwelle unterer Bereich | EN: Schwelle unterer Bereich" VALUE 0x7299C TKW_VV_VV_SW 100.0 FORMULA_0078 -80.0000 360.0000 FORMAT "%4.1" /end CHARACTERISTIC
/begin CHARACTERISTIC K_FGR_V_DIF_MIN_LL "Min. Reglerabweichung zur Ausl�sung SA | EN: Min. Reglerabweichung zur Auslösung SA" VALUE 0x7299E TKW_VV_VV_SW 100.0 FORMULA_0078 -360.0000 360.0000 FORMAT "%4.1" /end CHARACTERISTIC
/begin CHARACTERISTIC K_FGR_V_DIF_MAX_LL "Max. Reglerabweichung zur Ausl�sung SA | EN: Max. Reglerabweichung zur Auslösung SA" VALUE 0x729A0 TKW_VV_VV_SW 100.0 FORMULA_0078 -360.0000 360.0000 FORMAT "%4.1" /end CHARACTERISTIC
/begin CHARACTERISTIC K_FGR_FAK_V_SPORT "Wichtung Bereich Sport | EN: Wichtung Bereich Sport" VALUE 0x729A2 TKW_VV_VV_UB 100.0 FORMULA_0502 0.0 1.0000 /end CHARACTERISTIC
/begin CHARACTERISTIC K_FGR_FAK_V_NORMAL "Wichtung Bereich Normal | EN: Wichtung Bereich Normal" VALUE 0x729A3 TKW_VV_VV_UB 100.0 FORMULA_0502 0.0 1.0000 /end CHARACTERISTIC
/begin CHARACTERISTIC K_FGR_FAK_V_KOMFORT "Wichtung Bereich Komfort | EN: Wichtung Bereich Komfort" VALUE 0x729A4 TKW_VV_VV_UB 100.0 FORMULA_0502 0.0 1.0000 /end CHARACTERISTIC
/begin CHARACTERISTIC K_FGR_FAK_V_TIP "Wichtung Tippen | EN: Wichtung Tippen" VALUE 0x729A5 TKW_VV_VV_UB 100.0 FORMULA_0665 0.0 2.5500 /end CHARACTERISTIC
/begin CHARACTERISTIC K_FGR_AX_MAX "Max. Fahrzeugl�ngsbeschleunigung" VALUE 0x729A6 TKW_VV_VV_SW 100.0 FORMULA_0132 -20.0000 20.0000 FORMAT "%5.2" /end CHARACTERISTIC
/begin CHARACTERISTIC K_FGR_V_MAX "Vmax. Begrenzung | EN: Maximum speed limit [km/h]" VALUE 0x729A8 TKW_VV_VV_SW 100.0 FORMULA_0078 -80.0000 360.0000 FORMAT "%4.1" /end CHARACTERISTIC
/begin CHARACTERISTIC K_FGR_N_DIF_MAX "N Dif. max Begrenzung | EN: N Dif. max Begrenzung" VALUE 0x729AA TKW_VV_VV_SW 100.0 FORMULA_0006 0.0 10000.0000 /end CHARACTERISTIC
/begin CHARACTERISTIC K_FGR_N_DIF_DIAG_T "Max Zeitdauer eines DSC Bremseneingriff | EN: Max Zeitdauer eines DSC Bremseneingriff" VALUE 0x729AC TKW_VV_VV_UW 100.0 FORMULA_0021 0.0 655.0000 FORMAT "%5.2" /end CHARACTERISTIC
/begin CHARACTERISTIC K_FGR_V_SOLL_MAX_HYS "Vmax. Hysterese | EN: Maximum speed hysteresis [km/h]" VALUE 0x729AE TKW_VV_VV_SW 100.0 FORMULA_0078 -80.0000 360.0000 FORMAT "%4.1" /end CHARACTERISTIC
/begin CHARACTERISTIC K_FGR_N_MAX "Nmax. Begrenzung | EN: Maximum engine-speed limit [Upm]" VALUE 0x729B0 TKW_VV_VV_SW 100.0 FORMULA_0006 0.0 10000.0000 /end CHARACTERISTIC
/begin CHARACTERISTIC K_FGR_BESCHL_WA_SPORT "Sollbeschl. bei Wiederaufn. im Sportmodus | EN: Target acceleration on resume, Sport mode [m/(s*s)]" VALUE 0x729B2 TKW_VV_VV_SW 100.0 FORMULA_0132 -20.0000 20.0000 FORMAT "%5.2" /end CHARACTERISTIC
/begin CHARACTERISTIC K_FGR_BESCHL_SPORT "Sollbeschl. im Sportmodus | EN: Target acceleration in Sport mode [m/(s*s)]" VALUE 0x729B4 TKW_VV_VV_SW 100.0 FORMULA_0132 -20.0000 20.0000 FORMAT "%5.2" /end CHARACTERISTIC
/begin CHARACTERISTIC K_FGR_BESCHL_WA_KOMFORT "Sollbeschl. bei Wiederaufn. im Komfortmodus | EN: Target acceleration on resume, Comfort mode [m/(s*s)]" VALUE 0x729B6 TKW_VV_VV_SW 100.0 FORMULA_0132 -20.0000 20.0000 FORMAT "%5.2" /end CHARACTERISTIC
/begin CHARACTERISTIC K_FGR_BESCHL_KOMFORT "Sollbeschl. im Komfortmodus | EN: Target acceleration in Comfort mode [m/(s*s)]" VALUE 0x729B8 TKW_VV_VV_SW 100.0 FORMULA_0132 -20.0000 20.0000 FORMAT "%5.2" /end CHARACTERISTIC
/begin CHARACTERISTIC K_FGR_BESCHL_WA_NORMAL "Sollbeschl. bei Wiederaufn. im Normalmodus | EN: Target acceleration on resume, Normal mode [m/(s*s)]" VALUE 0x729BA TKW_VV_VV_SW 100.0 FORMULA_0132 -20.0000 20.0000 FORMAT "%5.2" /end CHARACTERISTIC
/begin CHARACTERISTIC K_FGR_BESCHL_NORMAL "Sollbeschl. im Normalmodus | EN: Target acceleration in Normal mode [m/(s*s)]" VALUE 0x729BC TKW_VV_VV_SW 100.0 FORMULA_0132 -20.0000 20.0000 FORMAT "%5.2" /end CHARACTERISTIC
/begin CHARACTERISTIC K_FGR_BESCHL_TIP "Sollbeschl. bei Tipp | EN: Target acceleration on tip [m/(s*s)]" VALUE 0x729BE TKW_VV_VV_SW 100.0 FORMULA_0132 -20.0000 20.0000 FORMAT "%5.2" /end CHARACTERISTIC
/begin CHARACTERISTIC K_FGR_VERZ "Sollverz�gerung beim Verz�gern | EN: Target deceleration when decelerating [m/(s*s)]" VALUE 0x729C0 TKW_VV_VV_SW 100.0 FORMULA_0132 -20.0000 20.0000 FORMAT "%5.2" /end CHARACTERISTIC
/begin CHARACTERISTIC K_FGR_VERZ_TIP "Sollverz�gerung bei Tipp | EN: Target deceleration on tip [m/(s*s)]" VALUE 0x729C2 TKW_VV_VV_SW 100.0 FORMULA_0132 -20.0000 20.0000 FORMAT "%5.2" /end CHARACTERISTIC
/begin CHARACTERISTIC K_FGR_V_FEHLER_T "Haltezeit f�r Signalfehler vor Abschaltung | EN: Hold time for signal fault before switch-off [s]" VALUE 0x729C4 TKW_VV_VV_UB 100.0 FORMULA_0317 0.0 2.5500 /end CHARACTERISTIC
/begin CHARACTERISTIC K_FGR_V_IST_TAU "Filterkonstante f�r Umschaltung Istgeschw. | EN: Filter constant for switching actual speed source [s]" VALUE 0x729C6 TKW_VV_VV_UW 100.0 FORMULA_0021 0.0 655.0000 FORMAT "%5.2" /end CHARACTERISTIC
/begin CHARACTERISTIC K_FGR_CFG_V_IST "Auswahl V-Ist: Fahrzeuggeschw. oder Anzeigegeschw. " VALUE 0x729C8 TKW_VV_VV_UB 100.0 FORMULA_0666 0.0 1.0 /end CHARACTERISTIC
/begin CHARACTERISTIC K_FGR_AX_TAU "Filterkonstante Beschleunigung | EN: Filter constant, acceleration [s]" VALUE 0x729C9 TKW_VV_VV_UB 100.0 FORMULA_0462 0.0101 2.5600 /end CHARACTERISTIC
/begin CHARACTERISTIC K_FGR_MD_FW_LL_HYS "Hysterese Minimalschwelle  | EN: Hysteresis, minimum threshold [%]" VALUE 0x729CA TKW_VV_VV_SW 100.0 FORMULA_0022 -200.0000 200.0000 FORMAT "%5.2" /end CHARACTERISTIC
/begin CHARACTERISTIC K_FGR_MD_FW_HYS "Hysterese �berholerkennung  | EN: Hysteresis for overtaking detection [%]" VALUE 0x729CC TKW_VV_VV_SW 100.0 FORMULA_0022 -200.0000 200.0000 FORMAT "%5.2" /end CHARACTERISTIC
/begin CHARACTERISTIC K_FGR_MD_DELTA "�nderungsbegrenzung Reglereingriff | EN: Rate limit on controller intervention [%/sek]" VALUE 0x729CE TKW_VV_VV_UW 100.0 FORMULA_0667 0.0 400.0000 FORMAT "%7.4" /end CHARACTERISTIC
/begin CHARACTERISTIC K_FGR_A1 "Reglerkoeffizient a1 | EN: Controller coefficient a1" VALUE 0x729D0 TKW_VV_VV_UB 100.0 FORMULA_0668 0.0 10.0000 /end CHARACTERISTIC
/begin CHARACTERISTIC K_FGR_T_MIN_SA "min. Wartezeit vor SA bei Konstantfahrt | EN: Minimum wait time before switch-off during steady cruising [sek]" VALUE 0x729D2 TKW_VV_VV_UW 100.0 FORMULA_0669 0.0 60.0000 FORMAT "%5.2" /end CHARACTERISTIC
/begin CHARACTERISTIC K_FGR_V_DIF_MIN_UEBERHOL "Schwelle f�r Wegbeschleunigung  | EN: Threshold for pull-away acceleration [km/h]" VALUE 0x729D4 TKW_VV_VV_SW 100.0 FORMULA_0078 -360.0000 360.0000 FORMAT "%4.1" /end CHARACTERISTIC
/begin CHARACTERISTIC K_FGR_STUFE_MPH "Schrittweite Stufe in MPH  | EN: Step size in mph [mph]" VALUE 0x729D6 TKW_VV_VV_SW 100.0 FORMULA_0664 -360.0000 360.0000 FORMAT "%4.1" /end CHARACTERISTIC
/begin CHARACTERISTIC K_FGR_STUFE_KMH "Schrittweite Stufe in KM/H  | EN: Step size in km/h [km/h]" VALUE 0x729D8 TKW_VV_VV_SW 100.0 FORMULA_0078 -360.0000 360.0000 FORMAT "%4.1" /end CHARACTERISTIC
/begin CHARACTERISTIC K_FGR_V_DIAG "Max. Abweichung V_RAD_HR und V_DIREKT  | EN: Maximum deviation V_RAD_HR vs V_DIREKT [km/h]" VALUE 0x729DA TKW_VV_VV_SW 100.0 FORMULA_0078 -360.0000 360.0000 FORMAT "%4.1" /end CHARACTERISTIC
/begin CHARACTERISTIC K_FGR_V_DIAG_T "Wartezeit f�r V_RAD_HR/V_DIREKT Differenz Fehler | EN: Wait time for V_RAD_HR/V_DIREKT difference fault [s]" VALUE 0x729DC TKW_VV_VV_UB 100.0 FORMULA_0317 0.0 2.5500 /end CHARACTERISTIC
/begin CHARACTERISTIC K_FGR_VAHA_DIAG_T "Wartezeit f�r V_VORNE/V_HINTEN Differenz Fehler | EN: Wait time for front/rear speed difference fault [s]" VALUE 0x729DD TKW_VV_VV_UB 100.0 FORMULA_0317 0.0 2.5500 /end CHARACTERISTIC
/begin CHARACTERISTIC KL_FGR_VERZ_WA "Sollverz�gerung bei Wiederaufnahme | EN: Target deceleration on resume" CURVE 0x729DE TKL_SW_VV_SW 100.0 FORMULA_0132 -20.0000 20.0000 /begin AXIS_DESCR STD_AXIS n FORMULA_0006 4 0.0 10000.0000 /end AXIS_DESCR FORMAT "%5.2" /end CHARACTERISTIC
/begin CHARACTERISTIC KL_FGR_MD_RAMPE_DELTA "Schrittweite der Absteuerrampe | EN: Step size of the ramp-out" CURVE 0x729F0 TKL_SW_VV_UW 100.0 FORMULA_0667 0.0 4000.0000 /begin AXIS_DESCR STD_AXIS n FORMULA_0006 6 0.0 10000.0000 /end AXIS_DESCR FORMAT "%7.4" /end CHARACTERISTIC
/begin CHARACTERISTIC KL_FGR_FAK_V_TIP "Wichtungsfaktor V-Tipp | EN: Weighting factor, speed tip (+/-)" CURVE 0x72A0A TKL_SW_VV_UB 100.0 FORMULA_0654 0.0 1.0000 /begin AXIS_DESCR STD_AXIS v FORMULA_0078 6 -360.0000 360.0000 FORMAT "%4.1" /end AXIS_DESCR /end CHARACTERISTIC
/begin CHARACTERISTIC KL_FGR_FAK_T_WA "Zeitabh�nige Wichtungsfaktoren f�r Wiederaufnahme | EN: Time-dependent weighting factors for resume" CURVE 0x72A1E TKL_UB_VV_UB 100.0 FORMULA_0655 0.0 1.9921 /begin AXIS_DESCR STD_AXIS Zeit FORMULA_0670 6 0.0 1.9921 /end AXIS_DESCR /end CHARACTERISTIC
/begin CHARACTERISTIC KL_FGR_FAK_T_BESCHL "Zeitabh�nige Wichtungsfaktoren f�r Beschleunigung | EN: Time-dependent weighting factors for acceleration" CURVE 0x72A2C TKL_UB_VV_UB 100.0 FORMULA_0655 0.0 1.9921 /begin AXIS_DESCR STD_AXIS Zeit FORMULA_0670 6 0.0 1.9921 /end AXIS_DESCR /end CHARACTERISTIC
/begin CHARACTERISTIC KL_FGR_FAK_T_VERZ "Zeitabh�nige Wichtungsfaktoren f�r Verz�gerung | EN: Time-dependent weighting factors for deceleration" CURVE 0x72A3A TKL_UB_VV_UB 100.0 FORMULA_0655 0.0 1.9921 /begin AXIS_DESCR STD_AXIS Zeit FORMULA_0670 6 0.0 1.9921 /end AXIS_DESCR /end CHARACTERISTIC
/begin CHARACTERISTIC KL_FGR_KR_FAK "Wichtung Regelverst�rkung | EN: Weighting of controller gain" CURVE 0x72A48 TKL_SW_VV_UB 100.0 FORMULA_0671 0.0 25.5000 /begin AXIS_DESCR STD_AXIS v FORMULA_0078 6 -360.0000 360.0000 FORMAT "%4.1" /end AXIS_DESCR /end CHARACTERISTIC
/begin CHARACTERISTIC KL_FGR_TN_FAK "Wichtung Nachstellzeit | EN: Weighting of integral time" CURVE 0x72A5C TKL_SW_VV_UB 100.0 FORMULA_0671 0.0 25.5000 /begin AXIS_DESCR STD_AXIS v FORMULA_0078 6 -360.0000 360.0000 FORMAT "%4.1" /end AXIS_DESCR /end CHARACTERISTIC
/begin CHARACTERISTIC KL_FGR_TV_FAK "Wichtung Vorhaltezeit | EN: Weighting of derivative time" CURVE 0x72A70 TKL_SW_VV_UB 100.0 FORMULA_0671 0.0 25.5000 /begin AXIS_DESCR STD_AXIS v FORMULA_0078 6 -360.0000 360.0000 FORMAT "%4.1" /end AXIS_DESCR /end CHARACTERISTIC
/begin CHARACTERISTIC KL_FGR_MD_FW_LL "Minimalschwelle zur Vermeidung SA-Ausl�sung | EN: Minimum threshold to avoid cruise switch-off" CURVE 0x72A84 TKL_SW_VV_UB 100.0 FORMULA_0672 0.0 25.5000 /begin AXIS_DESCR STD_AXIS n FORMULA_0006 6 0.0 10000.0000 /end AXIS_DESCR /end CHARACTERISTIC
/begin CHARACTERISTIC KL_FGR_V_FIL_A1 "Filterkonstante A1 f�r V Filter | EN: Filter constant A1 for speed filter" CURVE 0x72A98 TKL_UW_VV_SW 100.0 FORMULA_0295 -2.0000 1.9999 /begin AXIS_DESCR STD_AXIS t FORMULA_0021 7 0.0 655.3500 FORMAT "%5.2" /end AXIS_DESCR FORMAT "%7.4" /end CHARACTERISTIC
/begin CHARACTERISTIC KL_FGR_V_FIL_B1 "Filterkonstante B1 f�r V Filter | EN: Filter constant B1 for speed filter" CURVE 0x72AB6 TKL_UW_VV_UW 100.0 FORMULA_0658 0.0 0.2499 /begin AXIS_DESCR STD_AXIS t FORMULA_0021 7 0.0 655.3500 FORMAT "%5.2" /end AXIS_DESCR FORMAT "%7.4" /end CHARACTERISTIC
/begin CHARACTERISTIC KL_FGR_V_FIL_B2 "Filterkonstante B2 f�r V Filter | EN: Filter constant B2 for speed filter" CURVE 0x72AD4 TKL_UW_VV_UW 100.0 FORMULA_0658 0.0 0.2499 /begin AXIS_DESCR STD_AXIS t FORMULA_0021 7 0.0 655.3500 FORMAT "%5.2" /end AXIS_DESCR FORMAT "%7.4" /end CHARACTERISTIC
/begin CHARACTERISTIC KL_FGR_KOEFF_WICHT "Regler Koeffizienten Wichtung | EN: Controller coefficient weighting" CURVE 0x72AF2 TKL_UW_VV_UW 100.0 FORMULA_0656 0.0 655.3500 /begin AXIS_DESCR STD_AXIS t FORMULA_0021 4 0.0 655.3500 FORMAT "%5.2" /end AXIS_DESCR FORMAT "%6.3" /end CHARACTERISTIC
/begin CHARACTERISTIC KL_FGR_VAHA_DIAG "Differenz Geschw. VA/HA  | EN: Speed difference front/rear axle" CURVE 0x72B04 TKL_SW_VV_SW 100.0 FORMULA_0078 0.0 360.0000 /begin AXIS_DESCR STD_AXIS v FORMULA_0078 4 -360.0000 360.0000 FORMAT "%4.1" /end AXIS_DESCR FORMAT "%4.1" /end CHARACTERISTIC
/begin CHARACTERISTIC KL_FGR_V_SA_SPERRE "Geschwindigkeitsgrenze f�r SA Sperre | EN: Speed limit for cruise switch-off lock" CURVE 0x72B16 TKL_SW_VV_SW 100.0 FORMULA_0078 -360.0000 360.0000 /begin AXIS_DESCR STD_AXIS gang FORMULA_0486 8 -1.0000 10.0000 /end AXIS_DESCR FORMAT "%4.1" /end CHARACTERISTIC
/begin CHARACTERISTIC KF_FGR_VORST "PID-Regler | EN: PID controller" MAP 0x72B38 TKF_SW_SW_UW 100.0 FORMULA_0450 0.0 100.0000
 /begin AXIS_DESCR STD_AXIS Geschwindigkeit FORMULA_0078 12 -360.0000 360.0000 FORMAT "%4.1" /end AXIS_DESCR
 /begin AXIS_DESCR STD_AXIS gang FORMULA_0486 8 -1.0000 10.0000 /end AXIS_DESCR
 FORMAT "%6.3" /end CHARACTERISTIC
/begin CHARACTERISTIC KF_FGR_VORST_UP "PID-Regler | EN: PID controller" MAP 0x72C22 TKF_SW_SW_UW 100.0 FORMULA_0450 0.0 100.0000
 /begin AXIS_DESCR STD_AXIS Geschwindigkeit FORMULA_0078 12 -360.0000 360.0000 FORMAT "%4.1" /end AXIS_DESCR
 /begin AXIS_DESCR STD_AXIS gang FORMULA_0486 8 -1.0000 10.0000 /end AXIS_DESCR
 FORMAT "%6.3" /end CHARACTERISTIC
/begin CHARACTERISTIC KF_FGR_KR "Reglerverst�rkung | EN: Controller gain" MAP 0x72D0C TKF_SW_SW_UW 100.0 FORMULA_0673 0.0 100.0000
 /begin AXIS_DESCR STD_AXIS Geschwindigkeit FORMULA_0078 12 -360.0000 360.0000 FORMAT "%4.1" /end AXIS_DESCR
 /begin AXIS_DESCR STD_AXIS gang FORMULA_0486 8 -1.0000 10.0000 /end AXIS_DESCR
 FORMAT "%6.3" /end CHARACTERISTIC
/begin CHARACTERISTIC KF_FGR_KR_CONST "Reglerverst�rkung Konstantfahrt | EN: Controller gain, steady cruising" MAP 0x72DF6 TKF_SW_SW_UW 100.0 FORMULA_0673 0.0 100.0000
 /begin AXIS_DESCR STD_AXIS Geschwindigkeit FORMULA_0078 12 -360.0000 360.0000 FORMAT "%4.1" /end AXIS_DESCR
 /begin AXIS_DESCR STD_AXIS gang FORMULA_0486 8 -1.0000 10.0000 /end AXIS_DESCR
 FORMAT "%6.3" /end CHARACTERISTIC
/begin CHARACTERISTIC KF_FGR_TN "Nachstellzeit | EN: Integral (reset) time" MAP 0x72EE0 TKF_SW_SW_UW 100.0 FORMULA_0674 0.0 60.0000
 /begin AXIS_DESCR STD_AXIS Geschwindigkeit FORMULA_0078 12 -360.0000 360.0000 FORMAT "%4.1" /end AXIS_DESCR
 /begin AXIS_DESCR STD_AXIS gang FORMULA_0486 8 -1.0000 10.0000 /end AXIS_DESCR
 FORMAT "%6.3" /end CHARACTERISTIC
/begin CHARACTERISTIC KF_FGR_TN_CONST "Nachstellzeit Konstantfahrt | EN: Integral time, steady cruising" MAP 0x72FCA TKF_SW_SW_UW 100.0 FORMULA_0674 0.0 60.0000
 /begin AXIS_DESCR STD_AXIS Geschwindigkeit FORMULA_0078 12 -360.0000 360.0000 FORMAT "%4.1" /end AXIS_DESCR
 /begin AXIS_DESCR STD_AXIS gang FORMULA_0486 8 -1.0000 10.0000 /end AXIS_DESCR
 FORMAT "%6.3" /end CHARACTERISTIC
/begin CHARACTERISTIC KF_FGR_TV "Vorhaltezeit | EN: Derivative time" MAP 0x730B4 TKF_SW_SW_UW 100.0 FORMULA_0674 0.0 60.0000
 /begin AXIS_DESCR STD_AXIS Geschwindigkeit FORMULA_0078 12 -360.0000 360.0000 FORMAT "%4.1" /end AXIS_DESCR
 /begin AXIS_DESCR STD_AXIS gang FORMULA_0486 8 -1.0000 10.0000 /end AXIS_DESCR
 FORMAT "%6.3" /end CHARACTERISTIC
/begin CHARACTERISTIC KF_FGR_TV_CONST "Vorhaltezeit Konstantfahrt | EN: Derivative time, steady cruising" MAP 0x7319E TKF_SW_SW_UW 100.0 FORMULA_0674 0.0 60.0000
 /begin AXIS_DESCR STD_AXIS Geschwindigkeit FORMULA_0078 12 -360.0000 360.0000 FORMAT "%4.1" /end AXIS_DESCR
 /begin AXIS_DESCR STD_AXIS gang FORMULA_0486 8 -1.0000 10.0000 /end AXIS_DESCR
 FORMAT "%6.3" /end CHARACTERISTIC
/begin CHARACTERISTIC KF_FGR_FAK_V_WA "Wichtungsfaktor V-Wiederaufnahme | EN: Weighting factor, speed on resume" MAP 0x73288 TKF_SW_SW_UB 100.0 FORMULA_0654 0.0 1.0000 /begin AXIS_DESCR STD_AXIS v FORMULA_0078 6 -360.0000 360.0000 FORMAT "%4.1" /end AXIS_DESCR /begin AXIS_DESCR STD_AXIS md_rel FORMULA_0001 6 0.0 100.0000 FORMAT "%4.1" /end AXIS_DESCR /end CHARACTERISTIC
/begin CHARACTERISTIC K_FGR_V_SOLL_MIN_KMH_E2 "E2 Min. Ziel-/Sollgeschwindigkeit in km/h | EN: E2 Min. Ziel-/Sollgeschwindigkeit in km/h" VALUE 0x7A538 TKW_VV_VV_SW 100.0 FORMULA_0078 -360.0000 360.0000 FORMAT "%4.1" /end CHARACTERISTIC
/begin CHARACTERISTIC K_FGR_V_SOLL_MIN_MPH_E2 "E2 Min. Ziel-/Sollgeschwindigkeit in mph | EN: E2 Min. Ziel-/Sollgeschwindigkeit in mph" VALUE 0x7A53A TKW_VV_VV_SW 100.0 FORMULA_0664 -360.0000 360.0000 FORMAT "%4.1" /end CHARACTERISTIC
/begin CHARACTERISTIC K_FGR_T_FEHLER_E2 "Wartezeit f�r Ebene 2 Fehlermeldung | EN: Wartezeit für Ebene 2 Fehlermeldung" VALUE 0x7A53C TKW_VV_VV_UB 100.0 FORMULA_0501 0.0 25.5000 /end CHARACTERISTIC
/begin MEASUREMENT fgr_b_rgl_init "Init Regler" UBYTE FORMULA_0635 0 0 0.0 255.0 ECU_ADDRESS 0x3FB8CC /end MEASUREMENT
/begin MEASUREMENT fgr_init_beschl_set "Init Beschl. -> Set" UBYTE FORMULA_0635 0 0 0.0 255.0 ECU_ADDRESS 0x3FB8CD /end MEASUREMENT
/begin MEASUREMENT fgr_init_verzoeg_set "Init Verzoeg. -> Set" UBYTE FORMULA_0635 0 0 0.0 255.0 ECU_ADDRESS 0x3FB8CE /end MEASUREMENT
/begin MEASUREMENT fgr_md_fw_fgr_sum "Regler Summenwert" UWORD FORMULA_0636 0 0 0.0 100.0000 ECU_ADDRESS 0x3FB8D0 /end MEASUREMENT
/begin MEASUREMENT fgr_b_wa_first "First WA" UBYTE FORMULA_0635 0 0 0.0 255.0 ECU_ADDRESS 0x3FB8D2 /end MEASUREMENT
/begin MEASUREMENT fgr_fsp_code "Fehlerspeicher Code" UBYTE FORMULA_0637 0 0 0.0 255.0 ECU_ADDRESS 0x3FB8D3 /end MEASUREMENT
/begin MEASUREMENT fgr_b_dsc_reg_dsc "DSC im Regelbetrieb DSC" UBYTE FORMULA_0638 0 0 0.0 255.0 ECU_ADDRESS 0x3FB8D4 /end MEASUREMENT
/begin MEASUREMENT fgr_b_dsc_eingriff "DSC Eingriff" UBYTE FORMULA_0639 0 0 0.0 255.0 ECU_ADDRESS 0x3FB8D5 /end MEASUREMENT
/begin MEASUREMENT fgr_b_dsc_reg_eingriff "DSC Regelung/Eingriff" UBYTE FORMULA_0640 0 0 0.0 255.0 ECU_ADDRESS 0x3FB8D6 /end MEASUREMENT
/begin MEASUREMENT fgr_b_dsc_reg_abs_asc_msr "DSC im Regelbetrieb ABS,ASC,MSR" UBYTE FORMULA_0641 0 0 0.0 255.0 ECU_ADDRESS 0x3FB8D8 /end MEASUREMENT
/begin MEASUREMENT fgr_b_dsc_soft_off "FGR soft off wegen DSC" UBYTE FORMULA_0635 0 0 0.0 255.0 ECU_ADDRESS 0x3FB8DA /end MEASUREMENT
/begin MEASUREMENT fgr_can_stat_msw "Fgr CAN-Empfangsstatus" UBYTE FORMULA_0642 0 0 0.0 255.0 ECU_ADDRESS 0x3FB8DB /end MEASUREMENT
/begin MEASUREMENT fgr_stat_anf_msw "Fgr Status Anforderung" UBYTE FORMULA_0643 0 0 0.0 255.0 ECU_ADDRESS 0x3FB8DC /end MEASUREMENT
/begin MEASUREMENT fgr_stat_abschalten "Fgr Status Abschalten" UBYTE FORMULA_0644 0 0 0.0 255.0 ECU_ADDRESS 0x3FB8DE /end MEASUREMENT
/begin MEASUREMENT fgr_stat_soft_off_rev "Fgr Status weiches Abschalten" UBYTE FORMULA_0645 0 0 0.0 255.0 ECU_ADDRESS 0x3FB8DF /end MEASUREMENT
/begin MEASUREMENT fgr_stat_hard_off_rev "Fgr Status harter Abwurf reversibel" UBYTE FORMULA_0646 0 0 0.0 255.0 ECU_ADDRESS 0x3FB8E0 /end MEASUREMENT
/begin MEASUREMENT fgr_stat_hard_off_irr "Fgr Status harter Abwurf irreversibel" UBYTE FORMULA_0647 0 0 0.0 255.0 ECU_ADDRESS 0x3FB8E1 /end MEASUREMENT
/begin MEASUREMENT fgr_stat_hard_off_irr_old "Fgr Status harter Abwurf irreversibel old" UBYTE FORMULA_0647 0 0 0.0 255.0 ECU_ADDRESS 0x3FB8E2 /end MEASUREMENT
/begin MEASUREMENT fgr_status_stufe "FGR Status Stufe" UBYTE FORMULA_0648 0 0 0.0 255.0 ECU_ADDRESS 0x3FB8E3 /end MEASUREMENT
/begin MEASUREMENT fgr_status_can "Fgr CAN Status" UBYTE FORMULA_0326 0 0 0.0 255.0 ECU_ADDRESS 0x3FB8E4 /end MEASUREMENT
/begin MEASUREMENT fgr_hud_aus "FGR HUD Anzeige" UBYTE FORMULA_0649 0 0 0.0 255.0 ECU_ADDRESS 0x3FB8E6 /end MEASUREMENT
/begin MEASUREMENT fgr_hud_state "FGR HUD State" UBYTE FORMULA_0650 0 0 0.0 255.0 ECU_ADDRESS 0x3FB8E7 /end MEASUREMENT
/begin MEASUREMENT fgr_hud_bedien "FGR HUD Bedienbefehl abgesetzt" UBYTE FORMULA_0651 0 0 0.0 255.0 ECU_ADDRESS 0x3FB8E8 /end MEASUREMENT
/begin MEASUREMENT fgr_b_smg_rs "SMG Rennstart aktiv" UBYTE FORMULA_0327 0 0 0.0 255.0 ECU_ADDRESS 0x3FB8E9 /end MEASUREMENT
/begin MEASUREMENT fgr_v_tacho_fil "Kombi Geschwindigkeit gefiltert" SWORD FORMULA_0078 0 0 -80.0000 360.0000 ECU_ADDRESS 0x3FB8EA /end MEASUREMENT
/begin MEASUREMENT fgr_v_veh_kombi "FGR Geschw. f�r Anzeige Kombi" SWORD FORMULA_0329 0 0 -80.0000 360.0000 ECU_ADDRESS 0x3FB8EC /end MEASUREMENT
/begin MEASUREMENT fgr_v_soll_min "minimale Geschwindigkeit FGR" SWORD FORMULA_0078 0 0 -80.0000 360.0000 ECU_ADDRESS 0x3FB8EE /end MEASUREMENT
/begin MEASUREMENT fgr_v_soll_max "maximale Geschwindigkeit FGR" SWORD FORMULA_0078 0 0 -80.0000 360.0000 ECU_ADDRESS 0x3FB8F0 /end MEASUREMENT
/begin MEASUREMENT fgr_v_veh_ist "Ist Geschwindigkeit" SLONG FORMULA_0652 0 0 -360.0000 360.0000 ECU_ADDRESS 0x3FB8F4 /end MEASUREMENT
/begin MEASUREMENT fgr_v_veh_ziel "Ziel Geschwindigkeit" SLONG FORMULA_0652 0 0 -360.0000 360.0000 ECU_ADDRESS 0x3FB8F8 /end MEASUREMENT
/begin MEASUREMENT fgr_v_veh_soll "Soll Geschwindigkeit" SLONG FORMULA_0652 0 0 -360.0000 360.0000 ECU_ADDRESS 0x3FB8FC /end MEASUREMENT
/begin MEASUREMENT fgr_v_veh_soll_dif "Soll Geschwindigkeit PID Regler" SLONG FORMULA_0652 0 0 -360.0000 360.0000 ECU_ADDRESS 0x3FB900 /end MEASUREMENT
/begin MEASUREMENT fgr_v_veh_dif "Geschwindigkeitsabweichung PID Regler" SLONG FORMULA_0652 0 0 -360.0000 360.0000 ECU_ADDRESS 0x3FB904 /end MEASUREMENT
/begin MEASUREMENT fgr_v_veh_soll_dif_roh "Geschwindigkeits Rohwert Ziel-/ Sollabweichung" SLONG FORMULA_0652 0 0 -360.0000 360.0000 ECU_ADDRESS 0x3FB908 /end MEASUREMENT
/begin MEASUREMENT fgr_v_veh_soll_roh "Geschwindigkeits Rohwert" SLONG FORMULA_0652 0 0 -360.0000 360.0000 ECU_ADDRESS 0x3FB90C /end MEASUREMENT
/begin MEASUREMENT fgr_v_veh_fil "Gefilterte Geschwindigkeit" SLONG FORMULA_0652 0 0 -360.0000 360.0000 ECU_ADDRESS 0x3FB910 /end MEASUREMENT
/begin MEASUREMENT fgr_v_veh_stufe "Geschwindigkeit Stufe" SLONG FORMULA_0652 0 0 -360.0000 360.0000 ECU_ADDRESS 0x3FB914 /end MEASUREMENT
/begin MEASUREMENT fgr_v_veh_soll_inc "Rampeninkrement bei Aufsteuerung" UWORD FORMULA_0653 0 0 0.0 3.9999 ECU_ADDRESS 0x3FB918 /end MEASUREMENT
/begin MEASUREMENT fgr_v_veh_soll_inc_akt "Rampeninkrement bei Aufsteuerung gewichtet" UWORD FORMULA_0653 0 0 0.0 3.9999 ECU_ADDRESS 0x3FB91A /end MEASUREMENT
/begin MEASUREMENT fgr_v_veh_soll_dec "Rampendekrement bei Absteuerung" UWORD FORMULA_0653 0 0 0.0 3.9999 ECU_ADDRESS 0x3FB91C /end MEASUREMENT
/begin MEASUREMENT fgr_v_veh_soll_dec_akt "Rampendekrement bei Absteuerung gewichtet " UWORD FORMULA_0653 0 0 0.0 3.9999 ECU_ADDRESS 0x3FB91E /end MEASUREMENT
/begin MEASUREMENT fgr_fak_v_veh_soll "V-Soll Wichtungsfaktor " UBYTE FORMULA_0654 0 0 0.0 1.0000 ECU_ADDRESS 0x3FB920 /end MEASUREMENT
/begin MEASUREMENT fgr_fak_t_aktiv "Zeitabh�niger Wichtungsfaktor " UBYTE FORMULA_0655 0 0 0.0 1.9921 ECU_ADDRESS 0x3FB921 /end MEASUREMENT
/begin MEASUREMENT fgr_t_err_v_veh "Fehlzeit eines Geschwindigkeitssignals" UWORD FORMULA_0021 0 0 0.0 655.0000 ECU_ADDRESS 0x3FB922 /end MEASUREMENT
/begin MEASUREMENT fgr_t_kli "Zeit f�r Kennlineninterpolation" UWORD FORMULA_0021 0 0 0.0 655.0000 ECU_ADDRESS 0x3FB924 /end MEASUREMENT
/begin MEASUREMENT fgr_kw "Koeffizienten Wichtungsfaktor" SWORD FORMULA_0656 0 0 -327.6800 327.6700 ECU_ADDRESS 0x3FB926 /end MEASUREMENT
/begin MEASUREMENT fgr_ax_ist "Fahrzeug L�ngsbeschleunigung" SWORD FORMULA_0132 0 0 -20.0000 20.0000 ECU_ADDRESS 0x3FB928 /end MEASUREMENT
/begin MEASUREMENT fgr_ax_pos_soll "Sollbeschleunigung" SWORD FORMULA_0132 0 0 -20.0000 20.0000 ECU_ADDRESS 0x3FB92A /end MEASUREMENT
/begin MEASUREMENT fgr_ax_neg_soll "Sollverz�gerung" SWORD FORMULA_0132 0 0 -20.0000 20.0000 ECU_ADDRESS 0x3FB92C /end MEASUREMENT
/begin MEASUREMENT fgr_n_dif "n dif. Getriebeeingang" SWORD FORMULA_0657 0 0 -32768.0000 32767.0000 ECU_ADDRESS 0x3FB92E /end MEASUREMENT
/begin MEASUREMENT fgr_a1 "Reglerkoeffizient a1" SWORD FORMULA_0497 0 0 -327.6800 327.6700 ECU_ADDRESS 0x3FB930 /end MEASUREMENT
/begin MEASUREMENT fgr_b0 "Reglerkoeffizient b0" SWORD FORMULA_0497 0 0 -327.6800 327.6700 ECU_ADDRESS 0x3FB932 /end MEASUREMENT
/begin MEASUREMENT fgr_b1 "Reglerkoeffizient b1" SWORD FORMULA_0497 0 0 -327.6800 327.6700 ECU_ADDRESS 0x3FB934 /end MEASUREMENT
/begin MEASUREMENT fgr_b2 "Reglerkoeffizient b2" SWORD FORMULA_0497 0 0 -327.6800 327.6700 ECU_ADDRESS 0x3FB936 /end MEASUREMENT
/begin MEASUREMENT fgr_kr "Regler Zwischenfaktor kr" SWORD FORMULA_0497 0 0 -327.6800 327.6700 ECU_ADDRESS 0x3FB938 /end MEASUREMENT
/begin MEASUREMENT fgr_tn "Regler Zwischenfaktor tn" SWORD FORMULA_0497 0 0 -327.6800 327.6700 ECU_ADDRESS 0x3FB93A /end MEASUREMENT
/begin MEASUREMENT fgr_tv "Regler Zwischenfaktor tv" SWORD FORMULA_0497 0 0 -327.6800 327.6700 ECU_ADDRESS 0x3FB93C /end MEASUREMENT
/begin MEASUREMENT fgr_fil_a1 "Filterkoeffizient a1" SWORD FORMULA_0295 0 0 -2.0000 1.9999 ECU_ADDRESS 0x3FB93E /end MEASUREMENT
/begin MEASUREMENT fgr_fil_b1 "Filterkoeffizient b1" UWORD FORMULA_0658 0 0 0.0 0.2499 ECU_ADDRESS 0x3FB940 /end MEASUREMENT
/begin MEASUREMENT fgr_fil_b2 "Filterkoeffizient b2" UWORD FORMULA_0658 0 0 0.0 0.2499 ECU_ADDRESS 0x3FB942 /end MEASUREMENT
/begin MEASUREMENT fgr_md_fw_roh "Rohwert des Reglereingriffs" UWORD FORMULA_0636 0 0 0.0 100.0000 ECU_ADDRESS 0x3FB944 /end MEASUREMENT
/begin MEASUREMENT fgr_md_fw_sa "Rohwert des Reglereingriffs incl. SA" UWORD FORMULA_0636 0 0 0.0 100.0000 ECU_ADDRESS 0x3FB946 /end MEASUREMENT
/begin MEASUREMENT fgr_b_ueberhol_anf "Anforderung �berholen " UBYTE FORMULA_0327 0 0 0.0 255.0 ECU_ADDRESS 0x3FB948 /end MEASUREMENT
/begin MEASUREMENT fgr_t_constfahrt "Zeit Konstantfahrt" ULONG FORMULA_0659 0 0 0.0 42949672.9500 ECU_ADDRESS 0x3FB94C /end MEASUREMENT
/begin MEASUREMENT fgr_t_ueberhol "Zeit �berholen" ULONG FORMULA_0659 0 0 0.0 42949672.9500 ECU_ADDRESS 0x3FB950 /end MEASUREMENT
/begin MEASUREMENT fgr_t_aktiv "Zeit FGR aktiv" ULONG FORMULA_0659 0 0 0.0 42949672.9500 ECU_ADDRESS 0x3FB954 /end MEASUREMENT
/begin MEASUREMENT fgr_b_fehler_e2 "FGR Fehler Ebene 2" UBYTE FORMULA_0635 0 0 0.0 255.0 ECU_ADDRESS 0x3FC744 /end MEASUREMENT
/* ------------------ Abschnitt erzeugt aus fr.dat ------------------ */
/begin CHARACTERISTIC K_FR_CFG "Konfiguration | EN: Konfiguration" VALUE 0x732C6 TKW_VV_VV_UB 100.0 FORMULA_0678 0.0 255.0 /end CHARACTERISTIC
/begin CHARACTERISTIC K_FR_DI_ENTDR "Schrittweite bei DK entdrosselt" VALUE 0x732C8 TKW_VV_VV_SW 100.0 FORMULA_0677 0.0 0.5000 FORMAT "%7.4" /end CHARACTERISTIC
/begin CHARACTERISTIC K_FR_EDK_DIFF "max. Abweichung WDK Soll/Ist fuer FR-Freigabe | EN: Maximum setpoint/actual difference [%]" VALUE 0x732CA TKW_VV_VV_SW 100.0 FORMULA_0001 -10.0000 120.0000 FORMAT "%4.1" /end CHARACTERISTIC
/begin CHARACTERISTIC K_FR_DRREL_MAX "drrel-Schwelle zum Einfrieren FR-Regler" VALUE 0x732CC TKW_VV_VV_SW 100.0 FORMULA_0115 0.0 199.9938 FORMAT "%5.2" /end CHARACTERISTIC
/begin CHARACTERISTIC K_FR_IMIN "Minimaler I-Anteils | EN: Minimum integral share" VALUE 0x732CE TKW_VV_VV_SW 100.0 FORMULA_0024 -0.5000 0.0 FORMAT "%7.4" /end CHARACTERISTIC
/begin CHARACTERISTIC K_FR_IMAX "Maximaler I-Anteils | EN: Maximum integral share" VALUE 0x732D0 TKW_VV_VV_SW 100.0 FORMULA_0024 0.0 0.5000 FORMAT "%7.4" /end CHARACTERISTIC
/begin CHARACTERISTIC K_FR_ADAPT_SCHW_1of8_ "Adaptionsschwelle" VALUE 0x732D2 TKW_VV_VV_SW 100.0 FORMULA_0112 -100.0000 1400.0000 FORMAT "%4.1" /end CHARACTERISTIC
/begin CHARACTERISTIC K_FR_ADAPT_SCHW_2of8_ "Adaptionsschwelle" VALUE 0x732D4 TKW_VV_VV_SW 100.0 FORMULA_0112 -100.0000 1400.0000 FORMAT "%4.1" /end CHARACTERISTIC
/begin CHARACTERISTIC K_FR_ADAPT_SCHW_3of8_ "Adaptionsschwelle" VALUE 0x732D6 TKW_VV_VV_SW 100.0 FORMULA_0112 -100.0000 1400.0000 FORMAT "%4.1" /end CHARACTERISTIC
/begin CHARACTERISTIC K_FR_ADAPT_SCHW_4of8_ "Adaptionsschwelle" VALUE 0x732D8 TKW_VV_VV_SW 100.0 FORMULA_0112 -100.0000 1400.0000 FORMAT "%4.1" /end CHARACTERISTIC
/begin CHARACTERISTIC K_FR_ADAPT_SCHW_5of8_ "Adaptionsschwelle" VALUE 0x732DA TKW_VV_VV_SW 100.0 FORMULA_0112 -100.0000 1400.0000 FORMAT "%4.1" /end CHARACTERISTIC
/begin CHARACTERISTIC K_FR_ADAPT_SCHW_6of8_ "Adaptionsschwelle" VALUE 0x732DC TKW_VV_VV_SW 100.0 FORMULA_0112 -100.0000 1400.0000 FORMAT "%4.1" /end CHARACTERISTIC
/begin CHARACTERISTIC K_FR_ADAPT_SCHW_7of8_ "Adaptionsschwelle" VALUE 0x732DE TKW_VV_VV_SW 100.0 FORMULA_0112 -100.0000 1400.0000 FORMAT "%4.1" /end CHARACTERISTIC
/begin CHARACTERISTIC K_FR_ADAPT_SCHW_8of8_ "Adaptionsschwelle" VALUE 0x732E0 TKW_VV_VV_SW 100.0 FORMULA_0112 -100.0000 1400.0000 FORMAT "%4.1" /end CHARACTERISTIC
/begin CHARACTERISTIC K_FR_ADAPT_TAU "Adaptions-Tau" VALUE 0x732E2 TKW_VV_VV_UB 100.0 FORMULA_0679 0.1004 25.6000 /end CHARACTERISTIC
/begin CHARACTERISTIC K_FR_START_DELAY "Verzoegerung nach Start | EN: Delay after start [s]" VALUE 0x732E4 TKW_VV_VV_UW 100.0 FORMULA_0021 0.0 655.0000 FORMAT "%5.2" /end CHARACTERISTIC
/begin CHARACTERISTIC K_FR_EINGER_SCHW "Schwelle Eingeregelt | EN: Threshold for settled [%]" VALUE 0x732E6 TKW_VV_VV_SW 100.0 FORMULA_0001 0.0 100.0000 FORMAT "%4.1" /end CHARACTERISTIC
/begin CHARACTERISTIC K_FR_EINGER_HYS "Schwelle Eingeregelt | EN: Threshold for settled [%]" VALUE 0x732E8 TKW_VV_VV_SW 100.0 FORMULA_0001 0.0 100.0000 FORMAT "%4.1" /end CHARACTERISTIC
/begin CHARACTERISTIC KL_FR_IANT "Schrittweite I-Anteil | EN: Integral step size" CURVE 0x732EA TKL_SW_VV_SW 100.0 FORMULA_0677 -0.5000 0.5000
 /begin AXIS_DESCR STD_AXIS rf_delta FORMULA_0676 8 -1.0000 1.0000 FORMAT "%7.4" /end AXIS_DESCR
 FORMAT "%7.4" /end CHARACTERISTIC
/begin CHARACTERISTIC KL_FR_DRREL_MAX_N "drrel-Schwelle zum Einfrieren FR-Regler" CURVE 0x7330C TKL_SW_VV_SW 100.0 FORMULA_0115 0.0 199.9938 /begin AXIS_DESCR STD_AXIS n FORMULA_0006 6 0.0 10000.0000 /end AXIS_DESCR FORMAT "%5.2" /end CHARACTERISTIC
/begin CHARACTERISTIC KF_FR_RF_DELTA_REL_HYS "Abschaltschwelle ueber Regeldifferenz | EN: Switch-off threshold on control error" MAP 0x73326 TKF_SW_SW_SW 100.0 FORMULA_0001 0.0 100.0000 /begin AXIS_DESCR STD_AXIS n FORMULA_0006 4 0.0 10000.0000 /end AXIS_DESCR /begin AXIS_DESCR STD_AXIS rf FORMULA_0007 4 0.0 2.0000 FORMAT "%6.3" /end AXIS_DESCR FORMAT "%4.1" /end CHARACTERISTIC
/begin MEASUREMENT fr_zust_b1 "FR-Zustand" UBYTE FORMULA_0675 0 0 0.0 255.0 ECU_ADDRESS 0x3FB958 /end MEASUREMENT
/begin MEASUREMENT fr_zust_b2 "FR-Zustand" UBYTE FORMULA_0675 0 0 0.0 255.0 ECU_ADDRESS 0x3FB959 /end MEASUREMENT
/begin MEASUREMENT fr_rf_delta_b1 "Regelabweichung (Soll-Ist)" SWORD FORMULA_0676 0 0 -1.0000 1.0000 ECU_ADDRESS 0x3FB95A /end MEASUREMENT
/begin MEASUREMENT fr_rf_delta_b2 "Regelabweichung (Soll-Ist)" SWORD FORMULA_0676 0 0 -1.0000 1.0000 ECU_ADDRESS 0x3FB95C /end MEASUREMENT
/begin MEASUREMENT fr_ant_i_b1 "Schrittweite I-Regler" SWORD FORMULA_0677 0 0 -0.5000 0.5000 ECU_ADDRESS 0x3FB95E /end MEASUREMENT
/begin MEASUREMENT fr_ant_i_b2 "Schrittweite I-Regler" SWORD FORMULA_0677 0 0 -0.5000 0.5000 ECU_ADDRESS 0x3FB960 /end MEASUREMENT
/begin MEASUREMENT fr_reg_i_b1 "I-Anteil FR-Regler" SWORD FORMULA_0024 0 0 -0.5000 0.5000 ECU_ADDRESS 0x3FB962 /end MEASUREMENT
/begin MEASUREMENT fr_reg_i_b2 "I-Anteil FR-Regler" SWORD FORMULA_0024 0 0 -0.5000 0.5000 ECU_ADDRESS 0x3FB964 /end MEASUREMENT
/begin MEASUREMENT fr_rf_delta_rel_b1 "rel. Regelabweichung" SWORD FORMULA_0001 0 0 0.0 100.0000 ECU_ADDRESS 0x3FB966 /end MEASUREMENT
/begin MEASUREMENT fr_rf_delta_rel_b2 "rel. Regelabweichung" SWORD FORMULA_0001 0 0 0.0 100.0000 ECU_ADDRESS 0x3FB968 /end MEASUREMENT
/begin MEASUREMENT fr_rf_delta_rel_hys "Schwelle rel. Regelabweichung" SWORD FORMULA_0001 0 0 0.0 100.0000 ECU_ADDRESS 0x3FB96A /end MEASUREMENT
/begin MEASUREMENT fr_dr_rel_schw "drrel-Schwelle zum Einfrieren FR-Regler" SWORD FORMULA_0115 0 0 0.0 199.9938 ECU_ADDRESS 0x3FB96C /end MEASUREMENT
/* ------------------ Abschnitt erzeugt aus fra.dat ------------------ */
/begin CHARACTERISTIC K_FRA_CFG "Konfiguration" VALUE 0x73358 TKW_VV_VV_UB 100.0 FORMULA_0682 0.0 255.0 /end CHARACTERISTIC
/begin CHARACTERISTIC K_FRA_WAIT "Wartezeit" VALUE 0x73359 TKW_VV_VV_UB 100.0 FORMULA_0232 1.0000 255.0000 /end CHARACTERISTIC
/begin CHARACTERISTIC K_FRA_TMOT_SCHW "min. Temperaturschwelle" VALUE 0x7335A TKW_VV_VV_SW 100.0 FORMULA_0023 -50.0000 170.0000 FORMAT "%4.1" /end CHARACTERISTIC
/begin CHARACTERISTIC K_FRA_RF_MAX "max. rf-Schwelle" VALUE 0x7335C TKW_VV_VV_SW 100.0 FORMULA_0007 0.0 2.0000 FORMAT "%6.3" /end CHARACTERISTIC
/begin CHARACTERISTIC K_FRA_FR_I_REG_SCHW "Schwelle I-Anteil (FR aktiv)" VALUE 0x7335E TKW_VV_VV_SW 100.0 FORMULA_0024 0.0 0.5000 FORMAT "%7.4" /end CHARACTERISTIC
/begin CHARACTERISTIC K_FRA_RF_DELTA_SCHW "Schwelle Regeldifferenz (FR aus)" VALUE 0x73360 TKW_VV_VV_SW 100.0 FORMULA_0007 0.0 2.0000 FORMAT "%6.3" /end CHARACTERISTIC
/begin CHARACTERISTIC K_FRA_AQ_DELTA_SLOW "Adaptionsschritt - Langsam" VALUE 0x73362 TKW_VV_VV_SW 100.0 FORMULA_0422 0.0 50.0000 FORMAT "%5.2" /end CHARACTERISTIC
/begin CHARACTERISTIC K_FRA_AQ_DELTA_FAST "Adaptionsschritt - Schnell" VALUE 0x73364 TKW_VV_VV_SW 100.0 FORMULA_0422 0.0 50.0000 FORMAT "%5.2" /end CHARACTERISTIC
/begin CHARACTERISTIC K_FRA_AQ_MAX_SLOW "Aenderung pro Adaptionszyklus - Langsam" VALUE 0x73366 TKW_VV_VV_SW 100.0 FORMULA_0422 0.0 50.0000 FORMAT "%5.2" /end CHARACTERISTIC
/begin CHARACTERISTIC K_FRA_AQ_MAX_FAST "Zunahme pro Adaptionszyklus - Schnell" VALUE 0x73368 TKW_VV_VV_SW 100.0 FORMULA_0422 0.0 50.0000 FORMAT "%5.2" /end CHARACTERISTIC
/begin CHARACTERISTIC K_FRA_AQ_ADAPT_MIN "min. Adaptionswert" VALUE 0x7336A TKW_VV_VV_SW 100.0 FORMULA_0422 -50.0000 0.0 FORMAT "%5.2" /end CHARACTERISTIC
/begin CHARACTERISTIC K_FRA_AQ_ADAPT_MAX "max. Adaptionswert" VALUE 0x7336C TKW_VV_VV_SW 100.0 FORMULA_0422 0.0 50.0000 FORMAT "%5.2" /end CHARACTERISTIC
/begin CHARACTERISTIC K_FRA_GRUNDLECKLUFT "Grundleckluft" VALUE 0x7336E TKW_VV_VV_SW 100.0 FORMULA_0147 -100.0000 0.0 FORMAT "%4.1" /end CHARACTERISTIC
/begin CHARACTERISTIC KL_FRA_XSI_PSAU "Korrekturwert fuer Leckluft" CURVE 0x73370 TKL_SW_VV_UW 100.0 FORMULA_0075 0.0 4.0000
 /begin AXIS_DESCR STD_AXIS psau_rel FORMULA_0115 8 0.0 120.0000 FORMAT "%5.2" /end AXIS_DESCR
 FORMAT "%6.3" /end CHARACTERISTIC
/begin MEASUREMENT fra_aqmax "Zunahme pro Adaptionszyklus" SWORD FORMULA_0422 0 0 0.0 50.0000 ECU_ADDRESS 0x3FB96E /end MEASUREMENT
/begin MEASUREMENT fra_sperr_st_b1 "Sperrstatus" UBYTE FORMULA_0680 0 0 0.0 255.0 ECU_ADDRESS 0x3FB970 /end MEASUREMENT
/begin MEASUREMENT fra_sperr_st_b2 "Sperrstatus" UBYTE FORMULA_0680 0 0 0.0 255.0 ECU_ADDRESS 0x3FB971 /end MEASUREMENT
/begin MEASUREMENT fra_zust_b1 "Zustand" UBYTE FORMULA_0681 0 0 0.0 255.0 ECU_ADDRESS 0x3FB972 /end MEASUREMENT
/begin MEASUREMENT fra_zust_b2 "Zustand" UBYTE FORMULA_0681 0 0 0.0 255.0 ECU_ADDRESS 0x3FB973 /end MEASUREMENT
/begin MEASUREMENT fra_wait_b1 "Wartezeit" UBYTE FORMULA_0232 0 0 0.0 255.0000 ECU_ADDRESS 0x3FB974 /end MEASUREMENT
/begin MEASUREMENT fra_wait_b2 "Wartezeit" UBYTE FORMULA_0232 0 0 0.0 255.0000 ECU_ADDRESS 0x3FB975 /end MEASUREMENT
/begin MEASUREMENT fra_aq_adapt_b1 "gewicht. Leckluft plus Grund" SWORD FORMULA_0147 0 0 -100.0000 100.0000 ECU_ADDRESS 0x3FB976 /end MEASUREMENT
/begin MEASUREMENT fra_aq_adapt_b2 "gewicht. Leckluft plus Grund" SWORD FORMULA_0147 0 0 -100.0000 100.0000 ECU_ADDRESS 0x3FB978 /end MEASUREMENT
/* ------------------ Abschnitt erzeugt aus gang.dat ------------------ */
/begin CHARACTERISTIC K_GANG_N_VERH_MIN "Uebersetzungsverhaeltnis Minimum | EN: Minimum gear ratio" VALUE 0x73392 TKW_VV_VV_SW 100.0 FORMULA_0075 -10.0000 10.0000 FORMAT "%6.3" /end CHARACTERISTIC
/begin CHARACTERISTIC K_GANG_N_VERH_MAX "Uebersetzungsverhaeltnis Maximum | EN: Maximum gear ratio" VALUE 0x73394 TKW_VV_VV_SW 100.0 FORMULA_0075 -10.0000 10.0000 FORMAT "%6.3" /end CHARACTERISTIC
/begin CHARACTERISTIC K_GANG_I_RW_SMG "Uebersetzungsverhaeltnis Rueckwaertsgang SMG | EN: Reverse gear ratio, SMG" VALUE 0x73396 TKW_VV_VV_SW 100.0 FORMULA_0075 -10.0000 10.0000 FORMAT "%6.3" /end CHARACTERISTIC
/begin CHARACTERISTIC K_GANG_I_RW_HS "Uebersetzungsverhaeltnis Rueckwaertsgang Handschalter | EN: Reverse gear ratio, manual gearbox" VALUE 0x73398 TKW_VV_VV_SW 100.0 FORMULA_0075 -10.0000 10.0000 FORMAT "%6.3" /end CHARACTERISTIC
/begin CHARACTERISTIC K_GANG_I_HA_ADAPT_GANG_MIN_HS "minimaler Gang Adaption Hinterachse | EN: minimaler Gang Adaption Hinterachse" VALUE 0x7339A TKW_VV_VV_SB 100.0 FORMULA_0318 -1.0000 10.0000 /end CHARACTERISTIC
/begin CHARACTERISTIC K_GANG_I_HA_ADAPT_GANG_MAX_HS "maximaler Gang Adaption Hinterachse | EN: maximaler Gang Adaption Hinterachse" VALUE 0x7339B TKW_VV_VV_SB 100.0 FORMULA_0318 -1.0000 10.0000 /end CHARACTERISTIC
/begin CHARACTERISTIC K_GANG_I_HA_ADAPT_MD_MIN_HS "minimales Kupplungsmoment Adaption Hinterachse | EN: minimales Kupplungsmo-ment Adaption Hinterachse" VALUE 0x7339C TKW_VV_VV_SW 100.0 FORMULA_0009 -100.0000 1000.0000 FORMAT "%4.1" /end CHARACTERISTIC
/begin CHARACTERISTIC K_GANG_I_HA_ADAPT_MD_MAX_HS "maximales Kupplungsmoment Adaption Hinterachse | EN: maximales Kupplungsm o-ment Adaption Hinterachse" VALUE 0x7339E TKW_VV_VV_SW 100.0 FORMULA_0009 -100.0000 1000.0000 FORMAT "%4.1" /end CHARACTERISTIC
/begin CHARACTERISTIC K_GANG_I_HA_ADAPT_SCHLUPF_MIN_HS "minimaler Schlupf Adaption Hinterachse | EN: minimaler Schlupf Adapt ion Hinterachse" VALUE 0x733A0 TKW_VV_VV_SW 100.0 FORMULA_0463 -300.0000 300.0000 FORMAT "%4.1" /end CHARACTERISTIC
/begin CHARACTERISTIC K_GANG_I_HA_ADAPT_V_MIN_HS "minimale Geschwindigkeit Adaption Hinterachse | EN: minimale Geschwindigkeit Adaption Hinterachse" VALUE 0x733A2 TKW_VV_VV_SW 100.0 FORMULA_0078 -80.0000 360.0000 FORMAT "%4.1" /end CHARACTERISTIC
/begin CHARACTERISTIC K_GANG_I_HA_ADAPT_V_MAX_HS "maximale Geschwindigkeit Adaption Hinterachse | EN: maximale Geschwindig keit Adaption Hinterachse" VALUE 0x733A4 TKW_VV_VV_SW 100.0 FORMULA_0078 -80.0000 360.0000 FORMAT "%4.1" /end CHARACTERISTIC
/begin CHARACTERISTIC K_GANG_I_HA_ADAPT_CNT_MAX "maximale Zahl Messwerte Adaption Hinterachse | EN: maximale Zahl Messwerte Adaption Hinterachse" VALUE 0x733A6 TKW_VV_VV_UW 100.0 FORMULA_0010 0.0 65535.0000 /end CHARACTERISTIC
/begin CHARACTERISTIC K_GANG_I_HA_ADAPT_MIN "minimaler Adaptionswert Hinterachse | EN: minimaler Adaptionswert Hinterachse" VALUE 0x733A8 TKW_VV_VV_SW 100.0 FORMULA_0075 -10.0000 10.0000 FORMAT "%6.3" /end CHARACTERISTIC
/begin CHARACTERISTIC K_GANG_I_HA_ADAPT_MAX "maximaler Adaptionswert Hinterachse | EN: maximaler Adaptionswert Hinterachse" VALUE 0x733AA TKW_VV_VV_SW 100.0 FORMULA_0075 -10.0000 10.0000 FORMAT "%6.3" /end CHARACTERISTIC
/begin CHARACTERISTIC K_GANG_I_HA_SMG "Uebersetzungsverhaeltnis Hinterachse SMG | EN: Uebersetzungsverhaeltnis Hinterachse SMG" VALUE 0x733AC TKW_VV_VV_SW 100.0 FORMULA_0075 -10.0000 10.0000 FORMAT "%6.3" /end CHARACTERISTIC
/begin CHARACTERISTIC K_GANG_I_HA_HS "Uebersetzungsverhaeltnis Hinterachse Handschalter | EN: Uebersetzungsverhaeltnis Hinterachse Handschalter" VALUE 0x733AE TKW_VV_VV_SW 100.0 FORMULA_0075 -10.0000 10.0000 FORMAT "%6.3" /end CHARACTERISTIC
/begin CHARACTERISTIC K_GANG_R_RAD_DYN_NV "Radhalbmesser dynamisch adaptiert, temporaere Konstante | EN: Radhalbmesser dyn amisch adaptiert, temporaere Kon- stante" VALUE 0x733B0 TKW_VV_VV_SW 100.0 FORMULA_0690 -32.0000 31.9990 FORMAT "%6.3" /end CHARACTERISTIC
/begin CHARACTERISTIC K_GANG_GLG_TIMER_MAX "Zeit bis Anzeige Getriebeleergasse | EN: Time until gearbox neutral is displayed [ms]" VALUE 0x733B2 TKW_VV_VV_SW 100.0 FORMULA_0684 -327680.0000 327670.0000 /end CHARACTERISTIC
/begin CHARACTERISTIC K_GANG_1_TIMER_MAX "Zeit bis Anzeige 1.Gang | EN: Zeit bis Anzeige 1.Gang" VALUE 0x733B4 TKW_VV_VV_SW 100.0 FORMULA_0684 -327680.0000 327670.0000 /end CHARACTERISTIC
/begin CHARACTERISTIC KL_GANG_I_SMG "SMG Gang entsprechend Getriebeuebersetzung | EN: SMG gear from gearbox ratio" CURVE 0x733B6 TKL_SW_VV_SW 100.0 FORMULA_0691 -32.0000 31.9990
 /begin AXIS_DESCR STD_AXIS SMG_Getr_I FORMULA_0075 9 -10.0000 10.0000 FORMAT "%6.3" /end AXIS_DESCR
/end CHARACTERISTIC
/begin CHARACTERISTIC KL_GANG_I_HS "HS Gang entsprechend Getriebeuebersetzung | EN: Manual gearbox gear from gearbox ratio" CURVE 0x733DC TKL_SW_VV_SW 100.0 FORMULA_0691 -32.0000 31.9990
 /begin AXIS_DESCR STD_AXIS HS_Getr_I FORMULA_0075 8 -10.0000 10.0000 FORMAT "%6.3" /end AXIS_DESCR
/end CHARACTERISTIC
/begin MEASUREMENT gang_richtung "ermittelte Fahrtrichtung fuer Ganganzeige" UBYTE FORMULA_0683 0 0 0.0 255.0 ECU_ADDRESS 0x3FB980 /end MEASUREMENT
/begin MEASUREMENT gang_richtung_cnt "ermittelte Fahrtrichtung fuer Ganganzeige" SBYTE FORMULA_0003 0 0 -128.0000 127.0000 ECU_ADDRESS 0x3FB981 /end MEASUREMENT
/begin MEASUREMENT gang_1_timer "aktuelles Delay fuer Anzeige 1.Gang" SWORD FORMULA_0684 0 0 -327680.0000 327670.0000 ECU_ADDRESS 0x3FB982 /end MEASUREMENT
/begin MEASUREMENT gang_berech_neu_verz "vorhergehende Schalterstellung Gang neu berechnen" UWORD FORMULA_0010 0 0 0.0 65535.0000 ECU_ADDRESS 0x3FB984 /end MEASUREMENT
/begin MEASUREMENT gang_berech_kl "berechneter Gang aus Kennlinie" SWORD FORMULA_0010 0 0 -32768.0000 32767.0000 ECU_ADDRESS 0x3FB986 /end MEASUREMENT
/begin MEASUREMENT gang_berech_roh "berechneter Gang ohne R und N" SBYTE FORMULA_0318 0 0 -1.0000 10.0000 ECU_ADDRESS 0x3FB988 /end MEASUREMENT
/begin MEASUREMENT gang_can_sperre_irre_cnt "Counter fuer irreversible Sperre Ganganzeige" UBYTE FORMULA_0003 0 0 0.0 255.0000 ECU_ADDRESS 0x3FB989 /end MEASUREMENT
/begin MEASUREMENT gang_can_sperre_irre "irreversible Sperre fuer Ganganzeige" UBYTE FORMULA_0685 0 0 0.0 255.0 ECU_ADDRESS 0x3FB98A /end MEASUREMENT
/begin MEASUREMENT gang_ik "kuerzestes Getriebeuebersetzungsverhaeltnis" SWORD FORMULA_0075 0 0 -10.0000 10.0000 ECU_ADDRESS 0x3FB98C /end MEASUREMENT
/begin MEASUREMENT gang_il "laengstes Getriebeuebersetzungsverhaeltnis" SWORD FORMULA_0075 0 0 -10.0000 10.0000 ECU_ADDRESS 0x3FB98E /end MEASUREMENT
/begin MEASUREMENT gang_i "aktuelles Getriebeuebersetzungsverhaeltnis" SWORD FORMULA_0075 0 0 -10.0000 10.0000 ECU_ADDRESS 0x3FB990 /end MEASUREMENT
/begin MEASUREMENT gang_i_ha_adapt_st "Status Hinterachsadaption" UBYTE FORMULA_0033 0 0 0.0 255.0000 ECU_ADDRESS 0x3FB992 /end MEASUREMENT
/begin MEASUREMENT gang_i_ha_adapt_st_freigabe "Status Hinterachsadaption Freigabe" UBYTE FORMULA_0686 0 0 0.0 255.0 ECU_ADDRESS 0x3FB992 BIT_MASK 0x1 /end MEASUREMENT
/begin MEASUREMENT gang_i_ha_adapt_st_gueltig "Status Hinterachsadaption gueltig" UBYTE FORMULA_0687 0 0 0.0 255.0 ECU_ADDRESS 0x3FB992 BIT_MASK 0x2 /end MEASUREMENT
/begin MEASUREMENT gang_i_ha_adapt_st_verfuegbar "Status Hinterachsadaption verfuegbar" UBYTE FORMULA_0688 0 0 0.0 255.0 ECU_ADDRESS 0x3FB992 BIT_MASK 0x4 /end MEASUREMENT
/begin MEASUREMENT gang_i_ha_adapt_cnt "Anzahl Messwerte Adaption Hinterachse" UWORD FORMULA_0010 0 0 0.0 65535.0000 ECU_ADDRESS 0x3FB994 /end MEASUREMENT
/begin MEASUREMENT gang_i_ha_adapt_sum "Zwischensumme Adaption Hinterachse" SLONG FORMULA_0689 0 0 -10.0000 10.0000 ECU_ADDRESS 0x3FB998 /end MEASUREMENT
/begin MEASUREMENT gang_i_ha_adapt_avg "Adaptionswert Getriebeuebersetzung Hinterachse" SWORD FORMULA_0075 0 0 -10.0000 10.0000 ECU_ADDRESS 0x3FB99C /end MEASUREMENT
/begin MEASUREMENT gang_i_rad "Getriebeuebersetzungsverhaeltnis Strang" SWORD FORMULA_0075 0 0 -10.0000 20.0000 ECU_ADDRESS 0x3FB99E /end MEASUREMENT
/begin MEASUREMENT gang_r_rad_dyn_nv "Radhalbmesser dynamisch adaptiert" SWORD FORMULA_0690 0 0 -32.0000 31.9990 ECU_ADDRESS 0x3FB9A0 /end MEASUREMENT
/begin MEASUREMENT gang_glg_timer "aktuelles Delay fuer Anzeige Getriebeleergasse" SWORD FORMULA_0684 0 0 -327680.0000 327670.0000 ECU_ADDRESS 0x3FB9A2 /end MEASUREMENT
/begin MEASUREMENT gang_glg_getr_verz "vorhergehende Schalterstellung Getriebeleergasse" UWORD FORMULA_0010 0 0 0.0 65535.0000 ECU_ADDRESS 0x3FB9A4 /end MEASUREMENT
/* ------------------ Abschnitt erzeugt aus n_getr.dat ------------------ */
/begin CHARACTERISTIC K_N_GETR_MAX_PERIOD_HS "maximal zulaessige Zahnperiode (*6us) | EN: Maximum permitted tooth period (*6 us) [us]" VALUE 0x78694 TKW_VV_VV_UW 100.0 FORMULA_0839 0.0 393210.0000 /end CHARACTERISTIC
/begin CHARACTERISTIC K_N_GETR_F_HS "Faktor zur Drehzahlberechnung | EN: Factor for engine-speed calculation" VALUE 0x78698 TKW_VV_VV_UL 100.0 FORMULA_0000 0.0 4294967295.0000 /end CHARACTERISTIC
/begin CHARACTERISTIC K_N_GETR_CFG "Schalter Auswahl Getriebeeingangsdrehzahl" VALUE 0x7869C TKW_VV_VV_UB 100.0 FORMULA_0840 0.0 255.0 /end CHARACTERISTIC
/begin CHARACTERISTIC K_N_GETR_ABTRIEB_MIN "Getriebeabtriebssdrehzahl Minimum | EN: Getriebeabtriebssdrehzahl Minimum" VALUE 0x7869E TKW_VV_VV_SW 100.0 FORMULA_0006 -12000.0000 12000.0000 /end CHARACTERISTIC
/begin CHARACTERISTIC K_N_GETR_ABTRIEB_MAX "Getriebeabtriebssdrehzahl Maximum | EN: Getriebeabtriebssdrehzahl Maximum" VALUE 0x786A0 TKW_VV_VV_SW 100.0 FORMULA_0006 0.0 12000.0000 /end CHARACTERISTIC
/begin CHARACTERISTIC K_N_GETR_HS_DIAG_N "Leergasse: Bandgrenze Getr.eing.drehz. - Motordrehzahl | EN: Leergasse: Bandgrenze Getr.eing.drehz. - Motordrehzahl" VALUE 0x786A2 TKW_VV_VV_SW 100.0 FORMULA_0006 0.0 12000.0000 /end CHARACTERISTIC
/begin CHARACTERISTIC K_N_GETR_HS_DIAG_N_KS "Kraftschluss: Bandgrenze Getr.eing.drehz. - Motordrehzahl | EN: Kraftschluss: Bandgrenze Getr.eing.drehz. - Motordrehzahl" VALUE 0x786A4 TKW_VV_VV_SW 100.0 FORMULA_0006 0.0 12000.0000 /end CHARACTERISTIC
/begin CHARACTERISTIC K_N_GETR_HS_DIAG_T "Timergrenze, um Diagnose zu beenden | EN: Timergrenze, um Diagnose zu beenden" VALUE 0x786A6 TKW_VV_VV_UW 100.0 FORMULA_0117 0.0 325.0000 FORMAT "%5.2" /end CHARACTERISTIC
/begin MEASUREMENT n_getr_ein_ersatz "Getriebeeingangsdrehzahl Ersatzwert" SWORD FORMULA_0006 0 0 0.0 12000.0000 ECU_ADDRESS 0x3FC138 /end MEASUREMENT
/begin MEASUREMENT n_getr_ein_hs "Getriebeeingangsdrehzahl Handschalter" SWORD FORMULA_0006 0 0 0.0 12000.0000 ECU_ADDRESS 0x3FC13A /end MEASUREMENT
/begin MEASUREMENT n_getr_abtrieb_ersatz "Getriebeabtriebsdrehzahl Ersatzwert" SWORD FORMULA_0006 0 0 0.0 12000.0000 ECU_ADDRESS 0x3FC13C /end MEASUREMENT
/begin MEASUREMENT n_getr_abtrieb_ha "Getriebeabtriebsdrehzahl Hinterachse" SWORD FORMULA_0006 0 0 0.0 12000.0000 ECU_ADDRESS 0x3FC13E /end MEASUREMENT
/begin MEASUREMENT n_getr_hs_diag_timer "Diagnosetimer Getriebeeingangsdrehzahl" UWORD FORMULA_0117 0 0 0.0 325.0000 ECU_ADDRESS 0x3FC140 /end MEASUREMENT
/* ------------------ Abschnitt erzeugt aus v_direkt.dat ------------------ */
/begin CHARACTERISTIC K_V_DIREKT_TAU "TAU Geschwindigkeitserfassung | EN: Time constant, speed sensing" VALUE 0x7A31C TKW_VV_VV_UB 100.0 FORMULA_0462 0.0101 2.5600 /end CHARACTERISTIC
/begin CHARACTERISTIC K_V_DIREKT_FAK "Umrechnungsfaktor | EN: Conversion factor" VALUE 0x7A320 TKW_VV_VV_UL 100.0 FORMULA_0000 0.0 4294967295.0000 /end CHARACTERISTIC
/begin CHARACTERISTIC K_VDIAG_OFFSET "Diagnoseschwelle | EN: Diagnosis threshold" VALUE 0x7A324 TKW_VV_VV_SW 100.0 FORMULA_0078 -80.0000 360.0000 FORMAT "%4.1" /end CHARACTERISTIC
/begin CHARACTERISTIC K_VDIAG_VMAX "max. Diagnoseschwelle | EN: Maximum diagnosis threshold" VALUE 0x7A326 TKW_VV_VV_SW 100.0 FORMULA_0078 -80.0000 400.0000 FORMAT "%4.1" /end CHARACTERISTIC
/begin CHARACTERISTIC K_VDIAG_GRAD_MAX "max. Geschwindigkeitssprung in 10ms | EN: Maximum speed jump in 10 ms" VALUE 0x7A328 TKW_VV_VV_SW 100.0 FORMULA_1061 -80.0000 360.0000 FORMAT "%4.1" /end CHARACTERISTIC
/begin CHARACTERISTIC K_VDIAG_SA_OHNE_V "Timer fuer v-Diagnose | EN: Timer for speed diagnosis" VALUE 0x7A32A TKW_VV_VV_UW 100.0 FORMULA_0021 0.0 655.0000 FORMAT "%5.2" /end CHARACTERISTIC
/begin CHARACTERISTIC K_VDIAG_DN_OHNE_V "dn-Schwelle fuer v-Diagnose | EN: Engine-speed delta threshold for speed diagnosis" VALUE 0x7A32C TKW_VV_VV_SW 100.0 FORMULA_0114 -10000.0000 10000.0000 /end CHARACTERISTIC
/begin CHARACTERISTIC K_V_MAX_NEG_GRAD_E2 "min. Aenderungsbegrenzung - Ebene 2 | EN: Minimum rate limit - level 2 [km/h*10ms]" VALUE 0x7A9CE TKW_VV_VV_SW 100.0 FORMULA_1061 -80.0000 0.0 FORMAT "%4.1" /end CHARACTERISTIC
/begin CHARACTERISTIC K_V_MAX_POS_GRAD_E2 "max. Aenderungsbegrenzung - Ebene 2 | EN: Maximum rate limit - level 2 [km/h*10ms]" VALUE 0x7A9D0 TKW_VV_VV_SW 100.0 FORMULA_1061 0.0 360.0000 FORMAT "%4.1" /end CHARACTERISTIC
/begin CHARACTERISTIC K_V_MIN_E2 "min. Geschwindigkeit - Ebene 2 | EN: Minimum speed - level 2 [km/h]" VALUE 0x7A9D2 TKW_VV_VV_SW 100.0 FORMULA_0078 -100.0000 360.0000 FORMAT "%4.1" /end CHARACTERISTIC
/begin CHARACTERISTIC K_V_MAX_E2 "max. Geschwindigkeit - Ebene 2 | EN: Maximum speed - level 2 [km/h]" VALUE 0x7A9D4 TKW_VV_VV_SW 100.0 FORMULA_0078 -80.0000 400.0000 FORMAT "%4.1" /end CHARACTERISTIC
/begin MEASUREMENT v_direkt_period "Periode" UWORD FORMULA_0010 0 0 0.0 65535.0000 ECU_ADDRESS 0x3FC5E4 /end MEASUREMENT
/begin MEASUREMENT v_direkt_roh "diskrete Geschwindigkeit" SWORD FORMULA_0078 0 0 -80.0000 360.0000 ECU_ADDRESS 0x3FC5E6 /end MEASUREMENT
/begin MEASUREMENT v_direkt_fil "gefilterte Geschwindigkeit" SWORD FORMULA_0078 0 0 -80.0000 360.0000 ECU_ADDRESS 0x3FC5E8 /end MEASUREMENT
/begin MEASUREMENT v_direkt_t_sa "Timer fuer v-Diagnose" UWORD FORMULA_0021 0 0 0.0 655.0000 ECU_ADDRESS 0x3FC5EA /end MEASUREMENT
/begin MEASUREMENT v_direkt_timeout "Timeout v-Erfassung" UWORD FORMULA_0021 0 0 0.0 655.0000 ECU_ADDRESS 0x3FC5EC /end MEASUREMENT
/begin MEASUREMENT v_direkt_weg "Timeout v-Erfassung" ULONG FORMULA_0460 0 0 0.0 2684354.5593 ECU_ADDRESS 0x3FC5F0 /end MEASUREMENT
/begin MEASUREMENT v_e2 "Geschwindigkeit - Ebene 2" SWORD FORMULA_0078 0 0 -80.0000 360.0000 ECU_ADDRESS 0x3FC846 /end MEASUREMENT
/begin FUNCTION Eigendiagnose ""
 /begin DEF_CHARACTERISTIC K_ED_SMG_SK.FEHLERSCHWELLE K_ED_SMG_SK.INC_NACH_EINTRAG K_ED_SMG_SK.INC_VOR_EINTRAG K_ED_SMG_SK.KLASSENINDEX K_ED_SMG_SK.OK_SCHWELLE K_ED_SMG_SK.P_CODE_OPENLOAD K_ED_SMG_SK.P_CODE_SH_TO_GND K_ED_SMG_SK.P_CODE_SH_TO_UB K_ED_SMG_SK.P_CODE_UNPLAUSIBEL K_ED_SMG_SK_N.DEC_NACH_EINTRAG K_ED_SMG_SK_N.DEC_VOR_EINTRAG K_ED_SMG_SK_N.FEHLERSCHWELLE K_ED_SMG_SK_N.INC_NACH_EINTRAG K_ED_SMG_SK_N.INC_VOR_EINTRAG K_ED_SMG_SK_N.KLASSENINDEX K_ED_SMG_SK_N.OK_SCHWELLE K_ED_SMG_SK_N.P_CODE_OPENLOAD K_ED_SMG_SK_N.P_CODE_SH_TO_GND K_ED_SMG_SK_N.P_CODE_SH_TO_UB K_ED_SMG_SK_N.P_CODE_UNPLAUSIBEL K_ED_START_RL.DEC_NACH_EINTRAG K_ED_START_RL.DEC_VOR_EINTRAG K_ED_START_RL.FEHLERSCHWELLE K_ED_START_RL.INC_NACH_EINTRAG K_ED_START_RL.INC_VOR_EINTRAG K_ED_START_RL.KLASSENINDEX K_ED_START_RL.OK_SCHWELLE K_ED_START_RL.P_CODE_OPENLOAD K_ED_START_RL.P_CODE_SH_TO_GND K_ED_START_RL.P_CODE_SH_TO_UB K_ED_START_RL.P_CODE_UNPLAUSIBEL K_ED_TABG1.DEC_NACH_EINTRAG K_ED_TABG1.DEC_VOR_EINTRAG K_ED_TABG1.FEHLERSCHWELLE K_ED_TABG1.INC_NACH_EINTRAG K_ED_TABG1.INC_VOR_EINTRAG K_ED_TABG1.KLASSENINDEX K_ED_TABG1.OK_SCHWELLE K_ED_TABG1.P_CODE_OPENLOAD K_ED_TABG1.P_CODE_SH_TO_GND K_ED_TABG1.P_CODE_SH_TO_UB K_ED_TABG1.P_CODE_UNPLAUSIBEL K_ED_TABG2.DEC_NACH_EINTRAG K_ED_TABG2.DEC_VOR_EINTRAG K_ED_TABG2.FEHLERSCHWELLE K_ED_TABG2.INC_NACH_EINTRAG K_ED_TABG2.INC_VOR_EINTRAG K_ED_TABG2.KLASSENINDEX K_ED_TABG2.OK_SCHWELLE K_ED_TABG2.P_CODE_OPENLOAD K_ED_TABG2.P_CODE_SH_TO_GND K_ED_TABG2.P_CODE_SH_TO_UB K_ED_TABG2.P_CODE_UNPLAUSIBEL K_ED_TAN1.DEC_NACH_EINTRAG K_ED_TAN1.DEC_VOR_EINTRAG K_ED_TAN1.FEHLERSCHWELLE K_ED_TAN1.INC_NACH_EINTRAG K_ED_TAN1.INC_VOR_EINTRAG K_ED_TAN1.KLASSENINDEX K_ED_TAN1.OK_SCHWELLE K_ED_TAN1.P_CODE_OPENLOAD K_ED_TAN1.P_CODE_SH_TO_GND K_ED_TAN1.P_CODE_SH_TO_UB K_ED_TAN1.P_CODE_UNPLAUSIBEL K_ED_TAN2.DEC_NACH_EINTRAG K_ED_TAN2.DEC_VOR_EINTRAG K_ED_TAN2.FEHLERSCHWELLE K_ED_TAN2.INC_NACH_EINTRAG K_ED_TAN2.INC_VOR_EINTRAG K_ED_TAN2.KLASSENINDEX K_ED_TAN2.OK_SCHWELLE K_ED_TAN2.P_CODE_OPENLOAD K_ED_TAN2.P_CODE_SH_TO_GND K_ED_TAN2.P_CODE_SH_TO_UB K_ED_TAN2.P_CODE_UNPLAUSIBEL K_ED_TAN_OBD_B1.DEC_NACH_EINTRAG K_ED_TAN_OBD_B1.DEC_VOR_EINTRAG K_ED_TAN_OBD_B1.FEHLERSCHWELLE K_ED_TAN_OBD_B1.INC_NACH_EINTRAG K_ED_TAN_OBD_B1.INC_VOR_EINTRAG K_ED_TAN_OBD_B1.KLASSENINDEX K_ED_TAN_OBD_B1.OK_SCHWELLE K_ED_TAN_OBD_B1.P_CODE_OPENLOAD K_ED_TAN_OBD_B1.P_CODE_SH_TO_GND K_ED_TAN_OBD_B1.P_CODE_SH_TO_UB K_ED_TAN_OBD_B1.P_CODE_UNPLAUSIBEL K_ED_TAN_OBD_B2.DEC_NACH_EINTRAG K_ED_TAN_OBD_B2.DEC_VOR_EINTRAG K_ED_TAN_OBD_B2.FEHLERSCHWELLE K_ED_TAN_OBD_B2.INC_NACH_EINTRAG K_ED_TAN_OBD_B2.INC_VOR_EINTRAG K_ED_TAN_OBD_B2.KLASSENINDEX K_ED_TAN_OBD_B2.OK_SCHWELLE K_ED_TAN_OBD_B2.P_CODE_OPENLOAD K_ED_TAN_OBD_B2.P_CODE_SH_TO_GND K_ED_TAN_OBD_B2.P_CODE_SH_TO_UB K_ED_TAN_OBD_B2.P_CODE_UNPLAUSIBEL K_ED_TDME.DEC_NACH_EINTRAG K_ED_TDME.DEC_VOR_EINTRAG K_ED_TDME.FEHLERSCHWELLE K_ED_TDME.INC_NACH_EINTRAG K_ED_TDME.INC_VOR_EINTRAG K_ED_TDME.KLASSENINDEX K_ED_TDME.OK_SCHWELLE K_ED_TDME.P_CODE_OPENLOAD K_ED_TDME.P_CODE_SH_TO_GND K_ED_TDME.P_CODE_SH_TO_UB K_ED_TDME.P_CODE_UNPLAUSIBEL K_ED_THERMOSTAT.DEC_NACH_EINTRAG K_ED_THERMOSTAT.DEC_VOR_EINTRAG K_ED_THERMOSTAT.FEHLERSCHWELLE K_ED_THERMOSTAT.INC_NACH_EINTRAG K_ED_THERMOSTAT.INC_VOR_EINTRAG K_ED_THERMOSTAT.KLASSENINDEX K_ED_THERMOSTAT.OK_SCHWELLE K_ED_THERMOSTAT.P_CODE_OPENLOAD K_ED_THERMOSTAT.P_CODE_SH_TO_GND K_ED_THERMOSTAT.P_CODE_SH_TO_UB K_ED_THERMOSTAT.P_CODE_UNPLAUSIBEL K_ED_TIME_REL_OBD.DEC_NACH_EINTRAG K_ED_TIME_REL_OBD.DEC_VOR_EINTRAG K_ED_TIME_REL_OBD.FEHLERSCHWELLE K_ED_TIME_REL_OBD.INC_NACH_EINTRAG K_ED_TIME_REL_OBD.INC_VOR_EINTRAG K_ED_TIME_REL_OBD.KLASSENINDEX K_ED_TIME_REL_OBD.OK_SCHWELLE K_ED_TIME_REL_OBD.P_CODE_OPENLOAD K_ED_TIME_REL_OBD.P_CODE_SH_TO_GND K_ED_TIME_REL_OBD.P_CODE_SH_TO_UB K_ED_TIME_REL_OBD.P_CODE_UNPLAUSIBEL K_ED_TKA.DEC_NACH_EINTRAG K_ED_TKA.DEC_VOR_EINTRAG K_ED_TKA.FEHLERSCHWELLE K_ED_TKA.INC_NACH_EINTRAG K_ED_TKA.INC_VOR_EINTRAG K_ED_TKA.KLASSENINDEX K_ED_TKA.OK_SCHWELLE K_ED_TKA.P_CODE_OPENLOAD K_ED_TKA.P_CODE_SH_TO_GND K_ED_TKA.P_CODE_SH_TO_UB K_ED_TKA.P_CODE_UNPLAUSIBEL K_ED_TKA_OBD.DEC_NACH_EINTRAG K_ED_TKA_OBD.DEC_VOR_EINTRAG K_ED_TKA_OBD.FEHLERSCHWELLE K_ED_TKA_OBD.INC_NACH_EINTRAG K_ED_TKA_OBD.INC_VOR_EINTRAG K_ED_TKA_OBD.KLASSENINDEX K_ED_TKA_OBD.OK_SCHWELLE K_ED_TKA_OBD.P_CODE_OPENLOAD K_ED_TKA_OBD.P_CODE_SH_TO_GND K_ED_TKA_OBD.P_CODE_SH_TO_UB K_ED_TKA_OBD.P_CODE_UNPLAUSIBEL K_ED_TMOT.DEC_NACH_EINTRAG K_ED_TMOT.DEC_VOR_EINTRAG K_ED_TMOT.FEHLERSCHWELLE K_ED_TMOT.INC_NACH_EINTRAG K_ED_TMOT.INC_VOR_EINTRAG K_ED_TMOT.KLASSENINDEX K_ED_TMOT.OK_SCHWELLE K_ED_TMOT.P_CODE_OPENLOAD K_ED_TMOT.P_CODE_SH_TO_GND K_ED_TMOT.P_CODE_SH_TO_UB K_ED_TMOT.P_CODE_UNPLAUSIBEL K_ED_TMOT_OBD.DEC_NACH_EINTRAG K_ED_TMOT_OBD.DEC_VOR_EINTRAG K_ED_TMOT_OBD.FEHLERSCHWELLE K_ED_TMOT_OBD.INC_NACH_EINTRAG K_ED_TMOT_OBD.INC_VOR_EINTRAG K_ED_TMOT_OBD.KLASSENINDEX K_ED_TMOT_OBD.OK_SCHWELLE K_ED_TMOT_OBD.P_CODE_OPENLOAD K_ED_TMOT_OBD.P_CODE_SH_TO_GND K_ED_TMOT_OBD.P_CODE_SH_TO_UB K_ED_TMOT_OBD.P_CODE_UNPLAUSIBEL K_ED_TMOT_OBD_HIGH.DEC_NACH_EINTRAG K_ED_TMOT_OBD_HIGH.DEC_VOR_EINTRAG K_ED_TMOT_OBD_HIGH.FEHLERSCHWELLE K_ED_TMOT_OBD_HIGH.INC_NACH_EINTRAG K_ED_TMOT_OBD_HIGH.INC_VOR_EINTRAG K_ED_TMOT_OBD_HIGH.KLASSENINDEX K_ED_TMOT_OBD_HIGH.OK_SCHWELLE K_ED_TMOT_OBD_HIGH.P_CODE_OPENLOAD K_ED_TMOT_OBD_HIGH.P_CODE_SH_TO_GND K_ED_TMOT_OBD_HIGH.P_CODE_SH_TO_UB K_ED_TMOT_OBD_HIGH.P_CODE_UNPLAUSIBEL K_ED_TUMG.DEC_NACH_EINTRAG K_ED_TUMG.DEC_VOR_EINTRAG K_ED_TUMG.FEHLERSCHWELLE K_ED_TUMG.INC_NACH_EINTRAG K_ED_TUMG.INC_VOR_EINTRAG K_ED_TUMG.KLASSENINDEX K_ED_TUMG.OK_SCHWELLE K_ED_TUMG.P_CODE_OPENLOAD K_ED_TUMG.P_CODE_SH_TO_GND K_ED_TUMG.P_CODE_SH_TO_UB K_ED_TUMG.P_CODE_UNPLAUSIBEL K_ED_TUMG_OBD.DEC_NACH_EINTRAG K_ED_TUMG_OBD.DEC_VOR_EINTRAG K_ED_TUMG_OBD.FEHLERSCHWELLE K_ED_TUMG_OBD.INC_NACH_EINTRAG K_ED_TUMG_OBD.INC_VOR_EINTRAG K_ED_TUMG_OBD.KLASSENINDEX K_ED_TUMG_OBD.OK_SCHWELLE K_ED_TUMG_OBD.P_CODE_OPENLOAD K_ED_TUMG_OBD.P_CODE_SH_TO_GND K_ED_TUMG_OBD.P_CODE_SH_TO_UB K_ED_TUMG_OBD.P_CODE_UNPLAUSIBEL K_ED_UB.DEC_NACH_EINTRAG K_ED_UB.DEC_VOR_EINTRAG K_ED_UB.FEHLERSCHWELLE K_ED_UB.INC_NACH_EINTRAG K_ED_UB.INC_VOR_EINTRAG K_ED_UB.KLASSENINDEX K_ED_UB.OK_SCHWELLE K_ED_UB.P_CODE_OPENLOAD K_ED_UB.P_CODE_SH_TO_GND K_ED_UB.P_CODE_SH_TO_UB K_ED_UB.P_CODE_UNPLAUSIBEL K_ED_UBMIN K_ED_UEXT_111219514.DEC_NACH_EINTRAG K_ED_UEXT_111219514.DEC_VOR_EINTRAG K_ED_UEXT_111219514.FEHLERSCHWELLE K_ED_UEXT_111219514.INC_NACH_EINTRAG K_ED_UEXT_111219514.INC_VOR_EINTRAG K_ED_UEXT_111219514.KLASSENINDEX K_ED_UEXT_111219514.OK_SCHWELLE K_ED_UEXT_111219514.P_CODE_OPENLOAD K_ED_UEXT_111219514.P_CODE_SH_TO_GND K_ED_UEXT_111219514.P_CODE_SH_TO_UB K_ED_UEXT_111219514.P_CODE_UNPLAUSIBEL K_ED_UEXT_124_512.DEC_NACH_EINTRAG K_ED_UEXT_124_512.DEC_VOR_EINTRAG K_ED_UEXT_124_512.FEHLERSCHWELLE K_ED_UEXT_124_512.INC_NACH_EINTRAG K_ED_UEXT_124_512.INC_VOR_EINTRAG K_ED_UEXT_124_512.KLASSENINDEX K_ED_UEXT_124_512.OK_SCHWELLE K_ED_UEXT_124_512.P_CODE_OPENLOAD K_ED_UEXT_124_512.P_CODE_SH_TO_GND K_ED_UEXT_124_512.P_CODE_SH_TO_UB K_ED_UEXT_124_512.P_CODE_UNPLAUSIBEL K_ED_V_DIREKT.DEC_NACH_EINTRAG K_ED_V_DIREKT.DEC_VOR_EINTRAG K_ED_V_DIREKT.FEHLERSCHWELLE K_ED_V_DIREKT.INC_NACH_EINTRAG K_ED_V_DIREKT.INC_VOR_EINTRAG K_ED_V_DIREKT.KLASSENINDEX K_ED_V_DIREKT.OK_SCHWELLE K_ED_V_DIREKT.P_CODE_OPENLOAD K_ED_V_DIREKT.P_CODE_SH_TO_GND K_ED_V_DIREKT.P_CODE_SH_TO_UB K_ED_V_DIREKT.P_CODE_UNPLAUSIBEL K_ED_WUC_DELTA_TMOT K_ED_WUC_TMOT_MIN K_ED_ZOELP1.DEC_NACH_EINTRAG K_ED_ZOELP1.DEC_VOR_EINTRAG K_ED_ZOELP1.FEHLERSCHWELLE K_ED_ZOELP1.INC_NACH_EINTRAG K_ED_ZOELP1.INC_VOR_EINTRAG K_ED_ZOELP1.KLASSENINDEX K_ED_ZOELP1.OK_SCHWELLE K_ED_ZOELP1.P_CODE_OPENLOAD K_ED_ZOELP1.P_CODE_SH_TO_GND K_ED_ZOELP1.P_CODE_SH_TO_UB K_ED_ZOELP1.P_CODE_UNPLAUSIBEL K_ED_ZOELP2.DEC_NACH_EINTRAG K_ED_ZOELP2.DEC_VOR_EINTRAG K_ED_ZOELP2.FEHLERSCHWELLE K_ED_ZOELP2.INC_NACH_EINTRAG K_ED_ZOELP2.INC_VOR_EINTRAG K_ED_ZOELP2.KLASSENINDEX K_ED_ZOELP2.OK_SCHWELLE K_ED_ZOELP2.P_CODE_OPENLOAD K_ED_ZOELP2.P_CODE_SH_TO_GND K_ED_ZOELP2.P_CODE_SH_TO_UB K_ED_ZOELP2.P_CODE_UNPLAUSIBEL /end DEF_CHARACTERISTIC
/end FUNCTION
/begin FUNCTION Ercosek_SC "" /begin DEF_CHARACTERISTIC K_DIAGNOSE_INDEX_HI K_DIAGNOSE_INDEX_LO /end DEF_CHARACTERISTIC /begin REF_CHARACTERISTIC /end REF_CHARACTERISTIC /begin IN_MEASUREMENT /end IN_MEASUREMENT
 /begin OUT_MEASUREMENT ccp_aramStatus ccp_checksum ccp_moveStatus ccp_reqSwitch ccp_stateChecksum stack_status stack_usedErcosek stack_usedUser tm_100ms.dT tm_100ms.lastTask tm_100ms.maxTime tm_100ms.netTime tm_10ms.dT tm_10ms.lastTask tm_10ms.maxTime tm_10ms.netTime tm_5ms.dT tm_5ms.lastTask tm_5ms.maxTime tm_5ms.netTime tm_Sync1.dT tm_Sync1.lastTask tm_Sync1.maxTime tm_Sync1.netTime tm_Sync2.dT tm_Sync2.lastTask tm_Sync2.maxTime tm_Sync2.netTime tm_bgnd.dT tm_bgnd.grossRunTime tm_bgnd.lastTask tm_bgnd.maxTime tm_bgnd.netTime /end OUT_MEASUREMENT
/end FUNCTION
/begin FUNCTION FGR ""
 /begin DEF_CHARACTERISTIC KF_FGR_FAK_V_WA KF_FGR_KR KF_FGR_KR_CONST KF_FGR_TN KF_FGR_TN_CONST KF_FGR_TV KF_FGR_TV_CONST KF_FGR_VORST KF_FGR_VORST_UP KL_FGR_FAK_T_BESCHL KL_FGR_FAK_T_VERZ KL_FGR_FAK_T_WA KL_FGR_FAK_V_TIP KL_FGR_KOEFF_WICHT KL_FGR_KR_FAK KL_FGR_MD_FW_LL KL_FGR_MD_RAMPE_DELTA KL_FGR_TN_FAK KL_FGR_TV_FAK KL_FGR_VAHA_DIAG KL_FGR_VERZ_WA KL_FGR_V_FIL_A1 KL_FGR_V_FIL_B1 KL_FGR_V_FIL_B2 KL_FGR_V_SA_SPERRE K_FGR_A1 K_FGR_AX_MAX K_FGR_AX_TAU K_FGR_BESCHL_KOMFORT K_FGR_BESCHL_NORMAL K_FGR_BESCHL_SPORT K_FGR_BESCHL_TIP K_FGR_BESCHL_WA_KOMFORT K_FGR_BESCHL_WA_NORMAL K_FGR_BESCHL_WA_SPORT K_FGR_CFG_VORST K_FGR_CFG_V_IST K_FGR_CFG_V_MAX K_FGR_DSC_BLS_T K_FGR_DSC_MD_BLS_T K_FGR_DSC_MD_T K_FGR_EIN K_FGR_FAK_V_KOMFORT K_FGR_FAK_V_MAX K_FGR_FAK_V_MIN K_FGR_FAK_V_NORMAL K_FGR_FAK_V_SPORT K_FGR_FAK_V_TIP K_FGR_FSP_EIN K_FGR_MARKE_CFG K_FGR_MD_DELTA K_FGR_MD_FW_HYS K_FGR_MD_FW_LL_HYS K_FGR_MSW_T_MIN K_FGR_N_DIF_DIAG_T K_FGR_N_DIF_MAX K_FGR_N_MAX K_FGR_SMG_MCS K_FGR_STATE_AG K_FGR_STEP_T_MIN K_FGR_STUFE_KMH K_FGR_STUFE_MPH K_FGR_TIP_T_MIN K_FGR_T_AUS K_FGR_T_CONSTF_RAMPE K_FGR_T_FEHLER_E2 K_FGR_T_MIN_SA K_FGR_T_STRICH K_FGR_T_UEBERHOL_MAX K_FGR_VAHA_DIAG_T K_FGR_VERZ K_FGR_VERZ_TIP K_FGR_V_DIAG K_FGR_V_DIAG_T K_FGR_V_DIF_MAX K_FGR_V_DIF_MAX_AUFST K_FGR_V_DIF_MAX_LL K_FGR_V_DIF_MIN K_FGR_V_DIF_MIN_AUFST K_FGR_V_DIF_MIN_LL K_FGR_V_DIF_MIN_UEBERHOL K_FGR_V_FEHLER_T K_FGR_V_IST_MIN K_FGR_V_IST_TAU K_FGR_V_MAX K_FGR_V_SOLL_DIF_KONST K_FGR_V_SOLL_DIF_MAX K_FGR_V_SOLL_DIF_MIN K_FGR_V_SOLL_MAX_HYS K_FGR_V_SOLL_MAX_KMH K_FGR_V_SOLL_MAX_MPH K_FGR_V_SOLL_MAX_T K_FGR_V_SOLL_MIN_KMH K_FGR_V_SOLL_MIN_KMH_E2 K_FGR_V_SOLL_MIN_MPH K_FGR_V_SOLL_MIN_MPH_E2 K_FGR_V_SOLL_OFFSET K_FGR_V_TIP_INC_DEC /end DEF_CHARACTERISTIC
 /begin REF_CHARACTERISTIC /end REF_CHARACTERISTIC
 /begin IN_MEASUREMENT /end IN_MEASUREMENT
 /begin OUT_MEASUREMENT fgr_a1 fgr_ax_ist fgr_ax_neg_soll fgr_ax_pos_soll fgr_b0 fgr_b1 fgr_b2 fgr_b_dsc_eingriff fgr_b_dsc_reg_abs_asc_msr fgr_b_dsc_reg_dsc fgr_b_dsc_reg_eingriff fgr_b_dsc_soft_off fgr_b_fehler_e2 fgr_b_rgl_init fgr_b_smg_rs fgr_b_ueberhol_anf fgr_b_wa_first fgr_can_stat_msw fgr_fak_t_aktiv fgr_fak_v_veh_soll fgr_fil_a1 fgr_fil_b1 fgr_fil_b2 fgr_fsp_code fgr_hud_aus fgr_hud_bedien fgr_hud_state fgr_init_beschl_set fgr_init_verzoeg_set fgr_kr fgr_kw fgr_md_fw_fgr_sum fgr_md_fw_roh fgr_md_fw_sa fgr_n_dif fgr_stat_abschalten fgr_stat_anf_msw fgr_stat_hard_off_irr fgr_stat_hard_off_irr_old fgr_stat_hard_off_rev fgr_stat_soft_off_rev fgr_status_can fgr_status_stufe fgr_t_aktiv fgr_t_constfahrt fgr_t_err_v_veh fgr_t_kli fgr_t_ueberhol fgr_tn fgr_tv fgr_v_soll_max fgr_v_soll_min fgr_v_tacho_fil fgr_v_veh_dif fgr_v_veh_fil fgr_v_veh_ist fgr_v_veh_kombi fgr_v_veh_soll fgr_v_veh_soll_dec fgr_v_veh_soll_dec_akt fgr_v_veh_soll_dif fgr_v_veh_soll_dif_roh fgr_v_veh_soll_inc fgr_v_veh_soll_inc_akt fgr_v_veh_soll_roh fgr_v_veh_stufe fgr_v_veh_ziel /end OUT_MEASUREMENT
/end FUNCTION
/begin FUNCTION Fahrzeuggeschwindigkeit ""
 /begin DEF_CHARACTERISTIC K_VDIAG_DN_OHNE_V K_VDIAG_GRAD_MAX K_VDIAG_OFFSET K_VDIAG_SA_OHNE_V K_VDIAG_VMAX K_V_DIREKT_FAK K_V_DIREKT_TAU K_V_MAX_E2 K_V_MAX_NEG_GRAD_E2 K_V_MAX_POS_GRAD_E2 K_V_MIN_E2 /end DEF_CHARACTERISTIC
 /begin REF_CHARACTERISTIC /end REF_CHARACTERISTIC
 /begin IN_MEASUREMENT /end IN_MEASUREMENT
 /begin OUT_MEASUREMENT v_direkt_fil v_direkt_period v_direkt_roh v_direkt_t_sa v_direkt_timeout v_direkt_weg v_e2 /end OUT_MEASUREMENT
/end FUNCTION
/begin FUNCTION Flashservice "" /begin DEF_CHARACTERISTIC /end DEF_CHARACTERISTIC /begin REF_CHARACTERISTIC /end REF_CHARACTERISTIC /begin IN_MEASUREMENT /end IN_MEASUREMENT /begin OUT_MEASUREMENT /end OUT_MEASUREMENT /end FUNCTION
/begin FUNCTION Fuellungsadaption ""
 /begin DEF_CHARACTERISTIC KL_FRA_XSI_PSAU K_FRA_AQ_ADAPT_MAX K_FRA_AQ_ADAPT_MIN K_FRA_AQ_DELTA_FAST K_FRA_AQ_DELTA_SLOW K_FRA_AQ_MAX_FAST K_FRA_AQ_MAX_SLOW K_FRA_CFG K_FRA_FR_I_REG_SCHW K_FRA_GRUNDLECKLUFT K_FRA_RF_DELTA_SCHW K_FRA_RF_MAX K_FRA_TMOT_SCHW K_FRA_WAIT /end DEF_CHARACTERISTIC
 /begin REF_CHARACTERISTIC /end REF_CHARACTERISTIC
 /begin IN_MEASUREMENT /end IN_MEASUREMENT
 /begin OUT_MEASUREMENT fra_aq_adapt_b1 fra_aq_adapt_b2 fra_aqmax fra_sperr_st_b1 fra_sperr_st_b2 fra_wait_b1 fra_wait_b2 fra_zust_b1 fra_zust_b2 /end OUT_MEASUREMENT
/end FUNCTION
/begin FUNCTION Fuellungsregler ""
 /begin DEF_CHARACTERISTIC KF_FR_RF_DELTA_REL_HYS KL_FR_DRREL_MAX_N KL_FR_IANT K_FR_ADAPT_SCHW_1of8_ K_FR_ADAPT_SCHW_2of8_ K_FR_ADAPT_SCHW_3of8_ K_FR_ADAPT_SCHW_4of8_ K_FR_ADAPT_SCHW_5of8_ K_FR_ADAPT_SCHW_6of8_ K_FR_ADAPT_SCHW_7of8_ K_FR_ADAPT_SCHW_8of8_ K_FR_ADAPT_TAU K_FR_CFG K_FR_DI_ENTDR K_FR_DRREL_MAX K_FR_EDK_DIFF K_FR_EINGER_HYS K_FR_EINGER_SCHW K_FR_IMAX K_FR_IMIN K_FR_START_DELAY /end DEF_CHARACTERISTIC
 /begin REF_CHARACTERISTIC /end REF_CHARACTERISTIC
 /begin IN_MEASUREMENT /end IN_MEASUREMENT
 /begin OUT_MEASUREMENT fr_ant_i_b1 fr_ant_i_b2 fr_dr_rel_schw fr_reg_i_b1 fr_reg_i_b2 fr_rf_delta_b1 fr_rf_delta_b2 fr_rf_delta_rel_b1 fr_rf_delta_rel_b2 fr_rf_delta_rel_hys fr_zust_b1 fr_zust_b2 /end OUT_MEASUREMENT
/end FUNCTION
/begin FUNCTION GETR ""
 /begin DEF_CHARACTERISTIC K_N_GETR_ABTRIEB_MAX K_N_GETR_ABTRIEB_MIN K_N_GETR_CFG K_N_GETR_F_HS K_N_GETR_HS_DIAG_N K_N_GETR_HS_DIAG_N_KS K_N_GETR_HS_DIAG_T K_N_GETR_MAX_PERIOD_HS /end DEF_CHARACTERISTIC
 /begin REF_CHARACTERISTIC /end REF_CHARACTERISTIC
 /begin IN_MEASUREMENT /end IN_MEASUREMENT
 /begin OUT_MEASUREMENT n_getr_abtrieb_ersatz n_getr_abtrieb_ha n_getr_ein_ersatz n_getr_ein_hs n_getr_hs_diag_timer /end OUT_MEASUREMENT
/end FUNCTION
/begin FUNCTION Gangerkennung ""
 /begin DEF_CHARACTERISTIC KL_GANG_I_HS KL_GANG_I_SMG K_GANG_1_TIMER_MAX K_GANG_GLG_TIMER_MAX K_GANG_I_HA_ADAPT_CNT_MAX K_GANG_I_HA_ADAPT_GANG_MAX_HS K_GANG_I_HA_ADAPT_GANG_MIN_HS K_GANG_I_HA_ADAPT_MAX K_GANG_I_HA_ADAPT_MD_MAX_HS K_GANG_I_HA_ADAPT_MD_MIN_HS K_GANG_I_HA_ADAPT_MIN K_GANG_I_HA_ADAPT_SCHLUPF_MIN_HS K_GANG_I_HA_ADAPT_V_MAX_HS K_GANG_I_HA_ADAPT_V_MIN_HS K_GANG_I_HA_HS K_GANG_I_HA_SMG K_GANG_I_RW_HS K_GANG_I_RW_SMG K_GANG_N_VERH_MAX K_GANG_N_VERH_MIN K_GANG_R_RAD_DYN_NV /end DEF_CHARACTERISTIC
 /begin REF_CHARACTERISTIC /end REF_CHARACTERISTIC
 /begin IN_MEASUREMENT /end IN_MEASUREMENT
 /begin OUT_MEASUREMENT gang_1_timer gang_berech_kl gang_berech_neu_verz gang_berech_roh gang_can_sperre_irre gang_can_sperre_irre_cnt gang_glg_getr_verz gang_glg_timer gang_i gang_i_ha_adapt_avg gang_i_ha_adapt_cnt gang_i_ha_adapt_st gang_i_ha_adapt_st_freigabe gang_i_ha_adapt_st_gueltig gang_i_ha_adapt_st_verfuegbar gang_i_ha_adapt_sum gang_i_rad gang_ik gang_il gang_r_rad_dyn_nv gang_richtung gang_richtung_cnt /end OUT_MEASUREMENT
/end FUNCTION
/begin RECORD_LAYOUT TKW_VV_VV_UB FNC_VALUES 1 UBYTE COLUMN_DIR DIRECT /end RECORD_LAYOUT
/begin RECORD_LAYOUT TKW_VV_VV_SB FNC_VALUES 1 SBYTE COLUMN_DIR DIRECT /end RECORD_LAYOUT
/begin RECORD_LAYOUT TKW_VV_VV_UW FNC_VALUES 1 UWORD COLUMN_DIR DIRECT /end RECORD_LAYOUT
/begin RECORD_LAYOUT TKW_VV_VV_SW FNC_VALUES 1 SWORD COLUMN_DIR DIRECT /end RECORD_LAYOUT
/begin RECORD_LAYOUT TKW_VV_VV_UL FNC_VALUES 1 ULONG COLUMN_DIR DIRECT /end RECORD_LAYOUT
/begin RECORD_LAYOUT TKL_UB_VV_UB NO_AXIS_PTS_X 1 UBYTE RESERVED 2 BYTE AXIS_PTS_X 3 UBYTE INDEX_INCR DIRECT FNC_VALUES 4 UBYTE COLUMN_DIR DIRECT /end RECORD_LAYOUT
/begin RECORD_LAYOUT TKL_UW_VV_UW NO_AXIS_PTS_X 1 UBYTE RESERVED 2 BYTE AXIS_PTS_X 3 UWORD INDEX_INCR DIRECT FNC_VALUES 4 UWORD COLUMN_DIR DIRECT /end RECORD_LAYOUT
/begin RECORD_LAYOUT TKL_UW_VV_SW NO_AXIS_PTS_X 1 UBYTE RESERVED 2 BYTE AXIS_PTS_X 3 UWORD INDEX_INCR DIRECT FNC_VALUES 4 SWORD COLUMN_DIR DIRECT /end RECORD_LAYOUT
/begin RECORD_LAYOUT TKL_SW_VV_UB NO_AXIS_PTS_X 1 UBYTE RESERVED 2 BYTE AXIS_PTS_X 3 SWORD INDEX_INCR DIRECT FNC_VALUES 4 UBYTE COLUMN_DIR DIRECT /end RECORD_LAYOUT
/begin RECORD_LAYOUT TKL_SW_VV_UW NO_AXIS_PTS_X 1 UBYTE RESERVED 2 BYTE AXIS_PTS_X 3 SWORD INDEX_INCR DIRECT FNC_VALUES 4 UWORD COLUMN_DIR DIRECT /end RECORD_LAYOUT
/begin RECORD_LAYOUT TKL_SW_VV_SW NO_AXIS_PTS_X 1 UBYTE RESERVED 2 BYTE AXIS_PTS_X 3 SWORD INDEX_INCR DIRECT FNC_VALUES 4 SWORD COLUMN_DIR DIRECT /end RECORD_LAYOUT
/begin RECORD_LAYOUT TKF_SW_SW_UB NO_AXIS_PTS_X 1 UBYTE NO_AXIS_PTS_Y 2 UBYTE AXIS_PTS_X 3 SWORD INDEX_INCR DIRECT AXIS_PTS_Y 4 SWORD INDEX_INCR DIRECT FNC_VALUES 5 UBYTE COLUMN_DIR DIRECT /end RECORD_LAYOUT
/begin RECORD_LAYOUT TKF_SW_SW_UW NO_AXIS_PTS_X 1 UBYTE NO_AXIS_PTS_Y 2 UBYTE AXIS_PTS_X 3 SWORD INDEX_INCR DIRECT AXIS_PTS_Y 4 SWORD INDEX_INCR DIRECT FNC_VALUES 5 UWORD COLUMN_DIR DIRECT /end RECORD_LAYOUT
/begin RECORD_LAYOUT TKF_SW_SW_SW NO_AXIS_PTS_X 1 UBYTE NO_AXIS_PTS_Y 2 UBYTE AXIS_PTS_X 3 SWORD INDEX_INCR DIRECT AXIS_PTS_Y 4 SWORD INDEX_INCR DIRECT FNC_VALUES 5 SWORD COLUMN_DIR DIRECT /end RECORD_LAYOUT
/end MODULE
/end PROJECT
