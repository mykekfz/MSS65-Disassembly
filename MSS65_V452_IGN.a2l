/begin PROJECT MSS65-ign-V452 "MSS65 IGN - V452.01-B204.00, data set 0569Q60Z160E"
/begin HEADER "" VERSION "V452.01-B204.00" /end HEADER
/begin MODULE _MSS65-ign "MSS65 IGN - V452.01-B204.00, calibration xxxxxxxx"
/begin MOD_COMMON "" BYTE_ORDER MSB_FIRST /* Default byteorder (Motorola) */ /end MOD_COMMON
/* TPU KW FORMELN ------------------------------------------------------------------------*/
/begin COMPU_METHOD FORMULA_KW1 "FORMULA_KW1" RAT_FUNC "%5.0" "-" COEFFS 0 256 0 0 0 1 /end COMPU_METHOD
/begin COMPU_METHOD FORMULA_KW3 "FORMULA_KW3" TAB_VERB "%5.0" "-" COMPU_TAB_REF FORMULA_KW3_VTAB /end COMPU_METHOD
/begin COMPU_VTAB FORMULA_KW3_VTAB "FORMULA_KW3_VTAB" TAB_VERB 13 0 "ini" 1 "1st edge" 2 "second edge" 3 "wait teeth" 4 "search gap" 5 "1st missing required" 6 "last tooth until gap" 7 "1st missing tooth" 8 "2nd missing tooth" 9 "1st tooth after gap" 10 "2nd tooth after gap" 11 "tooth 2..56, 62..116" 12 "gap required" DEFAULT_VALUE "1 undefined" /end COMPU_VTAB
/begin COMPU_METHOD FORMULA_KW4 "FORMULA_KW4" RAT_FUNC "%5.0" "-" COEFFS 0 1 0 0 0 1 /end COMPU_METHOD
/begin COMPU_METHOD FORMULA_KW5 "FORMULA_KW5" RAT_FUNC "%5.0" "Upm" COEFFS 0 0 27344 0 1 0 /end COMPU_METHOD
/begin COMPU_METHOD FORMULA_KW6 "FORMULA_KW6" RAT_FUNC "%6.4" "�" COEFFS 0 1 0 0 0 0.00004291534423828125 /end COMPU_METHOD
/begin COMPU_METHOD FORMULA_KW8 "FORMULA_KW8" RAT_FUNC "%9.2" "ms" COEFFS 0 7000 0 0 0 1 /end COMPU_METHOD
/begin COMPU_METHOD FORMULA_KW9 "FORMULA_KW9" RAT_FUNC "%7.2" "ms" COEFFS 0 1 0 0 0 2.34057 /end COMPU_METHOD
/begin COMPU_METHOD FORMULA_KW10 "FORMULA_KW10" RAT_FUNC "%7.2" "�" COEFFS 0 1 0 0 0 0.01098633 /end COMPU_METHOD
/begin COMPU_METHOD FORMULA_KW11 "FORMULA_KW11" RAT_FUNC "%7.2" "ms" COEFFS 0 7000 0 0 0 1 /end COMPU_METHOD
/begin COMPU_METHOD FORMULA_KW12 "FORMULA_KW12" RAT_FUNC "%9.2" "ms" COEFFS 0 7000 0 0 0 256 /end COMPU_METHOD
/begin COMPU_METHOD FORMULA_KW13 "FORMULA_KW13" RAT_FUNC "%12.2" "ms" COEFFS 0 840000 0 0 0 1 /end COMPU_METHOD
/* TPU KW A ------------------------------------------------------------------------------*/
/begin MEASUREMENT tpu_a_kw_irq "Interrupt request." UWORD FORMULA_KW1 0 0 0.0 255.0000 ECU_ADDRESS 0x304100 /begin FUNCTION_LIST TPU /end FUNCTION_LIST BIT_MASK 0xFF00 /end MEASUREMENT
/begin MEASUREMENT tpu_a_kw_state "Zustand." UWORD FORMULA_KW3 0 0 0.0 15.0 ECU_ADDRESS 0x304100 /begin FUNCTION_LIST TPU /end FUNCTION_LIST BIT_MASK 0x000F /end MEASUREMENT
/begin MEASUREMENT tpu_a_kw_irq_ack "Interruptquittierung." UWORD FORMULA_KW1 0 0 0.0 255.0000 ECU_ADDRESS 0x304102 /begin FUNCTION_LIST TPU /end FUNCTION_LIST BIT_MASK 0xFF00 /end MEASUREMENT
/begin MEASUREMENT tpu_a_kw_irq_zahn "Interruptzahn." UWORD FORMULA_KW4 0 0 0.0 119.0000 ECU_ADDRESS 0x304102 /begin FUNCTION_LIST TPU /end FUNCTION_LIST BIT_MASK 0x00FF /end MEASUREMENT
/begin MEASUREMENT tpu_a_kw_time_out "Unterdrehzahl." UWORD FORMULA_KW5 0 0 4.0000 10000.0000 ECU_ADDRESS 0x304104 /begin FUNCTION_LIST TPU /end FUNCTION_LIST /end MEASUREMENT
/begin MEASUREMENT tpu_a_kw_link "Link-Vektor." UWORD FORMULA_KW4 0 0 0.0 65535.0000 ECU_ADDRESS 0x304106 /begin FUNCTION_LIST TPU /end FUNCTION_LIST /end MEASUREMENT
/begin MEASUREMENT tpu_a_kw_segm_start "Segmentstart." UWORD FORMULA_KW1 0 0 0.0 119.0000 ECU_ADDRESS 0x304108 /begin FUNCTION_LIST TPU /end FUNCTION_LIST BIT_MASK 0xFF00 /end MEASUREMENT
/begin MEASUREMENT tpu_a_kw_segm_length "Segmentlaenge." UWORD FORMULA_KW4 0 0 0.0 119.0000 ECU_ADDRESS 0x304108 /begin FUNCTION_LIST TPU /end FUNCTION_LIST BIT_MASK 0x00FF /end MEASUREMENT
/begin MEASUREMENT tpu_a_kw_max_teeth_unsync "Max Anzahl Flanken zur Lueckensuche." UWORD FORMULA_KW1 0 0 0.0 127.0000 ECU_ADDRESS 0x30410A /begin FUNCTION_LIST TPU /end FUNCTION_LIST BIT_MASK 0xFF00 /end MEASUREMENT
/begin MEASUREMENT tpu_a_kw_cnt_cor "Feinaufloesung vom Zahnzaehler." UWORD FORMULA_KW6 0 0 0.0 42747.6900 ECU_ADDRESS 0x30410A /begin FUNCTION_LIST TPU /end FUNCTION_LIST BIT_MASK 0xFF00 /end MEASUREMENT
/begin MEASUREMENT tpu_a_kw_wait_teeth "Zahnentprellung vor Lueckensuche." UWORD FORMULA_KW4 0 0 0.0 127.0000 ECU_ADDRESS 0x30410A /begin FUNCTION_LIST TPU /end FUNCTION_LIST BIT_MASK 0x00FF /end MEASUREMENT
/begin MEASUREMENT tpu_a_kw_next_segm_tooth "Naechster Segmentzahn." UWORD FORMULA_KW4 0 0 0.0 119.0000 ECU_ADDRESS 0x30410A /begin FUNCTION_LIST TPU /end FUNCTION_LIST BIT_MASK 0x00FF /end MEASUREMENT
/begin MEASUREMENT tpu_a_kw_cnt_720 "720� Zahnzaehler." UWORD FORMULA_KW1 0 0 0.0 119.0000 ECU_ADDRESS 0x30410C /begin FUNCTION_LIST TPU /end FUNCTION_LIST BIT_MASK 0xFF00 /end MEASUREMENT
/begin MEASUREMENT tpu_a_kw_segm_zeit "Segmentzeitpunkt." ULONG FORMULA_KW8 0 0 0.0 2396.7450 ECU_ADDRESS 0x30410C /begin FUNCTION_LIST TPU /end FUNCTION_LIST BIT_MASK 0x00FFFFFF /end MEASUREMENT
/begin MEASUREMENT tpu_a_htu "Hight-Time-Updater." UWORD FORMULA_KW9 0 0 0.0 2394.4031 ECU_ADDRESS 0x304110 /begin FUNCTION_LIST TPU /end FUNCTION_LIST /end MEASUREMENT
/begin MEASUREMENT tpu_a_kw_count "Kurbelwellenposition." UWORD FORMULA_KW10 0 0 0.0 719.9890 ECU_ADDRESS 0x304112 /begin FUNCTION_LIST TPU /end FUNCTION_LIST /end MEASUREMENT
/begin MEASUREMENT tpu_a_kw_last_period_low "16 lsb der letzten Periode." UWORD FORMULA_KW11 0 0 0.0 9.3621 ECU_ADDRESS 0x304114 /begin FUNCTION_LIST TPU /end FUNCTION_LIST /end MEASUREMENT
/begin MEASUREMENT tpu_a_kw_last_period_high "8 msb der letzten Periode." UWORD FORMULA_KW12 0 0 0.0 255.0000 ECU_ADDRESS 0x304116 /begin FUNCTION_LIST TPU /end FUNCTION_LIST BIT_MASK 0xFF00 /end MEASUREMENT
/begin MEASUREMENT tpu_a_kw_prev_period "Vorhergehende Periode." ULONG FORMULA_KW8 0 0 0.0 2396.7450 ECU_ADDRESS 0x304116 /begin FUNCTION_LIST TPU /end FUNCTION_LIST BIT_MASK 0x00FFFFFF /end MEASUREMENT
/begin MEASUREMENT tpu_a_kw_norm_period "normierte Periode." ULONG FORMULA_KW13 0 0 0.0 2396.7450 ECU_ADDRESS 0x30411A /begin FUNCTION_LIST TPU /end FUNCTION_LIST BIT_MASK 0xFFFFFF00 /end MEASUREMENT
/begin MEASUREMENT tpu_a_kw_last_event_time "Zeitpunkt vom letzten Ereignis." ULONG FORMULA_KW8 0 0 0.0 2396.7450 ECU_ADDRESS 0x30411C /begin FUNCTION_LIST TPU /end FUNCTION_LIST BIT_MASK 0x00FFFFFF /end MEASUREMENT
/begin MEASUREMENT tpu_a_kw_last_trans_time "Zeitpunkt letzter Zahnflanke." ULONG FORMULA_KW8 0 0 0.0 2396.7450 ECU_ADDRESS 0x3041DA /begin FUNCTION_LIST TPU /end FUNCTION_LIST BIT_MASK 0x00FFFFFF /end MEASUREMENT
/* TPU KW B ------------------------------------------------------------------------------*/
/begin MEASUREMENT tpu_b_kw_irq "Interrupt request." UWORD FORMULA_KW1 0 0 0.0 255.0000 ECU_ADDRESS 0x304500 /begin FUNCTION_LIST TPU /end FUNCTION_LIST BIT_MASK 0xFF00 /end MEASUREMENT
/begin MEASUREMENT tpu_b_kw_state "Zustand." UWORD FORMULA_KW3 0 0 0.0 15.0 ECU_ADDRESS 0x304500 /begin FUNCTION_LIST TPU /end FUNCTION_LIST BIT_MASK 0x000F /end MEASUREMENT
/begin MEASUREMENT tpu_b_kw_irq_ack "Interruptquittierung." UWORD FORMULA_KW1 0 0 0.0 255.0000 ECU_ADDRESS 0x304502 /begin FUNCTION_LIST TPU /end FUNCTION_LIST BIT_MASK 0xFF00 /end MEASUREMENT
/begin MEASUREMENT tpu_b_kw_irq_zahn "Interruptzahn." UWORD FORMULA_KW4 0 0 0.0 119.0000 ECU_ADDRESS 0x304502 /begin FUNCTION_LIST TPU /end FUNCTION_LIST BIT_MASK 0x00FF /end MEASUREMENT
/begin MEASUREMENT tpu_b_kw_time_out "Unterdrehzahl." UWORD FORMULA_KW5 0 0 4.0000 10000.0000 ECU_ADDRESS 0x304504 /begin FUNCTION_LIST TPU /end FUNCTION_LIST /end MEASUREMENT
/begin MEASUREMENT tpu_b_kw_link "Link-Vektor." UWORD FORMULA_KW4 0 0 0.0 65535.0000 ECU_ADDRESS 0x304506 /begin FUNCTION_LIST TPU /end FUNCTION_LIST /end MEASUREMENT
/begin MEASUREMENT tpu_b_kw_segm_start "Segmentstart." UWORD FORMULA_KW1 0 0 0.0 119.0000 ECU_ADDRESS 0x304508 /begin FUNCTION_LIST TPU /end FUNCTION_LIST BIT_MASK 0xFF00 /end MEASUREMENT
/begin MEASUREMENT tpu_b_kw_segm_length "Segmentlaenge." UWORD FORMULA_KW4 0 0 0.0 119.0000 ECU_ADDRESS 0x304508 /begin FUNCTION_LIST TPU /end FUNCTION_LIST BIT_MASK 0x00FF /end MEASUREMENT
/begin MEASUREMENT tpu_b_kw_max_teeth_unsync "Max Anzahl Flanken zur Lueckensuche." UWORD FORMULA_KW1 0 0 0.0 127.0000 ECU_ADDRESS 0x30450A /begin FUNCTION_LIST TPU /end FUNCTION_LIST BIT_MASK 0xFF00 /end MEASUREMENT
/begin MEASUREMENT tpu_b_kw_cnt_cor "Feinaufloesung vom Zahnzaehler." UWORD FORMULA_KW6 0 0 0.0 42747.6900 ECU_ADDRESS 0x30450A /begin FUNCTION_LIST TPU /end FUNCTION_LIST BIT_MASK 0xFF00 /end MEASUREMENT
/begin MEASUREMENT tpu_b_kw_wait_teeth "Zahnentprellung vor Lueckensuche." UWORD FORMULA_KW4 0 0 0.0 127.0000 ECU_ADDRESS 0x30450A /begin FUNCTION_LIST TPU /end FUNCTION_LIST BIT_MASK 0x00FF /end MEASUREMENT
/begin MEASUREMENT tpu_b_kw_next_segm_tooth "Naechster Segmentzahn." UWORD FORMULA_KW4 0 0 0.0 119.0000 ECU_ADDRESS 0x30450A /begin FUNCTION_LIST TPU /end FUNCTION_LIST BIT_MASK 0x00FF /end MEASUREMENT
/begin MEASUREMENT tpu_b_kw_cnt_720 "720� Zahnzaehler." UWORD FORMULA_KW1 0 0 0.0 119.0000 ECU_ADDRESS 0x30450C /begin FUNCTION_LIST TPU /end FUNCTION_LIST BIT_MASK 0xFF00 /end MEASUREMENT
/begin MEASUREMENT tpu_b_kw_segm_zeit "Segmentzeitpunkt." ULONG FORMULA_KW8 0 0 0.0 2396.7450 ECU_ADDRESS 0x30450C /begin FUNCTION_LIST TPU /end FUNCTION_LIST BIT_MASK 0x00FFFFFF /end MEASUREMENT
/begin MEASUREMENT tpu_b_htu "Hight-Time-Updater." UWORD FORMULA_KW9 0 0 0.0 2394.4031 ECU_ADDRESS 0x304510 /begin FUNCTION_LIST TPU /end FUNCTION_LIST /end MEASUREMENT
/begin MEASUREMENT tpu_b_kw_count "Kurbelwellenposition." UWORD FORMULA_KW10 0 0 0.0 719.9890 ECU_ADDRESS 0x304512 /begin FUNCTION_LIST TPU /end FUNCTION_LIST /end MEASUREMENT
/begin MEASUREMENT tpu_b_kw_last_period_low "16 lsb der letzten Periode." UWORD FORMULA_KW11 0 0 0.0 9.3621 ECU_ADDRESS 0x304514 /begin FUNCTION_LIST TPU /end FUNCTION_LIST /end MEASUREMENT
/begin MEASUREMENT tpu_b_kw_last_period_high "8 msb der letzten Periode." UWORD FORMULA_KW12 0 0 0.0 255.0000 ECU_ADDRESS 0x304516 /begin FUNCTION_LIST TPU /end FUNCTION_LIST BIT_MASK 0xFF00 /end MEASUREMENT
/begin MEASUREMENT tpu_b_kw_prev_period "Vorhergehende Periode." ULONG FORMULA_KW8 0 0 0.0 2396.7450 ECU_ADDRESS 0x304516 /begin FUNCTION_LIST TPU /end FUNCTION_LIST BIT_MASK 0x00FFFFFF /end MEASUREMENT
/begin MEASUREMENT tpu_b_kw_norm_period "normierte Periode." ULONG FORMULA_KW13 0 0 0.0 2396.7450 ECU_ADDRESS 0x30451A /begin FUNCTION_LIST TPU /end FUNCTION_LIST BIT_MASK 0xFFFFFF00 /end MEASUREMENT
/begin MEASUREMENT tpu_b_kw_last_event_time "Zeitpunkt vom letzten Ereignis." ULONG FORMULA_KW8 0 0 0.0 2396.7450 ECU_ADDRESS 0x30451C /begin FUNCTION_LIST TPU /end FUNCTION_LIST BIT_MASK 0x00FFFFFF /end MEASUREMENT
/begin MEASUREMENT tpu_b_kw_last_trans_time "Zeitpunkt letzter Zahnflanke." ULONG FORMULA_KW8 0 0 0.0 2396.7450 ECU_ADDRESS 0x3045DA /begin FUNCTION_LIST TPU /end FUNCTION_LIST BIT_MASK 0x00FFFFFF /end MEASUREMENT
/* TPU KW LU Messfenster -----------------------------------------------------------------*/
/begin MEASUREMENT tpu_b_kw_win_start_1 "Start Messfenster 1." UWORD FORMULA_KW1 0 0 0.0 119.0000 ECU_ADDRESS 0x3041CA /begin FUNCTION_LIST TPU /end FUNCTION_LIST BIT_MASK 0xFF00 /end MEASUREMENT
/begin MEASUREMENT tpu_b_kw_win_length_1 "Laenge Messfenster 1." UWORD FORMULA_KW4 0 0 0.0 119.0000 ECU_ADDRESS 0x3041CA /begin FUNCTION_LIST TPU /end FUNCTION_LIST BIT_MASK 0x00FF /end MEASUREMENT
/begin MEASUREMENT tpu_b_kw_win_temp_1 "Temp Zahn Messfenster 1." UWORD FORMULA_KW4 0 0 0.0 119.0000 ECU_ADDRESS 0x3041CE /begin FUNCTION_LIST TPU /end FUNCTION_LIST BIT_MASK 0x00FF /end MEASUREMENT
/begin MEASUREMENT tpu_b_kw_win_period_1 "Periode Messfenster 1." UWORD FORMULA_KW4 0 0 0.0 119.0000 ECU_ADDRESS 0x3041DC /begin FUNCTION_LIST TPU /end FUNCTION_LIST BIT_MASK 0x00FF /end MEASUREMENT
/begin MEASUREMENT tpu_b_kw_win_time_1 "Zeit Messfenster 1." ULONG FORMULA_KW8 0 0 0.0 2396.7450 ECU_ADDRESS 0x3041DC /begin FUNCTION_LIST TPU /end FUNCTION_LIST BIT_MASK 0x00FFFFFF /end MEASUREMENT
/begin MEASUREMENT tpu_b_kw_win_start_time_low_1 "16 LSB Zeitpunkt Start Messfenster 1." UWORD FORMULA_KW11 0 0 0.0 9.3621 ECU_ADDRESS 0x3041CC /begin FUNCTION_LIST TPU /end FUNCTION_LIST /end MEASUREMENT
/begin MEASUREMENT tpu_b_kw_win_start_time_high_1 "8 MSB Zeitpunkt Start Messfenster 1." UWORD FORMULA_KW12 0 0 0.0 255.0000 ECU_ADDRESS 0x3041CE /begin FUNCTION_LIST TPU /end FUNCTION_LIST BIT_MASK 0xFF00 /end MEASUREMENT
/begin MEASUREMENT tpu_b_kw_win_start_2 "Start Messfenster 2." UWORD FORMULA_KW1 0 0 0.0 119.0000 ECU_ADDRESS 0x3045CA /begin FUNCTION_LIST TPU /end FUNCTION_LIST BIT_MASK 0xFF00 /end MEASUREMENT
/begin MEASUREMENT tpu_b_kw_win_length_2 "Laenge Messfenster 2." UWORD FORMULA_KW4 0 0 0.0 119.0000 ECU_ADDRESS 0x3045CA /begin FUNCTION_LIST TPU /end FUNCTION_LIST BIT_MASK 0x00FF /end MEASUREMENT
/begin MEASUREMENT tpu_b_kw_win_temp_2 "Temp Zahn Messfenster 2." UWORD FORMULA_KW4 0 0 0.0 119.0000 ECU_ADDRESS 0x3045CE /begin FUNCTION_LIST TPU /end FUNCTION_LIST BIT_MASK 0x00FF /end MEASUREMENT
/begin MEASUREMENT tpu_b_kw_win_period_2 "Periode Messfenster 2." UWORD FORMULA_KW4 0 0 0.0 119.0000 ECU_ADDRESS 0x3045DC /begin FUNCTION_LIST TPU /end FUNCTION_LIST BIT_MASK 0x00FF /end MEASUREMENT
/begin MEASUREMENT tpu_b_kw_win_time_2 "Zeit Messfenster 2." ULONG FORMULA_KW8 0 0 0.0 2396.7450 ECU_ADDRESS 0x3045DC /begin FUNCTION_LIST TPU /end FUNCTION_LIST BIT_MASK 0x00FFFFFF /end MEASUREMENT
/begin MEASUREMENT tpu_b_kw_win_start_time_low_2 "16 LSB Zeitpunkt Start Messfenster 2." UWORD FORMULA_KW11 0 0 0.0 9.3621 ECU_ADDRESS 0x3045CC /begin FUNCTION_LIST TPU /end FUNCTION_LIST /end MEASUREMENT
/begin MEASUREMENT tpu_b_kw_win_start_time_high_2 "8 MSB Zeitpunkt Start Messfenster 2." UWORD FORMULA_KW12 0 0 0.0 255.0000 ECU_ADDRESS 0x3045CE /begin FUNCTION_LIST TPU /end FUNCTION_LIST BIT_MASK 0xFF00 /end MEASUREMENT
/* TPU PWM FORMELN -----------------------------------------------------------------------*/
/begin COMPU_METHOD FORMULA_PWM1 "FORMULA_PWM1" RAT_FUNC "%7.2" "ms" COEFFS 0 7000 0 0 0 1 /end COMPU_METHOD
/* TPU PWM -------------------------------------------------------------------------------*/
/begin MEASUREMENT tpu_pwm_active_time_llfss "TPU PWM active time." UWORD FORMULA_PWM1 0 0 0.0 9.3621 ECU_ADDRESS 0x3045C0 /begin FUNCTION_LIST TPU /end FUNCTION_LIST /end MEASUREMENT
/begin MEASUREMENT tpu_pwm_period_llfss "TPU PWM period." UWORD FORMULA_PWM1 0 0 0.0 9.3621 ECU_ADDRESS 0x3045C2 /begin FUNCTION_LIST TPU /end FUNCTION_LIST /end MEASUREMENT
/begin MEASUREMENT tpu_pwm_passive_time_llfss "TPU PWM passive time." UWORD FORMULA_PWM1 0 0 0.0 9.3621 ECU_ADDRESS 0x3045C4 /begin FUNCTION_LIST TPU /end FUNCTION_LIST /end MEASUREMENT
/begin MEASUREMENT tpu_pwm_active_time_llfso "TPU PWM active time." UWORD FORMULA_PWM1 0 0 0.0 9.3621 ECU_ADDRESS 0x3045D0 /begin FUNCTION_LIST TPU /end FUNCTION_LIST /end MEASUREMENT
/begin MEASUREMENT tpu_pwm_period_llfso "TPU PWM period." UWORD FORMULA_PWM1 0 0 0.0 9.3621 ECU_ADDRESS 0x3045D2 /begin FUNCTION_LIST TPU /end FUNCTION_LIST /end MEASUREMENT
/begin MEASUREMENT tpu_pwm_passive_time_llfso "TPU PWM passive time." UWORD FORMULA_PWM1 0 0 0.0 9.3621 ECU_ADDRESS 0x3045D4 /begin FUNCTION_LIST TPU /end FUNCTION_LIST /end MEASUREMENT
/* TPU DIO FORMELN -----------------------------------------------------------------------*/
/begin COMPU_METHOD FORMULA_DIO1 "FORMULA_DIO1" TAB_VERB "%5.0" "-" COMPU_TAB_REF FORMULA_DIO1_VTAB /end COMPU_METHOD
/begin COMPU_VTAB FORMULA_DIO1_VTAB "FORMULA_DIO1_VTAB" TAB_VERB 5 0x04 "in rising edge" 0x08 "in falling edge" 0x0C "in both edges" 0xE1 "out pin high" 0xE2 "out pin low" DEFAULT_VALUE "1 undefined" /end COMPU_VTAB
/begin COMPU_METHOD FORMULA_DIO2 "FORMULA_DIO2" RAT_FUNC "%5.0" "-" COEFFS 0 1 0 0 0 1 /end COMPU_METHOD
/begin COMPU_METHOD FORMULA_DIO3 "FORMULA_DIO3" RAT_FUNC "%7.2" "ms" COEFFS 0 7000 0 0 0 1 /end COMPU_METHOD
/* TPU DIO -------------------------------------------------------------------------------*/
/begin MEASUREMENT tpu_dio_config_irq_dsp "TPU DIO config." UWORD FORMULA_DIO1 0 0 0.0 511.0000 ECU_ADDRESS 0x304550 /begin FUNCTION_LIST TPU /end FUNCTION_LIST BIT_MASK 0x001FF /end MEASUREMENT
/begin MEASUREMENT tpu_dio_pin_level_irq_dsp "TPU DIO pin level." UWORD FORMULA_DIO2 0 0 0.0 1.0000 ECU_ADDRESS 0x304550 /begin FUNCTION_LIST TPU /end FUNCTION_LIST BIT_MASK 0x0001 /end MEASUREMENT
/begin MEASUREMENT tpu_dio_pulse_time_irq_dsp "TPU DIO pulse time." UWORD FORMULA_DIO3 0 0 0.0 9.3621 ECU_ADDRESS 0x304552 /begin FUNCTION_LIST TPU /end FUNCTION_LIST BIT_MASK 0x7FFF /end MEASUREMENT
/begin MEASUREMENT tpu_dio_irq_cnt_irq_dsp "TPU DIO interrupt counter." UWORD FORMULA_DIO2 0 0 0.0 65535.0000 ECU_ADDRESS 0x304552 /begin FUNCTION_LIST TPU /end FUNCTION_LIST /end MEASUREMENT
/* TPU FI FORMELN ------------------------------------------------------------------------*/
/begin COMPU_METHOD FORMULA_FI1 "FORMULA_FI1" RAT_FUNC "%7.2" "ms" COEFFS 0 14000 0 0 0 1 /end COMPU_METHOD
/begin COMPU_METHOD FORMULA_FI2 "FORMULA_FI2" RAT_FUNC "%5.0" "-" COEFFS 0 256 0 0 0 1 /end COMPU_METHOD
/begin COMPU_METHOD FORMULA_FI3 "FORMULA_FI3" RAT_FUNC "%5.0" "-" COEFFS 0 1 0 0 0 1 /end COMPU_METHOD
/* TPU FI --------------------------------------------------------------------------------*/
/begin MEASUREMENT tpu_fi_period_kw_rot "TPU FI period." UWORD FORMULA_FI1 0 0 0.0 9.3621 ECU_ADDRESS 0x304530 /begin FUNCTION_LIST TPU /end FUNCTION_LIST BIT_MASK 0xFFFE /end MEASUREMENT
/begin MEASUREMENT tpu_fi_pin_level_kw_rot "TPU FI pin level." UWORD FORMULA_FI3 0 0 0.0 1.0000 ECU_ADDRESS 0x304530 /begin FUNCTION_LIST TPU /end FUNCTION_LIST BIT_MASK 0x0001 /end MEASUREMENT
/begin MEASUREMENT tpu_fi_no_samples_kw_rot "TPU FI number of samples." UWORD FORMULA_FI2 0 0 0.0 255.0000 ECU_ADDRESS 0x304532 /begin FUNCTION_LIST TPU /end FUNCTION_LIST BIT_MASK 0xFF00 /end MEASUREMENT
/begin MEASUREMENT tpu_fi_sample_cnt_kw_rot "TPU FI sample counter." UWORD FORMULA_FI3 0 0 0.0 255.0000 ECU_ADDRESS 0x304532 /begin FUNCTION_LIST TPU /end FUNCTION_LIST BIT_MASK 0x00FF /end MEASUREMENT
/* TPU AA FORMELN ------------------------------------------------------------------------*/
/begin COMPU_METHOD FORMULA_AA1 "FORMULA_AA1" RAT_FUNC "%7.2" "�" COEFFS 0 1 0 0 0 0.01098633 /end COMPU_METHOD
/begin COMPU_METHOD FORMULA_AA2 "FORMULA_AA2" RAT_FUNC "%9.2" "ms" COEFFS 0 7000 0 0 0 1 /end COMPU_METHOD
/begin COMPU_METHOD FORMULA_AA3 "FORMULA_AA3" RAT_FUNC "%7.2" "ms" COEFFS 0 7000 0 0 0 1 /end COMPU_METHOD
/begin COMPU_METHOD FORMULA_AA4 "FORMULA_AA4" RAT_FUNC "%9.2" "ms" COEFFS 0 7000 0 0 0 256 /end COMPU_METHOD
/* TPU AA --------------------------------------------------------------------------------*/
/begin MEASUREMENT tpu_aa_angle_start_td "TPU AA angle start." UWORD FORMULA_AA1 0 0 0.0 719.9890 ECU_ADDRESS 0x304580 /begin FUNCTION_LIST TPU /end FUNCTION_LIST /end MEASUREMENT
/begin MEASUREMENT tpu_aa_angle_duration_td "TPU AA angle duration." UWORD FORMULA_AA1 0 0 0.0 719.9890 ECU_ADDRESS 0x304582 /begin FUNCTION_LIST TPU /end FUNCTION_LIST /end MEASUREMENT
/begin MEASUREMENT tpu_aa_angle_period_td "TPU AA angle period." UWORD FORMULA_AA1 0 0 0.0 719.9890 ECU_ADDRESS 0x304584 /begin FUNCTION_LIST TPU /end FUNCTION_LIST /end MEASUREMENT
/begin MEASUREMENT tpu_aa_start_time_low_td "16 lsb start time." UWORD FORMULA_AA3 0 0 0.0 9.3621 ECU_ADDRESS 0x304586 /begin FUNCTION_LIST TPU /end FUNCTION_LIST /end MEASUREMENT
/begin MEASUREMENT tpu_aa_start_time_high_td "8 msb start time." UWORD FORMULA_AA4 0 0 0.0 255.0000 ECU_ADDRESS 0x304588 /begin FUNCTION_LIST TPU /end FUNCTION_LIST BIT_MASK 0xFF00 /end MEASUREMENT
/begin MEASUREMENT tpu_aa_max_time_td "Max Active Time Limit." ULONG FORMULA_AA2 0 0 0.0 2396.7450 ECU_ADDRESS 0x304588 /begin FUNCTION_LIST TPU /end FUNCTION_LIST BIT_MASK 0x00FFFFFF /end MEASUREMENT
/begin MEASUREMENT tpu_aa_temp_angle_td "TPU AA temp period." UWORD FORMULA_AA1 0 0 0.0 719.9890 ECU_ADDRESS 0x30458C /begin FUNCTION_LIST TPU /end FUNCTION_LIST /end MEASUREMENT
/begin MEASUREMENT tpu_aa_ref_angle_td "TPU AA reference period." UWORD FORMULA_AA1 0 0 0.0 719.9890 ECU_ADDRESS 0x30458E /begin FUNCTION_LIST TPU /end FUNCTION_LIST /end MEASUREMENT
/begin MEASUREMENT tpu_aa_angle_start_kis "TPU AA angle start." UWORD FORMULA_AA1 0 0 0.0 719.9890 ECU_ADDRESS 0x3045F0 /begin FUNCTION_LIST TPU /end FUNCTION_LIST /end MEASUREMENT
/begin MEASUREMENT tpu_aa_angle_duration_kis "TPU AA angle duration." UWORD FORMULA_AA1 0 0 0.0 719.9890 ECU_ADDRESS 0x3045F2 /begin FUNCTION_LIST TPU /end FUNCTION_LIST /end MEASUREMENT
/begin MEASUREMENT tpu_aa_angle_period_kis "TPU AA angle period." UWORD FORMULA_AA1 0 0 0.0 719.9890 ECU_ADDRESS 0x3045F4 /begin FUNCTION_LIST TPU /end FUNCTION_LIST /end MEASUREMENT
/begin MEASUREMENT tpu_aa_start_time_low_kis "16 lsb start time." UWORD FORMULA_AA3 0 0 0.0 9.3621 ECU_ADDRESS 0x3045F6 /begin FUNCTION_LIST TPU /end FUNCTION_LIST /end MEASUREMENT
/begin MEASUREMENT tpu_aa_start_time_high_kis "8 msb start time." UWORD FORMULA_AA4 0 0 0.0 255.0000 ECU_ADDRESS 0x3045F8 /begin FUNCTION_LIST TPU /end FUNCTION_LIST BIT_MASK 0xFF00 /end MEASUREMENT
/begin MEASUREMENT tpu_aa_max_time_kis "Max Active Time Limit." ULONG FORMULA_AA2 0 0 0.0 2396.7450 ECU_ADDRESS 0x3045F8 /begin FUNCTION_LIST TPU /end FUNCTION_LIST BIT_MASK 0x00FFFFFF /end MEASUREMENT
/begin MEASUREMENT tpu_aa_temp_angle_kis "TPU AA temp period." UWORD FORMULA_AA1 0 0 0.0 719.9890 ECU_ADDRESS 0x3045FC /begin FUNCTION_LIST TPU /end FUNCTION_LIST /end MEASUREMENT
/begin MEASUREMENT tpu_aa_ref_angle_kis "TPU AA reference period." UWORD FORMULA_AA1 0 0 0.0 719.9890 ECU_ADDRESS 0x3045FE /begin FUNCTION_LIST TPU /end FUNCTION_LIST /end MEASUREMENT
/* TPU IGN FORMELN -----------------------------------------------------------------------*/
/begin COMPU_METHOD FORMULA_IGN1 "FORMULA_IGN1" RAT_FUNC "%7.2" "�" COEFFS 0 1 0 0 0 0.01098633 /end COMPU_METHOD
/begin COMPU_METHOD FORMULA_IGN2 "FORMULA_IGN2" RAT_FUNC "%7.2" "ms" COEFFS 0 1750 0 0 0 1 /end COMPU_METHOD
/begin COMPU_METHOD FORMULA_IGN3 "FORMULA_IGN3" RAT_FUNC "%5.0" "-" COEFFS 0 1 0 0 0 1 /end COMPU_METHOD
/begin COMPU_METHOD FORMULA_IGN4 "FORMULA_IGN4" RAT_FUNC "%5.0" "-" COEFFS 0 32768 0 0 0 1 /end COMPU_METHOD
/begin COMPU_METHOD FORMULA_IGN5 "FORMULA_IGN5" RAT_FUNC "%5.0" "-" COEFFS 0 16384 0 0 0 1 /end COMPU_METHOD
/begin COMPU_METHOD FORMULA_IGN6 "FORMULA_IGN6" RAT_FUNC "%5.0" "-" COEFFS 0 8192 0 0 0 1 /end COMPU_METHOD
/begin COMPU_METHOD FORMULA_IGN7 "FORMULA_IGN7" RAT_FUNC "%5.0" "-" COEFFS 0 4096 0 0 0 1 /end COMPU_METHOD
/begin COMPU_METHOD FORMULA_IGN8 "FORMULA_IGN8" RAT_FUNC "%5.0" "-" COEFFS 0 256 0 0 0 1 /end COMPU_METHOD
/begin COMPU_METHOD FORMULA_IGN9 "FORMULA_IGN9" RAT_FUNC "%5.0" "-" COEFFS 0 512 0 0 0 1 /end COMPU_METHOD
/begin COMPU_METHOD FORMULA_IGN10 "FORMULA_IGN10" RAT_FUNC "%7.2" "ms" COEFFS 0 49000 0 0 0 1 /end COMPU_METHOD
/begin COMPU_METHOD FORMULA_IGN11 "FORMULA_IGN11" RAT_FUNC "%7.2" "ms" COEFFS 0 7000 0 0 0 1 /end COMPU_METHOD
/* TPU IGN Globale Parameter -------------------------------------------------------------*/
/begin MEASUREMENT tpu_ign_double_fire_ctrl "TPU IGN Anforderung Doppelzuendung." UWORD FORMULA_IGN4 0 0 0.0 1.0000 ECU_ADDRESS 0x30412E /begin FUNCTION_LIST TPU /end FUNCTION_LIST BIT_MASK 0x8000 /end MEASUREMENT
/begin MEASUREMENT tpu_ign_spark_time "TPU IGN Aktivezeit Nachzuendpulse." UWORD FORMULA_IGN2 0 0 0.0 37.4484 ECU_ADDRESS 0x30413E /begin FUNCTION_LIST TPU /end FUNCTION_LIST /end MEASUREMENT
/begin MEASUREMENT tpu_ign_spark_off_time "TPU IGN Passivzeit Nachzuendpulse." UWORD FORMULA_IGN2 0 0 0.0 37.4484 ECU_ADDRESS 0x30414E /begin FUNCTION_LIST TPU /end FUNCTION_LIST /end MEASUREMENT
/begin MEASUREMENT tpu_ign_miss_fire_time "TPU IGN Bestromungszeit Fehlzuendung." UWORD FORMULA_IGN10 0 0 0.0 0.2914286 ECU_ADDRESS 0x30415E /begin FUNCTION_LIST TPU /end FUNCTION_LIST BIT_MASK 0xFF00 /end MEASUREMENT
/begin MEASUREMENT tpu_ign_max_sparks "TPU IGN max Anzahl Nachzuender." UWORD FORMULA_IGN3 0 0 0.0 255.0000 ECU_ADDRESS 0x30415E /begin FUNCTION_LIST TPU /end FUNCTION_LIST BIT_MASK 0x00FF /end MEASUREMENT
/begin MEASUREMENT tpu_ign_min_msg_pos "TPU IGN min Winkelabstand zur MSG Ausgabe." UWORD FORMULA_IGN1 0 0 0.0 719.9890 ECU_ADDRESS 0x30416E /begin FUNCTION_LIST TPU /end FUNCTION_LIST /end MEASUREMENT
/begin MEASUREMENT tpu_ign_msg_start_time "TPU IGN Zeit MSG Startbit." UWORD FORMULA_IGN11 0 0 0.0 9.3621 ECU_ADDRESS 0x30417E /begin FUNCTION_LIST TPU /end FUNCTION_LIST /end MEASUREMENT
/begin MEASUREMENT tpu_ign_msg_zero_time "TPU IGN Zeit MSG Nullbit." UWORD FORMULA_IGN11 0 0 0.0 9.3621 ECU_ADDRESS 0x30418E /begin FUNCTION_LIST TPU /end FUNCTION_LIST /end MEASUREMENT
/begin MEASUREMENT tpu_ign_glob_temp_1 "TPU IGN globaler Winkel." UWORD FORMULA_IGN1 0 0 0.0 719.9890 ECU_ADDRESS 0x30419E /begin FUNCTION_LIST TPU /end FUNCTION_LIST /end MEASUREMENT
/begin MEASUREMENT tpu_ign_glob_temp_2 "TPU IGN globaler Zeit." UWORD FORMULA_IGN2 0 0 0.0 37.4484 ECU_ADDRESS 0x3041AE /begin FUNCTION_LIST TPU /end FUNCTION_LIST /end MEASUREMENT
/* TPU IGN Parameter Zylinder 1 ----------------------------------------------------------*/
/begin MEASUREMENT tpu_ign_tz_zyl1 "TPU IGN Zuendwinkel." UWORD FORMULA_IGN1 0 0 0.0 719.9890 ECU_ADDRESS 0x304120 /begin FUNCTION_LIST TPU /end FUNCTION_LIST /end MEASUREMENT
/begin MEASUREMENT tpu_ign_dwell_time_zyl1 "TPU IGN Bestromungszeit." UWORD FORMULA_IGN2 0 0 0.0 37.4484 ECU_ADDRESS 0x304122 /begin FUNCTION_LIST TPU /end FUNCTION_LIST /end MEASUREMENT
/begin MEASUREMENT tpu_ign_tdc_angle_zyl1 "TPU IGN ZOT Lage." UWORD FORMULA_IGN1 0 0 0.0 719.9890 ECU_ADDRESS 0x304124 /begin FUNCTION_LIST TPU /end FUNCTION_LIST /end MEASUREMENT
/begin MEASUREMENT tpu_ign_msg_zyl1 "TPU IGN IC MSG." UWORD FORMULA_IGN3 0 0 0.0 127.0000 ECU_ADDRESS 0x304126 /begin FUNCTION_LIST TPU /end FUNCTION_LIST /end MEASUREMENT
/begin MEASUREMENT tpu_ign_double_fire_zyl1 "TPU IGN Doppelzuendung." UWORD FORMULA_IGN4 0 0 0.0 1.0000 ECU_ADDRESS 0x304128 /begin FUNCTION_LIST TPU /end FUNCTION_LIST BIT_MASK 0x8000 /end MEASUREMENT
/begin MEASUREMENT tpu_ign_miss_fire_request_zyl1 "TPU IGN Anforderung Zuendaussetzer." UWORD FORMULA_IGN5 0 0 0.0 1.0000 ECU_ADDRESS 0x304128 /begin FUNCTION_LIST TPU /end FUNCTION_LIST BIT_MASK 0x4000 /end MEASUREMENT
/begin MEASUREMENT tpu_ign_miss_fire_active_zyl1 "TPU IGN Zuendaussetzer aktiv." UWORD FORMULA_IGN6 0 0 0.0 1.0000 ECU_ADDRESS 0x304128 /begin FUNCTION_LIST TPU /end FUNCTION_LIST BIT_MASK 0x2000 /end MEASUREMENT
/begin MEASUREMENT tpu_ign_msg_err_zyl1 "TPU IGN MSG Uebertragungsfehler (zu spaet)." UWORD FORMULA_IGN7 0 0 0.0 1.0000 ECU_ADDRESS 0x304128 /begin FUNCTION_LIST TPU /end FUNCTION_LIST BIT_MASK 0x1000 /end MEASUREMENT
/begin MEASUREMENT tpu_ign_err_cnt_zyl1 "TPU IGN MSG Fehlerzaehler." UWORD FORMULA_IGN9 0 0 0.0 15.0000 ECU_ADDRESS 0x304128 /begin FUNCTION_LIST TPU /end FUNCTION_LIST BIT_MASK 0x0E00 /end MEASUREMENT
/begin MEASUREMENT tpu_ign_pin_level_zyl1 "TPU IGN Pin Level." UWORD FORMULA_IGN8 0 0 0.0 1.0000 ECU_ADDRESS 0x304128 /begin FUNCTION_LIST TPU /end FUNCTION_LIST BIT_MASK 0x0100 /end MEASUREMENT
/begin MEASUREMENT tpu_ign_temp_1_zyl1 "TPU IGN temp 1." UWORD FORMULA_IGN3 0 0 0.0 255.0000 ECU_ADDRESS 0x304128 /begin FUNCTION_LIST TPU /end FUNCTION_LIST BIT_MASK 0x00FF /end MEASUREMENT
/begin MEASUREMENT tpu_ign_temp_2_zyl1 "TPU IGN temp 2." UWORD FORMULA_IGN3 0 0 0.0 65535.0000 ECU_ADDRESS 0x30412A /begin FUNCTION_LIST TPU /end FUNCTION_LIST /end MEASUREMENT
/begin MEASUREMENT tpu_ign_temp_3_zyl1 "TPU IGN temp 3." UWORD FORMULA_IGN3 0 0 0.0 65535.0000 ECU_ADDRESS 0x30412C /begin FUNCTION_LIST TPU /end FUNCTION_LIST /end MEASUREMENT
/* TPU IGN Parameter Zylinder 2 ----------------------------------------------------------*/
/begin MEASUREMENT tpu_ign_tz_zyl2 "TPU IGN Zuendwinkel." UWORD FORMULA_IGN1 0 0 0.0 719.9890 ECU_ADDRESS 0x304130 /begin FUNCTION_LIST TPU /end FUNCTION_LIST /end MEASUREMENT
/begin MEASUREMENT tpu_ign_dwell_time_zyl2 "TPU IGN Bestromungszeit." UWORD FORMULA_IGN2 0 0 0.0 37.4484 ECU_ADDRESS 0x304132 /begin FUNCTION_LIST TPU /end FUNCTION_LIST /end MEASUREMENT
/begin MEASUREMENT tpu_ign_tdc_angle_zyl2 "TPU IGN ZOT Lage." UWORD FORMULA_IGN1 0 0 0.0 719.9890 ECU_ADDRESS 0x304134 /begin FUNCTION_LIST TPU /end FUNCTION_LIST /end MEASUREMENT
/begin MEASUREMENT tpu_ign_msg_zyl2 "TPU IGN IC MSG." UWORD FORMULA_IGN3 0 0 0.0 127.0000 ECU_ADDRESS 0x304136 /begin FUNCTION_LIST TPU /end FUNCTION_LIST /end MEASUREMENT
/begin MEASUREMENT tpu_ign_double_fire_zyl2 "TPU IGN Doppelzuendung." UWORD FORMULA_IGN4 0 0 0.0 1.0000 ECU_ADDRESS 0x304138 /begin FUNCTION_LIST TPU /end FUNCTION_LIST BIT_MASK 0x8000 /end MEASUREMENT
/begin MEASUREMENT tpu_ign_miss_fire_request_zyl2 "TPU IGN Anforderung Zuendaussetzer." UWORD FORMULA_IGN5 0 0 0.0 1.0000 ECU_ADDRESS 0x304138 /begin FUNCTION_LIST TPU /end FUNCTION_LIST BIT_MASK 0x4000 /end MEASUREMENT
/begin MEASUREMENT tpu_ign_miss_fire_active_zyl2 "TPU IGN Zuendaussetzer aktiv." UWORD FORMULA_IGN6 0 0 0.0 1.0000 ECU_ADDRESS 0x304138 /begin FUNCTION_LIST TPU /end FUNCTION_LIST BIT_MASK 0x2000 /end MEASUREMENT
/begin MEASUREMENT tpu_ign_msg_err_zyl2 "TPU IGN MSG Uebertragungsfehler (zu spaet)." UWORD FORMULA_IGN7 0 0 0.0 1.0000 ECU_ADDRESS 0x304138 /begin FUNCTION_LIST TPU /end FUNCTION_LIST BIT_MASK 0x1000 /end MEASUREMENT
/begin MEASUREMENT tpu_ign_err_cnt_zyl2 "TPU IGN MSG Fehlerzaehler." UWORD FORMULA_IGN9 0 0 0.0 15.0000 ECU_ADDRESS 0x304138 /begin FUNCTION_LIST TPU /end FUNCTION_LIST BIT_MASK 0x0E00 /end MEASUREMENT
/begin MEASUREMENT tpu_ign_pin_level_zyl2 "TPU IGN Pin Level." UWORD FORMULA_IGN8 0 0 0.0 1.0000 ECU_ADDRESS 0x304138 /begin FUNCTION_LIST TPU /end FUNCTION_LIST BIT_MASK 0x0100 /end MEASUREMENT
/begin MEASUREMENT tpu_ign_temp_1_zyl2 "TPU IGN temp 1." UWORD FORMULA_IGN3 0 0 0.0 255.0000 ECU_ADDRESS 0x304138 /begin FUNCTION_LIST TPU /end FUNCTION_LIST BIT_MASK 0x00FF /end MEASUREMENT
/begin MEASUREMENT tpu_ign_temp_2_zyl2 "TPU IGN temp 2." UWORD FORMULA_IGN3 0 0 0.0 65535.0000 ECU_ADDRESS 0x30413A /begin FUNCTION_LIST TPU /end FUNCTION_LIST /end MEASUREMENT
/begin MEASUREMENT tpu_ign_temp_3_zyl2 "TPU IGN temp 3." UWORD FORMULA_IGN3 0 0 0.0 65535.0000 ECU_ADDRESS 0x30413C /begin FUNCTION_LIST TPU /end FUNCTION_LIST /end MEASUREMENT
/* TPU IGN Parameter Zylinder 3 ----------------------------------------------------------*/
/begin MEASUREMENT tpu_ign_tz_zyl3 "TPU IGN Zuendwinkel." UWORD FORMULA_IGN1 0 0 0.0 719.9890 ECU_ADDRESS 0x304140 /begin FUNCTION_LIST TPU /end FUNCTION_LIST /end MEASUREMENT
/begin MEASUREMENT tpu_ign_dwell_time_zyl3 "TPU IGN Bestromungszeit." UWORD FORMULA_IGN2 0 0 0.0 37.4484 ECU_ADDRESS 0x304142 /begin FUNCTION_LIST TPU /end FUNCTION_LIST /end MEASUREMENT
/begin MEASUREMENT tpu_ign_tdc_angle_zyl3 "TPU IGN ZOT Lage." UWORD FORMULA_IGN1 0 0 0.0 719.9890 ECU_ADDRESS 0x304144 /begin FUNCTION_LIST TPU /end FUNCTION_LIST /end MEASUREMENT
/begin MEASUREMENT tpu_ign_msg_zyl3 "TPU IGN IC MSG." UWORD FORMULA_IGN3 0 0 0.0 127.0000 ECU_ADDRESS 0x304146 /begin FUNCTION_LIST TPU /end FUNCTION_LIST /end MEASUREMENT
/begin MEASUREMENT tpu_ign_double_fire_zyl3 "TPU IGN Doppelzuendung." UWORD FORMULA_IGN4 0 0 0.0 1.0000 ECU_ADDRESS 0x304148 /begin FUNCTION_LIST TPU /end FUNCTION_LIST BIT_MASK 0x8000 /end MEASUREMENT
/begin MEASUREMENT tpu_ign_miss_fire_request_zyl3 "TPU IGN Anforderung Zuendaussetzer." UWORD FORMULA_IGN5 0 0 0.0 1.0000 ECU_ADDRESS 0x304148 /begin FUNCTION_LIST TPU /end FUNCTION_LIST BIT_MASK 0x4000 /end MEASUREMENT
/begin MEASUREMENT tpu_ign_miss_fire_active_zyl3 "TPU IGN Zuendaussetzer aktiv." UWORD FORMULA_IGN6 0 0 0.0 1.0000 ECU_ADDRESS 0x304148 /begin FUNCTION_LIST TPU /end FUNCTION_LIST BIT_MASK 0x2000 /end MEASUREMENT
/begin MEASUREMENT tpu_ign_msg_err_zyl3 "TPU IGN MSG Uebertragungsfehler (zu spaet)." UWORD FORMULA_IGN7 0 0 0.0 1.0000 ECU_ADDRESS 0x304148 /begin FUNCTION_LIST TPU /end FUNCTION_LIST BIT_MASK 0x1000 /end MEASUREMENT
/begin MEASUREMENT tpu_ign_err_cnt_zyl3 "TPU IGN MSG Fehlerzaehler." UWORD FORMULA_IGN9 0 0 0.0 15.0000 ECU_ADDRESS 0x304148 /begin FUNCTION_LIST TPU /end FUNCTION_LIST BIT_MASK 0x0E00 /end MEASUREMENT
/begin MEASUREMENT tpu_ign_pin_level_zyl3 "TPU IGN Pin Level." UWORD FORMULA_IGN8 0 0 0.0 1.0000 ECU_ADDRESS 0x304148 /begin FUNCTION_LIST TPU /end FUNCTION_LIST BIT_MASK 0x0100 /end MEASUREMENT
/begin MEASUREMENT tpu_ign_temp_1_zyl3 "TPU IGN temp 1." UWORD FORMULA_IGN3 0 0 0.0 255.0000 ECU_ADDRESS 0x304148 /begin FUNCTION_LIST TPU /end FUNCTION_LIST BIT_MASK 0x00FF /end MEASUREMENT
/begin MEASUREMENT tpu_ign_temp_2_zyl3 "TPU IGN temp 2." UWORD FORMULA_IGN3 0 0 0.0 65535.0000 ECU_ADDRESS 0x30414A /begin FUNCTION_LIST TPU /end FUNCTION_LIST /end MEASUREMENT
/begin MEASUREMENT tpu_ign_temp_3_zyl3 "TPU IGN temp 3." UWORD FORMULA_IGN3 0 0 0.0 65535.0000 ECU_ADDRESS 0x30414C /begin FUNCTION_LIST TPU /end FUNCTION_LIST /end MEASUREMENT
/* TPU IGN Parameter Zylinder 4 ----------------------------------------------------------*/
/begin MEASUREMENT tpu_ign_tz_zyl4 "TPU IGN Zuendwinkel." UWORD FORMULA_IGN1 0 0 0.0 719.9890 ECU_ADDRESS 0x304150 /begin FUNCTION_LIST TPU /end FUNCTION_LIST /end MEASUREMENT
/begin MEASUREMENT tpu_ign_dwell_time_zyl4 "TPU IGN Bestromungszeit." UWORD FORMULA_IGN2 0 0 0.0 37.4484 ECU_ADDRESS 0x304152 /begin FUNCTION_LIST TPU /end FUNCTION_LIST /end MEASUREMENT
/begin MEASUREMENT tpu_ign_tdc_angle_zyl4 "TPU IGN ZOT Lage." UWORD FORMULA_IGN1 0 0 0.0 719.9890 ECU_ADDRESS 0x304154 /begin FUNCTION_LIST TPU /end FUNCTION_LIST /end MEASUREMENT
/begin MEASUREMENT tpu_ign_msg_zyl4 "TPU IGN IC MSG." UWORD FORMULA_IGN3 0 0 0.0 127.0000 ECU_ADDRESS 0x304156 /begin FUNCTION_LIST TPU /end FUNCTION_LIST /end MEASUREMENT
/begin MEASUREMENT tpu_ign_double_fire_zyl4 "TPU IGN Doppelzuendung." UWORD FORMULA_IGN4 0 0 0.0 1.0000 ECU_ADDRESS 0x304158 /begin FUNCTION_LIST TPU /end FUNCTION_LIST BIT_MASK 0x8000 /end MEASUREMENT
/begin MEASUREMENT tpu_ign_miss_fire_request_zyl4 "TPU IGN Anforderung Zuendaussetzer." UWORD FORMULA_IGN5 0 0 0.0 1.0000 ECU_ADDRESS 0x304158 /begin FUNCTION_LIST TPU /end FUNCTION_LIST BIT_MASK 0x4000 /end MEASUREMENT
/begin MEASUREMENT tpu_ign_miss_fire_active_zyl4 "TPU IGN Zuendaussetzer aktiv." UWORD FORMULA_IGN6 0 0 0.0 1.0000 ECU_ADDRESS 0x304158 /begin FUNCTION_LIST TPU /end FUNCTION_LIST BIT_MASK 0x2000 /end MEASUREMENT
/begin MEASUREMENT tpu_ign_msg_err_zyl4 "TPU IGN MSG Uebertragungsfehler (zu spaet)." UWORD FORMULA_IGN7 0 0 0.0 1.0000 ECU_ADDRESS 0x304158 /begin FUNCTION_LIST TPU /end FUNCTION_LIST BIT_MASK 0x1000 /end MEASUREMENT
/begin MEASUREMENT tpu_ign_err_cnt_zyl4 "TPU IGN MSG Fehlerzaehler." UWORD FORMULA_IGN9 0 0 0.0 15.0000 ECU_ADDRESS 0x304158 /begin FUNCTION_LIST TPU /end FUNCTION_LIST BIT_MASK 0x0E00 /end MEASUREMENT
/begin MEASUREMENT tpu_ign_pin_level_zyl4 "TPU IGN Pin Level." UWORD FORMULA_IGN8 0 0 0.0 1.0000 ECU_ADDRESS 0x304158 /begin FUNCTION_LIST TPU /end FUNCTION_LIST BIT_MASK 0x0100 /end MEASUREMENT
/begin MEASUREMENT tpu_ign_temp_1_zyl4 "TPU IGN temp 1." UWORD FORMULA_IGN3 0 0 0.0 255.0000 ECU_ADDRESS 0x304158 /begin FUNCTION_LIST TPU /end FUNCTION_LIST BIT_MASK 0x00FF /end MEASUREMENT
/begin MEASUREMENT tpu_ign_temp_2_zyl4 "TPU IGN temp 2." UWORD FORMULA_IGN3 0 0 0.0 65535.0000 ECU_ADDRESS 0x30415A /begin FUNCTION_LIST TPU /end FUNCTION_LIST /end MEASUREMENT
/begin MEASUREMENT tpu_ign_temp_3_zyl4 "TPU IGN temp 3." UWORD FORMULA_IGN3 0 0 0.0 65535.0000 ECU_ADDRESS 0x30415C /begin FUNCTION_LIST TPU /end FUNCTION_LIST /end MEASUREMENT
/* TPU IGN Parameter Zylinder 5 ----------------------------------------------------------*/
/begin MEASUREMENT tpu_ign_tz_zyl5 "TPU IGN Zuendwinkel." UWORD FORMULA_IGN1 0 0 0.0 719.9890 ECU_ADDRESS 0x304160 /begin FUNCTION_LIST TPU /end FUNCTION_LIST /end MEASUREMENT
/begin MEASUREMENT tpu_ign_dwell_time_zyl5 "TPU IGN Bestromungszeit." UWORD FORMULA_IGN2 0 0 0.0 37.4484 ECU_ADDRESS 0x304162 /begin FUNCTION_LIST TPU /end FUNCTION_LIST /end MEASUREMENT
/begin MEASUREMENT tpu_ign_tdc_angle_zyl5 "TPU IGN ZOT Lage." UWORD FORMULA_IGN1 0 0 0.0 719.9890 ECU_ADDRESS 0x304164 /begin FUNCTION_LIST TPU /end FUNCTION_LIST /end MEASUREMENT
/begin MEASUREMENT tpu_ign_msg_zyl5 "TPU IGN IC MSG." UWORD FORMULA_IGN3 0 0 0.0 127.0000 ECU_ADDRESS 0x304166 /begin FUNCTION_LIST TPU /end FUNCTION_LIST /end MEASUREMENT
/begin MEASUREMENT tpu_ign_double_fire_zyl5 "TPU IGN Doppelzuendung." UWORD FORMULA_IGN4 0 0 0.0 1.0000 ECU_ADDRESS 0x304168 /begin FUNCTION_LIST TPU /end FUNCTION_LIST BIT_MASK 0x8000 /end MEASUREMENT
/begin MEASUREMENT tpu_ign_miss_fire_request_zyl5 "TPU IGN Anforderung Zuendaussetzer." UWORD FORMULA_IGN5 0 0 0.0 1.0000 ECU_ADDRESS 0x304168 /begin FUNCTION_LIST TPU /end FUNCTION_LIST BIT_MASK 0x4000 /end MEASUREMENT
/begin MEASUREMENT tpu_ign_miss_fire_active_zyl5 "TPU IGN Zuendaussetzer aktiv." UWORD FORMULA_IGN6 0 0 0.0 1.0000 ECU_ADDRESS 0x304168 /begin FUNCTION_LIST TPU /end FUNCTION_LIST BIT_MASK 0x2000 /end MEASUREMENT
/begin MEASUREMENT tpu_ign_msg_err_zyl5 "TPU IGN MSG Uebertragungsfehler (zu spaet)." UWORD FORMULA_IGN7 0 0 0.0 1.0000 ECU_ADDRESS 0x304168 /begin FUNCTION_LIST TPU /end FUNCTION_LIST BIT_MASK 0x1000 /end MEASUREMENT
/begin MEASUREMENT tpu_ign_err_cnt_zyl5 "TPU IGN MSG Fehlerzaehler." UWORD FORMULA_IGN9 0 0 0.0 15.0000 ECU_ADDRESS 0x304168 /begin FUNCTION_LIST TPU /end FUNCTION_LIST BIT_MASK 0x0E00 /end MEASUREMENT
/begin MEASUREMENT tpu_ign_pin_level_zyl5 "TPU IGN Pin Level." UWORD FORMULA_IGN8 0 0 0.0 1.0000 ECU_ADDRESS 0x304168 /begin FUNCTION_LIST TPU /end FUNCTION_LIST BIT_MASK 0x0100 /end MEASUREMENT
/begin MEASUREMENT tpu_ign_temp_1_zyl5 "TPU IGN temp 1." UWORD FORMULA_IGN3 0 0 0.0 255.0000 ECU_ADDRESS 0x304168 /begin FUNCTION_LIST TPU /end FUNCTION_LIST BIT_MASK 0x00FF /end MEASUREMENT
/begin MEASUREMENT tpu_ign_temp_2_zyl5 "TPU IGN temp 2." UWORD FORMULA_IGN3 0 0 0.0 65535.0000 ECU_ADDRESS 0x30416A /begin FUNCTION_LIST TPU /end FUNCTION_LIST /end MEASUREMENT
/begin MEASUREMENT tpu_ign_temp_3_zyl5 "TPU IGN temp 3." UWORD FORMULA_IGN3 0 0 0.0 65535.0000 ECU_ADDRESS 0x30416C /begin FUNCTION_LIST TPU /end FUNCTION_LIST /end MEASUREMENT
/* TPU IGN Parameter Zylinder 6 ----------------------------------------------------------*/
/begin MEASUREMENT tpu_ign_tz_zyl6 "TPU IGN Zuendwinkel." UWORD FORMULA_IGN1 0 0 0.0 719.9890 ECU_ADDRESS 0x304170 /begin FUNCTION_LIST TPU /end FUNCTION_LIST /end MEASUREMENT
/begin MEASUREMENT tpu_ign_dwell_time_zyl6 "TPU IGN Bestromungszeit." UWORD FORMULA_IGN2 0 0 0.0 37.4484 ECU_ADDRESS 0x304172 /begin FUNCTION_LIST TPU /end FUNCTION_LIST /end MEASUREMENT
/begin MEASUREMENT tpu_ign_tdc_angle_zyl6 "TPU IGN ZOT Lage." UWORD FORMULA_IGN1 0 0 0.0 719.9890 ECU_ADDRESS 0x304174 /begin FUNCTION_LIST TPU /end FUNCTION_LIST /end MEASUREMENT
/begin MEASUREMENT tpu_ign_msg_zyl6 "TPU IGN IC MSG." UWORD FORMULA_IGN3 0 0 0.0 127.0000 ECU_ADDRESS 0x304176 /begin FUNCTION_LIST TPU /end FUNCTION_LIST /end MEASUREMENT
/begin MEASUREMENT tpu_ign_double_fire_zyl6 "TPU IGN Doppelzuendung." UWORD FORMULA_IGN4 0 0 0.0 1.0000 ECU_ADDRESS 0x304178 /begin FUNCTION_LIST TPU /end FUNCTION_LIST BIT_MASK 0x8000 /end MEASUREMENT
/begin MEASUREMENT tpu_ign_miss_fire_request_zyl6 "TPU IGN Anforderung Zuendaussetzer." UWORD FORMULA_IGN5 0 0 0.0 1.0000 ECU_ADDRESS 0x304178 /begin FUNCTION_LIST TPU /end FUNCTION_LIST BIT_MASK 0x4000 /end MEASUREMENT
/begin MEASUREMENT tpu_ign_miss_fire_active_zyl6 "TPU IGN Zuendaussetzer aktiv." UWORD FORMULA_IGN6 0 0 0.0 1.0000 ECU_ADDRESS 0x304178 /begin FUNCTION_LIST TPU /end FUNCTION_LIST BIT_MASK 0x2000 /end MEASUREMENT
/begin MEASUREMENT tpu_ign_msg_err_zyl6 "TPU IGN MSG Uebertragungsfehler (zu spaet)." UWORD FORMULA_IGN7 0 0 0.0 1.0000 ECU_ADDRESS 0x304178 /begin FUNCTION_LIST TPU /end FUNCTION_LIST BIT_MASK 0x1000 /end MEASUREMENT
/begin MEASUREMENT tpu_ign_err_cnt_zyl6 "TPU IGN MSG Fehlerzaehler." UWORD FORMULA_IGN9 0 0 0.0 15.0000 ECU_ADDRESS 0x304178 /begin FUNCTION_LIST TPU /end FUNCTION_LIST BIT_MASK 0x0E00 /end MEASUREMENT
/begin MEASUREMENT tpu_ign_pin_level_zyl6 "TPU IGN Pin Level." UWORD FORMULA_IGN8 0 0 0.0 1.0000 ECU_ADDRESS 0x304178 /begin FUNCTION_LIST TPU /end FUNCTION_LIST BIT_MASK 0x0100 /end MEASUREMENT
/begin MEASUREMENT tpu_ign_temp_1_zyl6 "TPU IGN temp 1." UWORD FORMULA_IGN3 0 0 0.0 255.0000 ECU_ADDRESS 0x304178 /begin FUNCTION_LIST TPU /end FUNCTION_LIST BIT_MASK 0x00FF /end MEASUREMENT
/begin MEASUREMENT tpu_ign_temp_2_zyl6 "TPU IGN temp 2." UWORD FORMULA_IGN3 0 0 0.0 65535.0000 ECU_ADDRESS 0x30417A /begin FUNCTION_LIST TPU /end FUNCTION_LIST /end MEASUREMENT
/begin MEASUREMENT tpu_ign_temp_3_zyl6 "TPU IGN temp 3." UWORD FORMULA_IGN3 0 0 0.0 65535.0000 ECU_ADDRESS 0x30417C /begin FUNCTION_LIST TPU /end FUNCTION_LIST /end MEASUREMENT
/* TPU IGN Parameter Zylinder 7 ----------------------------------------------------------*/
/begin MEASUREMENT tpu_ign_tz_zyl7 "TPU IGN Zuendwinkel." UWORD FORMULA_IGN1 0 0 0.0 719.9890 ECU_ADDRESS 0x304180 /begin FUNCTION_LIST TPU /end FUNCTION_LIST /end MEASUREMENT
/begin MEASUREMENT tpu_ign_dwell_time_zyl7 "TPU IGN Bestromungszeit." UWORD FORMULA_IGN2 0 0 0.0 37.4484 ECU_ADDRESS 0x304182 /begin FUNCTION_LIST TPU /end FUNCTION_LIST /end MEASUREMENT
/begin MEASUREMENT tpu_ign_tdc_angle_zyl7 "TPU IGN ZOT Lage." UWORD FORMULA_IGN1 0 0 0.0 719.9890 ECU_ADDRESS 0x304184 /begin FUNCTION_LIST TPU /end FUNCTION_LIST /end MEASUREMENT
/begin MEASUREMENT tpu_ign_msg_zyl7 "TPU IGN IC MSG." UWORD FORMULA_IGN3 0 0 0.0 127.0000 ECU_ADDRESS 0x304186 /begin FUNCTION_LIST TPU /end FUNCTION_LIST /end MEASUREMENT
/begin MEASUREMENT tpu_ign_double_fire_zyl7 "TPU IGN Doppelzuendung." UWORD FORMULA_IGN4 0 0 0.0 1.0000 ECU_ADDRESS 0x304188 /begin FUNCTION_LIST TPU /end FUNCTION_LIST BIT_MASK 0x8000 /end MEASUREMENT
/begin MEASUREMENT tpu_ign_miss_fire_request_zyl7 "TPU IGN Anforderung Zuendaussetzer." UWORD FORMULA_IGN5 0 0 0.0 1.0000 ECU_ADDRESS 0x304188 /begin FUNCTION_LIST TPU /end FUNCTION_LIST BIT_MASK 0x4000 /end MEASUREMENT
/begin MEASUREMENT tpu_ign_miss_fire_active_zyl7 "TPU IGN Zuendaussetzer aktiv." UWORD FORMULA_IGN6 0 0 0.0 1.0000 ECU_ADDRESS 0x304188 /begin FUNCTION_LIST TPU /end FUNCTION_LIST BIT_MASK 0x2000 /end MEASUREMENT
/begin MEASUREMENT tpu_ign_msg_err_zyl7 "TPU IGN MSG Uebertragungsfehler (zu spaet)." UWORD FORMULA_IGN7 0 0 0.0 1.0000 ECU_ADDRESS 0x304188 /begin FUNCTION_LIST TPU /end FUNCTION_LIST BIT_MASK 0x1000 /end MEASUREMENT
/begin MEASUREMENT tpu_ign_err_cnt_zyl7 "TPU IGN MSG Fehlerzaehler." UWORD FORMULA_IGN9 0 0 0.0 15.0000 ECU_ADDRESS 0x304188 /begin FUNCTION_LIST TPU /end FUNCTION_LIST BIT_MASK 0x0E00 /end MEASUREMENT
/begin MEASUREMENT tpu_ign_pin_level_zyl7 "TPU IGN Pin Level." UWORD FORMULA_IGN8 0 0 0.0 1.0000 ECU_ADDRESS 0x304188 /begin FUNCTION_LIST TPU /end FUNCTION_LIST BIT_MASK 0x0100 /end MEASUREMENT
/begin MEASUREMENT tpu_ign_temp_1_zyl7 "TPU IGN temp 1." UWORD FORMULA_IGN3 0 0 0.0 255.0000 ECU_ADDRESS 0x304188 /begin FUNCTION_LIST TPU /end FUNCTION_LIST BIT_MASK 0x00FF /end MEASUREMENT
/begin MEASUREMENT tpu_ign_temp_2_zyl7 "TPU IGN temp 2." UWORD FORMULA_IGN3 0 0 0.0 65535.0000 ECU_ADDRESS 0x30418A /begin FUNCTION_LIST TPU /end FUNCTION_LIST /end MEASUREMENT
/begin MEASUREMENT tpu_ign_temp_3_zyl7 "TPU IGN temp 3." UWORD FORMULA_IGN3 0 0 0.0 65535.0000 ECU_ADDRESS 0x30418C /begin FUNCTION_LIST TPU /end FUNCTION_LIST /end MEASUREMENT
/* TPU IGN Parameter Zylinder 8 ----------------------------------------------------------*/
/begin MEASUREMENT tpu_ign_tz_zyl8 "TPU IGN Zuendwinkel." UWORD FORMULA_IGN1 0 0 0.0 719.9890 ECU_ADDRESS 0x304190 /begin FUNCTION_LIST TPU /end FUNCTION_LIST /end MEASUREMENT
/begin MEASUREMENT tpu_ign_dwell_time_zyl8 "TPU IGN Bestromungszeit." UWORD FORMULA_IGN2 0 0 0.0 37.4484 ECU_ADDRESS 0x304192 /begin FUNCTION_LIST TPU /end FUNCTION_LIST /end MEASUREMENT
/begin MEASUREMENT tpu_ign_tdc_angle_zyl8 "TPU IGN ZOT Lage." UWORD FORMULA_IGN1 0 0 0.0 719.9890 ECU_ADDRESS 0x304194 /begin FUNCTION_LIST TPU /end FUNCTION_LIST /end MEASUREMENT
/begin MEASUREMENT tpu_ign_msg_zyl8 "TPU IGN IC MSG." UWORD FORMULA_IGN3 0 0 0.0 127.0000 ECU_ADDRESS 0x304196 /begin FUNCTION_LIST TPU /end FUNCTION_LIST /end MEASUREMENT
/begin MEASUREMENT tpu_ign_double_fire_zyl8 "TPU IGN Doppelzuendung." UWORD FORMULA_IGN4 0 0 0.0 1.0000 ECU_ADDRESS 0x304198 /begin FUNCTION_LIST TPU /end FUNCTION_LIST BIT_MASK 0x8000 /end MEASUREMENT
/begin MEASUREMENT tpu_ign_miss_fire_request_zyl8 "TPU IGN Anforderung Zuendaussetzer." UWORD FORMULA_IGN5 0 0 0.0 1.0000 ECU_ADDRESS 0x304198 /begin FUNCTION_LIST TPU /end FUNCTION_LIST BIT_MASK 0x4000 /end MEASUREMENT
/begin MEASUREMENT tpu_ign_miss_fire_active_zyl8 "TPU IGN Zuendaussetzer aktiv." UWORD FORMULA_IGN6 0 0 0.0 1.0000 ECU_ADDRESS 0x304198 /begin FUNCTION_LIST TPU /end FUNCTION_LIST BIT_MASK 0x2000 /end MEASUREMENT
/begin MEASUREMENT tpu_ign_msg_err_zyl8 "TPU IGN MSG Uebertragungsfehler (zu spaet)." UWORD FORMULA_IGN7 0 0 0.0 1.0000 ECU_ADDRESS 0x304198 /begin FUNCTION_LIST TPU /end FUNCTION_LIST BIT_MASK 0x1000 /end MEASUREMENT
/begin MEASUREMENT tpu_ign_err_cnt_zyl8 "TPU IGN MSG Fehlerzaehler." UWORD FORMULA_IGN9 0 0 0.0 15.0000 ECU_ADDRESS 0x304198 /begin FUNCTION_LIST TPU /end FUNCTION_LIST BIT_MASK 0x0E00 /end MEASUREMENT
/begin MEASUREMENT tpu_ign_pin_level_zyl8 "TPU IGN Pin Level." UWORD FORMULA_IGN8 0 0 0.0 1.0000 ECU_ADDRESS 0x304198 /begin FUNCTION_LIST TPU /end FUNCTION_LIST BIT_MASK 0x0100 /end MEASUREMENT
/begin MEASUREMENT tpu_ign_temp_1_zyl8 "TPU IGN temp 1." UWORD FORMULA_IGN3 0 0 0.0 255.0000 ECU_ADDRESS 0x304198 /begin FUNCTION_LIST TPU /end FUNCTION_LIST BIT_MASK 0x00FF /end MEASUREMENT
/begin MEASUREMENT tpu_ign_temp_2_zyl8 "TPU IGN temp 2." UWORD FORMULA_IGN3 0 0 0.0 65535.0000 ECU_ADDRESS 0x30419A /begin FUNCTION_LIST TPU /end FUNCTION_LIST /end MEASUREMENT
/begin MEASUREMENT tpu_ign_temp_3_zyl8 "TPU IGN temp 3." UWORD FORMULA_IGN3 0 0 0.0 65535.0000 ECU_ADDRESS 0x30419C /begin FUNCTION_LIST TPU /end FUNCTION_LIST /end MEASUREMENT
/* TPU IGN Parameter Zylinder 9 ----------------------------------------------------------*/
/begin MEASUREMENT tpu_ign_tz_zyl9 "TPU IGN Zuendwinkel." UWORD FORMULA_IGN1 0 0 0.0 719.9890 ECU_ADDRESS 0x3041A0 /begin FUNCTION_LIST TPU /end FUNCTION_LIST /end MEASUREMENT
/begin MEASUREMENT tpu_ign_dwell_time_zyl9 "TPU IGN Bestromungszeit." UWORD FORMULA_IGN2 0 0 0.0 37.4484 ECU_ADDRESS 0x3041A2 /begin FUNCTION_LIST TPU /end FUNCTION_LIST /end MEASUREMENT
/begin MEASUREMENT tpu_ign_tdc_angle_zyl9 "TPU IGN ZOT Lage." UWORD FORMULA_IGN1 0 0 0.0 719.9890 ECU_ADDRESS 0x3041A4 /begin FUNCTION_LIST TPU /end FUNCTION_LIST /end MEASUREMENT
/begin MEASUREMENT tpu_ign_msg_zyl9 "TPU IGN IC MSG." UWORD FORMULA_IGN3 0 0 0.0 127.0000 ECU_ADDRESS 0x3041A6 /begin FUNCTION_LIST TPU /end FUNCTION_LIST /end MEASUREMENT
/begin MEASUREMENT tpu_ign_double_fire_zyl9 "TPU IGN Doppelzuendung." UWORD FORMULA_IGN4 0 0 0.0 1.0000 ECU_ADDRESS 0x3041A8 /begin FUNCTION_LIST TPU /end FUNCTION_LIST BIT_MASK 0x8000 /end MEASUREMENT
/begin MEASUREMENT tpu_ign_miss_fire_request_zyl9 "TPU IGN Anforderung Zuendaussetzer." UWORD FORMULA_IGN5 0 0 0.0 1.0000 ECU_ADDRESS 0x3041A8 /begin FUNCTION_LIST TPU /end FUNCTION_LIST BIT_MASK 0x4000 /end MEASUREMENT
/begin MEASUREMENT tpu_ign_miss_fire_active_zyl9 "TPU IGN Zuendaussetzer aktiv." UWORD FORMULA_IGN6 0 0 0.0 1.0000 ECU_ADDRESS 0x3041A8 /begin FUNCTION_LIST TPU /end FUNCTION_LIST BIT_MASK 0x2000 /end MEASUREMENT
/begin MEASUREMENT tpu_ign_msg_err_zyl9 "TPU IGN MSG Uebertragungsfehler (zu spaet)." UWORD FORMULA_IGN7 0 0 0.0 1.0000 ECU_ADDRESS 0x3041A8 /begin FUNCTION_LIST TPU /end FUNCTION_LIST BIT_MASK 0x1000 /end MEASUREMENT
/begin MEASUREMENT tpu_ign_err_cnt_zyl9 "TPU IGN MSG Fehlerzaehler." UWORD FORMULA_IGN9 0 0 0.0 15.0000 ECU_ADDRESS 0x3041A8 /begin FUNCTION_LIST TPU /end FUNCTION_LIST BIT_MASK 0x0E00 /end MEASUREMENT
/begin MEASUREMENT tpu_ign_pin_level_zyl9 "TPU IGN Pin Level." UWORD FORMULA_IGN8 0 0 0.0 1.0000 ECU_ADDRESS 0x3041A8 /begin FUNCTION_LIST TPU /end FUNCTION_LIST BIT_MASK 0x0100 /end MEASUREMENT
/begin MEASUREMENT tpu_ign_temp_1_zyl9 "TPU IGN temp 1." UWORD FORMULA_IGN3 0 0 0.0 255.0000 ECU_ADDRESS 0x3041A8 /begin FUNCTION_LIST TPU /end FUNCTION_LIST BIT_MASK 0x00FF /end MEASUREMENT
/begin MEASUREMENT tpu_ign_temp_2_zyl9 "TPU IGN temp 2." UWORD FORMULA_IGN3 0 0 0.0 65535.0000 ECU_ADDRESS 0x3041AA /begin FUNCTION_LIST TPU /end FUNCTION_LIST /end MEASUREMENT
/begin MEASUREMENT tpu_ign_temp_3_zyl9 "TPU IGN temp 3." UWORD FORMULA_IGN3 0 0 0.0 65535.0000 ECU_ADDRESS 0x3041AC /begin FUNCTION_LIST TPU /end FUNCTION_LIST /end MEASUREMENT
/* TPU IGN Parameter Zylinder 10 ----------------------------------------------------------*/
/begin MEASUREMENT tpu_ign_tz_zyl10 "TPU IGN Zuendwinkel." UWORD FORMULA_IGN1 0 0 0.0 719.9890 ECU_ADDRESS 0x3041B0 /begin FUNCTION_LIST TPU /end FUNCTION_LIST /end MEASUREMENT
/begin MEASUREMENT tpu_ign_dwell_time_zyl10 "TPU IGN Bestromungszeit." UWORD FORMULA_IGN2 0 0 0.0 37.4484 ECU_ADDRESS 0x3041B2 /begin FUNCTION_LIST TPU /end FUNCTION_LIST /end MEASUREMENT
/begin MEASUREMENT tpu_ign_tdc_angle_zyl10 "TPU IGN ZOT Lage." UWORD FORMULA_IGN1 0 0 0.0 719.9890 ECU_ADDRESS 0x3041B4 /begin FUNCTION_LIST TPU /end FUNCTION_LIST /end MEASUREMENT
/begin MEASUREMENT tpu_ign_msg_zyl10 "TPU IGN IC MSG." UWORD FORMULA_IGN3 0 0 0.0 127.0000 ECU_ADDRESS 0x3041B6 /begin FUNCTION_LIST TPU /end FUNCTION_LIST /end MEASUREMENT
/begin MEASUREMENT tpu_ign_double_fire_zyl10 "TPU IGN Doppelzuendung." UWORD FORMULA_IGN4 0 0 0.0 1.0000 ECU_ADDRESS 0x3041B8 /begin FUNCTION_LIST TPU /end FUNCTION_LIST BIT_MASK 0x8000 /end MEASUREMENT
/begin MEASUREMENT tpu_ign_miss_fire_request_zyl10 "TPU IGN Anforderung Zuendaussetzer." UWORD FORMULA_IGN5 0 0 0.0 1.0000 ECU_ADDRESS 0x3041B8 /begin FUNCTION_LIST TPU /end FUNCTION_LIST BIT_MASK 0x4000 /end MEASUREMENT
/begin MEASUREMENT tpu_ign_miss_fire_active_zyl10 "TPU IGN Zuendaussetzer aktiv." UWORD FORMULA_IGN6 0 0 0.0 1.0000 ECU_ADDRESS 0x3041B8 /begin FUNCTION_LIST TPU /end FUNCTION_LIST BIT_MASK 0x2000 /end MEASUREMENT
/begin MEASUREMENT tpu_ign_msg_err_zyl10 "TPU IGN MSG Uebertragungsfehler (zu spaet)." UWORD FORMULA_IGN7 0 0 0.0 1.0000 ECU_ADDRESS 0x3041B8 /begin FUNCTION_LIST TPU /end FUNCTION_LIST BIT_MASK 0x1000 /end MEASUREMENT
/begin MEASUREMENT tpu_ign_err_cnt_zyl10 "TPU IGN MSG Fehlerzaehler." UWORD FORMULA_IGN9 0 0 0.0 15.0000 ECU_ADDRESS 0x3041B8 /begin FUNCTION_LIST TPU /end FUNCTION_LIST BIT_MASK 0x0E00 /end MEASUREMENT
/begin MEASUREMENT tpu_ign_pin_level_zyl10 "TPU IGN Pin Level." UWORD FORMULA_IGN8 0 0 0.0 1.0000 ECU_ADDRESS 0x3041B8 /begin FUNCTION_LIST TPU /end FUNCTION_LIST BIT_MASK 0x0100 /end MEASUREMENT
/begin MEASUREMENT tpu_ign_temp_1_zyl10 "TPU IGN temp 1." UWORD FORMULA_IGN3 0 0 0.0 255.0000 ECU_ADDRESS 0x3041B8 /begin FUNCTION_LIST TPU /end FUNCTION_LIST BIT_MASK 0x00FF /end MEASUREMENT
/begin MEASUREMENT tpu_ign_temp_2_zyl10 "TPU IGN temp 2." UWORD FORMULA_IGN3 0 0 0.0 65535.0000 ECU_ADDRESS 0x3041BA /begin FUNCTION_LIST TPU /end FUNCTION_LIST /end MEASUREMENT
/begin MEASUREMENT tpu_ign_temp_3_zyl10 "TPU IGN temp 3." UWORD FORMULA_IGN3 0 0 0.0 65535.0000 ECU_ADDRESS 0x3041BC /begin FUNCTION_LIST TPU /end FUNCTION_LIST /end MEASUREMENT
/* TPU APG FORMELN -----------------------------------------------------------------------*/
/begin COMPU_METHOD FORMULA_APG1 "FORMULA_APG1" RAT_FUNC "%7.2" "�" COEFFS 0 1 0 0 0 0.01098633 /end COMPU_METHOD
/begin COMPU_METHOD FORMULA_APG2 "FORMULA_APG2" RAT_FUNC "%9.2" "ms" COEFFS 0 7000 0 0 0 1 /end COMPU_METHOD
/begin COMPU_METHOD FORMULA_APG3 "FORMULA_APG3" RAT_FUNC "%7.2" "ms" COEFFS 0 7000 0 0 0 1 /end COMPU_METHOD
/begin COMPU_METHOD FORMULA_APG4 "FORMULA_APG4" RAT_FUNC "%5.0" "-" COEFFS 0 2048 0 0 0 1 /end COMPU_METHOD
/* TPU APG Bank 1 ------------------------------------------------------------------------*/
/begin MEASUREMENT tpu_apg_start_angle_b1 "TPU APG start angle." UWORD FORMULA_APG1 0 0 0.0 719.9890 ECU_ADDRESS 0x3041E0 /begin FUNCTION_LIST TPU /end FUNCTION_LIST /end MEASUREMENT
/begin MEASUREMENT tpu_apg_angle_period_b1 "TPU APG angle period." UWORD FORMULA_APG1 0 0 0.0 719.9890 ECU_ADDRESS 0x3041E2 /begin FUNCTION_LIST TPU /end FUNCTION_LIST /end MEASUREMENT
/begin MEASUREMENT tpu_apg_min_time_b1 "Minimale Pulszeit." UWORD FORMULA_APG3 0 0 0.0 9.3621 ECU_ADDRESS 0x3041E4 /begin FUNCTION_LIST TPU /end FUNCTION_LIST /end MEASUREMENT
/begin MEASUREMENT tpu_apg_delta_time_cpu_b1 "Delta CPU Zeit." UWORD FORMULA_APG3 0 0 0.0 9.3621 ECU_ADDRESS 0x3041E6 /begin FUNCTION_LIST TPU /end FUNCTION_LIST /end MEASUREMENT
/begin MEASUREMENT tpu_apg_delta_time_tpu_b1 "Delta TPU Zeit." UWORD FORMULA_APG3 0 0 0.0 9.3621 ECU_ADDRESS 0x3041E8 /begin FUNCTION_LIST TPU /end FUNCTION_LIST /end MEASUREMENT
/begin MEASUREMENT tpu_apg_temp_angle_b1 "TPU APG temp angle." UWORD FORMULA_APG1 0 0 0.0 719.9890 ECU_ADDRESS 0x3041EA /begin FUNCTION_LIST TPU /end FUNCTION_LIST /end MEASUREMENT
/begin MEASUREMENT tpu_apg_channel_b1 "Letzter Zuendkanal." UWORD FORMULA_APG4 0 0 0.0 15.0000 ECU_ADDRESS 0x3041EC /begin FUNCTION_LIST TPU /end FUNCTION_LIST BIT_MASK 0x7800 /end MEASUREMENT
/begin MEASUREMENT tpu_apg_ign_time_b1 "Zeitpunkt letzte Zuendung." ULONG FORMULA_APG2 0 0 0.0 2396.7450 ECU_ADDRESS 0x3041EC /begin FUNCTION_LIST TPU /end FUNCTION_LIST BIT_MASK 0x00FFFFFF /end MEASUREMENT
/* TPU APG Bank 2 ------------------------------------------------------------------------*/
/begin MEASUREMENT tpu_apg_start_angle_b2 "TPU APG start angle." UWORD FORMULA_APG1 0 0 0.0 719.9890 ECU_ADDRESS 0x3041F0 /begin FUNCTION_LIST TPU /end FUNCTION_LIST /end MEASUREMENT
/begin MEASUREMENT tpu_apg_angle_period_b2 "TPU APG angle period." UWORD FORMULA_APG1 0 0 0.0 719.9890 ECU_ADDRESS 0x3041F2 /begin FUNCTION_LIST TPU /end FUNCTION_LIST /end MEASUREMENT
/begin MEASUREMENT tpu_apg_min_time_b2 "Minimale Pulszeit." UWORD FORMULA_APG3 0 0 0.0 9.3621 ECU_ADDRESS 0x3041F4 /begin FUNCTION_LIST TPU /end FUNCTION_LIST /end MEASUREMENT
/begin MEASUREMENT tpu_apg_delta_time_cpu_b2 "Delta CPU Zeit." UWORD FORMULA_APG3 0 0 0.0 9.3621 ECU_ADDRESS 0x3041F6 /begin FUNCTION_LIST TPU /end FUNCTION_LIST /end MEASUREMENT
/begin MEASUREMENT tpu_apg_delta_time_tpu_b2 "Delta TPU Zeit." UWORD FORMULA_APG3 0 0 0.0 9.3621 ECU_ADDRESS 0x3041F8 /begin FUNCTION_LIST TPU /end FUNCTION_LIST /end MEASUREMENT
/begin MEASUREMENT tpu_apg_temp_angle_b2 "TPU APG temp angle." UWORD FORMULA_APG1 0 0 0.0 719.9890 ECU_ADDRESS 0x3041FA /begin FUNCTION_LIST TPU /end FUNCTION_LIST /end MEASUREMENT
/begin MEASUREMENT tpu_apg_channel_b2 "Letzter Zuendkanal." UWORD FORMULA_APG4 0 0 0.0 15.0000 ECU_ADDRESS 0x3041FC /begin FUNCTION_LIST TPU /end FUNCTION_LIST BIT_MASK 0x7800 /end MEASUREMENT
/begin MEASUREMENT tpu_apg_ign_time_b2 "Zeitpunkt letzte Zuendung." ULONG FORMULA_APG2 0 0 0.0 2396.7450 ECU_ADDRESS 0x3041FC /begin FUNCTION_LIST TPU /end FUNCTION_LIST BIT_MASK 0x00FFFFFF /end MEASUREMENT
/* ------------------ Abschnitt erzeugt aus adapt_common.dat ------------------ */
/begin COMPU_METHOD FORMULA_0000 "FORMULA_0000" RAT_FUNC "%7.0" "-" COEFFS 0 1 0 0 0 1 /end COMPU_METHOD
/begin COMPU_METHOD FORMULA_0001 "FORMULA_0001" RAT_FUNC "%6.1" "%" COEFFS 0 10 0 0 0 1 /end COMPU_METHOD
/begin COMPU_METHOD FORMULA_0003 "FORMULA_0003" RAT_FUNC "%3.0" "-" COEFFS 0 1 0 0 0 1 /end COMPU_METHOD
/begin COMPU_METHOD FORMULA_0006 "FORMULA_0006" RAT_FUNC "%5.0" "Upm" COEFFS 0 1 0 0 0 1 /end COMPU_METHOD
/begin COMPU_METHOD FORMULA_0007 "FORMULA_0007" RAT_FUNC "%8.3" "-" COEFFS 0 10000 0 0 0 1 /end COMPU_METHOD
/begin COMPU_METHOD FORMULA_0008 "FORMULA_0008" RAT_FUNC "%6.1" "V" COEFFS 0 10 0 0 0 1 /end COMPU_METHOD
/begin COMPU_METHOD FORMULA_0010 "FORMULA_0010" RAT_FUNC "%5.0" "-" COEFFS 0 1 0 0 0 1 /end COMPU_METHOD
/begin COMPU_METHOD FORMULA_0019 "FORMULA_0019" TAB_VERB "%7.2" "-" COMPU_TAB_REF FORMULA_0019_VTAB /end COMPU_METHOD
/begin COMPU_VTAB FORMULA_0019_VTAB "FORMULA_0019_VTAB" TAB_VERB 13 1 "Motor steht" 2 "Motor presync" 4 "Start" 8 "LLOKS" 16 "LLMKS" 32 "TL" 64 "VL" 128 "SA" 256 "NL" 512 "Abgew." 1024 "Kl15 aus" 2048 "Wakeup" 4096 "Schub" DEFAULT_VALUE "undefiniert" /end COMPU_VTAB
/begin COMPU_METHOD FORMULA_0020 "FORMULA_0020" RAT_FUNC "%5.0" "qmm/s" COEFFS 0 1 0 0 0 20 /end COMPU_METHOD
/begin COMPU_METHOD FORMULA_0021 "FORMULA_0021" RAT_FUNC "%7.2" "s" COEFFS 0 100 0 0 0 1 /end COMPU_METHOD
/* ------------------ Abschnitt erzeugt aus adapt_glob.dat ------------------ */
/begin COMPU_METHOD FORMULA_0023 "FORMULA_0023" RAT_FUNC "%6.1" "�C" COEFFS 0 10 2732 0 0 1 /end COMPU_METHOD
/begin COMPU_METHOD FORMULA_0025 "FORMULA_0025" RAT_FUNC "%8.3" "-" COEFFS 0 16384 0 0 0 1 /end COMPU_METHOD
/begin COMPU_METHOD FORMULA_0033 "FORMULA_0033" RAT_FUNC "%5.2" "-" COEFFS 0 1 0 0 0 1 /end COMPU_METHOD
/* ------------------ Abschnitt erzeugt aus debug.dat ------------------ */
/begin COMPU_METHOD FORMULA_0041 "FORMULA_0041" RAT_FUNC "%9.2" "-" COEFFS 0 1 0 0 0 1 /end COMPU_METHOD
/begin COMPU_METHOD FORMULA_0075 "FORMULA_0075" RAT_FUNC "%8.3" "-" COEFFS 0 1024 0 0 0 1 /end COMPU_METHOD
/begin COMPU_METHOD FORMULA_0077 "FORMULA_0077" RAT_FUNC "%6.1" "mbar" COEFFS 0 16 0 0 0 1 /end COMPU_METHOD
/* ------------------ Abschnitt erzeugt aus glob.dat ------------------ */
/begin COMPU_METHOD FORMULA_0083 "FORMULA_0083" RAT_FUNC "%7.2" "-" COEFFS 0 1 0 0 0 1 /end COMPU_METHOD
/begin COMPU_METHOD FORMULA_0111 "FORMULA_0111" RAT_FUNC "%6.1" "�KW" COEFFS 0 10 0 0 0 1 /end COMPU_METHOD
/begin COMPU_METHOD FORMULA_0115 "FORMULA_0115" RAT_FUNC "%7.2" "%" COEFFS 0 16384 0 0 0 100 /end COMPU_METHOD
/begin COMPU_METHOD FORMULA_0117 "FORMULA_0117" RAT_FUNC "%7.2" "s" COEFFS 0 200 0 0 0 1 /end COMPU_METHOD
/begin COMPU_METHOD FORMULA_0123 "FORMULA_0123" RAT_FUNC "%5.0" "digit" COEFFS 0 1 0 0 0 1 /end COMPU_METHOD
/begin COMPU_METHOD FORMULA_0147 "FORMULA_0147" RAT_FUNC "%6.1" "qmm" COEFFS 0 10 0 0 0 1 /end COMPU_METHOD
/begin COMPU_METHOD FORMULA_0228 "FORMULA_0228" TAB_VERB "%5.2" "-" COMPU_TAB_REF FORMULA_0228_VTAB /end COMPU_METHOD
/begin COMPU_VTAB FORMULA_0228_VTAB "FORMULA_0228_VTAB" TAB_VERB 16 0 "O.K." 1 "SH_TO_UB" 2 "SH_TO_GND" 3 "UB+GND" 4 "OPENLOAD" 5 "UB+OL" 6 "GND+OL" 7 "UB+GND+OL" 8 "UNPLAUSI" 9 "UB+UP" 10 "GND+UP" 11 "UB+GND+UP" 12 "OL+UP" 13 "UB+OL+UP" 14 "GND+OL+UP" 15 "UB+GND+OL+UP" /end COMPU_VTAB
/begin COMPU_METHOD FORMULA_0265 "FORMULA_0265" RAT_FUNC "%7.2" "V" COEFFS 0 1966080 0 0 0 200 /end COMPU_METHOD
/begin COMPU_METHOD FORMULA_0276 "FORMULA_0276" RAT_FUNC "%5.0" "%/s" COEFFS 0 1 0 0 0 20 /end COMPU_METHOD
/begin COMPU_METHOD FORMULA_0290 "FORMULA_0290" RAT_FUNC "%7.2" "Nms2" COEFFS 0 512 0 0 0 1 /end COMPU_METHOD
/* ------------------ Abschnitt erzeugt aus pctrl.dat ------------------ */
/begin COMPU_METHOD FORMULA_0352 "FORMULA_0352" RAT_FUNC "%5.2" "s" COEFFS 0 200 0 0 0 1 /end COMPU_METHOD
/* ------------------ Abschnitt erzeugt aus tpu_kw.dat ------------------ */
/begin COMPU_METHOD FORMULA_0402 "FORMULA_0402" TAB_VERB "%3.0" "-" COMPU_TAB_REF FORMULA_0402_VTAB /end COMPU_METHOD
/begin COMPU_VTAB FORMULA_0402_VTAB "FORMULA_0402_VTAB" TAB_VERB 5 0 "sync - 720� Mode" 1 "sync - 360� Mode" 129 "suche Luecke" 161 "Zahnentprellung laeuft" 225 "nicht sync." /end COMPU_VTAB
/begin COMPU_METHOD FORMULA_0403 "FORMULA_0403" RAT_FUNC "%3.0" "-" COEFFS 0 -1 1 0 0 -1 /end COMPU_METHOD
/begin COMPU_METHOD FORMULA_0404 "FORMULA_0404" TAB_VERB "%3.0" "-" COMPU_TAB_REF FORMULA_0404_VTAB /end COMPU_METHOD
/begin COMPU_VTAB FORMULA_0404_VTAB "FORMULA_0404_VTAB" TAB_VERB 1 0 "Kein Interrupt." DEFAULT_VALUE "Mind. Einfachinterrupt." /end COMPU_VTAB
/begin COMPU_METHOD FORMULA_0405 "FORMULA_0405" TAB_VERB "%3.0" "-" COMPU_TAB_REF FORMULA_0405_VTAB /end COMPU_METHOD
/begin COMPU_VTAB FORMULA_0405_VTAB "FORMULA_0405_VTAB" TAB_VERB 1 0 "nein." DEFAULT_VALUE "aktiv." /end COMPU_VTAB
/begin COMPU_METHOD FORMULA_0406 "FORMULA_0406" TAB_VERB "%3.0" "-" COMPU_TAB_REF FORMULA_0406_VTAB /end COMPU_METHOD
/begin COMPU_VTAB FORMULA_0406_VTAB "FORMULA_0406_VTAB" TAB_VERB 1 0 "nein." DEFAULT_VALUE "aktiv." /end COMPU_VTAB
/begin COMPU_METHOD FORMULA_0407 "FORMULA_0407" TAB_VERB "%3.0" "-" COMPU_TAB_REF FORMULA_0407_VTAB /end COMPU_METHOD
/begin COMPU_VTAB FORMULA_0407_VTAB "FORMULA_0407_VTAB" TAB_VERB 1 0 "nein." DEFAULT_VALUE "aktiv." /end COMPU_VTAB
/begin COMPU_METHOD FORMULA_0408 "FORMULA_0408" TAB_VERB "%3.0" "-" COMPU_TAB_REF FORMULA_0408_VTAB /end COMPU_METHOD
/begin COMPU_VTAB FORMULA_0408_VTAB "FORMULA_0408_VTAB" TAB_VERB 1 0 "nein." DEFAULT_VALUE "aktiv." /end COMPU_VTAB
/begin COMPU_METHOD FORMULA_0409 "FORMULA_0409" TAB_VERB "%3.0" "-" COMPU_TAB_REF FORMULA_0409_VTAB /end COMPU_METHOD
/begin COMPU_VTAB FORMULA_0409_VTAB "FORMULA_0409_VTAB" TAB_VERB 1 0 "nein." DEFAULT_VALUE "aktiv." /end COMPU_VTAB
/begin COMPU_METHOD FORMULA_0410 "FORMULA_0410" TAB_VERB "%3.0" "-" COMPU_TAB_REF FORMULA_0410_VTAB /end COMPU_METHOD
/begin COMPU_VTAB FORMULA_0410_VTAB "FORMULA_0410_VTAB" TAB_VERB 1 0 "nein." DEFAULT_VALUE "aktiv." /end COMPU_VTAB
/begin COMPU_METHOD FORMULA_0411 "FORMULA_0411" TAB_VERB "%3.0" "-" COMPU_TAB_REF FORMULA_0411_VTAB /end COMPU_METHOD
/begin COMPU_VTAB FORMULA_0411_VTAB "FORMULA_0411_VTAB" TAB_VERB 1 0 "nein." DEFAULT_VALUE "aktiv." /end COMPU_VTAB
/begin COMPU_METHOD FORMULA_0412 "FORMULA_0412" TAB_VERB "%3.0" "-" COMPU_TAB_REF FORMULA_0412_VTAB /end COMPU_METHOD
/begin COMPU_VTAB FORMULA_0412_VTAB "FORMULA_0412_VTAB" TAB_VERB 1 0 "nein." DEFAULT_VALUE "aktiv." /end COMPU_VTAB
/begin COMPU_METHOD FORMULA_0413 "FORMULA_0413" RAT_FUNC "%5.0" "Upm" COEFFS 0 0 27344 0 1 0 /end COMPU_METHOD
/* ------------------ Abschnitt erzeugt aus version.dat ------------------ */
/begin COMPU_METHOD FORMULA_0414 "FORMULA_0414" TAB_VERB "%3.0" "-" COMPU_TAB_REF FORMULA_0414_VTAB /end COMPU_METHOD
/begin COMPU_VTAB FORMULA_0414_VTAB "FORMULA_0414_VTAB" TAB_VERB 63 45 "-" 48 "0" 49 "1" 50 "2" 51 "3" 52 "4" 53 "5" 54 "6" 55 "7" 56 "8" 57 "9" 65 "A" 66 "B" 67 "C" 68 "D" 69 "E" 70 "F" 71 "G" 72 "H" 73 "I" 74 "J" 75 "K" 76 "L" 77 "M" 78 "N" 79 "O" 80 "P" 81 "Q" 82 "R" 83 "S" 84 "T" 85 "U" 86 "V" 87 "W" 88 "X" 89 "Y" 90 "Z" 97 "a" 98 "b" 99 "c" 100 "d" 101 "e" 102 "f" 103 "g" 104 "h" 105 "i" 106 "j" 107 "k" 108 "l" 109 "m" 110 "n" 111 "o" 112 "p" 113 "q" 114 "r" 115 "s" 116 "t" 117 "u" 118 "v" 119 "w" 120 "x" 121 "y" 122 "z" DEFAULT_VALUE "DEZ" /end COMPU_VTAB
/begin COMPU_METHOD FORMULA_0415 "FORMULA_0415" TAB_VERB "%5.2" "-" COMPU_TAB_REF FORMULA_0415_VTAB /end COMPU_METHOD
/begin COMPU_VTAB FORMULA_0415_VTAB "FORMULA_0415_VTAB" TAB_VERB 29 0 "Labordaten" 1 "ZS-E-45" 2 "Master" 3 "Prerauer" 4 "Erler" 5 "Heiss" 6 "Lutz" 7 "Maier" 8 "Andritzky" 9 "Neumann" 10 "Wilke" 11 "Scherer" 12 "Erdoedy" 13 "Fischer" 14 "May" 15 "ECE" 16 "US" 17 "Habermann" 18 "Moesbauer" 19 "Hartke" 20 "Renner" 21 "Stoll" 22 "Schaefer" 23 "Ast" 24 "Eickmeyer" 25 "Biebl" 26 "Betz" 27 "NN2" 28 "NN2" DEFAULT_VALUE "unbekannt" /end COMPU_VTAB
/begin COMPU_METHOD FORMULA_0416 "FORMULA_0416" TAB_VERB "%5.2" "-" COMPU_TAB_REF FORMULA_0416_VTAB /end COMPU_METHOD
/begin COMPU_VTAB FORMULA_0416_VTAB "FORMULA_0416_VTAB" TAB_VERB 6 177 "B1-Muster" 178 "B2-Muster" 179 "B3-Muster" 193 "C1-Muster" 194 "C2-Muster" 255 "ohne Kennung" /end COMPU_VTAB
/begin COMPU_METHOD FORMULA_0417 "FORMULA_0417" TAB_VERB "%5.2" "-" COMPU_TAB_REF FORMULA_0417_VTAB /end COMPU_METHOD
/begin COMPU_VTAB FORMULA_0417_VTAB "FORMULA_0417_VTAB" TAB_VERB 2 1 "INJ" 2 "IGN" DEFAULT_VALUE "undefiniert" /end COMPU_VTAB
/* ------------------ Abschnitt erzeugt aus aq.dat ------------------ */
/begin COMPU_METHOD FORMULA_0477 "FORMULA_0477" RAT_FUNC "%7.2" "s" COEFFS 0 0 327.67 0 1 0 /end COMPU_METHOD
/begin COMPU_METHOD FORMULA_0478 "FORMULA_0478" RAT_FUNC "%6.3" "s" COEFFS 0 0 1.28 0 1 0 /end COMPU_METHOD
/begin COMPU_METHOD FORMULA_0479 "FORMULA_0479" RAT_FUNC "%4.1" "%" COEFFS 0 10 0 0 0 1 /end COMPU_METHOD
/* ------------------ Abschnitt erzeugt aus diag_tr.dat ------------------ */
/begin COMPU_METHOD FORMULA_0580 "FORMULA_0580" TAB_VERB "%5.2" "-" COMPU_TAB_REF FORMULA_0580_VTAB /end COMPU_METHOD
/begin COMPU_VTAB FORMULA_0580_VTAB "FORMULA_0580_VTAB" TAB_VERB 4 0 "Aus" 1 "readDummy" 2 "An" 4 "Stop" DEFAULT_VALUE "undef" /end COMPU_VTAB
/begin COMPU_METHOD FORMULA_0710 "FORMULA_0710" RAT_FUNC "%6.1" "�KW" COEFFS 0 65536 0 0 0 720 /end COMPU_METHOD
/begin COMPU_METHOD FORMULA_0774 "FORMULA_0774" RAT_FUNC "%3.0" "Segm" COEFFS 0 1 0 0 0 1 /end COMPU_METHOD
/* ------------------ Abschnitt erzeugt aus tpu_ign.dat ------------------ */
/begin COMPU_METHOD FORMULA_1027 "FORMULA_1027" RAT_FUNC "%3.0" "us" COEFFS 0 0.875 0 0 0 1 /end COMPU_METHOD
/* ------------------ Abschnitt erzeugt aus tz.dat ------------------ */
/begin COMPU_METHOD FORMULA_1035 "FORMULA_1035" RAT_FUNC "%7.2" "ms" COEFFS 0 10000 0 0 0 8 /end COMPU_METHOD
/begin COMPU_METHOD FORMULA_1036 "FORMULA_1036" RAT_FUNC "%7.2" "Grad/10ms" COEFFS 0 160 0 0 0 1 /end COMPU_METHOD
/begin COMPU_METHOD FORMULA_1037 "FORMULA_1037" TAB_VERB "%3.0" "-" COMPU_TAB_REF FORMULA_1037_VTAB /end COMPU_METHOD
/begin COMPU_VTAB FORMULA_1037_VTAB "FORMULA_1037_VTAB" TAB_VERB 2 0 "inaktiv" 1 "aktiv" DEFAULT_VALUE "ungueltig" /end COMPU_VTAB
/begin COMPU_METHOD FORMULA_1038 "FORMULA_1038" RAT_FUNC "%6.1" "A" COEFFS 0 1000 0 0 0 1 /end COMPU_METHOD
/begin COMPU_METHOD FORMULA_1039 "FORMULA_1039" RAT_FUNC "%3.0" "seg" COEFFS 0 1 0 0 0 2 /end COMPU_METHOD
/begin COMPU_METHOD FORMULA_1040 "FORMULA_1040" RAT_FUNC "%6.1" "�/Segment" COEFFS 0 10 0 0 0 1 /end COMPU_METHOD
/begin COMPU_METHOD FORMULA_1041 "FORMULA_1041" RAT_FUNC "%3.0" "seg" COEFFS 0 -1 1 0 0 -1 /end COMPU_METHOD
/begin COMPU_METHOD FORMULA_1042 "FORMULA_1042" RAT_FUNC "%4.1" "�KW/seg" COEFFS 0 10 0 0 0 1 /end COMPU_METHOD
/begin COMPU_METHOD FORMULA_1043 "FORMULA_1043" RAT_FUNC "%5.2" "-/segment" COEFFS 0 256 0 0 0 1 /end COMPU_METHOD
/* ------------------ Abschnitt erzeugt aus uext.dat ------------------ */
/begin COMPU_METHOD FORMULA_1045 "FORMULA_1045" RAT_FUNC "%7.2" "V" COEFFS 0 30720 0 0 0 200 /end COMPU_METHOD
/* ------------------ Abschnitt erzeugt aus tpu_code.dat ------------------ */
/begin MEASUREMENT tpu_code_status "TPU MicroCode Status." UWORD FORMULA_0010 0 0 0.0 65535.0000 ECU_ADDRESS 0x3FC4A2 /end MEASUREMENT
/begin MEASUREMENT tpu_a.TPUMCR "TPU3 Module Configuration Register." UWORD FORMULA_0010 0 0 0.0 65535.0000 ECU_ADDRESS 0x304000 /end MEASUREMENT
/begin MEASUREMENT tpu_a.TICR "TPU3 Interrupt Configuration Register." UWORD FORMULA_0010 0 0 0.0 65535.0000 ECU_ADDRESS 0x304008 /end MEASUREMENT
/begin MEASUREMENT tpu_a.CIER "Channel Interrupt Enable Register." UWORD FORMULA_0010 0 0 0.0 65535.0000 ECU_ADDRESS 0x30400A /end MEASUREMENT
/begin MEASUREMENT tpu_a.CFSR01 "Channel Funktion Selection Register 0,1." ULONG FORMULA_0000 0 0 0.0 4294967295.0000 ECU_ADDRESS 0x30400C /end MEASUREMENT
/begin MEASUREMENT tpu_a.CFSR23 "Channel Funktion Selection Register 2,3." ULONG FORMULA_0000 0 0 0.0 4294967295.0000 ECU_ADDRESS 0x304010 /end MEASUREMENT
/begin MEASUREMENT tpu_a.HSQR "Host Sequence Register 0,1." ULONG FORMULA_0000 0 0 0.0 4294967295.0000 ECU_ADDRESS 0x304014 /end MEASUREMENT
/begin MEASUREMENT tpu_a.HSRR "Host Service Request Register 0,1." ULONG FORMULA_0000 0 0 0.0 4294967295.0000 ECU_ADDRESS 0x304018 /end MEASUREMENT
/begin MEASUREMENT tpu_a.CPR "Channel Priority Register 0,1." ULONG FORMULA_0000 0 0 0.0 4294967295.0000 ECU_ADDRESS 0x30401C /end MEASUREMENT
/begin MEASUREMENT tpu_a.CISR "Channel Interrupt Status Register." UWORD FORMULA_0010 0 0 0.0 65535.0000 ECU_ADDRESS 0x304020 /end MEASUREMENT
/begin MEASUREMENT tpu_a.TPUMCR2 "TPU Module Configuration Register 2." UWORD FORMULA_0010 0 0 0.0 65535.0000 ECU_ADDRESS 0x304028 /end MEASUREMENT
/begin MEASUREMENT tpu_a.TPUMCR3 "TPU Module Configuration Register 3." UWORD FORMULA_0010 0 0 0.0 65535.0000 ECU_ADDRESS 0x30402A /end MEASUREMENT
/begin MEASUREMENT tpu_b.TPUMCR "TPU3 Module Configuration Register." UWORD FORMULA_0010 0 0 0.0 65535.0000 ECU_ADDRESS 0x304400 /end MEASUREMENT
/begin MEASUREMENT tpu_b.TICR "TPU3 Interrupt Configuration Register." UWORD FORMULA_0010 0 0 0.0 65535.0000 ECU_ADDRESS 0x304408 /end MEASUREMENT
/begin MEASUREMENT tpu_b.CIER "Channel Interrupt Enable Register." UWORD FORMULA_0010 0 0 0.0 65535.0000 ECU_ADDRESS 0x30440A /end MEASUREMENT
/begin MEASUREMENT tpu_b.CFSR01 "Channel Funktion Selection Register 0,1." ULONG FORMULA_0000 0 0 0.0 4294967295.0000 ECU_ADDRESS 0x30440C /end MEASUREMENT
/begin MEASUREMENT tpu_b.CFSR23 "Channel Funktion Selection Register 2,3." ULONG FORMULA_0000 0 0 0.0 4294967295.0000 ECU_ADDRESS 0x304410 /end MEASUREMENT
/begin MEASUREMENT tpu_b.HSQR "Host Sequence Register 0,1." ULONG FORMULA_0000 0 0 0.0 4294967295.0000 ECU_ADDRESS 0x304414 /end MEASUREMENT
/begin MEASUREMENT tpu_b.HSRR "Host Service Request Register 0,1." ULONG FORMULA_0000 0 0 0.0 4294967295.0000 ECU_ADDRESS 0x304418 /end MEASUREMENT
/begin MEASUREMENT tpu_b.CPR "Channel Priority Register 0,1." ULONG FORMULA_0000 0 0 0.0 4294967295.0000 ECU_ADDRESS 0x30441C /end MEASUREMENT
/begin MEASUREMENT tpu_b.CISR "Channel Interrupt Status Register." UWORD FORMULA_0010 0 0 0.0 65535.0000 ECU_ADDRESS 0x304420 /end MEASUREMENT
/begin MEASUREMENT tpu_b.TPUMCR2 "TPU Module Configuration Register 2." UWORD FORMULA_0010 0 0 0.0 65535.0000 ECU_ADDRESS 0x304428 /end MEASUREMENT
/begin MEASUREMENT tpu_b.TPUMCR3 "TPU Module Configuration Register 3." UWORD FORMULA_0010 0 0 0.0 65535.0000 ECU_ADDRESS 0x30442A /end MEASUREMENT
/* ------------------ Abschnitt erzeugt aus tpu_kw.dat ------------------ */
/begin CHARACTERISTIC K_TPU_KW_N_MIN "Unterdrehzahl. | EN: Under-speed" VALUE 0x79B40 TKW_VV_VV_UW 100.0 FORMULA_0413 4.0000 10000.0000 /end CHARACTERISTIC
/begin CHARACTERISTIC K_TPU_KW_SYNC_ZAHN "KW Interruptzahn zur NW Sync. | EN: Crankshaft interrupt tooth for camshaft sync" VALUE 0x79B42 TKW_VV_VV_UB 100.0 FORMULA_0003 0.0 59.0000 /end CHARACTERISTIC
/begin MEASUREMENT tpu_st_a "Status TPU Synchronisation" UBYTE FORMULA_0402 0 0 0.0 255.0 ECU_ADDRESS 0x3FC4A4 /end MEASUREMENT
/begin MEASUREMENT tpu_st_b "Status TPU Synchronisation" UBYTE FORMULA_0402 0 0 0.0 255.0 ECU_ADDRESS 0x3FC4A5 /end MEASUREMENT
/begin MEASUREMENT tpu_zyl "aktueller Zylinder" UBYTE FORMULA_0403 0 0 1.0000 12.0000 ECU_ADDRESS 0x3FC4A6 /end MEASUREMENT
/begin MEASUREMENT tpu_zyl_p2 "zwei Zylinder in der Zukunft" UBYTE FORMULA_0403 0 0 1.0000 12.0000 ECU_ADDRESS 0x3FC4A7 /end MEASUREMENT
/begin MEASUREMENT tpu_bank "aktuelle Bank" UBYTE FORMULA_0403 0 0 1.0000 2.0000 ECU_ADDRESS 0x3FC4A8 /end MEASUREMENT
/begin MEASUREMENT tpu_zyl_bank "aktueller Zylinder der Bank" UBYTE FORMULA_0403 0 0 1.0000 2.0000 ECU_ADDRESS 0x3FC4A9 /end MEASUREMENT
/begin MEASUREMENT tpu_index "Segmentindex fuer den Gesamtmotor" UBYTE FORMULA_0003 0 0 0.0 11.0000 ECU_ADDRESS 0x3FC4AA /end MEASUREMENT
/begin MEASUREMENT tpu_kw_rot "Rotation." UBYTE FORMULA_0003 0 0 0.0 1.0000 ECU_ADDRESS 0x3FC4AB /end MEASUREMENT
/begin MEASUREMENT tpu_idx_a "Segmentindex auf TPU" UBYTE FORMULA_0003 0 0 0.0 5.0000 ECU_ADDRESS 0x3FC4AC /end MEASUREMENT
/begin MEASUREMENT tpu_idx_b "Segmentindex auf TPU" UBYTE FORMULA_0003 0 0 0.0 5.0000 ECU_ADDRESS 0x3FC4AD /end MEASUREMENT
/begin MEASUREMENT tpu_kw_nw_sync_cnt_a "Umsynchronisationszaehler" UBYTE FORMULA_0003 0 0 0.0 255.0000 ECU_ADDRESS 0x3FC4AE /end MEASUREMENT
/begin MEASUREMENT tpu_kw_nw_sync_cnt_b "Umsynchronisationszaehler" UBYTE FORMULA_0003 0 0 0.0 255.0000 ECU_ADDRESS 0x3FC4AF /end MEASUREMENT
/begin MEASUREMENT tpu_kw_irq_a "Letzte KW Interruptart." UBYTE FORMULA_0404 0 0 0.0 255.0 ECU_ADDRESS 0x3FC4B0 /end MEASUREMENT
/begin MEASUREMENT tpu_kw_irq_b "Letzte KW Interruptart." UBYTE FORMULA_0404 0 0 0.0 255.0 ECU_ADDRESS 0x3FC4B1 /end MEASUREMENT
/begin MEASUREMENT tpu_kw_irq_tooth_a "Zahninterrupt." UBYTE FORMULA_0405 0 0 0.0 255.0 ECU_ADDRESS 0x3FC4B0 BIT_MASK 0x80 /end MEASUREMENT
/begin MEASUREMENT tpu_kw_irq_tooth_b "Zahninterrupt." UBYTE FORMULA_0405 0 0 0.0 255.0 ECU_ADDRESS 0x3FC4B1 BIT_MASK 0x80 /end MEASUREMENT
/begin MEASUREMENT tpu_kw_irq_segm_a "Segmentinterrupt." UBYTE FORMULA_0406 0 0 0.0 255.0 ECU_ADDRESS 0x3FC4B0 BIT_MASK 0x40 /end MEASUREMENT
/begin MEASUREMENT tpu_kw_irq_segm_b "Segmentinterrupt." UBYTE FORMULA_0406 0 0 0.0 255.0 ECU_ADDRESS 0x3FC4B1 BIT_MASK 0x40 /end MEASUREMENT
/begin MEASUREMENT tpu_kw_irq_mess_a "Messfensterinterrupt (LU)." UBYTE FORMULA_0407 0 0 0.0 255.0 ECU_ADDRESS 0x3FC4B0 BIT_MASK 0x20 /end MEASUREMENT
/begin MEASUREMENT tpu_kw_irq_mess_b "Messfensterinterrupt (LU)." UBYTE FORMULA_0407 0 0 0.0 255.0 ECU_ADDRESS 0x3FC4B1 BIT_MASK 0x20 /end MEASUREMENT
/begin MEASUREMENT tpu_kw_irq_n_min_a "Unterdrehzahlinterrupt." UBYTE FORMULA_0408 0 0 0.0 255.0 ECU_ADDRESS 0x3FC4B0 BIT_MASK 0x10 /end MEASUREMENT
/begin MEASUREMENT tpu_kw_irq_n_min_b "Unterdrehzahlinterrupt." UBYTE FORMULA_0408 0 0 0.0 255.0 ECU_ADDRESS 0x3FC4B1 BIT_MASK 0x10 /end MEASUREMENT
/begin MEASUREMENT tpu_kw_irq_error_a "Fehlerinterrupt." UBYTE FORMULA_0409 0 0 0.0 255.0 ECU_ADDRESS 0x3FC4B0 BIT_MASK 0x8 /end MEASUREMENT
/begin MEASUREMENT tpu_kw_irq_error_b "Fehlerinterrupt." UBYTE FORMULA_0409 0 0 0.0 255.0 ECU_ADDRESS 0x3FC4B1 BIT_MASK 0x8 /end MEASUREMENT
/begin MEASUREMENT tpu_kw_irq_pre_sync_a "Pre-Sync-Interrupt (Start Lueckensuche)." UBYTE FORMULA_0410 0 0 0.0 255.0 ECU_ADDRESS 0x3FC4B0 BIT_MASK 0x4 /end MEASUREMENT
/begin MEASUREMENT tpu_kw_irq_pre_sync_b "Pre-Sync-Interrupt (Start Lueckensuche)." UBYTE FORMULA_0410 0 0 0.0 255.0 ECU_ADDRESS 0x3FC4B1 BIT_MASK 0x4 /end MEASUREMENT
/begin MEASUREMENT tpu_kw_irq_sync_a "Sync-Interrupt (Luecke gefunden)." UBYTE FORMULA_0411 0 0 0.0 255.0 ECU_ADDRESS 0x3FC4B0 BIT_MASK 0x2 /end MEASUREMENT
/begin MEASUREMENT tpu_kw_irq_sync_b "Sync-Interrupt (Luecke gefunden)." UBYTE FORMULA_0411 0 0 0.0 255.0 ECU_ADDRESS 0x3FC4B1 BIT_MASK 0x2 /end MEASUREMENT
/begin MEASUREMENT tpu_kw_irq_info_a "Infointerrupt (+/- ein Zahn)." UBYTE FORMULA_0412 0 0 0.0 255.0 ECU_ADDRESS 0x3FC4B0 BIT_MASK 0x1 /end MEASUREMENT
/begin MEASUREMENT tpu_kw_irq_info_b "Infointerrupt (+/- ein Zahn)." UBYTE FORMULA_0412 0 0 0.0 255.0 ECU_ADDRESS 0x3FC4B1 BIT_MASK 0x1 /end MEASUREMENT
/begin MEASUREMENT tpu_kw_irq_zahn_a "Zahnnummer TPU bei Eintritt in ISR." UBYTE FORMULA_0003 0 0 0.0 255.0000 ECU_ADDRESS 0x3FC4B2 /end MEASUREMENT
/begin MEASUREMENT tpu_kw_irq_zahn_b "Zahnnummer TPU bei Eintritt in ISR." UBYTE FORMULA_0003 0 0 0.0 255.0000 ECU_ADDRESS 0x3FC4B3 /end MEASUREMENT
/begin MEASUREMENT tpu_kw_irq_cnt_a "TPU Interruptzaehler." UBYTE FORMULA_0003 0 0 0.0 255.0000 ECU_ADDRESS 0x3FC4B4 /end MEASUREMENT
/begin MEASUREMENT tpu_kw_irq_cnt_b "TPU Interruptzaehler." UBYTE FORMULA_0003 0 0 0.0 255.0000 ECU_ADDRESS 0x3FC4B5 /end MEASUREMENT
/begin MEASUREMENT tpu_kw_irq_segm_cnt_a "Anzahl Segmentinterrupts." UBYTE FORMULA_0003 0 0 0.0 255.0000 ECU_ADDRESS 0x3FC4B6 /end MEASUREMENT
/begin MEASUREMENT tpu_kw_irq_segm_cnt_b "Anzahl Segmentinterrupts." UBYTE FORMULA_0003 0 0 0.0 255.0000 ECU_ADDRESS 0x3FC4B7 /end MEASUREMENT
/begin MEASUREMENT tpu_kw_irq_tooth_cnt_a "Zahninterruptzaehler." UBYTE FORMULA_0003 0 0 0.0 255.0000 ECU_ADDRESS 0x3FC4B8 /end MEASUREMENT
/begin MEASUREMENT tpu_kw_irq_tooth_cnt_b "Zahninterruptzaehler." UBYTE FORMULA_0003 0 0 0.0 255.0000 ECU_ADDRESS 0x3FC4B9 /end MEASUREMENT
/* ------------------ Abschnitt erzeugt aus version.dat ------------------ */
/begin CHARACTERISTIC K_DATENKENNUNG_1_1of5_ "Datenkennsatzkennung Nr. 1" VALUE 0x70262 TKW_VV_VV_UB 100.0 FORMULA_0414 0.0 255.0 /end CHARACTERISTIC
/begin CHARACTERISTIC K_DATENKENNUNG_1_2of5_ "Datenkennsatzkennung Nr. 1" VALUE 0x70263 TKW_VV_VV_UB 100.0 FORMULA_0414 0.0 255.0 /end CHARACTERISTIC
/begin CHARACTERISTIC K_DATENKENNUNG_1_3of5_ "Datenkennsatzkennung Nr. 1" VALUE 0x70264 TKW_VV_VV_UB 100.0 FORMULA_0414 0.0 255.0 /end CHARACTERISTIC
/begin CHARACTERISTIC K_DATENKENNUNG_1_4of5_ "Datenkennsatzkennung Nr. 1" VALUE 0x70265 TKW_VV_VV_UB 100.0 FORMULA_0414 0.0 255.0 /end CHARACTERISTIC
/begin CHARACTERISTIC K_DATENKENNUNG_1_5of5_ "Datenkennsatzkennung Nr. 1" VALUE 0x70266 TKW_VV_VV_UB 100.0 FORMULA_0414 0.0 255.0 /end CHARACTERISTIC
/begin CHARACTERISTIC K_DATENKENNUNG_2_1of5_ "Datenkennsatzkennung Nr. 2" VALUE 0x70273 TKW_VV_VV_UB 100.0 FORMULA_0414 0.0 255.0 /end CHARACTERISTIC
/begin CHARACTERISTIC K_DATENKENNUNG_2_2of5_ "Datenkennsatzkennung Nr. 2" VALUE 0x70274 TKW_VV_VV_UB 100.0 FORMULA_0414 0.0 255.0 /end CHARACTERISTIC
/begin CHARACTERISTIC K_DATENKENNUNG_2_3of5_ "Datenkennsatzkennung Nr. 2" VALUE 0x70275 TKW_VV_VV_UB 100.0 FORMULA_0414 0.0 255.0 /end CHARACTERISTIC
/begin CHARACTERISTIC K_DATENKENNUNG_2_4of5_ "Datenkennsatzkennung Nr. 2" VALUE 0x70276 TKW_VV_VV_UB 100.0 FORMULA_0414 0.0 255.0 /end CHARACTERISTIC
/begin CHARACTERISTIC K_DATENKENNUNG_2_5of5_ "Datenkennsatzkennung Nr. 2" VALUE 0x70277 TKW_VV_VV_UB 100.0 FORMULA_0414 0.0 255.0 /end CHARACTERISTIC
/begin CHARACTERISTIC K_DATENKENNUNG_3_1of5_ "Datenkennsatzkennung Nr. 3" VALUE 0x70284 TKW_VV_VV_UB 100.0 FORMULA_0414 0.0 255.0 /end CHARACTERISTIC
/begin CHARACTERISTIC K_DATENKENNUNG_3_2of5_ "Datenkennsatzkennung Nr. 3" VALUE 0x70285 TKW_VV_VV_UB 100.0 FORMULA_0414 0.0 255.0 /end CHARACTERISTIC
/begin CHARACTERISTIC K_DATENKENNUNG_3_3of5_ "Datenkennsatzkennung Nr. 3" VALUE 0x70286 TKW_VV_VV_UB 100.0 FORMULA_0414 0.0 255.0 /end CHARACTERISTIC
/begin CHARACTERISTIC K_DATENKENNUNG_3_4of5_ "Datenkennsatzkennung Nr. 3" VALUE 0x70287 TKW_VV_VV_UB 100.0 FORMULA_0414 0.0 255.0 /end CHARACTERISTIC
/begin CHARACTERISTIC K_DATENKENNUNG_3_5of5_ "Datenkennsatzkennung Nr. 3" VALUE 0x70288 TKW_VV_VV_UB 100.0 FORMULA_0414 0.0 255.0 /end CHARACTERISTIC
/begin CHARACTERISTIC K_VERS_PROG "Programmversion | EN: Program version" VALUE 0x70250 TKW_VV_VV_UW 100.0 FORMULA_0010 0.0 65535.0000 /end CHARACTERISTIC
/begin CHARACTERISTIC K_VERS_PROZ "Prozessorkennung | EN: Processor ID" VALUE 0x70252 TKW_VV_VV_UB 100.0 FORMULA_0417 0.0 255.0 /end CHARACTERISTIC
/begin CHARACTERISTIC K_VERS_NAME "Applikateur | EN: Calibrator ID" VALUE 0x70253 TKW_VV_VV_UB 100.0 FORMULA_0415 0.0 255.0 /end CHARACTERISTIC
/begin CHARACTERISTIC K_VERS_DATEN "Datenversion | EN: Data version" VALUE 0x70254 TKW_VV_VV_UW 100.0 FORMULA_0010 0.0 65535.0000 /end CHARACTERISTIC
/begin MEASUREMENT vers_prog "Programmversion" UWORD FORMULA_0010 0 0 0.0 65535.0000 ECU_ADDRESS 0x3FC612 /end MEASUREMENT
/begin MEASUREMENT vers_index "Programmindex" UBYTE FORMULA_0003 0 0 0.0 255.0000 ECU_ADDRESS 0x3FC614 /end MEASUREMENT
/begin MEASUREMENT vers_name "Applikateur der Ref-Page" UBYTE FORMULA_0415 0 0 0.0 255.0 ECU_ADDRESS 0x3FC615 /end MEASUREMENT
/begin MEASUREMENT vers_sg "verbautes Steuergeraet" UBYTE FORMULA_0416 0 0 0.0 255.0 ECU_ADDRESS 0x3FC616 /end MEASUREMENT
/* ------------------ Abschnitt erzeugt aus aq.dat ------------------ */
/begin CHARACTERISTIC K_AQ_DR_REL_GRAD_TAU "TAU fuer dr_rel Gradienten" VALUE 0x702C2 TKW_VV_VV_UB 100.0 FORMULA_0478 0.0051 1.2800 /end CHARACTERISTIC
/begin CHARACTERISTIC K_AQ_DK0_DK_IST_SCHW "DkIst-Schwelle fuer DK0-Erkennung | EN: DkIst-Schwelle fuer DK0 -Erkennung" VALUE 0x702C3 TKW_VV_VV_UB 100.0 FORMULA_0479 0.0 25.5000 /end CHARACTERISTIC
/begin CHARACTERISTIC K_AQ_RF_RG_KORR_FAK "Korrektur der Restgasmenge" VALUE 0x702C4 TKW_VV_VV_UW 100.0 FORMULA_0075 0.0 4.0000 FORMAT "%6.3" /end CHARACTERISTIC
/begin CHARACTERISTIC K_AQ_LLS_ABW_T_MIN "Zeitschwelle fuer LLS eingeregelt | EN: Zeitschwelle fuer LLS eingeregelt" VALUE 0x702C6 TKW_VV_VV_UB 100.0 FORMULA_0352 0.0 1.2750 /end CHARACTERISTIC
/begin CHARACTERISTIC K_AQ_DK_ABW_T_MIN "Zeitschwelle fuer DK eingeregelt | EN: Zeitschwelle fuer DK eingeregelt" VALUE 0x702C7 TKW_VV_VV_UB 100.0 FORMULA_0352 0.0 1.2750 /end CHARACTERISTIC
/begin CHARACTERISTIC K_AQ_DK0_LLS_AQ_SCHW "AqLLS-Schwelle fuer DK0-Erkennung | EN: AqLLS-Schwelle fuer DK0 -Erkennung" VALUE 0x702C8 TKW_VV_VV_UW 100.0 FORMULA_0147 0.0 6500.0000 FORMAT "%4.1" /end CHARACTERISTIC
/begin CHARACTERISTIC KL_AQ_ABS_LLS "Oeffnungquerschnitt LLS (Bank) | EN: Idle air valve (LLS) opening cross-section (per bank)" CURVE 0x702CA TKL_SW_VV_UW 100.0 FORMULA_0147 0.0 6500.0000
 /begin AXIS_DESCR STD_AXIS wdk FORMULA_0001 8 -10.0000 120.0000 FORMAT "%4.1" /end AXIS_DESCR
 FORMAT "%4.1" /end CHARACTERISTIC
/begin CHARACTERISTIC KL_AQ_ABS_DK "Oeffnungsquerschnitt DK (Bank) | EN: Throttle opening cross-section (per bank)" CURVE 0x702EC TKL_SW_VV_UW 100.0 FORMULA_0147 0.0 6500.0000
 /begin AXIS_DESCR STD_AXIS wdk FORMULA_0001 8 -10.0000 120.0000 FORMAT "%4.1" /end AXIS_DESCR
 FORMAT "%4.1" /end CHARACTERISTIC
/begin CHARACTERISTIC KL_AQ_IST_RF_TAU "Tau fuer aq_rf Filter | EN: Tau fuer aq_rf Filter" CURVE 0x7030E TKL_SW_VV_UW 100.0 FORMULA_0477 0.0050 327.6700
 /begin AXIS_DESCR STD_AXIS egas_aq_soll_grad FORMULA_0020 5 -30000.0000 30000.0000 /end AXIS_DESCR
 FORMAT "%5.2" /end CHARACTERISTIC
/begin CHARACTERISTIC KL_AQ_ABS_LLS_ABW_MAX "Schwelle fuer LLS eingeregelt | EN: Threshold for idle air valve settled" CURVE 0x70324 TKL_UW_VV_UW 100.0 FORMULA_0147 0.0 6500.0000
 /begin AXIS_DESCR STD_AXIS aq_soll_lls FORMULA_0147 4 0.0 6500.0000 FORMAT "%4.1" /end AXIS_DESCR
 FORMAT "%4.1" /end CHARACTERISTIC
/begin CHARACTERISTIC KL_AQ_ABS_DK_ABW_MAX "Schwelle fuer DK eingeregelt | EN: Threshold for throttle position settled" CURVE 0x70336 TKL_UW_VV_UW 100.0 FORMULA_0147 0.0 6500.0000
 /begin AXIS_DESCR STD_AXIS aq_soll_dk FORMULA_0147 4 0.0 6500.0000 FORMAT "%4.1" /end AXIS_DESCR
 FORMAT "%4.1" /end CHARACTERISTIC
/begin CHARACTERISTIC KL_AQ_RF_MAX_ROH "maximale rel. Fuellung fuer die AQ-Berchnung " CURVE 0x70348 TKL_SW_VV_SW 100.0 FORMULA_0007 0.0 2.0000 /begin AXIS_DESCR STD_AXIS n FORMULA_0006 20 0.0 10000.0000 /end AXIS_DESCR FORMAT "%6.3" /end CHARACTERISTIC
/begin MEASUREMENT aq_abs_b1 "Abs. Oeffnungsquerschnitt" UWORD FORMULA_0147 0 0 0.0 6500.0000 ECU_ADDRESS 0x3FB18A /end MEASUREMENT
/begin MEASUREMENT aq_abs_b2 "Abs. Oeffnungsquerschnitt" UWORD FORMULA_0147 0 0 0.0 6500.0000 ECU_ADDRESS 0x3FB18C /end MEASUREMENT
/begin MEASUREMENT aq_abs_roh_b1 "Abs.roh Oeffnungsquerschnitt ohne sek. Einfluesse" UWORD FORMULA_0147 0 0 0.0 6500.0000 ECU_ADDRESS 0x3FB18E /end MEASUREMENT
/begin MEASUREMENT aq_abs_roh_b2 "Abs.roh Oeffnungsquerschnitt ohne sek. Einfluesse" UWORD FORMULA_0147 0 0 0.0 6500.0000 ECU_ADDRESS 0x3FB190 /end MEASUREMENT
/begin MEASUREMENT aq_abs_dk_b1 "Abs. Oeffnungsquerschnitt Drosselklappen" UWORD FORMULA_0147 0 0 0.0 6500.0000 ECU_ADDRESS 0x3FB192 /end MEASUREMENT
/begin MEASUREMENT aq_abs_dk_b2 "Abs. Oeffnungsquerschnitt Drosselklappen" UWORD FORMULA_0147 0 0 0.0 6500.0000 ECU_ADDRESS 0x3FB194 /end MEASUREMENT
/begin MEASUREMENT aq_abs_lls_b1 "Abs. Oeffnungsquerschnitt Leerlaufsystem" UWORD FORMULA_0147 0 0 0.0 6500.0000 ECU_ADDRESS 0x3FB196 /end MEASUREMENT
/begin MEASUREMENT aq_abs_lls_b2 "Abs. Oeffnungsquerschnitt Leerlaufsystem" UWORD FORMULA_0147 0 0 0.0 6500.0000 ECU_ADDRESS 0x3FB198 /end MEASUREMENT
/begin MEASUREMENT aq_abs_max_lls "Max. abs. Oeffnungsquerschnitt Leerlaufsystem" UWORD FORMULA_0147 0 0 0.0 6500.0000 ECU_ADDRESS 0x3FB19A /end MEASUREMENT
/begin MEASUREMENT aq_abs_max_dk "Max. abs. Oeffnungsquerschnitt Drosselklappen" UWORD FORMULA_0147 0 0 0.0 6500.0000 ECU_ADDRESS 0x3FB19C /end MEASUREMENT
/begin MEASUREMENT aq_rf_roh_b1 "Fuellung aus Inv. Ipol nicht gefiltert und rg korregiert" SWORD FORMULA_0007 0 0 0.0 2.0000 ECU_ADDRESS 0x3FB1A6 /end MEASUREMENT
/begin MEASUREMENT aq_rf_roh_b2 "Fuellung aus Inv. Ipol nicht gefiltert und rg korregiert" SWORD FORMULA_0007 0 0 0.0 2.0000 ECU_ADDRESS 0x3FB1A8 /end MEASUREMENT
/begin MEASUREMENT aq_rf_roh_fil_b1 "Fuellung aus Inv. Ipol gefiltert und rg korregiert" SWORD FORMULA_0007 0 0 0.0 2.0000 ECU_ADDRESS 0x3FB1AA /end MEASUREMENT
/begin MEASUREMENT aq_rf_roh_fil_b2 "Fuellung aus Inv. Ipol gefiltert und rg korregiert" SWORD FORMULA_0007 0 0 0.0 2.0000 ECU_ADDRESS 0x3FB1AC /end MEASUREMENT
/begin MEASUREMENT aq_tau_b1 "Filterkonstante fuer dr_rel und aq_rf" UWORD FORMULA_0477 0 0 0.0050 327.6700 ECU_ADDRESS 0x3FB1B2 /end MEASUREMENT
/begin MEASUREMENT aq_tau_b2 "Filterkonstante fuer dr_rel und aq_rf" UWORD FORMULA_0477 0 0 0.0050 327.6700 ECU_ADDRESS 0x3FB1B4 /end MEASUREMENT
/begin MEASUREMENT dr_rel_roh_b1 "relative Drosselung Roh (ohne Filterung)" SWORD FORMULA_0115 0 0 0.0 199.9938 ECU_ADDRESS 0x3FB1B6 /end MEASUREMENT
/begin MEASUREMENT dr_rel_roh_b2 "relative Drosselung Roh (ohne Filterung)" SWORD FORMULA_0115 0 0 0.0 199.9938 ECU_ADDRESS 0x3FB1B8 /end MEASUREMENT
/begin MEASUREMENT aq_rf_roh_inv_b1 "Fuellung aus Inv. Ipol.nicht gefiltert und keine korrektur" SWORD FORMULA_0007 0 0 0.0 2.0000 ECU_ADDRESS 0x3FB1BA /end MEASUREMENT
/begin MEASUREMENT aq_rf_roh_inv_b2 "Fuellung aus Inv. Ipol.nicht gefiltert und keine korrektur" SWORD FORMULA_0007 0 0 0.0 2.0000 ECU_ADDRESS 0x3FB1BC /end MEASUREMENT
/begin MEASUREMENT aq_rf_inv_b1 "Istfuellung Korrigiert mit FR+FRA+EGAS_AQ_WL" SWORD FORMULA_0007 0 0 0.0 2.0000 ECU_ADDRESS 0x3FB1BE /end MEASUREMENT
/begin MEASUREMENT aq_rf_inv_b2 "Istfuellung Korrigiert mit FR+FRA+EGAS_AQ_WL" SWORD FORMULA_0007 0 0 0.0 2.0000 ECU_ADDRESS 0x3FB1C0 /end MEASUREMENT
/begin MEASUREMENT aq_rf_van_inv_b1 "Istfuellung Korrigiert mit FR+FRA+EGAS_AQ_WL+VANOS" SWORD FORMULA_0007 0 0 0.0 2.0000 ECU_ADDRESS 0x3FB1C2 /end MEASUREMENT
/begin MEASUREMENT aq_rf_van_inv_b2 "Istfuellung Korrigiert mit FR+FRA+EGAS_AQ_WL+VANOS" SWORD FORMULA_0007 0 0 0.0 2.0000 ECU_ADDRESS 0x3FB1C4 /end MEASUREMENT
/begin MEASUREMENT aq_rf_max_roh "rf_max_roh" SWORD FORMULA_0007 0 0 0.0 2.0000 ECU_ADDRESS 0x3FB1C6 /end MEASUREMENT
/* ------------------ Abschnitt erzeugt aus diag_tr.dat ------------------ */
/begin CHARACTERISTIC K_DIAG_TR_MAX_ERR "erlaubte Fehler bis zum Eintrag als SG-Interner | EN: Permitted faults before entry as ECU-internal" VALUE 0x70C5C TKW_VV_VV_UB 100.0 FORMULA_0003 0.0 255.0000 /end CHARACTERISTIC
/begin MEASUREMENT diag_tr_atic29_tx_cnt "Checkbyte fuer die Queue" UBYTE FORMULA_0033 0 0 0.0 255.0000 ECU_ADDRESS 0x3FB555 /end MEASUREMENT
/begin MEASUREMENT diag_tr_atic29_error "Error Zaheler Atic29" UBYTE FORMULA_0033 0 0 0.0 255.0000 ECU_ADDRESS 0x3FB556 /end MEASUREMENT
/begin MEASUREMENT diag_st_atic29_nn "Diagnosestatus ATIC29 Treiber Queue IGN" UBYTE FORMULA_0228 0 0 0.0 15.0 ECU_ADDRESS 0x3FB557 BIT_MASK 0xF /end MEASUREMENT
/begin MEASUREMENT diag_st_atic29_ion1_verst "Diagnosestatus ATIC29 Treiber Queue IGN" UBYTE FORMULA_0228 0 0 0.0 15.0 ECU_ADDRESS 0x3FB558 BIT_MASK 0xF /end MEASUREMENT
/begin MEASUREMENT diag_st_atic29_ion1_spg "Diagnosestatus ATIC29 Treiber Queue IGN" UBYTE FORMULA_0228 0 0 0.0 15.0 ECU_ADDRESS 0x3FB559 BIT_MASK 0xF /end MEASUREMENT
/begin MEASUREMENT diag_st_atic29_ion2_verst "Diagnosestatus ATIC29 Treiber Queue IGN" UBYTE FORMULA_0228 0 0 0.0 15.0 ECU_ADDRESS 0x3FB55A BIT_MASK 0xF /end MEASUREMENT
/begin MEASUREMENT diag_st_atic29_ion2_spg "Diagnosestatus ATIC29 Treiber Queue IGN" UBYTE FORMULA_0228 0 0 0.0 15.0 ECU_ADDRESS 0x3FB55B BIT_MASK 0xF /end MEASUREMENT
/begin MEASUREMENT diag_tr_atic29_st "Diagnosetreiberstatus" UBYTE FORMULA_0580 0 0 0.0 255.0 ECU_ADDRESS 0x3FB55C /end MEASUREMENT
/* ------------------ Abschnitt erzeugt aus ioncom.dat ------------------ */
/begin MEASUREMENT ioncom_destaddr "IP-Adresse des Empf�ngers der Messdaten" ULONG FORMULA_0041 0 0 0.0 4294967295.0000 ECU_ADDRESS 0x3FB9C0 /end MEASUREMENT
/* ------------------ Abschnitt erzeugt aus j.dat ------------------ */
/begin CHARACTERISTIC K_J_MOTOR "Traegheitsmoment Motor | EN: Moment of inertia, engine" VALUE 0x73482 TKW_VV_VV_UW 100.0 FORMULA_0290 0.0010 120.0000 FORMAT "%5.2" /end CHARACTERISTIC
/begin CHARACTERISTIC K_J_AC "Traegheitsmoment AC | EN: Moment of inertia, A/C compressor" VALUE 0x73484 TKW_VV_VV_UW 100.0 FORMULA_0290 0.0 120.0000 FORMAT "%5.2" /end CHARACTERISTIC
/begin CHARACTERISTIC K_J_FZG_SMG_R "Traegheitsmoment Fzg - SMG | EN: Moment of inertia, vehicle - SMG" VALUE 0x73486 TKW_VV_VV_UW 100.0 FORMULA_0290 0.0 120.0000 FORMAT "%5.2" /end CHARACTERISTIC
/begin CHARACTERISTIC K_J_FZG_SMG_N "Traegheitsmoment Fzg - SMG | EN: Moment of inertia, vehicle - SMG" VALUE 0x73488 TKW_VV_VV_UW 100.0 FORMULA_0290 0.0 120.0000 FORMAT "%5.2" /end CHARACTERISTIC
/begin CHARACTERISTIC K_J_FZG_SMG_1 "Traegheitsmoment Fzg - SMG | EN: Moment of inertia, vehicle - SMG" VALUE 0x7348A TKW_VV_VV_UW 100.0 FORMULA_0290 0.0 120.0000 FORMAT "%5.2" /end CHARACTERISTIC
/begin CHARACTERISTIC K_J_FZG_SMG_2 "Traegheitsmoment Fzg - SMG | EN: Moment of inertia, vehicle - SMG" VALUE 0x7348C TKW_VV_VV_UW 100.0 FORMULA_0290 0.0 120.0000 FORMAT "%5.2" /end CHARACTERISTIC
/begin CHARACTERISTIC K_J_FZG_SMG_3 "Traegheitsmoment Fzg - SMG | EN: Moment of inertia, vehicle - SMG" VALUE 0x7348E TKW_VV_VV_UW 100.0 FORMULA_0290 0.0 120.0000 FORMAT "%5.2" /end CHARACTERISTIC
/begin CHARACTERISTIC K_J_FZG_SMG_4 "Traegheitsmoment Fzg - SMG | EN: Moment of inertia, vehicle - SMG" VALUE 0x73490 TKW_VV_VV_UW 100.0 FORMULA_0290 0.0 120.0000 FORMAT "%5.2" /end CHARACTERISTIC
/begin CHARACTERISTIC K_J_FZG_SMG_5 "Traegheitsmoment Fzg - SMG | EN: Moment of inertia, vehicle - SMG" VALUE 0x73492 TKW_VV_VV_UW 100.0 FORMULA_0290 0.0 120.0000 FORMAT "%5.2" /end CHARACTERISTIC
/begin CHARACTERISTIC K_J_FZG_SMG_6 "Traegheitsmoment Fzg - SMG | EN: Moment of inertia, vehicle - SMG" VALUE 0x73494 TKW_VV_VV_UW 100.0 FORMULA_0290 0.0 120.0000 FORMAT "%5.2" /end CHARACTERISTIC
/begin CHARACTERISTIC K_J_FZG_SMG_7 "Traegheitsmoment Fzg - SMG | EN: Moment of inertia, vehicle - SMG" VALUE 0x73496 TKW_VV_VV_UW 100.0 FORMULA_0290 0.0 120.0000 FORMAT "%5.2" /end CHARACTERISTIC
/begin CHARACTERISTIC K_J_FZG_HSG_R "Traegheitsmoment Fzg - SMG | EN: Moment of inertia, vehicle - SMG" VALUE 0x73498 TKW_VV_VV_UW 100.0 FORMULA_0290 0.0 120.0000 FORMAT "%5.2" /end CHARACTERISTIC
/begin CHARACTERISTIC K_J_FZG_HSG_N "Traegheitsmoment Fzg - SMG | EN: Moment of inertia, vehicle - SMG" VALUE 0x7349A TKW_VV_VV_UW 100.0 FORMULA_0290 0.0 120.0000 FORMAT "%5.2" /end CHARACTERISTIC
/begin CHARACTERISTIC K_J_FZG_HSG_1 "Traegheitsmoment Fzg - SMG | EN: Moment of inertia, vehicle - SMG" VALUE 0x7349C TKW_VV_VV_UW 100.0 FORMULA_0290 0.0 120.0000 FORMAT "%5.2" /end CHARACTERISTIC
/begin CHARACTERISTIC K_J_FZG_HSG_2 "Traegheitsmoment Fzg - SMG | EN: Moment of inertia, vehicle - SMG" VALUE 0x7349E TKW_VV_VV_UW 100.0 FORMULA_0290 0.0 120.0000 FORMAT "%5.2" /end CHARACTERISTIC
/begin CHARACTERISTIC K_J_FZG_HSG_3 "Traegheitsmoment Fzg - SMG | EN: Moment of inertia, vehicle - SMG" VALUE 0x734A0 TKW_VV_VV_UW 100.0 FORMULA_0290 0.0 120.0000 FORMAT "%5.2" /end CHARACTERISTIC
/begin CHARACTERISTIC K_J_FZG_HSG_4 "Traegheitsmoment Fzg - SMG | EN: Moment of inertia, vehicle - SMG" VALUE 0x734A2 TKW_VV_VV_UW 100.0 FORMULA_0290 0.0 120.0000 FORMAT "%5.2" /end CHARACTERISTIC
/begin CHARACTERISTIC K_J_FZG_HSG_5 "Traegheitsmoment Fzg - SMG | EN: Moment of inertia, vehicle - SMG" VALUE 0x734A4 TKW_VV_VV_UW 100.0 FORMULA_0290 0.0 120.0000 FORMAT "%5.2" /end CHARACTERISTIC
/begin CHARACTERISTIC K_J_FZG_HSG_6 "Traegheitsmoment Fzg - SMG | EN: Moment of inertia, vehicle - SMG" VALUE 0x734A6 TKW_VV_VV_UW 100.0 FORMULA_0290 0.0 120.0000 FORMAT "%5.2" /end CHARACTERISTIC
/begin CHARACTERISTIC K_J_FZG_HSG_7 "Traegheitsmoment Fzg - SMG | EN: Moment of inertia, vehicle - SMG" VALUE 0x734A8 TKW_VV_VV_UW 100.0 FORMULA_0290 0.0 120.0000 FORMAT "%5.2" /end CHARACTERISTIC
/begin CHARACTERISTIC K_J_FZG_DKG_R "Traegheitsmoment Fzg - SMG | EN: Moment of inertia, vehicle - SMG" VALUE 0x734AA TKW_VV_VV_UW 100.0 FORMULA_0290 0.0 120.0000 FORMAT "%5.2" /end CHARACTERISTIC
/begin CHARACTERISTIC K_J_FZG_DKG_N "Traegheitsmoment Fzg - SMG | EN: Moment of inertia, vehicle - SMG" VALUE 0x734AC TKW_VV_VV_UW 100.0 FORMULA_0290 0.0 120.0000 FORMAT "%5.2" /end CHARACTERISTIC
/begin CHARACTERISTIC K_J_FZG_DKG_1 "Traegheitsmoment Fzg - SMG | EN: Moment of inertia, vehicle - SMG" VALUE 0x734AE TKW_VV_VV_UW 100.0 FORMULA_0290 0.0 120.0000 FORMAT "%5.2" /end CHARACTERISTIC
/begin CHARACTERISTIC K_J_FZG_DKG_2 "Traegheitsmoment Fzg - SMG | EN: Moment of inertia, vehicle - SMG" VALUE 0x734B0 TKW_VV_VV_UW 100.0 FORMULA_0290 0.0 120.0000 FORMAT "%5.2" /end CHARACTERISTIC
/begin CHARACTERISTIC K_J_FZG_DKG_3 "Traegheitsmoment Fzg - SMG | EN: Moment of inertia, vehicle - SMG" VALUE 0x734B2 TKW_VV_VV_UW 100.0 FORMULA_0290 0.0 120.0000 FORMAT "%5.2" /end CHARACTERISTIC
/begin CHARACTERISTIC K_J_FZG_DKG_4 "Traegheitsmoment Fzg - SMG | EN: Moment of inertia, vehicle - SMG" VALUE 0x734B4 TKW_VV_VV_UW 100.0 FORMULA_0290 0.0 120.0000 FORMAT "%5.2" /end CHARACTERISTIC
/begin CHARACTERISTIC K_J_FZG_DKG_5 "Traegheitsmoment Fzg - SMG | EN: Moment of inertia, vehicle - SMG" VALUE 0x734B6 TKW_VV_VV_UW 100.0 FORMULA_0290 0.0 120.0000 FORMAT "%5.2" /end CHARACTERISTIC
/begin CHARACTERISTIC K_J_FZG_DKG_6 "Traegheitsmoment Fzg - SMG | EN: Moment of inertia, vehicle - SMG" VALUE 0x734B8 TKW_VV_VV_UW 100.0 FORMULA_0290 0.0 120.0000 FORMAT "%5.2" /end CHARACTERISTIC
/begin CHARACTERISTIC K_J_FZG_DKG_7 "Traegheitsmoment Fzg - SMG | EN: Moment of inertia, vehicle - SMG" VALUE 0x734BA TKW_VV_VV_UW 100.0 FORMULA_0290 0.0 120.0000 FORMAT "%5.2" /end CHARACTERISTIC
/begin MEASUREMENT j_fzg "Traegheitsmoment Fzg" UWORD FORMULA_0290 0 0 0.0 120.0000 ECU_ADDRESS 0x3FBA02 /end MEASUREMENT
/* ------------------ Abschnitt erzeugt aus tpu_code_ign.dat ------------------ */
/begin MEASUREMENT tpu_a_pram_1of16_1of8_ "Parameter RAM." UWORD FORMULA_0010 0 0 0.0 65535.0000 ECU_ADDRESS 0x304100 /end MEASUREMENT
/begin MEASUREMENT tpu_a_pram_1of16_2of8_ "Parameter RAM." UWORD FORMULA_0010 0 0 0.0 65535.0000 ECU_ADDRESS 0x304102 /end MEASUREMENT
/begin MEASUREMENT tpu_a_pram_1of16_3of8_ "Parameter RAM." UWORD FORMULA_0010 0 0 0.0 65535.0000 ECU_ADDRESS 0x304104 /end MEASUREMENT
/begin MEASUREMENT tpu_a_pram_1of16_4of8_ "Parameter RAM." UWORD FORMULA_0010 0 0 0.0 65535.0000 ECU_ADDRESS 0x304106 /end MEASUREMENT
/begin MEASUREMENT tpu_a_pram_1of16_5of8_ "Parameter RAM." UWORD FORMULA_0010 0 0 0.0 65535.0000 ECU_ADDRESS 0x304108 /end MEASUREMENT
/begin MEASUREMENT tpu_a_pram_1of16_6of8_ "Parameter RAM." UWORD FORMULA_0010 0 0 0.0 65535.0000 ECU_ADDRESS 0x30410A /end MEASUREMENT
/begin MEASUREMENT tpu_a_pram_1of16_7of8_ "Parameter RAM." UWORD FORMULA_0010 0 0 0.0 65535.0000 ECU_ADDRESS 0x30410C /end MEASUREMENT
/begin MEASUREMENT tpu_a_pram_1of16_8of8_ "Parameter RAM." UWORD FORMULA_0010 0 0 0.0 65535.0000 ECU_ADDRESS 0x30410E /end MEASUREMENT
/begin MEASUREMENT tpu_a_pram_2of16_1of8_ "Parameter RAM." UWORD FORMULA_0010 0 0 0.0 65535.0000 ECU_ADDRESS 0x304110 /end MEASUREMENT
/begin MEASUREMENT tpu_a_pram_2of16_2of8_ "Parameter RAM." UWORD FORMULA_0010 0 0 0.0 65535.0000 ECU_ADDRESS 0x304112 /end MEASUREMENT
/begin MEASUREMENT tpu_a_pram_2of16_3of8_ "Parameter RAM." UWORD FORMULA_0010 0 0 0.0 65535.0000 ECU_ADDRESS 0x304114 /end MEASUREMENT
/begin MEASUREMENT tpu_a_pram_2of16_4of8_ "Parameter RAM." UWORD FORMULA_0010 0 0 0.0 65535.0000 ECU_ADDRESS 0x304116 /end MEASUREMENT
/begin MEASUREMENT tpu_a_pram_2of16_5of8_ "Parameter RAM." UWORD FORMULA_0010 0 0 0.0 65535.0000 ECU_ADDRESS 0x304118 /end MEASUREMENT
/begin MEASUREMENT tpu_a_pram_2of16_6of8_ "Parameter RAM." UWORD FORMULA_0010 0 0 0.0 65535.0000 ECU_ADDRESS 0x30411A /end MEASUREMENT
/begin MEASUREMENT tpu_a_pram_2of16_7of8_ "Parameter RAM." UWORD FORMULA_0010 0 0 0.0 65535.0000 ECU_ADDRESS 0x30411C /end MEASUREMENT
/begin MEASUREMENT tpu_a_pram_2of16_8of8_ "Parameter RAM." UWORD FORMULA_0010 0 0 0.0 65535.0000 ECU_ADDRESS 0x30411E /end MEASUREMENT
/begin MEASUREMENT tpu_a_pram_3of16_1of8_ "Parameter RAM." UWORD FORMULA_0010 0 0 0.0 65535.0000 ECU_ADDRESS 0x304120 /end MEASUREMENT
/begin MEASUREMENT tpu_a_pram_3of16_2of8_ "Parameter RAM." UWORD FORMULA_0010 0 0 0.0 65535.0000 ECU_ADDRESS 0x304122 /end MEASUREMENT
/begin MEASUREMENT tpu_a_pram_3of16_3of8_ "Parameter RAM." UWORD FORMULA_0010 0 0 0.0 65535.0000 ECU_ADDRESS 0x304124 /end MEASUREMENT
/begin MEASUREMENT tpu_a_pram_3of16_4of8_ "Parameter RAM." UWORD FORMULA_0010 0 0 0.0 65535.0000 ECU_ADDRESS 0x304126 /end MEASUREMENT
/begin MEASUREMENT tpu_a_pram_3of16_5of8_ "Parameter RAM." UWORD FORMULA_0010 0 0 0.0 65535.0000 ECU_ADDRESS 0x304128 /end MEASUREMENT
/begin MEASUREMENT tpu_a_pram_3of16_6of8_ "Parameter RAM." UWORD FORMULA_0010 0 0 0.0 65535.0000 ECU_ADDRESS 0x30412A /end MEASUREMENT
/begin MEASUREMENT tpu_a_pram_3of16_7of8_ "Parameter RAM." UWORD FORMULA_0010 0 0 0.0 65535.0000 ECU_ADDRESS 0x30412C /end MEASUREMENT
/begin MEASUREMENT tpu_a_pram_3of16_8of8_ "Parameter RAM." UWORD FORMULA_0010 0 0 0.0 65535.0000 ECU_ADDRESS 0x30412E /end MEASUREMENT
/begin MEASUREMENT tpu_a_pram_4of16_1of8_ "Parameter RAM." UWORD FORMULA_0010 0 0 0.0 65535.0000 ECU_ADDRESS 0x304130 /end MEASUREMENT
/begin MEASUREMENT tpu_a_pram_4of16_2of8_ "Parameter RAM." UWORD FORMULA_0010 0 0 0.0 65535.0000 ECU_ADDRESS 0x304132 /end MEASUREMENT
/begin MEASUREMENT tpu_a_pram_4of16_3of8_ "Parameter RAM." UWORD FORMULA_0010 0 0 0.0 65535.0000 ECU_ADDRESS 0x304134 /end MEASUREMENT
/begin MEASUREMENT tpu_a_pram_4of16_4of8_ "Parameter RAM." UWORD FORMULA_0010 0 0 0.0 65535.0000 ECU_ADDRESS 0x304136 /end MEASUREMENT
/begin MEASUREMENT tpu_a_pram_4of16_5of8_ "Parameter RAM." UWORD FORMULA_0010 0 0 0.0 65535.0000 ECU_ADDRESS 0x304138 /end MEASUREMENT
/begin MEASUREMENT tpu_a_pram_4of16_6of8_ "Parameter RAM." UWORD FORMULA_0010 0 0 0.0 65535.0000 ECU_ADDRESS 0x30413A /end MEASUREMENT
/begin MEASUREMENT tpu_a_pram_4of16_7of8_ "Parameter RAM." UWORD FORMULA_0010 0 0 0.0 65535.0000 ECU_ADDRESS 0x30413C /end MEASUREMENT
/begin MEASUREMENT tpu_a_pram_4of16_8of8_ "Parameter RAM." UWORD FORMULA_0010 0 0 0.0 65535.0000 ECU_ADDRESS 0x30413E /end MEASUREMENT
/begin MEASUREMENT tpu_a_pram_5of16_1of8_ "Parameter RAM." UWORD FORMULA_0010 0 0 0.0 65535.0000 ECU_ADDRESS 0x304140 /end MEASUREMENT
/begin MEASUREMENT tpu_a_pram_5of16_2of8_ "Parameter RAM." UWORD FORMULA_0010 0 0 0.0 65535.0000 ECU_ADDRESS 0x304142 /end MEASUREMENT
/begin MEASUREMENT tpu_a_pram_5of16_3of8_ "Parameter RAM." UWORD FORMULA_0010 0 0 0.0 65535.0000 ECU_ADDRESS 0x304144 /end MEASUREMENT
/begin MEASUREMENT tpu_a_pram_5of16_4of8_ "Parameter RAM." UWORD FORMULA_0010 0 0 0.0 65535.0000 ECU_ADDRESS 0x304146 /end MEASUREMENT
/begin MEASUREMENT tpu_a_pram_5of16_5of8_ "Parameter RAM." UWORD FORMULA_0010 0 0 0.0 65535.0000 ECU_ADDRESS 0x304148 /end MEASUREMENT
/begin MEASUREMENT tpu_a_pram_5of16_6of8_ "Parameter RAM." UWORD FORMULA_0010 0 0 0.0 65535.0000 ECU_ADDRESS 0x30414A /end MEASUREMENT
/begin MEASUREMENT tpu_a_pram_5of16_7of8_ "Parameter RAM." UWORD FORMULA_0010 0 0 0.0 65535.0000 ECU_ADDRESS 0x30414C /end MEASUREMENT
/begin MEASUREMENT tpu_a_pram_5of16_8of8_ "Parameter RAM." UWORD FORMULA_0010 0 0 0.0 65535.0000 ECU_ADDRESS 0x30414E /end MEASUREMENT
/begin MEASUREMENT tpu_a_pram_6of16_1of8_ "Parameter RAM." UWORD FORMULA_0010 0 0 0.0 65535.0000 ECU_ADDRESS 0x304150 /end MEASUREMENT
/begin MEASUREMENT tpu_a_pram_6of16_2of8_ "Parameter RAM." UWORD FORMULA_0010 0 0 0.0 65535.0000 ECU_ADDRESS 0x304152 /end MEASUREMENT
/begin MEASUREMENT tpu_a_pram_6of16_3of8_ "Parameter RAM." UWORD FORMULA_0010 0 0 0.0 65535.0000 ECU_ADDRESS 0x304154 /end MEASUREMENT
/begin MEASUREMENT tpu_a_pram_6of16_4of8_ "Parameter RAM." UWORD FORMULA_0010 0 0 0.0 65535.0000 ECU_ADDRESS 0x304156 /end MEASUREMENT
/begin MEASUREMENT tpu_a_pram_6of16_5of8_ "Parameter RAM." UWORD FORMULA_0010 0 0 0.0 65535.0000 ECU_ADDRESS 0x304158 /end MEASUREMENT
/begin MEASUREMENT tpu_a_pram_6of16_6of8_ "Parameter RAM." UWORD FORMULA_0010 0 0 0.0 65535.0000 ECU_ADDRESS 0x30415A /end MEASUREMENT
/begin MEASUREMENT tpu_a_pram_6of16_7of8_ "Parameter RAM." UWORD FORMULA_0010 0 0 0.0 65535.0000 ECU_ADDRESS 0x30415C /end MEASUREMENT
/begin MEASUREMENT tpu_a_pram_6of16_8of8_ "Parameter RAM." UWORD FORMULA_0010 0 0 0.0 65535.0000 ECU_ADDRESS 0x30415E /end MEASUREMENT
/begin MEASUREMENT tpu_a_pram_7of16_1of8_ "Parameter RAM." UWORD FORMULA_0010 0 0 0.0 65535.0000 ECU_ADDRESS 0x304160 /end MEASUREMENT
/begin MEASUREMENT tpu_a_pram_7of16_2of8_ "Parameter RAM." UWORD FORMULA_0010 0 0 0.0 65535.0000 ECU_ADDRESS 0x304162 /end MEASUREMENT
/begin MEASUREMENT tpu_a_pram_7of16_3of8_ "Parameter RAM." UWORD FORMULA_0010 0 0 0.0 65535.0000 ECU_ADDRESS 0x304164 /end MEASUREMENT
/begin MEASUREMENT tpu_a_pram_7of16_4of8_ "Parameter RAM." UWORD FORMULA_0010 0 0 0.0 65535.0000 ECU_ADDRESS 0x304166 /end MEASUREMENT
/begin MEASUREMENT tpu_a_pram_7of16_5of8_ "Parameter RAM." UWORD FORMULA_0010 0 0 0.0 65535.0000 ECU_ADDRESS 0x304168 /end MEASUREMENT
/begin MEASUREMENT tpu_a_pram_7of16_6of8_ "Parameter RAM." UWORD FORMULA_0010 0 0 0.0 65535.0000 ECU_ADDRESS 0x30416A /end MEASUREMENT
/begin MEASUREMENT tpu_a_pram_7of16_7of8_ "Parameter RAM." UWORD FORMULA_0010 0 0 0.0 65535.0000 ECU_ADDRESS 0x30416C /end MEASUREMENT
/begin MEASUREMENT tpu_a_pram_7of16_8of8_ "Parameter RAM." UWORD FORMULA_0010 0 0 0.0 65535.0000 ECU_ADDRESS 0x30416E /end MEASUREMENT
/begin MEASUREMENT tpu_a_pram_8of16_1of8_ "Parameter RAM." UWORD FORMULA_0010 0 0 0.0 65535.0000 ECU_ADDRESS 0x304170 /end MEASUREMENT
/begin MEASUREMENT tpu_a_pram_8of16_2of8_ "Parameter RAM." UWORD FORMULA_0010 0 0 0.0 65535.0000 ECU_ADDRESS 0x304172 /end MEASUREMENT
/begin MEASUREMENT tpu_a_pram_8of16_3of8_ "Parameter RAM." UWORD FORMULA_0010 0 0 0.0 65535.0000 ECU_ADDRESS 0x304174 /end MEASUREMENT
/begin MEASUREMENT tpu_a_pram_8of16_4of8_ "Parameter RAM." UWORD FORMULA_0010 0 0 0.0 65535.0000 ECU_ADDRESS 0x304176 /end MEASUREMENT
/begin MEASUREMENT tpu_a_pram_8of16_5of8_ "Parameter RAM." UWORD FORMULA_0010 0 0 0.0 65535.0000 ECU_ADDRESS 0x304178 /end MEASUREMENT
/begin MEASUREMENT tpu_a_pram_8of16_6of8_ "Parameter RAM." UWORD FORMULA_0010 0 0 0.0 65535.0000 ECU_ADDRESS 0x30417A /end MEASUREMENT
/begin MEASUREMENT tpu_a_pram_8of16_7of8_ "Parameter RAM." UWORD FORMULA_0010 0 0 0.0 65535.0000 ECU_ADDRESS 0x30417C /end MEASUREMENT
/begin MEASUREMENT tpu_a_pram_8of16_8of8_ "Parameter RAM." UWORD FORMULA_0010 0 0 0.0 65535.0000 ECU_ADDRESS 0x30417E /end MEASUREMENT
/begin MEASUREMENT tpu_a_pram_9of16_1of8_ "Parameter RAM." UWORD FORMULA_0010 0 0 0.0 65535.0000 ECU_ADDRESS 0x304180 /end MEASUREMENT
/begin MEASUREMENT tpu_a_pram_9of16_2of8_ "Parameter RAM." UWORD FORMULA_0010 0 0 0.0 65535.0000 ECU_ADDRESS 0x304182 /end MEASUREMENT
/begin MEASUREMENT tpu_a_pram_9of16_3of8_ "Parameter RAM." UWORD FORMULA_0010 0 0 0.0 65535.0000 ECU_ADDRESS 0x304184 /end MEASUREMENT
/begin MEASUREMENT tpu_a_pram_9of16_4of8_ "Parameter RAM." UWORD FORMULA_0010 0 0 0.0 65535.0000 ECU_ADDRESS 0x304186 /end MEASUREMENT
/begin MEASUREMENT tpu_a_pram_9of16_5of8_ "Parameter RAM." UWORD FORMULA_0010 0 0 0.0 65535.0000 ECU_ADDRESS 0x304188 /end MEASUREMENT
/begin MEASUREMENT tpu_a_pram_9of16_6of8_ "Parameter RAM." UWORD FORMULA_0010 0 0 0.0 65535.0000 ECU_ADDRESS 0x30418A /end MEASUREMENT
/begin MEASUREMENT tpu_a_pram_9of16_7of8_ "Parameter RAM." UWORD FORMULA_0010 0 0 0.0 65535.0000 ECU_ADDRESS 0x30418C /end MEASUREMENT
/begin MEASUREMENT tpu_a_pram_9of16_8of8_ "Parameter RAM." UWORD FORMULA_0010 0 0 0.0 65535.0000 ECU_ADDRESS 0x30418E /end MEASUREMENT
/begin MEASUREMENT tpu_a_pram_10of16_1of8_ "Parameter RAM." UWORD FORMULA_0010 0 0 0.0 65535.0000 ECU_ADDRESS 0x304190 /end MEASUREMENT
/begin MEASUREMENT tpu_a_pram_10of16_2of8_ "Parameter RAM." UWORD FORMULA_0010 0 0 0.0 65535.0000 ECU_ADDRESS 0x304192 /end MEASUREMENT
/begin MEASUREMENT tpu_a_pram_10of16_3of8_ "Parameter RAM." UWORD FORMULA_0010 0 0 0.0 65535.0000 ECU_ADDRESS 0x304194 /end MEASUREMENT
/begin MEASUREMENT tpu_a_pram_10of16_4of8_ "Parameter RAM." UWORD FORMULA_0010 0 0 0.0 65535.0000 ECU_ADDRESS 0x304196 /end MEASUREMENT
/begin MEASUREMENT tpu_a_pram_10of16_5of8_ "Parameter RAM." UWORD FORMULA_0010 0 0 0.0 65535.0000 ECU_ADDRESS 0x304198 /end MEASUREMENT
/begin MEASUREMENT tpu_a_pram_10of16_6of8_ "Parameter RAM." UWORD FORMULA_0010 0 0 0.0 65535.0000 ECU_ADDRESS 0x30419A /end MEASUREMENT
/begin MEASUREMENT tpu_a_pram_10of16_7of8_ "Parameter RAM." UWORD FORMULA_0010 0 0 0.0 65535.0000 ECU_ADDRESS 0x30419C /end MEASUREMENT
/begin MEASUREMENT tpu_a_pram_10of16_8of8_ "Parameter RAM." UWORD FORMULA_0010 0 0 0.0 65535.0000 ECU_ADDRESS 0x30419E /end MEASUREMENT
/begin MEASUREMENT tpu_a_pram_11of16_1of8_ "Parameter RAM." UWORD FORMULA_0010 0 0 0.0 65535.0000 ECU_ADDRESS 0x3041A0 /end MEASUREMENT
/begin MEASUREMENT tpu_a_pram_11of16_2of8_ "Parameter RAM." UWORD FORMULA_0010 0 0 0.0 65535.0000 ECU_ADDRESS 0x3041A2 /end MEASUREMENT
/begin MEASUREMENT tpu_a_pram_11of16_3of8_ "Parameter RAM." UWORD FORMULA_0010 0 0 0.0 65535.0000 ECU_ADDRESS 0x3041A4 /end MEASUREMENT
/begin MEASUREMENT tpu_a_pram_11of16_4of8_ "Parameter RAM." UWORD FORMULA_0010 0 0 0.0 65535.0000 ECU_ADDRESS 0x3041A6 /end MEASUREMENT
/begin MEASUREMENT tpu_a_pram_11of16_5of8_ "Parameter RAM." UWORD FORMULA_0010 0 0 0.0 65535.0000 ECU_ADDRESS 0x3041A8 /end MEASUREMENT
/begin MEASUREMENT tpu_a_pram_11of16_6of8_ "Parameter RAM." UWORD FORMULA_0010 0 0 0.0 65535.0000 ECU_ADDRESS 0x3041AA /end MEASUREMENT
/begin MEASUREMENT tpu_a_pram_11of16_7of8_ "Parameter RAM." UWORD FORMULA_0010 0 0 0.0 65535.0000 ECU_ADDRESS 0x3041AC /end MEASUREMENT
/begin MEASUREMENT tpu_a_pram_11of16_8of8_ "Parameter RAM." UWORD FORMULA_0010 0 0 0.0 65535.0000 ECU_ADDRESS 0x3041AE /end MEASUREMENT
/begin MEASUREMENT tpu_a_pram_12of16_1of8_ "Parameter RAM." UWORD FORMULA_0010 0 0 0.0 65535.0000 ECU_ADDRESS 0x3041B0 /end MEASUREMENT
/begin MEASUREMENT tpu_a_pram_12of16_2of8_ "Parameter RAM." UWORD FORMULA_0010 0 0 0.0 65535.0000 ECU_ADDRESS 0x3041B2 /end MEASUREMENT
/begin MEASUREMENT tpu_a_pram_12of16_3of8_ "Parameter RAM." UWORD FORMULA_0010 0 0 0.0 65535.0000 ECU_ADDRESS 0x3041B4 /end MEASUREMENT
/begin MEASUREMENT tpu_a_pram_12of16_4of8_ "Parameter RAM." UWORD FORMULA_0010 0 0 0.0 65535.0000 ECU_ADDRESS 0x3041B6 /end MEASUREMENT
/begin MEASUREMENT tpu_a_pram_12of16_5of8_ "Parameter RAM." UWORD FORMULA_0010 0 0 0.0 65535.0000 ECU_ADDRESS 0x3041B8 /end MEASUREMENT
/begin MEASUREMENT tpu_a_pram_12of16_6of8_ "Parameter RAM." UWORD FORMULA_0010 0 0 0.0 65535.0000 ECU_ADDRESS 0x3041BA /end MEASUREMENT
/begin MEASUREMENT tpu_a_pram_12of16_7of8_ "Parameter RAM." UWORD FORMULA_0010 0 0 0.0 65535.0000 ECU_ADDRESS 0x3041BC /end MEASUREMENT
/begin MEASUREMENT tpu_a_pram_12of16_8of8_ "Parameter RAM." UWORD FORMULA_0010 0 0 0.0 65535.0000 ECU_ADDRESS 0x3041BE /end MEASUREMENT
/begin MEASUREMENT tpu_a_pram_13of16_1of8_ "Parameter RAM." UWORD FORMULA_0010 0 0 0.0 65535.0000 ECU_ADDRESS 0x3041C0 /end MEASUREMENT
/begin MEASUREMENT tpu_a_pram_13of16_2of8_ "Parameter RAM." UWORD FORMULA_0010 0 0 0.0 65535.0000 ECU_ADDRESS 0x3041C2 /end MEASUREMENT
/begin MEASUREMENT tpu_a_pram_13of16_3of8_ "Parameter RAM." UWORD FORMULA_0010 0 0 0.0 65535.0000 ECU_ADDRESS 0x3041C4 /end MEASUREMENT
/begin MEASUREMENT tpu_a_pram_13of16_4of8_ "Parameter RAM." UWORD FORMULA_0010 0 0 0.0 65535.0000 ECU_ADDRESS 0x3041C6 /end MEASUREMENT
/begin MEASUREMENT tpu_a_pram_13of16_5of8_ "Parameter RAM." UWORD FORMULA_0010 0 0 0.0 65535.0000 ECU_ADDRESS 0x3041C8 /end MEASUREMENT
/begin MEASUREMENT tpu_a_pram_13of16_6of8_ "Parameter RAM." UWORD FORMULA_0010 0 0 0.0 65535.0000 ECU_ADDRESS 0x3041CA /end MEASUREMENT
/begin MEASUREMENT tpu_a_pram_13of16_7of8_ "Parameter RAM." UWORD FORMULA_0010 0 0 0.0 65535.0000 ECU_ADDRESS 0x3041CC /end MEASUREMENT
/begin MEASUREMENT tpu_a_pram_13of16_8of8_ "Parameter RAM." UWORD FORMULA_0010 0 0 0.0 65535.0000 ECU_ADDRESS 0x3041CE /end MEASUREMENT
/begin MEASUREMENT tpu_a_pram_14of16_1of8_ "Parameter RAM." UWORD FORMULA_0010 0 0 0.0 65535.0000 ECU_ADDRESS 0x3041D0 /end MEASUREMENT
/begin MEASUREMENT tpu_a_pram_14of16_2of8_ "Parameter RAM." UWORD FORMULA_0010 0 0 0.0 65535.0000 ECU_ADDRESS 0x3041D2 /end MEASUREMENT
/begin MEASUREMENT tpu_a_pram_14of16_3of8_ "Parameter RAM." UWORD FORMULA_0010 0 0 0.0 65535.0000 ECU_ADDRESS 0x3041D4 /end MEASUREMENT
/begin MEASUREMENT tpu_a_pram_14of16_4of8_ "Parameter RAM." UWORD FORMULA_0010 0 0 0.0 65535.0000 ECU_ADDRESS 0x3041D6 /end MEASUREMENT
/begin MEASUREMENT tpu_a_pram_14of16_5of8_ "Parameter RAM." UWORD FORMULA_0010 0 0 0.0 65535.0000 ECU_ADDRESS 0x3041D8 /end MEASUREMENT
/begin MEASUREMENT tpu_a_pram_14of16_6of8_ "Parameter RAM." UWORD FORMULA_0010 0 0 0.0 65535.0000 ECU_ADDRESS 0x3041DA /end MEASUREMENT
/begin MEASUREMENT tpu_a_pram_14of16_7of8_ "Parameter RAM." UWORD FORMULA_0010 0 0 0.0 65535.0000 ECU_ADDRESS 0x3041DC /end MEASUREMENT
/begin MEASUREMENT tpu_a_pram_14of16_8of8_ "Parameter RAM." UWORD FORMULA_0010 0 0 0.0 65535.0000 ECU_ADDRESS 0x3041DE /end MEASUREMENT
/begin MEASUREMENT tpu_a_pram_15of16_1of8_ "Parameter RAM." UWORD FORMULA_0010 0 0 0.0 65535.0000 ECU_ADDRESS 0x3041E0 /end MEASUREMENT
/begin MEASUREMENT tpu_a_pram_15of16_2of8_ "Parameter RAM." UWORD FORMULA_0010 0 0 0.0 65535.0000 ECU_ADDRESS 0x3041E2 /end MEASUREMENT
/begin MEASUREMENT tpu_a_pram_15of16_3of8_ "Parameter RAM." UWORD FORMULA_0010 0 0 0.0 65535.0000 ECU_ADDRESS 0x3041E4 /end MEASUREMENT
/begin MEASUREMENT tpu_a_pram_15of16_4of8_ "Parameter RAM." UWORD FORMULA_0010 0 0 0.0 65535.0000 ECU_ADDRESS 0x3041E6 /end MEASUREMENT
/begin MEASUREMENT tpu_a_pram_15of16_5of8_ "Parameter RAM." UWORD FORMULA_0010 0 0 0.0 65535.0000 ECU_ADDRESS 0x3041E8 /end MEASUREMENT
/begin MEASUREMENT tpu_a_pram_15of16_6of8_ "Parameter RAM." UWORD FORMULA_0010 0 0 0.0 65535.0000 ECU_ADDRESS 0x3041EA /end MEASUREMENT
/begin MEASUREMENT tpu_a_pram_15of16_7of8_ "Parameter RAM." UWORD FORMULA_0010 0 0 0.0 65535.0000 ECU_ADDRESS 0x3041EC /end MEASUREMENT
/begin MEASUREMENT tpu_a_pram_15of16_8of8_ "Parameter RAM." UWORD FORMULA_0010 0 0 0.0 65535.0000 ECU_ADDRESS 0x3041EE /end MEASUREMENT
/begin MEASUREMENT tpu_a_pram_16of16_1of8_ "Parameter RAM." UWORD FORMULA_0010 0 0 0.0 65535.0000 ECU_ADDRESS 0x3041F0 /end MEASUREMENT
/begin MEASUREMENT tpu_a_pram_16of16_2of8_ "Parameter RAM." UWORD FORMULA_0010 0 0 0.0 65535.0000 ECU_ADDRESS 0x3041F2 /end MEASUREMENT
/begin MEASUREMENT tpu_a_pram_16of16_3of8_ "Parameter RAM." UWORD FORMULA_0010 0 0 0.0 65535.0000 ECU_ADDRESS 0x3041F4 /end MEASUREMENT
/begin MEASUREMENT tpu_a_pram_16of16_4of8_ "Parameter RAM." UWORD FORMULA_0010 0 0 0.0 65535.0000 ECU_ADDRESS 0x3041F6 /end MEASUREMENT
/begin MEASUREMENT tpu_a_pram_16of16_5of8_ "Parameter RAM." UWORD FORMULA_0010 0 0 0.0 65535.0000 ECU_ADDRESS 0x3041F8 /end MEASUREMENT
/begin MEASUREMENT tpu_a_pram_16of16_6of8_ "Parameter RAM." UWORD FORMULA_0010 0 0 0.0 65535.0000 ECU_ADDRESS 0x3041FA /end MEASUREMENT
/begin MEASUREMENT tpu_a_pram_16of16_7of8_ "Parameter RAM." UWORD FORMULA_0010 0 0 0.0 65535.0000 ECU_ADDRESS 0x3041FC /end MEASUREMENT
/begin MEASUREMENT tpu_a_pram_16of16_8of8_ "Parameter RAM." UWORD FORMULA_0010 0 0 0.0 65535.0000 ECU_ADDRESS 0x3041FE /end MEASUREMENT
/begin MEASUREMENT tpu_b_pram_1of16_1of8_ "Parameter RAM." UWORD FORMULA_0010 0 0 0.0 65535.0000 ECU_ADDRESS 0x304500 /end MEASUREMENT
/begin MEASUREMENT tpu_b_pram_1of16_2of8_ "Parameter RAM." UWORD FORMULA_0010 0 0 0.0 65535.0000 ECU_ADDRESS 0x304502 /end MEASUREMENT
/begin MEASUREMENT tpu_b_pram_1of16_3of8_ "Parameter RAM." UWORD FORMULA_0010 0 0 0.0 65535.0000 ECU_ADDRESS 0x304504 /end MEASUREMENT
/begin MEASUREMENT tpu_b_pram_1of16_4of8_ "Parameter RAM." UWORD FORMULA_0010 0 0 0.0 65535.0000 ECU_ADDRESS 0x304506 /end MEASUREMENT
/begin MEASUREMENT tpu_b_pram_1of16_5of8_ "Parameter RAM." UWORD FORMULA_0010 0 0 0.0 65535.0000 ECU_ADDRESS 0x304508 /end MEASUREMENT
/begin MEASUREMENT tpu_b_pram_1of16_6of8_ "Parameter RAM." UWORD FORMULA_0010 0 0 0.0 65535.0000 ECU_ADDRESS 0x30450A /end MEASUREMENT
/begin MEASUREMENT tpu_b_pram_1of16_7of8_ "Parameter RAM." UWORD FORMULA_0010 0 0 0.0 65535.0000 ECU_ADDRESS 0x30450C /end MEASUREMENT
/begin MEASUREMENT tpu_b_pram_1of16_8of8_ "Parameter RAM." UWORD FORMULA_0010 0 0 0.0 65535.0000 ECU_ADDRESS 0x30450E /end MEASUREMENT
/begin MEASUREMENT tpu_b_pram_2of16_1of8_ "Parameter RAM." UWORD FORMULA_0010 0 0 0.0 65535.0000 ECU_ADDRESS 0x304510 /end MEASUREMENT
/begin MEASUREMENT tpu_b_pram_2of16_2of8_ "Parameter RAM." UWORD FORMULA_0010 0 0 0.0 65535.0000 ECU_ADDRESS 0x304512 /end MEASUREMENT
/begin MEASUREMENT tpu_b_pram_2of16_3of8_ "Parameter RAM." UWORD FORMULA_0010 0 0 0.0 65535.0000 ECU_ADDRESS 0x304514 /end MEASUREMENT
/begin MEASUREMENT tpu_b_pram_2of16_4of8_ "Parameter RAM." UWORD FORMULA_0010 0 0 0.0 65535.0000 ECU_ADDRESS 0x304516 /end MEASUREMENT
/begin MEASUREMENT tpu_b_pram_2of16_5of8_ "Parameter RAM." UWORD FORMULA_0010 0 0 0.0 65535.0000 ECU_ADDRESS 0x304518 /end MEASUREMENT
/begin MEASUREMENT tpu_b_pram_2of16_6of8_ "Parameter RAM." UWORD FORMULA_0010 0 0 0.0 65535.0000 ECU_ADDRESS 0x30451A /end MEASUREMENT
/begin MEASUREMENT tpu_b_pram_2of16_7of8_ "Parameter RAM." UWORD FORMULA_0010 0 0 0.0 65535.0000 ECU_ADDRESS 0x30451C /end MEASUREMENT
/begin MEASUREMENT tpu_b_pram_2of16_8of8_ "Parameter RAM." UWORD FORMULA_0010 0 0 0.0 65535.0000 ECU_ADDRESS 0x30451E /end MEASUREMENT
/begin MEASUREMENT tpu_b_pram_3of16_1of8_ "Parameter RAM." UWORD FORMULA_0010 0 0 0.0 65535.0000 ECU_ADDRESS 0x304520 /end MEASUREMENT
/begin MEASUREMENT tpu_b_pram_3of16_2of8_ "Parameter RAM." UWORD FORMULA_0010 0 0 0.0 65535.0000 ECU_ADDRESS 0x304522 /end MEASUREMENT
/begin MEASUREMENT tpu_b_pram_3of16_3of8_ "Parameter RAM." UWORD FORMULA_0010 0 0 0.0 65535.0000 ECU_ADDRESS 0x304524 /end MEASUREMENT
/begin MEASUREMENT tpu_b_pram_3of16_4of8_ "Parameter RAM." UWORD FORMULA_0010 0 0 0.0 65535.0000 ECU_ADDRESS 0x304526 /end MEASUREMENT
/begin MEASUREMENT tpu_b_pram_3of16_5of8_ "Parameter RAM." UWORD FORMULA_0010 0 0 0.0 65535.0000 ECU_ADDRESS 0x304528 /end MEASUREMENT
/begin MEASUREMENT tpu_b_pram_3of16_6of8_ "Parameter RAM." UWORD FORMULA_0010 0 0 0.0 65535.0000 ECU_ADDRESS 0x30452A /end MEASUREMENT
/begin MEASUREMENT tpu_b_pram_3of16_7of8_ "Parameter RAM." UWORD FORMULA_0010 0 0 0.0 65535.0000 ECU_ADDRESS 0x30452C /end MEASUREMENT
/begin MEASUREMENT tpu_b_pram_3of16_8of8_ "Parameter RAM." UWORD FORMULA_0010 0 0 0.0 65535.0000 ECU_ADDRESS 0x30452E /end MEASUREMENT
/begin MEASUREMENT tpu_b_pram_4of16_1of8_ "Parameter RAM." UWORD FORMULA_0010 0 0 0.0 65535.0000 ECU_ADDRESS 0x304530 /end MEASUREMENT
/begin MEASUREMENT tpu_b_pram_4of16_2of8_ "Parameter RAM." UWORD FORMULA_0010 0 0 0.0 65535.0000 ECU_ADDRESS 0x304532 /end MEASUREMENT
/begin MEASUREMENT tpu_b_pram_4of16_3of8_ "Parameter RAM." UWORD FORMULA_0010 0 0 0.0 65535.0000 ECU_ADDRESS 0x304534 /end MEASUREMENT
/begin MEASUREMENT tpu_b_pram_4of16_4of8_ "Parameter RAM." UWORD FORMULA_0010 0 0 0.0 65535.0000 ECU_ADDRESS 0x304536 /end MEASUREMENT
/begin MEASUREMENT tpu_b_pram_4of16_5of8_ "Parameter RAM." UWORD FORMULA_0010 0 0 0.0 65535.0000 ECU_ADDRESS 0x304538 /end MEASUREMENT
/begin MEASUREMENT tpu_b_pram_4of16_6of8_ "Parameter RAM." UWORD FORMULA_0010 0 0 0.0 65535.0000 ECU_ADDRESS 0x30453A /end MEASUREMENT
/begin MEASUREMENT tpu_b_pram_4of16_7of8_ "Parameter RAM." UWORD FORMULA_0010 0 0 0.0 65535.0000 ECU_ADDRESS 0x30453C /end MEASUREMENT
/begin MEASUREMENT tpu_b_pram_4of16_8of8_ "Parameter RAM." UWORD FORMULA_0010 0 0 0.0 65535.0000 ECU_ADDRESS 0x30453E /end MEASUREMENT
/begin MEASUREMENT tpu_b_pram_5of16_1of8_ "Parameter RAM." UWORD FORMULA_0010 0 0 0.0 65535.0000 ECU_ADDRESS 0x304540 /end MEASUREMENT
/begin MEASUREMENT tpu_b_pram_5of16_2of8_ "Parameter RAM." UWORD FORMULA_0010 0 0 0.0 65535.0000 ECU_ADDRESS 0x304542 /end MEASUREMENT
/begin MEASUREMENT tpu_b_pram_5of16_3of8_ "Parameter RAM." UWORD FORMULA_0010 0 0 0.0 65535.0000 ECU_ADDRESS 0x304544 /end MEASUREMENT
/begin MEASUREMENT tpu_b_pram_5of16_4of8_ "Parameter RAM." UWORD FORMULA_0010 0 0 0.0 65535.0000 ECU_ADDRESS 0x304546 /end MEASUREMENT
/begin MEASUREMENT tpu_b_pram_5of16_5of8_ "Parameter RAM." UWORD FORMULA_0010 0 0 0.0 65535.0000 ECU_ADDRESS 0x304548 /end MEASUREMENT
/begin MEASUREMENT tpu_b_pram_5of16_6of8_ "Parameter RAM." UWORD FORMULA_0010 0 0 0.0 65535.0000 ECU_ADDRESS 0x30454A /end MEASUREMENT
/begin MEASUREMENT tpu_b_pram_5of16_7of8_ "Parameter RAM." UWORD FORMULA_0010 0 0 0.0 65535.0000 ECU_ADDRESS 0x30454C /end MEASUREMENT
/begin MEASUREMENT tpu_b_pram_5of16_8of8_ "Parameter RAM." UWORD FORMULA_0010 0 0 0.0 65535.0000 ECU_ADDRESS 0x30454E /end MEASUREMENT
/begin MEASUREMENT tpu_b_pram_6of16_1of8_ "Parameter RAM." UWORD FORMULA_0010 0 0 0.0 65535.0000 ECU_ADDRESS 0x304550 /end MEASUREMENT
/begin MEASUREMENT tpu_b_pram_6of16_2of8_ "Parameter RAM." UWORD FORMULA_0010 0 0 0.0 65535.0000 ECU_ADDRESS 0x304552 /end MEASUREMENT
/begin MEASUREMENT tpu_b_pram_6of16_3of8_ "Parameter RAM." UWORD FORMULA_0010 0 0 0.0 65535.0000 ECU_ADDRESS 0x304554 /end MEASUREMENT
/begin MEASUREMENT tpu_b_pram_6of16_4of8_ "Parameter RAM." UWORD FORMULA_0010 0 0 0.0 65535.0000 ECU_ADDRESS 0x304556 /end MEASUREMENT
/begin MEASUREMENT tpu_b_pram_6of16_5of8_ "Parameter RAM." UWORD FORMULA_0010 0 0 0.0 65535.0000 ECU_ADDRESS 0x304558 /end MEASUREMENT
/begin MEASUREMENT tpu_b_pram_6of16_6of8_ "Parameter RAM." UWORD FORMULA_0010 0 0 0.0 65535.0000 ECU_ADDRESS 0x30455A /end MEASUREMENT
/begin MEASUREMENT tpu_b_pram_6of16_7of8_ "Parameter RAM." UWORD FORMULA_0010 0 0 0.0 65535.0000 ECU_ADDRESS 0x30455C /end MEASUREMENT
/begin MEASUREMENT tpu_b_pram_6of16_8of8_ "Parameter RAM." UWORD FORMULA_0010 0 0 0.0 65535.0000 ECU_ADDRESS 0x30455E /end MEASUREMENT
/begin MEASUREMENT tpu_b_pram_7of16_1of8_ "Parameter RAM." UWORD FORMULA_0010 0 0 0.0 65535.0000 ECU_ADDRESS 0x304560 /end MEASUREMENT
/begin MEASUREMENT tpu_b_pram_7of16_2of8_ "Parameter RAM." UWORD FORMULA_0010 0 0 0.0 65535.0000 ECU_ADDRESS 0x304562 /end MEASUREMENT
/begin MEASUREMENT tpu_b_pram_7of16_3of8_ "Parameter RAM." UWORD FORMULA_0010 0 0 0.0 65535.0000 ECU_ADDRESS 0x304564 /end MEASUREMENT
/begin MEASUREMENT tpu_b_pram_7of16_4of8_ "Parameter RAM." UWORD FORMULA_0010 0 0 0.0 65535.0000 ECU_ADDRESS 0x304566 /end MEASUREMENT
/begin MEASUREMENT tpu_b_pram_7of16_5of8_ "Parameter RAM." UWORD FORMULA_0010 0 0 0.0 65535.0000 ECU_ADDRESS 0x304568 /end MEASUREMENT
/begin MEASUREMENT tpu_b_pram_7of16_6of8_ "Parameter RAM." UWORD FORMULA_0010 0 0 0.0 65535.0000 ECU_ADDRESS 0x30456A /end MEASUREMENT
/begin MEASUREMENT tpu_b_pram_7of16_7of8_ "Parameter RAM." UWORD FORMULA_0010 0 0 0.0 65535.0000 ECU_ADDRESS 0x30456C /end MEASUREMENT
/begin MEASUREMENT tpu_b_pram_7of16_8of8_ "Parameter RAM." UWORD FORMULA_0010 0 0 0.0 65535.0000 ECU_ADDRESS 0x30456E /end MEASUREMENT
/begin MEASUREMENT tpu_b_pram_8of16_1of8_ "Parameter RAM." UWORD FORMULA_0010 0 0 0.0 65535.0000 ECU_ADDRESS 0x304570 /end MEASUREMENT
/begin MEASUREMENT tpu_b_pram_8of16_2of8_ "Parameter RAM." UWORD FORMULA_0010 0 0 0.0 65535.0000 ECU_ADDRESS 0x304572 /end MEASUREMENT
/begin MEASUREMENT tpu_b_pram_8of16_3of8_ "Parameter RAM." UWORD FORMULA_0010 0 0 0.0 65535.0000 ECU_ADDRESS 0x304574 /end MEASUREMENT
/begin MEASUREMENT tpu_b_pram_8of16_4of8_ "Parameter RAM." UWORD FORMULA_0010 0 0 0.0 65535.0000 ECU_ADDRESS 0x304576 /end MEASUREMENT
/begin MEASUREMENT tpu_b_pram_8of16_5of8_ "Parameter RAM." UWORD FORMULA_0010 0 0 0.0 65535.0000 ECU_ADDRESS 0x304578 /end MEASUREMENT
/begin MEASUREMENT tpu_b_pram_8of16_6of8_ "Parameter RAM." UWORD FORMULA_0010 0 0 0.0 65535.0000 ECU_ADDRESS 0x30457A /end MEASUREMENT
/begin MEASUREMENT tpu_b_pram_8of16_7of8_ "Parameter RAM." UWORD FORMULA_0010 0 0 0.0 65535.0000 ECU_ADDRESS 0x30457C /end MEASUREMENT
/begin MEASUREMENT tpu_b_pram_8of16_8of8_ "Parameter RAM." UWORD FORMULA_0010 0 0 0.0 65535.0000 ECU_ADDRESS 0x30457E /end MEASUREMENT
/begin MEASUREMENT tpu_b_pram_9of16_1of8_ "Parameter RAM." UWORD FORMULA_0010 0 0 0.0 65535.0000 ECU_ADDRESS 0x304580 /end MEASUREMENT
/begin MEASUREMENT tpu_b_pram_9of16_2of8_ "Parameter RAM." UWORD FORMULA_0010 0 0 0.0 65535.0000 ECU_ADDRESS 0x304582 /end MEASUREMENT
/begin MEASUREMENT tpu_b_pram_9of16_3of8_ "Parameter RAM." UWORD FORMULA_0010 0 0 0.0 65535.0000 ECU_ADDRESS 0x304584 /end MEASUREMENT
/begin MEASUREMENT tpu_b_pram_9of16_4of8_ "Parameter RAM." UWORD FORMULA_0010 0 0 0.0 65535.0000 ECU_ADDRESS 0x304586 /end MEASUREMENT
/begin MEASUREMENT tpu_b_pram_9of16_5of8_ "Parameter RAM." UWORD FORMULA_0010 0 0 0.0 65535.0000 ECU_ADDRESS 0x304588 /end MEASUREMENT
/begin MEASUREMENT tpu_b_pram_9of16_6of8_ "Parameter RAM." UWORD FORMULA_0010 0 0 0.0 65535.0000 ECU_ADDRESS 0x30458A /end MEASUREMENT
/begin MEASUREMENT tpu_b_pram_9of16_7of8_ "Parameter RAM." UWORD FORMULA_0010 0 0 0.0 65535.0000 ECU_ADDRESS 0x30458C /end MEASUREMENT
/begin MEASUREMENT tpu_b_pram_9of16_8of8_ "Parameter RAM." UWORD FORMULA_0010 0 0 0.0 65535.0000 ECU_ADDRESS 0x30458E /end MEASUREMENT
/begin MEASUREMENT tpu_b_pram_10of16_1of8_ "Parameter RAM." UWORD FORMULA_0010 0 0 0.0 65535.0000 ECU_ADDRESS 0x304590 /end MEASUREMENT
/begin MEASUREMENT tpu_b_pram_10of16_2of8_ "Parameter RAM." UWORD FORMULA_0010 0 0 0.0 65535.0000 ECU_ADDRESS 0x304592 /end MEASUREMENT
/begin MEASUREMENT tpu_b_pram_10of16_3of8_ "Parameter RAM." UWORD FORMULA_0010 0 0 0.0 65535.0000 ECU_ADDRESS 0x304594 /end MEASUREMENT
/begin MEASUREMENT tpu_b_pram_10of16_4of8_ "Parameter RAM." UWORD FORMULA_0010 0 0 0.0 65535.0000 ECU_ADDRESS 0x304596 /end MEASUREMENT
/begin MEASUREMENT tpu_b_pram_10of16_5of8_ "Parameter RAM." UWORD FORMULA_0010 0 0 0.0 65535.0000 ECU_ADDRESS 0x304598 /end MEASUREMENT
/begin MEASUREMENT tpu_b_pram_10of16_6of8_ "Parameter RAM." UWORD FORMULA_0010 0 0 0.0 65535.0000 ECU_ADDRESS 0x30459A /end MEASUREMENT
/begin MEASUREMENT tpu_b_pram_10of16_7of8_ "Parameter RAM." UWORD FORMULA_0010 0 0 0.0 65535.0000 ECU_ADDRESS 0x30459C /end MEASUREMENT
/begin MEASUREMENT tpu_b_pram_10of16_8of8_ "Parameter RAM." UWORD FORMULA_0010 0 0 0.0 65535.0000 ECU_ADDRESS 0x30459E /end MEASUREMENT
/begin MEASUREMENT tpu_b_pram_11of16_1of8_ "Parameter RAM." UWORD FORMULA_0010 0 0 0.0 65535.0000 ECU_ADDRESS 0x3045A0 /end MEASUREMENT
/begin MEASUREMENT tpu_b_pram_11of16_2of8_ "Parameter RAM." UWORD FORMULA_0010 0 0 0.0 65535.0000 ECU_ADDRESS 0x3045A2 /end MEASUREMENT
/begin MEASUREMENT tpu_b_pram_11of16_3of8_ "Parameter RAM." UWORD FORMULA_0010 0 0 0.0 65535.0000 ECU_ADDRESS 0x3045A4 /end MEASUREMENT
/begin MEASUREMENT tpu_b_pram_11of16_4of8_ "Parameter RAM." UWORD FORMULA_0010 0 0 0.0 65535.0000 ECU_ADDRESS 0x3045A6 /end MEASUREMENT
/begin MEASUREMENT tpu_b_pram_11of16_5of8_ "Parameter RAM." UWORD FORMULA_0010 0 0 0.0 65535.0000 ECU_ADDRESS 0x3045A8 /end MEASUREMENT
/begin MEASUREMENT tpu_b_pram_11of16_6of8_ "Parameter RAM." UWORD FORMULA_0010 0 0 0.0 65535.0000 ECU_ADDRESS 0x3045AA /end MEASUREMENT
/begin MEASUREMENT tpu_b_pram_11of16_7of8_ "Parameter RAM." UWORD FORMULA_0010 0 0 0.0 65535.0000 ECU_ADDRESS 0x3045AC /end MEASUREMENT
/begin MEASUREMENT tpu_b_pram_11of16_8of8_ "Parameter RAM." UWORD FORMULA_0010 0 0 0.0 65535.0000 ECU_ADDRESS 0x3045AE /end MEASUREMENT
/begin MEASUREMENT tpu_b_pram_12of16_1of8_ "Parameter RAM." UWORD FORMULA_0010 0 0 0.0 65535.0000 ECU_ADDRESS 0x3045B0 /end MEASUREMENT
/begin MEASUREMENT tpu_b_pram_12of16_2of8_ "Parameter RAM." UWORD FORMULA_0010 0 0 0.0 65535.0000 ECU_ADDRESS 0x3045B2 /end MEASUREMENT
/begin MEASUREMENT tpu_b_pram_12of16_3of8_ "Parameter RAM." UWORD FORMULA_0010 0 0 0.0 65535.0000 ECU_ADDRESS 0x3045B4 /end MEASUREMENT
/begin MEASUREMENT tpu_b_pram_12of16_4of8_ "Parameter RAM." UWORD FORMULA_0010 0 0 0.0 65535.0000 ECU_ADDRESS 0x3045B6 /end MEASUREMENT
/begin MEASUREMENT tpu_b_pram_12of16_5of8_ "Parameter RAM." UWORD FORMULA_0010 0 0 0.0 65535.0000 ECU_ADDRESS 0x3045B8 /end MEASUREMENT
/begin MEASUREMENT tpu_b_pram_12of16_6of8_ "Parameter RAM." UWORD FORMULA_0010 0 0 0.0 65535.0000 ECU_ADDRESS 0x3045BA /end MEASUREMENT
/begin MEASUREMENT tpu_b_pram_12of16_7of8_ "Parameter RAM." UWORD FORMULA_0010 0 0 0.0 65535.0000 ECU_ADDRESS 0x3045BC /end MEASUREMENT
/begin MEASUREMENT tpu_b_pram_12of16_8of8_ "Parameter RAM." UWORD FORMULA_0010 0 0 0.0 65535.0000 ECU_ADDRESS 0x3045BE /end MEASUREMENT
/begin MEASUREMENT tpu_b_pram_13of16_1of8_ "Parameter RAM." UWORD FORMULA_0010 0 0 0.0 65535.0000 ECU_ADDRESS 0x3045C0 /end MEASUREMENT
/begin MEASUREMENT tpu_b_pram_13of16_2of8_ "Parameter RAM." UWORD FORMULA_0010 0 0 0.0 65535.0000 ECU_ADDRESS 0x3045C2 /end MEASUREMENT
/begin MEASUREMENT tpu_b_pram_13of16_3of8_ "Parameter RAM." UWORD FORMULA_0010 0 0 0.0 65535.0000 ECU_ADDRESS 0x3045C4 /end MEASUREMENT
/begin MEASUREMENT tpu_b_pram_13of16_4of8_ "Parameter RAM." UWORD FORMULA_0010 0 0 0.0 65535.0000 ECU_ADDRESS 0x3045C6 /end MEASUREMENT
/begin MEASUREMENT tpu_b_pram_13of16_5of8_ "Parameter RAM." UWORD FORMULA_0010 0 0 0.0 65535.0000 ECU_ADDRESS 0x3045C8 /end MEASUREMENT
/begin MEASUREMENT tpu_b_pram_13of16_6of8_ "Parameter RAM." UWORD FORMULA_0010 0 0 0.0 65535.0000 ECU_ADDRESS 0x3045CA /end MEASUREMENT
/begin MEASUREMENT tpu_b_pram_13of16_7of8_ "Parameter RAM." UWORD FORMULA_0010 0 0 0.0 65535.0000 ECU_ADDRESS 0x3045CC /end MEASUREMENT
/begin MEASUREMENT tpu_b_pram_13of16_8of8_ "Parameter RAM." UWORD FORMULA_0010 0 0 0.0 65535.0000 ECU_ADDRESS 0x3045CE /end MEASUREMENT
/begin MEASUREMENT tpu_b_pram_14of16_1of8_ "Parameter RAM." UWORD FORMULA_0010 0 0 0.0 65535.0000 ECU_ADDRESS 0x3045D0 /end MEASUREMENT
/begin MEASUREMENT tpu_b_pram_14of16_2of8_ "Parameter RAM." UWORD FORMULA_0010 0 0 0.0 65535.0000 ECU_ADDRESS 0x3045D2 /end MEASUREMENT
/begin MEASUREMENT tpu_b_pram_14of16_3of8_ "Parameter RAM." UWORD FORMULA_0010 0 0 0.0 65535.0000 ECU_ADDRESS 0x3045D4 /end MEASUREMENT
/begin MEASUREMENT tpu_b_pram_14of16_4of8_ "Parameter RAM." UWORD FORMULA_0010 0 0 0.0 65535.0000 ECU_ADDRESS 0x3045D6 /end MEASUREMENT
/begin MEASUREMENT tpu_b_pram_14of16_5of8_ "Parameter RAM." UWORD FORMULA_0010 0 0 0.0 65535.0000 ECU_ADDRESS 0x3045D8 /end MEASUREMENT
/begin MEASUREMENT tpu_b_pram_14of16_6of8_ "Parameter RAM." UWORD FORMULA_0010 0 0 0.0 65535.0000 ECU_ADDRESS 0x3045DA /end MEASUREMENT
/begin MEASUREMENT tpu_b_pram_14of16_7of8_ "Parameter RAM." UWORD FORMULA_0010 0 0 0.0 65535.0000 ECU_ADDRESS 0x3045DC /end MEASUREMENT
/begin MEASUREMENT tpu_b_pram_14of16_8of8_ "Parameter RAM." UWORD FORMULA_0010 0 0 0.0 65535.0000 ECU_ADDRESS 0x3045DE /end MEASUREMENT
/begin MEASUREMENT tpu_b_pram_15of16_1of8_ "Parameter RAM." UWORD FORMULA_0010 0 0 0.0 65535.0000 ECU_ADDRESS 0x3045E0 /end MEASUREMENT
/begin MEASUREMENT tpu_b_pram_15of16_2of8_ "Parameter RAM." UWORD FORMULA_0010 0 0 0.0 65535.0000 ECU_ADDRESS 0x3045E2 /end MEASUREMENT
/begin MEASUREMENT tpu_b_pram_15of16_3of8_ "Parameter RAM." UWORD FORMULA_0010 0 0 0.0 65535.0000 ECU_ADDRESS 0x3045E4 /end MEASUREMENT
/begin MEASUREMENT tpu_b_pram_15of16_4of8_ "Parameter RAM." UWORD FORMULA_0010 0 0 0.0 65535.0000 ECU_ADDRESS 0x3045E6 /end MEASUREMENT
/begin MEASUREMENT tpu_b_pram_15of16_5of8_ "Parameter RAM." UWORD FORMULA_0010 0 0 0.0 65535.0000 ECU_ADDRESS 0x3045E8 /end MEASUREMENT
/begin MEASUREMENT tpu_b_pram_15of16_6of8_ "Parameter RAM." UWORD FORMULA_0010 0 0 0.0 65535.0000 ECU_ADDRESS 0x3045EA /end MEASUREMENT
/begin MEASUREMENT tpu_b_pram_15of16_7of8_ "Parameter RAM." UWORD FORMULA_0010 0 0 0.0 65535.0000 ECU_ADDRESS 0x3045EC /end MEASUREMENT
/begin MEASUREMENT tpu_b_pram_15of16_8of8_ "Parameter RAM." UWORD FORMULA_0010 0 0 0.0 65535.0000 ECU_ADDRESS 0x3045EE /end MEASUREMENT
/begin MEASUREMENT tpu_b_pram_16of16_1of8_ "Parameter RAM." UWORD FORMULA_0010 0 0 0.0 65535.0000 ECU_ADDRESS 0x3045F0 /end MEASUREMENT
/begin MEASUREMENT tpu_b_pram_16of16_2of8_ "Parameter RAM." UWORD FORMULA_0010 0 0 0.0 65535.0000 ECU_ADDRESS 0x3045F2 /end MEASUREMENT
/begin MEASUREMENT tpu_b_pram_16of16_3of8_ "Parameter RAM." UWORD FORMULA_0010 0 0 0.0 65535.0000 ECU_ADDRESS 0x3045F4 /end MEASUREMENT
/begin MEASUREMENT tpu_b_pram_16of16_4of8_ "Parameter RAM." UWORD FORMULA_0010 0 0 0.0 65535.0000 ECU_ADDRESS 0x3045F6 /end MEASUREMENT
/begin MEASUREMENT tpu_b_pram_16of16_5of8_ "Parameter RAM." UWORD FORMULA_0010 0 0 0.0 65535.0000 ECU_ADDRESS 0x3045F8 /end MEASUREMENT
/begin MEASUREMENT tpu_b_pram_16of16_6of8_ "Parameter RAM." UWORD FORMULA_0010 0 0 0.0 65535.0000 ECU_ADDRESS 0x3045FA /end MEASUREMENT
/begin MEASUREMENT tpu_b_pram_16of16_7of8_ "Parameter RAM." UWORD FORMULA_0010 0 0 0.0 65535.0000 ECU_ADDRESS 0x3045FC /end MEASUREMENT
/begin MEASUREMENT tpu_b_pram_16of16_8of8_ "Parameter RAM." UWORD FORMULA_0010 0 0 0.0 65535.0000 ECU_ADDRESS 0x3045FE /end MEASUREMENT
/* ------------------ Abschnitt erzeugt aus tpu_ign.dat ------------------ */
/begin CHARACTERISTIC K_TPU_IGN_MISS_FIRE_TIME "Ini Schliesszeit fuer die Ausgabe von Fehlzuendungen. | EN: Initial dwell time for output of misfires" VALUE 0x79B3C TKW_VV_VV_UB 100.0 FORMULA_1027 0.0 291.4285 /end CHARACTERISTIC
/begin CHARACTERISTIC K_TPU_IGN_MIN_SCI_POS "Ini minimalen Winkelabstand vorm Zuendwinkel. | EN: Initial minimum angle distance before ignition angle" VALUE 0x79B3E TKW_VV_VV_SW 100.0 FORMULA_0710 -360.0000 359.9000 FORMAT "%4.1" /end CHARACTERISTIC
/* ------------------ Abschnitt erzeugt aus tz.dat ------------------ */
/begin CHARACTERISTIC K_TZ_SZ_CONTROL "Kontrollbits Bit1 -> Zyl1 (1: ueber K_TZ_SZ_MCS 0: ueber Funktion) | EN: Kontrollbits Bit1 - > Zyl1 (1: ueber K_TZ_SZ_MCS 0: ueber Funktion)" VALUE 0x79D60 TKW_VV_VV_UW 100.0 FORMULA_0083 0.0 65535.0000 FORMAT "%5.2" /end CHARACTERISTIC
/begin CHARACTERISTIC K_TZ_DIAG_MAX_BESTR_TPU "Schwelle fuer Fehlereintrag Dauerbestromung TPU" VALUE 0x79D62 TKW_VV_VV_UB 100.0 FORMULA_1039 0.0 255.0000 /end CHARACTERISTIC
/begin CHARACTERISTIC K_TZ_MAX "fruehester Zuendwinkel | EN: fruehester Zuendwinkel | [Code V452 IGN 0x667F4] Earliest allowed ignition, last limit in the chain (60 degKW)." VALUE 0x79D64 TKW_VV_VV_SW 100.0 FORMULA_0111 -50.0000 60.0000 FORMAT "%4.1" /end CHARACTERISTIC
/begin CHARACTERISTIC K_TZ_ZWB_B1 "Aenderungsbegrenzung Bereich 1 | EN: Aenderungsbegrenzung B e-reich 1 | [Code V452 IGN 0x660D0/0x667F4] Ignition change limit per segment (symmetric, advance and retard) for range rf below K_TZ_RF_ZWB. Applied to base + TKORR before all offsets; bypassed in start/some states." VALUE 0x79D66 TKW_VV_VV_SW 100.0 FORMULA_1040 0.0 50.0000 FORMAT "%4.1" /end CHARACTERISTIC
/begin CHARACTERISTIC K_TZ_ZWB_B2 "Aenderungsbegrenzung Bereich 2 | EN: Aenderungsbegrenzung B e-reich 2 | [Code V452 IGN 0x660D0/0x667F4] Ignition change limit per segment (symmetric, advance and retard) for range rf above K_TZ_RF_ZWB and n above idle + K_TZ_DN_ZWB. Applied to base + TKORR before all offsets; bypassed in start/some states." VALUE 0x79D68 TKW_VV_VV_SW 100.0 FORMULA_1040 0.0 50.0000 FORMAT "%4.1" /end CHARACTERISTIC
/begin CHARACTERISTIC K_TZ_ZWB_B3 "Aenderungsbegrenzung Bereich 3 | EN: Aenderungsbegrenzung B e-reich 3 | [Code V452 IGN 0x660D0/0x667F4] Ignition change limit per segment (symmetric, advance and retard) for range n at/below llr_n_soll + K_TZ_DN_ZWB. Applied to base + TKORR before all offsets; bypassed in start/some states." VALUE 0x79D6A TKW_VV_VV_SW 100.0 FORMULA_1040 0.0 50.0000 FORMAT "%4.1" /end CHARACTERISTIC
/begin CHARACTERISTIC K_TZ_KH_ZWB_B1 "Aenderungsbegrenzung Bereich 1 im KH | EN: Aenderungsbegrenzung B e-reich 1 im KH | [Code V452 IGN 0x660D0] As K_TZ_ZWB_B1 but during catalyst heating." VALUE 0x79D6C TKW_VV_VV_SW 100.0 FORMULA_1040 0.0 50.0000 FORMAT "%4.1" /end CHARACTERISTIC
/begin CHARACTERISTIC K_TZ_KH_ZWB_B2 "Aenderungsbegrenzung Bereich 2 im KH | EN: Aenderungsbegrenzung B e-reich 2 im KH | [Code V452 IGN 0x660D0] As K_TZ_ZWB_B2 but during catalyst heating." VALUE 0x79D6E TKW_VV_VV_SW 100.0 FORMULA_1040 0.0 50.0000 FORMAT "%4.1" /end CHARACTERISTIC
/begin CHARACTERISTIC K_TZ_KH_ZWB_B3 "Aenderungsbegrenzung Bereich 3 im KH | EN: Aenderungsbegrenzung B e-reich 3 im KH | [Code V452 IGN 0x660D0] As K_TZ_ZWB_B3 but during catalyst heating." VALUE 0x79D70 TKW_VV_VV_SW 100.0 FORMULA_1040 0.0 50.0000 FORMAT "%4.1" /end CHARACTERISTIC
/begin CHARACTERISTIC K_TZ_RF_ZWB "RF Umschaltschwelle fuer ZWB | EN: RF Umschaltschwelle fuer ZWB | [Code V452 IGN 0x660D0] rf threshold selecting K_TZ_ZWB_B1 (below) / B2 (above)." VALUE 0x79D72 TKW_VV_VV_SW 100.0 FORMULA_0007 0.0 2.0000 FORMAT "%6.3" /end CHARACTERISTIC
/begin CHARACTERISTIC K_TZ_KH_RF_ZWB "RF Umschaltschwelle fuer ZWB im KH | EN: RF Umschaltschwelle fuer ZWB im KH | [Code V452 IGN 0x660D0] rf threshold for the KH (cat heating) change limits." VALUE 0x79D74 TKW_VV_VV_SW 100.0 FORMULA_0007 0.0 2.0000 FORMAT "%6.3" /end CHARACTERISTIC
/begin CHARACTERISTIC K_TZ_DN_ZWB "Drehzahl Hysterese fuer ZWB | EN: Drehzahl Hysterese fuer ZWB | [Code V452 IGN 0x660D0] n hysteresis above the idle target speed llr_n_soll for selecting the change-limit range." VALUE 0x79D76 TKW_VV_VV_SW 100.0 FORMULA_0006 0.0 10000.0000 /end CHARACTERISTIC
/begin CHARACTERISTIC K_TZ_MCS "Zuendwinkelkorrektur ueber MCS | EN: Zuendwinkelkorrektur ueber MCS | [Code V452 IGN 0x667F4] Global ignition offset added to both banks after the rate limit (0 here). Not reduced by anything except the final limits." VALUE 0x79D78 TKW_VV_VV_SW 100.0 FORMULA_0111 -50.0000 60.0000 FORMAT "%4.1" /end CHARACTERISTIC
/begin CHARACTERISTIC K_TZ_MCS_Z_ZYL1 "zyl.selektive Zuendwinkelkorrektur ueber MCS | [Code V452 IGN 0x667F4] Cylinder-1 ignition offset, added per cylinder after K_TZ_MCS (cylinder index = bank x 5 + k). Only ZYL1 is referenced directly; the others are read as an array." VALUE 0x79D7A TKW_VV_VV_SW 100.0 FORMULA_0111 -50.0000 60.0000 FORMAT "%4.1" /end CHARACTERISTIC
/begin CHARACTERISTIC K_TZ_MCS_Z_ZYL2 "zyl.selektive Zuendwinkelkorrektur ueber MCS | [Code V452 IGN 0x667F4] Cylinder-2 ignition offset, added per cylinder after K_TZ_MCS (cylinder index = bank x 5 + k). Only ZYL1 is referenced directly; the others are read as an array." VALUE 0x79D7C TKW_VV_VV_SW 100.0 FORMULA_0111 -50.0000 60.0000 FORMAT "%4.1" /end CHARACTERISTIC
/begin CHARACTERISTIC K_TZ_MCS_Z_ZYL3 "zyl.selektive Zuendwinkelkorrektur ueber MCS | [Code V452 IGN 0x667F4] Cylinder-3 ignition offset, added per cylinder after K_TZ_MCS (cylinder index = bank x 5 + k). Only ZYL1 is referenced directly; the others are read as an array." VALUE 0x79D7E TKW_VV_VV_SW 100.0 FORMULA_0111 -50.0000 60.0000 FORMAT "%4.1" /end CHARACTERISTIC
/begin CHARACTERISTIC K_TZ_MCS_Z_ZYL4 "zyl.selektive Zuendwinkelkorrektur ueber MCS | [Code V452 IGN 0x667F4] Cylinder-4 ignition offset, added per cylinder after K_TZ_MCS (cylinder index = bank x 5 + k). Only ZYL1 is referenced directly; the others are read as an array." VALUE 0x79D80 TKW_VV_VV_SW 100.0 FORMULA_0111 -50.0000 60.0000 FORMAT "%4.1" /end CHARACTERISTIC
/begin CHARACTERISTIC K_TZ_MCS_Z_ZYL5 "zyl.selektive Zuendwinkelkorrektur ueber MCS | [Code V452 IGN 0x667F4] Cylinder-5 ignition offset, added per cylinder after K_TZ_MCS (cylinder index = bank x 5 + k). Only ZYL1 is referenced directly; the others are read as an array." VALUE 0x79D82 TKW_VV_VV_SW 100.0 FORMULA_0111 -50.0000 60.0000 FORMAT "%4.1" /end CHARACTERISTIC
/begin CHARACTERISTIC K_TZ_MCS_Z_ZYL6 "zyl.selektive Zuendwinkelkorrektur ueber MCS | [Code V452 IGN 0x667F4] Cylinder-6 ignition offset, added per cylinder after K_TZ_MCS (cylinder index = bank x 5 + k). Only ZYL1 is referenced directly; the others are read as an array." VALUE 0x79D84 TKW_VV_VV_SW 100.0 FORMULA_0111 -50.0000 60.0000 FORMAT "%4.1" /end CHARACTERISTIC
/begin CHARACTERISTIC K_TZ_MCS_Z_ZYL7 "zyl.selektive Zuendwinkelkorrektur ueber MCS | [Code V452 IGN 0x667F4] Cylinder-7 ignition offset, added per cylinder after K_TZ_MCS (cylinder index = bank x 5 + k). Only ZYL1 is referenced directly; the others are read as an array." VALUE 0x79D86 TKW_VV_VV_SW 100.0 FORMULA_0111 -50.0000 60.0000 FORMAT "%4.1" /end CHARACTERISTIC
/begin CHARACTERISTIC K_TZ_MCS_Z_ZYL8 "zyl.selektive Zuendwinkelkorrektur ueber MCS | [Code V452 IGN 0x667F4] Cylinder-8 ignition offset, added per cylinder after K_TZ_MCS (cylinder index = bank x 5 + k). Only ZYL1 is referenced directly; the others are read as an array." VALUE 0x79D88 TKW_VV_VV_SW 100.0 FORMULA_0111 -50.0000 60.0000 FORMAT "%4.1" /end CHARACTERISTIC
/begin CHARACTERISTIC K_TZ_MCS_Z_ZYL9 "zyl.selektive Zuendwinkelkorrektur ueber MCS | [Code V452 IGN 0x667F4] Cylinder-9 ignition offset, added per cylinder after K_TZ_MCS (cylinder index = bank x 5 + k). Only ZYL1 is referenced directly; the others are read as an array." VALUE 0x79D8A TKW_VV_VV_SW 100.0 FORMULA_0111 -50.0000 60.0000 FORMAT "%4.1" /end CHARACTERISTIC
/begin CHARACTERISTIC K_TZ_MCS_Z_ZYL10 "zyl.selektive Zuendwinkelkorrektur ueber MCS | [Code V452 IGN 0x667F4] Cylinder-10 ignition offset, added per cylinder after K_TZ_MCS (cylinder index = bank x 5 + k). Only ZYL1 is referenced directly; the others are read as an array." VALUE 0x79D8C TKW_VV_VV_SW 100.0 FORMULA_0111 -50.0000 60.0000 FORMAT "%4.1" /end CHARACTERISTIC
/begin CHARACTERISTIC K_TZ_UB_ERSATZ "Ub-Ersatzwert fuer Schliesszeitberechnung | EN: Ub-Ersatzwert fuer Schlies s-zeitberechnung" VALUE 0x79D8E TKW_VV_VV_SW 100.0 FORMULA_0008 0.0 28.0000 FORMAT "%4.1" /end CHARACTERISTIC
/begin CHARACTERISTIC K_TZ_KL15_NACHLAUF "Kl15 Nachlauf der Zuendung" VALUE 0x79D90 TKW_VV_VV_UB 100.0 FORMULA_0774 0.0 255.0000 /end CHARACTERISTIC
/begin CHARACTERISTIC K_TZ_ION_COIL "Auswahl integrierte Ionen-Zuendspulen." VALUE 0x79D92 TKW_VV_VV_UW 100.0 FORMULA_0010 0.0 65535.0000 /end CHARACTERISTIC
/begin CHARACTERISTIC K_TZ_SZ_MAX "Spulenstrom bei KH | EN: Maximaler Spulenstrom" VALUE 0x79D94 TKW_VV_VV_SW 100.0 FORMULA_1038 0.0 30.0000 FORMAT "%4.1" /end CHARACTERISTIC
/begin CHARACTERISTIC K_TZ_ABSCH_CTR "Abchalten der Zuendung nach Anzahl von Segmenten " VALUE 0x79D96 TKW_VV_VV_UB 100.0 FORMULA_0774 0.0 255.0000 /end CHARACTERISTIC
/begin CHARACTERISTIC K_TZ_DBGR_DR_REL_TAU "Druckbegrenzung DR_Rel Filter Tau" VALUE 0x79D97 TKW_VV_VV_UB 100.0 FORMULA_0478 0.0051 1.2800 /end CHARACTERISTIC
/begin CHARACTERISTIC K_TZ_DBGR_DR_REL "Triggerschwelle DBGR abh. von dr_rel | [Code V452 IGN 0x66D4C] Minimum dr_rel (higher bank) for the tip-in retard." VALUE 0x79D98 TKW_VV_VV_SW 100.0 FORMULA_0115 0.0 199.9938 FORMAT "%5.2" /end CHARACTERISTIC
/begin CHARACTERISTIC K_TZ_DBGR_ANZ_SEG "Anz. Segmente bis ruecksetzen | EN: Anz. Segmente bis rueckse t-zen | [Code V452 IGN 0x66D4C] Hold time (segments) of the tip-in retard before it ramps back." VALUE 0x79D9A TKW_VV_VV_UB 100.0 FORMULA_1041 1.0000 256.0000 /end CHARACTERISTIC
/begin CHARACTERISTIC K_TZ_DBGR_AUFREG "Aufregelrampe Druckbegrenzung | EN: Aufregelrampe Druckbegren-zung | [Code V452 IGN 0x66D4C] Recovery step per segment of the tip-in retard." VALUE 0x79D9B TKW_VV_VV_UB 100.0 FORMULA_1042 0.0 25.5000 /end CHARACTERISTIC
/begin CHARACTERISTIC K_TZ_SZ_I_VERSCHL_OFFS "SZ-Offset bei Kerzenverschleiss" VALUE 0x79D9C TKW_VV_VV_SW 100.0 FORMULA_1038 0.0 5.0000 FORMAT "%4.1" /end CHARACTERISTIC
/begin CHARACTERISTIC K_TZ_SZ_AUSS_DELAY "Delay fuer Abschaltung der Stromanhebung | EN: Delay fuer Abschaltung der Stromanhebung" VALUE 0x79D9E TKW_VV_VV_UW 100.0 FORMULA_0117 0.0 5.0000 FORMAT "%5.2" /end CHARACTERISTIC
/begin CHARACTERISTIC K_TZ_SZ_MCS "Festwert fuer Schliesszeit | EN: Festwert fuer Schliesszeit" VALUE 0x79DA0 TKW_VV_VV_SW 100.0 FORMULA_1035 0.0 5.0000 FORMAT "%5.2" /end CHARACTERISTIC
/begin CHARACTERISTIC K_TZ_I_BEGR "Begrenzter Spulenstrom bei SA oder Zuendaussetzer | EN: Begrenzter Spulenstrom bei SA oder Zuendaussetzer" VALUE 0x79DA2 TKW_VV_VV_SW 100.0 FORMULA_1038 0.0 30.0000 FORMAT "%4.1" /end CHARACTERISTIC
/begin CHARACTERISTIC K_TZ_I_SA_DELAY "Delay fuer SA Abschaltung | EN: Delay fuer SA Abschaltung" VALUE 0x79DA4 TKW_VV_VV_UW 100.0 FORMULA_0117 0.0 5.0000 FORMAT "%5.2" /end CHARACTERISTIC
/begin CHARACTERISTIC K_TZ_GRAD_TAU "Filterkonstante fuer tz_grad | EN: Filterkonstante fuer tz_grad" VALUE 0x79DA6 TKW_VV_VV_UB 100.0 FORMULA_1043 0.0040 0.9960 /end CHARACTERISTIC
/begin CHARACTERISTIC K_TZ_DBGR_TMOT "Schwelle fuer DBGR-Fkt. aktive | EN: Schwelle fuer DBGR -Fkt. aktive | [Code V452 IGN 0x66D4C] Coolant temperature above which the tip-in retard is active (-40.9 degC = always)." VALUE 0x79DA8 TKW_VV_VV_SW 100.0 FORMULA_0023 -50.0000 170.0000 FORMAT "%4.1" /end CHARACTERISTIC
/begin CHARACTERISTIC K_TZ_NZ_N_MAX "Maximale Drehzahl bei der noch Nachzuender ausgegeben werden. | EN: Maximale Drehzahl bei der noch Nachzuender ausgeg e- ben werden." VALUE 0x79DAA TKW_VV_VV_SW 100.0 FORMULA_0006 0.0 10000.0000 /end CHARACTERISTIC
/begin CHARACTERISTIC K_TZ_NZ_CHARGE "Bestromungszeit fuer Nachzuendpulse." VALUE 0x79DAC TKW_VV_VV_SW 100.0 FORMULA_1035 0.0 5.0000 FORMAT "%5.2" /end CHARACTERISTIC
/begin CHARACTERISTIC K_TZ_NZ_DIS_CHARGE "Funkenbrenndauerbegrenzung vor Nachzuendpulsen." VALUE 0x79DAE TKW_VV_VV_SW 100.0 FORMULA_1035 0.0 5.0000 FORMAT "%5.2" /end CHARACTERISTIC
/begin CHARACTERISTIC K_TZ_NZ_ANZ_B1 "Anzahl der maximal ausgegebenen Nachzuendpulse." VALUE 0x79DB0 TKW_VV_VV_UB 100.0 FORMULA_0003 0.0 10.0000 /end CHARACTERISTIC
/begin CHARACTERISTIC K_TZ_NZ_ANZ_B2 "Anzahl der maximal ausgegebenen Nachzuendpulse." VALUE 0x79DB1 TKW_VV_VV_UB 100.0 FORMULA_0003 0.0 10.0000 /end CHARACTERISTIC
/begin CHARACTERISTIC KL_TZ_START_N "Start Zuendwinkel = f{ n } | EN: Start ignition angle vs engine speed | [Code V452 IGN 0x66284] Start ignition over n; start state only (no engine-running state bits). Sum with KL_TZ_START_TMOT, both banks." CURVE 0x79DB2 TKL_SW_VV_SW 100.0 FORMULA_0111 -50.0000 60.0000 /begin AXIS_DESCR STD_AXIS n FORMULA_0006 3 0.0 10000.0000 /end AXIS_DESCR FORMAT "%4.1" /end CHARACTERISTIC
/begin CHARACTERISTIC KL_TZ_START_TMOT "Offset Start Zuendwinkel = f{ tmot } | EN: Ignition-angle offset at start vs engine temperature | [Code V452 IGN 0x66284] Start ignition offset over coolant temperature, added to KL_TZ_START_N." CURVE 0x79DC0 TKL_SW_VV_SW 100.0 FORMULA_0111 -50.0000 60.0000
 /begin AXIS_DESCR STD_AXIS tmot FORMULA_0023 3 -50.0000 170.0000 FORMAT "%4.1" /end AXIS_DESCR
 FORMAT "%4.1" /end CHARACTERISTIC
/begin CHARACTERISTIC KL_TZ_DBGR_TRIGGER "Triggerschwelle fuer dr_rel Grad. | EN: Ignition-angle offset at start vs engine temperature | [Code V452 IGN 0x66D4C] dr_rel gradient threshold for the tip-in retard KL_TZ_DBGR_OFFS." CURVE 0x79DCE TKL_SW_VV_SW 100.0 FORMULA_0276 -655000.0000 655000.0000 /begin AXIS_DESCR STD_AXIS n FORMULA_0006 4 0.0 10000.0000 /end AXIS_DESCR /end CHARACTERISTIC
/begin CHARACTERISTIC KL_TZ_DBGR_OFFS "Druckbegrenzungsoffset | [Code V452 IGN 0x66D4C] Tip-in retard (Druckbegrenzung) over n. Triggered when the dr_rel gradient > KL_TZ_DBGR_TRIGGER and dr_rel > K_TZ_DBGR_DR_REL and tmot > K_TZ_DBGR_TMOT; held K_TZ_DBGR_ANZ_SEG segments, then ramps back by K_TZ_DBGR_AUFREG per segment. Combined with knock adaptation by min() (the larger retard wins, not added)." CURVE 0x79DE0 TKL_SW_VV_SW 100.0 FORMULA_0111 -50.0000 60.0000 /begin AXIS_DESCR STD_AXIS n FORMULA_0006 7 0.0 10000.0000 /end AXIS_DESCR FORMAT "%4.1" /end CHARACTERISTIC
/begin CHARACTERISTIC KL_TZ_SZ_LAM_OFFS "Schliesszeitoffset aus Lambda | EN: Dwell-time offset from lambda" CURVE 0x79DFE TKL_UW_VV_SW 100.0 FORMULA_1038 0.0 30.0000
 /begin AXIS_DESCR STD_AXIS lam_ist_mw_b1 FORMULA_0025 7 0.0 3.9990 FORMAT "%6.3" /end AXIS_DESCR
 FORMAT "%4.1" /end CHARACTERISTIC
/begin CHARACTERISTIC KL_TZ_SZ_TMOT_OFFS "Schliesszeitoffset aus TMOT | EN: Dwell-time offset from engine temperature" CURVE 0x79E1C TKL_SW_VV_SW 100.0 FORMULA_1038 0.0 30.0000
 /begin AXIS_DESCR STD_AXIS tmot FORMULA_0023 6 -50.0000 170.0000 FORMAT "%4.1" /end AXIS_DESCR
 FORMAT "%4.1" /end CHARACTERISTIC
/begin CHARACTERISTIC KL_TZ_SZ_START_OFFS "Schliesszeitoffset aus TMOT | EN: Dwell-time offset during start" CURVE 0x79E36 TKL_SW_VV_SW 100.0 FORMULA_1038 0.0 30.0000
 /begin AXIS_DESCR STD_AXIS tmot_start FORMULA_0023 6 -50.0000 170.0000 FORMAT "%4.1" /end AXIS_DESCR
 FORMAT "%4.1" /end CHARACTERISTIC
/begin CHARACTERISTIC KL_TZ_SZ_STARTOFFS_TIME "Zeit fuer Schliesszeitoffset im Start | EN: Zeit fuer Schliesszeitoffset im Start" CURVE 0x79E50 TKL_SW_VV_UW 100.0 FORMULA_0021 0.0 655.0000
 /begin AXIS_DESCR STD_AXIS tmot_start FORMULA_0023 6 -50.0000 170.0000 FORMAT "%4.1" /end AXIS_DESCR
 FORMAT "%5.2" /end CHARACTERISTIC
/begin CHARACTERISTIC KF_TZ_LL "Leerlauf Zuendwinkel = f{n,rf} | EN: Idle ignition angle vs engine speed and charge | [Code V452 IGN 0x66284] Idle ignition (n x rf), per bank. Used in the idle states only; then KL_TZ_TKORR_LL is added." MAP 0x79E6A TKF_SW_SW_SW 100.0 FORMULA_0111 -50.0000 60.0000 /begin AXIS_DESCR STD_AXIS n FORMULA_0006 10 0.0 10000.0000 /end AXIS_DESCR /begin AXIS_DESCR STD_AXIS rf_m FORMULA_0007 4 0.0 2.0000 FORMAT "%6.3" /end AXIS_DESCR FORMAT "%4.1" /end CHARACTERISTIC
/begin CHARACTERISTIC KF_TZ_GRUND "Grundkennfeld Zuendwinkel fuer TL | EN: Base ignition-angle map for part load | [Code V452 IGN 0x66284] Part-load base ignition (n x rf). Part load: per bank with rf_b1/rf_b2. Full load: read with rf_m as the base of the TL->VL blend. Final chain (0x667F4) per cylinder: base + KL_TZ_TKORR -> rate limit K_TZ_ZWB -> + K_TZ_MCS + K_TZ_MCS_Z_ZYLi -> + min(knock adaptation, DBGR) -> + knock control -> torque cut -> max(KF_TZ_MIN) -> min(K_TZ_MAX)." MAP 0x79ED8 TKF_SW_SW_SW 100.0 FORMULA_0111 -50.0000 60.0000 /begin AXIS_DESCR STD_AXIS n FORMULA_0006 18 0.0 10000.0000 /end AXIS_DESCR /begin AXIS_DESCR STD_AXIS rf FORMULA_0007 12 0.0 2.0000 FORMAT "%6.3" /end AXIS_DESCR FORMAT "%4.1" /end CHARACTERISTIC
/begin CHARACTERISTIC KF_TZ_VL "Vollast Zuendwinkel | EN: Full-load ignition angle | [Code V452 IGN 0x66284] Full-load ignition (n x pumg = ambient pressure rows 700/960/1030 mbar). Only in full-load state. tz = KF_TZ_GRUND(n,rf_m) + (KF_TZ_VL - KF_TZ_GRUND) x tz_tl_vl_fak, with tz_tl_vl_fak = (md_wunsch_rel - KL_ZUST_MD_TL_VL)/(100 % - KL_ZUST_MD_TL_VL): 0 at 90 % torque demand, 1.0 at 100 %. Same value for both banks. Then reduced by knock adaptation (incl. KF_KA_OFFS_VL), knock control and floored by KF_TZ_MIN." MAP 0x7A0C6 TKF_SW_SW_SW 100.0 FORMULA_0111 -50.0000 60.0000 /begin AXIS_DESCR STD_AXIS n FORMULA_0006 18 0.0 10000.0000 /end AXIS_DESCR
 /begin AXIS_DESCR STD_AXIS pumg FORMULA_0077 3 400.0000 1200.0000 FORMAT "%4.1" /end AXIS_DESCR
 FORMAT "%4.1" /end CHARACTERISTIC
/begin CHARACTERISTIC KL_TZ_TKORR_LL "tmot-Zuendwinkelkorrektur fuer LL | [Code V452 IGN 0x660D0/0x667F4] Coolant-temperature correction added to the base angle at idle." CURVE 0x7A15E TKL_SW_VV_SW 100.0 FORMULA_0111 -50.0000 60.0000
 /begin AXIS_DESCR STD_AXIS tmot FORMULA_0023 6 -50.0000 170.0000 FORMAT "%4.1" /end AXIS_DESCR
 FORMAT "%4.1" /end CHARACTERISTIC
/begin CHARACTERISTIC KL_TZ_TKORR_TL "tmot-Zuendwinkelkorrektur fuer TL | [Code V452 IGN 0x660D0/0x667F4] Coolant-temperature correction added to the base angle in part load (all 0 here). 0 in full load." CURVE 0x7A178 TKL_SW_VV_SW 100.0 FORMULA_0111 -50.0000 60.0000
 /begin AXIS_DESCR STD_AXIS tmot FORMULA_0023 6 -50.0000 170.0000 FORMAT "%4.1" /end AXIS_DESCR
 FORMAT "%4.1" /end CHARACTERISTIC
/begin CHARACTERISTIC KL_TZ_PHASE "Zuendwinkel Schaubabschaltern = f{ n } | EN: Ignition angle during shift cut vs engine speed | [Code V452 IGN 0x667F4] Phase offset added only for the output timing (tz_zyl + tz_phase); not part of the ignition value used by knock/torque." CURVE 0x7A192 TKL_SW_VV_SW 100.0 FORMULA_0111 -50.0000 60.0000 /begin AXIS_DESCR STD_AXIS n FORMULA_0006 4 0.0 10000.0000 /end AXIS_DESCR FORMAT "%4.1" /end CHARACTERISTIC
/begin CHARACTERISTIC KL_TZ_MIN_TMOT "Offset spaetest zulaessiger Zuendwinkel | EN: Offset of latest permitted ignition angle | [Code V452 IGN 0x66284] Coolant-temperature offset added to KF_TZ_MIN (all 0 here)." CURVE 0x7A1A4 TKL_SW_VV_SW 100.0 FORMULA_0111 -50.0000 60.0000
 /begin AXIS_DESCR STD_AXIS tmot FORMULA_0023 4 -50.0000 170.0000 FORMAT "%4.1" /end AXIS_DESCR
 FORMAT "%4.1" /end CHARACTERISTIC
/begin CHARACTERISTIC KF_TZ_I "Stromkennfeld fuer die SZ-Berechnung | EN: Coil-current map for dwell calculation" MAP 0x7A1B6 TKF_SW_SW_SW 100.0 FORMULA_1038 0.0 30.0000 /begin AXIS_DESCR STD_AXIS n FORMULA_0006 5 0.0 10000.0000 /end AXIS_DESCR /begin AXIS_DESCR STD_AXIS rf FORMULA_0007 7 0.0 2.0000 FORMAT "%6.3" /end AXIS_DESCR FORMAT "%4.1" /end CHARACTERISTIC
/begin CHARACTERISTIC KF_TZ_MIN "spaetest zulaessiger Zuendwinkel | EN: Coil-current map for dwell calculation | [Code V452 IGN 0x66284/0x667F4] Latest allowed ignition (n x rf_b) + KL_TZ_MIN_TMOT = tz_min_b. Applied AFTER knock adaptation, knock control and torque intervention: no retard can go later than this. It also caps the knock-control step (0x454BC). At high load it is the real limit on total retard (e.g. 5000 rpm rf 0.9: 18 degKW)." MAP 0x7A216 TKF_SW_SW_SW 100.0 FORMULA_0111 -50.0000 60.0000 /begin AXIS_DESCR STD_AXIS n FORMULA_0006 8 0.0 10000.0000 /end AXIS_DESCR /begin AXIS_DESCR STD_AXIS rf FORMULA_0007 6 0.0 2.0000 FORMAT "%6.3" /end AXIS_DESCR FORMAT "%4.1" /end CHARACTERISTIC
/begin CHARACTERISTIC KF_TZ_I_SZ "Schliesszeit Kennfeld | EN: Dwell time map" MAP 0x7A294 TKF_SW_SW_SW 100.0 FORMULA_1035 0.0 26.2136 /begin AXIS_DESCR STD_AXIS tz_sz_i FORMULA_1038 5 0.0 30.0000 FORMAT "%4.1" /end AXIS_DESCR /begin AXIS_DESCR STD_AXIS ub FORMULA_0008 7 0.0 28.0000 FORMAT "%4.1" /end AXIS_DESCR FORMAT "%5.2" /end CHARACTERISTIC
/begin MEASUREMENT tz_zyl1 "Zuendwinkel" SWORD FORMULA_0111 0 0 -50.0000 60.0000 ECU_ADDRESS 0x3FC504 /end MEASUREMENT
/begin MEASUREMENT tz_zyl2 "Zuendwinkel" SWORD FORMULA_0111 0 0 -50.0000 60.0000 ECU_ADDRESS 0x3FC506 /end MEASUREMENT
/begin MEASUREMENT tz_zyl3 "Zuendwinkel" SWORD FORMULA_0111 0 0 -50.0000 60.0000 ECU_ADDRESS 0x3FC508 /end MEASUREMENT
/begin MEASUREMENT tz_zyl4 "Zuendwinkel" SWORD FORMULA_0111 0 0 -50.0000 60.0000 ECU_ADDRESS 0x3FC50A /end MEASUREMENT
/begin MEASUREMENT tz_zyl5 "Zuendwinkel" SWORD FORMULA_0111 0 0 -50.0000 60.0000 ECU_ADDRESS 0x3FC50C /end MEASUREMENT
/begin MEASUREMENT tz_zyl6 "Zuendwinkel" SWORD FORMULA_0111 0 0 -50.0000 60.0000 ECU_ADDRESS 0x3FC50E /end MEASUREMENT
/begin MEASUREMENT tz_zyl7 "Zuendwinkel" SWORD FORMULA_0111 0 0 -50.0000 60.0000 ECU_ADDRESS 0x3FC510 /end MEASUREMENT
/begin MEASUREMENT tz_zyl8 "Zuendwinkel" SWORD FORMULA_0111 0 0 -50.0000 60.0000 ECU_ADDRESS 0x3FC512 /end MEASUREMENT
/begin MEASUREMENT tz_zyl9 "Zuendwinkel" SWORD FORMULA_0111 0 0 -50.0000 60.0000 ECU_ADDRESS 0x3FC514 /end MEASUREMENT
/begin MEASUREMENT tz_zyl10 "Zuendwinkel" SWORD FORMULA_0111 0 0 -50.0000 60.0000 ECU_ADDRESS 0x3FC516 /end MEASUREMENT
/begin MEASUREMENT tz_ve_zyl1 "Zuendwinkel ohne Momenteneingriff" SWORD FORMULA_0111 0 0 -50.0000 60.0000 ECU_ADDRESS 0x3FC518 /end MEASUREMENT
/begin MEASUREMENT tz_ve_zyl2 "Zuendwinkel ohne Momenteneingriff" SWORD FORMULA_0111 0 0 -50.0000 60.0000 ECU_ADDRESS 0x3FC51A /end MEASUREMENT
/begin MEASUREMENT tz_ve_zyl3 "Zuendwinkel ohne Momenteneingriff" SWORD FORMULA_0111 0 0 -50.0000 60.0000 ECU_ADDRESS 0x3FC51C /end MEASUREMENT
/begin MEASUREMENT tz_ve_zyl4 "Zuendwinkel ohne Momenteneingriff" SWORD FORMULA_0111 0 0 -50.0000 60.0000 ECU_ADDRESS 0x3FC51E /end MEASUREMENT
/begin MEASUREMENT tz_ve_zyl5 "Zuendwinkel ohne Momenteneingriff" SWORD FORMULA_0111 0 0 -50.0000 60.0000 ECU_ADDRESS 0x3FC520 /end MEASUREMENT
/begin MEASUREMENT tz_ve_zyl6 "Zuendwinkel ohne Momenteneingriff" SWORD FORMULA_0111 0 0 -50.0000 60.0000 ECU_ADDRESS 0x3FC522 /end MEASUREMENT
/begin MEASUREMENT tz_ve_zyl7 "Zuendwinkel ohne Momenteneingriff" SWORD FORMULA_0111 0 0 -50.0000 60.0000 ECU_ADDRESS 0x3FC524 /end MEASUREMENT
/begin MEASUREMENT tz_ve_zyl8 "Zuendwinkel ohne Momenteneingriff" SWORD FORMULA_0111 0 0 -50.0000 60.0000 ECU_ADDRESS 0x3FC526 /end MEASUREMENT
/begin MEASUREMENT tz_ve_zyl9 "Zuendwinkel ohne Momenteneingriff" SWORD FORMULA_0111 0 0 -50.0000 60.0000 ECU_ADDRESS 0x3FC528 /end MEASUREMENT
/begin MEASUREMENT tz_ve_zyl10 "Zuendwinkel ohne Momenteneingriff" SWORD FORMULA_0111 0 0 -50.0000 60.0000 ECU_ADDRESS 0x3FC52A /end MEASUREMENT
/begin MEASUREMENT tz_grund_b1 "Grundzuendwinkel" SWORD FORMULA_0111 0 0 -50.0000 60.0000 ECU_ADDRESS 0x3FC540 /end MEASUREMENT
/begin MEASUREMENT tz_grund_b2 "Grundzuendwinkel" SWORD FORMULA_0111 0 0 -50.0000 60.0000 ECU_ADDRESS 0x3FC542 /end MEASUREMENT
/begin MEASUREMENT tz_grund_mw "Grundzuendwinkelmittelwert" SWORD FORMULA_0111 0 0 -50.0000 60.0000 ECU_ADDRESS 0x3FC544 /end MEASUREMENT
/begin MEASUREMENT tz_stat_b1 "stationaer Zuendwinkel" SWORD FORMULA_0111 0 0 -50.0000 60.0000 ECU_ADDRESS 0x3FC546 /end MEASUREMENT
/begin MEASUREMENT tz_stat_b2 "stationaer Zuendwinkel" SWORD FORMULA_0111 0 0 -50.0000 60.0000 ECU_ADDRESS 0x3FC548 /end MEASUREMENT
/begin MEASUREMENT tz_zwb_1of2_ "Zuendwinkel nach ZWB" SWORD FORMULA_0111 0 0 -50.0000 60.0000 ECU_ADDRESS 0x3FC54A /end MEASUREMENT
/begin MEASUREMENT tz_zwb_2of2_ "Zuendwinkel nach ZWB" SWORD FORMULA_0111 0 0 -50.0000 60.0000 ECU_ADDRESS 0x3FC54C /end MEASUREMENT
/begin MEASUREMENT tz_zwb_incr "Delta Zuendwinkel fuer ZWB" SWORD FORMULA_0111 0 0 -50.0000 60.0000 ECU_ADDRESS 0x3FC54E /end MEASUREMENT
/begin MEASUREMENT tz_tkorr "Korrekturoffset Temperatureinfluss" SWORD FORMULA_0111 0 0 -50.0000 60.0000 ECU_ADDRESS 0x3FC550 /end MEASUREMENT
/begin MEASUREMENT tz_sz_zyl1 "Schliesszeit der Zuendspulen" SWORD FORMULA_1035 0 0 0.0 26.2136 ECU_ADDRESS 0x3FC552 /end MEASUREMENT
/begin MEASUREMENT tz_sz_zyl2 "Schliesszeit der Zuendspulen" SWORD FORMULA_1035 0 0 0.0 26.2136 ECU_ADDRESS 0x3FC554 /end MEASUREMENT
/begin MEASUREMENT tz_sz_zyl3 "Schliesszeit der Zuendspulen" SWORD FORMULA_1035 0 0 0.0 26.2136 ECU_ADDRESS 0x3FC556 /end MEASUREMENT
/begin MEASUREMENT tz_sz_zyl4 "Schliesszeit der Zuendspulen" SWORD FORMULA_1035 0 0 0.0 26.2136 ECU_ADDRESS 0x3FC558 /end MEASUREMENT
/begin MEASUREMENT tz_sz_zyl5 "Schliesszeit der Zuendspulen" SWORD FORMULA_1035 0 0 0.0 26.2136 ECU_ADDRESS 0x3FC55A /end MEASUREMENT
/begin MEASUREMENT tz_sz_zyl6 "Schliesszeit der Zuendspulen" SWORD FORMULA_1035 0 0 0.0 26.2136 ECU_ADDRESS 0x3FC55C /end MEASUREMENT
/begin MEASUREMENT tz_sz_zyl7 "Schliesszeit der Zuendspulen" SWORD FORMULA_1035 0 0 0.0 26.2136 ECU_ADDRESS 0x3FC55E /end MEASUREMENT
/begin MEASUREMENT tz_sz_zyl8 "Schliesszeit der Zuendspulen" SWORD FORMULA_1035 0 0 0.0 26.2136 ECU_ADDRESS 0x3FC560 /end MEASUREMENT
/begin MEASUREMENT tz_sz_zyl9 "Schliesszeit der Zuendspulen" SWORD FORMULA_1035 0 0 0.0 26.2136 ECU_ADDRESS 0x3FC562 /end MEASUREMENT
/begin MEASUREMENT tz_sz_zyl10 "Schliesszeit der Zuendspulen" SWORD FORMULA_1035 0 0 0.0 26.2136 ECU_ADDRESS 0x3FC564 /end MEASUREMENT
/begin MEASUREMENT tz_phase "Phasenkorrektur des Induktivgebers" SWORD FORMULA_0111 0 0 -50.0000 60.0000 ECU_ADDRESS 0x3FC566 /end MEASUREMENT
/begin MEASUREMENT tz_sa_offset "ZW-Eingriff von SA/WE" SWORD FORMULA_0111 0 0 -50.0000 60.0000 ECU_ADDRESS 0x3FC568 /end MEASUREMENT
/begin MEASUREMENT tz_sa_delta "" SWORD FORMULA_1036 0 0 -100.0000 0.0 ECU_ADDRESS 0x3FC56A /end MEASUREMENT
/begin MEASUREMENT tz_status "Status Zuendung" UBYTE FORMULA_1037 0 0 0.0 255.0 ECU_ADDRESS 0x3FC56D /end MEASUREMENT
/begin MEASUREMENT tz_kl15aus_count "Kl15 Nachlauf" UBYTE FORMULA_0033 0 0 0.0 255.0000 ECU_ADDRESS 0x3FC56E /end MEASUREMENT
/begin MEASUREMENT tz_tl_vl_fak "Faktor fuer Offset TL->VL Kennfeld" UWORD FORMULA_0075 0 0 0.0 4.0000 ECU_ADDRESS 0x3FC570 /end MEASUREMENT
/begin MEASUREMENT tz_vl_offs "Zuendwinkeloffset zum Grundkennfeld" SWORD FORMULA_0111 0 0 -50.0000 60.0000 ECU_ADDRESS 0x3FC572 /end MEASUREMENT
/begin MEASUREMENT tz_absch_ctr "Zaehler Abschalter der Zuendung" UBYTE FORMULA_0003 0 0 0.0 255.0000 ECU_ADDRESS 0x3FC574 /end MEASUREMENT
/begin MEASUREMENT tz_dr_rel_grad_roh_1of2_ "Rohwert Aenderungsgeschwindigkeit dr_rel" SWORD FORMULA_0276 0 0 -655000.0000 655000.0000 ECU_ADDRESS 0x3FC576 /end MEASUREMENT
/begin MEASUREMENT tz_dr_rel_grad_roh_2of2_ "Rohwert Aenderungsgeschwindigkeit dr_rel" SWORD FORMULA_0276 0 0 -655000.0000 655000.0000 ECU_ADDRESS 0x3FC578 /end MEASUREMENT
/begin MEASUREMENT tz_dr_rel_grad_1of2_ "Gefilterte Aenderungsgeschwindigkeit dr_rel" SWORD FORMULA_0276 0 0 -655000.0000 655000.0000 ECU_ADDRESS 0x3FC57A /end MEASUREMENT
/begin MEASUREMENT tz_dr_rel_grad_2of2_ "Gefilterte Aenderungsgeschwindigkeit dr_rel" SWORD FORMULA_0276 0 0 -655000.0000 655000.0000 ECU_ADDRESS 0x3FC57C /end MEASUREMENT
/begin MEASUREMENT tz_dbgr_roh_1of2_ "Druckbegrenzungsoffset aus KL" SWORD FORMULA_0111 0 0 -50.0000 60.0000 ECU_ADDRESS 0x3FC57E /end MEASUREMENT
/begin MEASUREMENT tz_dbgr_roh_2of2_ "Druckbegrenzungsoffset aus KL" SWORD FORMULA_0111 0 0 -50.0000 60.0000 ECU_ADDRESS 0x3FC580 /end MEASUREMENT
/begin MEASUREMENT tz_dbgr_offs_1of2_ "Eingerechneter Druckbegrenzungsoffset" SWORD FORMULA_0111 0 0 -50.0000 60.0000 ECU_ADDRESS 0x3FC582 /end MEASUREMENT
/begin MEASUREMENT tz_dbgr_offs_2of2_ "Eingerechneter Druckbegrenzungsoffset" SWORD FORMULA_0111 0 0 -50.0000 60.0000 ECU_ADDRESS 0x3FC584 /end MEASUREMENT
/begin MEASUREMENT tz_sz_auss_timer "Timer fuer die Stromerhoehung" UWORD FORMULA_0117 0 0 0.0 325.0000 ECU_ADDRESS 0x3FC586 /end MEASUREMENT
/begin MEASUREMENT tz_sz_i_grund_1of2_ "Spulenstrom aus Grundkennfeld" SWORD FORMULA_1038 0 0 0.0 30.0000 ECU_ADDRESS 0x3FC588 /end MEASUREMENT
/begin MEASUREMENT tz_sz_i_grund_2of2_ "Spulenstrom aus Grundkennfeld" SWORD FORMULA_1038 0 0 0.0 30.0000 ECU_ADDRESS 0x3FC58A /end MEASUREMENT
/begin MEASUREMENT tz_sz_lam_offs_1of2_ "SZ-Offset aus Lambda" SWORD FORMULA_1038 0 0 0.0 30.0000 ECU_ADDRESS 0x3FC58C /end MEASUREMENT
/begin MEASUREMENT tz_sz_lam_offs_2of2_ "SZ-Offset aus Lambda" SWORD FORMULA_1038 0 0 0.0 30.0000 ECU_ADDRESS 0x3FC58E /end MEASUREMENT
/begin MEASUREMENT tz_sz_tmot_offs "SZ-Offset aus tmot" SWORD FORMULA_1038 0 0 0.0 30.0000 ECU_ADDRESS 0x3FC590 /end MEASUREMENT
/begin MEASUREMENT tz_sz_start_offs "SZ-Offset aus Start-Bedingung" SWORD FORMULA_1038 0 0 0.0 30.0000 ECU_ADDRESS 0x3FC592 /end MEASUREMENT
/begin MEASUREMENT tz_sz_kerz_verschl_offs "SZ-Offset aus B_KERZ_VERSCHL" SWORD FORMULA_1038 0 0 0.0 30.0000 ECU_ADDRESS 0x3FC594 /end MEASUREMENT
/begin MEASUREMENT tz_sz_i_1of2_ "Auszugebener Spulenstrom" SWORD FORMULA_1038 0 0 0.0 30.0000 ECU_ADDRESS 0x3FC596 /end MEASUREMENT
/begin MEASUREMENT tz_sz_i_2of2_ "Auszugebener Spulenstrom" SWORD FORMULA_1038 0 0 0.0 30.0000 ECU_ADDRESS 0x3FC598 /end MEASUREMENT
/begin MEASUREMENT tz_diag_tpu_ctr_zyl1 "Zaehler fuer Bestromungsueberwachung der TPU" UBYTE FORMULA_1039 0 0 0.0 255.0000 ECU_ADDRESS 0x3FC59A /end MEASUREMENT
/begin MEASUREMENT tz_diag_tpu_ctr_zyl2 "Zaehler fuer Bestromungsueberwachung der TPU" UBYTE FORMULA_1039 0 0 0.0 255.0000 ECU_ADDRESS 0x3FC59B /end MEASUREMENT
/begin MEASUREMENT tz_diag_tpu_ctr_zyl3 "Zaehler fuer Bestromungsueberwachung der TPU" UBYTE FORMULA_1039 0 0 0.0 255.0000 ECU_ADDRESS 0x3FC59C /end MEASUREMENT
/begin MEASUREMENT tz_diag_tpu_ctr_zyl4 "Zaehler fuer Bestromungsueberwachung der TPU" UBYTE FORMULA_1039 0 0 0.0 255.0000 ECU_ADDRESS 0x3FC59D /end MEASUREMENT
/begin MEASUREMENT tz_diag_tpu_ctr_zyl5 "Zaehler fuer Bestromungsueberwachung der TPU" UBYTE FORMULA_1039 0 0 0.0 255.0000 ECU_ADDRESS 0x3FC59E /end MEASUREMENT
/begin MEASUREMENT tz_diag_tpu_ctr_zyl6 "Zaehler fuer Bestromungsueberwachung der TPU" UBYTE FORMULA_1039 0 0 0.0 255.0000 ECU_ADDRESS 0x3FC59F /end MEASUREMENT
/begin MEASUREMENT tz_diag_tpu_ctr_zyl7 "Zaehler fuer Bestromungsueberwachung der TPU" UBYTE FORMULA_1039 0 0 0.0 255.0000 ECU_ADDRESS 0x3FC5A0 /end MEASUREMENT
/begin MEASUREMENT tz_diag_tpu_ctr_zyl8 "Zaehler fuer Bestromungsueberwachung der TPU" UBYTE FORMULA_1039 0 0 0.0 255.0000 ECU_ADDRESS 0x3FC5A1 /end MEASUREMENT
/begin MEASUREMENT tz_diag_tpu_ctr_zyl9 "Zaehler fuer Bestromungsueberwachung der TPU" UBYTE FORMULA_1039 0 0 0.0 255.0000 ECU_ADDRESS 0x3FC5A2 /end MEASUREMENT
/begin MEASUREMENT tz_diag_tpu_ctr_zyl10 "Zaehler fuer Bestromungsueberwachung der TPU" UBYTE FORMULA_1039 0 0 0.0 255.0000 ECU_ADDRESS 0x3FC5A3 /end MEASUREMENT
/begin MEASUREMENT tz_mw_b1 "Mittelwert-Zuendwinkel der Bank" SWORD FORMULA_0111 0 0 -50.0000 60.0000 ECU_ADDRESS 0x3FC5A4 /end MEASUREMENT
/begin MEASUREMENT tz_mw_b2 "Mittelwert-Zuendwinkel der Bank" SWORD FORMULA_0111 0 0 -50.0000 60.0000 ECU_ADDRESS 0x3FC5A6 /end MEASUREMENT
/begin MEASUREMENT tz_mw_fil_b1 "Gradient vom Mittelwert-Zuendwinkel der Bank" SWORD FORMULA_0111 0 0 -50.0000 60.0000 ECU_ADDRESS 0x3FC5A8 /end MEASUREMENT
/begin MEASUREMENT tz_mw_fil_b2 "Gradient vom Mittelwert-Zuendwinkel der Bank" SWORD FORMULA_0111 0 0 -50.0000 60.0000 ECU_ADDRESS 0x3FC5AA /end MEASUREMENT
/begin MEASUREMENT tz_vekr_1of10_ "tz vor Eingriff KR" SWORD FORMULA_0111 0 0 -50.0000 60.0000 ECU_ADDRESS 0x3FC5AC /end MEASUREMENT
/begin MEASUREMENT tz_vekr_2of10_ "tz vor Eingriff KR" SWORD FORMULA_0111 0 0 -50.0000 60.0000 ECU_ADDRESS 0x3FC5AE /end MEASUREMENT
/begin MEASUREMENT tz_vekr_3of10_ "tz vor Eingriff KR" SWORD FORMULA_0111 0 0 -50.0000 60.0000 ECU_ADDRESS 0x3FC5B0 /end MEASUREMENT
/begin MEASUREMENT tz_vekr_4of10_ "tz vor Eingriff KR" SWORD FORMULA_0111 0 0 -50.0000 60.0000 ECU_ADDRESS 0x3FC5B2 /end MEASUREMENT
/begin MEASUREMENT tz_vekr_5of10_ "tz vor Eingriff KR" SWORD FORMULA_0111 0 0 -50.0000 60.0000 ECU_ADDRESS 0x3FC5B4 /end MEASUREMENT
/begin MEASUREMENT tz_vekr_6of10_ "tz vor Eingriff KR" SWORD FORMULA_0111 0 0 -50.0000 60.0000 ECU_ADDRESS 0x3FC5B6 /end MEASUREMENT
/begin MEASUREMENT tz_vekr_7of10_ "tz vor Eingriff KR" SWORD FORMULA_0111 0 0 -50.0000 60.0000 ECU_ADDRESS 0x3FC5B8 /end MEASUREMENT
/begin MEASUREMENT tz_vekr_8of10_ "tz vor Eingriff KR" SWORD FORMULA_0111 0 0 -50.0000 60.0000 ECU_ADDRESS 0x3FC5BA /end MEASUREMENT
/begin MEASUREMENT tz_vekr_9of10_ "tz vor Eingriff KR" SWORD FORMULA_0111 0 0 -50.0000 60.0000 ECU_ADDRESS 0x3FC5BC /end MEASUREMENT
/begin MEASUREMENT tz_vekr_10of10_ "tz vor Eingriff KR" SWORD FORMULA_0111 0 0 -50.0000 60.0000 ECU_ADDRESS 0x3FC5BE /end MEASUREMENT
/* ------------------ Abschnitt erzeugt aus uext.dat ------------------ */
/begin CHARACTERISTIC K_UEXT_TAU "Filterkonstante Versorgungsspannung | EN: Filter constant, supply voltage" VALUE 0x7A306 TKW_VV_VV_UB 100.0 FORMULA_0478 0.0051 1.2800 /end CHARACTERISTIC
/begin CHARACTERISTIC K_UEXT_DIAG_MIN "Untere Grenze Versorgungsspannung | EN: Lower limit, supply voltage" VALUE 0x7A308 TKW_VV_VV_UW 100.0 FORMULA_1045 4.0000 5.0000 FORMAT "%5.2" /end CHARACTERISTIC
/begin CHARACTERISTIC K_UEXT_DIAG_MAX "Obere Grenze Versorgungsspannung | EN: Upper limit, supply voltage" VALUE 0x7A30A TKW_VV_VV_UW 100.0 FORMULA_1045 5.0000 6.0000 FORMAT "%5.2" /end CHARACTERISTIC
/begin CHARACTERISTIC K_UEXT_ERSATZ "Ersatzwert Versorgungsspannung | EN: Substitute value, supply voltage" VALUE 0x7A30C TKW_VV_VV_UW 100.0 FORMULA_1045 4.0000 6.0000 FORMAT "%5.2" /end CHARACTERISTIC
/begin MEASUREMENT uext_ad_pin_111_219_514 "AD-Wert Versorgungsspannungen" SWORD FORMULA_0123 0 0 0.0 1023.0000 ECU_ADDRESS 0x3FC5CA /end MEASUREMENT
/begin MEASUREMENT uext_ad_pin_124_512 "AD-Wert Versorgungsspannungen" SWORD FORMULA_0123 0 0 0.0 1023.0000 ECU_ADDRESS 0x3FC5CC /end MEASUREMENT
/begin MEASUREMENT uext_roh_pin_111_219_514 "Roh-Wert d. Versorgungsspannungen" UWORD FORMULA_0265 0 0 0.0 6.6665 ECU_ADDRESS 0x3FC5CE /end MEASUREMENT
/begin MEASUREMENT uext_roh_pin_124_512 "Roh-Wert d. Versorgungsspannungen" UWORD FORMULA_0265 0 0 0.0 6.6665 ECU_ADDRESS 0x3FC5D0 /end MEASUREMENT
/* ------------------ Abschnitt erzeugt aus uintern.dat ------------------ */
/begin CHARACTERISTIC K_UINTERN_AD_1_8_MAX "Maximaler AD-Wert interne Versorgungsspannung | EN: Maximum A/D value, internal supply voltage" VALUE 0x7A30E TKW_VV_VV_SW 100.0 FORMULA_0123 0.0 1023.0000 /end CHARACTERISTIC
/begin CHARACTERISTIC K_UINTERN_AD_1_8_MIN "Minimaler AD-Wert interne Versorgungsspannung | EN: Minimum A/D value, internal supply voltage" VALUE 0x7A310 TKW_VV_VV_SW 100.0 FORMULA_0123 0.0 1023.0000 /end CHARACTERISTIC
/begin CHARACTERISTIC K_UINTERN_AD_2_55_MAX "Maximaler AD-Wert interne Versorgungsspannung | EN: Maximum A/D value, internal supply voltage" VALUE 0x7A312 TKW_VV_VV_SW 100.0 FORMULA_0123 0.0 1023.0000 /end CHARACTERISTIC
/begin CHARACTERISTIC K_UINTERN_AD_2_55_MIN "Minimaler AD-Wert interne Versorgungsspannung | EN: Minimum A/D value, internal supply voltage" VALUE 0x7A314 TKW_VV_VV_SW 100.0 FORMULA_0123 0.0 1023.0000 /end CHARACTERISTIC
/begin CHARACTERISTIC K_UINTERN_AD_3_3_MAX "Maximaler AD-Wert interne Versorgungsspannung | EN: Maximum A/D value, internal supply voltage" VALUE 0x7A316 TKW_VV_VV_SW 100.0 FORMULA_0123 0.0 1023.0000 /end CHARACTERISTIC
/begin CHARACTERISTIC K_UINTERN_AD_3_3_MIN "Minimaler AD-Wert interne Versorgungsspannung | EN: Minimum A/D value, internal supply voltage" VALUE 0x7A318 TKW_VV_VV_SW 100.0 FORMULA_0123 0.0 1023.0000 /end CHARACTERISTIC
/begin CHARACTERISTIC K_UINTERN_FEHLER_ZAEHLER "Maximalwert des Fehlerfilters | EN: Maximum value of fault filter" VALUE 0x7A31A TKW_VV_VV_UW 100.0 FORMULA_0010 0.0 65535.0000 /end CHARACTERISTIC
/begin MEASUREMENT uintern_ad_1_8 "AD-Wert interne Versorgungsspannung" SWORD FORMULA_0123 0 0 0.0 1023.0000 ECU_ADDRESS 0x3FC5D2 /end MEASUREMENT
/begin MEASUREMENT uintern_ad_2_55 "AD-Wert interne Versorgungsspannung" SWORD FORMULA_0123 0 0 0.0 1023.0000 ECU_ADDRESS 0x3FC5D4 /end MEASUREMENT
/begin MEASUREMENT uintern_ad_3_3 "AD-Wert interne Versorgungsspannung" SWORD FORMULA_0123 0 0 0.0 1023.0000 ECU_ADDRESS 0x3FC5D6 /end MEASUREMENT
/begin MEASUREMENT uintern_fehler_zaehler_1_8 "Fehlerfilter" UWORD FORMULA_0010 0 0 0.0 65535.0000 ECU_ADDRESS 0x3FC5D8 /end MEASUREMENT
/begin MEASUREMENT uintern_fehler_zaehler_2_55 "Fehlerfilter" UWORD FORMULA_0010 0 0 0.0 65535.0000 ECU_ADDRESS 0x3FC5DA /end MEASUREMENT
/begin MEASUREMENT uintern_fehler_zaehler_3_3 "Fehlerfilter" UWORD FORMULA_0010 0 0 0.0 65535.0000 ECU_ADDRESS 0x3FC5DC /end MEASUREMENT
/* ------------------ Abschnitt erzeugt aus zust_ign.dat ------------------ */
/begin MEASUREMENT zustand_motor_ign "Betriebszustand der Motorsteuerung" UWORD FORMULA_0019 0 0 0.0 65535.0 ECU_ADDRESS 0x3FC72C /end MEASUREMENT
/begin FUNCTION TPU ""
 /begin DEF_CHARACTERISTIC K_TPU_IGN_MIN_SCI_POS K_TPU_IGN_MISS_FIRE_TIME K_TPU_KW_N_MIN K_TPU_KW_SYNC_ZAHN /end DEF_CHARACTERISTIC
 /begin REF_CHARACTERISTIC /end REF_CHARACTERISTIC
 /begin IN_MEASUREMENT /end IN_MEASUREMENT
 /begin OUT_MEASUREMENT tpu_a.CFSR01 tpu_a.CFSR23 tpu_a.CIER tpu_a.CISR tpu_a.CPR tpu_a.HSQR tpu_a.HSRR tpu_a.TICR tpu_a.TPUMCR tpu_a.TPUMCR2 tpu_a.TPUMCR3 tpu_a_pram_10of16_1of8_ tpu_a_pram_10of16_2of8_ tpu_a_pram_10of16_3of8_ tpu_a_pram_10of16_4of8_ tpu_a_pram_10of16_5of8_ tpu_a_pram_10of16_6of8_ tpu_a_pram_10of16_7of8_ tpu_a_pram_10of16_8of8_ tpu_a_pram_11of16_1of8_ tpu_a_pram_11of16_2of8_ tpu_a_pram_11of16_3of8_ tpu_a_pram_11of16_4of8_ tpu_a_pram_11of16_5of8_ tpu_a_pram_11of16_6of8_ tpu_a_pram_11of16_7of8_ tpu_a_pram_11of16_8of8_ tpu_a_pram_12of16_1of8_ tpu_a_pram_12of16_2of8_ tpu_a_pram_12of16_3of8_ tpu_a_pram_12of16_4of8_ tpu_a_pram_12of16_5of8_ tpu_a_pram_12of16_6of8_ tpu_a_pram_12of16_7of8_ tpu_a_pram_12of16_8of8_ tpu_a_pram_13of16_1of8_ tpu_a_pram_13of16_2of8_ tpu_a_pram_13of16_3of8_ tpu_a_pram_13of16_4of8_ tpu_a_pram_13of16_5of8_ tpu_a_pram_13of16_6of8_ tpu_a_pram_13of16_7of8_ tpu_a_pram_13of16_8of8_ tpu_a_pram_14of16_1of8_ tpu_a_pram_14of16_2of8_ tpu_a_pram_14of16_3of8_ tpu_a_pram_14of16_4of8_ tpu_a_pram_14of16_5of8_ tpu_a_pram_14of16_6of8_ tpu_a_pram_14of16_7of8_ tpu_a_pram_14of16_8of8_ tpu_a_pram_15of16_1of8_ tpu_a_pram_15of16_2of8_ tpu_a_pram_15of16_3of8_ tpu_a_pram_15of16_4of8_ tpu_a_pram_15of16_5of8_ tpu_a_pram_15of16_6of8_ tpu_a_pram_15of16_7of8_ tpu_a_pram_15of16_8of8_ tpu_a_pram_16of16_1of8_ tpu_a_pram_16of16_2of8_ tpu_a_pram_16of16_3of8_ tpu_a_pram_16of16_4of8_ tpu_a_pram_16of16_5of8_ tpu_a_pram_16of16_6of8_ tpu_a_pram_16of16_7of8_ tpu_a_pram_16of16_8of8_ tpu_a_pram_1of16_1of8_ tpu_a_pram_1of16_2of8_ tpu_a_pram_1of16_3of8_ tpu_a_pram_1of16_4of8_ tpu_a_pram_1of16_5of8_ tpu_a_pram_1of16_6of8_ tpu_a_pram_1of16_7of8_ tpu_a_pram_1of16_8of8_ tpu_a_pram_2of16_1of8_ tpu_a_pram_2of16_2of8_ tpu_a_pram_2of16_3of8_ tpu_a_pram_2of16_4of8_ tpu_a_pram_2of16_5of8_ tpu_a_pram_2of16_6of8_ tpu_a_pram_2of16_7of8_ tpu_a_pram_2of16_8of8_ tpu_a_pram_3of16_1of8_ tpu_a_pram_3of16_2of8_ tpu_a_pram_3of16_3of8_ tpu_a_pram_3of16_4of8_ tpu_a_pram_3of16_5of8_ tpu_a_pram_3of16_6of8_ tpu_a_pram_3of16_7of8_ tpu_a_pram_3of16_8of8_ tpu_a_pram_4of16_1of8_ tpu_a_pram_4of16_2of8_ tpu_a_pram_4of16_3of8_ tpu_a_pram_4of16_4of8_ tpu_a_pram_4of16_5of8_ tpu_a_pram_4of16_6of8_ tpu_a_pram_4of16_7of8_ tpu_a_pram_4of16_8of8_ tpu_a_pram_5of16_1of8_ tpu_a_pram_5of16_2of8_ tpu_a_pram_5of16_3of8_ tpu_a_pram_5of16_4of8_ tpu_a_pram_5of16_5of8_ tpu_a_pram_5of16_6of8_ tpu_a_pram_5of16_7of8_ tpu_a_pram_5of16_8of8_ tpu_a_pram_6of16_1of8_ tpu_a_pram_6of16_2of8_ tpu_a_pram_6of16_3of8_ tpu_a_pram_6of16_4of8_ tpu_a_pram_6of16_5of8_ tpu_a_pram_6of16_6of8_ tpu_a_pram_6of16_7of8_ tpu_a_pram_6of16_8of8_ tpu_a_pram_7of16_1of8_ tpu_a_pram_7of16_2of8_ tpu_a_pram_7of16_3of8_ tpu_a_pram_7of16_4of8_ tpu_a_pram_7of16_5of8_ tpu_a_pram_7of16_6of8_ tpu_a_pram_7of16_7of8_ tpu_a_pram_7of16_8of8_ tpu_a_pram_8of16_1of8_ tpu_a_pram_8of16_2of8_ tpu_a_pram_8of16_3of8_ tpu_a_pram_8of16_4of8_ tpu_a_pram_8of16_5of8_ tpu_a_pram_8of16_6of8_ tpu_a_pram_8of16_7of8_ tpu_a_pram_8of16_8of8_ tpu_a_pram_9of16_1of8_ tpu_a_pram_9of16_2of8_ tpu_a_pram_9of16_3of8_ tpu_a_pram_9of16_4of8_ tpu_a_pram_9of16_5of8_ tpu_a_pram_9of16_6of8_ tpu_a_pram_9of16_7of8_ tpu_a_pram_9of16_8of8_ tpu_b.CFSR01 tpu_b.CFSR23 tpu_b.CIER tpu_b.CISR tpu_b.CPR tpu_b.HSQR tpu_b.HSRR tpu_b.TICR tpu_b.TPUMCR tpu_b.TPUMCR2 tpu_b.TPUMCR3 tpu_b_pram_10of16_1of8_ tpu_b_pram_10of16_2of8_ tpu_b_pram_10of16_3of8_ tpu_b_pram_10of16_4of8_ tpu_b_pram_10of16_5of8_ tpu_b_pram_10of16_6of8_ tpu_b_pram_10of16_7of8_ tpu_b_pram_10of16_8of8_ tpu_b_pram_11of16_1of8_ tpu_b_pram_11of16_2of8_ tpu_b_pram_11of16_3of8_ tpu_b_pram_11of16_4of8_ tpu_b_pram_11of16_5of8_ tpu_b_pram_11of16_6of8_ tpu_b_pram_11of16_7of8_ tpu_b_pram_11of16_8of8_ tpu_b_pram_12of16_1of8_ tpu_b_pram_12of16_2of8_ tpu_b_pram_12of16_3of8_ tpu_b_pram_12of16_4of8_ tpu_b_pram_12of16_5of8_ tpu_b_pram_12of16_6of8_ tpu_b_pram_12of16_7of8_ tpu_b_pram_12of16_8of8_ tpu_b_pram_13of16_1of8_ tpu_b_pram_13of16_2of8_ tpu_b_pram_13of16_3of8_ tpu_b_pram_13of16_4of8_ tpu_b_pram_13of16_5of8_ tpu_b_pram_13of16_6of8_ tpu_b_pram_13of16_7of8_ tpu_b_pram_13of16_8of8_ tpu_b_pram_14of16_1of8_ tpu_b_pram_14of16_2of8_ tpu_b_pram_14of16_3of8_ tpu_b_pram_14of16_4of8_ tpu_b_pram_14of16_5of8_ tpu_b_pram_14of16_6of8_ tpu_b_pram_14of16_7of8_ tpu_b_pram_14of16_8of8_ tpu_b_pram_15of16_1of8_ tpu_b_pram_15of16_2of8_ tpu_b_pram_15of16_3of8_ tpu_b_pram_15of16_4of8_ tpu_b_pram_15of16_5of8_ tpu_b_pram_15of16_6of8_ tpu_b_pram_15of16_7of8_ tpu_b_pram_15of16_8of8_ tpu_b_pram_16of16_1of8_ tpu_b_pram_16of16_2of8_ tpu_b_pram_16of16_3of8_ tpu_b_pram_16of16_4of8_ tpu_b_pram_16of16_5of8_ tpu_b_pram_16of16_6of8_ tpu_b_pram_16of16_7of8_ tpu_b_pram_16of16_8of8_ tpu_b_pram_1of16_1of8_ tpu_b_pram_1of16_2of8_ tpu_b_pram_1of16_3of8_ tpu_b_pram_1of16_4of8_ tpu_b_pram_1of16_5of8_ tpu_b_pram_1of16_6of8_ tpu_b_pram_1of16_7of8_ tpu_b_pram_1of16_8of8_ tpu_b_pram_2of16_1of8_ tpu_b_pram_2of16_2of8_ tpu_b_pram_2of16_3of8_ tpu_b_pram_2of16_4of8_ tpu_b_pram_2of16_5of8_ tpu_b_pram_2of16_6of8_ tpu_b_pram_2of16_7of8_ tpu_b_pram_2of16_8of8_ tpu_b_pram_3of16_1of8_ tpu_b_pram_3of16_2of8_ tpu_b_pram_3of16_3of8_ tpu_b_pram_3of16_4of8_ tpu_b_pram_3of16_5of8_ tpu_b_pram_3of16_6of8_ tpu_b_pram_3of16_7of8_ tpu_b_pram_3of16_8of8_ tpu_b_pram_4of16_1of8_ tpu_b_pram_4of16_2of8_ tpu_b_pram_4of16_3of8_ tpu_b_pram_4of16_4of8_ tpu_b_pram_4of16_5of8_ tpu_b_pram_4of16_6of8_ tpu_b_pram_4of16_7of8_ tpu_b_pram_4of16_8of8_ tpu_b_pram_5of16_1of8_ tpu_b_pram_5of16_2of8_ tpu_b_pram_5of16_3of8_ tpu_b_pram_5of16_4of8_ tpu_b_pram_5of16_5of8_ tpu_b_pram_5of16_6of8_ tpu_b_pram_5of16_7of8_ tpu_b_pram_5of16_8of8_ tpu_b_pram_6of16_1of8_ tpu_b_pram_6of16_2of8_ tpu_b_pram_6of16_3of8_ tpu_b_pram_6of16_4of8_ tpu_b_pram_6of16_5of8_ tpu_b_pram_6of16_6of8_ tpu_b_pram_6of16_7of8_ tpu_b_pram_6of16_8of8_ tpu_b_pram_7of16_1of8_ tpu_b_pram_7of16_2of8_ tpu_b_pram_7of16_3of8_ tpu_b_pram_7of16_4of8_ tpu_b_pram_7of16_5of8_ tpu_b_pram_7of16_6of8_ tpu_b_pram_7of16_7of8_ tpu_b_pram_7of16_8of8_ tpu_b_pram_8of16_1of8_ tpu_b_pram_8of16_2of8_ tpu_b_pram_8of16_3of8_ tpu_b_pram_8of16_4of8_ tpu_b_pram_8of16_5of8_ tpu_b_pram_8of16_6of8_ tpu_b_pram_8of16_7of8_ tpu_b_pram_8of16_8of8_ tpu_b_pram_9of16_1of8_ tpu_b_pram_9of16_2of8_ tpu_b_pram_9of16_3of8_ tpu_b_pram_9of16_4of8_ tpu_b_pram_9of16_5of8_ tpu_b_pram_9of16_6of8_ tpu_b_pram_9of16_7of8_ tpu_b_pram_9of16_8of8_ tpu_bank tpu_code_status tpu_idx_a tpu_idx_b tpu_index tpu_kw_irq_a tpu_kw_irq_b tpu_kw_irq_cnt_a tpu_kw_irq_cnt_b tpu_kw_irq_error_a tpu_kw_irq_error_b tpu_kw_irq_info_a tpu_kw_irq_info_b tpu_kw_irq_mess_a tpu_kw_irq_mess_b tpu_kw_irq_n_min_a tpu_kw_irq_n_min_b tpu_kw_irq_pre_sync_a tpu_kw_irq_pre_sync_b tpu_kw_irq_segm_a tpu_kw_irq_segm_b tpu_kw_irq_segm_cnt_a tpu_kw_irq_segm_cnt_b tpu_kw_irq_sync_a tpu_kw_irq_sync_b tpu_kw_irq_tooth_a tpu_kw_irq_tooth_b tpu_kw_irq_tooth_cnt_a tpu_kw_irq_tooth_cnt_b tpu_kw_irq_zahn_a tpu_kw_irq_zahn_b tpu_kw_nw_sync_cnt_a tpu_kw_nw_sync_cnt_b tpu_kw_rot tpu_st_a tpu_st_b tpu_zyl tpu_zyl_bank tpu_zyl_p2 /end OUT_MEASUREMENT
/end FUNCTION
/begin FUNCTION Traegheitsmoment ""
 /begin DEF_CHARACTERISTIC K_J_AC K_J_FZG_DKG_1 K_J_FZG_DKG_2 K_J_FZG_DKG_3 K_J_FZG_DKG_4 K_J_FZG_DKG_5 K_J_FZG_DKG_6 K_J_FZG_DKG_7 K_J_FZG_DKG_N K_J_FZG_DKG_R K_J_FZG_HSG_1 K_J_FZG_HSG_2 K_J_FZG_HSG_3 K_J_FZG_HSG_4 K_J_FZG_HSG_5 K_J_FZG_HSG_6 K_J_FZG_HSG_7 K_J_FZG_HSG_N K_J_FZG_HSG_R K_J_FZG_SMG_1 K_J_FZG_SMG_2 K_J_FZG_SMG_3 K_J_FZG_SMG_4 K_J_FZG_SMG_5 K_J_FZG_SMG_6 K_J_FZG_SMG_7 K_J_FZG_SMG_N K_J_FZG_SMG_R K_J_MOTOR /end DEF_CHARACTERISTIC
 /begin REF_CHARACTERISTIC /end REF_CHARACTERISTIC
 /begin IN_MEASUREMENT /end IN_MEASUREMENT
 /begin OUT_MEASUREMENT j_fzg /end OUT_MEASUREMENT
/end FUNCTION
/begin FUNCTION Version ""
 /begin DEF_CHARACTERISTIC K_DATENKENNUNG_1_1of5_ K_DATENKENNUNG_1_2of5_ K_DATENKENNUNG_1_3of5_ K_DATENKENNUNG_1_4of5_ K_DATENKENNUNG_1_5of5_ K_DATENKENNUNG_2_1of5_ K_DATENKENNUNG_2_2of5_ K_DATENKENNUNG_2_3of5_ K_DATENKENNUNG_2_4of5_ K_DATENKENNUNG_2_5of5_ K_DATENKENNUNG_3_1of5_ K_DATENKENNUNG_3_2of5_ K_DATENKENNUNG_3_3of5_ K_DATENKENNUNG_3_4of5_ K_DATENKENNUNG_3_5of5_ K_VERS_DATEN K_VERS_NAME K_VERS_PROG K_VERS_PROZ /end DEF_CHARACTERISTIC
 /begin REF_CHARACTERISTIC /end REF_CHARACTERISTIC
 /begin IN_MEASUREMENT /end IN_MEASUREMENT
 /begin OUT_MEASUREMENT vers_index vers_name vers_prog vers_sg /end OUT_MEASUREMENT
/end FUNCTION
/begin FUNCTION Versorgungsspannungen ""
 /begin DEF_CHARACTERISTIC K_UEXT_DIAG_MAX K_UEXT_DIAG_MIN K_UEXT_ERSATZ K_UEXT_TAU K_UINTERN_AD_1_8_MAX K_UINTERN_AD_1_8_MIN K_UINTERN_AD_2_55_MAX K_UINTERN_AD_2_55_MIN K_UINTERN_AD_3_3_MAX K_UINTERN_AD_3_3_MIN K_UINTERN_FEHLER_ZAEHLER /end DEF_CHARACTERISTIC
 /begin REF_CHARACTERISTIC /end REF_CHARACTERISTIC
 /begin IN_MEASUREMENT /end IN_MEASUREMENT
 /begin OUT_MEASUREMENT uext_ad_pin_111_219_514 uext_ad_pin_124_512 uext_roh_pin_111_219_514 uext_roh_pin_124_512 uintern_ad_1_8 uintern_ad_2_55 uintern_ad_3_3 uintern_fehler_zaehler_1_8 uintern_fehler_zaehler_2_55 uintern_fehler_zaehler_3_3 /end OUT_MEASUREMENT
/end FUNCTION
/begin FUNCTION Zuendung ""
 /begin DEF_CHARACTERISTIC KF_TZ_GRUND KF_TZ_I KF_TZ_I_SZ KF_TZ_LL KF_TZ_MIN KF_TZ_VL KL_TZ_DBGR_OFFS KL_TZ_DBGR_TRIGGER KL_TZ_MIN_TMOT KL_TZ_PHASE KL_TZ_START_N KL_TZ_START_TMOT KL_TZ_SZ_LAM_OFFS KL_TZ_SZ_STARTOFFS_TIME KL_TZ_SZ_START_OFFS KL_TZ_SZ_TMOT_OFFS KL_TZ_TKORR_LL KL_TZ_TKORR_TL K_TZ_ABSCH_CTR K_TZ_DBGR_ANZ_SEG K_TZ_DBGR_AUFREG K_TZ_DBGR_DR_REL K_TZ_DBGR_DR_REL_TAU K_TZ_DBGR_TMOT K_TZ_DIAG_MAX_BESTR_TPU K_TZ_DN_ZWB K_TZ_GRAD_TAU K_TZ_ION_COIL K_TZ_I_BEGR K_TZ_I_SA_DELAY K_TZ_KH_RF_ZWB K_TZ_KH_ZWB_B1 K_TZ_KH_ZWB_B2 K_TZ_KH_ZWB_B3 K_TZ_KL15_NACHLAUF K_TZ_MAX K_TZ_MCS K_TZ_MCS_Z_ZYL1 K_TZ_MCS_Z_ZYL10 K_TZ_MCS_Z_ZYL2 K_TZ_MCS_Z_ZYL3 K_TZ_MCS_Z_ZYL4 K_TZ_MCS_Z_ZYL5 K_TZ_MCS_Z_ZYL6 K_TZ_MCS_Z_ZYL7 K_TZ_MCS_Z_ZYL8 K_TZ_MCS_Z_ZYL9 K_TZ_NZ_ANZ_B1 K_TZ_NZ_ANZ_B2 K_TZ_NZ_CHARGE K_TZ_NZ_DIS_CHARGE K_TZ_NZ_N_MAX K_TZ_RF_ZWB K_TZ_SZ_AUSS_DELAY K_TZ_SZ_CONTROL K_TZ_SZ_I_VERSCHL_OFFS K_TZ_SZ_MAX K_TZ_SZ_MCS K_TZ_UB_ERSATZ K_TZ_ZWB_B1 K_TZ_ZWB_B2 K_TZ_ZWB_B3 /end DEF_CHARACTERISTIC
 /begin REF_CHARACTERISTIC /end REF_CHARACTERISTIC
 /begin IN_MEASUREMENT /end IN_MEASUREMENT
 /begin OUT_MEASUREMENT tz_absch_ctr tz_dbgr_offs_1of2_ tz_dbgr_offs_2of2_ tz_dbgr_roh_1of2_ tz_dbgr_roh_2of2_ tz_diag_tpu_ctr_zyl1 tz_diag_tpu_ctr_zyl10 tz_diag_tpu_ctr_zyl2 tz_diag_tpu_ctr_zyl3 tz_diag_tpu_ctr_zyl4 tz_diag_tpu_ctr_zyl5 tz_diag_tpu_ctr_zyl6 tz_diag_tpu_ctr_zyl7 tz_diag_tpu_ctr_zyl8 tz_diag_tpu_ctr_zyl9 tz_dr_rel_grad_1of2_ tz_dr_rel_grad_2of2_ tz_dr_rel_grad_roh_1of2_ tz_dr_rel_grad_roh_2of2_ tz_grund_b1 tz_grund_b2 tz_grund_mw tz_kl15aus_count tz_mw_b1 tz_mw_b2 tz_mw_fil_b1 tz_mw_fil_b2 tz_phase tz_sa_delta tz_sa_offset tz_stat_b1 tz_stat_b2 tz_status tz_sz_auss_timer tz_sz_i_1of2_ tz_sz_i_2of2_ tz_sz_i_grund_1of2_ tz_sz_i_grund_2of2_ tz_sz_kerz_verschl_offs tz_sz_lam_offs_1of2_ tz_sz_lam_offs_2of2_ tz_sz_start_offs tz_sz_tmot_offs tz_sz_zyl1 tz_sz_zyl10 tz_sz_zyl2 tz_sz_zyl3 tz_sz_zyl4 tz_sz_zyl5 tz_sz_zyl6 tz_sz_zyl7 tz_sz_zyl8 tz_sz_zyl9 tz_tkorr tz_tl_vl_fak tz_ve_zyl1 tz_ve_zyl10 tz_ve_zyl2 tz_ve_zyl3 tz_ve_zyl4 tz_ve_zyl5 tz_ve_zyl6 tz_ve_zyl7 tz_ve_zyl8 tz_ve_zyl9 tz_vekr_10of10_ tz_vekr_1of10_ tz_vekr_2of10_ tz_vekr_3of10_ tz_vekr_4of10_ tz_vekr_5of10_ tz_vekr_6of10_ tz_vekr_7of10_ tz_vekr_8of10_ tz_vekr_9of10_ tz_vl_offs tz_zwb_1of2_ tz_zwb_2of2_ tz_zwb_incr tz_zyl1 tz_zyl10 tz_zyl2 tz_zyl3 tz_zyl4 tz_zyl5 tz_zyl6 tz_zyl7 tz_zyl8 tz_zyl9 /end OUT_MEASUREMENT
/end FUNCTION
/begin FUNCTION Zustand "" /begin DEF_CHARACTERISTIC /end DEF_CHARACTERISTIC /begin REF_CHARACTERISTIC /end REF_CHARACTERISTIC /begin IN_MEASUREMENT /end IN_MEASUREMENT /begin OUT_MEASUREMENT zustand_motor_ign /end OUT_MEASUREMENT /end FUNCTION
/begin FUNCTION aq ""
 /begin DEF_CHARACTERISTIC KL_AQ_ABS_DK KL_AQ_ABS_DK_ABW_MAX KL_AQ_ABS_LLS KL_AQ_ABS_LLS_ABW_MAX KL_AQ_IST_RF_TAU KL_AQ_RF_MAX_ROH K_AQ_DK0_DK_IST_SCHW K_AQ_DK0_LLS_AQ_SCHW K_AQ_DK_ABW_T_MIN K_AQ_DR_REL_GRAD_TAU K_AQ_LLS_ABW_T_MIN K_AQ_RF_RG_KORR_FAK /end DEF_CHARACTERISTIC
 /begin REF_CHARACTERISTIC /end REF_CHARACTERISTIC
 /begin IN_MEASUREMENT /end IN_MEASUREMENT
 /begin OUT_MEASUREMENT aq_abs_b1 aq_abs_b2 aq_abs_dk_b1 aq_abs_dk_b2 aq_abs_lls_b1 aq_abs_lls_b2 aq_abs_max_dk aq_abs_max_lls aq_abs_roh_b1 aq_abs_roh_b2 aq_rf_inv_b1 aq_rf_inv_b2 aq_rf_max_roh aq_rf_roh_b1 aq_rf_roh_b2 aq_rf_roh_fil_b1 aq_rf_roh_fil_b2 aq_rf_roh_inv_b1 aq_rf_roh_inv_b2 aq_rf_van_inv_b1 aq_rf_van_inv_b2 aq_tau_b1 aq_tau_b2 dr_rel_roh_b1 dr_rel_roh_b2 /end OUT_MEASUREMENT
/end FUNCTION
/begin FUNCTION diag_tr_ign "" /begin DEF_CHARACTERISTIC K_DIAG_TR_MAX_ERR /end DEF_CHARACTERISTIC /begin REF_CHARACTERISTIC /end REF_CHARACTERISTIC /begin IN_MEASUREMENT /end IN_MEASUREMENT
 /begin OUT_MEASUREMENT diag_st_atic29_ion1_spg diag_st_atic29_ion1_verst diag_st_atic29_ion2_spg diag_st_atic29_ion2_verst diag_st_atic29_nn diag_tr_atic29_error diag_tr_atic29_st diag_tr_atic29_tx_cnt /end OUT_MEASUREMENT
/end FUNCTION
/begin FUNCTION ioncom "" /begin DEF_CHARACTERISTIC /end DEF_CHARACTERISTIC /begin REF_CHARACTERISTIC /end REF_CHARACTERISTIC /begin IN_MEASUREMENT /end IN_MEASUREMENT /begin OUT_MEASUREMENT ioncom_destaddr /end OUT_MEASUREMENT /end FUNCTION
/begin RECORD_LAYOUT TKW_VV_VV_UB FNC_VALUES 1 UBYTE COLUMN_DIR DIRECT /end RECORD_LAYOUT
/begin RECORD_LAYOUT TKW_VV_VV_UW FNC_VALUES 1 UWORD COLUMN_DIR DIRECT /end RECORD_LAYOUT
/begin RECORD_LAYOUT TKW_VV_VV_SW FNC_VALUES 1 SWORD COLUMN_DIR DIRECT /end RECORD_LAYOUT
/begin RECORD_LAYOUT TKL_UW_VV_UW NO_AXIS_PTS_X 1 UBYTE RESERVED 2 BYTE AXIS_PTS_X 3 UWORD INDEX_INCR DIRECT FNC_VALUES 4 UWORD COLUMN_DIR DIRECT /end RECORD_LAYOUT
/begin RECORD_LAYOUT TKL_UW_VV_SW NO_AXIS_PTS_X 1 UBYTE RESERVED 2 BYTE AXIS_PTS_X 3 UWORD INDEX_INCR DIRECT FNC_VALUES 4 SWORD COLUMN_DIR DIRECT /end RECORD_LAYOUT
/begin RECORD_LAYOUT TKL_SW_VV_UW NO_AXIS_PTS_X 1 UBYTE RESERVED 2 BYTE AXIS_PTS_X 3 SWORD INDEX_INCR DIRECT FNC_VALUES 4 UWORD COLUMN_DIR DIRECT /end RECORD_LAYOUT
/begin RECORD_LAYOUT TKL_SW_VV_SW NO_AXIS_PTS_X 1 UBYTE RESERVED 2 BYTE AXIS_PTS_X 3 SWORD INDEX_INCR DIRECT FNC_VALUES 4 SWORD COLUMN_DIR DIRECT /end RECORD_LAYOUT
/begin RECORD_LAYOUT TKF_SW_SW_SW NO_AXIS_PTS_X 1 UBYTE NO_AXIS_PTS_Y 2 UBYTE AXIS_PTS_X 3 SWORD INDEX_INCR DIRECT AXIS_PTS_Y 4 SWORD INDEX_INCR DIRECT FNC_VALUES 5 SWORD COLUMN_DIR DIRECT /end RECORD_LAYOUT
/end MODULE
/end PROJECT
